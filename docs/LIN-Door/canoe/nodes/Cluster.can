/*
 * Cluster.can — Instrument Cluster
 *
 * 역할: BCM_FaultStatus 수신 → RED 경고등 활성화/소등 제어
 * 채널: CAN-HS (500kbps)
 * DBC: vehicle_system.dbc — BCM_FaultStatus (라우팅 후 CAN-HS), Cluster_Display
 *
 * V-Model: SWE.3/SWE.6 (구현) → SWE.4 (05_Unit_Test.md 단위 테스트로 검증)
 * ISO 26262: Part 6, Clause 8
 */

includes
{
}

variables
{
  msTimer tWarnLampCheck;        // 50ms 주기 경고등 상태 확인

  int gWarnLampRed  = 0;         // RED 경고등 상태 (0: 소등, 1: 점등)
  int gLastFaultVal = 0;         // 이전 Fault 상태 (변화 감지용)
}

/*============================================================
 * 초기화
 *============================================================*/
on start
{
  write("[Cluster] 노드 시작 — 경고등 소등 상태");
  @Cluster::warnLampRed = 0;
}

/*============================================================
 * BCM_FaultStatus 수신 (CAN-HS로 라우팅된 메시지)
 * - Gateway가 CAN-LS → CAN-HS로 복사한 0x500 메시지 수신
 * - 수신 후 50ms 이내 경고등 활성화
 *============================================================*/
on message BCM_FaultStatus
{
  int faultVal;
  faultVal = this.WindowMotorOvercurrent;

  if (faultVal == 1 && gWarnLampRed == 0)
  {
    activateWarnLamp();
  }
}

/*============================================================
 * 경고등 활성화 함수
 *============================================================*/
void activateWarnLamp()
{
  gWarnLampRed          = 1;
  @Cluster::warnLampRed = 1;
  write("[Cluster] 🔴 RED 경고등 점등 — Window Motor 과전류 감지");
}

/*============================================================
 * 경고등 소등 함수
 *============================================================*/
void deactivateWarnLamp()
{
  gWarnLampRed          = 0;
  @Cluster::warnLampRed = 0;
  write("[Cluster] ⚪ 경고등 소등 — DTC 클리어 완료");
}

/*============================================================
 * UDS_Response 수신 — DTC 클리어 응답 감지 (0x54)
 *============================================================*/
on message UDS_Response
{
  byte responseCode;
  responseCode = this.byte(0);

  if (responseCode == 0x54)   // PositiveResponse for ClearDTC (0x14)
  {
    deactivateWarnLamp();
  }
}
