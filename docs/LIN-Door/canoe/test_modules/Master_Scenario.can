/*
 * Master_Scenario.can — E2E Automated Test Module
 *
 * 역할: 전체 시나리오(Fault → Gateway → UDS → OTA) 순차 자동 실행 및 검증
 * 실행: CANoe → Test Setup → Add Test Module → Master_Scenario.can
 *
 * V-Model: SWE.5/SYS.5 (통합/시스템 테스트 자동화)
 * ISO 26262: Part 6, Clause 10 (Test Case Automation)
 */

includes
{
}

variables
{
  /* 테스트 결과 기록용 */
  char gTestStep[100];
}

/*============================================================
 * 메인 테스트 함수
 *============================================================*/
void MainTest()
{
  testModuleTitle("E2E Master Scenario Test");
  testModuleDescription("Fault Detection → Gateway Routing → UDS Diagnostics → OTA Update 전체 검증");

  /* 1. 초기화 및 준비 */
  TC_00_Initialize();

  /* 2. 고장 감지 시나리오 */
  TC_01_Fault_Detection();

  /* 3. 진단 서비스 시나리오 */
  TC_02_UDS_Diagnostics();

  /* 4. OTA 업데이트 시나리오 */
  TC_03_OTA_Update();

  /* 5. 결과 정리 */
  TC_99_Cleanup();
}

/*============================================================
 * TC_00: 시스템 초기화 확인
 *============================================================*/
testcase TC_00_Initialize()
{
  testCaseTitle("TC_00", "시스템 초기화 상태 점검");
  testCaseDescription("모든 노드와 변수가 초기 상태(0)인지 확인");

  /* 변수 초기화 */
  @BCM::overcurrentDetected = 0;
  @UDS::currentSession      = 1;   // Default Session
  @OTA::otaInProgress       = 0;

  /* 1초 대기 후 상태 확인 */
  testWaitForTimeout(1000);

  if (@BCM::faultActive == 0 && @Cluster::warnLampRed == 0)
    testStepPass("Init", "시스템 초기화 완료 (Fault: 0, Warning: 0)");
  else
    testStepFail("Init", "초기화 실패 (Fault 또는 Warning 활성 상태)");
}

/*============================================================
 * TC_01: 고장 감지 및 경고등 점등 (Requirements 1, 2, 3)
 *============================================================*/
testcase TC_01_Fault_Detection()
{
  testCaseTitle("TC_01", "고장 감지 및 경고등 점등");
  testCaseDescription("과전류 주입 → DTC 생성 → 경고등 활성화까지 End-to-End 검증");

  /* 1. 과전류 주입 */
  testStep("Action", "과전류(Fault) 주입");
  @BCM::overcurrentDetected = 1;

  /* 2. DTC 생성 확인 (최대 100ms 대기) */
  if (testWaitForSysVar(@BCM::faultActive, 100) == 1)
  {
    if (@BCM::faultActive == 1)
      testStepPass("Check DTC", "BCM DTC B1234 생성 확인");
    else
      testStepFail("Check DTC", "BCM DTC 생성 실패");
  }
  else
  {
    testStepFail("Check DTC", "DTC 생성 타임아웃");
  }

  /* 3. Cluster 경고등 점등 확인 (최대 200ms 대기 - 라우팅 지연 포함) */
  if (testWaitForSysVar(@Cluster::warnLampRed, 200) == 1)
  {
    if (@Cluster::warnLampRed == 1)
      testStepPass("Check Lamp", "Cluster RED 경고등 점등 확인");
    else
      testStepFail("Check Lamp", "Cluster 경고등 점등 실패");
  }
  else
  {
    testStepFail("Check Lamp", "경고등 반응 타임아웃");
  }
}

/*============================================================
 * TC_02: UDS 진단 서비스 (Requirements 8, 9, 10)
 *============================================================*/
testcase TC_02_UDS_Diagnostics()
{
  testCaseTitle("TC_02", "UDS 진단: 세션 전환 및 DTC 확인");
  testCaseDescription("Extended Session 전환 → DTC 조회 → DTC 클리어 검증");

  /* 1. Extended Session(0x03) 전환 */
  testStep("Action", "UDS 0x10 0x03 요청");
  @UDS::lastServiceID = 0x10; 
  // 실제 Tester 노드가 0x10 요청을 보내도록 트리거 (Tester.can의 sysvar 이벤트 활용)
  // 주의: Tester.can에서 @UDS::lastServiceID 변경 시 동작하도록 구현되어 있어야 함

  // 세션 변경 확인 (최대 1000ms)
  if (testWaitForSysVar(@UDS::currentSession, 1000) == 1)
  {
    if (@UDS::currentSession == 3)
      testStepPass("Session", "Extended Session 전환 성공");
    else
      testStepFail("Session", "세션 전환 실패 (Current: %d)", @UDS::currentSession);
  }

  /* 2. DTC 클리어 (0x14) */
  testStep("Action", "UDS 0x14 DTC 클리어 요청");
  @UDS::lastServiceID = 0x14;

  // 클리어 완료 확인
  if (testWaitForSysVar(@UDS::dtcCleared, 1000) == 1)
  {
    if (@UDS::dtcCleared == 1)
      testStepPass("Clear DTC", "DTC 클리어 응답 수신");
    else
      testStepFail("Clear DTC", "DTC 클리어 실패");
  }

  /* 3. 경고등 소등 확인 */
  testWaitForTimeout(200); // 처리 시간 대기
  if (@Cluster::warnLampRed == 0)
    testStepPass("Check Lamp", "Cluster 경고등 소등 확인");
  else
    testStepFail("Check Lamp", "경고등 소등 실패");
}

/*============================================================
 * TC_03: OTA 업데이트 (Requirements 11, 12, 13)
 *============================================================*/
testcase TC_03_OTA_Update()
{
  testCaseTitle("TC_03", "OTA 펌웨어 업데이트");
  testCaseDescription("OTA 시작 → 블록 전송 → CRC 검증 완료까지");

  /* 1. OTA 시작 */
  testStep("Action", "OTA 업데이트 트리거");
  @OTA::otaInProgress = 1;

  /* 2. 완료 대기 (최대 10초) */
  // 성공적으로 완료되면 @OTA::crcMatch가 1이 됨
  long result;
  result = testWaitForSysVar(@OTA::crcMatch, 10000);

  if (result == 1 && @OTA::crcMatch == 1)
  {
    testStepPass("OTA Complete", "OTA 업데이트 및 CRC 검증 성공");
  }
  else
  {
    testStepFail("OTA Complete", "OTA 업데이트 타임아웃 또는 실패");
  }
}

/*============================================================
 * TC_99: 정리
 *============================================================*/
testcase TC_99_Cleanup()
{
  testCaseTitle("TC_99", "테스트 종료 및 정리");
  
  @BCM::overcurrentDetected = 0;
  @OTA::otaInProgress = 0;
  @UDS::currentSession = 1;
}
