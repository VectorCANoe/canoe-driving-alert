/*
 * Ambulance_Node.can — V2V Ambulance Emergency Vehicle
 *
 * 역할:
 *   - Panel [긴급 출동] 버튼 → sysvar V2V::Ambulance_Active = 1
 *   - Panel [해제] 버튼      → sysvar V2V::Ambulance_Active = 0
 *   - 긴급 활성 시 500ms 주기 keepAlive 브로드캐스트 (ETH 시뮬)
 *
 * 우선순위: Ambulance > Police (Req_029)
 *   경찰차와 구급차가 동시 활성일 때 Civ_Node Arbiter가 구급차를 우선 선택.
 *
 * Ethernet 시뮬레이션 방식:
 *   실제 배포 시:
 *     data[0]=VEHICLE_TYPE_AMBULANCE(2), data[1]=Status, data[2]=Direction, data[3]=ETA
 *     UdpSocket::SendTo(gSocket, "255.255.255.255", 5000, data, 4)
 *   CANoe SIL: sysvar V2V::Ambulance_* 경유, Police_Node와 동일 구조.
 *
 * Panel 연결 sysvar:
 *   V2V::Ambulance_Active     — [긴급 출동] 토글 버튼 (0/1)
 *   V2V::Ambulance_Direction  — 방향 선택 (0=Front 1=Left 2=Right 3=Rear)
 *   V2V::Ambulance_ETA        — ETA TrackBar (0~999초)
 *
 * V-Model: SWE.3 (구현)
 * Req 추적: Req_018 (구급차 접근 경고), Req_029 (구급 우선순위)
 */

includes
{
}

variables
{
  /* 타이머 */
  msTimer tAmbulanceAlive;          /* 500ms keepAlive 브로드캐스트 */

  /* 상태 */
  int    gAmbulanceActive         = 0;
  int    gAmbulanceDispatchCount  = 0;

  /* 상수 */
  const int VEHICLE_TYPE_AMBULANCE = 2;
  const int STATUS_ACTIVE          = 1;
  const int STATUS_CLEAR           = 0;
  const int KEEPALIVE_PERIOD_MS    = 500;
}

/*============================================================
 * 초기화
 *============================================================*/
on start
{
  write("[Ambulance_Node] 노드 시작 — 대기 중 (긴급 출동 대기)");
}

/*============================================================
 * Panel [긴급 출동] / [해제] 버튼 수신
 * Req_018: 구급차 긴급 접근 시 일반차에 즉시 경고 전달
 * Req_029: Ambulance > Police 우선순위 (Arbiter에서 처리)
 *============================================================*/
on sysvar V2V::Ambulance_Active
{
  if (@V2V::Ambulance_Active == STATUS_ACTIVE)
  {
    gAmbulanceActive = 1;
    gAmbulanceDispatchCount++;

    write("[Ambulance_Node] ★ 긴급 출동 #%d 브로드캐스트 시작",
          gAmbulanceDispatchCount);
    write("[Ambulance_Node]   VehicleType=AMBULANCE  Status=ACTIVE  Direction=%d  ETA=%ds",
          @V2V::Ambulance_Direction, @V2V::Ambulance_ETA);
    write("[Ambulance_Node]   [ETH UDP] → 255.255.255.255:5000 브로드캐스트 (SIL: sysvar 경유)");
    write("[Ambulance_Node]   ※ 경찰차 동시 활성 시에도 구급차 우선 (Req_029)");

    setTimer(tAmbulanceAlive, KEEPALIVE_PERIOD_MS);
  }
  else
  {
    gAmbulanceActive = 0;
    cancelTimer(tAmbulanceAlive);

    write("[Ambulance_Node] 긴급 해제 브로드캐스트");
    write("[Ambulance_Node]   VehicleType=AMBULANCE  Status=CLEAR");
  }
}

/*============================================================
 * ETA / Direction 변경 감지 (활성 중 업데이트)
 *============================================================*/
on sysvar V2V::Ambulance_ETA
{
  if (gAmbulanceActive == 1)
  {
    write("[Ambulance_Node] ETA 업데이트 → %ds (긴급 활성 중)", @V2V::Ambulance_ETA);
  }
}

on sysvar V2V::Ambulance_Direction
{
  if (gAmbulanceActive == 1)
  {
    write("[Ambulance_Node] 방향 업데이트 → %d (긴급 활성 중)", @V2V::Ambulance_Direction);
  }
}

/*============================================================
 * keepAlive 타이머 (500ms 주기)
 *============================================================*/
on timer tAmbulanceAlive
{
  if (gAmbulanceActive == 1)
  {
    write("[Ambulance_Node] keepAlive broadcast (AMBULANCE ACTIVE | ETA=%ds | Dir=%d)",
          @V2V::Ambulance_ETA, @V2V::Ambulance_Direction);
    setTimer(tAmbulanceAlive, KEEPALIVE_PERIOD_MS);
  }
}
