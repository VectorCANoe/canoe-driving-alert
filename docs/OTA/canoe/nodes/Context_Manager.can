/*
 * Context_Manager.can — Navigation Context Manager
 *
 * 역할:
 *   - Panel sysvar(gRoadZone, gVehicleSpeed, gSteeringInput) 수신
 *   - 구간별 제한속도 초과 → gWarningLevel 설정
 *   - 고속도로(Zone 2) 10초 조향 없음 → gWarningLevel 설정
 *   - Vehicle_Context CAN 메시지 (0x100) 10ms 주기 브로드캐스트
 *
 * 채널: CAN HS 500kbps (송신 전용)
 * DBC: emergency_system.dbc — Vehicle_Context (0x100)
 *
 * V-Model: SYS.3 / SWE.3 (기능 명세 → 구현)
 * Req 추적: Req_007~Req_016 (구간 인식 경고)
 */

includes
{
}

variables
{
  /* 타이머 */
  msTimer tContextTx;          /* 10ms 주기 CAN 브로드캐스트 */
  msTimer tHighwaySteer;       /* 고속도로 조향 감시 (10초) */

  /* 구간 상태 */
  double gSpeed        = 60.0; /* 현재 차속 (km/h) */
  int    gZone         = 0;    /* 현재 구간 (0~3) */
  int    gNavDir       = 0;    /* IC 방향 (0=좌, 1=우) */
  int    gSteering     = 1;    /* 0=조향없음, 1=조향있음 */
  int    gWarningLvl   = 0;    /* 경고 레벨 (0=없음, 1=경고) */
  int    gAliveCounter = 0;

  /* 구간별 제한속도 (km/h) */
  const double LIMIT_NORMAL  = 80.0;
  const double LIMIT_SCHOOL  = 30.0;
  const double LIMIT_HIGHWAY = 110.0;

  /* 고속도로 조향 타임아웃 */
  const int STEER_TIMEOUT_MS = 10000; /* 10초 */
}

/*============================================================
 * 초기화
 *============================================================*/
on start
{
  write("[Context_Manager] 노드 시작 — 구간 인식 + 경고 레벨 관리");

  /* Panel sysvar 초기값 동기화 */
  gSpeed    = @Navigation::gVehicleSpeed;
  gZone     = @Navigation::gRoadZone;
  gNavDir   = @Navigation::gNavDirection;
  gSteering = @Navigation::gSteeringInput;

  evaluateWarning();
  setTimer(tContextTx, 10);
}

/*============================================================
 * Panel sysvar 수신 — gRoadZone 변경 (구간 전환)
 * Req_007: 구간 정보 변경 시 해당 구간 경고 규칙으로 전환
 *============================================================*/
on sysvar Navigation::gRoadZone
{
  int prevZone;
  prevZone = gZone;
  gZone    = @Navigation::gRoadZone;

  if (prevZone != gZone)
  {
    /* 구간 전환 시 조향 타이머·경고 레벨 초기화 */
    cancelTimer(tHighwaySteer);
    gWarningLvl              = 0;
    @Arbiter::gWarningLevel  = 0;

    write("[Context_Manager] 구간 전환: Zone %d → Zone %d", prevZone, gZone);

    /* 고속도로 진입 + 이미 조향 없음 → 타이머 즉시 시작 */
    if (gZone == 2 && gSteering == 0)
    {
      setTimer(tHighwaySteer, STEER_TIMEOUT_MS);
      write("[Context_Manager] 고속도로 진입, 조향 없음 → 10초 감시 시작");
    }
  }

  evaluateWarning();
}

/*============================================================
 * Panel sysvar 수신 — gVehicleSpeed 변경
 * Req_010: 스쿨존 제한속도 초과 시 즉시 경고
 *============================================================*/
on sysvar Navigation::gVehicleSpeed
{
  gSpeed = @Navigation::gVehicleSpeed;
  evaluateWarning();
}

/*============================================================
 * Panel sysvar 수신 — gNavDirection 변경 (IC 방향)
 *============================================================*/
on sysvar Navigation::gNavDirection
{
  gNavDir = @Navigation::gNavDirection;
}

/*============================================================
 * Panel sysvar 수신 — gSteeringInput 변경
 * Req_011: 고속도로 장시간 조향 없음 → 주의 경고
 * Req_012: 조향 복귀 시 경고 해제
 *============================================================*/
on sysvar Navigation::gSteeringInput
{
  gSteering = @Navigation::gSteeringInput;

  if (gZone == 2)
  {
    if (gSteering == 0)
    {
      /* 조향 없음 → 10초 카운트다운 시작 */
      setTimer(tHighwaySteer, STEER_TIMEOUT_MS);
      write("[Context_Manager] 고속도로 조향 감시 시작 (10초 카운트다운)");
    }
    else
    {
      /* 조향 복귀 → 타이머 취소, 경고 해제 */
      cancelTimer(tHighwaySteer);
      if (gWarningLvl > 0)
      {
        gWarningLvl             = 0;
        @Arbiter::gWarningLevel = 0;
        write("[Context_Manager] 고속도로 조향 복귀 → 경고 해제");
      }
    }
  }
}

/*============================================================
 * 고속도로 조향 타임아웃 (10초 경과)
 * Req_011: 장시간 조향 입력 없을 때 주의 경고 발생
 *============================================================*/
on timer tHighwaySteer
{
  if (gZone == 2 && gSteering == 0)
  {
    gWarningLvl             = 1;
    @Arbiter::gWarningLevel = gWarningLvl;
    write("[Context_Manager] ⚠ 고속도로 10초 조향 없음 → WarningLevel=1");
  }
}

/*============================================================
 * 경고 레벨 평가 함수
 * - 구간별 제한속도 대비 현재 속도 비교
 * - IC 구간(Zone 3)은 속도 경고 없음 (방향 안내만)
 *============================================================*/
void evaluateWarning()
{
  int    newLevel = 0;
  double limit    = 0.0;

  /* 구간별 제한속도 결정 */
  switch (gZone)
  {
    case 0: limit = LIMIT_NORMAL;  break;
    case 1: limit = LIMIT_SCHOOL;  break;
    case 2: limit = LIMIT_HIGHWAY; break;
    case 3: limit = 0.0;           break; /* IC: 속도 경고 없음 */
    default: limit = LIMIT_NORMAL; break;
  }

  /* 제한속도 초과 시 경고 레벨 1 */
  if (gZone != 3 && limit > 0.0 && gSpeed > limit)
  {
    newLevel = 1;
    write("[Context_Manager] 속도 초과: %.1f > %.1f km/h (Zone=%d)",
          gSpeed, limit, gZone);
  }

  /* 변경된 경우만 업데이트 */
  if (newLevel != gWarningLvl)
  {
    gWarningLvl             = newLevel;
    @Arbiter::gWarningLevel = gWarningLvl;
  }
}

/*============================================================
 * Vehicle_Context CAN 브로드캐스트 (10ms 주기)
 * 수신: Civ_Node, Ambient_ECU, Cluster_ECU
 *============================================================*/
on timer tContextTx
{
  message Vehicle_Context txMsg;

  /* Vehicle_Speed: factor=0.1 → raw = physical * 10 */
  txMsg.Vehicle_Speed  = (word)(gSpeed * 10.0);
  txMsg.RoadZone       = gZone;
  txMsg.WarningLevel   = gWarningLvl;
  txMsg.SteeringActive = gSteering;
  txMsg.NavDirection   = gNavDir;
  txMsg.AliveCounter   = gAliveCounter;
  txMsg.Checksum       = (gAliveCounter ^ gZone ^ gWarningLvl) & 0x0F;

  output(txMsg);

  gAliveCounter = (gAliveCounter + 1) & 0x0F;
  setTimer(tContextTx, 10);
}
