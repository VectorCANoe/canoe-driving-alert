includes
{
}

variables
{
}

on start
{
  write("[INFOTAINMENT_GW] absorbed into IVI runtime; wrapper only");
}
