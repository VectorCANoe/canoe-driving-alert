includes
{
}

variables
{
  msTimer tInfoExt100;
  int gLastIviDiagSid;
  int gLastIviDiagDidHigh;
  int gLastIviDiagDidLow;
}

int clampRange(int value, int minValue, int maxValue)
{
  if (value < minValue)
  {
    return minValue;
  }
  if (value > maxValue)
  {
    return maxValue;
  }
  return value;
}

on start
{
  gLastIviDiagSid = 0x22;
  gLastIviDiagDidHigh = 0xF1;
  gLastIviDiagDidLow = 0x90;
  setTimer(tInfoExt100, 100);
  write("[INFOTAINMENT_GW] start");
}

on message frmNavContextCanMsg
{
  int roadZone;
  int navDirection;
  int zoneDistance;
  int speedLimit;

  roadZone = clampRange(this.gRoadZone, 0, 3);
  navDirection = clampRange(this.gNavDirection, 0, 3);
  zoneDistance = clampRange(this.gZoneDistance, 0, 255);
  speedLimit = clampRange(this.gSpeedLimit, 0, 255);
  @Infotainment::roadZone = roadZone;
  @Infotainment::navDirection = navDirection;
  @Infotainment::zoneDistance = zoneDistance;
  @Infotainment::speedLimit = speedLimit;
}

on message frmIviDiagReqMsg
{
  gLastIviDiagSid = clampRange(this.IviDiagServiceId, 0, 255);
  gLastIviDiagDidHigh = clampRange(this.IviDiagDidHigh, 0, 255);
  gLastIviDiagDidLow = clampRange(this.IviDiagDidLow, 0, 255);
}

on timer tInfoExt100
{
  message frmMapRenderStateMsg mMap;
  message frmRouteAlertMsg mRoute;
  message frmTrafficEventMsg mTraffic;
  message frmConnectivityStateMsg mConn;
  message frmIviHealthDetailMsg mHealthDetail;
  message frmIviDiagResMsg mDiagRes;
  int roadZone;
  int navDirection;
  int zoneDistance;
  int speedLimit;

  roadZone = clampRange((int)@Infotainment::roadZone, 0, 3);
  navDirection = clampRange((int)@Infotainment::navDirection, 0, 3);
  zoneDistance = clampRange((int)@Infotainment::zoneDistance, 0, 255);
  speedLimit = clampRange((int)@Infotainment::speedLimit, 0, 255);

  mMap.MapRenderState = 1;
  mMap.ZoomLevel = (roadZone == 2) ? 12 : 16;
  mMap.TileLoadPercent = 95;
  output(mMap);

  mRoute.RouteAlertType = roadZone;
  mRoute.RouteAlertPrio = (roadZone == 1) ? 5 : 2;
  mRoute.RouteAlertActive = (roadZone > 0) ? 1 : 0;
  mRoute.RouteAlertEta = zoneDistance;
  output(mRoute);

  mTraffic.TrafficEventType = roadZone;
  mTraffic.TrafficSeverity = (roadZone == 1) ? 7 : 2;
  mTraffic.TrafficDistance = zoneDistance;
  output(mTraffic);

  mConn.ConnectivityType = 1;
  mConn.ConnectivityState = 1;
  mConn.SignalBars = 4;
  output(mConn);

  mHealthDetail.IviCpuLoad = (speedLimit > 100) ? 45 : 35;
  mHealthDetail.IviMemLoad = 40;
  output(mHealthDetail);

  mDiagRes.IviDiagRespCode = 0x62;
  mDiagRes.IviDiagData0 = gLastIviDiagDidHigh & 0xFF;
  mDiagRes.IviDiagData1 = gLastIviDiagDidLow & 0xFF;
  output(mDiagRes);

  setTimer(tInfoExt100, 100);
}
