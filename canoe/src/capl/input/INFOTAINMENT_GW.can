includes
{
}

variables
{
}

int clampRange(int value, int minValue, int maxValue)
{
  if (value < minValue)
  {
    return minValue;
  }
  if (value > maxValue)
  {
    return maxValue;
  }
  return value;
}

on start
{
  write("[INFOTAINMENT_GW] start");
}

on message frmNavContextCanMsg
{
  int roadZone;
  int navDirection;
  int zoneDistance;

  roadZone = clampRange(this.gRoadZone, 0, 3);
  navDirection = clampRange(this.gNavDirection, 0, 3);
  zoneDistance = clampRange(this.gZoneDistance, 0, 255);
  @Infotainment::roadZone = roadZone;
  @Infotainment::navDirection = navDirection;
  @Infotainment::zoneDistance = zoneDistance;
}
