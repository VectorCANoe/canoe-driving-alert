includes
{
}

variables
{
  msTimer tChassisBase100;
  int gChassisAliveCnt;
}

int clampRange(int value, int minValue, int maxValue)
{
  if (value < minValue)
  {
    return minValue;
  }
  if (value > maxValue)
  {
    return maxValue;
  }
  return value;
}

on start
{
  gChassisAliveCnt = 0;
  setTimer(tChassisBase100, 100);
  write("[CHASSIS_GW] start");
}

on message frmVehicleStateCanMsg
{
  int speed;
  int driveState;

  speed = clampRange(this.gVehicleSpeed, 0, 255);
  driveState = clampRange(this.gDriveState, 0, 3);

  @Core::vehicleSpeedNorm = speed;
  @Core::driveStateNorm = driveState;
}

on message frmSteeringCanMsg
{
  int steering;

  steering = clampRange(this.SteeringInput, 0, 1);
  @Core::steeringInputNorm = steering;
}

on timer tChassisBase100
{
  message frmSteeringStateCanMsg mSteerState;
  message frmChassisHealthMsg mHealth;
  int steeringNorm;

  steeringNorm = clampRange((int)@Core::steeringInputNorm, 0, 1);
  mSteerState.SteeringState = steeringNorm;
  output(mSteerState);

  mHealth.ChassisAliveCnt = gChassisAliveCnt & 0xFF;
  mHealth.ChassisDiagState = 0;
  mHealth.ChassisFailCode = 0;
  output(mHealth);
  gChassisAliveCnt = (gChassisAliveCnt + 1) & 0xFF;

  setTimer(tChassisBase100, 100);
}
