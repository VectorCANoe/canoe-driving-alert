includes
{
  #define DIAG_TARGET_IVI 1
  #define DIAG_TARGET_CLU 2
  #define DIAG_TARGET_ADAS 3
  #define DIAG_TARGET_VCU 4
  #define DIAG_TARGET_ESC 5
  #define DIAG_TARGET_BCM 6
  #define DIAG_TARGET_TMU 7
  #define DIAG_TARGET_DATC 8
  #define DIAG_TARGET_SCC 9
  #define DIAG_TARGET_HUD 10
  #define DIAG_TARGET_AMP 11
  #define DIAG_TARGET_DMS 12
  #define DIAG_TARGET_OMS 13
  #define DIAG_TARGET_V2X 14
  #define DIAG_TARGET_CGW 15
  #define DIAG_TARGET_SGW 16
  #define DIAG_TARGET_DCM 17
  #define DIAG_TARGET_ABS 18
  #define DIAG_TARGET_EPB 19
  #define DIAG_TARGET_TPMS 20
  #define DIAG_TARGET_SAS 21
  #define DIAG_TARGET_VSM 22
  #define DIAG_TARGET_EHB 23
  #define DIAG_TARGET_ECS 24
  #define DIAG_TARGET_CDC 25
  #define DIAG_TARGET_ACU 26
  #define DIAG_TARGET_ODS 27
  #define DIAG_TARGET_SMK 28
  #define DIAG_TARGET_AFLS 29
  #define DIAG_TARGET_WIP 30

  #define DIAG_BUS_ETH 1
  #define DIAG_BUS_POWERTRAIN 2
  #define DIAG_BUS_CHASSIS 3
  #define DIAG_BUS_BODY 4
  #define DIAG_BUS_INFOTAINMENT 5
  #define DIAG_BUS_ADAS 6

  #include "..\\common\\CAPL_COMMON.cin"
}

variables
{
  msTimer tInput100;
  msTimer tDemoStep;
  msTimer tScenarioEval;
  msTimer tScenarioPhase2;
  msTimer tScenarioPhase3;
  int gDemoStepIndex;
  int gDemoRunning;
  int gCurrentScenarioId;
  int gArbitrationSnapshotBaseline;
  int gScenarioInputLock;
  int gLockDriveState;
  int gLockVehicleSpeed;
  int gLockSteeringInput;
  int gLockRoadZone;
  int gLockNavDirection;
  int gLockZoneDistance;
  int gLockSpeedLimit;
  int gLockAlertState;
  int gLockEmergencyType;
  int gLockEmergencyDirection;
  int gLockEta;
  int gLockSourceId;
  int gLockForceFailSafe;
  int gLockObjectTrackValid;
  int gLockObjectRange;
  int gLockObjectRelSpeed;
  int gLockObjectConfidence;
  int gLockIntersectionConflictFlag;
  int gLockMergeCutInFlag;
  int gLockObjectAlertHoldMs;
  int gScenarioCmdInternalClear;
  int gScenarioMirrorInternalWrite;
}


int calcBaselineGearState(int driveState)
{
  if (driveState <= 0)
  {
    return 0; /* P */
  }
  if (driveState == 1)
  {
    return 1; /* R */
  }
  if (driveState == 2)
  {
    return 2; /* N */
  }
  return 3;   /* D */
}

int calcBaselineIgnitionState(int speed, int driveState)
{
  if (speed > 0 || driveState > 0)
  {
    return 1;
  }
  return 0;
}

void sendBaselineDiagRequest(int scenarioId)
{
  message frmIviDiagReqMsg mIvi;
  message frmCluDiagReqMsg mClu;
  message frmAdasDiagReqMsg mAdas;
  message frmPtDiagReqMsg mPt;
  message frmChassisDiagReqMsg mChs;
  message frmBcmDiagReqMsg mBcm;
  message frmTmuDiagReqMsg mTmu;
  message frmDatcDiagReqMsg mDatc;
  message frmSccDiagReqMsg mScc;
  message frmHudDiagReqMsg mHud;
  message frmAmpDiagReqMsg mAmp;
  message frmDmsDiagReqMsg mDms;
  message frmOmsDiagReqMsg mOms;
  message ethV2xDiagReqMsg mV2x;
  message ethCgwDiagReqMsg mCgw;
  message ethSgwDiagReqMsg mSgw;
  message ethDcmDiagReqMsg mDcm;
  message frmAbsDiagReqMsg mAbs;
  message frmEpbDiagReqMsg mEpb;
  message frmTpmsDiagReqMsg mTpms;
  message frmSasDiagReqMsg mSas;
  message frmVsmDiagReqMsg mVsm;
  message frmEhbDiagReqMsg mEhb;
  message frmEcsDiagReqMsg mEcs;
  message frmCdcDiagReqMsg mCdc;
  message frmAcuDiagReqMsg mAcu;
  message frmOdsDiagReqMsg mOds;
  message frmSmkDiagReqMsg mSmk;
  message frmAflsDiagReqMsg mAfls;
  message frmWipDiagReqMsg mWip;
  int didLow;

  didLow = clampRange(scenarioId, 0, 255);

  mIvi.IviDiagServiceId = 0x22;
  mIvi.IviDiagDidHigh = 0xF1;
  mIvi.IviDiagDidLow = didLow;
  mirrorDiagRequest(DIAG_TARGET_IVI, 0x22, 0xF1, didLow, DIAG_BUS_INFOTAINMENT);
  output(mIvi);

  mClu.CluDiagServiceId = 0x22;
  mClu.CluDiagDidHigh = 0xF1;
  mClu.CluDiagDidLow = didLow;
  mirrorDiagRequest(DIAG_TARGET_CLU, 0x22, 0xF1, didLow, DIAG_BUS_INFOTAINMENT);
  output(mClu);

  mAdas.AdasDiagServiceId = 0x22;
  mAdas.AdasDiagDidHigh = 0xF1;
  mAdas.AdasDiagDidLow = didLow;
  mirrorDiagRequest(DIAG_TARGET_ADAS, 0x22, 0xF1, didLow, DIAG_BUS_ADAS);
  output(mAdas);

  mPt.PtDiagServiceId = 0x22;
  mPt.PtDiagDidHigh = 0xF1;
  mPt.PtDiagDidLow = didLow;
  mirrorDiagRequest(DIAG_TARGET_VCU, 0x22, 0xF1, didLow, DIAG_BUS_POWERTRAIN);
  output(mPt);

  mChs.ChsDiagServiceId = 0x22;
  mChs.ChsDiagDidHigh = 0xF1;
  mChs.ChsDiagDidLow = didLow;
  mirrorDiagRequest(DIAG_TARGET_ESC, 0x22, 0xF1, didLow, DIAG_BUS_CHASSIS);
  output(mChs);

  mBcm.BcmDiagServiceId = 0x22;
  mBcm.BcmDiagDidHigh = 0xF1;
  mBcm.BcmDiagDidLow = didLow;
  mirrorDiagRequest(DIAG_TARGET_BCM, 0x22, 0xF1, didLow, DIAG_BUS_BODY);
  output(mBcm);

  mTmu.TmuDiagServiceId = 0x22;
  mTmu.TmuDiagDidHigh = 0xF1;
  mTmu.TmuDiagDidLow = didLow;
  mirrorDiagRequest(DIAG_TARGET_TMU, 0x22, 0xF1, didLow, DIAG_BUS_INFOTAINMENT);
  output(mTmu);

  mDatc.DatcDiagServiceId = 0x22;
  mDatc.DatcDiagDidHigh = 0xF1;
  mDatc.DatcDiagDidLow = didLow;
  mirrorDiagRequest(DIAG_TARGET_DATC, 0x22, 0xF1, didLow, DIAG_BUS_BODY);
  output(mDatc);

  mScc.SccDiagServiceId = 0x22;
  mScc.SccDiagDidHigh = 0xF1;
  mScc.SccDiagDidLow = didLow;
  mirrorDiagRequest(DIAG_TARGET_SCC, 0x22, 0xF1, didLow, DIAG_BUS_POWERTRAIN);
  output(mScc);

  mHud.HudDiagServiceId = 0x22;
  mHud.HudDiagDidHigh = 0xF1;
  mHud.HudDiagDidLow = didLow;
  mirrorDiagRequest(DIAG_TARGET_HUD, 0x22, 0xF1, didLow, DIAG_BUS_INFOTAINMENT);
  output(mHud);

  mAmp.AmpDiagServiceId = 0x22;
  mAmp.AmpDiagDidHigh = 0xF1;
  mAmp.AmpDiagDidLow = didLow;
  mirrorDiagRequest(DIAG_TARGET_AMP, 0x22, 0xF1, didLow, DIAG_BUS_INFOTAINMENT);
  output(mAmp);

  mDms.DmsDiagServiceId = 0x22;
  mDms.DmsDiagDidHigh = 0xF1;
  mDms.DmsDiagDidLow = didLow;
  mirrorDiagRequest(DIAG_TARGET_DMS, 0x22, 0xF1, didLow, DIAG_BUS_ADAS);
  output(mDms);

  mOms.OmsDiagServiceId = 0x22;
  mOms.OmsDiagDidHigh = 0xF1;
  mOms.OmsDiagDidLow = didLow;
  mirrorDiagRequest(DIAG_TARGET_OMS, 0x22, 0xF1, didLow, DIAG_BUS_ADAS);
  output(mOms);

  mV2x.V2xDiagServiceId = 0x22;
  mV2x.V2xDiagDidHigh = 0xF1;
  mV2x.V2xDiagDidLow = didLow;
  mirrorDiagRequest(DIAG_TARGET_V2X, 0x22, 0xF1, didLow, DIAG_BUS_ETH);
  output(mV2x);

  mCgw.CgwDiagServiceId = 0x22;
  mCgw.CgwDiagDidHigh = 0xF1;
  mCgw.CgwDiagDidLow = didLow;
  mirrorDiagRequest(DIAG_TARGET_CGW, 0x22, 0xF1, didLow, DIAG_BUS_ETH);
  output(mCgw);

  mSgw.SgwDiagServiceId = 0x22;
  mSgw.SgwDiagDidHigh = 0xF1;
  mSgw.SgwDiagDidLow = didLow;
  mirrorDiagRequest(DIAG_TARGET_SGW, 0x22, 0xF1, didLow, DIAG_BUS_ETH);
  output(mSgw);

  mDcm.DcmDiagServiceId = 0x22;
  mDcm.DcmDiagDidHigh = 0xF1;
  mDcm.DcmDiagDidLow = didLow;
  mirrorDiagRequest(DIAG_TARGET_DCM, 0x22, 0xF1, didLow, DIAG_BUS_ETH);
  output(mDcm);

  mAbs.AbsDiagServiceId = 0x22;
  mAbs.AbsDiagDidHigh = 0xF1;
  mAbs.AbsDiagDidLow = didLow;
  mirrorDiagRequest(DIAG_TARGET_ABS, 0x22, 0xF1, didLow, DIAG_BUS_CHASSIS);
  output(mAbs);
  mEpb.EpbDiagServiceId = 0x22;
  mEpb.EpbDiagDidHigh = 0xF1;
  mEpb.EpbDiagDidLow = didLow;
  mirrorDiagRequest(DIAG_TARGET_EPB, 0x22, 0xF1, didLow, DIAG_BUS_CHASSIS);
  output(mEpb);
  mTpms.TpmsDiagServiceId = 0x22;
  mTpms.TpmsDiagDidHigh = 0xF1;
  mTpms.TpmsDiagDidLow = didLow;
  mirrorDiagRequest(DIAG_TARGET_TPMS, 0x22, 0xF1, didLow, DIAG_BUS_CHASSIS);
  output(mTpms);
  mSas.SasDiagServiceId = 0x22;
  mSas.SasDiagDidHigh = 0xF1;
  mSas.SasDiagDidLow = didLow;
  mirrorDiagRequest(DIAG_TARGET_SAS, 0x22, 0xF1, didLow, DIAG_BUS_CHASSIS);
  output(mSas);
  mVsm.VsmDiagServiceId = 0x22;
  mVsm.VsmDiagDidHigh = 0xF1;
  mVsm.VsmDiagDidLow = didLow;
  mirrorDiagRequest(DIAG_TARGET_VSM, 0x22, 0xF1, didLow, DIAG_BUS_CHASSIS);
  output(mVsm);
  mEhb.EhbDiagServiceId = 0x22;
  mEhb.EhbDiagDidHigh = 0xF1;
  mEhb.EhbDiagDidLow = didLow;
  mirrorDiagRequest(DIAG_TARGET_EHB, 0x22, 0xF1, didLow, DIAG_BUS_CHASSIS);
  output(mEhb);
  mEcs.EcsDiagServiceId = 0x22;
  mEcs.EcsDiagDidHigh = 0xF1;
  mEcs.EcsDiagDidLow = didLow;
  mirrorDiagRequest(DIAG_TARGET_ECS, 0x22, 0xF1, didLow, DIAG_BUS_CHASSIS);
  output(mEcs);
  mCdc.CdcDiagServiceId = 0x22;
  mCdc.CdcDiagDidHigh = 0xF1;
  mCdc.CdcDiagDidLow = didLow;
  mirrorDiagRequest(DIAG_TARGET_CDC, 0x22, 0xF1, didLow, DIAG_BUS_CHASSIS);
  output(mCdc);
  mAcu.AcuDiagServiceId = 0x22;
  mAcu.AcuDiagDidHigh = 0xF1;
  mAcu.AcuDiagDidLow = didLow;
  mirrorDiagRequest(DIAG_TARGET_ACU, 0x22, 0xF1, didLow, DIAG_BUS_CHASSIS);
  output(mAcu);
  mOds.OdsDiagServiceId = 0x22;
  mOds.OdsDiagDidHigh = 0xF1;
  mOds.OdsDiagDidLow = didLow;
  mirrorDiagRequest(DIAG_TARGET_ODS, 0x22, 0xF1, didLow, DIAG_BUS_CHASSIS);
  output(mOds);
  mSmk.SmkDiagServiceId = 0x22;
  mSmk.SmkDiagDidHigh = 0xF1;
  mSmk.SmkDiagDidLow = didLow;
  mirrorDiagRequest(DIAG_TARGET_SMK, 0x22, 0xF1, didLow, DIAG_BUS_BODY);
  output(mSmk);
  mAfls.AflsDiagServiceId = 0x22;
  mAfls.AflsDiagDidHigh = 0xF1;
  mAfls.AflsDiagDidLow = didLow;
  mirrorDiagRequest(DIAG_TARGET_AFLS, 0x22, 0xF1, didLow, DIAG_BUS_BODY);
  output(mAfls);
  mWip.WipDiagServiceId = 0x22;
  mWip.WipDiagDidHigh = 0xF1;
  mWip.WipDiagDidLow = didLow;
  mirrorDiagRequest(DIAG_TARGET_WIP, 0x22, 0xF1, didLow, DIAG_BUS_BODY);
  output(mWip);
}

on message frmIviDiagResMsg
{
  mirrorDiagResponse(DIAG_TARGET_IVI, this.IviDiagRespCode, this.IviDiagData0, this.IviDiagData1, DIAG_BUS_INFOTAINMENT);
}

on message frmCluDiagResMsg
{
  mirrorDiagResponse(DIAG_TARGET_CLU, this.CluDiagRespCode, this.CluDiagData0, this.CluDiagData1, DIAG_BUS_INFOTAINMENT);
}

on message frmAdasDiagResMsg
{
  mirrorDiagResponse(DIAG_TARGET_ADAS, this.AdasDiagRespCode, this.AdasDiagData0, this.AdasDiagData1, DIAG_BUS_ADAS);
}

on message frmPtDiagResMsg
{
  mirrorDiagResponse(DIAG_TARGET_VCU, this.PtDiagRespCode, this.PtDiagData0, this.PtDiagData1, DIAG_BUS_POWERTRAIN);
}

on message frmChassisDiagResMsg
{
  mirrorDiagResponse(DIAG_TARGET_ESC, this.ChsDiagRespCode, this.ChsDiagData0, this.ChsDiagData1, DIAG_BUS_CHASSIS);
}

on message frmBcmDiagResMsg
{
  mirrorDiagResponse(DIAG_TARGET_BCM, this.BcmDiagRespCode, this.BcmDiagData0, this.BcmDiagData1, DIAG_BUS_BODY);
}

on message frmTmuDiagResMsg
{
  mirrorDiagResponse(DIAG_TARGET_TMU, this.TmuDiagRespCode, this.TmuDiagData0, this.TmuDiagData1, DIAG_BUS_INFOTAINMENT);
}

on message frmDatcDiagResMsg
{
  mirrorDiagResponse(DIAG_TARGET_DATC, this.DatcDiagRespCode, this.DatcDiagData0, this.DatcDiagData1, DIAG_BUS_BODY);
}

on message frmSccDiagResMsg
{
  mirrorDiagResponse(DIAG_TARGET_SCC, this.SccDiagRespCode, this.SccDiagData0, this.SccDiagData1, DIAG_BUS_POWERTRAIN);
}

on message frmHudDiagResMsg
{
  mirrorDiagResponse(DIAG_TARGET_HUD, this.HudDiagRespCode, this.HudDiagData0, this.HudDiagData1, DIAG_BUS_INFOTAINMENT);
}

on message frmAmpDiagResMsg
{
  mirrorDiagResponse(DIAG_TARGET_AMP, this.AmpDiagRespCode, this.AmpDiagData0, this.AmpDiagData1, DIAG_BUS_INFOTAINMENT);
}

on message frmDmsDiagResMsg
{
  mirrorDiagResponse(DIAG_TARGET_DMS, this.DmsDiagRespCode, this.DmsDiagData0, this.DmsDiagData1, DIAG_BUS_ADAS);
}

on message frmOmsDiagResMsg
{
  mirrorDiagResponse(DIAG_TARGET_OMS, this.OmsDiagRespCode, this.OmsDiagData0, this.OmsDiagData1, DIAG_BUS_ADAS);
}

on message ethV2xDiagResMsg
{
  mirrorDiagResponse(DIAG_TARGET_V2X, this.V2xDiagRespCode, this.V2xDiagData0, this.V2xDiagData1, DIAG_BUS_ETH);
}

on message ethCgwDiagResMsg
{
  mirrorDiagResponse(DIAG_TARGET_CGW, this.CgwDiagRespCode, this.CgwDiagData0, this.CgwDiagData1, DIAG_BUS_ETH);
}

on message ethSgwDiagResMsg
{
  mirrorDiagResponse(DIAG_TARGET_SGW, this.SgwDiagRespCode, this.SgwDiagData0, this.SgwDiagData1, DIAG_BUS_ETH);
}

on message ethDcmDiagResMsg
{
  mirrorDiagResponse(DIAG_TARGET_DCM, this.DcmDiagRespCode, this.DcmDiagData0, this.DcmDiagData1, DIAG_BUS_ETH);
}

on message frmAbsDiagResMsg
{
  mirrorDiagResponse(DIAG_TARGET_ABS, this.AbsDiagRespCode, this.AbsDiagData0, this.AbsDiagData1, DIAG_BUS_CHASSIS);
}

on message frmEpbDiagResMsg
{
  mirrorDiagResponse(DIAG_TARGET_EPB, this.EpbDiagRespCode, this.EpbDiagData0, this.EpbDiagData1, DIAG_BUS_CHASSIS);
}

on message frmTpmsDiagResMsg
{
  mirrorDiagResponse(DIAG_TARGET_TPMS, this.TpmsDiagRespCode, this.TpmsDiagData0, this.TpmsDiagData1, DIAG_BUS_CHASSIS);
}

on message frmSasDiagResMsg
{
  mirrorDiagResponse(DIAG_TARGET_SAS, this.SasDiagRespCode, this.SasDiagData0, this.SasDiagData1, DIAG_BUS_CHASSIS);
}

on message frmVsmDiagResMsg
{
  mirrorDiagResponse(DIAG_TARGET_VSM, this.VsmDiagRespCode, this.VsmDiagData0, this.VsmDiagData1, DIAG_BUS_CHASSIS);
}

on message frmEhbDiagResMsg
{
  mirrorDiagResponse(DIAG_TARGET_EHB, this.EhbDiagRespCode, this.EhbDiagData0, this.EhbDiagData1, DIAG_BUS_CHASSIS);
}

on message frmEcsDiagResMsg
{
  mirrorDiagResponse(DIAG_TARGET_ECS, this.EcsDiagRespCode, this.EcsDiagData0, this.EcsDiagData1, DIAG_BUS_CHASSIS);
}

on message frmCdcDiagResMsg
{
  mirrorDiagResponse(DIAG_TARGET_CDC, this.CdcDiagRespCode, this.CdcDiagData0, this.CdcDiagData1, DIAG_BUS_CHASSIS);
}

on message frmAcuDiagResMsg
{
  mirrorDiagResponse(DIAG_TARGET_ACU, this.AcuDiagRespCode, this.AcuDiagData0, this.AcuDiagData1, DIAG_BUS_CHASSIS);
}

on message frmOdsDiagResMsg
{
  mirrorDiagResponse(DIAG_TARGET_ODS, this.OdsDiagRespCode, this.OdsDiagData0, this.OdsDiagData1, DIAG_BUS_CHASSIS);
}

on message frmSmkDiagResMsg
{
  mirrorDiagResponse(DIAG_TARGET_SMK, this.SmkDiagRespCode, this.SmkDiagData0, this.SmkDiagData1, DIAG_BUS_BODY);
}

on message frmAflsDiagResMsg
{
  mirrorDiagResponse(DIAG_TARGET_AFLS, this.AflsDiagRespCode, this.AflsDiagData0, this.AflsDiagData1, DIAG_BUS_BODY);
}

on message frmWipDiagResMsg
{
  mirrorDiagResponse(DIAG_TARGET_WIP, this.WipDiagRespCode, this.WipDiagData0, this.WipDiagData1, DIAG_BUS_BODY);
}

void pushLockedScenarioInputs()
{
  @Chassis::driveState = clampRange(gLockDriveState, 0, 3);
  @Chassis::vehicleSpeed = clampRange(gLockVehicleSpeed, 0, 255);
  @Chassis::steeringInput = clampRange(gLockSteeringInput, 0, 1);
  @Infotainment::roadZone = clampRange(gLockRoadZone, 0, 3);
  @Infotainment::navDirection = clampRange(gLockNavDirection, 0, 3);
  @Infotainment::zoneDistance = clampRange(gLockZoneDistance, 0, 255);
  @Infotainment::speedLimit = clampRange(gLockSpeedLimit, 0, 255);
  @V2X::alertState = clampRange(gLockAlertState, 0, 1);
  @V2X::emergencyType = clampRange(gLockEmergencyType, 0, 2);
  @V2X::emergencyDirection = clampRange(gLockEmergencyDirection, 0, 3);
  @V2X::eta = clampRange(gLockEta, 0, 255);
  @V2X::sourceId = clampRange(gLockSourceId, 0, 255);
  @Test::forceFailSafe = clampRange(gLockForceFailSafe, 0, 1);
  @Core::objectTrackValid = clampRange(gLockObjectTrackValid, 0, 1);
  @Core::objectRange = clampRange(gLockObjectRange, 0, 500);
  @Core::objectRelSpeed = clampRange(gLockObjectRelSpeed, -200, 200);
  @Core::objectConfidence = clampRange(gLockObjectConfidence, 0, 100);
  @Core::intersectionConflictFlag = clampRange(gLockIntersectionConflictFlag, 0, 1);
  @Core::mergeCutInFlag = clampRange(gLockMergeCutInFlag, 0, 1);
  @Core::objectAlertHoldMs = clampRange(gLockObjectAlertHoldMs, 0, 5000);
}

void cancelScenarioTransientTimers()
{
  cancelTimer(tScenarioEval);
  cancelTimer(tScenarioPhase2);
  cancelTimer(tScenarioPhase3);
}

void stopScenarioExecution()
{
  gDemoRunning = 0;
  gScenarioInputLock = 0;
  gCurrentScenarioId = 0;
  gArbitrationSnapshotBaseline = 0;
  cancelTimer(tDemoStep);
  cancelScenarioTransientTimers();
  @Test::forceFailSafe = 0;
  @Test::scenarioResult = 0;
}

void setScenarioMirror(int scenarioId)
{
  gScenarioMirrorInternalWrite = 1;
  @Test::testScenario = clampRange(scenarioId, 0, 255);
}

void publishScenarioResultFrame()
{
  message frmTestResultMsg mRes;

  mRes.ScenarioResult = (((int)@Test::scenarioResult) == 1) ? 1 : 0;
  output(mRes);
}

void beginScenarioExecution(int scenarioId)
{
  gDemoRunning = 0;
  cancelTimer(tDemoStep);
  cancelScenarioTransientTimers();
  @Test::scenarioResult = 0;
  applyScenarioPreset(scenarioId);
  gCurrentScenarioId = scenarioId;
  setScenarioMirror(scenarioId);
  scheduleScenarioEvaluation(scenarioId);
}

void beginAutoDemoExecution()
{
  cancelScenarioTransientTimers();
  gDemoRunning = 1;
  gDemoStepIndex = 0;
  setScenarioMirror(100);
  runDemoStep();
}

void beginBaselineDiagRequest(int scenarioId)
{
  stopScenarioExecution();
  gCurrentScenarioId = scenarioId;
  setScenarioMirror(scenarioId);
  sendBaselineDiagRequest(scenarioId);
}

void applyScenarioPreset(int scenarioId)
{
  gScenarioInputLock = 1;
  gLockDriveState = 3;
  gLockVehicleSpeed = 20;
  gLockSteeringInput = 1;
  gLockRoadZone = 0;
  gLockNavDirection = 0;
  gLockZoneDistance = 50;
  gLockSpeedLimit = 30;
  gLockAlertState = 0;
  gLockEmergencyType = 0;
  gLockEmergencyDirection = 1;
  gLockEta = 10;
  gLockSourceId = 1;
  gLockForceFailSafe = 0;
  gLockObjectTrackValid = 0;
  gLockObjectRange = 0;
  gLockObjectRelSpeed = 0;
  gLockObjectConfidence = 0;
  gLockIntersectionConflictFlag = 0;
  gLockMergeCutInFlag = 0;
  gLockObjectAlertHoldMs = 300;
  @Test::displayModeSetting = 0;
  @Test::alertVolumeSetting = 0;
  @Test::seatBeltOverride = 0;
  @Test::historyQueryOffset = 0;

  if (scenarioId == 1)
  {
    /* Normal idle */
  }
  else if (scenarioId == 2)
  {
    /* School zone overspeed */
    gLockRoadZone = 1;
    gLockVehicleSpeed = 45;
    gLockSpeedLimit = 30;
  }
  else if (scenarioId == 3)
  {
    /* Highway no steering */
    gLockRoadZone = 2;
    gLockSteeringInput = 0;
    gLockVehicleSpeed = 80;
    gLockSpeedLimit = 100;
  }
  else if (scenarioId == 4)
  {
    /* Police emergency */
    gLockAlertState = 1;
    gLockEmergencyType = 1;
    gLockEta = 12;
    gLockEmergencyDirection = 1;
    gLockSourceId = 11;
  }
  else if (scenarioId == 5)
  {
    /* Ambulance emergency */
    gLockAlertState = 1;
    gLockEmergencyType = 2;
    gLockEta = 8;
    gLockEmergencyDirection = 2;
    gLockSourceId = 22;
  }
  else if (scenarioId == 6)
  {
    /* Timeout test preparation: emergency active then stop update externally */
    gLockAlertState = 1;
    gLockEmergencyType = 2;
    gLockEta = 5;
    gLockSourceId = 33;
  }
  else if (scenarioId == 7)
  {
    /* Guide zone left */
    gLockRoadZone = 3;
    gLockNavDirection = 1;
    gLockVehicleSpeed = 35;
  }
  else if (scenarioId == 8)
  {
    /* Guide zone right */
    gLockRoadZone = 3;
    gLockNavDirection = 2;
    gLockVehicleSpeed = 35;
  }
  else if (scenarioId == 9)
  {
    /* Req_030: ETA priority - Phase 1: Police ETA=20 sourceId=5 */
    gLockAlertState = 1;
    gLockEmergencyType = 1;
    gLockEta = 20;
    gLockSourceId = 5;
    gLockEmergencyDirection = 1;
    setTimer(tScenarioPhase2, 300);
  }
  else if (scenarioId == 10)
  {
    /* Req_031: SourceID tiebreaker - Phase 1: Police ETA=10 sourceId=20 */
    gLockAlertState = 1;
    gLockEmergencyType = 1;
    gLockEta = 10;
    gLockSourceId = 20;
    gLockEmergencyDirection = 1;
    setTimer(tScenarioPhase2, 300);
  }
  else if (scenarioId == 11)
  {
    /* Req_034: nav->emergency transition - Phase 1: guide zone stable */
    gLockRoadZone = 3;
    gLockNavDirection = 1;
    gLockVehicleSpeed = 35;
    gLockAlertState = 0;
    gLockEmergencyType = 0;
    setTimer(tScenarioPhase2, 400);
  }
  else if (scenarioId == 12)
  {
    /* Req_006 + Req_026: duplicate guard - Phase 1: school zone overspeed active */
    gLockRoadZone = 1;
    gLockVehicleSpeed = 45;
    gLockSpeedLimit = 30;
    gLockAlertState = 0;
    gLockEmergencyType = 0;
    setTimer(tScenarioPhase2, 300);
  }
  else if (scenarioId == 13)
  {
    /* Req_015: zone transition stability - Phase 1: school zone warning stable */
    gLockRoadZone = 1;
    gLockVehicleSpeed = 45;
    gLockSpeedLimit = 30;
    gLockSteeringInput = 1;
    gLockAlertState = 0;
    gLockEmergencyType = 0;
    setTimer(tScenarioPhase2, 300);
  }
  else if (scenarioId == 14)
  {
    /* Req_110 + Req_111 + Req_112: domain boundary health - normal driving D gear */
    gLockDriveState = 3;
    gLockVehicleSpeed = 60;
    gLockRoadZone = 0;
    gLockAlertState = 0;
    gLockEmergencyType = 0;
  }
  else if (scenarioId == 15)
  {
    /* Req_120: emergency proximity risk score update */
    gLockVehicleSpeed = 70;
    gLockSteeringInput = 0;
    gLockAlertState = 1;
    gLockEmergencyType = 1;
    gLockEmergencyDirection = 0;
    gLockEta = 6;
    gLockSourceId = 41;
  }
  else if (scenarioId == 16)
  {
    /* Req_121: risk-threshold decel assist activation */
    gLockVehicleSpeed = 90;
    gLockSteeringInput = 0;
    gLockAlertState = 1;
    gLockEmergencyType = 2;
    gLockEmergencyDirection = 0;
    gLockEta = 4;
    gLockSourceId = 42;
  }
  else if (scenarioId == 17)
  {
    /* Req_123: driver intervention release */
    gLockVehicleSpeed = 90;
    gLockSteeringInput = 0;
    gLockAlertState = 1;
    gLockEmergencyType = 2;
    gLockEmergencyDirection = 0;
    gLockEta = 4;
    gLockSourceId = 43;
    setTimer(tScenarioPhase2, 250);
  }
  else if (scenarioId == 18)
  {
    /* Req_127 + Req_128 + Req_129 (Legacy Req_124): forced fail-safe gating */
    gLockVehicleSpeed = 70;
    gLockAlertState = 1;
    gLockEmergencyType = 1;
    gLockEta = 6;
    gLockSourceId = 44;
    gLockForceFailSafe = 1;
  }
  else if (scenarioId == 19)
  {
    /* Req_125 + Req_126 (Legacy Req_122): decel assist + emergency warning sync */
    gLockRoadZone = 1;
    gLockSpeedLimit = 30;
    gLockVehicleSpeed = 75;
    gLockSteeringInput = 0;
    gLockAlertState = 1;
    gLockEmergencyType = 2;
    gLockEmergencyDirection = 0;
    gLockEta = 4;
    gLockSourceId = 45;
  }
  else if (scenarioId == 20)
  {
    /* Req_132: longitudinal TTC forward conflict */
    gLockRoadZone = 2;
    gLockVehicleSpeed = 85;
    gLockSteeringInput = 0;
    gLockObjectTrackValid = 1;
    gLockObjectRange = 40;
    gLockObjectRelSpeed = -45;
    gLockObjectConfidence = 85;
    gLockObjectAlertHoldMs = 300;
  }
  else if (scenarioId == 21)
  {
    /* Req_134: intersection lateral conflict */
    gLockRoadZone = 2;
    gLockVehicleSpeed = 60;
    gLockSteeringInput = 1;
    gLockObjectTrackValid = 1;
    gLockObjectRange = 35;
    gLockObjectRelSpeed = -35;
    gLockObjectConfidence = 80;
    gLockIntersectionConflictFlag = 1;
    gLockObjectAlertHoldMs = 300;
  }
  else if (scenarioId == 22)
  {
    /* Req_135: merge/cut-in conflict */
    gLockRoadZone = 2;
    gLockVehicleSpeed = 78;
    gLockSteeringInput = 1;
    gLockObjectTrackValid = 1;
    gLockObjectRange = 32;
    gLockObjectRelSpeed = -38;
    gLockObjectConfidence = 82;
    gLockMergeCutInFlag = 1;
    gLockObjectAlertHoldMs = 300;
  }
  else if (scenarioId == 23)
  {
    /* Req_137: object risk + decel assist request without emergency context */
    gLockRoadZone = 2;
    gLockVehicleSpeed = 90;
    gLockSteeringInput = 0;
    gLockObjectTrackValid = 1;
    gLockObjectRange = 28;
    gLockObjectRelSpeed = -55;
    gLockObjectConfidence = 90;
    gLockObjectAlertHoldMs = 300;
  }
  else if (scenarioId == 24)
  {
    /* Req_138: confidence degradation must force fail-safe-like downgrade */
    gLockRoadZone = 2;
    gLockVehicleSpeed = 80;
    gLockSteeringInput = 0;
    gLockObjectTrackValid = 1;
    gLockObjectRange = 30;
    gLockObjectRelSpeed = -40;
    gLockObjectConfidence = 20;
    gLockObjectAlertHoldMs = 300;
  }
  else if (scenarioId == 25)
  {
    /* Req_136: object tracking loss hold-time behavior */
    gLockRoadZone = 2;
    gLockVehicleSpeed = 72;
    gLockSteeringInput = 1;
    gLockObjectTrackValid = 1;
    gLockObjectRange = 34;
    gLockObjectRelSpeed = -34;
    gLockObjectConfidence = 75;
    gLockObjectAlertHoldMs = 500;
    setTimer(tScenarioPhase2, 350);
  }

  pushLockedScenarioInputs();
  write("[EVIDENCE_IN] scenario=%d inputTsMs=%lu",
        scenarioId, getSimulationTimeMs());
}

void scheduleScenarioEvaluation(int scenarioId)
{
  int evalDelayMs;

  evalDelayMs = 700;
  if (scenarioId == 3)
  {
    evalDelayMs = 11000;
  }
  else if (scenarioId == 6)
  {
    evalDelayMs = 1500; /* Req_024: ensure 200ms timeoutClear pulse has fully expired before eval */
  }
  else if (scenarioId == 7 || scenarioId == 8)
  {
    evalDelayMs = 700;
  }
  else if (scenarioId == 9 || scenarioId == 10)
  {
    evalDelayMs = 700;
  }
  else if (scenarioId == 11)
  {
    evalDelayMs = 800;
  }
  else if (scenarioId == 12)
  {
    evalDelayMs = 900;
  }
  else if (scenarioId == 13)
  {
    evalDelayMs = 1000;
  }
  else if (scenarioId == 14)
  {
    evalDelayMs = 700;
  }
  else if (scenarioId == 15 || scenarioId == 16 || scenarioId == 19)
  {
    evalDelayMs = 800;
  }
  else if (scenarioId == 17)
  {
    evalDelayMs = 900;
  }
  else if (scenarioId == 18)
  {
    evalDelayMs = 700;
  }
  else if (scenarioId >= 20 && scenarioId <= 24)
  {
    evalDelayMs = 900;
  }
  else if (scenarioId == 25)
  {
    evalDelayMs = 1100;
  }
  setTimer(tScenarioEval, evalDelayMs);
}

void evaluateScenarioResult()
{
  int result;
  int level;
  int type;
  int code;
  int timeoutClear;
  int ambientPattern;
  int ambientColor;
  int duplicatePopupGuard;
  int snapshotDelta;
  int proximityRiskLevel;
  int decelAssistReq;
  int failSafeMode;
  int objectTrackValid;
  int objectRiskClass;
  int objectTtcMin;
  int objectEventCode;
  int intersectionConflictFlag;
  int mergeCutInFlag;
  int uiRenderAlertType;
  int uiRenderTextCode;

  result = 0;
  level = (int)@Core::selectedAlertLevel;
  type = (int)@Core::selectedAlertType;
  code = (int)@Cluster::warningTextCode;
  timeoutClear = ((int)@Core::timeoutClear == 1) ? 1 : 0;
  ambientPattern = (int)@Body::ambientPattern;
  ambientColor = (int)@Body::ambientColor;
  duplicatePopupGuard = (int)@CoreState::duplicatePopupGuard;
  proximityRiskLevel = (int)@Core::proximityRiskLevel;
  decelAssistReq = (int)@Core::decelAssistReq;
  failSafeMode = (int)@Core::failSafeMode;
  objectTrackValid = (int)@Core::objectTrackValid;
  objectRiskClass = (int)@Core::objectRiskClass;
  objectTtcMin = (int)@Core::objectTtcMin;
  objectEventCode = (int)@Core::objectEventCode;
  intersectionConflictFlag = (int)@Core::intersectionConflictFlag;
  mergeCutInFlag = (int)@Core::mergeCutInFlag;
  uiRenderAlertType = (int)@UiRender::activeAlertType;
  uiRenderTextCode = (int)@UiRender::renderTextCode;

  if (gCurrentScenarioId == 1)
  {
    result = (level == 0 && code == 0) ? 1 : 0;
  }
  else if (gCurrentScenarioId == 2)
  {
    /* Req_010 + Req_037: school zone overspeed, fixed red fast-flash pattern */
    result = (level == 3 && type == 3 && ambientColor == 3 && ambientPattern == 5) ? 1 : 0;
  }
  else if (gCurrentScenarioId == 3)
  {
    /* Req_011 + Req_037 (Legacy Req_038): highway no-steer, fixed orange pulse pattern */
    result = (level == 2 && type == 4 && ambientColor == 4 && ambientPattern == 4) ? 1 : 0;
  }
  else if (gCurrentScenarioId == 4)
  {
    /* Req_017 + Req_035 (Legacy Req_036): police emergency, distinct red-blue color+pattern */
    result = (level == 6 && type == 1 && code == 101 && duplicatePopupGuard > 0 &&
              ambientColor == 6 && ambientPattern == 6) ? 1 : 0;
  }
  else if (gCurrentScenarioId == 5)
  {
    /* Req_017 + Req_035 (Legacy Req_018/036): ambulance emergency, distinct red-white color+pattern */
    result = (level == 7 && type == 2 && code == 202 && duplicatePopupGuard > 0 &&
              ambientColor == 7 && ambientPattern == 7) ? 1 : 0;
  }
  else if (gCurrentScenarioId == 6)
  {
    result = (timeoutClear == 1 && level == 0 && code == 0) ? 1 : 0;
  }
  else if (gCurrentScenarioId == 7)
  {
    /* Req_013 + Req_037 (Legacy Req_039): guide left, cyan flow-left pattern */
    result = (level == 2 && type == 5 && ambientColor == 5 && ambientPattern == 2 && code == 31) ? 1 : 0;
  }
  else if (gCurrentScenarioId == 8)
  {
    /* Req_014 + Req_037 (Legacy Req_039): guide right, cyan flow-right pattern */
    result = (level == 2 && type == 6 && ambientColor == 5 && ambientPattern == 3 && code == 32) ? 1 : 0;
  }
  else if (gCurrentScenarioId == 9)
  {
    /* Req_030: lower ETA competitor (sourceId=99, eta=10) should be active */
    result = ((int)@V2X::eta == 10 && (int)@V2X::sourceId == 99 && level == 6) ? 1 : 0;
  }
  else if (gCurrentScenarioId == 10)
  {
    /* Req_031: lower sourceId (5) wins despite same ETA as prior active (sourceId=20) */
    result = ((int)@V2X::sourceId == 5 && (int)@V2X::eta == 10 && level == 6) ? 1 : 0;
  }
  else if (gCurrentScenarioId == 11)
  {
    /* Req_034: emergency took over AND arbitration delta <= 3 (no repeated flips) */
    snapshotDelta = ((int)@CoreState::arbitrationSnapshotId - gArbitrationSnapshotBaseline) & 0xFFFF;
    result = (level == 6 && type == 1 && snapshotDelta <= 3) ? 1 : 0;
  }
  else if (gCurrentScenarioId == 12)
  {
    /* Req_006 + Req_026: re-triggered school zone warning still within guard window */
    result = (level == 3 && type == 3 && duplicatePopupGuard > 0) ? 1 : 0;
  }
  else if (gCurrentScenarioId == 13)
  {
    /* Req_015: after zone flip (school->highway->school), settle correctly, <=3 arb changes */
    snapshotDelta = ((int)@CoreState::arbitrationSnapshotId - gArbitrationSnapshotBaseline) & 0xFFFF;
    result = (level == 3 && type == 3 && snapshotDelta <= 3) ? 1 : 0;
  }
  else if (gCurrentScenarioId == 14)
  {
    /* Req_110 + Req_111 + Req_112: all domain boundaries healthy, routing normal */
    result = ((int)@CoreState::domainBoundaryStatus == 1 &&
              (int)@CoreState::routingPolicy == 1 &&
              level == 0) ? 1 : 0;
  }
  else if (gCurrentScenarioId == 15)
  {
    /* Req_120: risk level must be periodically computed from emergency/speed/ETA */
    result = (proximityRiskLevel >= 60 && proximityRiskLevel <= 100) ? 1 : 0;
  }
  else if (gCurrentScenarioId == 16)
  {
    /* Req_121: threshold-crossing should request decel assist */
    result = (proximityRiskLevel >= 70 && decelAssistReq == 1 && failSafeMode == 0 &&
              level == 7 && type == 2) ? 1 : 0;
  }
  else if (gCurrentScenarioId == 17)
  {
    /* Req_123: steering intervention releases decel assist */
    result = ((int)@Core::steeringInputNorm == 1 && decelAssistReq == 0 &&
              failSafeMode == 0) ? 1 : 0;
  }
  else if (gCurrentScenarioId == 18)
  {
    /* Req_127 + Req_128 + Req_129 (Legacy Req_124): fail-safe blocks decel assist but keeps minimum warning path */
    result = (failSafeMode >= 1 && decelAssistReq == 0 &&
              level >= 6 && code >= 100) ? 1 : 0;
  }
  else if (gCurrentScenarioId == 19)
  {
    /* Req_125 + Req_126 (Legacy Req_122): decel assist active with emergency-priority sync to renderer */
    result = (decelAssistReq == 1 && level == 7 && type == 2 &&
              uiRenderAlertType == 2 && uiRenderTextCode >= 200 &&
              ambientColor == 7 && code >= 200) ? 1 : 0;
  }
  else if (gCurrentScenarioId == 20)
  {
    /* Req_132: TTC-based forward object conflict warning */
    result = (objectTrackValid == 1 && objectRiskClass >= 3 && objectTtcMin <= 3500 &&
              proximityRiskLevel >= 60) ? 1 : 0;
  }
  else if (gCurrentScenarioId == 21)
  {
    /* Req_134: intersection conflict should map to object-context alert */
    result = (intersectionConflictFlag == 1 && objectRiskClass >= 3 &&
              level >= 4 && type == 5) ? 1 : 0;
  }
  else if (gCurrentScenarioId == 22)
  {
    /* Req_135: merge/cut-in conflict should map to object-context alert */
    result = (mergeCutInFlag == 1 && objectRiskClass >= 3 &&
              level >= 4 && type == 6) ? 1 : 0;
  }
  else if (gCurrentScenarioId == 23)
  {
    /* Req_137: object high-risk must trigger decel assist without emergency input */
    result = ((int)@Core::emergencyContext == 0 && objectRiskClass >= 4 &&
              proximityRiskLevel >= 75 && decelAssistReq == 1 && failSafeMode == 0) ? 1 : 0;
  }
  else if (gCurrentScenarioId == 24)
  {
    /* Req_138: low confidence must force degrade and cancel decel assist */
    result = (objectTrackValid == 1 && (int)@Core::objectConfidence < 35 &&
              failSafeMode >= 1 && decelAssistReq == 0) ? 1 : 0;
  }
  else if (gCurrentScenarioId == 25)
  {
    /* Req_136: hold-time should keep risk class/event around short track loss window */
    result = (objectTrackValid == 1 && objectRiskClass >= 3 &&
              objectEventCode >= 1381 && objectEventCode <= 1383) ? 1 : 0;
  }
  else
  {
    result = ((int)@Test::scenarioResult == 1) ? 1 : 0;
  }

  @Test::scenarioResult = result;
}

void runDemoStep()
{
  cancelScenarioTransientTimers();
  gDemoStepIndex = gDemoStepIndex + 1;
  if (gDemoStepIndex > 8)
  {
    gDemoStepIndex = 1;
  }

  applyScenarioPreset(gDemoStepIndex);
  gCurrentScenarioId = gDemoStepIndex;
  setScenarioMirror(gCurrentScenarioId);
  scheduleScenarioEvaluation(gDemoStepIndex);
  setTimer(tDemoStep, 4000);
}

on timer tScenarioPhase2
{
  if (gCurrentScenarioId == 9)
  {
    /* Req_030: Phase 2 - inject lower ETA competitor (different sourceId) */
    gLockEmergencyType = 1;
    gLockEta = 10;
    gLockSourceId = 99;
    gLockEmergencyDirection = 2;
    pushLockedScenarioInputs();
    write("[TEST_SCN] Req_030 phase2: inject eta=10 sourceId=99");
  }
  else if (gCurrentScenarioId == 10)
  {
    /* Req_031: Phase 2 - inject same ETA, lower SourceID competitor */
    gLockEmergencyType = 1;
    gLockEta = 10;
    gLockSourceId = 5;
    gLockEmergencyDirection = 2;
    pushLockedScenarioInputs();
    write("[TEST_SCN] Req_031 phase2: inject eta=10 sourceId=5");
  }
  else if (gCurrentScenarioId == 11)
  {
    /* Req_034: Phase 2 - snapshot arbitration baseline then inject emergency */
    gArbitrationSnapshotBaseline = (int)@CoreState::arbitrationSnapshotId;
    gLockAlertState = 1;
    gLockEmergencyType = 1;
    gLockEta = 15;
    gLockSourceId = 10;
    gLockEmergencyDirection = 1;
    pushLockedScenarioInputs();
    write("[TEST_SCN] Req_034 phase2: inject police, baseline snapshotId=%d",
          gArbitrationSnapshotBaseline);
  }
  else if (gCurrentScenarioId == 12)
  {
    /* Req_006 + Req_026: Phase 2 - clear school zone warning (speed drops below limit) */
    gLockVehicleSpeed = 20;
    pushLockedScenarioInputs();
    setTimer(tScenarioPhase3, 100);
    write("[TEST_SCN] Req_006 phase2: speed=20 clear warning");
  }
  else if (gCurrentScenarioId == 13)
  {
    /* Req_015: Phase 2 - snapshot baseline + switch to highway zone (steerInput=1: no warn) */
    gArbitrationSnapshotBaseline = (int)@CoreState::arbitrationSnapshotId;
    gLockRoadZone = 2;
    gLockVehicleSpeed = 80;
    gLockSpeedLimit = 100;
    gLockSteeringInput = 1;
    pushLockedScenarioInputs();
    setTimer(tScenarioPhase3, 200);
    write("[TEST_SCN] Req_015 phase2: roadZone=2 baseline snapshotId=%d",
          gArbitrationSnapshotBaseline);
  }
  else if (gCurrentScenarioId == 17)
  {
    /* Req_123: simulate driver intervention (steering input) */
    gLockSteeringInput = 1;
    pushLockedScenarioInputs();
    write("[TEST_SCN] Req_123 phase2: steering intervention");
  }
  else if (gCurrentScenarioId == 25)
  {
    /* Req_136: force temporary object loss and verify hold-time behavior */
    gLockObjectTrackValid = 0;
    pushLockedScenarioInputs();
    write("[TEST_SCN] Req_136 phase2: object track lost");
  }
}

on timer tScenarioPhase3
{
  if (gCurrentScenarioId == 12)
  {
    /* Req_006 + Req_026: Phase 3 - re-trigger school zone warning */
    gLockVehicleSpeed = 45;
    pushLockedScenarioInputs();
    write("[TEST_SCN] Req_006 phase3: speed=45 re-trigger warning");
  }
  else if (gCurrentScenarioId == 13)
  {
    /* Req_015: Phase 3 - return to school zone (must re-settle without flip-flop) */
    gLockRoadZone = 1;
    gLockVehicleSpeed = 45;
    gLockSpeedLimit = 30;
    gLockSteeringInput = 1;
    pushLockedScenarioInputs();
    write("[TEST_SCN] Req_015 phase3: roadZone=1 back to school zone");
  }
}

on start
{
  gDemoStepIndex = 0;
  gDemoRunning = 0;
  gCurrentScenarioId = 0;
  gArbitrationSnapshotBaseline = 0;
  gScenarioInputLock = 0;
  gLockDriveState = 3;
  gLockVehicleSpeed = 20;
  gLockSteeringInput = 1;
  gLockRoadZone = 0;
  gLockNavDirection = 0;
  gLockZoneDistance = 50;
  gLockSpeedLimit = 30;
  gLockAlertState = 0;
  gLockEmergencyType = 0;
  gLockEmergencyDirection = 1;
  gLockEta = 10;
  gLockSourceId = 1;
  gLockForceFailSafe = 0;
  gLockObjectTrackValid = 0;
  gLockObjectRange = 0;
  gLockObjectRelSpeed = 0;
  gLockObjectConfidence = 0;
  gLockIntersectionConflictFlag = 0;
  gLockMergeCutInFlag = 0;
  gLockObjectAlertHoldMs = 300;
  gScenarioCmdInternalClear = 0;
  gScenarioMirrorInternalWrite = 0;
  @Test::scenarioCommand = 0;
  @Test::scenarioCommandAck = 0;
  @Test::testScenario = 0;
  @Test::scenarioResult = 0;
  @Test::forceFailSafe = 0;
  @Test::displayModeSetting = 0;
  @Test::alertVolumeSetting = 0;
  @Test::seatBeltOverride = 0;
  @Test::historyQueryOffset = 0;
  @Test::historyQueryCode = 0;
  @Core::objectTrackValid = 0;
  @Core::objectRange = 0;
  @Core::objectRelSpeed = 0;
  @Core::objectConfidence = 0;
  @Core::objectRiskClass = 0;
  @Core::objectTtcMin = 10000;
  @Core::intersectionConflictFlag = 0;
  @Core::mergeCutInFlag = 0;
  @Core::objectAlertHoldMs = 300;
  @Core::objectEventCode = 0;
  setTimer(tInput100, 100);
  write("[TEST_SCN] start");
}

on timer tInput100
{
  message frmVehicleStateCanMsg mVeh;
  message frmSteeringCanMsg mStr;
  message frmNavContextCanMsg mNav;
  message frmIgnitionEngineMsg mIgn;
  message frmGearStateMsg mGear;
  message frmPedalInputCanMsg mPedal;
  message frmEngineSpeedTempMsg mEngTemp;
  message frmFuelBatteryStateMsg mFuelBat;
  message frmThrottleStateMsg mThrottle;
  message frmTransmissionTempMsg mTransTemp;
  message frmEngineTorqueMsg mEngineTorque;
  message frmEngineLoadMsg mEngineLoad;
  message frmTransShiftStateMsg mShift;
  message frmThermalMgmtStateMsg mThermal;
  message ethObjectRiskInputMsg mObjInput;
  int speed;
  int driveState;
  int steeringInput;
  int roadZone;
  int navDirection;
  int zoneDistance;
  int speedLimit;
  int ignitionState;
  int engineState;
  int gearState;
  int accelPedal;
  int brakePedal;
  int objectTrackValid;
  int objectRange;
  int objectRelSpeed;
  int objectConfidence;
  int intersectionConflictFlag;
  int mergeCutInFlag;
  int objectAlertHoldMs;

  if (gScenarioInputLock == 1)
  {
    speed = clampRange(gLockVehicleSpeed, 0, 255);
    driveState = clampRange(gLockDriveState, 0, 3);
    steeringInput = clampRange(gLockSteeringInput, 0, 1);
    roadZone = clampRange(gLockRoadZone, 0, 3);
    navDirection = clampRange(gLockNavDirection, 0, 3);
    zoneDistance = clampRange(gLockZoneDistance, 0, 255);
    speedLimit = clampRange(gLockSpeedLimit, 0, 255);
    pushLockedScenarioInputs();
  }
  else
  {
    speed = clampRange((int)@Chassis::vehicleSpeed, 0, 255);
    driveState = clampRange((int)@Chassis::driveState, 0, 3);
    steeringInput = clampRange((int)@Chassis::steeringInput, 0, 1);
    roadZone = clampRange((int)@Infotainment::roadZone, 0, 3);
    navDirection = clampRange((int)@Infotainment::navDirection, 0, 3);
    zoneDistance = clampRange((int)@Infotainment::zoneDistance, 0, 255);
    speedLimit = clampRange((int)@Infotainment::speedLimit, 0, 255);
  }
  ignitionState = calcBaselineIgnitionState(speed, driveState);
  engineState = (ignitionState == 1) ? 2 : 0;
  gearState = calcBaselineGearState(driveState);
  accelPedal = clampRange(speed / 2, 0, 100);
  brakePedal = (driveState == 0) ? 30 : 0;
  objectTrackValid = clampRange((int)@Core::objectTrackValid, 0, 1);
  objectRange = clampRange((int)@Core::objectRange, 0, 500);
  objectRelSpeed = clampRange((int)@Core::objectRelSpeed, -200, 200);
  objectConfidence = clampRange((int)@Core::objectConfidence, 0, 100);
  intersectionConflictFlag = clampRange((int)@Core::intersectionConflictFlag, 0, 1);
  mergeCutInFlag = clampRange((int)@Core::mergeCutInFlag, 0, 1);
  objectAlertHoldMs = clampRange((int)@Core::objectAlertHoldMs, 0, 5000);

  mVeh.gVehicleSpeed = speed;
  mVeh.gDriveState = driveState;
  output(mVeh);

  mStr.SteeringInput = steeringInput;
  output(mStr);

  mNav.gRoadZone = roadZone;
  mNav.gNavDirection = navDirection;
  mNav.gZoneDistance = zoneDistance;
  mNav.gSpeedLimit = speedLimit;
  output(mNav);

  /* Comm_101 baseline powertrain path */
  mIgn.IgnitionState = ignitionState;
  mIgn.EngineState = engineState;
  output(mIgn);

  mGear.GearInput = gearState;
  mGear.GearState = gearState;
  output(mGear);

  /* Comm_102 baseline chassis input path */
  mPedal.AccelPedal = accelPedal;
  mPedal.BrakePedal = brakePedal;
  output(mPedal);

  /* Comm_105 baseline gateway/boundary path
     VCU now owns vehicle-state and powertrain supervisory output frames. */

  /* Comm_101 baseline powertrain detail path */
  mEngTemp.EngineRpm = clampRange(speed * 40, 0, 65535);
  mEngTemp.CoolantTemp = 85;
  mEngTemp.OilTemp = 90;
  output(mEngTemp);

  mFuelBat.FuelLevel = 60;
  mFuelBat.BatterySoc = 80;
  mFuelBat.ChargingState = (engineState > 0) ? 1 : 0;
  output(mFuelBat);

  mThrottle.ThrottlePos = accelPedal;
  mThrottle.ThrottleReq = accelPedal;
  output(mThrottle);

  mTransTemp.TransOilTemp = 75;
  mTransTemp.ClutchTemp = 70;
  output(mTransTemp);

  /* Comm_204 extension path */
  mEngineTorque.EngineTorqueAct = clampRange(accelPedal * 5, 0, 65535);
  output(mEngineTorque);

  mEngineLoad.EngineLoad = accelPedal;
  output(mEngineLoad);

  mShift.ShiftState = gearState;
  mShift.ShiftTargetGear = gearState;
  mShift.ShiftSlip = (driveState == 3 && speed > 90) ? 8 : 0;
  output(mShift);

  mThermal.ThermalMode = (engineState > 0) ? 1 : 0;
  mThermal.FanDuty = 12;
  mThermal.CoolantTarget = 88;
  output(mThermal);

  /* Comm_130 pre-activation object input contract (E213 SIL stub path). */
  mObjInput.ObjectTrackValid = objectTrackValid;
  mObjInput.ObjectRangeM = objectRange;
  mObjInput.ObjectRelSpeedKph = objectRelSpeed;
  mObjInput.ObjectConfidence = objectConfidence;
  mObjInput.IntersectionConflict = intersectionConflictFlag;
  mObjInput.MergeCutIn = mergeCutInFlag;
  mObjInput.ObjectAlertHoldMs = objectAlertHoldMs;
  output(mObjInput);

  setTimer(tInput100, 100);
}

on sysvar Test::scenarioResult
{
  publishScenarioResultFrame();
}

on sysvar Test::scenarioCommand
{
  int scenarioId;
  scenarioId = (int)@Test::scenarioCommand;

  if (gScenarioCmdInternalClear == 1)
  {
    gScenarioCmdInternalClear = 0;
    return;
  }

  if (scenarioId == 100)
  {
    beginAutoDemoExecution();
    write("[TEST_SCN] command: auto demo start");
  }
  else if (scenarioId == 0)
  {
    stopScenarioExecution();
    setScenarioMirror(0);
    write("[TEST_SCN] command: auto demo stop");
  }
  else if (scenarioId >= 1 && scenarioId <= 25)
  {
    beginScenarioExecution(scenarioId);
    write("[TEST_SCN] command apply scenario=%d", scenarioId);
  }
  else if (scenarioId >= 200 && scenarioId <= 255)
  {
    beginBaselineDiagRequest(scenarioId);
    write("[TEST_SCN] command send baseline diag scenario=%d", scenarioId);
  }
  else
  {
    write("[TEST_SCN] command ignore invalid scenario=%d", scenarioId);
  }

  @Test::scenarioCommandAck = clampRange(scenarioId, 0, 255);
  gScenarioCmdInternalClear = 1;
  @Test::scenarioCommand = 0;
}

on sysvar Test::testScenario
{
  int scenarioId;

  if (gScenarioMirrorInternalWrite == 1)
  {
    gScenarioMirrorInternalWrite = 0;
    return;
  }

  scenarioId = (int)@Test::testScenario;

  if (gScenarioInputLock == 1 &&
      scenarioId != 0 &&
      scenarioId != 100 &&
      scenarioId != gCurrentScenarioId)
  {
    /* Ignore panel re-write while a locked scenario is running.
       Switch scenario only via explicit reset (scenario 0) first. */
    setScenarioMirror(gCurrentScenarioId);
    write("[TEST_SCN] ignore scenario change while locked: req=%d keep=%d",
          scenarioId, gCurrentScenarioId);
    return;
  }

  if (scenarioId == 100)
  {
    beginAutoDemoExecution();
    write("[TEST_SCN] auto demo start");
  }
  else if (scenarioId == 0)
  {
    stopScenarioExecution();
    setScenarioMirror(0);
    write("[TEST_SCN] auto demo stop");
  }
  else if (scenarioId >= 1 && scenarioId <= 25)
  {
    beginScenarioExecution(scenarioId);
    write("[TEST_SCN] apply scenario=%d", scenarioId);
  }
  else if (scenarioId >= 200 && scenarioId <= 255)
  {
    beginBaselineDiagRequest(scenarioId);
    write("[TEST_SCN] send baseline diag request scenario=%d", scenarioId);
  }
  else
  {
    write("[TEST_SCN] ignore invalid scenario=%d", scenarioId);
  }
}

on timer tDemoStep
{
  if (gDemoRunning == 1)
  {
    runDemoStep();
  }
}

on timer tScenarioEval
{
  int coreLevel;
  int coreType;
  int timeoutClear;
  int proximityRiskLevel;
  int decelAssistReq;
  int failSafeMode;
  int objectTrackValid;
  int objectRiskClass;
  int objectTtcMin;
  int objectEventCode;
  int renderAlertType;
  int renderTextCode;
  int clusterCode;

  evaluateScenarioResult();
  coreLevel = (int)@Core::selectedAlertLevel;
  coreType = (int)@Core::selectedAlertType;
  timeoutClear = (int)@Core::timeoutClear;
  proximityRiskLevel = (int)@Core::proximityRiskLevel;
  decelAssistReq = (int)@Core::decelAssistReq;
  failSafeMode = (int)@Core::failSafeMode;
  objectTrackValid = (int)@Core::objectTrackValid;
  objectRiskClass = (int)@Core::objectRiskClass;
  objectTtcMin = (int)@Core::objectTtcMin;
  objectEventCode = (int)@Core::objectEventCode;
  renderAlertType = (int)@UiRender::activeAlertType;
  renderTextCode = (int)@UiRender::renderTextCode;
  clusterCode = (int)@Cluster::warningTextCode;

  write("[EVIDENCE_OUT] scenario=%d outputTsMs=%lu result=%d level=%d type=%d code=%d timeout=%d risk=%d decel=%d failSafe=%d objValid=%d objClass=%d objTtc=%d objEvent=%d renderType=%d renderCode=%d",
        gCurrentScenarioId, getSimulationTimeMs(), (int)@Test::scenarioResult,
        coreLevel, coreType, clusterCode, timeoutClear, proximityRiskLevel,
        decelAssistReq, failSafeMode, objectTrackValid, objectRiskClass,
        objectTtcMin, objectEventCode, renderAlertType, renderTextCode);

}
