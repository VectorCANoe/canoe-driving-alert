includes
{
}

variables
{
  msTimer tInput100;
  msTimer tDemoStep;
  msTimer tScenarioEval;
  int gDemoStepIndex;
  int gDemoRunning;
  int gCurrentScenarioId;
  int gBaseTraceSnapshotId;
}

int clampRange(int value, int minValue, int maxValue)
{
  if (value < minValue)
  {
    return minValue;
  }
  if (value > maxValue)
  {
    return maxValue;
  }
  return value;
}

int calcBaselineGearState(int driveState)
{
  if (driveState <= 0)
  {
    return 0; /* P */
  }
  if (driveState == 1)
  {
    return 1; /* R */
  }
  if (driveState == 2)
  {
    return 2; /* N */
  }
  return 3;   /* D */
}

int calcBaselineIgnitionState(int speed, int driveState)
{
  if (speed > 0 || driveState > 0)
  {
    return 1;
  }
  return 0;
}

void applyScenarioPreset(int scenarioId)
{
  @Chassis::driveState = 3;
  @Chassis::vehicleSpeed = 20;
  @Chassis::steeringInput = 1;
  @Infotainment::roadZone = 0;
  @Infotainment::navDirection = 0;
  @Infotainment::zoneDistance = 50;
  @Infotainment::speedLimit = 30;
  @V2X::alertState = 0;
  @V2X::emergencyType = 0;
  @V2X::emergencyDirection = 1;
  @V2X::eta = 10;
  @V2X::sourceId = 1;

  if (scenarioId == 1)
  {
    /* Normal idle */
  }
  else if (scenarioId == 2)
  {
    /* School zone overspeed */
    @Infotainment::roadZone = 1;
    @Chassis::vehicleSpeed = 45;
    @Infotainment::speedLimit = 30;
  }
  else if (scenarioId == 3)
  {
    /* Highway no steering */
    @Infotainment::roadZone = 2;
    @Chassis::steeringInput = 0;
    @Chassis::vehicleSpeed = 80;
    @Infotainment::speedLimit = 100;
  }
  else if (scenarioId == 4)
  {
    /* Police emergency */
    @V2X::alertState = 1;
    @V2X::emergencyType = 1;
    @V2X::eta = 12;
    @V2X::emergencyDirection = 1;
    @V2X::sourceId = 11;
  }
  else if (scenarioId == 5)
  {
    /* Ambulance emergency */
    @V2X::alertState = 1;
    @V2X::emergencyType = 2;
    @V2X::eta = 8;
    @V2X::emergencyDirection = 2;
    @V2X::sourceId = 22;
  }
  else if (scenarioId == 6)
  {
    /* Timeout test preparation: emergency active then stop update externally */
    @V2X::alertState = 1;
    @V2X::emergencyType = 2;
    @V2X::eta = 5;
    @V2X::sourceId = 33;
  }
  else if (scenarioId == 7)
  {
    /* Guide zone left */
    @Infotainment::roadZone = 3;
    @Infotainment::navDirection = 1;
    @Chassis::vehicleSpeed = 35;
  }
  else if (scenarioId == 8)
  {
    /* Guide zone right */
    @Infotainment::roadZone = 3;
    @Infotainment::navDirection = 2;
    @Chassis::vehicleSpeed = 35;
  }
}

void scheduleScenarioEvaluation(int scenarioId)
{
  int evalDelayMs;

  evalDelayMs = 700;
  if (scenarioId == 3)
  {
    evalDelayMs = 11000;
  }
  else if (scenarioId == 6)
  {
    evalDelayMs = 1300;
  }
  else if (scenarioId == 7 || scenarioId == 8)
  {
    evalDelayMs = 700;
  }
  setTimer(tScenarioEval, evalDelayMs);
}

void evaluateScenarioResult()
{
  int result;
  int level;
  int type;
  int code;
  int timeoutClear;
  int ambientPattern;
  int duplicatePopupGuard;

  result = 0;
  level = (int)@Core::selectedAlertLevel;
  type = (int)@Core::selectedAlertType;
  code = (int)@Cluster::warningTextCode;
  timeoutClear = ((int)@Core::timeoutClear == 1) ? 1 : 0;
  ambientPattern = (int)@Body::ambientPattern;
  duplicatePopupGuard = (int)@CoreState::duplicatePopupGuard;

  if (gCurrentScenarioId == 1)
  {
    result = (level == 0 && code == 0) ? 1 : 0;
  }
  else if (gCurrentScenarioId == 2)
  {
    result = (level == 3 && type == 3) ? 1 : 0;
  }
  else if (gCurrentScenarioId == 3)
  {
    result = (level == 2 && type == 4) ? 1 : 0;
  }
  else if (gCurrentScenarioId == 4)
  {
    result = (level == 6 && type == 1 && code == 101 && duplicatePopupGuard > 0) ? 1 : 0;
  }
  else if (gCurrentScenarioId == 5)
  {
    result = (level == 7 && type == 2 && code == 202 && duplicatePopupGuard > 0) ? 1 : 0;
  }
  else if (gCurrentScenarioId == 6)
  {
    result = (timeoutClear == 1 && level == 0 && code == 0) ? 1 : 0;
  }
  else if (gCurrentScenarioId == 7)
  {
    result = (level == 2 && type == 5 && ambientPattern == 2 && code == 31) ? 1 : 0;
  }
  else if (gCurrentScenarioId == 8)
  {
    result = (level == 2 && type == 6 && ambientPattern == 3 && code == 32) ? 1 : 0;
  }
  else
  {
    result = ((int)@Test::scenarioResult == 1) ? 1 : 0;
  }

  @Test::scenarioResult = result;
}

void runDemoStep()
{
  gDemoStepIndex = gDemoStepIndex + 1;
  if (gDemoStepIndex > 8)
  {
    gDemoStepIndex = 1;
  }

  applyScenarioPreset(gDemoStepIndex);
  gCurrentScenarioId = gDemoStepIndex;
  scheduleScenarioEvaluation(gDemoStepIndex);
  setTimer(tDemoStep, 4000);
}

on start
{
  gDemoStepIndex = 0;
  gDemoRunning = 0;
  gCurrentScenarioId = 0;
  gBaseTraceSnapshotId = 0;
  @Test::scenarioResult = 0;
  setTimer(tInput100, 100);
  write("[SIL_TEST_CTRL] start");
}

on timer tInput100
{
  message frmVehicleStateCanMsg mVeh;
  message frmSteeringCanMsg mStr;
  message frmNavContextCanMsg mNav;
  message frmIgnitionEngineMsg mIgn;
  message frmGearStateMsg mGear;
  message frmPedalInputCanMsg mPedal;
  int speed;
  int driveState;
  int steeringInput;
  int roadZone;
  int navDirection;
  int zoneDistance;
  int speedLimit;
  int ignitionState;
  int engineState;
  int gearState;
  int accelPedal;
  int brakePedal;

  speed = clampRange((int)@Chassis::vehicleSpeed, 0, 255);
  driveState = clampRange((int)@Chassis::driveState, 0, 3);
  steeringInput = clampRange((int)@Chassis::steeringInput, 0, 1);
  roadZone = clampRange((int)@Infotainment::roadZone, 0, 3);
  navDirection = clampRange((int)@Infotainment::navDirection, 0, 3);
  zoneDistance = clampRange((int)@Infotainment::zoneDistance, 0, 255);
  speedLimit = clampRange((int)@Infotainment::speedLimit, 0, 255);
  ignitionState = calcBaselineIgnitionState(speed, driveState);
  engineState = (ignitionState == 1) ? 2 : 0;
  gearState = calcBaselineGearState(driveState);
  accelPedal = clampRange(speed / 2, 0, 100);
  brakePedal = (driveState == 0) ? 30 : 0;

  mVeh.gVehicleSpeed = speed;
  mVeh.gDriveState = driveState;
  output(mVeh);

  mStr.SteeringInput = steeringInput;
  output(mStr);

  mNav.gRoadZone = roadZone;
  mNav.gNavDirection = navDirection;
  mNav.gZoneDistance = zoneDistance;
  mNav.gSpeedLimit = speedLimit;
  output(mNav);

  /* Comm_101 baseline powertrain path */
  mIgn.IgnitionState = ignitionState;
  mIgn.EngineState = engineState;
  output(mIgn);

  mGear.GearInput = gearState;
  mGear.GearState = gearState;
  output(mGear);

  /* Comm_102 baseline chassis input path */
  mPedal.AccelPedal = accelPedal;
  mPedal.BrakePedal = brakePedal;
  output(mPedal);

  setTimer(tInput100, 100);
}

on sysvar Test::scenarioResult
{
  message frmTestResultMsg mRes;
  mRes.ScenarioResult = (int)@Test::scenarioResult;
  output(mRes);
}

on sysvar Test::testScenario
{
  int scenarioId;
  scenarioId = (int)@Test::testScenario;

  if (scenarioId == 100)
  {
    gDemoRunning = 1;
    gDemoStepIndex = 0;
    runDemoStep();
    write("[SIL_TEST_CTRL] auto demo start");
  }
  else if (scenarioId == 0)
  {
    gDemoRunning = 0;
    cancelTimer(tDemoStep);
    write("[SIL_TEST_CTRL] auto demo stop");
  }
  else if (scenarioId >= 1 && scenarioId <= 8)
  {
    gDemoRunning = 0;
    cancelTimer(tDemoStep);
    applyScenarioPreset(scenarioId);
    gCurrentScenarioId = scenarioId;
    scheduleScenarioEvaluation(scenarioId);
    write("[SIL_TEST_CTRL] apply scenario=%d", scenarioId);
  }
  else
  {
    write("[SIL_TEST_CTRL] ignore invalid scenario=%d", scenarioId);
  }
}

on timer tDemoStep
{
  if (gDemoRunning == 1)
  {
    runDemoStep();
  }
}

on timer tScenarioEval
{
  message frmBaseTestResultMsg mBase;

  evaluateScenarioResult();
  gBaseTraceSnapshotId = (gBaseTraceSnapshotId + 1) & 0xFFFF;

  /* Comm_106 baseline aggregate result frame */
  mBase.BaseScenarioId = clampRange(gCurrentScenarioId, 0, 255);
  mBase.BaseScenarioResult = ((int)@Test::scenarioResult == 1) ? 1 : 0;
  mBase.FlowCoverageMask = 0x007F; /* Flow_101~Flow_106 coverage */
  mBase.TraceSnapshotId = gBaseTraceSnapshotId;
  mBase.TestHealth = 0;
  output(mBase);
}
