includes
{
}

variables
{
  msTimer tInput100;
  msTimer tDemoStep;
  int gDemoStepIndex;
  int gDemoRunning;
}

int clampRange(int value, int minValue, int maxValue)
{
  if (value < minValue)
  {
    return minValue;
  }
  if (value > maxValue)
  {
    return maxValue;
  }
  return value;
}

void applyScenarioPreset(int scenarioId)
{
  @Chassis::driveState = 3;
  @Chassis::vehicleSpeed = 20;
  @Chassis::steeringInput = 1;
  @Infotainment::roadZone = 0;
  @Infotainment::navDirection = 0;
  @Infotainment::zoneDistance = 50;
  @V2X::alertState = 0;
  @V2X::emergencyType = 0;
  @V2X::emergencyDirection = 1;
  @V2X::eta = 10;

  if (scenarioId == 1)
  {
    /* Normal idle */
  }
  else if (scenarioId == 2)
  {
    /* School zone overspeed */
    @Infotainment::roadZone = 1;
    @Chassis::vehicleSpeed = 45;
  }
  else if (scenarioId == 3)
  {
    /* Highway no steering */
    @Infotainment::roadZone = 2;
    @Chassis::steeringInput = 0;
    @Chassis::vehicleSpeed = 80;
  }
  else if (scenarioId == 4)
  {
    /* Police emergency */
    @V2X::alertState = 1;
    @V2X::emergencyType = 1;
    @V2X::eta = 12;
    @V2X::emergencyDirection = 1;
  }
  else if (scenarioId == 5)
  {
    /* Ambulance emergency */
    @V2X::alertState = 1;
    @V2X::emergencyType = 2;
    @V2X::eta = 8;
    @V2X::emergencyDirection = 2;
  }
  else if (scenarioId == 6)
  {
    /* Timeout test preparation: emergency active then stop update externally */
    @V2X::alertState = 1;
    @V2X::emergencyType = 2;
    @V2X::eta = 5;
  }
}

void runDemoStep()
{
  gDemoStepIndex = gDemoStepIndex + 1;
  if (gDemoStepIndex > 6)
  {
    gDemoStepIndex = 1;
  }

  applyScenarioPreset(gDemoStepIndex);
  @Test::scenarioResult = 1;
  setTimer(tDemoStep, 4000);
}

on start
{
  gDemoStepIndex = 0;
  gDemoRunning = 0;
  setTimer(tInput100, 100);
  write("[SIL_TEST_CTRL] start");
}

on timer tInput100
{
  message frmVehicleStateCanMsg mVeh;
  message frmSteeringCanMsg mStr;
  message frmNavContextCanMsg mNav;
  int speed;
  int driveState;
  int steeringInput;
  int roadZone;
  int navDirection;
  int zoneDistance;

  speed = clampRange((int)@Chassis::vehicleSpeed, 0, 255);
  driveState = clampRange((int)@Chassis::driveState, 0, 3);
  steeringInput = clampRange((int)@Chassis::steeringInput, 0, 1);
  roadZone = clampRange((int)@Infotainment::roadZone, 0, 3);
  navDirection = clampRange((int)@Infotainment::navDirection, 0, 3);
  zoneDistance = clampRange((int)@Infotainment::zoneDistance, 0, 255);

  mVeh.gVehicleSpeed = speed;
  mVeh.gDriveState = driveState;
  output(mVeh);

  mStr.SteeringInput = steeringInput;
  output(mStr);

  mNav.gRoadZone = roadZone;
  mNav.gNavDirection = navDirection;
  mNav.gZoneDistance = zoneDistance;
  output(mNav);

  setTimer(tInput100, 100);
}

on sysvar Test::scenarioResult
{
  message frmTestResultMsg mRes;
  mRes.ScenarioResult = (int)@Test::scenarioResult;
  output(mRes);
}

on sysvar Test::testScenario
{
  int scenarioId;
  scenarioId = (int)@Test::testScenario;

  if (scenarioId == 100)
  {
    gDemoRunning = 1;
    gDemoStepIndex = 0;
    runDemoStep();
    write("[SIL_TEST_CTRL] auto demo start");
  }
  else if (scenarioId == 0)
  {
    gDemoRunning = 0;
    cancelTimer(tDemoStep);
    write("[SIL_TEST_CTRL] auto demo stop");
  }
  else if (scenarioId >= 1 && scenarioId <= 6)
  {
    gDemoRunning = 0;
    cancelTimer(tDemoStep);
    applyScenarioPreset(scenarioId);
    write("[SIL_TEST_CTRL] apply scenario=%d", scenarioId);
  }
  else
  {
    write("[SIL_TEST_CTRL] ignore invalid scenario=%d", scenarioId);
  }
}

on timer tDemoStep
{
  if (gDemoRunning == 1)
  {
    runDemoStep();
  }
}
