includes
{
}

variables
{
  msTimer tInput100;
  msTimer tDemoStep;
  msTimer tScenarioEval;
  int gDemoStepIndex;
  int gDemoRunning;
  int gCurrentScenarioId;
}

int clampRange(int value, int minValue, int maxValue)
{
  if (value < minValue)
  {
    return minValue;
  }
  if (value > maxValue)
  {
    return maxValue;
  }
  return value;
}

void applyScenarioPreset(int scenarioId)
{
  @Chassis::driveState = 3;
  @Chassis::vehicleSpeed = 20;
  @Chassis::steeringInput = 1;
  @Infotainment::roadZone = 0;
  @Infotainment::navDirection = 0;
  @Infotainment::zoneDistance = 50;
  @V2X::alertState = 0;
  @V2X::emergencyType = 0;
  @V2X::emergencyDirection = 1;
  @V2X::eta = 10;
  @V2X::sourceId = 1;

  if (scenarioId == 1)
  {
    /* Normal idle */
  }
  else if (scenarioId == 2)
  {
    /* School zone overspeed */
    @Infotainment::roadZone = 1;
    @Chassis::vehicleSpeed = 45;
  }
  else if (scenarioId == 3)
  {
    /* Highway no steering */
    @Infotainment::roadZone = 2;
    @Chassis::steeringInput = 0;
    @Chassis::vehicleSpeed = 80;
  }
  else if (scenarioId == 4)
  {
    /* Police emergency */
    @V2X::alertState = 1;
    @V2X::emergencyType = 1;
    @V2X::eta = 12;
    @V2X::emergencyDirection = 1;
    @V2X::sourceId = 11;
  }
  else if (scenarioId == 5)
  {
    /* Ambulance emergency */
    @V2X::alertState = 1;
    @V2X::emergencyType = 2;
    @V2X::eta = 8;
    @V2X::emergencyDirection = 2;
    @V2X::sourceId = 22;
  }
  else if (scenarioId == 6)
  {
    /* Timeout test preparation: emergency active then stop update externally */
    @V2X::alertState = 1;
    @V2X::emergencyType = 2;
    @V2X::eta = 5;
    @V2X::sourceId = 33;
  }
}

void scheduleScenarioEvaluation(int scenarioId)
{
  int evalDelayMs;

  evalDelayMs = 700;
  if (scenarioId == 3)
  {
    evalDelayMs = 11000;
  }
  else if (scenarioId == 6)
  {
    evalDelayMs = 1300;
  }
  setTimer(tScenarioEval, evalDelayMs);
}

void evaluateScenarioResult()
{
  int result;
  int level;
  int type;
  int code;
  int timeoutClear;

  result = 0;
  level = (int)@Core::selectedAlertLevel;
  type = (int)@Core::selectedAlertType;
  code = (int)@Cluster::warningTextCode;
  timeoutClear = ((int)@Core::timeoutClear == 1) ? 1 : 0;

  if (gCurrentScenarioId == 1)
  {
    result = (level == 0 && code == 0) ? 1 : 0;
  }
  else if (gCurrentScenarioId == 2)
  {
    result = (level == 3 && type == 3) ? 1 : 0;
  }
  else if (gCurrentScenarioId == 3)
  {
    result = (level == 2 && type == 4) ? 1 : 0;
  }
  else if (gCurrentScenarioId == 4)
  {
    result = (level == 6 && type == 1 && code >= 100 && code < 200) ? 1 : 0;
  }
  else if (gCurrentScenarioId == 5)
  {
    result = (level == 7 && type == 2 && code >= 200 && code < 300) ? 1 : 0;
  }
  else if (gCurrentScenarioId == 6)
  {
    result = (timeoutClear == 1 || level == 0) ? 1 : 0;
  }
  else
  {
    result = ((int)@Test::scenarioResult == 1) ? 1 : 0;
  }

  @Test::scenarioResult = result;
}

void runDemoStep()
{
  gDemoStepIndex = gDemoStepIndex + 1;
  if (gDemoStepIndex > 6)
  {
    gDemoStepIndex = 1;
  }

  applyScenarioPreset(gDemoStepIndex);
  gCurrentScenarioId = gDemoStepIndex;
  scheduleScenarioEvaluation(gDemoStepIndex);
  setTimer(tDemoStep, 4000);
}

on start
{
  gDemoStepIndex = 0;
  gDemoRunning = 0;
  gCurrentScenarioId = 0;
  @Test::scenarioResult = 0;
  setTimer(tInput100, 100);
  write("[SIL_TEST_CTRL] start");
}

on timer tInput100
{
  message frmVehicleStateCanMsg mVeh;
  message frmSteeringCanMsg mStr;
  message frmNavContextCanMsg mNav;
  int speed;
  int driveState;
  int steeringInput;
  int roadZone;
  int navDirection;
  int zoneDistance;

  speed = clampRange((int)@Chassis::vehicleSpeed, 0, 255);
  driveState = clampRange((int)@Chassis::driveState, 0, 3);
  steeringInput = clampRange((int)@Chassis::steeringInput, 0, 1);
  roadZone = clampRange((int)@Infotainment::roadZone, 0, 3);
  navDirection = clampRange((int)@Infotainment::navDirection, 0, 3);
  zoneDistance = clampRange((int)@Infotainment::zoneDistance, 0, 255);

  mVeh.gVehicleSpeed = speed;
  mVeh.gDriveState = driveState;
  output(mVeh);

  mStr.SteeringInput = steeringInput;
  output(mStr);

  mNav.gRoadZone = roadZone;
  mNav.gNavDirection = navDirection;
  mNav.gZoneDistance = zoneDistance;
  output(mNav);

  setTimer(tInput100, 100);
}

on sysvar Test::scenarioResult
{
  message frmTestResultMsg mRes;
  mRes.ScenarioResult = (int)@Test::scenarioResult;
  output(mRes);
}

on sysvar Test::testScenario
{
  int scenarioId;
  scenarioId = (int)@Test::testScenario;

  if (scenarioId == 100)
  {
    gDemoRunning = 1;
    gDemoStepIndex = 0;
    runDemoStep();
    write("[SIL_TEST_CTRL] auto demo start");
  }
  else if (scenarioId == 0)
  {
    gDemoRunning = 0;
    cancelTimer(tDemoStep);
    write("[SIL_TEST_CTRL] auto demo stop");
  }
  else if (scenarioId >= 1 && scenarioId <= 6)
  {
    gDemoRunning = 0;
    cancelTimer(tDemoStep);
    applyScenarioPreset(scenarioId);
    gCurrentScenarioId = scenarioId;
    scheduleScenarioEvaluation(scenarioId);
    write("[SIL_TEST_CTRL] apply scenario=%d", scenarioId);
  }
  else
  {
    write("[SIL_TEST_CTRL] ignore invalid scenario=%d", scenarioId);
  }
}

on timer tDemoStep
{
  if (gDemoRunning == 1)
  {
    runDemoStep();
  }
}

on timer tScenarioEval
{
  evaluateScenarioResult();
}
