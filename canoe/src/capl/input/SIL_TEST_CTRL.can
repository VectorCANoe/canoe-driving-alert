includes
{
}

variables
{
  msTimer tInput100;
  msTimer tDemoStep;
  msTimer tScenarioEval;
  int gDemoStepIndex;
  int gDemoRunning;
  int gCurrentScenarioId;
  int gCurrentSpeedLimit;
}

int clampRange(int value, int minValue, int maxValue)
{
  if (value < minValue)
  {
    return minValue;
  }
  if (value > maxValue)
  {
    return maxValue;
  }
  return value;
}

void SetManualInput(long driveState,
                    long vehicleSpeed,
                    long steeringInput,
                    long roadZone,
                    long navDirection,
                    long zoneDistance,
                    long speedLimit)
{
  @Chassis::driveState = clampRange((int)driveState, 0, 3);
  @Chassis::vehicleSpeed = clampRange((int)vehicleSpeed, 0, 255);
  @Chassis::steeringInput = clampRange((int)steeringInput, 0, 1);
  @Infotainment::roadZone = clampRange((int)roadZone, 0, 3);
  @Infotainment::navDirection = clampRange((int)navDirection, 0, 3);
  @Infotainment::zoneDistance = clampRange((int)zoneDistance, 0, 255);
  gCurrentSpeedLimit = clampRange((int)speedLimit, 0, 255);
  if (gCurrentSpeedLimit == 0)
  {
    gCurrentSpeedLimit = 30;
  }
}

void SetEmergencyInput(long alertState,
                       long emergencyType,
                       long emergencyDirection,
                       long eta,
                       long sourceId)
{
  @V2X::alertState = clampRange((int)alertState, 0, 1);
  @V2X::emergencyType = clampRange((int)emergencyType, 0, 2);
  @V2X::emergencyDirection = clampRange((int)emergencyDirection, 0, 3);
  @V2X::eta = clampRange((int)eta, 0, 255);
  @V2X::sourceId = clampRange((int)sourceId, 0, 255);
}

void ResetManualInput()
{
  SetManualInput(3, 20, 1, 0, 0, 50, 30);
  SetEmergencyInput(0, 0, 1, 10, 1);
}

void applyScenarioPreset(int scenarioId)
{
  ResetManualInput();

  if (scenarioId == 1)
  {
    /* Normal idle */
  }
  else if (scenarioId == 2)
  {
    /* School zone overspeed */
    SetManualInput(3, 45, 1, 1, 0, 50, 30);
  }
  else if (scenarioId == 3)
  {
    /* Highway no steering */
    SetManualInput(3, 80, 0, 2, 0, 50, 100);
  }
  else if (scenarioId == 4)
  {
    /* Police emergency */
    SetEmergencyInput(1, 1, 1, 12, 11);
  }
  else if (scenarioId == 5)
  {
    /* Ambulance emergency */
    SetEmergencyInput(1, 2, 2, 8, 22);
  }
  else if (scenarioId == 6)
  {
    /* Timeout test preparation: emergency active then stop update externally */
    SetEmergencyInput(1, 2, 2, 5, 33);
  }
  else if (scenarioId == 7)
  {
    /* Guide zone left */
    SetManualInput(3, 35, 1, 3, 1, 50, 30);
  }
  else if (scenarioId == 8)
  {
    /* Guide zone right */
    SetManualInput(3, 35, 1, 3, 2, 50, 30);
  }
}

void scheduleScenarioEvaluation(int scenarioId)
{
  int evalDelayMs;

  evalDelayMs = 700;
  if (scenarioId == 3)
  {
    evalDelayMs = 11000;
  }
  else if (scenarioId == 6)
  {
    evalDelayMs = 1300;
  }
  else if (scenarioId == 7 || scenarioId == 8)
  {
    evalDelayMs = 700;
  }
  setTimer(tScenarioEval, evalDelayMs);
}

void evaluateScenarioResult()
{
  int result;
  int level;
  int type;
  int code;
  int timeoutClear;
  int ambientPattern;
  int duplicatePopupGuard;

  result = 0;
  level = (int)@Core::selectedAlertLevel;
  type = (int)@Core::selectedAlertType;
  code = (int)@Cluster::warningTextCode;
  timeoutClear = ((int)@Core::timeoutClear == 1) ? 1 : 0;
  ambientPattern = (int)@Body::ambientPattern;
  duplicatePopupGuard = (int)@CoreState::duplicatePopupGuard;

  if (gCurrentScenarioId == 1)
  {
    result = (level == 0 && code == 0) ? 1 : 0;
  }
  else if (gCurrentScenarioId == 2)
  {
    result = (level == 3 && type == 3) ? 1 : 0;
  }
  else if (gCurrentScenarioId == 3)
  {
    result = (level == 2 && type == 4) ? 1 : 0;
  }
  else if (gCurrentScenarioId == 4)
  {
    result = (level == 6 && type == 1 && code == 101 && duplicatePopupGuard > 0) ? 1 : 0;
  }
  else if (gCurrentScenarioId == 5)
  {
    result = (level == 7 && type == 2 && code == 202 && duplicatePopupGuard > 0) ? 1 : 0;
  }
  else if (gCurrentScenarioId == 6)
  {
    result = (timeoutClear == 1 && level == 0 && code == 0) ? 1 : 0;
  }
  else if (gCurrentScenarioId == 7)
  {
    result = (level == 2 && type == 5 && ambientPattern == 2 && code == 31) ? 1 : 0;
  }
  else if (gCurrentScenarioId == 8)
  {
    result = (level == 2 && type == 6 && ambientPattern == 3 && code == 32) ? 1 : 0;
  }
  else
  {
    result = ((int)@Test::scenarioResult == 1) ? 1 : 0;
  }

  @Test::scenarioResult = result;
}

void runDemoStep()
{
  gDemoStepIndex = gDemoStepIndex + 1;
  if (gDemoStepIndex > 8)
  {
    gDemoStepIndex = 1;
  }

  applyScenarioPreset(gDemoStepIndex);
  gCurrentScenarioId = gDemoStepIndex;
  scheduleScenarioEvaluation(gDemoStepIndex);
  setTimer(tDemoStep, 4000);
}

on start
{
  gDemoStepIndex = 0;
  gDemoRunning = 0;
  gCurrentScenarioId = 0;
  @Test::scenarioResult = 0;
  setTimer(tInput100, 100);
  write("[SIL_TEST_CTRL] start");
}

on timer tInput100
{
  message frmVehicleStateCanMsg mVeh;
  message frmSteeringCanMsg mStr;
  message frmNavContextCanMsg mNav;
  int speed;
  int driveState;
  int steeringInput;
  int roadZone;
  int navDirection;
  int zoneDistance;
  int speedLimit;

  speed = clampRange((int)@Chassis::vehicleSpeed, 0, 255);
  driveState = clampRange((int)@Chassis::driveState, 0, 3);
  steeringInput = clampRange((int)@Chassis::steeringInput, 0, 1);
  roadZone = clampRange((int)@Infotainment::roadZone, 0, 3);
  navDirection = clampRange((int)@Infotainment::navDirection, 0, 3);
  zoneDistance = clampRange((int)@Infotainment::zoneDistance, 0, 255);
  speedLimit = clampRange(gCurrentSpeedLimit, 0, 255);

  mVeh.gVehicleSpeed = speed;
  mVeh.gDriveState = driveState;
  output(mVeh);

  mStr.SteeringInput = steeringInput;
  output(mStr);

  mNav.gRoadZone = roadZone;
  mNav.gNavDirection = navDirection;
  mNav.gZoneDistance = zoneDistance;
  mNav.gSpeedLimit = speedLimit;
  output(mNav);

  setTimer(tInput100, 100);
}

on sysvar Test::scenarioResult
{
  message frmTestResultMsg mRes;
  mRes.ScenarioResult = (int)@Test::scenarioResult;
  output(mRes);
}

on sysvar Test::testScenario
{
  int scenarioId;
  scenarioId = (int)@Test::testScenario;

  if (scenarioId == 100)
  {
    gDemoRunning = 1;
    gDemoStepIndex = 0;
    runDemoStep();
    write("[SIL_TEST_CTRL] auto demo start");
  }
  else if (scenarioId == 0)
  {
    gDemoRunning = 0;
    cancelTimer(tDemoStep);
    write("[SIL_TEST_CTRL] auto demo stop");
  }
  else if (scenarioId >= 1 && scenarioId <= 8)
  {
    gDemoRunning = 0;
    cancelTimer(tDemoStep);
    applyScenarioPreset(scenarioId);
    gCurrentScenarioId = scenarioId;
    scheduleScenarioEvaluation(scenarioId);
    write("[SIL_TEST_CTRL] apply scenario=%d", scenarioId);
  }
  else
  {
    write("[SIL_TEST_CTRL] ignore invalid scenario=%d", scenarioId);
  }
}

on timer tDemoStep
{
  if (gDemoRunning == 1)
  {
    runDemoStep();
  }
}

on timer tScenarioEval
{
  evaluateScenarioResult();
}
