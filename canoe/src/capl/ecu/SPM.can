includes
{
  #include "..\\common\\CAPL_COMMON.cin"
}

variables
{
  msTimer tSurroundParkCycle;
  int gAvmActive;
  int gViewMode;
  int gParkAssistActive;
  int gMinDistanceCm;
  int gSpasSteerAssist;
  int gRspaBrakeHold;
  int gLastActive;
  int gLastReady;
  int gLastViewMode;
  int gLastProximityClass;
  int gLastDistance;
}

void publishSurroundParkState()
{
  message frmSurroundParkMasterStateMsg mSurround;
  int surroundActive;
  int autoParkReady;
  int proximityClass;
  int distanceBucket;

  surroundActive = (gAvmActive == 1 || gParkAssistActive == 1) ? 1 : 0;
  autoParkReady = (gSpasSteerAssist == 1 || gRspaBrakeHold == 1) ? 1 : 0;

  if (gMinDistanceCm <= 30)
  {
    proximityClass = 3;
  }
  else if (gMinDistanceCm <= 60)
  {
    proximityClass = 2;
  }
  else if (gMinDistanceCm <= 120)
  {
    proximityClass = 1;
  }
  else
  {
    proximityClass = 0;
  }

  distanceBucket = clampRange(gMinDistanceCm, 0, 255);

  mSurround.SurroundActive = surroundActive;
  mSurround.AutoParkReady = autoParkReady;
  mSurround.ViewMode = clampRange(gViewMode, 0, 7);
  mSurround.ProximityClass = clampRange(proximityClass, 0, 3);
  mSurround.SteeringAssistReq = clampRange(gSpasSteerAssist, 0, 1);
  mSurround.BrakeHoldReq = clampRange(gRspaBrakeHold, 0, 1);
  mSurround.DistanceBucket = distanceBucket;
  output(mSurround);

  if (surroundActive != gLastActive ||
      autoParkReady != gLastReady ||
      gViewMode != gLastViewMode ||
      proximityClass != gLastProximityClass ||
      distanceBucket != gLastDistance)
  {
    write("[SPM] active=%d ready=%d view=%d prox=%d dist=%d steer=%d hold=%d",
          surroundActive,
          autoParkReady,
          gViewMode,
          proximityClass,
          distanceBucket,
          gSpasSteerAssist,
          gRspaBrakeHold);
    gLastActive = surroundActive;
    gLastReady = autoParkReady;
    gLastViewMode = gViewMode;
    gLastProximityClass = proximityClass;
    gLastDistance = distanceBucket;
  }
}

on start
{
  gAvmActive = 0;
  gViewMode = 0;
  gParkAssistActive = 0;
  gMinDistanceCm = 255;
  gSpasSteerAssist = 0;
  gRspaBrakeHold = 0;
  gLastActive = -1;
  gLastReady = -1;
  gLastViewMode = -1;
  gLastProximityClass = -1;
  gLastDistance = -1;
  setTimer(tSurroundParkCycle, 100);
  write("[SPM] start");
}

on timer tSurroundParkCycle
{
  publishSurroundParkState();
  setTimer(tSurroundParkCycle, 100);
}

on message frmAvmStateMsg
{
  gAvmActive = clampRange((int)this.AvmActive, 0, 1);
  gViewMode = clampRange((int)this.ViewMode, 0, 7);
}

on message frmParkUltrasonicStateMsg
{
  gParkAssistActive = clampRange((int)this.ParkAssistActive, 0, 1);
  gMinDistanceCm = clampRange((int)this.MinDistanceCm, 0, 255);
}

on message frmSpasStateMsg
{
  gSpasSteerAssist = clampRange((int)this.SteeringAssistReq, 0, 1);
}

on message frmRspaStateMsg
{
  gRspaBrakeHold = clampRange((int)this.BrakeHoldReq, 0, 1);
}

on stopMeasurement
{
  cancelTimer(tSurroundParkCycle);
}
