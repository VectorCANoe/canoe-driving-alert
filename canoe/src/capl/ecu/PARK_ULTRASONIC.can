includes
{
  #include "..\\common\\CAPL_COMMON.cin"
}

variables
{
  msTimer tParkUltrasonicCycle;
  int gLastActive;
  int gLastDistance;
  int gLastZoneMask;
  int gLastAudibleWarn;
}

void publishParkUltrasonicState()
{
  message frmParkUltrasonicStateMsg mPark;
  int vehicleSpeed;
  int brakePedal;
  int steeringInput;
  int active;
  int minDistance;
  int zoneMask;
  int audibleWarn;

  vehicleSpeed = clampRange((int)@Core::vehicleSpeedNorm, 0, 255);
  brakePedal = clampRange((int)@Core::brakePedalNorm, 0, 1);
  steeringInput = clampRange((int)@Core::steeringInputNorm, 0, 1);

  active = (vehicleSpeed <= 15) ? 1 : 0;
  minDistance = 255;
  zoneMask = 0;
  audibleWarn = 0;

  if (active == 1)
  {
    minDistance = (vehicleSpeed <= 5) ? 35 : 80;
    if (brakePedal == 1)
    {
      zoneMask = zoneMask | 0x01;
    }
    if (steeringInput == 1)
    {
      zoneMask = zoneMask | 0x02;
    }
    if (vehicleSpeed <= 3)
    {
      audibleWarn = 1;
    }
  }

  mPark.ParkAssistActive = active;
  mPark.MinDistanceCm = minDistance;
  mPark.ZoneMask = zoneMask;
  mPark.AudibleWarn = audibleWarn;
  output(mPark);

  if (active != gLastActive ||
      minDistance != gLastDistance ||
      zoneMask != gLastZoneMask ||
      audibleWarn != gLastAudibleWarn)
  {
    write("[PARK_ULTRASONIC] active=%d dist=%d zone=0x%02X warn=%d speed=%d",
          active,
          minDistance,
          zoneMask,
          audibleWarn,
          vehicleSpeed);
    gLastActive = active;
    gLastDistance = minDistance;
    gLastZoneMask = zoneMask;
    gLastAudibleWarn = audibleWarn;
  }
}

on start
{
  gLastActive = -1;
  gLastDistance = -1;
  gLastZoneMask = -1;
  gLastAudibleWarn = -1;
  setTimer(tParkUltrasonicCycle, 100);
  write("[PARK_ULTRASONIC] start");
}

on timer tParkUltrasonicCycle
{
  publishParkUltrasonicState();
  setTimer(tParkUltrasonicCycle, 100);
}

on stopMeasurement
{
  cancelTimer(tParkUltrasonicCycle);
}
