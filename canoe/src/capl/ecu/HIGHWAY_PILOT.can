includes
{
  #include "..\\common\\CAPL_COMMON.cin"
}

variables
{
  msTimer tHighwayPilotCycle;
  int gCruiseState;
  int gSetSpeed;
  int gLaneGuideState;
  int gDmsActive;
  int gAttentionLevel;
  int gLastReady;
  int gLastLongCtrl;
  int gLastLatCtrl;
  int gLastDriverReq;
  int gLastAvail;
}

void publishHighwayPilotState()
{
  message frmHighwayPilotStateMsg mHp;
  int baseZoneContext;
  int highwayReady;
  int longCtrlActive;
  int latCtrlActive;
  int driverMonitorReq;
  int availabilityLevel;

  baseZoneContext = clampRange((int)@Core::baseZoneContext, 0, 7);

  highwayReady = (baseZoneContext == 2 && gCruiseState >= 1 && gAttentionLevel <= 2) ? 1 : 0;
  longCtrlActive = (highwayReady == 1 && gCruiseState == 2) ? 1 : 0;
  latCtrlActive = (highwayReady == 1 && gLaneGuideState >= 2) ? 1 : 0;
  driverMonitorReq = (gDmsActive == 1 && gAttentionLevel >= 2) ? 1 : 0;

  availabilityLevel = 0;
  if (highwayReady == 1)
  {
    availabilityLevel = 1;
  }
  if (longCtrlActive == 1 && latCtrlActive == 1)
  {
    availabilityLevel = 2;
  }
  if (driverMonitorReq == 1)
  {
    availabilityLevel = 1;
  }

  mHp.HighwayPilotReady = highwayReady;
  mHp.LongCtrlActive = longCtrlActive;
  mHp.LatCtrlActive = latCtrlActive;
  mHp.DriverMonitorReq = driverMonitorReq;
  mHp.AvailabilityLevel = clampRange(availabilityLevel, 0, 3);
  mHp.SetSpeed = clampRange(gSetSpeed, 0, 255);
  mHp.LaneGuideState = clampRange(gLaneGuideState, 0, 3);
  mHp.CruiseState = clampRange(gCruiseState, 0, 3);
  output(mHp);

  if (highwayReady != gLastReady ||
      longCtrlActive != gLastLongCtrl ||
      latCtrlActive != gLastLatCtrl ||
      driverMonitorReq != gLastDriverReq ||
      availabilityLevel != gLastAvail)
  {
    write("[HIGHWAY_PILOT] ready=%d long=%d lat=%d dmsReq=%d avail=%d setSpeed=%d lane=%d",
          highwayReady,
          longCtrlActive,
          latCtrlActive,
          driverMonitorReq,
          availabilityLevel,
          gSetSpeed,
          gLaneGuideState);
    gLastReady = highwayReady;
    gLastLongCtrl = longCtrlActive;
    gLastLatCtrl = latCtrlActive;
    gLastDriverReq = driverMonitorReq;
    gLastAvail = availabilityLevel;
  }
}

on start
{
  gCruiseState = 0;
  gSetSpeed = 0;
  gLaneGuideState = 0;
  gDmsActive = 0;
  gAttentionLevel = 1;
  gLastReady = -1;
  gLastLongCtrl = -1;
  gLastLatCtrl = -1;
  gLastDriverReq = -1;
  gLastAvail = -1;
  setTimer(tHighwayPilotCycle, 100);
  write("[HIGHWAY_PILOT] start");
}

on timer tHighwayPilotCycle
{
  publishHighwayPilotState();
  setTimer(tHighwayPilotCycle, 100);
}

on message frmCruiseStateMsg
{
  gCruiseState = clampRange((int)this.CruiseState, 0, 3);
  gSetSpeed = clampRange((int)this.SetSpeedKph, 0, 255);
}

on message frmLdwsLkasStateMsg
{
  gLaneGuideState = clampRange((int)this.LaneGuideState, 0, 3);
}

on message frmDmsStateMsg
{
  gDmsActive = clampRange((int)this.DriverMonitorActive, 0, 1);
  gAttentionLevel = clampRange((int)this.AttentionLevel, 0, 3);
}

on stopMeasurement
{
  cancelTimer(tHighwayPilotCycle);
}