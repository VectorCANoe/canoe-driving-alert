includes
{
  #include "..\\common\\CAPL_COMMON.cin"
}

variables
{
  msTimer tCarpayCycle;
  int gServiceMode;
  int gSignalBars;
  int gRemoteClimateReq;
  int gLastPayState;
  int gLastWallet;
  int gLastReceipt;
  int gLastQuality;
}

on start
{
  gServiceMode = 0;
  gSignalBars = 0;
  gRemoteClimateReq = 0;
  gLastPayState = -1;
  gLastWallet = -1;
  gLastReceipt = -1;
  gLastQuality = -1;
  setTimer(tCarpayCycle, 100);
  write("[CPAY] start");
}

on message frmTmuServiceStateMsg
{
  gServiceMode = clampRange((int)this.TmuServiceMode, 0, 3);
  gRemoteClimateReq = clampRange((int)this.RemoteClimateReq, 0, 1);
  gSignalBars = clampRange((int)this.SignalBars, 0, 15);
}

on timer tCarpayCycle
{
  message frmCarpayCtrlStateMsg mPay;
  int paymentState;
  int walletLinkState;
  int receiptPending;
  int serviceQuality;

  walletLinkState = (gServiceMode > 0 && gSignalBars >= 2) ? 1 : 0;
  paymentState = 0;
  if (walletLinkState == 1)
  {
    paymentState = (gRemoteClimateReq == 1) ? 2 : 1;
  }
  receiptPending = (paymentState == 2) ? 1 : 0;
  serviceQuality = clampRange(gSignalBars * 20, 0, 100);

  mPay.PaymentState = clampRange(paymentState, 0, 7);
  mPay.WalletLinkState = clampRange(walletLinkState, 0, 3);
  mPay.ReceiptPending = clampRange(receiptPending, 0, 1);
  mPay.ServiceQuality = serviceQuality;
  output(mPay);

  if (mPay.PaymentState != gLastPayState ||
      mPay.WalletLinkState != gLastWallet ||
      mPay.ReceiptPending != gLastReceipt ||
      mPay.ServiceQuality != gLastQuality)
  {
    write("[CPAY] pay=%d wallet=%d receipt=%d quality=%d bars=%d",
          mPay.PaymentState,
          mPay.WalletLinkState,
          mPay.ReceiptPending,
          mPay.ServiceQuality,
          gSignalBars);
    gLastPayState = mPay.PaymentState;
    gLastWallet = mPay.WalletLinkState;
    gLastReceipt = mPay.ReceiptPending;
    gLastQuality = mPay.ServiceQuality;
  }

  setTimer(tCarpayCycle, 100);
}

on stopMeasurement
{
  cancelTimer(tCarpayCycle);
}

