includes
{
  #include "..\\common\\CAPL_COMMON.cin"
}

variables
{
  msTimer tLidarCycle;
  int gObjectConfidence;
  int gObjectEventCode;
  int gObjectTrackValid;
  int gObjectFailSafeMode;
  int gLastHealth;
  int gLastDetected;
  int gLastFreeSpaceClass;
  int gLastConfidence;
  int gLastRangeBucket;
}

void publishLidarState()
{
  message frmLidarStateMsg mLidar;
  int health;
  int targetDetected;
  int freeSpaceClass;
  int rangeBucket;

  targetDetected = clampRange(gObjectTrackValid, 0, 1);

  if (gObjectFailSafeMode >= 2)
  {
    health = 0;
  }
  else if (gObjectConfidence >= 70)
  {
    health = 2;
  }
  else if (gObjectConfidence >= 30)
  {
    health = 1;
  }
  else
  {
    health = 0;
  }

  if (gObjectConfidence >= 80)
  {
    freeSpaceClass = 2;
  }
  else if (gObjectConfidence >= 40)
  {
    freeSpaceClass = 1;
  }
  else
  {
    freeSpaceClass = 0;
  }

  rangeBucket = clampRange((gObjectEventCode -band 0xFF), 0, 255);

  mLidar.LidarHealth = clampRange(health, 0, 3);
  mLidar.TargetDetected = targetDetected;
  mLidar.FreeSpaceClass = clampRange(freeSpaceClass, 0, 3);
  mLidar.Confidence = clampRange(gObjectConfidence, 0, 100);
  mLidar.RangeBucket = rangeBucket;
  output(mLidar);

  if (health != gLastHealth ||
      targetDetected != gLastDetected ||
      freeSpaceClass != gLastFreeSpaceClass ||
      gObjectConfidence != gLastConfidence ||
      rangeBucket != gLastRangeBucket)
  {
    write("[LDR] health=%d target=%d free=%d conf=%d range=%d failSafe=%d",
          health,
          targetDetected,
          freeSpaceClass,
          gObjectConfidence,
          rangeBucket,
          gObjectFailSafeMode);
    gLastHealth = health;
    gLastDetected = targetDetected;
    gLastFreeSpaceClass = freeSpaceClass;
    gLastConfidence = gObjectConfidence;
    gLastRangeBucket = rangeBucket;
  }
}

on start
{
  gObjectConfidence = 0;
  gObjectEventCode = 0;
  gObjectTrackValid = 0;
  gObjectFailSafeMode = 0;
  gLastHealth = -1;
  gLastDetected = -1;
  gLastFreeSpaceClass = -1;
  gLastConfidence = -1;
  gLastRangeBucket = -1;
  setTimer(tLidarCycle, 100);
  write("[LDR] start");
}

on timer tLidarCycle
{
  publishLidarState();
  setTimer(tLidarCycle, 100);
}

on message ethObjectSafetyStateMsg
{
  gObjectConfidence = clampRange((int)this.ObjectConfidence, 0, 100);
  gObjectEventCode = clampRange((int)this.ObjectEventCode, 0, 65535);
  gObjectFailSafeMode = clampRange((int)this.ObjectFailSafeMode, 0, 2);
  gObjectTrackValid = clampRange((int)this.ObjectTrackValid, 0, 1);
}

on stopMeasurement
{
  cancelTimer(tLidarCycle);
}