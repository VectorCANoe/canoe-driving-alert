includes
{
  #include "..\\common\\CAPL_COMMON.cin"
}

variables
{
  msTimer tLidarCycle;
  long gEthSocket;
  char gEthRxBuffer[64];
  int gObjectConfidence;
  int gObjectEventCode;
  int gObjectTrackValid;
  int gObjectFailSafeMode;
  dword gObjectSafetyRxTsMs;
  int gLastHealth;
  int gLastDetected;
  int gLastFreeSpaceClass;
  int gLastConfidence;
  int gLastRangeBucket;
}

void publishLidarState()
{
  message frmLidarStateMsg mLidar;
  int health;
  int targetDetected;
  int freeSpaceClass;
  int rangeBucket;
  int objectConfidence;
  int objectEventCode;
  int objectTrackValid;
  int objectFailSafeMode;

  objectConfidence = clampRange((int)@Core::objectConfidence, 0, 100);
  objectEventCode = clampRange((int)@Core::objectEventCode, 0, 65535);
  objectTrackValid = clampRange((int)@Core::objectTrackValid, 0, 1);
  objectFailSafeMode = clampRange((int)@Core::failSafeMode, 0, 2);

  if (ethIsRecentTick(gObjectSafetyRxTsMs, 300) == 1)
  {
    if (gObjectConfidence > objectConfidence)
    {
      objectConfidence = gObjectConfidence;
    }
    if (gObjectEventCode != 0)
    {
      objectEventCode = gObjectEventCode;
    }
    if (gObjectTrackValid > objectTrackValid)
    {
      objectTrackValid = gObjectTrackValid;
    }
    if (gObjectFailSafeMode > objectFailSafeMode)
    {
      objectFailSafeMode = gObjectFailSafeMode;
    }
  }

  targetDetected = clampRange(objectTrackValid, 0, 1);

  if (objectFailSafeMode >= 2)
  {
    health = 0;
  }
  else if (objectConfidence >= 70)
  {
    health = 2;
  }
  else if (objectConfidence >= 30)
  {
    health = 1;
  }
  else
  {
    health = 0;
  }

  if (objectConfidence >= 80)
  {
    freeSpaceClass = 2;
  }
  else if (objectConfidence >= 40)
  {
    freeSpaceClass = 1;
  }
  else
  {
    freeSpaceClass = 0;
  }

  rangeBucket = clampRange((objectEventCode & 0xFF), 0, 255);

  mLidar.LidarHealth = clampRange(health, 0, 3);
  mLidar.TargetDetected = targetDetected;
  mLidar.FreeSpaceClass = clampRange(freeSpaceClass, 0, 3);
  mLidar.Confidence = clampRange(objectConfidence, 0, 100);
  mLidar.RangeBucket = rangeBucket;
  output(mLidar);

  if (health != gLastHealth ||
      targetDetected != gLastDetected ||
      freeSpaceClass != gLastFreeSpaceClass ||
      objectConfidence != gLastConfidence ||
      rangeBucket != gLastRangeBucket)
  {
    write("[LDR] health=%d target=%d free=%d conf=%d range=%d failSafe=%d",
          health,
          targetDetected,
          freeSpaceClass,
          objectConfidence,
          rangeBucket,
          objectFailSafeMode);
    gLastHealth = health;
    gLastDetected = targetDetected;
    gLastFreeSpaceClass = freeSpaceClass;
    gLastConfidence = objectConfidence;
    gLastRangeBucket = rangeBucket;
  }
}

void OnUdpReceiveFrom(dword socket, long result, dword address, dword port, char buffer[], dword count)
{
  int msgId;
  int payload3;

  if (socket != gEthSocket)
  {
    return;
  }
  if (result == 0)
  {
    msgId = ethFrameMsgId(buffer, count);
    if (msgId == ethMsgObjectSafety() && ethFramePayloadLen(count) >= 4)
    {
      payload3 = ethGetU8(buffer, 3);
      gObjectConfidence = clampRange(ethGetU8(buffer, 0), 0, 100);
      gObjectEventCode = clampRange(ethGetU16Le(buffer, 1), 0, 65535);
      gObjectFailSafeMode = clampRange(payload3 & 0x3, 0, 2);
      gObjectTrackValid = clampRange((payload3 >> 2) & 0x1, 0, 1);
      gObjectSafetyRxTsMs = getSimulationTimeMs();
    }
  }

  ethArmReceive(gEthSocket, gEthRxBuffer, elcount(gEthRxBuffer));
}

on start
{
  gEthSocket = ethOpenDefaultSocket();
  gObjectConfidence = 0;
  gObjectEventCode = 0;
  gObjectTrackValid = 0;
  gObjectFailSafeMode = 0;
  gObjectSafetyRxTsMs = 0;
  gLastHealth = -1;
  gLastDetected = -1;
  gLastFreeSpaceClass = -1;
  gLastConfidence = -1;
  gLastRangeBucket = -1;
  if (gEthSocket != ethInvalidSocket())
  {
    ethStartReceiver(gEthSocket, gEthRxBuffer, elcount(gEthRxBuffer));
  }
  setTimer(tLidarCycle, 100);
  write("[LDR] start");
}

on timer tLidarCycle
{
  publishLidarState();
  setTimer(tLidarCycle, 100);
}

on stopMeasurement
{
  cancelTimer(tLidarCycle);
  ethCloseSocket(gEthSocket);
  gEthSocket = ethInvalidSocket();
}
