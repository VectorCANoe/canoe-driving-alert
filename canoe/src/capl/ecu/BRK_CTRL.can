/*@!Encoding:65001*/
// BRK_CTRL.can
// Chassis Domain — 브레이크 압력 램프 + ABS/ESC 시뮬레이션
// 입력  : frmPedalInputCanMsg.BrakePedal (from PEDAL_BUTTON_CTRL)
//         @Powertrain::ignitionState     (from ENG_CTRL bridge)
// 출력  : @Chassis::brakePressure (ACCEL_CTRL가 참조)
//         frmBrakeStatusMsg, frmAbsStateMsg, frmEscStateMsg,
//         frmBrakeTempMsg, frmBrakeWearMsg

includes
{
}

variables
{
  msTimer tBrakeCycle;
  double  gBrakePressureActual;   // 현재 실제 압력 (부드러운 램프)
  int     gBrakePedal;            // CAN 수신 페달 목표값 (0-100)
  int     gWheelSpdFL;
  int     gLastBrakePedal;
  int     gLastAssistReq;
}

on start
{
  gBrakePressureActual = 0.0;
  gBrakePedal          = 0;
  gWheelSpdFL          = 0;
  gLastBrakePedal      = -1;
  gLastAssistReq       = -1;
  setTimer(tBrakeCycle, 100);
  write("[BRK_CTRL] start — pressure ramp +5.0/-3.0 per 100ms");
}

// PEDAL_BUTTON_CTRL이 출력한 frmPedalInputCanMsg 수신
on message frmPedalInputCanMsg
{
  gBrakePedal = this.BrakePedal;
  if (gBrakePedal < 0)   gBrakePedal = 0;
  if (gBrakePedal > 100) gBrakePedal = 100;
}

on message frmWheelSpeedMsg
{
  gWheelSpdFL = this.WheelSpdFL;
}

on timer tBrakeCycle
{
  message frmBrakeStatusMsg mStatus;
  message frmAbsStateMsg    mAbs;
  message frmEscStateMsg    mEsc;
  message frmBrakeTempMsg   mTemp;
  message frmBrakeWearMsg   mWear;

  int ignition;
  int decelAssistReq;
  int appliedBrakePedal;
  int brakePressure;
  int absActive;
  int espActive;
  int absSlip;

  ignition = (int)@Powertrain::ignitionState;

  // 시동 OFF → 즉시 압력 0
  if (ignition == 0)
  {
    gBrakePressureActual    = 0.0;
    @Chassis::brakePressure = 0;
    setTimer(tBrakeCycle, 100);
    return;
  }

  // ── 압력 램프 (+5.0 상승 / -3.0 하강 per 100ms) ──────────────
  if ((double)gBrakePedal > gBrakePressureActual)
  {
    gBrakePressureActual += 5.0;
    if (gBrakePressureActual > (double)gBrakePedal)
      gBrakePressureActual = (double)gBrakePedal;
  }
  else if ((double)gBrakePedal < gBrakePressureActual)
  {
    gBrakePressureActual -= 3.0;
    if (gBrakePressureActual < (double)gBrakePedal)
      gBrakePressureActual = (double)gBrakePedal;
  }
  // ──────────────────────────────────────────────────────────────

  // ACCEL_CTRL가 이 값을 읽어 속도를 감속시킴
  @Chassis::brakePressure = (int)gBrakePressureActual;

  // Decel Assist (ADAS 긴급 감속 요청)
  decelAssistReq    = ((int)@Core::decelAssistReq == 1) ? 1 : 0;
  appliedBrakePedal = (int)gBrakePressureActual;
  if (decelAssistReq == 1 && appliedBrakePedal < 25)
    appliedBrakePedal = 25;

  // CAN 신호로 변환 (0-100% → 0-255)
  brakePressure = appliedBrakePedal * 2;
  if (brakePressure > 255) brakePressure = 255;

  absActive = ((appliedBrakePedal > 80) && (gWheelSpdFL > 10)) ? 1 : 0;
  absSlip   = absActive ? ((appliedBrakePedal - 80) & 0x3F) : 0;
  espActive = ((appliedBrakePedal > 40) && ((int)@Core::steeringInputNorm == 1)) ? 1 : 0;

  mStatus.BrakePressure = brakePressure;
  mStatus.BrakeMode     = (appliedBrakePedal > 80) ? 2 : ((appliedBrakePedal > 0) ? 1 : 0);
  mStatus.AbsActive     = absActive;
  mStatus.EspActive     = espActive;
  output(mStatus);

  mAbs.AbsCtrlState   = absActive ? 2 : 0;
  mAbs.AbsSlipLevel   = absSlip;
  mAbs.AbsPressureCmd = absActive ? brakePressure : 0;
  output(mAbs);

  mEsc.EscCtrlState    = espActive ? 2 : 0;
  mEsc.EscIntervention = espActive ? ((appliedBrakePedal - 40) & 0x3F) : 0;
  mEsc.EscYawTarget    = 128;
  output(mEsc);

  mTemp.BrakeTempFL = 30 + (appliedBrakePedal / 5);
  mTemp.BrakeTempFR = 30 + (appliedBrakePedal / 5);
  output(mTemp);

  mWear.BrakePadWearLvl = 10;
  output(mWear);

  if (gBrakePedal != gLastBrakePedal || decelAssistReq != gLastAssistReq)
  {
    write("[BRK_CTRL] pedal=%d actual=%.1f applied=%d pressure=%d abs=%d esp=%d",
          gBrakePedal, gBrakePressureActual, appliedBrakePedal,
          brakePressure, absActive, espActive);
    gLastBrakePedal = gBrakePedal;
    gLastAssistReq  = decelAssistReq;
  }

  setTimer(tBrakeCycle, 100);
}
