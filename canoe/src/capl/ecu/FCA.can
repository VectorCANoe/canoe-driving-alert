includes
{
  #include "..\\common\\CAPL_COMMON.cin"
}

variables
{
  msTimer tFcaCycle;
  int gLastFcwState;
  int gLastAebRequest;
  int gLastObjectRiskClass;
  int gLastTtcBucket;
  int gLastAlertLevel;
}

int calcFcwState(int objectRiskClass, int objectTtcMin, int decelAssistReq)
{
  if (decelAssistReq == 1 && objectRiskClass >= 4)
  {
    return 3;
  }
  if (objectRiskClass >= 4 || objectTtcMin <= 1800)
  {
    return 2;
  }
  if (objectRiskClass >= 3 || objectTtcMin <= 2500)
  {
    return 1;
  }
  return 0;
}

void publishFcaState()
{
  message frmFcaStateMsg mFca;
  int objectRiskClass;
  int objectTtcMin;
  int decelAssistReq;
  int alertLevel;
  int fcwState;
  int aebRequest;
  int ttcBucket;

  objectRiskClass = clampRange((int)@Core::objectRiskClass, 0, 7);
  objectTtcMin = clampRange((int)@Core::objectTtcMin, 0, 10000);
  decelAssistReq = (((int)@Core::decelAssistReq) == 1) ? 1 : 0;
  alertLevel = clampRange((int)@Core::selectedAlertLevel, 0, 7);

  fcwState = calcFcwState(objectRiskClass, objectTtcMin, decelAssistReq);
  aebRequest = (decelAssistReq == 1 && objectRiskClass >= 4) ? 1 : 0;
  ttcBucket = clampRange(objectTtcMin / 100, 0, 255);

  mFca.FcwState = fcwState;
  mFca.AebRequest = aebRequest;
  mFca.DecelAssistReq = decelAssistReq;
  mFca.ObjectRiskClass = objectRiskClass;
  mFca.TtcBucket = ttcBucket;
  mFca.SelectedAlertLevel = alertLevel;
  output(mFca);

  if (fcwState != gLastFcwState ||
      aebRequest != gLastAebRequest ||
      objectRiskClass != gLastObjectRiskClass ||
      ttcBucket != gLastTtcBucket ||
      alertLevel != gLastAlertLevel)
  {
    write("[FCA] fcw=%d aeb=%d riskClass=%d ttcBucket=%d alert=%d",
          fcwState,
          aebRequest,
          objectRiskClass,
          ttcBucket,
          alertLevel);
    gLastFcwState = fcwState;
    gLastAebRequest = aebRequest;
    gLastObjectRiskClass = objectRiskClass;
    gLastTtcBucket = ttcBucket;
    gLastAlertLevel = alertLevel;
  }
}

on start
{
  gLastFcwState = -1;
  gLastAebRequest = -1;
  gLastObjectRiskClass = -1;
  gLastTtcBucket = -1;
  gLastAlertLevel = -1;
  setTimer(tFcaCycle, 100);
  write("[FCA] start");
}

on timer tFcaCycle
{
  publishFcaState();
  setTimer(tFcaCycle, 100);
}

on stopMeasurement
{
  cancelTimer(tFcaCycle);
}
