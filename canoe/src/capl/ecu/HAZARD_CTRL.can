includes
{
}

variables
{
}

on start
{
  write("[HAZARD_CTRL] absorbed into BCM runtime; wrapper only");
}
