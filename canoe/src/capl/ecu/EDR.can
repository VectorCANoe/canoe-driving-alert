includes
{
  #include "..\\common\\CAPL_COMMON.cin"
}

variables
{
  msTimer tEdrCycle;
  long gEthSocket;
  char gEthRxBuffer[64];
  int gAlertLevel;
  int gFailSafeMode;
  int gWarningPathStatus;
  int gE2eHealthState;
  int gObjectTrackValid;
  int gObjectEventCode;
  dword gSelectedAlertRxTsMs;
  dword gFailSafeRxTsMs;
  dword gObjectSafetyRxTsMs;
  int gLastRecordState;
  int gLastEventSeverity;
  int gLastRecordReason;
  int gLastStorageLevel;
  int gLastEventCode;
}

void publishEdrState()
{
  int alertLevel;
  int recordState;
  int eventSeverity;
  int recordReason;
  int storageLevel;
  int lastEventCode;
  int failSafeMode;
  int warningPathStatus;
  int e2eHealthState;
  int objectTrackValid;
  int objectEventCode;

  alertLevel = 0;
  failSafeMode = 0;
  warningPathStatus = 0;
  e2eHealthState = 2;
  objectTrackValid = 0;
  objectEventCode = 0;

  if (ethIsRecentTick(gSelectedAlertRxTsMs, 300) == 1)
  {
    alertLevel = gAlertLevel;
  }

  if (ethIsRecentTick(gFailSafeRxTsMs, 300) == 1)
  {
    warningPathStatus = gWarningPathStatus;
    failSafeMode = gFailSafeMode;
    e2eHealthState = gE2eHealthState;
  }
  if (ethIsRecentTick(gObjectSafetyRxTsMs, 300) == 1)
  {
    objectTrackValid = gObjectTrackValid;
    objectEventCode = gObjectEventCode;
  }

  if (alertLevel >= 5)
  {
    eventSeverity = 3;
  }
  else if (alertLevel >= 3 || failSafeMode > 0)
  {
    eventSeverity = 2;
  }
  else if (alertLevel > 0 || objectTrackValid == 1)
  {
    eventSeverity = 1;
  }
  else
  {
    eventSeverity = 0;
  }

  if (failSafeMode == 2 || eventSeverity >= 3)
  {
    recordState = 2;
  }
  else if (eventSeverity > 0)
  {
    recordState = 1;
  }
  else
  {
    recordState = 0;
  }

  if (failSafeMode > 0)
  {
    recordReason = 1;
  }
  else if (objectTrackValid == 1)
  {
    recordReason = 2;
  }
  else if (alertLevel > 0)
  {
    recordReason = 3;
  }
  else
  {
    recordReason = 0;
  }

  storageLevel = clampRange((eventSeverity * 20) + (warningPathStatus * 10) + (e2eHealthState == 0 ? 30 : 0), 0, 100);
  lastEventCode = clampRange(objectEventCode, 0, 255);

  if (recordState != gLastRecordState ||
      eventSeverity != gLastEventSeverity ||
      recordReason != gLastRecordReason ||
      storageLevel != gLastStorageLevel ||
      lastEventCode != gLastEventCode)
  {
    write("[EDR] state=%d severity=%d reason=%d storage=%d lastCode=%d failSafe=%d alert=%d",
          recordState,
          eventSeverity,
          recordReason,
          storageLevel,
          lastEventCode,
          failSafeMode,
          alertLevel);
    gLastRecordState = recordState;
    gLastEventSeverity = eventSeverity;
    gLastRecordReason = recordReason;
    gLastStorageLevel = storageLevel;
    gLastEventCode = lastEventCode;
  }
}

void OnUdpReceiveFrom(dword socket, long result, dword address, dword port, char buffer[], dword count)
{
  int msgId;
  int payload0;
  int payload3;

  if (socket != gEthSocket)
  {
    return;
  }
  if (result == 0)
  {
    msgId = ethFrameMsgId(buffer, count);
    if (msgId == ethMsgSelectedAlert() && ethFramePayloadLen(count) >= 1)
    {
      payload0 = ethGetU8(buffer, 0);
      gAlertLevel = clampRange(payload0 & 0x7, 0, 7);
      gSelectedAlertRxTsMs = getSimulationTimeMs();
    }
    else if (msgId == ethMsgFailSafe() && ethFramePayloadLen(count) >= 1)
    {
      payload0 = ethGetU8(buffer, 0);
      gWarningPathStatus = clampRange(payload0 & 0x3, 0, 2);
      gE2eHealthState = clampRange((payload0 >> 2) & 0x3, 0, 2);
      gFailSafeMode = clampRange((payload0 >> 4) & 0x3, 0, 2);
      gFailSafeRxTsMs = getSimulationTimeMs();
    }
    else if (msgId == ethMsgObjectSafety() && ethFramePayloadLen(count) >= 4)
    {
      payload3 = ethGetU8(buffer, 3);
      gObjectTrackValid = clampRange((payload3 >> 2) & 0x1, 0, 1);
      gObjectEventCode = clampRange(ethGetU16Le(buffer, 1), 0, 65535);
      gObjectSafetyRxTsMs = getSimulationTimeMs();
    }
  }

  ethArmReceive(gEthSocket, gEthRxBuffer, elcount(gEthRxBuffer));
}

on start
{
  gEthSocket = ethOpenDefaultSocket();
  gAlertLevel = 0;
  gFailSafeMode = 0;
  gWarningPathStatus = 0;
  gE2eHealthState = 2;
  gObjectTrackValid = 0;
  gObjectEventCode = 0;
  gSelectedAlertRxTsMs = 0;
  gFailSafeRxTsMs = 0;
  gObjectSafetyRxTsMs = 0;
  gLastRecordState = -1;
  gLastEventSeverity = -1;
  gLastRecordReason = -1;
  gLastStorageLevel = -1;
  gLastEventCode = -1;
  if (gEthSocket != ethInvalidSocket())
  {
    ethStartReceiver(gEthSocket, gEthRxBuffer, elcount(gEthRxBuffer));
  }
  setTimer(tEdrCycle, 100);
  write("[EDR] start");
}

on timer tEdrCycle
{
  publishEdrState();
  setTimer(tEdrCycle, 100);
}

on stopMeasurement
{
  cancelTimer(tEdrCycle);
  ethCloseSocket(gEthSocket);
  gEthSocket = ethInvalidSocket();
}
