includes
{
  #include "..\\common\\CAPL_COMMON.cin"
}

variables
{
  msTimer tEdrCycle;
  int gFailSafeMode;
  int gDomainPathStatus;
  int gE2eHealthState;
  int gObjectTrackValid;
  int gObjectEventCode;
  int gLastRecordState;
  int gLastEventSeverity;
  int gLastRecordReason;
  int gLastStorageLevel;
  int gLastEventCode;
}

void publishEdrState()
{
  message ethEdrStateMsg mEdr;
  int alertLevel;
  int recordState;
  int eventSeverity;
  int recordReason;
  int storageLevel;
  int lastEventCode;

  alertLevel = clampRange((int)@Core::selectedAlertLevel, 0, 7);

  if (alertLevel >= 5)
  {
    eventSeverity = 3;
  }
  else if (alertLevel >= 3 || gFailSafeMode > 0)
  {
    eventSeverity = 2;
  }
  else if (alertLevel > 0 || gObjectTrackValid == 1)
  {
    eventSeverity = 1;
  }
  else
  {
    eventSeverity = 0;
  }

  if (gFailSafeMode == 2 || eventSeverity >= 3)
  {
    recordState = 2;
  }
  else if (eventSeverity > 0)
  {
    recordState = 1;
  }
  else
  {
    recordState = 0;
  }

  if (gFailSafeMode > 0)
  {
    recordReason = 1;
  }
  else if (gObjectTrackValid == 1)
  {
    recordReason = 2;
  }
  else if (alertLevel > 0)
  {
    recordReason = 3;
  }
  else
  {
    recordReason = 0;
  }

  storageLevel = clampRange((eventSeverity * 20) + (gDomainPathStatus * 10) + (gE2eHealthState == 0 ? 30 : 0), 0, 100);
  lastEventCode = clampRange(gObjectEventCode, 0, 255);

  mEdr.RecordState = clampRange(recordState, 0, 3);
  mEdr.EventSeverity = clampRange(eventSeverity, 0, 3);
  mEdr.RecordReason = clampRange(recordReason, 0, 15);
  mEdr.StorageLevel = storageLevel;
  mEdr.LastEventCode = lastEventCode;
  output(mEdr);

  if (recordState != gLastRecordState ||
      eventSeverity != gLastEventSeverity ||
      recordReason != gLastRecordReason ||
      storageLevel != gLastStorageLevel ||
      lastEventCode != gLastEventCode)
  {
    write("[EDR] state=%d severity=%d reason=%d storage=%d lastCode=%d failSafe=%d alert=%d",
          recordState,
          eventSeverity,
          recordReason,
          storageLevel,
          lastEventCode,
          gFailSafeMode,
          alertLevel);
    gLastRecordState = recordState;
    gLastEventSeverity = eventSeverity;
    gLastRecordReason = recordReason;
    gLastStorageLevel = storageLevel;
    gLastEventCode = lastEventCode;
  }
}

on start
{
  gFailSafeMode = 0;
  gDomainPathStatus = 0;
  gE2eHealthState = 2;
  gObjectTrackValid = 0;
  gObjectEventCode = 0;
  gLastRecordState = -1;
  gLastEventSeverity = -1;
  gLastRecordReason = -1;
  gLastStorageLevel = -1;
  gLastEventCode = -1;
  setTimer(tEdrCycle, 100);
  write("[EDR] start");
}

on timer tEdrCycle
{
  publishEdrState();
  setTimer(tEdrCycle, 100);
}

on message ethFailSafeStateMsg
{
  gDomainPathStatus = clampRange((int)this.DomainPathStatus, 0, 2);
  gE2eHealthState = clampRange((int)this.E2eHealthState, 0, 2);
  gFailSafeMode = clampRange((int)this.FailSafeMode, 0, 2);
}

on message ethObjectSafetyStateMsg
{
  gObjectTrackValid = clampRange((int)this.ObjectTrackValid, 0, 1);
  gObjectEventCode = clampRange((int)this.ObjectEventCode, 0, 65535);
}

on stopMeasurement
{
  cancelTimer(tEdrCycle);
}