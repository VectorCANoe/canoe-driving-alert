includes
{
  #include "..\\common\\CAPL_COMMON.cin"
}

variables
{
  msTimer tSunroofCycle;
  int gLastPosition;
  int gLastTiltState;
  int gLastSunshadeState;
}

on start
{
  gLastPosition = -1;
  gLastTiltState = -1;
  gLastSunshadeState = -1;
  setTimer(tSunroofCycle, 100);
  write("[SUNROOF_MODULE] start");
}

on timer tSunroofCycle
{
  message frmSunroofStateMsg mRoof;
  int driveState;
  int timeoutClear;
  int position;
  int tiltState;
  int sunshadeState;

  driveState = clampRange((int)@Core::driveStateNorm, 0, 3);
  timeoutClear = clampRange((int)@Core::timeoutClear, 0, 1);

  position = 0;
  tiltState = 0;
  sunshadeState = 0;

  if (driveState == 0 && timeoutClear == 1)
  {
    position = 35;
    tiltState = 1;
    sunshadeState = 1;
  }
  else if (driveState == 0)
  {
    sunshadeState = 1;
  }

  mRoof.SunroofPosition = clampRange(position, 0, 100);
  mRoof.SunroofTiltState = clampRange(tiltState, 0, 3);
  mRoof.SunshadeState = clampRange(sunshadeState, 0, 3);
  output(mRoof);

  if (mRoof.SunroofPosition != gLastPosition ||
      mRoof.SunroofTiltState != gLastTiltState ||
      mRoof.SunshadeState != gLastSunshadeState)
  {
    write("[SUNROOF_MODULE] pos=%d tilt=%d shade=%d drive=%d",
          mRoof.SunroofPosition,
          mRoof.SunroofTiltState,
          mRoof.SunshadeState,
          driveState);
    gLastPosition = mRoof.SunroofPosition;
    gLastTiltState = mRoof.SunroofTiltState;
    gLastSunshadeState = mRoof.SunshadeState;
  }

  setTimer(tSunroofCycle, 100);
}

on stopMeasurement
{
  cancelTimer(tSunroofCycle);
}
