includes
{
  #include "..\\common\\CAPL_COMMON.cin"
}

variables
{
  msTimer tLvrCycle;
  int gGearInput;
  int gGearState;
  int gIgnitionState;
  int gLastPosition;
  int gLastValid;
  int gLastParkLock;
}

on start
{
  gGearInput = 0;
  gGearState = 0;
  gIgnitionState = 0;
  gLastPosition = -1;
  gLastValid = -1;
  gLastParkLock = -1;
  setTimer(tLvrCycle, 100);
  write("[LVR] start");
}

on message frmGearStateMsg
{
  gGearInput = clampRange((int)this.GearInput, 0, 7);
  gGearState = clampRange((int)this.GearState, 0, 7);
}

on message frmIgnitionEngineMsg
{
  gIgnitionState = clampRange((int)this.IgnitionState, 0, 1);
}

on timer tLvrCycle
{
  message frmLvrStateMsg mLvr;
  int leverValid;
  int parkLockCmd;

  leverValid = (gIgnitionState == 1) ? 1 : 0;
  parkLockCmd = ((gGearState == 0) && (gIgnitionState == 0)) ? 1 : 0;

  mLvr.LeverPosition = gGearInput;
  mLvr.LeverValid = leverValid;
  mLvr.ParkLockCmd = parkLockCmd;
  mLvr.LeverState = gGearState;
  output(mLvr);

  if (mLvr.LeverPosition != gLastPosition ||
      mLvr.LeverValid != gLastValid ||
      mLvr.ParkLockCmd != gLastParkLock)
  {
    write("[LVR] pos=%d state=%d valid=%d park=%d",
          mLvr.LeverPosition,
          mLvr.LeverState,
          mLvr.LeverValid,
          mLvr.ParkLockCmd);
    gLastPosition = mLvr.LeverPosition;
    gLastValid = mLvr.LeverValid;
    gLastParkLock = mLvr.ParkLockCmd;
  }

  setTimer(tLvrCycle, 100);
}

on stopMeasurement
{
  cancelTimer(tLvrCycle);
}
