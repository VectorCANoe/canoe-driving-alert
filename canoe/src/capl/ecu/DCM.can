includes
{
  #include "..\\common\\CAPL_COMMON.cin"
}

variables
{
  msTimer tDcmCycle;
  long gEthSocket;
  char gEthRxBuffer[64];
  int gNavSessionState;
  int gNavRouteClass;
  int gAlertLevel;
  int gWarningPathStatus;
  int gE2eHealthState;
  int gFailSafeMode;
  dword gNavRxMs;
  dword gNotifRxMs;
  dword gFailSafeRxMs;
  int gSecuritySession;
  int gAuthState;
  int gSecurityFault;
  int gSecurityPolicy;
  int gLastTraceSession;
  int gLastTraceAuth;
  int gLastTraceFault;
  int gLastTracePolicy;
  int gLastTraceServiceState;
  int gLastTraceResponseKind;
  int gLastTraceReasonCode;
}

void publishReservedDiagServiceSeam()
{
  int serviceState;
  int responseKind;
  int reasonCode;

  serviceState = 0;
  responseKind = 0;
  reasonCode = 0;

  if (gSecurityFault >= 2)
  {
    serviceState = 2;
    responseKind = 4;
    reasonCode = 2;
  }
  else if (gSecurityFault == 1 || gSecurityPolicy == 1)
  {
    serviceState = 3;
    responseKind = 2;
    reasonCode = 3;
  }
  else if (gSecuritySession >= 2 && gAuthState >= 2)
  {
    serviceState = 1;
    responseKind = 1;
    reasonCode = 0;
  }
  else if (gSecuritySession > 0 || gAuthState > 0)
  {
    serviceState = 3;
    responseKind = 4;
    reasonCode = 4;
  }

  @Diag::ServiceState = serviceState;
  @Diag::ResponseKind = responseKind;
  @Diag::ReasonCode = reasonCode;
  @Diag::LastRequestSid = 0x22;
  @Diag::LastResponseOk = (responseKind == 1) ? 1 : 0;

  if (responseKind == 1)
  {
    @Diag::LastResponseCode = 0x62;
  }
  else if (responseKind == 2)
  {
    @Diag::LastResponseCode = 0x7F;
  }
  else if (responseKind == 3)
  {
    @Diag::LastResponseCode = 0x78;
  }
  else if (responseKind == 4)
  {
    @Diag::LastResponseCode = 0x7F;
  }
  else
  {
    @Diag::LastResponseCode = 0x00;
  }
}

void publishDcmStateTrace()
{
  int serviceState;
  int responseKind;
  int reasonCode;

  serviceState = clampRange((int)@Diag::ServiceState, 0, 3);
  responseKind = clampRange((int)@Diag::ResponseKind, 0, 4);
  reasonCode = clampRange((int)@Diag::ReasonCode, 0, 65535);
  if (gSecuritySession != gLastTraceSession ||
      gAuthState != gLastTraceAuth ||
      gSecurityFault != gLastTraceFault ||
      gSecurityPolicy != gLastTracePolicy ||
      serviceState != gLastTraceServiceState ||
      responseKind != gLastTraceResponseKind ||
      reasonCode != gLastTraceReasonCode)
  {
    write("[DCM] session=%d service=%d resp=%d reason=%d auth=%d fault=%d policy=%d",
          gSecuritySession,
          serviceState,
          responseKind,
          reasonCode,
          gAuthState,
          gSecurityFault,
          gSecurityPolicy);
    gLastTraceSession = gSecuritySession;
    gLastTraceAuth = gAuthState;
    gLastTraceFault = gSecurityFault;
    gLastTracePolicy = gSecurityPolicy;
    gLastTraceServiceState = serviceState;
    gLastTraceResponseKind = responseKind;
    gLastTraceReasonCode = reasonCode;
  }
}

on start
{
  gEthSocket = ethOpenDefaultSocket();
  gNavSessionState = 0;
  gNavRouteClass = 0;
  gAlertLevel = 0;
  gWarningPathStatus = 2;
  gE2eHealthState = 0;
  gFailSafeMode = 2;
  gNavRxMs = 0;
  gNotifRxMs = 0;
  gFailSafeRxMs = 0;
  gSecuritySession = 0;
  gAuthState = 0;
  gSecurityFault = 0;
  gSecurityPolicy = 0;
  gLastTraceSession = -1;
  gLastTraceAuth = -1;
  gLastTraceFault = -1;
  gLastTracePolicy = -1;
  gLastTraceServiceState = -1;
  gLastTraceResponseKind = -1;
  gLastTraceReasonCode = -1;
  @Diag::ServiceState = 0;
  @Diag::ResponseKind = 0;
  @Diag::ReasonCode = 0;
  @Diag::LastRequestSid = 0;
  @Diag::LastResponseCode = 0;
  @Diag::LastResponseOk = 0;
  if (gEthSocket != ethInvalidSocket())
  {
    ethStartReceiver(gEthSocket, gEthRxBuffer, elcount(gEthRxBuffer));
  }
  setTimer(tDcmCycle, 100);
  write("[DCM] start");
}

on timer tDcmCycle
{
  int routeActive;
  int alertLevel;
  int boundaryAlive;
  int warningPathStatus;
  int failSafeMode;

  routeActive = (ethIsRecentTick(gNavRxMs, 300) == 1 &&
                 (gNavSessionState > 0 || gNavRouteClass > 0)) ? 1 : 0;
  alertLevel = (ethIsRecentTick(gNotifRxMs, 300) == 1) ? gAlertLevel : 0;
  boundaryAlive = (ethIsRecentTick(gFailSafeRxMs, 300) == 1) ? 1 : 0;
  warningPathStatus = boundaryAlive == 1 ? gWarningPathStatus : 2;
  failSafeMode = boundaryAlive == 1 ? gFailSafeMode : 2;

  gSecuritySession = 0;
  if (routeActive == 1 || alertLevel > 0)
  {
    gSecuritySession = 1;
  }
  if (boundaryAlive == 1 && routeActive == 1)
  {
    gSecuritySession = 2;
  }

  gAuthState = (gSecuritySession > 0) ? 1 : 0;
  if (failSafeMode == 0 && boundaryAlive == 1)
  {
    gAuthState = 2;
  }

  gSecurityFault = 0;
  if (failSafeMode >= 2 || warningPathStatus >= 2)
  {
    gSecurityFault = 2;
  }
  else if (failSafeMode == 1 || warningPathStatus == 1)
  {
    gSecurityFault = 1;
  }
  gSecurityPolicy = warningPathStatus;
  publishReservedDiagServiceSeam();
  publishDcmStateTrace();
  setTimer(tDcmCycle, 100);
}

on stopMeasurement
{
  cancelTimer(tDcmCycle);
  ethCloseSocket(gEthSocket);
  gEthSocket = ethInvalidSocket();
}

on message frmNavModuleStateMsg
{
  gNavSessionState = clampRange((int)this.NavSessionState, 0, 3);
  gNavRouteClass = clampRange((int)this.NavRouteClass, 0, 3);
  gNavRxMs = getSimulationTimeMs();
}

on message frmClusterNotifMsg
{
  gAlertLevel = clampRange((int)this.ClusterNotifArg, 0, 7);
  gNotifRxMs = getSimulationTimeMs();
}

void OnUdpReceiveFrom(dword socket, long result, dword address, dword port, char buffer[], dword count)
{
  int payload0;

  if (socket != gEthSocket)
  {
    return;
  }
  if (result == 0 &&
      ethFrameMsgId(buffer, count) == ethMsgFailSafe() &&
      ethFramePayloadLen(count) >= 1)
  {
    payload0 = ethGetU8(buffer, 0);
    gWarningPathStatus = clampRange(payload0 & 0x3, 0, 2);
    gE2eHealthState = clampRange((payload0 >> 2) & 0x3, 0, 2);
    gFailSafeMode = clampRange((payload0 >> 4) & 0x3, 0, 2);
    gFailSafeRxMs = getSimulationTimeMs();
  }

  ethArmReceive(gEthSocket, gEthRxBuffer, elcount(gEthRxBuffer));
}
