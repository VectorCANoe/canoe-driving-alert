includes
{
  #include "..\\common\\CAPL_COMMON.cin"
}

variables
{
  msTimer tDcmCycle;
  int gSecuritySession;
  int gAuthState;
  int gSecurityFault;
  int gSecurityPolicy;
}


  if (gAuthState >= 2)
  {
  }

  if (gSecurityPolicy >= 2 || gSecurityFault >= 2)
  {
  }
  else if (gSecurityPolicy == 1 || gSecurityFault == 1)
  {
  }



  {
    write("[DCM] session=%d path=%d pending=%d sid=0x%X sec=%d auth=%d fault=%d policy=%d",
          gSecuritySession,
          gAuthState,
          gSecurityFault,
          gSecurityPolicy);
  }
}

on start
{
  gSecuritySession = 0;
  gAuthState = 0;
  gSecurityFault = 0;
  gSecurityPolicy = 0;
  setTimer(tDcmCycle, 100);
  write("[DCM] start");
}

on timer tDcmCycle
{
  setTimer(tDcmCycle, 100);
}

on message ethSecurityStateMsg
{
  gSecuritySession = clampRange((int)this.SecuritySession, 0, 7);
  gAuthState = clampRange((int)this.AuthState, 0, 3);
  gSecurityFault = clampRange((int)this.SecurityFault, 0, 15);
  gSecurityPolicy = clampRange((int)this.SecurityPolicy, 0, 15);
}

on stopMeasurement
{
  cancelTimer(tDcmCycle);
}
