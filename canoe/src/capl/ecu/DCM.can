includes
{
  #include "..\\common\\CAPL_COMMON.cin"
}

variables
{
  msTimer tDcmCycle;
  int gSecuritySession;
  int gAuthState;
  int gSecurityFault;
  int gSecurityPolicy;
}
void publishDcmStateTrace()
{
  write("[DCM] session=%d path=%d pending=%d sid=0x%X sec=%d auth=%d fault=%d policy=%d",
        gSecuritySession,
        gSecurityPolicy,
        0,
        0x22,
        0,
        gAuthState,
        gSecurityFault,
        gSecurityPolicy);
}

on start
{
  gSecuritySession = 0;
  gAuthState = 0;
  gSecurityFault = 0;
  gSecurityPolicy = 0;
  setTimer(tDcmCycle, 100);
  write("[DCM] start");
}

on timer tDcmCycle
{
  int roadZone;
  int alertLevel;
  int boundaryAlive;
  int warningPathStatus;
  int failSafeMode;

  roadZone = clampRange((int)@Infotainment::roadZone, 0, 3);
  alertLevel = clampRange((int)@Core::selectedAlertLevel, 0, 7);
  boundaryAlive = clampRange((int)@CoreState::domainBoundaryStatus, 0, 1);
  warningPathStatus = clampRange((int)@CoreState::warningPathStatus, 0, 2);
  failSafeMode = clampRange((int)@Core::failSafeMode, 0, 2);

  gSecuritySession = 0;
  if (roadZone > 0 || alertLevel > 0)
  {
    gSecuritySession = 1;
  }
  if (boundaryAlive == 1 && roadZone > 0)
  {
    gSecuritySession = 2;
  }

  gAuthState = (gSecuritySession > 0) ? 1 : 0;
  if (failSafeMode == 0 && boundaryAlive == 1)
  {
    gAuthState = 2;
  }

  gSecurityFault = 0;
  if (failSafeMode > 0)
  {
    gSecurityFault = 2;
  }
  else if (warningPathStatus == 1)
  {
    gSecurityFault = 1;
  }
  gSecurityPolicy = warningPathStatus;
  publishDcmStateTrace();
  setTimer(tDcmCycle, 100);
}

on stopMeasurement
{
  cancelTimer(tDcmCycle);
}
