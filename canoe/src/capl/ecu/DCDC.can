includes
{
  #include "..\\common\\CAPL_COMMON.cin"
}

variables
{
  msTimer tDcdcCycle;
  int gBatterySoc;
  int gChargingState;
  int gLastMode;
  int gLastVolt;
  int gLastCurr;
}

on start
{
  gBatterySoc = 95;
  gChargingState = 0;
  gLastMode = -1;
  gLastVolt = -1;
  gLastCurr = -1;
  setTimer(tDcdcCycle, 100);
  write("[DCDC] start");
}

on message frmFuelBatteryStateMsg
{
  gBatterySoc = clampRange((int)this.BatterySoc, 0, 100);
  gChargingState = clampRange((int)this.ChargingState, 0, 3);
}

on timer tDcdcCycle
{
  message frmDcdcStateMsg mDcdc;
  int driveState;
  int dcdcMode;
  int lvOutputVolt;
  int lvOutputCurr;

  driveState = clampRange((int)@Core::driveStateNorm, 0, 3);

  if (gChargingState == 1)
  {
    dcdcMode = 2;
  }
  else if (driveState > 0)
  {
    dcdcMode = 1;
  }
  else
  {
    dcdcMode = 0;
  }

  lvOutputVolt = (dcdcMode > 0) ? 140 : 124;
  lvOutputCurr = (dcdcMode == 2) ? 35 : ((dcdcMode == 1) ? 18 : 4);
  if (gBatterySoc < 40) lvOutputCurr = clampRange(lvOutputCurr + 10, 0, 255);

  mDcdc.DcdcMode = clampRange(dcdcMode, 0, 7);
  mDcdc.LvOutputVolt = clampRange(lvOutputVolt, 0, 255);
  mDcdc.LvOutputCurr = clampRange(lvOutputCurr, 0, 255);
  output(mDcdc);

  if (mDcdc.DcdcMode != gLastMode ||
      mDcdc.LvOutputVolt != gLastVolt ||
      mDcdc.LvOutputCurr != gLastCurr)
  {
    write("[DCDC] mode=%d volt=%d curr=%d soc=%d",
          mDcdc.DcdcMode,
          mDcdc.LvOutputVolt,
          mDcdc.LvOutputCurr,
          gBatterySoc);
    gLastMode = mDcdc.DcdcMode;
    gLastVolt = mDcdc.LvOutputVolt;
    gLastCurr = mDcdc.LvOutputCurr;
  }

  setTimer(tDcdcCycle, 100);
}

on stopMeasurement
{
  cancelTimer(tDcdcCycle);
}
