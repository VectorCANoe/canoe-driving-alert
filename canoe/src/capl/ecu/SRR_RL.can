includes
{
  #include "..\\common\\CAPL_COMMON.cin"
}

variables
{
  msTimer tSrrRlCycle;
  int gLastDetected;
  int gLastRisk;
  int gLastMerge;
  int gLastTurn;
}

void publishSrrRlState()
{
  message frmSrrRlStateMsg mSrrRl;
  int mergeConflict;
  int riskClass;
  int turnLampState;
  int detected;
  int riskLevel;

  mergeConflict = (((int)@Core::mergeCutInFlag) == 1) ? 1 : 0;
  riskClass = clampRange((int)@Core::objectRiskClass, 0, 7);
  turnLampState = clampRange((int)@CoreState::turnLampState, 0, 3);

  detected = (mergeConflict == 1 && turnLampState == 1 && riskClass >= 2) ? 1 : 0;
  riskLevel = detected == 1 ? clampRange(35 + (riskClass * 10), 0, 100) : 0;

  mSrrRl.SideObjectDetected = detected;
  mSrrRl.SideRiskLevel = riskLevel;
  mSrrRl.MergeConflict = mergeConflict;
  mSrrRl.TurnLampState = turnLampState;
  output(mSrrRl);

  if (detected != gLastDetected ||
      riskLevel != gLastRisk ||
      mergeConflict != gLastMerge ||
      turnLampState != gLastTurn)
  {
    write("[SRR_RL] detected=%d risk=%d merge=%d turn=%d class=%d",
          detected,
          riskLevel,
          mergeConflict,
          turnLampState,
          riskClass);
    gLastDetected = detected;
    gLastRisk = riskLevel;
    gLastMerge = mergeConflict;
    gLastTurn = turnLampState;
  }
}

on start
{
  gLastDetected = -1;
  gLastRisk = -1;
  gLastMerge = -1;
  gLastTurn = -1;
  setTimer(tSrrRlCycle, 100);
  write("[SRR_RL] start");
}

on timer tSrrRlCycle
{
  publishSrrRlState();
  setTimer(tSrrRlCycle, 100);
}

on stopMeasurement
{
  cancelTimer(tSrrRlCycle);
}
