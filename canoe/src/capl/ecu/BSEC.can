includes
{
  #include "..\\common\\CAPL_COMMON.cin"
}

variables
{
  msTimer tSecurityCycle;
  int gAlarmArmState;
  int gIntrusionDetect;
  int gLastAlarmArmState;
  int gLastIntrusionDetect;
}

void publishSecurityState()
{
  message frmAlarmStateMsg mAlarm;

  mAlarm.AlarmArmState = clampRange(gAlarmArmState, 0, 3);
  mAlarm.IntrusionDetect = clampRange(gIntrusionDetect, 0, 1);
  output(mAlarm);

  if (mAlarm.AlarmArmState != gLastAlarmArmState ||
      mAlarm.IntrusionDetect != gLastIntrusionDetect)
  {
    write("[BODY_SECURITY_MODULE] arm=%d intrusion=%d",
          mAlarm.AlarmArmState,
          mAlarm.IntrusionDetect);
    gLastAlarmArmState = mAlarm.AlarmArmState;
    gLastIntrusionDetect = mAlarm.IntrusionDetect;
  }
}

on start
{
  gAlarmArmState = 1;
  gIntrusionDetect = 0;
  gLastAlarmArmState = -1;
  gLastIntrusionDetect = -1;
  setTimer(tSecurityCycle, 100);
  write("[BODY_SECURITY_MODULE] start");
}

on timer tSecurityCycle
{
  gIntrusionDetect = ((int)@Core::selectedAlertLevel >= 7) ? 1 : 0;
  publishSecurityState();
  setTimer(tSecurityCycle, 100);
}

on stopMeasurement
{
  cancelTimer(tSecurityCycle);
}
