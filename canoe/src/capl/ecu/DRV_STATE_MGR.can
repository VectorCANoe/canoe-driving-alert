includes
{
}

variables
{
}

on start
{
  write("[DRV_STATE_MGR] start (driver-state chain disabled)");
}
