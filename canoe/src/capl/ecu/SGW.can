includes
{
  #include "..\\common\\CAPL_COMMON.cin"
}

variables
{
  msTimer tSgwCycle;
  int gIboxLinkMode;
  int gIboxRouteState;
  int gIboxServiceFlags;
  int gFailSafeMode;
  int gBoundaryAlive;
  int gWarningPathStatus;
  int gLastSecuritySession;
  int gLastAuthState;
  int gLastSecurityFault;
  int gLastSecurityPolicy;
}

void publishSecurityState()
{
  int securitySession;
  int authState;
  int keyPresence;
  int securityFault;
  int securityPolicy;
  int roadZone;
  int navDirection;
  int zoneDistance;
  int speedLimit;
  int vehicleSpeed;
  int alertLevel;

  roadZone = clampRange((int)@Infotainment::roadZone, 0, 3);
  navDirection = clampRange((int)@Infotainment::navDirection, 0, 3);
  zoneDistance = clampRange((int)@Infotainment::zoneDistance, 0, 255);
  speedLimit = clampRange((int)@Infotainment::speedLimit, 0, 255);
  vehicleSpeed = clampRange((int)@Chassis::vehicleSpeed, 0, 255);
  alertLevel = clampRange((int)@Core::selectedAlertLevel, 0, 7);
  gWarningPathStatus = clampRange((int)@CoreState::warningPathStatus, 0, 2);
  gFailSafeMode = clampRange((int)@Core::failSafeMode, 0, 2);
  gBoundaryAlive = clampRange((int)@CoreState::domainBoundaryStatus, 0, 1);

  gIboxLinkMode = 0;
  if (roadZone > 0 || alertLevel > 0)
  {
    gIboxLinkMode = 1;
  }
  if (gBoundaryAlive == 1 && roadZone > 0)
  {
    gIboxLinkMode = 2;
  }

  gIboxRouteState = 0;
  if (roadZone > 0)
  {
    gIboxRouteState = 1;
  }
  if (navDirection > 0 && zoneDistance > 0)
  {
    gIboxRouteState = 2;
  }

  gIboxServiceFlags = 0;
  if (roadZone > 0)
  {
    gIboxServiceFlags = gIboxServiceFlags | 1;
  }
  if (alertLevel > 0)
  {
    gIboxServiceFlags = gIboxServiceFlags | 2;
  }
  if (gFailSafeMode > 0)
  {
    gIboxServiceFlags = gIboxServiceFlags | 4;
  }
  if (speedLimit > 0 && vehicleSpeed > speedLimit)
  {
    gIboxServiceFlags = gIboxServiceFlags | 8;
  }

  securitySession = 0;
  if (gIboxLinkMode > 0)
  {
    securitySession = 1;
  }
  if (gBoundaryAlive == 1 && gIboxLinkMode >= 2)
  {
    securitySession = 2;
  }

  authState = 0;
  if (securitySession > 0)
  {
    authState = 1;
  }
  if (gFailSafeMode == 0 && gBoundaryAlive == 1)
  {
    authState = 2;
  }

  keyPresence = ((gIboxServiceFlags & 1) != 0) ? 1 : 0;

  securityFault = 0;
  if (gFailSafeMode > 0)
  {
    securityFault = 2;
  }
  else if (gWarningPathStatus == 1)
  {
    securityFault = 1;
  }

  securityPolicy = gWarningPathStatus;
  if (securityPolicy < 0 || securityPolicy > 3)
  {
    securityPolicy = 0;
  }

  if (securitySession != gLastSecuritySession ||
      authState != gLastAuthState ||
      securityFault != gLastSecurityFault ||
      securityPolicy != gLastSecurityPolicy)
  {
    write("[SGW] session=%d auth=%d key=%d fault=%d policy=%d route=%d service=0x%X",
          securitySession,
          authState,
          keyPresence,
          securityFault,
          securityPolicy,
          gIboxRouteState,
          gIboxServiceFlags);
    gLastSecuritySession = securitySession;
    gLastAuthState = authState;
    gLastSecurityFault = securityFault;
    gLastSecurityPolicy = securityPolicy;
  }
}

on start
{
  gIboxLinkMode = 0;
  gIboxRouteState = 0;
  gIboxServiceFlags = 0;
  gFailSafeMode = 1;
  gBoundaryAlive = 0;
  gWarningPathStatus = 2;
  gLastSecuritySession = -1;
  gLastAuthState = -1;
  gLastSecurityFault = -1;
  gLastSecurityPolicy = -1;
  setTimer(tSgwCycle, 100);
  write("[SGW] start");
}

on timer tSgwCycle
{
  publishSecurityState();
  setTimer(tSgwCycle, 100);
}

on stopMeasurement
{
  cancelTimer(tSgwCycle);
}
