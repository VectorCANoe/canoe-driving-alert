includes
{
  #include "..\\common\\CAPL_COMMON.cin"
}

variables
{
  msTimer tSgwCycle;
  long gEthSocket;
  char gEthRxBuffer[64];
  int gIboxLinkMode;
  int gIboxRouteState;
  int gIboxServiceFlags;
  int gNavSessionState;
  int gNavRouteClass;
  int gNavSpeedLimit;
  int gVehicleSpeed;
  int gAlertLevel;
  int gFailSafeMode;
  int gBoundaryAlive;
  int gWarningPathStatus;
  dword gNavRxMs;
  dword gVehicleRxMs;
  dword gNotifRxMs;
  dword gFailSafeRxMs;
  int gLastSecuritySession;
  int gLastAuthState;
  int gLastSecurityFault;
  int gLastSecurityPolicy;
}

void publishReservedDiagSecuritySeam(int diagStage, int securitySession, int authState)
{
  int securityState;
  int routeOwner;

  securityState = 0;
  if (diagStage >= 2)
  {
    securityState = 3;
  }
  else if (diagStage == 1)
  {
    securityState = 2;
  }
  else if (securitySession > 0 || authState > 0)
  {
    securityState = 1;
  }

  routeOwner = 0;
  if (diagStage == 1)
  {
    routeOwner = 3;
  }
  else if (diagStage >= 2)
  {
    routeOwner = 1;
  }
  else if (securitySession > 0 || authState > 0)
  {
    routeOwner = 2;
  }
  else if (gIboxLinkMode > 0 || gIboxRouteState > 0 || gIboxServiceFlags > 0)
  {
    routeOwner = 1;
  }

  @Diag::SecurityState = securityState;
  @Diag::RouteOwner = routeOwner;
}

void publishSecurityState()
{
  int diagStage;
  int securitySession;
  int authState;
  int keyPresence;
  int securityFault;
  int securityPolicy;
  int routeActive;
  int guidedRouteActive;
  int serviceContext;
  int speedLimit;
  int vehicleSpeed;
  int alertLevel;

  routeActive = (ethIsRecentTick(gNavRxMs, 300) == 1 &&
                 (gNavSessionState > 0 || gNavRouteClass > 0)) ? 1 : 0;
  guidedRouteActive = (ethIsRecentTick(gNavRxMs, 300) == 1 && gNavRouteClass == 3) ? 1 : 0;
  speedLimit = (ethIsRecentTick(gNavRxMs, 300) == 1) ? gNavSpeedLimit : 0;
  vehicleSpeed = (ethIsRecentTick(gVehicleRxMs, 300) == 1) ? gVehicleSpeed : 0;
  alertLevel = (ethIsRecentTick(gNotifRxMs, 300) == 1) ? gAlertLevel : 0;
  gBoundaryAlive = (ethIsRecentTick(gFailSafeRxMs, 300) == 1) ? 1 : 0;
  if (gBoundaryAlive == 0)
  {
    gWarningPathStatus = 2;
    gFailSafeMode = 2;
  }
  serviceContext = ethHasBoundaryServiceContext(routeActive, alertLevel);
  diagStage = ethDiagBoundaryStage(routeActive,
                                   alertLevel,
                                   gBoundaryAlive,
                                   gWarningPathStatus,
                                   gFailSafeMode);

  gIboxLinkMode = 0;
  if (serviceContext == 1)
  {
    gIboxLinkMode = 1;
  }
  if (diagStage == 1 && routeActive == 1)
  {
    gIboxLinkMode = 2;
  }

  gIboxRouteState = 0;
  if (routeActive == 1)
  {
    gIboxRouteState = 1;
  }
  if (guidedRouteActive == 1)
  {
    gIboxRouteState = 2;
  }

  gIboxServiceFlags = 0;
  if (routeActive == 1)
  {
    gIboxServiceFlags = gIboxServiceFlags | 1;
  }
  if (alertLevel > 0)
  {
    gIboxServiceFlags = gIboxServiceFlags | 2;
  }
  if (diagStage >= 2)
  {
    gIboxServiceFlags = gIboxServiceFlags | 4;
  }
  if (diagStage == 1 &&
      routeActive == 1 &&
      speedLimit > 0 &&
      vehicleSpeed > speedLimit)
  {
    gIboxServiceFlags = gIboxServiceFlags | 8;
  }

  securitySession = 0;
  if (serviceContext == 1)
  {
    securitySession = 1;
  }
  if (diagStage == 1 && routeActive == 1)
  {
    securitySession = 2;
  }

  authState = 0;
  if (serviceContext == 1)
  {
    authState = 1;
  }
  if (diagStage == 1)
  {
    authState = 2;
  }

  keyPresence = ((gIboxServiceFlags & 1) != 0) ? 1 : 0;

  securityFault = ethDiagStageToSecurityFault(diagStage);
  securityPolicy = ethDiagStageToPolicy(diagStage);

  publishReservedDiagSecuritySeam(diagStage, securitySession, authState);

  if (securitySession != gLastSecuritySession ||
      authState != gLastAuthState ||
      securityFault != gLastSecurityFault ||
      securityPolicy != gLastSecurityPolicy)
  {
    write("[SGW] session=%d auth=%d key=%d fault=%d policy=%d route=%d service=0x%X",
          securitySession,
          authState,
          keyPresence,
          securityFault,
          securityPolicy,
          gIboxRouteState,
          gIboxServiceFlags);
    gLastSecuritySession = securitySession;
    gLastAuthState = authState;
    gLastSecurityFault = securityFault;
    gLastSecurityPolicy = securityPolicy;
  }
}

on start
{
  gEthSocket = ethOpenDefaultSocket();
  gIboxLinkMode = 0;
  gIboxRouteState = 0;
  gIboxServiceFlags = 0;
  gNavSessionState = 0;
  gNavRouteClass = 0;
  gNavSpeedLimit = 0;
  gVehicleSpeed = 0;
  gAlertLevel = 0;
  gFailSafeMode = 1;
  gBoundaryAlive = 0;
  gWarningPathStatus = 2;
  gNavRxMs = 0;
  gVehicleRxMs = 0;
  gNotifRxMs = 0;
  gFailSafeRxMs = 0;
  gLastSecuritySession = -1;
  gLastAuthState = -1;
  gLastSecurityFault = -1;
  gLastSecurityPolicy = -1;
  @Diag::SecurityState = 0;
  @Diag::RouteOwner = 0;
  if (gEthSocket != ethInvalidSocket())
  {
    ethStartReceiver(gEthSocket, gEthRxBuffer, elcount(gEthRxBuffer));
  }
  setTimer(tSgwCycle, 100);
  write("[SGW] start");
}

on timer tSgwCycle
{
  publishSecurityState();
  setTimer(tSgwCycle, 100);
}

on stopMeasurement
{
  cancelTimer(tSgwCycle);
  ethCloseSocket(gEthSocket);
  gEthSocket = ethInvalidSocket();
}

on message frmNavModuleStateMsg
{
  gNavSessionState = clampRange((int)this.NavSessionState, 0, 3);
  gNavRouteClass = clampRange((int)this.NavRouteClass, 0, 3);
  gNavSpeedLimit = clampRange((int)this.NavSpeedLimit, 0, 255);
  gNavRxMs = getSimulationTimeMs();
}

on message frmVehicleStateCanMsg
{
  gVehicleSpeed = clampRange((int)this.gVehicleSpeed, 0, 255);
  gVehicleRxMs = getSimulationTimeMs();
}

on message frmClusterNotifMsg
{
  gAlertLevel = clampRange((int)this.ClusterNotifArg, 0, 7);
  gNotifRxMs = getSimulationTimeMs();
}

void OnUdpReceiveFrom(dword socket, long result, dword address, dword port, char buffer[], dword count)
{
  int payload0;

  if (socket != gEthSocket)
  {
    return;
  }
  if (result == 0 &&
      ethFrameMsgId(buffer, count) == ethMsgFailSafe() &&
      ethFramePayloadLen(count) >= 1)
  {
    payload0 = ethGetU8(buffer, 0);
    gWarningPathStatus = clampRange(payload0 & 0x3, 0, 2);
    gFailSafeMode = clampRange((payload0 >> 4) & 0x3, 0, 2);
    gFailSafeRxMs = getSimulationTimeMs();
  }

  ethArmReceive(gEthSocket, gEthRxBuffer, elcount(gEthRxBuffer));
}
