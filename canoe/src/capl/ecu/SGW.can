includes
{
  #include "..\\common\\CAPL_COMMON.cin"
}

variables
{
  msTimer tSgwCycle;
  int gIboxLinkMode;
  int gIboxRouteState;
  int gIboxServiceFlags;
  int gIboxDiagState;
  int gFailSafeMode;
  int gBoundaryAlive;
  int gDomainPathStatus;
  int gLastSecuritySession;
  int gLastAuthState;
  int gLastSecurityFault;
  int gLastSecurityPolicy;
}

void publishSecurityState()
{
  message ethSecurityStateMsg mSec;
  int securitySession;
  int authState;
  int keyPresence;
  int securityFault;
  int securityPolicy;

  securitySession = 0;
  if (gIboxLinkMode > 0)
  {
    securitySession = 1;
  }
  if (gBoundaryAlive == 1 && gIboxLinkMode >= 2)
  {
    securitySession = 2;
  }

  authState = 0;
  if (securitySession > 0)
  {
    authState = 1;
  }
  if (gFailSafeMode == 0 && gIboxDiagState == 0 && gBoundaryAlive == 1)
  {
    authState = 2;
  }

  keyPresence = ((gIboxServiceFlags & 1) != 0) ? 1 : 0;

  securityFault = 0;
  if (gFailSafeMode > 0 || gIboxDiagState >= 2)
  {
    securityFault = 2;
  }
  else if (gIboxDiagState == 1 || gDomainPathStatus == 1)
  {
    securityFault = 1;
  }

  securityPolicy = gDomainPathStatus;
  if (securityPolicy < 0 || securityPolicy > 3)
  {
    securityPolicy = 0;
  }

  mSec.SecuritySession = clampRange(securitySession, 0, 7);
  mSec.AuthState = clampRange(authState, 0, 3);
  mSec.KeyPresence = clampRange(keyPresence, 0, 1);
  mSec.SecurityFault = clampRange(securityFault, 0, 15);
  mSec.SecurityPolicy = clampRange(securityPolicy, 0, 15);
  output(mSec);

  if (mSec.SecuritySession != gLastSecuritySession ||
      mSec.AuthState != gLastAuthState ||
      mSec.SecurityFault != gLastSecurityFault ||
      mSec.SecurityPolicy != gLastSecurityPolicy)
  {
    write("[SGW] session=%d auth=%d fault=%d policy=%d link=%d diag=%d failSafe=%d",
          mSec.SecuritySession,
          mSec.AuthState,
          mSec.SecurityFault,
          mSec.SecurityPolicy,
          gIboxLinkMode,
          gIboxDiagState,
          gFailSafeMode);
    gLastSecuritySession = mSec.SecuritySession;
    gLastAuthState = mSec.AuthState;
    gLastSecurityFault = mSec.SecurityFault;
    gLastSecurityPolicy = mSec.SecurityPolicy;
  }
}

on start
{
  gIboxLinkMode = 0;
  gIboxRouteState = 0;
  gIboxServiceFlags = 0;
  gIboxDiagState = 0;
  gFailSafeMode = 1;
  gBoundaryAlive = 0;
  gDomainPathStatus = 2;
  gLastSecuritySession = -1;
  gLastAuthState = -1;
  gLastSecurityFault = -1;
  gLastSecurityPolicy = -1;
  setTimer(tSgwCycle, 100);
  write("[SGW] start");
}

on timer tSgwCycle
{
  publishSecurityState();
  setTimer(tSgwCycle, 100);
}

on message ethIboxStateMsg
{
  gIboxLinkMode = clampRange((int)this.IboxLinkMode, 0, 3);
  gIboxRouteState = clampRange((int)this.IboxRouteState, 0, 3);
  gIboxServiceFlags = clampRange((int)this.IboxServiceFlags, 0, 15);
  gIboxDiagState = clampRange((int)this.IboxDiagState, 0, 15);
}

on message ethFailSafeStateMsg
{
  gDomainPathStatus = clampRange((int)this.DomainPathStatus, 0, 3);
  gFailSafeMode = clampRange((int)this.FailSafeMode, 0, 3);
  gBoundaryAlive = clampRange((int)this.BoundaryAlive, 0, 1);
}

on stopMeasurement
{
  cancelTimer(tSgwCycle);
}
