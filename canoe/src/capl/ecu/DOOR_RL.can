includes
{
  #include "..\\common\\CAPL_COMMON.cin"
}

variables
{
  msTimer tDoorRlCycle;
  int gLastLockState;
  int gLastOpenState;
  int gLastWindowPos;
}

on start
{
  gLastLockState = -1;
  gLastOpenState = -1;
  gLastWindowPos = -1;
  setTimer(tDoorRlCycle, 100);
  write("[DOOR_RL] start");
}

on timer tDoorRlCycle
{
  message frmDoorRlStateMsg mDoor;
  int lockState;
  int openState;
  int windowPos;

  lockState = 1;
  openState = 0;
  windowPos = 0;

  mDoor.DoorRlLockState = clampRange(lockState, 0, 3);
  mDoor.DoorRlOpenState = clampRange(openState, 0, 1);
  mDoor.DoorRlWindowPos = clampRange(windowPos, 0, 100);
  output(mDoor);

  if (mDoor.DoorRlLockState != gLastLockState ||
      mDoor.DoorRlOpenState != gLastOpenState ||
      mDoor.DoorRlWindowPos != gLastWindowPos)
  {
    write("[DOOR_RL] lock=%d open=%d win=%d",
          mDoor.DoorRlLockState,
          mDoor.DoorRlOpenState,
          mDoor.DoorRlWindowPos);
    gLastLockState = mDoor.DoorRlLockState;
    gLastOpenState = mDoor.DoorRlOpenState;
    gLastWindowPos = mDoor.DoorRlWindowPos;
  }

  setTimer(tDoorRlCycle, 100);
}

on stopMeasurement
{
  cancelTimer(tDoorRlCycle);
}
