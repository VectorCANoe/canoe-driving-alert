includes
{
  #include "..\\common\\CAPL_COMMON.cin"
}

variables
{
  msTimer tMassageSeatCycle;
  int gSeatPos;
  int gSeatHeatLvl;
  int gSeatVentLvl;
  int gLastMode;
  int gLastIntensity;
  int gLastOccupancy;
  int gLastAlertMode;
  int gLastDriveComfortMode;
}

void publishMassageSeatState()
{
  message frmMassageSeatCtrlStateMsg mMassage;
  int vehicleSpeed;
  int alertLevel;
  int driverSeatBelt;
  int occupancyState;
  int alertComfortMode;
  int driveComfortMode;
  int massageMode;
  int massageIntensity;

  vehicleSpeed = clampRange((int)@Core::vehicleSpeedNorm, 0, 255);
  alertLevel = clampRange((int)@Core::selectedAlertLevel, 0, 7);
  driverSeatBelt = clampRange((int)@CoreState::driverSeatBelt, 0, 1);

  occupancyState = (gSeatPos > 5 || driverSeatBelt == 1) ? 1 : 0;
  alertComfortMode = (alertLevel >= 4) ? 1 : 0;
  driveComfortMode = (vehicleSpeed >= 40) ? 2 : ((vehicleSpeed > 0) ? 1 : 0);

  massageMode = 0;
  if (occupancyState == 1)
  {
    if (alertComfortMode == 1)
    {
      massageMode = 3;
    }
    else if (gSeatHeatLvl >= 2 || gSeatVentLvl >= 2)
    {
      massageMode = 2;
    }
    else if (driveComfortMode > 0)
    {
      massageMode = 1;
    }
  }

  massageIntensity = clampRange((gSeatHeatLvl * 12) + (gSeatVentLvl * 8) + (alertLevel * 6), 0, 100);
  if (massageMode == 0)
  {
    massageIntensity = 0;
  }

  mMassage.MassageMode = clampRange(massageMode, 0, 7);
  mMassage.MassageIntensity = massageIntensity;
  mMassage.OccupancyState = occupancyState;
  mMassage.AlertComfortMode = alertComfortMode;
  mMassage.DriveComfortMode = clampRange(driveComfortMode, 0, 3);
  output(mMassage);

  if (massageMode != gLastMode ||
      massageIntensity != gLastIntensity ||
      occupancyState != gLastOccupancy ||
      alertComfortMode != gLastAlertMode ||
      driveComfortMode != gLastDriveComfortMode)
  {
    write("[MSC] mode=%d intensity=%d occ=%d alert=%d driveComfort=%d heat=%d vent=%d",
          massageMode,
          massageIntensity,
          occupancyState,
          alertComfortMode,
          driveComfortMode,
          gSeatHeatLvl,
          gSeatVentLvl);
    gLastMode = massageMode;
    gLastIntensity = massageIntensity;
    gLastOccupancy = occupancyState;
    gLastAlertMode = alertComfortMode;
    gLastDriveComfortMode = driveComfortMode;
  }
}

on start
{
  gSeatPos = 0;
  gSeatHeatLvl = 0;
  gSeatVentLvl = 0;
  gLastMode = -1;
  gLastIntensity = -1;
  gLastOccupancy = -1;
  gLastAlertMode = -1;
  gLastDriveComfortMode = -1;
  setTimer(tMassageSeatCycle, 100);
  write("[MSC] start");
}

on timer tMassageSeatCycle
{
  publishMassageSeatState();
  setTimer(tMassageSeatCycle, 100);
}

on message frmSeatDrvStateMsg
{
  gSeatPos = clampRange((int)this.SeatDrvPos, 0, 255);
  gSeatHeatLvl = clampRange((int)this.SeatDrvHeatLvl, 0, 15);
  gSeatVentLvl = clampRange((int)this.SeatDrvVentLvl, 0, 15);
}

on stopMeasurement
{
  cancelTimer(tMassageSeatCycle);
}
