includes
{
  #include "..\\common\\CAPL_COMMON.cin"
}

variables
{
  msTimer tRseCycle;
  int gMediaSource;
  int gMediaState;
  int gMuteState;
  int gVolumeLevel;
  int gAudioFocusOwner;
  int gAudioDuckingLvl;
  int gTrackType;
  int gProjectionType;
  int gProjectionState;
  int gLastPlaybackState;
  int gLastSource;
  int gLastLinkState;
  int gLastContentType;
}

void publishRseState()
{
  message frmRseStateMsg mRse;
  int playbackState;
  int linkState;
  int volumeProfile;
  int zoneMode;

  playbackState = clampRange(gMediaState, 0, 7);
  if (gMuteState == 1 || gAudioFocusOwner > 0)
  {
    playbackState = 2;
  }

  linkState = 0;
  if (gProjectionState > 0)
  {
    linkState = 1;
    if (gProjectionType > 0)
    {
      linkState = 2;
    }
  }

  volumeProfile = gVolumeLevel - (gAudioDuckingLvl * 5);
  volumeProfile = clampRange(volumeProfile, 0, 100);

  zoneMode = (gProjectionState > 0) ? 1 : 0;

  mRse.RsePlaybackState = clampRange(playbackState, 0, 7);
  mRse.RseSource = clampRange(gMediaSource, 0, 7);
  mRse.RseLinkState = clampRange(linkState, 0, 3);
  mRse.RseVolumeProfile = volumeProfile;
  mRse.RseContentType = clampRange(gTrackType, 0, 15);
  mRse.RseZoneMode = clampRange(zoneMode, 0, 3);
  output(mRse);

  if (mRse.RsePlaybackState != gLastPlaybackState ||
      mRse.RseSource != gLastSource ||
      mRse.RseLinkState != gLastLinkState ||
      mRse.RseContentType != gLastContentType)
  {
    write("[RSE] playback=%d source=%d link=%d vol=%d content=%d zone=%d",
          mRse.RsePlaybackState,
          mRse.RseSource,
          mRse.RseLinkState,
          mRse.RseVolumeProfile,
          mRse.RseContentType,
          mRse.RseZoneMode);
    gLastPlaybackState = mRse.RsePlaybackState;
    gLastSource = mRse.RseSource;
    gLastLinkState = mRse.RseLinkState;
    gLastContentType = mRse.RseContentType;
  }
}

on start
{
  gMediaSource = 0;
  gMediaState = 0;
  gMuteState = 0;
  gVolumeLevel = 20;
  gAudioFocusOwner = 0;
  gAudioDuckingLvl = 0;
  gTrackType = 0;
  gProjectionType = 0;
  gProjectionState = 0;
  gLastPlaybackState = -1;
  gLastSource = -1;
  gLastLinkState = -1;
  gLastContentType = -1;
  setTimer(tRseCycle, 100);
  write("[RSE] start");
}

on timer tRseCycle
{
  publishRseState();
  setTimer(tRseCycle, 100);
}

on message frmMediaStateMsg
{
  gMediaSource = clampRange((int)this.MediaSource, 0, 7);
  gMediaState = clampRange((int)this.MediaState, 0, 7);
  gMuteState = clampRange((int)this.MuteState, 0, 1);
  gVolumeLevel = clampRange((int)this.VolumeLevel, 0, 100);
}

on message frmAudioFocusMsg
{
  gAudioFocusOwner = clampRange((int)this.AudioFocusOwner, 0, 7);
  gAudioDuckingLvl = clampRange((int)this.AudioDuckingLvl, 0, 7);
}

on message frmMediaMetaMsg
{
  gTrackType = clampRange((int)this.MediaTrackType, 0, 15);
}

on message frmPhoneProjectionMsg
{
  gProjectionType = clampRange((int)this.ProjectionType, 0, 3);
  gProjectionState = clampRange((int)this.ProjectionState, 0, 3);
}

on stopMeasurement
{
  cancelTimer(tRseCycle);
}
