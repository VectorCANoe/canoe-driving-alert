includes
{
  #include "..\\common\\CAPL_COMMON.cin"
}

variables
{
  msTimer tSrrFlCycle;
  long gEthSocket;
  char gEthRxBuffer[64];
  int gMergeConflict;
  int gRiskClass;
  int gTurnLampState;
  dword gScenarioAlertRxMs;
  dword gRiskStateRxMs;
  dword gLampRxMs;
  int gLastObjectInputStale;
  int gLastLampInputStale;
  int gLastDetected;
  int gLastRisk;
  int gLastMerge;
  int gLastTurn;
  int gLastPathReady;
}

int srrFlPathReady()
{
  int warningPathStatus;
  int e2eHealthState;
  int failSafeMode;

  warningPathStatus = clampRange((int)@CoreState::warningPathStatus, 0, 2);
  e2eHealthState = clampRange((int)@CoreState::e2eHealthState, 0, 2);
  failSafeMode = clampRange((int)@Core::failSafeMode, 0, 2);
  if (warningPathStatus >= 2 || e2eHealthState == 0 || failSafeMode >= 2)
  {
    return 0;
  }
  return 1;
}

void traceSrrFlInputHealth(int objectInputStale, int lampInputStale)
{
  if (objectInputStale != gLastObjectInputStale)
  {
    if (objectInputStale == 1)
    {
      write("[SRR_FL] object input stale");
    }
    else
    {
      write("[SRR_FL] object input restored");
    }
    gLastObjectInputStale = objectInputStale;
  }

  if (lampInputStale != gLastLampInputStale)
  {
    if (lampInputStale == 1)
    {
      write("[SRR_FL] lamp input stale");
    }
    else
    {
      write("[SRR_FL] lamp input restored");
    }
    gLastLampInputStale = lampInputStale;
  }
}

void publishSrrFlState()
{
  message frmSrrFlStateMsg mSrrFl;
  int objectInputStale;
  int lampInputStale;
  int mergeConflict;
  int riskClass;
  int turnLampState;
  int detected;
  int riskLevel;
  int pathReady;

  objectInputStale =
    ((ethIsRecentTick(gScenarioAlertRxMs, 300) == 1) &&
     (ethIsRecentTick(gRiskStateRxMs, 300) == 1)) ? 0 : 1;
  lampInputStale = (ethIsRecentTick(gLampRxMs, 300) == 1) ? 0 : 1;
  traceSrrFlInputHealth(objectInputStale, lampInputStale);

  mergeConflict = gMergeConflict;
  riskClass = gRiskClass;
  turnLampState = gTurnLampState;
  if (objectInputStale == 1)
  {
    mergeConflict = 0;
    riskClass = 0;
  }
  if (lampInputStale == 1)
  {
    turnLampState = 0;
  }

  pathReady = srrFlPathReady();
  detected = (mergeConflict == 1 && turnLampState == 1 && riskClass >= 2) ? 1 : 0;
  riskLevel = (detected == 1) ? clampRange(40 + (riskClass * 10), 0, 100) : 0;
  if (pathReady == 0)
  {
    mergeConflict = 0;
    riskClass = 0;
    detected = 0;
    riskLevel = 0;
  }

  mSrrFl.SideObjectDetected = detected;
  mSrrFl.SideRiskLevel = riskLevel;
  mSrrFl.MergeConflict = mergeConflict;
  mSrrFl.TurnLampState = turnLampState;
  output(mSrrFl);

  if (pathReady != gLastPathReady ||
      detected != gLastDetected ||
      riskLevel != gLastRisk ||
      mergeConflict != gLastMerge ||
      turnLampState != gLastTurn)
  {
    write("[SRR_FL] path=%d detected=%d risk=%d merge=%d turn=%d class=%d",
          pathReady,
          detected,
          riskLevel,
          mergeConflict,
          turnLampState,
          riskClass);
    gLastPathReady = pathReady;
    gLastDetected = detected;
    gLastRisk = riskLevel;
    gLastMerge = mergeConflict;
    gLastTurn = turnLampState;
  }
}

void OnUdpReceiveFrom(dword socket, long result, dword address, dword port, char buffer[], dword count)
{
  int msgId;
  int payload1;

  if (socket != gEthSocket)
  {
    return;
  }
  if (result == 0)
  {
    msgId = ethFrameMsgId(buffer, count);
    if (msgId == ethMsgObjectScenarioAlert() && ethFramePayloadLen(count) >= 3)
    {
      payload1 = ethGetU8(buffer, 1);
      gMergeConflict = clampRange((payload1 >> 1) & 0x1, 0, 1);
      gRiskClass = clampRange(ethGetU8(buffer, 2) & 0x7, 0, 7);
      gScenarioAlertRxMs = getSimulationTimeMs();
    }
    else if (msgId == ethMsgObjectRiskState() && ethFramePayloadLen(count) >= 1)
    {
      gRiskClass = clampRange(ethGetU8(buffer, 0) & 0x7, 0, 7);
      gRiskStateRxMs = getSimulationTimeMs();
    }
  }

  ethArmReceive(gEthSocket, gEthRxBuffer, elcount(gEthRxBuffer));
}

on start
{
  gEthSocket = ethOpenDefaultSocket();
  gMergeConflict = 0;
  gRiskClass = 0;
  gTurnLampState = 0;
  gScenarioAlertRxMs = 0;
  gRiskStateRxMs = 0;
  gLampRxMs = 0;
  gLastObjectInputStale = 0;
  gLastLampInputStale = 0;
  gLastPathReady = -1;
  gLastDetected = -1;
  gLastRisk = -1;
  gLastMerge = -1;
  gLastTurn = -1;
  if (gEthSocket != ethInvalidSocket())
  {
    ethStartReceiver(gEthSocket, gEthRxBuffer, elcount(gEthRxBuffer));
  }
  setTimer(tSrrFlCycle, 100);
  write("[SRR_FL] start");
}

on timer tSrrFlCycle
{
  publishSrrFlState();
  setTimer(tSrrFlCycle, 100);
}

on message frmLampControlMsg
{
  gTurnLampState = clampRange((int)this.TurnLampState, 0, 3);
  gLampRxMs = getSimulationTimeMs();
}

on stopMeasurement
{
  cancelTimer(tSrrFlCycle);
  ethCloseSocket(gEthSocket);
  gEthSocket = ethInvalidSocket();
}
