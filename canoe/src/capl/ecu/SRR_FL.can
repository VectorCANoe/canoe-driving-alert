includes
{
  #include "..\\common\\CAPL_COMMON.cin"
}

variables
{
  msTimer tSrrFlCycle;
  int gLastDetected;
  int gLastRisk;
  int gLastMerge;
  int gLastTurn;
}

void publishSrrFlState()
{
  message frmSrrFlStateMsg mSrrFl;
  int mergeConflict;
  int riskClass;
  int turnLampState;
  int detected;
  int riskLevel;

  mergeConflict = (((int)@Core::mergeCutInFlag) == 1) ? 1 : 0;
  riskClass = clampRange((int)@Core::objectRiskClass, 0, 7);
  turnLampState = clampRange((int)@CoreState::turnLampState, 0, 3);

  detected = (mergeConflict == 1 && turnLampState == 1 && riskClass >= 2) ? 1 : 0;
  riskLevel = detected == 1 ? clampRange(40 + (riskClass * 10), 0, 100) : 0;

  mSrrFl.SideObjectDetected = detected;
  mSrrFl.SideRiskLevel = riskLevel;
  mSrrFl.MergeConflict = mergeConflict;
  mSrrFl.TurnLampState = turnLampState;
  output(mSrrFl);

  if (detected != gLastDetected ||
      riskLevel != gLastRisk ||
      mergeConflict != gLastMerge ||
      turnLampState != gLastTurn)
  {
    write("[SRR_FL] detected=%d risk=%d merge=%d turn=%d class=%d",
          detected,
          riskLevel,
          mergeConflict,
          turnLampState,
          riskClass);
    gLastDetected = detected;
    gLastRisk = riskLevel;
    gLastMerge = mergeConflict;
    gLastTurn = turnLampState;
  }
}

on start
{
  gLastDetected = -1;
  gLastRisk = -1;
  gLastMerge = -1;
  gLastTurn = -1;
  setTimer(tSrrFlCycle, 100);
  write("[SRR_FL] start");
}

on timer tSrrFlCycle
{
  publishSrrFlState();
  setTimer(tSrrFlCycle, 100);
}

on stopMeasurement
{
  cancelTimer(tSrrFlCycle);
}
