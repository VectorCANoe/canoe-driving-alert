includes
{
  #include "..\\common\\CAPL_COMMON.cin"
}

variables
{
  msTimer tBmsCycle;
  int gBatterySoc;
  int gChargingState;
  int gLastState;
  int gLastSoc;
  int gLastTemp;
}

on start
{
  gBatterySoc = 95;
  gChargingState = 0;
  gLastState = -1;
  gLastSoc = -1;
  gLastTemp = -1;
  setTimer(tBmsCycle, 100);
  write("[BAT_BMS] start");
}

on message frmFuelBatteryStateMsg
{
  gBatterySoc = clampRange((int)this.BatterySoc, 0, 100);
  gChargingState = clampRange((int)this.ChargingState, 0, 3);
}

on timer tBmsCycle
{
  message frmBatBmsStateMsg mBms;
  int bmsState;
  int packTemp;

  bmsState = (gChargingState == 1) ? 2 : ((gBatterySoc < 15) ? 3 : 1);
  packTemp = 28 + ((100 - gBatterySoc) / 8);
  if (gChargingState == 1) packTemp = clampRange(packTemp + 4, 0, 255);

  mBms.BmsState = clampRange(bmsState, 0, 7);
  mBms.PackSoc = clampRange(gBatterySoc, 0, 100);
  mBms.PackTemp = clampRange(packTemp, 0, 255);
  output(mBms);

  if (mBms.BmsState != gLastState ||
      mBms.PackSoc != gLastSoc ||
      mBms.PackTemp != gLastTemp)
  {
    write("[BAT_BMS] state=%d soc=%d temp=%d charging=%d",
          mBms.BmsState,
          mBms.PackSoc,
          mBms.PackTemp,
          gChargingState);
    gLastState = mBms.BmsState;
    gLastSoc = mBms.PackSoc;
    gLastTemp = mBms.PackTemp;
  }

  setTimer(tBmsCycle, 100);
}

on stopMeasurement
{
  cancelTimer(tBmsCycle);
}
