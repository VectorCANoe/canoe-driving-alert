includes
{
}

variables
{
  msTimer tBoundaryCheck;
  int gChassisAlive;
  int gBodyAlive;
  int gInfoAlive;
  dword gChassisTsMs;
  dword gBodyTsMs;
  dword gInfoTsMs;
  int gLastBoundaryStatus;
}

on start
{
  gChassisAlive = 0;
  gBodyAlive    = 0;
  gInfoAlive    = 0;
  gChassisTsMs  = 0;
  gBodyTsMs     = 0;
  gInfoTsMs     = 0;
  gLastBoundaryStatus = -1;
  @CoreState::domainBoundaryStatus = 0;
  setTimer(tBoundaryCheck, 300);
  write("[DOMAIN_BOUNDARY_MGR] start");
}

on message frmChassisHealthMsg
{
  gChassisAlive = this.ChassisAliveCnt;
  gChassisTsMs  = (dword)(timeNow() / 100000);
}

on message frmBodyHealthMsg
{
  gBodyAlive  = this.BodyAliveCnt;
  gBodyTsMs   = (dword)(timeNow() / 100000);
}

on message frmInfotainmentHealthMsg
{
  gInfoAlive  = this.InfoAliveCnt;
  gInfoTsMs   = (dword)(timeNow() / 100000);
}

on timer tBoundaryCheck
{
  dword nowMs;
  int allAlive;

  nowMs    = (dword)(timeNow() / 100000);
  allAlive = 0;

  /* All three domains must have been heard within 300 ms */
  if ((nowMs - gChassisTsMs) < 300 &&
      (nowMs - gBodyTsMs)    < 300 &&
      (nowMs - gInfoTsMs)    < 300 &&
      gChassisAlive > 0 &&
      gBodyAlive    > 0 &&
      gInfoAlive    > 0)
  {
    allAlive = 1;
  }

  @CoreState::domainBoundaryStatus = allAlive;

  if (allAlive != gLastBoundaryStatus)
  {
    write("[DOMAIN_BOUNDARY_MGR] boundary=%d ch=%d bd=%d inf=%d",
          allAlive, gChassisAlive, gBodyAlive, gInfoAlive);
    gLastBoundaryStatus = allAlive;
  }

  setTimer(tBoundaryCheck, 300);
}
