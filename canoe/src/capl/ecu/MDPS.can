includes
{
  #include "..\\common\\CAPL_COMMON.cin"
}

variables
{
  msTimer tMdpsCycle;
  long gEthSocket;
  dword gEthTargetIp;
  int gSteeringInput;
  int gSpeedNorm;
  int gPrevSteering;
}

void publishBackboneSteeringState(int steeringAngleRaw, int steeringQuality)
{
  char frame[3];
  int steeringInput;

  steeringInput = clampRange(gSteeringInput, 0, 1);

  ethInitFrame(frame, ethMsgSteering(), 1);
  ethSetU8(frame, 0, steeringInput);
  ethSendFrame(gEthSocket, gEthTargetIp, ethMsgSteering(), frame, 1);
}

on start
{
  gEthSocket = ethOpenDefaultSocket();
  gEthTargetIp = ethGetDefaultIpAddress();
  gSteeringInput = 0;
  gSpeedNorm = 0;
  gPrevSteering = -1;
  setTimer(tMdpsCycle, 50);
  write("[MDPS] start");
}

on message frmSteeringCanMsg
{
  gSteeringInput = clampRange((int)this.SteeringInput, 0, 1);
  @Core::steeringInputNorm = gSteeringInput;
}

on message frmVehicleStateCanMsg
{
  gSpeedNorm = clampRange((int)this.gVehicleSpeed, 0, 255);
}

on timer tMdpsCycle
{
  message frmSteeringStateCanMsg mSteerState;
  message frmSteeringTorqueMsg mSteerTorque;
  message frmEpsStateMsg mEps;
  int steeringAngleRaw;
  int assistLevel;
  int steeringTorque;

  steeringAngleRaw = gSteeringInput * 30;
  assistLevel = (gSpeedNorm > 80) ? 1 : 2;
  steeringTorque = gSteeringInput * 20;

  if (gSteeringInput != gPrevSteering)
  {
    write("[MDPS] input=%d assist=%d angle=%d",
          gSteeringInput, assistLevel, steeringAngleRaw);
    gPrevSteering = gSteeringInput;
  }

  mSteerState.SteeringState = gSteeringInput;
  output(mSteerState);

  mSteerTorque.SteeringTorque = steeringTorque;
  mSteerTorque.SteeringAssistLv = assistLevel;
  output(mSteerTorque);

  mEps.EpsAssistState = assistLevel;
  mEps.EpsFaultState = 0;
  mEps.EpsTemp = 55;
  output(mEps);

  publishBackboneSteeringState(steeringAngleRaw, (mEps.EpsFaultState == 0) ? 3 : 1);

  setTimer(tMdpsCycle, 50);
}

on stopMeasurement
{
  cancelTimer(tMdpsCycle);
  ethCloseSocket(gEthSocket);
  gEthSocket = ethInvalidSocket();
}
