includes
{
}

variables
{
  msTimer tSteerCycle;
  int gSteeringState;
  int gPrevSteering;
}

on start
{
  gSteeringState = 0;
  gPrevSteering  = -1;
  setTimer(tSteerCycle, 50);
  write("[MDPS] start");
}

on timer tSteerCycle
{
  message frmSteeringCanMsg mSteer;
  int steerInput;

  steerInput = (int)@Chassis::steeringInput;
  if (steerInput < 0) steerInput = 0;
  if (steerInput > 1) steerInput = 1;

  if (steerInput != gPrevSteering)
  {
    write("[MDPS] input=%d", steerInput);
    gPrevSteering = steerInput;
  }

  mSteer.SteeringInput = steerInput;
  output(mSteer);

  setTimer(tSteerCycle, 50);
}
