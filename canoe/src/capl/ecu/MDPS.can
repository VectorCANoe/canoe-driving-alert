includes
{
  #include "..\\common\\CAPL_COMMON.cin"
}

variables
{
  msTimer tMdpsCycle;
  int gSteeringInput;
  int gSpeedNorm;
  int gPrevSteering;
}

on start
{
  gSteeringInput = 0;
  gSpeedNorm = 0;
  gPrevSteering = -1;
  setTimer(tMdpsCycle, 50);
  write("[MDPS] start");
}

on message frmSteeringCanMsg
{
  gSteeringInput = clampRange((int)this.SteeringInput, 0, 1);
  @Core::steeringInputNorm = gSteeringInput;
}

on message frmVehicleStateCanMsg
{
  gSpeedNorm = clampRange((int)this.gVehicleSpeed, 0, 255);
}

on timer tMdpsCycle
{
  message frmSteeringStateCanMsg mSteerState;
  message frmSteeringTorqueMsg mSteerTorque;
  message frmSteeringAngleMsg mSteerAngle;
  message frmEpsStateMsg mEps;
  int steeringAngleRaw;
  int assistLevel;
  int steeringTorque;

  steeringAngleRaw = gSteeringInput * 30;
  assistLevel = (gSpeedNorm > 80) ? 1 : 2;
  steeringTorque = gSteeringInput * 20;

  if (gSteeringInput != gPrevSteering)
  {
    write("[MDPS] input=%d assist=%d angle=%d",
          gSteeringInput, assistLevel, steeringAngleRaw);
    gPrevSteering = gSteeringInput;
  }

  mSteerState.SteeringState = gSteeringInput;
  output(mSteerState);

  mSteerTorque.SteeringTorque = steeringTorque;
  mSteerTorque.SteeringAssistLv = assistLevel;
  output(mSteerTorque);

  mSteerAngle.SteeringAngleRaw = steeringAngleRaw;
  output(mSteerAngle);

  mEps.EpsAssistState = assistLevel;
  mEps.EpsFaultState = 0;
  mEps.EpsTemp = 55;
  output(mEps);

  setTimer(tMdpsCycle, 50);
}
