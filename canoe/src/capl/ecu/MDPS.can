includes
{
  #include "..\\common\\CAPL_COMMON.cin"
}

variables
{
  msTimer tMdpsCycle;
  long gEthSocket;
  long gEthTxSocket;
  dword gEthTargetIp;
  int gSteeringInput;
  int gSpeedNorm;
  int gPrevSteering;
}

int getMdpsTxPort()
{
  return ethBackbonePort() + 3;
}

void publishBackboneSteeringState(int steeringAngleRaw, int steeringQuality)
{
  char frame[3];
  int steeringInput;
  long txSocket;

  steeringInput = clampRange(gSteeringInput, 0, 1);
  txSocket = gEthTxSocket;
  if (txSocket == ethInvalidSocket())
  {
    txSocket = gEthSocket;
  }

  ethInitFrame(frame, ethMsgSteering(), 1);
  ethSetU8(frame, 0, steeringInput);
  ethSendFrame(txSocket, gEthTargetIp, ethMsgSteering(), frame, 1);
}

on start
{
  gEthSocket = ethOpenDefaultSocket();
  gEthTxSocket = ethOpenNodeSocket(getMdpsTxPort());
  gEthTargetIp = ethGetDefaultIpAddress();
  gSteeringInput = 0;
  gSpeedNorm = 0;
  gPrevSteering = -1;
  if (gEthTxSocket == ethInvalidSocket())
  {
    write("[MDPS] tx socket fallback to shared backbone port");
  }
  setTimer(tMdpsCycle, 50);
  write("[MDPS] start");
}

on message frmSteeringCanMsg
{
  gSteeringInput = clampRange((int)this.SteeringInput, 0, 1);
  @Core::steeringInputNorm = gSteeringInput;
}

on message frmVehicleStateCanMsg
{
  gSpeedNorm = clampRange((int)this.gVehicleSpeed, 0, 255);
}

on timer tMdpsCycle
{
  message frmSteeringStateCanMsg mSteerState;
  message frmSteeringTorqueMsg mSteerTorque;
  message frmEpsStateMsg mEps;
  int steeringAngleRaw;
  int assistLevel;
  int steeringTorque;

  steeringAngleRaw = gSteeringInput * 30;
  assistLevel = (gSpeedNorm > 80) ? 1 : 2;
  steeringTorque = gSteeringInput * 20;

  if (gSteeringInput != gPrevSteering)
  {
    write("[MDPS] input=%d assist=%d angle=%d",
          gSteeringInput, assistLevel, steeringAngleRaw);
    gPrevSteering = gSteeringInput;
  }

  mSteerState.SteeringState = gSteeringInput;
  output(mSteerState);

  mSteerTorque.SteeringTorque = steeringTorque;
  mSteerTorque.SteeringAssistLv = assistLevel;
  output(mSteerTorque);

  mEps.EpsAssistState = assistLevel;
  mEps.EpsFaultState = 0;
  mEps.EpsTemp = 55;
  output(mEps);

  publishBackboneSteeringState(steeringAngleRaw, (mEps.EpsFaultState == 0) ? 3 : 1);

  setTimer(tMdpsCycle, 50);
}

on stopMeasurement
{
  cancelTimer(tMdpsCycle);
  ethCloseSocket(gEthTxSocket);
  gEthTxSocket = ethInvalidSocket();
  ethCloseSocket(gEthSocket);
  gEthSocket = ethInvalidSocket();
}
