includes
{
  #include "..\\common\\CAPL_COMMON.cin"
}

variables
{
  msTimer tMdpsCycle;
  int gSteeringInput;
  int gSpeedNorm;
  int gPrevSteering;
}

void publishBackboneSteeringState(int steeringAngleRaw, int steeringQuality)
{
  message ethSteeringMsg mEthSteer;

  /* Internal chassis steering gateway seam for CAN-stub today, transport swap later. */
  mEthSteer.SteeringInput = clampRange(gSteeringInput, 0, 1);
  mEthSteer.SteeringAngleDeg = clampRange(steeringAngleRaw, -720, 720);
  mEthSteer.SteeringQuality = clampRange(steeringQuality, 0, 3);
  output(mEthSteer);
}

on start
{
  gSteeringInput = 0;
  gSpeedNorm = 0;
  gPrevSteering = -1;
  setTimer(tMdpsCycle, 50);
  write("[MDPS] start");
}

on message frmSteeringCanMsg
{
  gSteeringInput = clampRange((int)this.SteeringInput, 0, 1);
  @Core::steeringInputNorm = gSteeringInput;
}

on message frmVehicleStateCanMsg
{
  gSpeedNorm = clampRange((int)this.gVehicleSpeed, 0, 255);
}

on timer tMdpsCycle
{
  message frmSteeringStateCanMsg mSteerState;
  message frmSteeringTorqueMsg mSteerTorque;
  message frmEpsStateMsg mEps;
  int steeringAngleRaw;
  int assistLevel;
  int steeringTorque;

  steeringAngleRaw = gSteeringInput * 30;
  assistLevel = (gSpeedNorm > 80) ? 1 : 2;
  steeringTorque = gSteeringInput * 20;

  if (gSteeringInput != gPrevSteering)
  {
    write("[MDPS] input=%d assist=%d angle=%d",
          gSteeringInput, assistLevel, steeringAngleRaw);
    gPrevSteering = gSteeringInput;
  }

  mSteerState.SteeringState = gSteeringInput;
  output(mSteerState);

  mSteerTorque.SteeringTorque = steeringTorque;
  mSteerTorque.SteeringAssistLv = assistLevel;
  output(mSteerTorque);

  mEps.EpsAssistState = assistLevel;
  mEps.EpsFaultState = 0;
  mEps.EpsTemp = 55;
  output(mEps);

  publishBackboneSteeringState(steeringAngleRaw, (mEps.EpsFaultState == 0) ? 3 : 1);

  setTimer(tMdpsCycle, 50);
}
