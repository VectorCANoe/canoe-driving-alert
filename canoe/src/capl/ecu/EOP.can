includes
{
  #include "..\\common\\CAPL_COMMON.cin"
}

variables
{
  msTimer tEopCycle;
  int gEngineRpm;
  int gOilTemp;
  int gDriveMode;
  int gLastState;
  long gLastPumpRpm;
  int gLastPressure;
}

on start
{
  gEngineRpm = 0;
  gOilTemp = 20;
  gDriveMode = 0;
  gLastState = -1;
  gLastPumpRpm = -1;
  gLastPressure = -1;
  setTimer(tEopCycle, 100);
  write("[EOP] start");
}

on message frmEngineSpeedTempMsg
{
  gEngineRpm = clampRange((int)this.EngineRpm, 0, 65535);
  gOilTemp = clampRange((int)this.OilTemp, 0, 255);
}

on message frmVehicleModeMsg
{
  gDriveMode = clampRange((int)this.DriveMode, 0, 7);
}

on timer tEopCycle
{
  message frmEopStateMsg mEop;
  int driveState;
  int eopState;
  long pumpRpm;
  int oilPressure;
  int tempPenalty;

  driveState = clampRange((int)@Core::driveStateNorm, 0, 3);

  if (gEngineRpm > 0 || driveState > 0)
  {
    eopState = 2;
    pumpRpm = 800 + (gEngineRpm / 4) + (gDriveMode * 100);
  }
  else
  {
    eopState = 0;
    pumpRpm = 0;
  }

  tempPenalty = (gOilTemp > 100) ? (gOilTemp - 100) : 0;
  oilPressure = (eopState == 0) ? 0 : clampRange(80 + (gEngineRpm / 60) - tempPenalty, 0, 255);

  mEop.EopState = clampRange(eopState, 0, 7);
  mEop.PumpRpm = clampRange((int)pumpRpm, 0, 65535);
  mEop.OilPressure = oilPressure;
  output(mEop);

  if (mEop.EopState != gLastState ||
      mEop.PumpRpm != gLastPumpRpm ||
      mEop.OilPressure != gLastPressure)
  {
    write("[EOP] state=%d rpm=%d pressure=%d oilTemp=%d",
          mEop.EopState,
          mEop.PumpRpm,
          mEop.OilPressure,
          gOilTemp);
    gLastState = mEop.EopState;
    gLastPumpRpm = mEop.PumpRpm;
    gLastPressure = mEop.OilPressure;
  }

  setTimer(tEopCycle, 100);
}

on stopMeasurement
{
  cancelTimer(tEopCycle);
}
