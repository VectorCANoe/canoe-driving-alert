includes
{
}

variables
{
}

on start
{
  write("[CLU_BASE_CTRL] absorbed into CLUSTER runtime; wrapper only");
}
