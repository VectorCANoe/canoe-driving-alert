includes
{
  #include "..\\common\\CAPL_COMMON.cin"
}

variables
{
  msTimer tMirrorCycle;
  int gTurnLampState;
  dword gLampControlRxMs;
  int gLastLampInputStale;
  int gLastFoldState;
  int gLastHeatState;
  int gLastAdjustAxis;
}

void traceMirrorInputHealth(int lampInputStale)
{
  if (lampInputStale != gLastLampInputStale)
  {
    write("[MIR] lamp-control input %s", lampInputStale == 1 ? "stale" : "restored");
    gLastLampInputStale = lampInputStale;
  }
}

on start
{
  gTurnLampState = 0;
  gLampControlRxMs = 0;
  gLastLampInputStale = 0;
  gLastFoldState = -1;
  gLastHeatState = -1;
  gLastAdjustAxis = -1;
  setTimer(tMirrorCycle, 100);
  write("[MIR] start");
}

on timer tMirrorCycle
{
  message frmMirrorStateMsg mMirror;
  int lampInputStale;
  int driveState;
  int timeoutClear;
  int failSafeMode;
  int turnLampState;
  int foldState;
  int heatState;
  int adjustAxis;

  lampInputStale = (ethIsRecentTick(gLampControlRxMs, 300) == 1) ? 0 : 1;
  traceMirrorInputHealth(lampInputStale);

  driveState = clampRange((int)@Core::driveStateNorm, 0, 3);
  timeoutClear = clampRange((int)@Core::timeoutClear, 0, 1);
  failSafeMode = clampRange((int)@Core::failSafeMode, 0, 2);
  turnLampState = gTurnLampState;
  if (lampInputStale == 1)
  {
    turnLampState = 0;
  }

  foldState = (driveState == 0) ? 1 : 0;
  heatState = (timeoutClear == 1 || failSafeMode == 1) ? 1 : 0;
  adjustAxis = 0;
  if (turnLampState == 1)
  {
    adjustAxis = 1;
  }
  else if (turnLampState == 2)
  {
    adjustAxis = 2;
  }

  mMirror.MirrorFoldState = clampRange(foldState, 0, 3);
  mMirror.MirrorHeatState = clampRange(heatState, 0, 1);
  mMirror.MirrorAdjustAxis = clampRange(adjustAxis, 0, 3);
  output(mMirror);

  if (mMirror.MirrorFoldState != gLastFoldState ||
      mMirror.MirrorHeatState != gLastHeatState ||
      mMirror.MirrorAdjustAxis != gLastAdjustAxis)
  {
    write("[MIR] fold=%d heat=%d axis=%d turn=%d drive=%d",
          mMirror.MirrorFoldState,
          mMirror.MirrorHeatState,
          mMirror.MirrorAdjustAxis,
          turnLampState,
          driveState);
    gLastFoldState = mMirror.MirrorFoldState;
    gLastHeatState = mMirror.MirrorHeatState;
    gLastAdjustAxis = mMirror.MirrorAdjustAxis;
  }

  setTimer(tMirrorCycle, 100);
}

on message frmLampControlMsg
{
  gTurnLampState = clampRange((int)this.TurnLampState, 0, 3);
  gLampControlRxMs = getSimulationTimeMs();
}

on stopMeasurement
{
  cancelTimer(tMirrorCycle);
}

