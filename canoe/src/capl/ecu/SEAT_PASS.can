includes
{
  #include "..\\common\\CAPL_COMMON.cin"
}

variables
{
  msTimer tSeatPassCycle;
  int gLastPos;
  int gLastHeat;
  int gLastVent;
}

on start
{
  gLastPos = -1;
  gLastHeat = -1;
  gLastVent = -1;
  setTimer(tSeatPassCycle, 100);
  write("[SEAT_PASS] start");
}

on timer tSeatPassCycle
{
  message frmSeatPassStateMsg mSeat;
  int pos;
  int heat;
  int vent;

  pos = 118;
  heat = 0;
  vent = 0;

  mSeat.SeatPassPos = clampRange(pos, 0, 255);
  mSeat.SeatPassHeatLvl = clampRange(heat, 0, 15);
  mSeat.SeatPassVentLvl = clampRange(vent, 0, 15);
  output(mSeat);

  if (mSeat.SeatPassPos != gLastPos ||
      mSeat.SeatPassHeatLvl != gLastHeat ||
      mSeat.SeatPassVentLvl != gLastVent)
  {
    write("[SEAT_PASS] pos=%d heat=%d vent=%d",
          mSeat.SeatPassPos,
          mSeat.SeatPassHeatLvl,
          mSeat.SeatPassVentLvl);
    gLastPos = mSeat.SeatPassPos;
    gLastHeat = mSeat.SeatPassHeatLvl;
    gLastVent = mSeat.SeatPassVentLvl;
  }

  setTimer(tSeatPassCycle, 100);
}

on stopMeasurement
{
  cancelTimer(tSeatPassCycle);
}
