includes
{
  #include "..\\common\\CAPL_COMMON.cin"
}

variables
{
  msTimer tLdwsCycle;
  int gLastLaneDepartureWarn;
  int gLastLaneKeepAssist;
  int gLastLaneGuideState;
  int gLastTurnLampState;
  int gLastVehicleSpeed;
  int gLastAlertLevel;
}

void publishLdwsLkasState()
{
  message frmLdwsLkasStateMsg mLdws;
  int alertLevel;
  int alertType;
  int turnLampState;
  int vehicleSpeed;
  int laneDepartureWarn;
  int laneKeepAssist;
  int laneGuideState;

  alertLevel = clampRange((int)@Core::selectedAlertLevel, 0, 7);
  alertType = clampRange((int)@Core::selectedAlertType, 0, 7);
  turnLampState = clampRange((int)@CoreState::turnLampState, 0, 3);
  vehicleSpeed = clampRange((int)@Core::vehicleSpeedNorm, 0, 255);

  laneDepartureWarn = 0;
  laneKeepAssist = 0;
  laneGuideState = 0;

  if (vehicleSpeed >= 30 && turnLampState == 0 && (alertType == 5 || alertType == 6 || alertLevel >= 2))
  {
    laneDepartureWarn = 1;
    laneGuideState = 1;
  }

  if (vehicleSpeed >= 40 && turnLampState == 0 && (alertType == 6 || alertLevel >= 3))
  {
    laneKeepAssist = 1;
    laneGuideState = 2;
  }

  mLdws.LaneDepartureWarn = laneDepartureWarn;
  mLdws.LaneKeepAssistActive = laneKeepAssist;
  mLdws.LaneGuideState = laneGuideState;
  mLdws.TurnLampState = turnLampState;
  mLdws.VehicleSpeed = vehicleSpeed;
  mLdws.SelectedAlertLevel = alertLevel;
  output(mLdws);

  if (laneDepartureWarn != gLastLaneDepartureWarn ||
      laneKeepAssist != gLastLaneKeepAssist ||
      laneGuideState != gLastLaneGuideState ||
      turnLampState != gLastTurnLampState ||
      vehicleSpeed != gLastVehicleSpeed ||
      alertLevel != gLastAlertLevel)
  {
    write("[LDWS_LKAS] warn=%d assist=%d guide=%d turn=%d speed=%d alert=%d",
          laneDepartureWarn,
          laneKeepAssist,
          laneGuideState,
          turnLampState,
          vehicleSpeed,
          alertLevel);
    gLastLaneDepartureWarn = laneDepartureWarn;
    gLastLaneKeepAssist = laneKeepAssist;
    gLastLaneGuideState = laneGuideState;
    gLastTurnLampState = turnLampState;
    gLastVehicleSpeed = vehicleSpeed;
    gLastAlertLevel = alertLevel;
  }
}

on start
{
  gLastLaneDepartureWarn = -1;
  gLastLaneKeepAssist = -1;
  gLastLaneGuideState = -1;
  gLastTurnLampState = -1;
  gLastVehicleSpeed = -1;
  gLastAlertLevel = -1;
  setTimer(tLdwsCycle, 100);
  write("[LDWS_LKAS] start");
}

on timer tLdwsCycle
{
  publishLdwsLkasState();
  setTimer(tLdwsCycle, 100);
}

on stopMeasurement
{
  cancelTimer(tLdwsCycle);
}
