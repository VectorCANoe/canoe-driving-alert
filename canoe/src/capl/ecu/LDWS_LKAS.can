includes
{
  #include "..\\common\\CAPL_COMMON.cin"
}

variables
{
  msTimer tLdwsCycle;
  int gCameraHealth;
  int gLaneModelValid;
  dword gFcamRxMs;
  int gLastFcamInputStale;
  int gLastLaneDepartureWarn;
  int gLastLaneKeepAssist;
  int gLastLaneGuideState;
  int gLastTurnLampState;
  int gLastVehicleSpeed;
  int gLastAlertLevel;
  int gLastPathReady;
}

int ldwsPathReady()
{
  int warningPathStatus;
  int e2eHealthState;
  int failSafeMode;

  warningPathStatus = clampRange((int)@CoreState::warningPathStatus, 0, 2);
  e2eHealthState = clampRange((int)@CoreState::e2eHealthState, 0, 2);
  failSafeMode = clampRange((int)@Core::failSafeMode, 0, 2);
  if (warningPathStatus >= 2 || e2eHealthState == 0 || failSafeMode >= 2)
  {
    return 0;
  }
  return 1;
}

void traceLdwsInputHealth(int fcamInputStale)
{
  if (fcamInputStale != gLastFcamInputStale)
  {
    if (fcamInputStale == 1)
    {
      write("[LDWS_LKAS] fcam input stale");
    }
    else
    {
      write("[LDWS_LKAS] fcam input restored");
    }
    gLastFcamInputStale = fcamInputStale;
  }
}

void publishLdwsLkasState()
{
  message frmLdwsLkasStateMsg mLdws;
  int baseZoneContext;
  int steerGroupFlag;
  int fcamInputStale;
  int cameraHealth;
  int laneModelValid;
  int alertLevel;
  int turnLampState;
  int vehicleSpeed;
  int laneDepartureWarn;
  int laneKeepAssist;
  int laneGuideState;
  int pathReady;

  baseZoneContext = clampRange((int)@Core::baseZoneContext, 0, 4);
  steerGroupFlag = clampRange((int)@Core::steerGroupFlag, 0, 1);
  fcamInputStale = (ethIsRecentTick(gFcamRxMs, 300) == 1) ? 0 : 1;
  traceLdwsInputHealth(fcamInputStale);
  cameraHealth = gCameraHealth;
  laneModelValid = gLaneModelValid;
  alertLevel = 0;
  turnLampState = clampRange((int)@CoreState::turnLampState, 0, 3);
  vehicleSpeed = clampRange((int)@Core::vehicleSpeedNorm, 0, 255);
  pathReady = ldwsPathReady();

  if (fcamInputStale == 1)
  {
    cameraHealth = 0;
    laneModelValid = 0;
  }

  laneDepartureWarn = 0;
  laneKeepAssist = 0;
  laneGuideState = 0;

  if (baseZoneContext == 2 &&
      vehicleSpeed >= 30 &&
      turnLampState == 0 &&
      laneModelValid == 1 &&
      steerGroupFlag == 1)
  {
    laneDepartureWarn = 1;
    laneGuideState = 1;
    alertLevel = 2;
  }

  if (baseZoneContext == 2 &&
      vehicleSpeed >= 40 &&
      turnLampState == 0 &&
      laneModelValid == 1 &&
      cameraHealth >= 2)
  {
    laneKeepAssist = 1;
    laneGuideState = 2;
    alertLevel = 3;
  }
  if (pathReady == 0)
  {
    laneDepartureWarn = 0;
    laneKeepAssist = 0;
    laneGuideState = 0;
    alertLevel = 0;
  }

  mLdws.LaneDepartureWarn = laneDepartureWarn;
  mLdws.LaneKeepAssistActive = laneKeepAssist;
  mLdws.LaneGuideState = laneGuideState;
  mLdws.TurnLampState = turnLampState;
  mLdws.VehicleSpeed = vehicleSpeed;
  mLdws.SelectedAlertLevel = alertLevel;
  output(mLdws);

  if (pathReady != gLastPathReady ||
      laneDepartureWarn != gLastLaneDepartureWarn ||
      laneKeepAssist != gLastLaneKeepAssist ||
      laneGuideState != gLastLaneGuideState ||
      turnLampState != gLastTurnLampState ||
      vehicleSpeed != gLastVehicleSpeed ||
      alertLevel != gLastAlertLevel)
  {
    write("[LDWS_LKAS] path=%d warn=%d assist=%d guide=%d turn=%d speed=%d zone=%d lane=%d cam=%d alert=%d",
          pathReady,
          laneDepartureWarn,
          laneKeepAssist,
          laneGuideState,
          turnLampState,
          vehicleSpeed,
          baseZoneContext,
          laneModelValid,
          cameraHealth,
          alertLevel);
    gLastPathReady = pathReady;
    gLastLaneDepartureWarn = laneDepartureWarn;
    gLastLaneKeepAssist = laneKeepAssist;
    gLastLaneGuideState = laneGuideState;
    gLastTurnLampState = turnLampState;
    gLastVehicleSpeed = vehicleSpeed;
    gLastAlertLevel = alertLevel;
  }
}

on start
{
  gCameraHealth = 0;
  gLaneModelValid = 0;
  gFcamRxMs = 0;
  gLastFcamInputStale = 0;
  gLastPathReady = -1;
  gLastLaneDepartureWarn = -1;
  gLastLaneKeepAssist = -1;
  gLastLaneGuideState = -1;
  gLastTurnLampState = -1;
  gLastVehicleSpeed = -1;
  gLastAlertLevel = -1;
  setTimer(tLdwsCycle, 100);
  write("[LDWS_LKAS] start");
}

on timer tLdwsCycle
{
  publishLdwsLkasState();
  setTimer(tLdwsCycle, 100);
}

on message frmFcamStateMsg
{
  gCameraHealth = clampRange((int)this.CameraHealth, 0, 3);
  gLaneModelValid = clampRange((int)this.LaneModelValid, 0, 1);
  gFcamRxMs = getSimulationTimeMs();
}

on stopMeasurement
{
  cancelTimer(tLdwsCycle);
}
