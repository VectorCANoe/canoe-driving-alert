includes
{
  #include "..\\common\\CAPL_COMMON.cin"
}

variables
{
  msTimer tAebDomainCycle;
  long gEthSocket;
  char gEthRxBuffer[64];
  int gFcwState;
  int gAebRequest;
  int gDecelAssistReq;
  int gObjectRiskClass;
  int gTtcBucket;
  int gSelectedAlertLevel;
  int gFailSafeMode;
  int gLastArmed;
  int gLastStopReq;
  int gLastDecelProfile;
  int gLastHealth;
  int gLastRiskClass;
}

void publishAebDomainState()
{
  message frmAebDomainStateMsg mAeb;
  int aebArmed;
  int stopReq;
  int decelProfile;
  int domainHealth;

  aebArmed = (gFcwState >= 1 && gFailSafeMode < 2) ? 1 : 0;
  stopReq = (gAebRequest == 1 && gFailSafeMode < 2) ? 1 : 0;

  decelProfile = 0;
  if (gDecelAssistReq == 1)
  {
    decelProfile = 1;
    if (gObjectRiskClass >= 4 || gTtcBucket <= 10)
    {
      decelProfile = 3;
    }
    else if (gObjectRiskClass >= 2 || gTtcBucket <= 20)
    {
      decelProfile = 2;
    }
  }

  domainHealth = 2;
  if (gFailSafeMode == 1)
  {
    domainHealth = 1;
  }
  else if (gFailSafeMode >= 2)
  {
    domainHealth = 0;
  }

  mAeb.AebArmed = aebArmed;
  mAeb.StopReq = stopReq;
  mAeb.DecelProfile = clampRange(decelProfile, 0, 3);
  mAeb.DomainHealth = clampRange(domainHealth, 0, 3);
  mAeb.ObjectRiskClass = clampRange(gObjectRiskClass, 0, 7);
  mAeb.SelectedAlertLevel = clampRange(gSelectedAlertLevel, 0, 7);
  mAeb.TtcBucket = clampRange(gTtcBucket, 0, 255);
  output(mAeb);

  if (aebArmed != gLastArmed ||
      stopReq != gLastStopReq ||
      decelProfile != gLastDecelProfile ||
      domainHealth != gLastHealth ||
      gObjectRiskClass != gLastRiskClass)
  {
    write("[AEB] armed=%d stop=%d profile=%d health=%d risk=%d ttc=%d",
          aebArmed,
          stopReq,
          decelProfile,
          domainHealth,
          gObjectRiskClass,
          gTtcBucket);
    gLastArmed = aebArmed;
    gLastStopReq = stopReq;
    gLastDecelProfile = decelProfile;
    gLastHealth = domainHealth;
    gLastRiskClass = gObjectRiskClass;
  }
}

void OnUdpReceiveFrom(dword socket, long result, dword address, dword port, char buffer[], dword count)
{
  int msgId;
  int payload0;

  if (socket != gEthSocket)
  {
    return;
  }
  if (result == 0)
  {
    msgId = ethFrameMsgId(buffer, count);
    if (msgId == ethMsgFailSafe() && ethFramePayloadLen(count) >= 1)
    {
      payload0 = ethGetU8(buffer, 0);
      gFailSafeMode = clampRange((payload0 >> 4) & 0x3, 0, 2);
    }
  }

  ethArmReceive(gEthSocket, gEthRxBuffer, elcount(gEthRxBuffer));
}

on start
{
  gEthSocket = ethOpenDefaultSocket();
  gFcwState = 0;
  gAebRequest = 0;
  gDecelAssistReq = 0;
  gObjectRiskClass = 0;
  gTtcBucket = 255;
  gSelectedAlertLevel = 0;
  gFailSafeMode = 0;
  gLastArmed = -1;
  gLastStopReq = -1;
  gLastDecelProfile = -1;
  gLastHealth = -1;
  gLastRiskClass = -1;
  if (gEthSocket != ethInvalidSocket())
  {
    ethStartReceiver(gEthSocket, gEthRxBuffer, elcount(gEthRxBuffer));
  }
  setTimer(tAebDomainCycle, 100);
  write("[AEB] start");
}

on timer tAebDomainCycle
{
  publishAebDomainState();
  setTimer(tAebDomainCycle, 100);
}

on message frmFcaStateMsg
{
  gFcwState = clampRange((int)this.FcwState, 0, 3);
  gAebRequest = clampRange((int)this.AebRequest, 0, 1);
  gDecelAssistReq = clampRange((int)this.DecelAssistReq, 0, 1);
  gObjectRiskClass = clampRange((int)this.ObjectRiskClass, 0, 7);
  gTtcBucket = clampRange((int)this.TtcBucket, 0, 255);
  gSelectedAlertLevel = clampRange((int)this.SelectedAlertLevel, 0, 7);
}

on stopMeasurement
{
  cancelTimer(tAebDomainCycle);
  ethCloseSocket(gEthSocket);
  gEthSocket = ethInvalidSocket();
}
