includes
{
  #include "..\\common\\CAPL_COMMON.cin"
}

variables
{
  msTimer tAebDomainCycle;
  long gEthSocket;
  char gEthRxBuffer[64];
  int gFcwState;
  int gAebRequest;
  int gDecelAssistReq;
  int gObjectRiskClass;
  int gTtcBucket;
  int gSelectedAlertLevel;
  dword gFcaRxMs;
  int gFailSafeMode;
  dword gFailSafeRxTsMs;
  int gLastFcaInputStale;
  int gLastArmed;
  int gLastStopReq;
  int gLastDecelProfile;
  int gLastHealth;
  int gLastRiskClass;
}

void traceAebInputHealth(int fcaInputStale)
{
  if (fcaInputStale != gLastFcaInputStale)
  {
    if (fcaInputStale == 1)
    {
      write("[AEB] fca input stale");
    }
    else
    {
      write("[AEB] fca input restored");
    }
    gLastFcaInputStale = fcaInputStale;
  }
}

int getEffectiveFailSafeMode()
{
  int failSafeMode;

  failSafeMode = clampRange((int)@Core::failSafeMode, 0, 2);
  if (ethIsRecentTick(gFailSafeRxTsMs, 300) == 1 && gFailSafeMode > failSafeMode)
  {
    failSafeMode = gFailSafeMode;
  }
  return failSafeMode;
}

void publishAebDomainState()
{
  message frmAebDomainStateMsg mAeb;
  int fcaInputStale;
  int fcwState;
  int aebRequest;
  int decelAssistReq;
  int objectRiskClass;
  int ttcBucket;
  int selectedAlertLevel;
  int aebArmed;
  int stopReq;
  int decelProfile;
  int domainHealth;
  int failSafeMode;

  fcaInputStale = (ethIsRecentTick(gFcaRxMs, 300) == 1) ? 0 : 1;
  traceAebInputHealth(fcaInputStale);

  failSafeMode = getEffectiveFailSafeMode();
  fcwState = gFcwState;
  aebRequest = gAebRequest;
  decelAssistReq = gDecelAssistReq;
  objectRiskClass = gObjectRiskClass;
  ttcBucket = gTtcBucket;
  selectedAlertLevel = gSelectedAlertLevel;
  if (fcaInputStale == 1)
  {
    fcwState = 0;
    aebRequest = 0;
    decelAssistReq = 0;
    objectRiskClass = 0;
    ttcBucket = 255;
    selectedAlertLevel = 0;
  }

  aebArmed = (fcwState >= 1 && failSafeMode < 2) ? 1 : 0;
  stopReq = (aebRequest == 1 && failSafeMode < 2) ? 1 : 0;

  decelProfile = 0;
  if (decelAssistReq == 1)
  {
    decelProfile = 1;
    if (objectRiskClass >= 4 || ttcBucket <= 10)
    {
      decelProfile = 3;
    }
    else if (objectRiskClass >= 2 || ttcBucket <= 20)
    {
      decelProfile = 2;
    }
  }

  domainHealth = 2;
  if (failSafeMode == 1)
  {
    domainHealth = 1;
  }
  else if (failSafeMode >= 2)
  {
    domainHealth = 0;
  }
  if (fcaInputStale == 1 && domainHealth > 1)
  {
    domainHealth = 1;
  }

  mAeb.AebArmed = aebArmed;
  mAeb.StopReq = stopReq;
  mAeb.DecelProfile = clampRange(decelProfile, 0, 3);
  mAeb.DomainHealth = clampRange(domainHealth, 0, 3);
  mAeb.ObjectRiskClass = clampRange(objectRiskClass, 0, 7);
  mAeb.SelectedAlertLevel = clampRange(selectedAlertLevel, 0, 7);
  mAeb.TtcBucket = clampRange(ttcBucket, 0, 255);
  output(mAeb);

  if (aebArmed != gLastArmed ||
      stopReq != gLastStopReq ||
      decelProfile != gLastDecelProfile ||
      domainHealth != gLastHealth ||
      objectRiskClass != gLastRiskClass)
  {
    write("[AEB] armed=%d stop=%d profile=%d health=%d risk=%d ttc=%d",
          aebArmed,
          stopReq,
          decelProfile,
          domainHealth,
          objectRiskClass,
          ttcBucket);
    gLastArmed = aebArmed;
    gLastStopReq = stopReq;
    gLastDecelProfile = decelProfile;
    gLastHealth = domainHealth;
    gLastRiskClass = objectRiskClass;
  }
}

void OnUdpReceiveFrom(dword socket, long result, dword address, dword port, char buffer[], dword count)
{
  int msgId;
  int payload0;

  if (socket != gEthSocket)
  {
    return;
  }
  if (result == 0)
  {
    msgId = ethFrameMsgId(buffer, count);
    if (msgId == ethMsgFailSafe() && ethFramePayloadLen(count) >= 1)
    {
      payload0 = ethGetU8(buffer, 0);
      gFailSafeMode = clampRange((payload0 >> 4) & 0x3, 0, 2);
      gFailSafeRxTsMs = getSimulationTimeMs();
    }
  }

  ethArmReceive(gEthSocket, gEthRxBuffer, elcount(gEthRxBuffer));
}

on start
{
  gEthSocket = ethOpenDefaultSocket();
  gFcwState = 0;
  gAebRequest = 0;
  gDecelAssistReq = 0;
  gObjectRiskClass = 0;
  gTtcBucket = 255;
  gSelectedAlertLevel = 0;
  gFcaRxMs = 0;
  gFailSafeMode = 0;
  gFailSafeRxTsMs = 0;
  gLastFcaInputStale = 0;
  gLastArmed = -1;
  gLastStopReq = -1;
  gLastDecelProfile = -1;
  gLastHealth = -1;
  gLastRiskClass = -1;
  if (gEthSocket != ethInvalidSocket())
  {
    ethStartReceiver(gEthSocket, gEthRxBuffer, elcount(gEthRxBuffer));
  }
  setTimer(tAebDomainCycle, 100);
  write("[AEB] start");
}

on timer tAebDomainCycle
{
  publishAebDomainState();
  setTimer(tAebDomainCycle, 100);
}

on message frmFcaStateMsg
{
  gFcwState = clampRange((int)this.FcwState, 0, 3);
  gAebRequest = clampRange((int)this.AebRequest, 0, 1);
  gDecelAssistReq = clampRange((int)this.DecelAssistReq, 0, 1);
  gObjectRiskClass = clampRange((int)this.ObjectRiskClass, 0, 7);
  gTtcBucket = clampRange((int)this.TtcBucket, 0, 255);
  gSelectedAlertLevel = clampRange((int)this.SelectedAlertLevel, 0, 7);
  gFcaRxMs = getSimulationTimeMs();
}

on stopMeasurement
{
  cancelTimer(tAebDomainCycle);
  ethCloseSocket(gEthSocket);
  gEthSocket = ethInvalidSocket();
}
