includes
{
  #include "..\\common\\CAPL_COMMON.cin"
}

variables
{
  msTimer tSrrFrCycle;
  int gLastDetected;
  int gLastRisk;
  int gLastMerge;
  int gLastTurn;
}

void publishSrrFrState()
{
  message frmSrrFrStateMsg mSrrFr;
  int mergeConflict;
  int riskClass;
  int turnLampState;
  int detected;
  int riskLevel;

  mergeConflict = (((int)@Core::mergeCutInFlag) == 1) ? 1 : 0;
  riskClass = clampRange((int)@Core::objectRiskClass, 0, 7);
  turnLampState = clampRange((int)@CoreState::turnLampState, 0, 3);

  detected = (mergeConflict == 1 && turnLampState == 2 && riskClass >= 2) ? 1 : 0;
  riskLevel = detected == 1 ? clampRange(40 + (riskClass * 10), 0, 100) : 0;

  mSrrFr.SideObjectDetected = detected;
  mSrrFr.SideRiskLevel = riskLevel;
  mSrrFr.MergeConflict = mergeConflict;
  mSrrFr.TurnLampState = turnLampState;
  output(mSrrFr);

  if (detected != gLastDetected ||
      riskLevel != gLastRisk ||
      mergeConflict != gLastMerge ||
      turnLampState != gLastTurn)
  {
    write("[SRR_FR] detected=%d risk=%d merge=%d turn=%d class=%d",
          detected,
          riskLevel,
          mergeConflict,
          turnLampState,
          riskClass);
    gLastDetected = detected;
    gLastRisk = riskLevel;
    gLastMerge = mergeConflict;
    gLastTurn = turnLampState;
  }
}

on start
{
  gLastDetected = -1;
  gLastRisk = -1;
  gLastMerge = -1;
  gLastTurn = -1;
  setTimer(tSrrFrCycle, 100);
  write("[SRR_FR] start");
}

on timer tSrrFrCycle
{
  publishSrrFrState();
  setTimer(tSrrFrCycle, 100);
}

on stopMeasurement
{
  cancelTimer(tSrrFrCycle);
}
