/*@!Encoding:949*/
// TRANSMISSION_CTRL_fixed.can
// Powertrain 도메인

includes
{
}

variables
{
  msTimer tTransCycle;
  int gGear;
}

on start
{
  gGear = 1;
  setTimer(tTransCycle, 100);
  write("[TRANSMISSION] start");
}

on timer tTransCycle
{
  int ignition;
  int speed;
  int driveMode;

  ignition  = (int)@Powertrain::ignitionState;
  speed     = (int)@Chassis::vehicleSpeed;
  driveMode = (int)@Chassis::driveMode;

  if (ignition == 0)
  {
    gGear = 1;
    @Chassis::gearPosition = gGear;
    setTimer(tTransCycle, 100);
    return;
  }

  if (driveMode != 3)
  {
    gGear = 1;
  }
  else
  {
    if (speed < 40)       gGear = 1;
    else if (speed < 80)  gGear = 2;
    else if (speed < 120) gGear = 3;
    else                  gGear = 4;
  }

  @Chassis::gearPosition = gGear;

  setTimer(tTransCycle, 100);
}
