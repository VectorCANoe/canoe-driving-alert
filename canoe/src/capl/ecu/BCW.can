includes
{
  #include "..\\common\\CAPL_COMMON.cin"
}

variables
{
  msTimer tBcwCycle;
  int gLastWarnLeft;
  int gLastWarnRight;
  int gLastMergeConflict;
  int gLastRiskClass;
  int gLastAlertLevel;
}

void publishBcwState()
{
  message frmBcwStateMsg mBcw;
  int turnLampState;
  int mergeConflict;
  int objectRiskClass;
  int alertLevel;
  int warnLeft;
  int warnRight;

  turnLampState = clampRange((int)@CoreState::turnLampState, 0, 3);
  mergeConflict = (((int)@Core::mergeCutInFlag) == 1) ? 1 : 0;
  objectRiskClass = clampRange((int)@Core::objectRiskClass, 0, 7);
  alertLevel = clampRange((int)@Core::selectedAlertLevel, 0, 7);

  warnLeft = 0;
  warnRight = 0;

  if (mergeConflict == 1 && objectRiskClass >= 2)
  {
    if (turnLampState == 1)
    {
      warnLeft = 1;
    }
    else if (turnLampState == 2)
    {
      warnRight = 1;
    }
  }

  mBcw.BcwWarnLeft = warnLeft;
  mBcw.BcwWarnRight = warnRight;
  mBcw.MergeConflict = mergeConflict;
  mBcw.ObjectRiskClass = objectRiskClass;
  mBcw.SelectedAlertLevel = alertLevel;
  output(mBcw);

  if (warnLeft != gLastWarnLeft ||
      warnRight != gLastWarnRight ||
      mergeConflict != gLastMergeConflict ||
      objectRiskClass != gLastRiskClass ||
      alertLevel != gLastAlertLevel)
  {
    write("[BCW] left=%d right=%d merge=%d riskClass=%d alert=%d",
          warnLeft,
          warnRight,
          mergeConflict,
          objectRiskClass,
          alertLevel);
    gLastWarnLeft = warnLeft;
    gLastWarnRight = warnRight;
    gLastMergeConflict = mergeConflict;
    gLastRiskClass = objectRiskClass;
    gLastAlertLevel = alertLevel;
  }
}

on start
{
  gLastWarnLeft = -1;
  gLastWarnRight = -1;
  gLastMergeConflict = -1;
  gLastRiskClass = -1;
  gLastAlertLevel = -1;
  setTimer(tBcwCycle, 100);
  write("[BCW] start");
}

on timer tBcwCycle
{
  publishBcwState();
  setTimer(tBcwCycle, 100);
}

on stopMeasurement
{
  cancelTimer(tBcwCycle);
}
