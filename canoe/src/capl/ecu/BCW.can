includes
{
  #include "..\\common\\CAPL_COMMON.cin"
}

variables
{
  msTimer tBcwCycle;
  int gLastWarnLeft;
  int gLastWarnRight;
  int gLastMergeConflict;
  int gLastRiskClass;
  int gLastAlertLevel;
  int gLastPathReady;
}

int bcwPathReady()
{
  int warningPathStatus;
  int e2eHealthState;
  int failSafeMode;

  warningPathStatus = clampRange((int)@CoreState::warningPathStatus, 0, 2);
  e2eHealthState = clampRange((int)@CoreState::e2eHealthState, 0, 2);
  failSafeMode = clampRange((int)@Core::failSafeMode, 0, 2);
  if (warningPathStatus >= 2 || e2eHealthState == 0 || failSafeMode >= 2)
  {
    return 0;
  }
  return 1;
}

int deriveBcwAlertLevel(int warnLeft, int warnRight, int objectRiskClass)
{
  if ((warnLeft == 1 || warnRight == 1) && objectRiskClass >= 4)
  {
    return 4;
  }
  if (warnLeft == 1 || warnRight == 1)
  {
    return 3;
  }
  return 0;
}

void publishBcwState()
{
  message frmBcwStateMsg mBcw;
  int turnLampState;
  int mergeConflict;
  int objectRiskClass;
  int alertLevel;
  int warnLeft;
  int warnRight;
  int pathReady;

  turnLampState = clampRange((int)@CoreState::turnLampState, 0, 3);
  mergeConflict = (((int)@Core::mergeCutInFlag) == 1) ? 1 : 0;
  objectRiskClass = clampRange((int)@Core::objectRiskClass, 0, 7);
  pathReady = bcwPathReady();

  warnLeft = 0;
  warnRight = 0;

  if (mergeConflict == 1 && objectRiskClass >= 2)
  {
    if (turnLampState == 1)
    {
      warnLeft = 1;
    }
    else if (turnLampState == 2)
    {
      warnRight = 1;
    }
  }
  alertLevel = deriveBcwAlertLevel(warnLeft, warnRight, objectRiskClass);
  if (pathReady == 0)
  {
    warnLeft = 0;
    warnRight = 0;
    mergeConflict = 0;
    objectRiskClass = 0;
    alertLevel = 0;
  }

  mBcw.BcwWarnLeft = warnLeft;
  mBcw.BcwWarnRight = warnRight;
  mBcw.MergeConflict = mergeConflict;
  mBcw.ObjectRiskClass = objectRiskClass;
  mBcw.SelectedAlertLevel = alertLevel;
  output(mBcw);

  if (pathReady != gLastPathReady ||
      warnLeft != gLastWarnLeft ||
      warnRight != gLastWarnRight ||
      mergeConflict != gLastMergeConflict ||
      objectRiskClass != gLastRiskClass ||
      alertLevel != gLastAlertLevel)
  {
    write("[BCW] path=%d left=%d right=%d merge=%d riskClass=%d alert=%d",
          pathReady,
          warnLeft,
          warnRight,
          mergeConflict,
          objectRiskClass,
          alertLevel);
    gLastPathReady = pathReady;
    gLastWarnLeft = warnLeft;
    gLastWarnRight = warnRight;
    gLastMergeConflict = mergeConflict;
    gLastRiskClass = objectRiskClass;
    gLastAlertLevel = alertLevel;
  }
}

on start
{
  gLastPathReady = -1;
  gLastWarnLeft = -1;
  gLastWarnRight = -1;
  gLastMergeConflict = -1;
  gLastRiskClass = -1;
  gLastAlertLevel = -1;
  setTimer(tBcwCycle, 100);
  write("[BCW] start");
}

on timer tBcwCycle
{
  publishBcwState();
  setTimer(tBcwCycle, 100);
}

on stopMeasurement
{
  cancelTimer(tBcwCycle);
}
