includes
{
  #include "..\\common\\CAPL_COMMON.cin"
}

variables
{
  msTimer tIsgCycle;
  int gBatterySoc;
  int gChargingState;
  int gDriveMode;
  int gEngineState;
  int gLastState;
  int gLastReady;
  int gLastRegen;
}

on start
{
  gBatterySoc = 95;
  gChargingState = 0;
  gDriveMode = 0;
  gEngineState = 0;
  gLastState = -1;
  gLastReady = -1;
  gLastRegen = -1;
  setTimer(tIsgCycle, 100);
  write("[ISG] start");
}

on message frmFuelBatteryStateMsg
{
  gBatterySoc = clampRange((int)this.BatterySoc, 0, 100);
  gChargingState = clampRange((int)this.ChargingState, 0, 3);
}

on message frmVehicleModeMsg
{
  gDriveMode = clampRange((int)this.DriveMode, 0, 7);
  gEngineState = clampRange((int)this.PowertrainState, 0, 255);
}

on timer tIsgCycle
{
  message frmIsgStateMsg mIsg;
  int driveState;
  int speed;
  int isgState;
  int restartReady;
  int recuperationLvl;

  driveState = clampRange((int)@Core::driveStateNorm, 0, 3);
  speed = clampRange((int)@Core::vehicleSpeedNorm, 0, 255);

  if (gEngineState == 0)
  {
    isgState = 0;
    restartReady = 0;
    recuperationLvl = 0;
  }
  else if (driveState == 0 && gBatterySoc < 95)
  {
    isgState = 1;
    restartReady = 1;
    recuperationLvl = 0;
  }
  else if (driveState > 0 && gBatterySoc < 75 && gDriveMode == 1)
  {
    isgState = 2;
    restartReady = 1;
    recuperationLvl = 10;
  }
  else
  {
    isgState = 3;
    restartReady = 1;
    recuperationLvl = clampRange((speed / 2) + ((gChargingState == 2) ? 20 : 0), 0, 100);
  }

  mIsg.IsgState = clampRange(isgState, 0, 7);
  mIsg.RestartReady = clampRange(restartReady, 0, 1);
  mIsg.RecuperationLvl = clampRange(recuperationLvl, 0, 100);
  output(mIsg);

  if (mIsg.IsgState != gLastState ||
      mIsg.RestartReady != gLastReady ||
      mIsg.RecuperationLvl != gLastRegen)
  {
    write("[ISG] state=%d ready=%d regen=%d soc=%d mode=%d",
          mIsg.IsgState,
          mIsg.RestartReady,
          mIsg.RecuperationLvl,
          gBatterySoc,
          gDriveMode);
    gLastState = mIsg.IsgState;
    gLastReady = mIsg.RestartReady;
    gLastRegen = mIsg.RecuperationLvl;
  }

  setTimer(tIsgCycle, 100);
}

on stopMeasurement
{
  cancelTimer(tIsgCycle);
}
