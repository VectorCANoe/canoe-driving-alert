includes
{
  #include "..\\common\\CAPL_COMMON.cin"
}

variables
{
  msTimer tCabinSensingCycle;
  int gRearSeatBelt;
  int gSeatBeltWarnLvl;
  int gCabinTemp;
  int gAirQualityIndex;
  int gLastOccupancyState;
  int gLastAirQualityState;
  int gLastCabinAlertState;
  int gLastPresenceScore;
}

on start
{
  gRearSeatBelt = 0;
  gSeatBeltWarnLvl = 0;
  gCabinTemp = 24;
  gAirQualityIndex = 90;
  gLastOccupancyState = -1;
  gLastAirQualityState = -1;
  gLastCabinAlertState = -1;
  gLastPresenceScore = -1;
  setTimer(tCabinSensingCycle, 100);
  write("[CABIN_SENSING] start");
}

on timer tCabinSensingCycle
{
  message frmCabinSensingStateMsg mCabin;
  int occupancyState;
  int airQualityState;
  int cabinAlertState;
  int presenceScore;

  occupancyState = (gRearSeatBelt > 0) ? 2 : 1;
  airQualityState = 0;
  if (gAirQualityIndex < 70)
  {
    airQualityState = 2;
  }
  else if (gAirQualityIndex < 85)
  {
    airQualityState = 1;
  }

  cabinAlertState = 0;
  if (gSeatBeltWarnLvl >= 2 || airQualityState >= 2)
  {
    cabinAlertState = 2;
  }
  else if (gSeatBeltWarnLvl == 1 || airQualityState == 1)
  {
    cabinAlertState = 1;
  }

  presenceScore = 50 + (gRearSeatBelt * 10);
  if (gCabinTemp >= 30)
  {
    presenceScore = clampRange(presenceScore + 20, 0, 100);
  }

  mCabin.OccupancyState = clampRange(occupancyState, 0, 7);
  mCabin.AirQualityState = clampRange(airQualityState, 0, 7);
  mCabin.CabinAlertState = clampRange(cabinAlertState, 0, 3);
  mCabin.CabinPresenceScore = clampRange(presenceScore, 0, 100);
  output(mCabin);

  if (mCabin.OccupancyState != gLastOccupancyState ||
      mCabin.AirQualityState != gLastAirQualityState ||
      mCabin.CabinAlertState != gLastCabinAlertState ||
      mCabin.CabinPresenceScore != gLastPresenceScore)
  {
    write("[CABIN_SENSING] occ=%d aq=%d alert=%d score=%d belt=%d aqi=%d temp=%d",
          mCabin.OccupancyState,
          mCabin.AirQualityState,
          mCabin.CabinAlertState,
          mCabin.CabinPresenceScore,
          gRearSeatBelt,
          gAirQualityIndex,
          gCabinTemp);
    gLastOccupancyState = mCabin.OccupancyState;
    gLastAirQualityState = mCabin.AirQualityState;
    gLastCabinAlertState = mCabin.CabinAlertState;
    gLastPresenceScore = mCabin.CabinPresenceScore;
  }

  setTimer(tCabinSensingCycle, 100);
}

on message frmSeatBeltStateMsg
{
  gRearSeatBelt = clampRange((int)this.RearSeatBelt, 0, 3);
  gSeatBeltWarnLvl = clampRange((int)this.SeatBeltWarnLvl, 0, 3);
}

on message frmCabinAirStateMsg
{
  gCabinTemp = clampRange((int)this.CabinTemp, 0, 100);
  gAirQualityIndex = clampRange((int)this.AirQualityIndex, 0, 255);
}

on stopMeasurement
{
  cancelTimer(tCabinSensingCycle);
}
