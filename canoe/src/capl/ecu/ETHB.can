includes
{
  #include "..\\common\\CAPL_COMMON.cin"
}

variables
{
  msTimer tEthBackboneCycle;
  long gEthSocket;
  char gEthRxBuffer[64];
  int gIboxRouteState;
  int gIboxSignalBars;
  int gIboxServiceFlags;
  int gSecuritySession;
  int gAuthState;
  int gSecurityFault;
  int gNavSessionState;
  int gNavRouteClass;
  int gAlertLevel;
  int gWarningPathStatus;
  int gFailSafeMode;
  dword gNavRxMs;
  dword gNotifRxMs;
  dword gFailSafeRxMs;
  int gLastBackboneMode;
  int gLastRouteHealth;
  int gLastServiceHealth;
  int gLastSecurityLevel;
  int gLastActiveServices;
  int gLastFaultBitmap;
}

void publishBackboneState()
{
  int backboneMode;
  int roadZoneActive;
  int guidedRouteActive;
  int routeHealth;
  int serviceHealth;
  int securityLevel;
  int activeServices;
  int faultBitmap;
  int boundaryAlive;

  roadZoneActive = (ethIsRecentTick(gNavRxMs, 300) == 1 &&
                    (gNavSessionState > 0 || gNavRouteClass > 0)) ? 1 : 0;
  guidedRouteActive = (ethIsRecentTick(gNavRxMs, 300) == 1 && gNavRouteClass == 3) ? 1 : 0;
  boundaryAlive = (ethIsRecentTick(gFailSafeRxMs, 300) == 1) ? 1 : 0;

  gIboxRouteState = 0;
  if (roadZoneActive == 1)
  {
    gIboxRouteState = 1;
  }
  if (guidedRouteActive == 1)
  {
    gIboxRouteState = 2;
  }

  gIboxSignalBars = 1;
  if (boundaryAlive == 1)
  {
    gIboxSignalBars = 3;
  }
  if (boundaryAlive == 1 && gWarningPathStatus == 0)
  {
    gIboxSignalBars = 4;
  }

  gIboxServiceFlags = 0;
  if (roadZoneActive == 1)
  {
    gIboxServiceFlags = gIboxServiceFlags | 1;
  }
  if (ethIsRecentTick(gNotifRxMs, 300) == 1 && gAlertLevel > 0)
  {
    gIboxServiceFlags = gIboxServiceFlags | 2;
  }
  if (gFailSafeMode > 0)
  {
    gIboxServiceFlags = gIboxServiceFlags | 4;
  }

  gSecuritySession = 0;
  if (roadZoneActive == 1 || (ethIsRecentTick(gNotifRxMs, 300) == 1 && gAlertLevel > 0))
  {
    gSecuritySession = 1;
  }
  if (boundaryAlive == 1 && roadZoneActive == 1)
  {
    gSecuritySession = 2;
  }
  gAuthState = (gSecuritySession > 0) ? 1 : 0;
  if (gFailSafeMode == 0 && boundaryAlive == 1)
  {
    gAuthState = 2;
  }
  gSecurityFault = 0;
  if (gFailSafeMode > 0)
  {
    gSecurityFault = 2;
  }
  else if (gWarningPathStatus == 1)
  {
    gSecurityFault = 1;
  }

  routeHealth = clampRange(gIboxRouteState, 0, 3);

  serviceHealth = 0;
  if (gIboxSignalBars > 0 || (gIboxServiceFlags & 0x3) != 0)
  {
    serviceHealth = 1;
  }
  if (routeHealth >= 2 &&
      gIboxSignalBars >= 2 &&
      (gIboxServiceFlags & 0x3) != 0 &&
      gFailSafeMode == 0 &&
      gSecurityFault == 0)
  {
    serviceHealth = 2;
  }

  securityLevel = clampRange(gAuthState, 0, 3);
  if (gSecuritySession >= 4)
  {
    securityLevel = 3;
  }

  backboneMode = 1;
  if (gFailSafeMode > 0 || routeHealth <= 1)
  {
    backboneMode = 2;
  }
  if (securityLevel >= 2 && serviceHealth >= 2)
  {
    backboneMode = 3;
  }

  activeServices = 0;
  if (gIboxSignalBars > 0) { activeServices = activeServices + 1; }
  if (gSecuritySession > 0) { activeServices = activeServices + 1; }
  if (gIboxServiceFlags > 0) { activeServices = activeServices + 1; }

  faultBitmap = 0;
  if (gSecurityFault > 0) { faultBitmap = faultBitmap | 0x01; }
  if (gFailSafeMode > 0) { faultBitmap = faultBitmap | 0x04; }

  if (backboneMode != gLastBackboneMode ||
      routeHealth != gLastRouteHealth ||
      serviceHealth != gLastServiceHealth ||
      securityLevel != gLastSecurityLevel ||
      activeServices != gLastActiveServices ||
      faultBitmap != gLastFaultBitmap)
  {
    write("[ETHB] mode=%d route=%d service=%d sec=%d active=%d faults=0x%02X",
          backboneMode,
          routeHealth,
          serviceHealth,
          securityLevel,
          activeServices,
          faultBitmap);
    gLastBackboneMode = backboneMode;
    gLastRouteHealth = routeHealth;
    gLastServiceHealth = serviceHealth;
    gLastSecurityLevel = securityLevel;
    gLastActiveServices = activeServices;
    gLastFaultBitmap = faultBitmap;
  }
}

on start
{
  gEthSocket = ethOpenDefaultSocket();
  gIboxRouteState = 0;
  gIboxSignalBars = 0;
  gIboxServiceFlags = 0;
  gSecuritySession = 0;
  gAuthState = 0;
  gSecurityFault = 0;
  gNavSessionState = 0;
  gNavRouteClass = 0;
  gAlertLevel = 0;
  gWarningPathStatus = 2;
  gFailSafeMode = 0;
  gNavRxMs = 0;
  gNotifRxMs = 0;
  gFailSafeRxMs = 0;
  gLastBackboneMode = -1;
  gLastRouteHealth = -1;
  gLastServiceHealth = -1;
  gLastSecurityLevel = -1;
  gLastActiveServices = -1;
  gLastFaultBitmap = -1;
  if (gEthSocket != ethInvalidSocket())
  {
    ethStartReceiver(gEthSocket, gEthRxBuffer, elcount(gEthRxBuffer));
  }
  setTimer(tEthBackboneCycle, 100);
  write("[ETHB] start");
}

on timer tEthBackboneCycle
{
  publishBackboneState();
  setTimer(tEthBackboneCycle, 100);
}

on stopMeasurement
{
  cancelTimer(tEthBackboneCycle);
  ethCloseSocket(gEthSocket);
  gEthSocket = ethInvalidSocket();
}

on message frmNavModuleStateMsg
{
  gNavSessionState = clampRange((int)this.NavSessionState, 0, 3);
  gNavRouteClass = clampRange((int)this.NavRouteClass, 0, 3);
  gNavRxMs = getSimulationTimeMs();
}

on message frmClusterNotifMsg
{
  gAlertLevel = clampRange((int)this.ClusterNotifArg, 0, 7);
  gNotifRxMs = getSimulationTimeMs();
}

void OnUdpReceiveFrom(dword socket, long result, dword address, dword port, char buffer[], dword count)
{
  int payload0;

  if (socket != gEthSocket)
  {
    return;
  }
  if (result == 0 &&
      ethFrameMsgId(buffer, count) == ethMsgFailSafe() &&
      ethFramePayloadLen(count) >= 1)
  {
    payload0 = ethGetU8(buffer, 0);
    gWarningPathStatus = clampRange(payload0 & 0x3, 0, 2);
    gFailSafeMode = clampRange((payload0 >> 4) & 0x3, 0, 2);
    gFailSafeRxMs = getSimulationTimeMs();
  }

  ethArmReceive(gEthSocket, gEthRxBuffer, elcount(gEthRxBuffer));
}
