includes
{
  #include "..\\common\\CAPL_COMMON.cin"
}

variables
{
  msTimer tRoadPreviewCycle;
  int gCameraHealth;
  int gObjectDetected;
  int gLaneModelValid;
  int gConfidence;
  dword gFcamRxMs;
  int gLastFcamInputStale;
  int gLastHealth;
  int gLastLanePreview;
  int gLastZonePreview;
  int gLastSpeedLimit;
  int gLastConfidence;
}

void traceRpcInputHealth(int fcamInputStale)
{
  if (fcamInputStale != gLastFcamInputStale)
  {
    if (fcamInputStale == 1)
    {
      write("[RPC] fcam input stale");
    }
    else
    {
      write("[RPC] fcam input restored");
    }
    gLastFcamInputStale = fcamInputStale;
  }
}

void publishRoadPreviewState()
{
  message frmRoadPreviewCameraStateMsg mPreview;
  int fcamInputStale;
  int zonePreview;
  int speedLimit;
  int cameraHealth;
  int objectDetected;
  int laneModelValid;
  int confidence;
  int previewHealth;

  fcamInputStale = (ethIsRecentTick(gFcamRxMs, 300) == 1) ? 0 : 1;
  traceRpcInputHealth(fcamInputStale);

  zonePreview = clampRange((int)@Core::baseZoneContext, 0, 7);
  speedLimit = clampRange((int)@Core::speedLimitNorm, 0, 255);
  cameraHealth = gCameraHealth;
  objectDetected = gObjectDetected;
  laneModelValid = gLaneModelValid;
  confidence = gConfidence;
  if (fcamInputStale == 1)
  {
    cameraHealth = 0;
    objectDetected = 0;
    laneModelValid = 0;
    confidence = 0;
  }

  previewHealth = 0;
  if (cameraHealth >= 2 && confidence >= 60)
  {
    previewHealth = 2;
  }
  else if (cameraHealth >= 1 && confidence >= 30)
  {
    previewHealth = 1;
  }

  mPreview.PreviewHealth = clampRange(previewHealth, 0, 3);
  mPreview.LanePreviewValid = clampRange(laneModelValid, 0, 1);
  mPreview.ZonePreview = clampRange(zonePreview, 0, 7);
  mPreview.SpeedLimit = speedLimit;
  mPreview.PreviewConfidence = clampRange(confidence, 0, 100);
  output(mPreview);

  if (previewHealth != gLastHealth ||
      laneModelValid != gLastLanePreview ||
      zonePreview != gLastZonePreview ||
      speedLimit != gLastSpeedLimit ||
      confidence != gLastConfidence)
  {
    write("[RPC] health=%d lane=%d zone=%d speedLimit=%d conf=%d obj=%d",
          previewHealth,
          laneModelValid,
          zonePreview,
          speedLimit,
          confidence,
          objectDetected);
    gLastHealth = previewHealth;
    gLastLanePreview = laneModelValid;
    gLastZonePreview = zonePreview;
    gLastSpeedLimit = speedLimit;
    gLastConfidence = confidence;
  }
}

on start
{
  gCameraHealth = 0;
  gObjectDetected = 0;
  gLaneModelValid = 0;
  gConfidence = 0;
  gFcamRxMs = 0;
  gLastFcamInputStale = 0;
  gLastHealth = -1;
  gLastLanePreview = -1;
  gLastZonePreview = -1;
  gLastSpeedLimit = -1;
  gLastConfidence = -1;
  setTimer(tRoadPreviewCycle, 100);
  write("[RPC] start");
}

on timer tRoadPreviewCycle
{
  publishRoadPreviewState();
  setTimer(tRoadPreviewCycle, 100);
}

on message frmFcamStateMsg
{
  gCameraHealth = clampRange((int)this.CameraHealth, 0, 3);
  gObjectDetected = clampRange((int)this.ObjectDetected, 0, 1);
  gLaneModelValid = clampRange((int)this.LaneModelValid, 0, 1);
  gConfidence = clampRange((int)this.Confidence, 0, 100);
  gFcamRxMs = getSimulationTimeMs();
}

on stopMeasurement
{
  cancelTimer(tRoadPreviewCycle);
}
