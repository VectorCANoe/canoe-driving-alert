includes
{
  #include "..\\common\\CAPL_COMMON.cin"
}

variables
{
  msTimer tSrrRrCycle;
  int gLastDetected;
  int gLastRisk;
  int gLastMerge;
  int gLastTurn;
}

void publishSrrRrState()
{
  message frmSrrRrStateMsg mSrrRr;
  int mergeConflict;
  int riskClass;
  int turnLampState;
  int detected;
  int riskLevel;

  mergeConflict = (((int)@Core::mergeCutInFlag) == 1) ? 1 : 0;
  riskClass = clampRange((int)@Core::objectRiskClass, 0, 7);
  turnLampState = clampRange((int)@CoreState::turnLampState, 0, 3);

  detected = (mergeConflict == 1 && turnLampState == 2 && riskClass >= 2) ? 1 : 0;
  riskLevel = detected == 1 ? clampRange(35 + (riskClass * 10), 0, 100) : 0;

  mSrrRr.SideObjectDetected = detected;
  mSrrRr.SideRiskLevel = riskLevel;
  mSrrRr.MergeConflict = mergeConflict;
  mSrrRr.TurnLampState = turnLampState;
  output(mSrrRr);

  if (detected != gLastDetected ||
      riskLevel != gLastRisk ||
      mergeConflict != gLastMerge ||
      turnLampState != gLastTurn)
  {
    write("[SRR_RR] detected=%d risk=%d merge=%d turn=%d class=%d",
          detected,
          riskLevel,
          mergeConflict,
          turnLampState,
          riskClass);
    gLastDetected = detected;
    gLastRisk = riskLevel;
    gLastMerge = mergeConflict;
    gLastTurn = turnLampState;
  }
}

on start
{
  gLastDetected = -1;
  gLastRisk = -1;
  gLastMerge = -1;
  gLastTurn = -1;
  setTimer(tSrrRrCycle, 100);
  write("[SRR_RR] start");
}

on timer tSrrRrCycle
{
  publishSrrRrState();
  setTimer(tSrrRrCycle, 100);
}

on stopMeasurement
{
  cancelTimer(tSrrRrCycle);
}
