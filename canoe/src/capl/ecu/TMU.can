includes
{
  #include "..\\common\\CAPL_COMMON.cin"
}

variables
{
  msTimer tTmuCycle;
  int gConnType;
  int gConnState;
  int gSignalBars;
  int gIviCpuLoad;
  int gIviMemLoad;
  int gLastLinkState;
  int gLastServiceMode;
  int gLastRemoteClimateReq;
}

void publishTmuState()
{
  message frmTmuServiceStateMsg mTmu;
  int failSafeMode;
  int linkState;
  int serviceMode;
  int remoteClimateReq;

  failSafeMode = clampRange((int)@Core::failSafeMode, 0, 2);

  linkState = 0;
  if (gConnState > 0)
  {
    linkState = 1;
    if (gSignalBars >= 3)
    {
      linkState = 2;
    }
  }

  serviceMode = 0;
  if (linkState > 0)
  {
    serviceMode = 1;
  }
  if (failSafeMode > 0)
  {
    serviceMode = 2;
  }

  if (gIviCpuLoad >= 85 || gIviMemLoad >= 85)
  {
    serviceMode = 2;
  }
  else if (gIviCpuLoad >= 60 || gIviMemLoad >= 60)
  {
    if (serviceMode == 0)
    {
      serviceMode = 1;
    }
  }

  remoteClimateReq = 0;
  if (serviceMode == 1 &&
      gConnType == 1 &&
      gSignalBars >= 3 &&
      gIviCpuLoad < 60 &&
      gIviMemLoad < 60)
  {
    remoteClimateReq = 1;
  }

  mTmu.TmuLinkState = linkState;
  mTmu.TmuServiceMode = serviceMode;
  mTmu.RemoteClimateReq = remoteClimateReq;
  mTmu.SignalBars = clampRange(gSignalBars, 0, 15);
  output(mTmu);

  if (linkState != gLastLinkState ||
      serviceMode != gLastServiceMode ||
      remoteClimateReq != gLastRemoteClimateReq)
  {
    gLastLinkState = linkState;
    gLastServiceMode = serviceMode;
    gLastRemoteClimateReq = remoteClimateReq;
  }
}

on start
{
  gConnType = 0;
  gConnState = 0;
  gSignalBars = 0;
  gIviCpuLoad = 0;
  gIviMemLoad = 0;
  gLastLinkState = -1;
  gLastServiceMode = -1;
  gLastRemoteClimateReq = -1;

  setTimer(tTmuCycle, 100);
  write("[TMU] start");
}

on timer tTmuCycle
{

  publishTmuState();
  setTimer(tTmuCycle, 100);
}

on message frmConnectivityStateMsg
{
  gConnType = clampRange((int)this.ConnectivityType, 0, 7);
  gConnState = clampRange((int)this.ConnectivityState, 0, 7);
  gSignalBars = clampRange((int)this.SignalBars, 0, 15);
}

on message frmIviHealthDetailMsg
{
  gIviCpuLoad = clampRange((int)this.IviCpuLoad, 0, 100);
  gIviMemLoad = clampRange((int)this.IviMemLoad, 0, 100);
}

on stopMeasurement
{
  cancelTimer(tTmuCycle);
}
