includes
{
  #include "..\\common\\CAPL_COMMON.cin"
}

variables
{
  msTimer tEwpCycle;
  int gThermalMode;
  int gFanDuty;
  int gCoolantTarget;
  int gCoolantTemp;
  int gLastState;
  int gLastDuty;
  int gLastFlow;
}

on start
{
  gThermalMode = 0;
  gFanDuty = 0;
  gCoolantTarget = 90;
  gCoolantTemp = 20;
  gLastState = -1;
  gLastDuty = -1;
  gLastFlow = -1;
  setTimer(tEwpCycle, 100);
  write("[EWP] start");
}

on message frmThermalMgmtStateMsg
{
  gThermalMode = clampRange((int)this.ThermalMode, 0, 7);
  gFanDuty = clampRange((int)this.FanDuty, 0, 31);
  gCoolantTarget = clampRange((int)this.CoolantTarget, 0, 255);
}

on message frmEngineSpeedTempMsg
{
  gCoolantTemp = clampRange((int)this.CoolantTemp, 0, 255);
}

on timer tEwpCycle
{
  message frmEwpStateMsg mEwp;
  int ewpState;
  int pumpDuty;
  int coolantFlow;
  int thermalGap;

  thermalGap = gCoolantTemp - gCoolantTarget;

  if (gThermalMode > 0 || gCoolantTemp > 70)
  {
    ewpState = (thermalGap > 5) ? 2 : 1;
    pumpDuty = clampRange((gFanDuty * 3) + ((thermalGap > 0) ? thermalGap : 0), 0, 100);
  }
  else
  {
    ewpState = 0;
    pumpDuty = 0;
  }

  coolantFlow = (ewpState == 0) ? 0 : clampRange((pumpDuty * 2) + (gThermalMode * 10), 0, 255);

  mEwp.EwpState = clampRange(ewpState, 0, 7);
  mEwp.PumpDuty = pumpDuty;
  mEwp.CoolantFlow = coolantFlow;
  output(mEwp);

  if (mEwp.EwpState != gLastState ||
      mEwp.PumpDuty != gLastDuty ||
      mEwp.CoolantFlow != gLastFlow)
  {
    write("[EWP] state=%d duty=%d flow=%d coolant=%d target=%d",
          mEwp.EwpState,
          mEwp.PumpDuty,
          mEwp.CoolantFlow,
          gCoolantTemp,
          gCoolantTarget);
    gLastState = mEwp.EwpState;
    gLastDuty = mEwp.PumpDuty;
    gLastFlow = mEwp.CoolantFlow;
  }

  setTimer(tEwpCycle, 100);
}

on stopMeasurement
{
  cancelTimer(tEwpCycle);
}
