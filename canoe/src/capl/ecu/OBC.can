includes
{
  #include "..\\common\\CAPL_COMMON.cin"
}

variables
{
  msTimer tObcCycle;
  int gBatterySoc;
  int gChargingState;
  int gLastState;
  int gLastPlug;
  int gLastPower;
}

on start
{
  gBatterySoc = 95;
  gChargingState = 0;
  gLastState = -1;
  gLastPlug = -1;
  gLastPower = -1;
  setTimer(tObcCycle, 100);
  write("[OBC] start");
}

on message frmFuelBatteryStateMsg
{
  gBatterySoc = clampRange((int)this.BatterySoc, 0, 100);
  gChargingState = clampRange((int)this.ChargingState, 0, 3);
}

on timer tObcCycle
{
  message frmObcStateMsg mObc;
  int driveState;
  int obcState;
  int acPlugState;
  int chargePowerKw;

  driveState = clampRange((int)@Core::driveStateNorm, 0, 3);
  acPlugState = (driveState == 0) ? 1 : 0;

  if (gChargingState == 1 && acPlugState == 1)
  {
    obcState = 2;
    chargePowerKw = clampRange((100 - gBatterySoc) / 2, 0, 22);
  }
  else if (acPlugState == 1)
  {
    obcState = 1;
    chargePowerKw = 0;
  }
  else
  {
    obcState = 0;
    chargePowerKw = 0;
  }

  mObc.ObcState = clampRange(obcState, 0, 7);
  mObc.AcPlugState = clampRange(acPlugState, 0, 1);
  mObc.ChargePowerKw = clampRange(chargePowerKw, 0, 255);
  output(mObc);

  if (mObc.ObcState != gLastState ||
      mObc.AcPlugState != gLastPlug ||
      mObc.ChargePowerKw != gLastPower)
  {
    write("[OBC] state=%d plug=%d power=%d soc=%d",
          mObc.ObcState,
          mObc.AcPlugState,
          mObc.ChargePowerKw,
          gBatterySoc);
    gLastState = mObc.ObcState;
    gLastPlug = mObc.AcPlugState;
    gLastPower = mObc.ChargePowerKw;
  }

  setTimer(tObcCycle, 100);
}

on stopMeasurement
{
  cancelTimer(tObcCycle);
}
