includes
{
  #include "..\\common\\CAPL_COMMON.cin"
}

variables
{
  msTimer tSpasCycle;
  int gLastActive;
  int gLastStage;
  int gLastAssistReq;
  int gLastSpeed;
}

void publishSpasState()
{
  message frmSpasStateMsg mSpas;
  int vehicleSpeed;
  int steeringInput;
  int active;
  int stage;
  int assistReq;

  vehicleSpeed = clampRange((int)@Core::vehicleSpeedNorm, 0, 255);
  steeringInput = clampRange((int)@Core::steeringInputNorm, 0, 1);

  active = 0;
  stage = 0;
  assistReq = 0;

  if (vehicleSpeed <= 15)
  {
    active = 1;
    stage = 1;
  }
  if (vehicleSpeed <= 8 && steeringInput == 1)
  {
    active = 1;
    stage = 2;
    assistReq = 1;
  }

  mSpas.SpasActive = active;
  mSpas.SpasStage = stage;
  mSpas.SteeringAssistReq = assistReq;
  mSpas.VehicleSpeed = vehicleSpeed;
  output(mSpas);

  if (active != gLastActive ||
      stage != gLastStage ||
      assistReq != gLastAssistReq ||
      vehicleSpeed != gLastSpeed)
  {
    write("[SPAS] active=%d stage=%d assist=%d speed=%d steerIn=%d",
          active,
          stage,
          assistReq,
          vehicleSpeed,
          steeringInput);
    gLastActive = active;
    gLastStage = stage;
    gLastAssistReq = assistReq;
    gLastSpeed = vehicleSpeed;
  }
}

on start
{
  gLastActive = -1;
  gLastStage = -1;
  gLastAssistReq = -1;
  gLastSpeed = -1;
  setTimer(tSpasCycle, 100);
  write("[SPAS] start");
}

on timer tSpasCycle
{
  publishSpasState();
  setTimer(tSpasCycle, 100);
}

on stopMeasurement
{
  cancelTimer(tSpasCycle);
}
