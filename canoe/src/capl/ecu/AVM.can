includes
{
  #include "..\\common\\CAPL_COMMON.cin"
}

variables
{
  msTimer tAvmCycle;
  int gLastActive;
  int gLastViewMode;
  int gLastOverlay;
  int gLastSpeed;
}

void publishAvmState()
{
  message frmAvmStateMsg mAvm;
  int vehicleSpeed;
  int steeringInput;
  int brakePedal;
  int active;
  int viewMode;
  int overlay;

  vehicleSpeed = clampRange((int)@Core::vehicleSpeedNorm, 0, 255);
  steeringInput = clampRange((int)@Core::steeringInputNorm, 0, 1);
  brakePedal = clampRange((int)@Core::brakePedalNorm, 0, 1);

  active = (vehicleSpeed <= 20) ? 1 : 0;
  viewMode = 0;
  overlay = 0;

  if (active == 1)
  {
    if (vehicleSpeed <= 5 && brakePedal == 1)
    {
      viewMode = 3;
    }
    else if (steeringInput == 1)
    {
      viewMode = 1;
    }
    else
    {
      viewMode = 2;
    }
    overlay = (steeringInput == 1) ? 1 : 0;
  }

  mAvm.AvmActive = active;
  mAvm.ViewMode = clampRange(viewMode, 0, 7);
  mAvm.SteeringOverlay = overlay;
  mAvm.VehicleSpeed = vehicleSpeed;
  output(mAvm);

  if (active != gLastActive ||
      viewMode != gLastViewMode ||
      overlay != gLastOverlay ||
      vehicleSpeed != gLastSpeed)
  {
    write("[AVM] active=%d view=%d overlay=%d speed=%d brake=%d steerIn=%d",
          active,
          viewMode,
          overlay,
          vehicleSpeed,
          brakePedal,
          steeringInput);
    gLastActive = active;
    gLastViewMode = viewMode;
    gLastOverlay = overlay;
    gLastSpeed = vehicleSpeed;
  }
}

on start
{
  gLastActive = -1;
  gLastViewMode = -1;
  gLastOverlay = -1;
  gLastSpeed = -1;
  setTimer(tAvmCycle, 100);
  write("[AVM] start");
}

on timer tAvmCycle
{
  publishAvmState();
  setTimer(tAvmCycle, 100);
}

on stopMeasurement
{
  cancelTimer(tAvmCycle);
}
