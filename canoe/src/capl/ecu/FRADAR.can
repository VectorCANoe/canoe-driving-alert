includes
{
  #include "..\\common\\CAPL_COMMON.cin"
}

variables
{
  msTimer tFradarCycle;
  int gLastHealth;
  int gLastDetected;
  int gLastDistanceBucket;
  int gLastRelSpeedBucket;
}

void publishFradarState()
{
  message frmFradarStateMsg mFradar;
  int trackValid;
  int confidence;
  int rangeM;
  int relSpeed;
  int health;
  int detected;
  int distanceBucket;
  int relSpeedBucket;

  trackValid = clampRange((int)@Core::objectTrackValid, 0, 1);
  confidence = clampRange((int)@Core::objectConfidence, 0, 100);
  rangeM = clampRange((int)@Core::objectRange, 0, 500);
  relSpeed = clampRange((int)@Core::objectRelSpeed, -200, 200);

  detected = trackValid;
  if (confidence >= 70)
  {
    health = 2;
  }
  else if (confidence >= 30)
  {
    health = 1;
  }
  else
  {
    health = 0;
  }

  distanceBucket = clampRange(rangeM, 0, 255);
  relSpeedBucket = clampRange(relSpeed + 128, 0, 255);

  mFradar.RadarHealth = clampRange(health, 0, 3);
  mFradar.ObjectDetected = detected;
  mFradar.DistanceBucket = distanceBucket;
  mFradar.RelSpeedBucket = relSpeedBucket;
  output(mFradar);

  if (health != gLastHealth ||
      detected != gLastDetected ||
      distanceBucket != gLastDistanceBucket ||
      relSpeedBucket != gLastRelSpeedBucket)
  {
    write("[FRADAR] health=%d detected=%d range=%d rel=%d conf=%d",
          health,
          detected,
          rangeM,
          relSpeed,
          confidence);
    gLastHealth = health;
    gLastDetected = detected;
    gLastDistanceBucket = distanceBucket;
    gLastRelSpeedBucket = relSpeedBucket;
  }
}

on start
{
  gLastHealth = -1;
  gLastDetected = -1;
  gLastDistanceBucket = -1;
  gLastRelSpeedBucket = -1;
  setTimer(tFradarCycle, 100);
  write("[FRADAR] start");
}

on timer tFradarCycle
{
  publishFradarState();
  setTimer(tFradarCycle, 100);
}

on stopMeasurement
{
  cancelTimer(tFradarCycle);
}
