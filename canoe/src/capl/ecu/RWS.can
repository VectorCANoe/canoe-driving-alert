includes
{
  #include "..\\common\\CAPL_COMMON.cin"
}

variables
{
  msTimer tRwsCycle;
  int gVehicleSpeed;
  int gSteeringTorque;
  int gLastMode;
  int gLastState;
  int gLastAngle;
}

on start
{
  gVehicleSpeed = 0;
  gSteeringTorque = 0;
  gLastMode = -1;
  gLastState = -1;
  gLastAngle = -1;
  setTimer(tRwsCycle, 100);
  write("[RWS] start");
}

on message frmVehicleStateCanMsg
{
  gVehicleSpeed = clampRange((int)this.gVehicleSpeed, 0, 255);
}

on message frmSteeringTorqueMsg
{
  gSteeringTorque = clampRange((int)this.SteeringTorque, 0, 4095);
}

on timer tRwsCycle
{
  message frmRwsStateMsg mRws;
  int rwsMode;
  int rwsState;
  int rearSteerAngle;

  rwsMode = (gVehicleSpeed < 60) ? 1 : 2;
  rwsState = (gSteeringTorque > 5) ? 1 : 0;
  rearSteerAngle = clampRange(gSteeringTorque / 4, 0, 255);
  if (rwsMode == 2)
  {
    rearSteerAngle = clampRange(rearSteerAngle / 2, 0, 255);
  }

  mRws.RwsMode = clampRange(rwsMode, 0, 7);
  mRws.RwsState = clampRange(rwsState, 0, 3);
  mRws.RearSteerAngle = clampRange(rearSteerAngle, 0, 255);
  output(mRws);

  if (mRws.RwsMode != gLastMode ||
      mRws.RwsState != gLastState ||
      mRws.RearSteerAngle != gLastAngle)
  {
    write("[RWS] mode=%d state=%d angle=%d speed=%d",
          mRws.RwsMode,
          mRws.RwsState,
          mRws.RearSteerAngle,
          gVehicleSpeed);
    gLastMode = mRws.RwsMode;
    gLastState = mRws.RwsState;
    gLastAngle = mRws.RearSteerAngle;
  }

  setTimer(tRwsCycle, 100);
}

on stopMeasurement
{
  cancelTimer(tRwsCycle);
}
