includes
{
  #include "..\\common\\CAPL_COMMON.cin"
}

variables
{
  msTimer tSmkCycle;
  int gImmobilizerState;
  int gKeyAuthState;
  int gLastImmobilizerState;
  int gLastKeyAuthState;
}

void publishSmkState()
{
  message frmImmobilizerStateMsg mImmobilizer;

  mImmobilizer.ImmobilizerState = clampRange(gImmobilizerState, 0, 3);
  mImmobilizer.KeyAuthState = clampRange(gKeyAuthState, 0, 3);
  output(mImmobilizer);

  if (mImmobilizer.ImmobilizerState != gLastImmobilizerState ||
      mImmobilizer.KeyAuthState != gLastKeyAuthState)
  {
    write("[SMK] immo=%d auth=%d", mImmobilizer.ImmobilizerState, mImmobilizer.KeyAuthState);
    gLastImmobilizerState = mImmobilizer.ImmobilizerState;
    gLastKeyAuthState = mImmobilizer.KeyAuthState;
  }
}

on start
{
  gImmobilizerState = 1;
  gKeyAuthState = 1;
  gLastImmobilizerState = -1;
  gLastKeyAuthState = -1;
  setTimer(tSmkCycle, 100);
  write("[SMK] start");
}

on timer tSmkCycle
{
  publishSmkState();
  setTimer(tSmkCycle, 100);
}

on stopMeasurement
{
  cancelTimer(tSmkCycle);
}
