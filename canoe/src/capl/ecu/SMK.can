includes
{
  #include "..\\common\\CAPL_COMMON.cin"
}

variables
{
  int gDiagPending;
  int gLastDiagSid;
  int gLastDiagDidHigh;
  int gLastDiagDidLow;
  msTimer tSmkCycle;
  int gImmobilizerState;
  int gKeyAuthState;
  int gLastImmobilizerState;
  int gLastKeyAuthState;
}

void publishSmkState()
{
  message frmImmobilizerStateMsg mImmobilizer;

  mImmobilizer.ImmobilizerState = clampRange(gImmobilizerState, 0, 3);
  mImmobilizer.KeyAuthState = clampRange(gKeyAuthState, 0, 3);
  output(mImmobilizer);

  if (mImmobilizer.ImmobilizerState != gLastImmobilizerState ||
      mImmobilizer.KeyAuthState != gLastKeyAuthState)
  {
    write("[SMK] immo=%d auth=%d", mImmobilizer.ImmobilizerState, mImmobilizer.KeyAuthState);
    gLastImmobilizerState = mImmobilizer.ImmobilizerState;
    gLastKeyAuthState = mImmobilizer.KeyAuthState;
  }
}

on start
{
  gDiagPending = 0;
  gLastDiagSid = 0;
  gLastDiagDidHigh = 0;
  gLastDiagDidLow = 0;
  gImmobilizerState = 1;
  gKeyAuthState = 1;
  gLastImmobilizerState = -1;
  gLastKeyAuthState = -1;
  setTimer(tSmkCycle, 100);
  write("[SMK] start");
}

on timer tSmkCycle
{
  if (gDiagPending == 1)
  {
    message frmSmkDiagResMsg mDiagRes;

    mDiagRes.SmkDiagRespCode = getBasicDiagRespCode(gLastDiagSid);
    mDiagRes.SmkDiagData0 = gLastDiagDidHigh;
    mDiagRes.SmkDiagData1 = gLastDiagDidLow;
    output(mDiagRes);
    gDiagPending = 0;
  }

  if ((int)@Core::timeoutClear == 1)
  {
    gKeyAuthState = 0;
  }
  else
  {
    gKeyAuthState = 1;
  }
  publishSmkState();
  setTimer(tSmkCycle, 100);
}

on message frmSmkDiagReqMsg
{
  gLastDiagSid = clampRange((int)this.SmkDiagServiceId, 0, 255);
  gLastDiagDidHigh = clampRange((int)this.SmkDiagDidHigh, 0, 255);
  gLastDiagDidLow = clampRange((int)this.SmkDiagDidLow, 0, 255);
  gDiagPending = 1;
}

on stopMeasurement
{
  cancelTimer(tSmkCycle);
}
