includes
{
  #include "..\\common\\CAPL_COMMON.cin"
}

variables
{
  msTimer tRspaCycle;
  int gLastReady;
  int gLastDirection;
  int gLastBrakeHoldReq;
  int gLastSpeed;
}

void publishRspaState()
{
  message frmRspaStateMsg mRspa;
  int vehicleSpeed;
  int driveState;
  int turnLampState;
  int ready;
  int direction;
  int brakeHoldReq;

  vehicleSpeed = clampRange((int)@Core::vehicleSpeedNorm, 0, 255);
  driveState = clampRange((int)@Core::driveStateNorm, 0, 3);
  turnLampState = clampRange((int)@CoreState::turnLampState, 0, 3);

  ready = 0;
  direction = 0;
  brakeHoldReq = 0;

  if (vehicleSpeed <= 5 && driveState >= 2)
  {
    ready = 1;
  }
  if (ready == 1)
  {
    direction = turnLampState;
  }
  if (vehicleSpeed <= 2 && ready == 1)
  {
    brakeHoldReq = 1;
  }

  mRspa.RspaReady = ready;
  mRspa.RspaDirection = clampRange(direction, 0, 3);
  mRspa.BrakeHoldReq = brakeHoldReq;
  mRspa.VehicleSpeed = vehicleSpeed;
  output(mRspa);

  if (ready != gLastReady ||
      direction != gLastDirection ||
      brakeHoldReq != gLastBrakeHoldReq ||
      vehicleSpeed != gLastSpeed)
  {
    write("[RSPA] ready=%d dir=%d hold=%d speed=%d drive=%d",
          ready,
          direction,
          brakeHoldReq,
          vehicleSpeed,
          driveState);
    gLastReady = ready;
    gLastDirection = direction;
    gLastBrakeHoldReq = brakeHoldReq;
    gLastSpeed = vehicleSpeed;
  }
}

on start
{
  gLastReady = -1;
  gLastDirection = -1;
  gLastBrakeHoldReq = -1;
  gLastSpeed = -1;
  setTimer(tRspaCycle, 100);
  write("[RSPA] start");
}

on timer tRspaCycle
{
  publishRspaState();
  setTimer(tRspaCycle, 100);
}

on stopMeasurement
{
  cancelTimer(tRspaCycle);
}
