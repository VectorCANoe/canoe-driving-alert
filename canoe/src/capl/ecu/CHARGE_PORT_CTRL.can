includes
{
  #include "..\\common\\CAPL_COMMON.cin"
}

variables
{
  msTimer tChargePortCycle;
  int gObcState;
  int gAcPlugState;
  int gBmsState;
  int gPackSoc;
  int gPackTemp;
  int gLastPortLockState;
  int gLastPlugState;
  int gLastChargeEnable;
  int gLastThermalState;
  int gLastChargeTargetSoc;
}

void publishChargePortState()
{
  message frmChargePortCtrlStateMsg mPort;
  int driveState;
  int portLockState;
  int plugState;
  int chargeEnable;
  int thermalState;
  int chargeTargetSoc;

  driveState = clampRange((int)@Core::driveStateNorm, 0, 3);
  plugState = clampRange(gAcPlugState, 0, 1);
  chargeEnable = (gObcState == 2 && gBmsState <= 2 && driveState == 0) ? 1 : 0;

  if (plugState == 0)
  {
    portLockState = 0;
  }
  else if (chargeEnable == 1)
  {
    portLockState = 2;
  }
  else
  {
    portLockState = 1;
  }

  if (gPackTemp >= 45)
  {
    thermalState = 2;
  }
  else if (gPackTemp >= 35)
  {
    thermalState = 1;
  }
  else
  {
    thermalState = 0;
  }

  chargeTargetSoc = 100;
  if (thermalState == 2)
  {
    chargeTargetSoc = 80;
  }
  else if (gPackSoc >= 90)
  {
    chargeTargetSoc = 90;
  }
  if (gBmsState >= 3)
  {
    chargeTargetSoc = 70;
  }

  mPort.PortLockState = clampRange(portLockState, 0, 3);
  mPort.PlugState = plugState;
  mPort.ChargeEnable = chargeEnable;
  mPort.ThermalState = clampRange(thermalState, 0, 3);
  mPort.ChargeTargetSoc = clampRange(chargeTargetSoc, 0, 100);
  output(mPort);

  if (portLockState != gLastPortLockState ||
      plugState != gLastPlugState ||
      chargeEnable != gLastChargeEnable ||
      thermalState != gLastThermalState ||
      chargeTargetSoc != gLastChargeTargetSoc)
  {
    write("[CHARGE_PORT_CTRL] lock=%d plug=%d enable=%d thermal=%d targetSoc=%d soc=%d temp=%d obc=%d",
          portLockState,
          plugState,
          chargeEnable,
          thermalState,
          chargeTargetSoc,
          gPackSoc,
          gPackTemp,
          gObcState);
    gLastPortLockState = portLockState;
    gLastPlugState = plugState;
    gLastChargeEnable = chargeEnable;
    gLastThermalState = thermalState;
    gLastChargeTargetSoc = chargeTargetSoc;
  }
}

on start
{
  gObcState = 0;
  gAcPlugState = 0;
  gBmsState = 0;
  gPackSoc = 95;
  gPackTemp = 28;
  gLastPortLockState = -1;
  gLastPlugState = -1;
  gLastChargeEnable = -1;
  gLastThermalState = -1;
  gLastChargeTargetSoc = -1;
  setTimer(tChargePortCycle, 100);
  write("[CHARGE_PORT_CTRL] start");
}

on timer tChargePortCycle
{
  publishChargePortState();
  setTimer(tChargePortCycle, 100);
}

on message frmObcStateMsg
{
  gObcState = clampRange((int)this.ObcState, 0, 7);
  gAcPlugState = clampRange((int)this.AcPlugState, 0, 1);
}

on message frmBatBmsStateMsg
{
  gBmsState = clampRange((int)this.BmsState, 0, 7);
  gPackSoc = clampRange((int)this.PackSoc, 0, 100);
  gPackTemp = clampRange((int)this.PackTemp, 0, 255);
}

on stopMeasurement
{
  cancelTimer(tChargePortCycle);
}