includes
{
  #include "..\\common\\CAPL_COMMON.cin"
}

variables
{
  msTimer tSasCycle;
  int gSteeringInput;
  int gVehicleSpeed;
  int gLastAngle;
}

void publishSasState()
{
  message frmSteeringAngleMsg mSas;
  int steeringAngleRaw;

  steeringAngleRaw = gSteeringInput * 30;
  if (gVehicleSpeed > 90)
  {
    steeringAngleRaw = steeringAngleRaw * 2;
  }

  mSas.SteeringAngleRaw = clampRange(steeringAngleRaw, 0, 65535);
  output(mSas);

  if (mSas.SteeringAngleRaw != gLastAngle)
  {
    write("[SAS] angleRaw=%d input=%d speed=%d",
          mSas.SteeringAngleRaw,
          gSteeringInput,
          gVehicleSpeed);
    gLastAngle = mSas.SteeringAngleRaw;
  }
}

on start
{
  gSteeringInput = 0;
  gVehicleSpeed = 0;
  gLastAngle = -1;
  setTimer(tSasCycle, 100);
  write("[SAS] start");
}

on timer tSasCycle
{
  publishSasState();
  setTimer(tSasCycle, 100);
}

on message frmSteeringCanMsg
{
  gSteeringInput = clampRange((int)this.SteeringInput, 0, 1);
}

on message frmVehicleStateCanMsg
{
  gVehicleSpeed = clampRange((int)this.gVehicleSpeed, 0, 255);
}

on stopMeasurement
{
  cancelTimer(tSasCycle);
}
