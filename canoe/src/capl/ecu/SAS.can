includes
{
  #include "..\\common\\CAPL_COMMON.cin"
}

variables
{
  msTimer tSasCycle;
  int gSteeringInput;
  int gVehicleSpeed;
  dword gSteeringRxMs;
  dword gVehicleStateRxMs;
  int gLastSteeringInputStale;
  int gLastVehicleInputStale;
  int gLastAngle;
}

void traceSasInputHealth(int steeringInputStale, int vehicleInputStale)
{
  if (steeringInputStale != gLastSteeringInputStale)
  {
    write("[SAS] steering input %s", steeringInputStale == 1 ? "stale" : "restored");
    gLastSteeringInputStale = steeringInputStale;
  }

  if (vehicleInputStale != gLastVehicleInputStale)
  {
    write("[SAS] vehicle-state input %s", vehicleInputStale == 1 ? "stale" : "restored");
    gLastVehicleInputStale = vehicleInputStale;
  }
}

void publishSasState()
{
  message frmSteeringAngleMsg mSas;
  int steeringInputStale;
  int vehicleInputStale;
  int steeringInput;
  int vehicleSpeed;
  int steeringAngleRaw;

  steeringInputStale = (ethIsRecentTick(gSteeringRxMs, 300) == 1) ? 0 : 1;
  vehicleInputStale = (ethIsRecentTick(gVehicleStateRxMs, 300) == 1) ? 0 : 1;
  traceSasInputHealth(steeringInputStale, vehicleInputStale);

  steeringInput = gSteeringInput;
  vehicleSpeed = gVehicleSpeed;
  if (steeringInputStale == 1)
  {
    steeringInput = 0;
  }
  if (vehicleInputStale == 1)
  {
    vehicleSpeed = 0;
  }

  steeringAngleRaw = steeringInput * 30;
  if (vehicleSpeed > 90)
  {
    steeringAngleRaw = steeringAngleRaw * 2;
  }

  mSas.SteeringAngleRaw = clampRange(steeringAngleRaw, 0, 65535);
  output(mSas);

  if (mSas.SteeringAngleRaw != gLastAngle)
  {
    write("[SAS] angleRaw=%d input=%d speed=%d",
          mSas.SteeringAngleRaw,
          steeringInput,
          vehicleSpeed);
    gLastAngle = mSas.SteeringAngleRaw;
  }
}

on start
{
  gSteeringInput = 0;
  gVehicleSpeed = 0;
  gSteeringRxMs = 0;
  gVehicleStateRxMs = 0;
  gLastSteeringInputStale = 0;
  gLastVehicleInputStale = 0;
  gLastAngle = -1;
  setTimer(tSasCycle, 100);
  write("[SAS] start");
}

on timer tSasCycle
{

  publishSasState();
  setTimer(tSasCycle, 100);
}

on message frmSteeringCanMsg
{
  gSteeringInput = clampRange((int)this.SteeringInput, 0, 1);
  gSteeringRxMs = getSimulationTimeMs();
}

on message frmVehicleStateCanMsg
{
  gVehicleSpeed = clampRange((int)this.gVehicleSpeed, 0, 255);
  gVehicleStateRxMs = getSimulationTimeMs();
}

on stopMeasurement
{
  cancelTimer(tSasCycle);
}
