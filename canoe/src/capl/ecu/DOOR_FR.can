includes
{
  #include "..\\common\\CAPL_COMMON.cin"
}

variables
{
  msTimer tDoorFrCycle;
  int gLastLockState;
  int gLastOpenState;
  int gLastWindowPos;
}

on start
{
  gLastLockState = -1;
  gLastOpenState = -1;
  gLastWindowPos = -1;
  setTimer(tDoorFrCycle, 100);
  write("[DOOR_FR] start");
}

on timer tDoorFrCycle
{
  message frmDoorFrStateMsg mDoor;
  int lockState;
  int openState;
  int windowPos;

  lockState = 1;
  openState = 0;
  windowPos = 0;
  if ((int)@Core::timeoutClear == 1)
  {
    lockState = 0;
    openState = 1;
    windowPos = 10;
  }

  mDoor.DoorFrLockState = clampRange(lockState, 0, 3);
  mDoor.DoorFrOpenState = clampRange(openState, 0, 1);
  mDoor.DoorFrWindowPos = clampRange(windowPos, 0, 100);
  output(mDoor);

  if (mDoor.DoorFrLockState != gLastLockState ||
      mDoor.DoorFrOpenState != gLastOpenState ||
      mDoor.DoorFrWindowPos != gLastWindowPos)
  {
    write("[DOOR_FR] lock=%d open=%d win=%d",
          mDoor.DoorFrLockState,
          mDoor.DoorFrOpenState,
          mDoor.DoorFrWindowPos);
    gLastLockState = mDoor.DoorFrLockState;
    gLastOpenState = mDoor.DoorFrOpenState;
    gLastWindowPos = mDoor.DoorFrWindowPos;
  }

  setTimer(tDoorFrCycle, 100);
}

on stopMeasurement
{
  cancelTimer(tDoorFrCycle);
}
