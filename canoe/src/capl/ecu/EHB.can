/*@!Encoding:949*/
includes
{
  #include "..\\common\\CAPL_COMMON.cin"
}

variables
{
  msTimer tEhbCycle;
  int gBrakePressure;
  int gLastCtrlState;
  int gLastPressureCmd;
}

on start
{
  gBrakePressure = 0;
  gLastCtrlState = -1;
  gLastPressureCmd = -1;
  setTimer(tEhbCycle, 100);
  write("[EHB] start");
}

on message frmBrakeStatusMsg
{
  gBrakePressure = clampRange((int)this.BrakePressure, 0, 255);
}

on timer tEhbCycle
{
  message frmEhbStateMsg mEhb;
  int ctrlState;

  ctrlState = (gBrakePressure > 0) ? 1 : 0;
  if ((int)@Core::decelAssistReq == 1)
  {
    ctrlState = 2;
  }

  mEhb.EhbCtrlState = clampRange(ctrlState, 0, 7);
  mEhb.EhbPressureCmd = gBrakePressure;
  output(mEhb);

  if (mEhb.EhbCtrlState != gLastCtrlState ||
      mEhb.EhbPressureCmd != gLastPressureCmd)
  {
    write("[EHB] state=%d pressure=%d", mEhb.EhbCtrlState, mEhb.EhbPressureCmd);
    gLastCtrlState = mEhb.EhbCtrlState;
    gLastPressureCmd = mEhb.EhbPressureCmd;
  }

  setTimer(tEhbCycle, 100);
}

on stopMeasurement
{
  cancelTimer(tEhbCycle);
}
