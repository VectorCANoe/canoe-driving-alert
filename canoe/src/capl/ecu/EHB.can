/*@!Encoding:949*/
includes
{
  #include "..\\common\\CAPL_COMMON.cin"
}

variables
{
  msTimer tEhbCycle;
  int gBrakePressure;
  dword gBrakeStatusRxMs;
  int gLastBrakeInputStale;
  int gLastCtrlState;
  int gLastPressureCmd;
}

void traceEhbInputHealth(int brakeInputStale)
{
  if (brakeInputStale != gLastBrakeInputStale)
  {
    if (brakeInputStale == 1)
    {
      write("[EHB] brake input stale");
    }
    else
    {
      write("[EHB] brake input restored");
    }
    gLastBrakeInputStale = brakeInputStale;
  }
}

on start
{
  gBrakePressure = 0;
  gBrakeStatusRxMs = 0;
  gLastBrakeInputStale = 0;
  gLastCtrlState = -1;
  gLastPressureCmd = -1;
  setTimer(tEhbCycle, 100);
  write("[EHB] start");
}

on message frmBrakeStatusMsg
{
  gBrakePressure = clampRange((int)this.BrakePressure, 0, 255);
  gBrakeStatusRxMs = getSimulationTimeMs();
}

on timer tEhbCycle
{
  message frmEhbStateMsg mEhb;
  int brakeInputStale;
  int brakePressure;
  int ctrlState;

  brakeInputStale = (ethIsRecentTick(gBrakeStatusRxMs, 300) == 1) ? 0 : 1;
  traceEhbInputHealth(brakeInputStale);

  brakePressure = gBrakePressure;
  if (brakeInputStale == 1)
  {
    brakePressure = 0;
  }

  ctrlState = (brakePressure > 0) ? 1 : 0;
  if ((int)@Core::decelAssistReq == 1)
  {
    ctrlState = 2;
  }

  mEhb.EhbCtrlState = clampRange(ctrlState, 0, 7);
  mEhb.EhbPressureCmd = brakePressure;
  output(mEhb);

  if (mEhb.EhbCtrlState != gLastCtrlState ||
      mEhb.EhbPressureCmd != gLastPressureCmd)
  {
    write("[EHB] state=%d pressure=%d", mEhb.EhbCtrlState, mEhb.EhbPressureCmd);
    gLastCtrlState = mEhb.EhbCtrlState;
    gLastPressureCmd = mEhb.EhbPressureCmd;
  }

  setTimer(tEhbCycle, 100);
}

on stopMeasurement
{
  cancelTimer(tEhbCycle);
}
