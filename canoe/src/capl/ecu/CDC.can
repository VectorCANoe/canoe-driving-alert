includes
{
  #include "..\\common\\CAPL_COMMON.cin"
}

variables
{
  msTimer tCdcCycle;
  int gDampingLevel;
  int gLastMode;
  int gLastValveCurrent;
}

on start
{
  gDampingLevel = 12;
  gLastMode = -1;
  gLastValveCurrent = -1;
  setTimer(tCdcCycle, 100);
  write("[CDC] start");
}

on message frmSuspensionStateMsg
{
  gDampingLevel = clampRange((int)this.DampingLevel, 0, 255);
}

on timer tCdcCycle
{
  message frmCdcStateMsg mCdc;
  int mode;
  int valveCurrent;

  mode = (gDampingLevel > 20) ? 2 : ((gDampingLevel > 0) ? 1 : 0);
  valveCurrent = clampRange(gDampingLevel * 4, 0, 255);

  mCdc.CdcMode = clampRange(mode, 0, 7);
  mCdc.CdcValveCurrent = valveCurrent;
  output(mCdc);

  if (mCdc.CdcMode != gLastMode ||
      mCdc.CdcValveCurrent != gLastValveCurrent)
  {
    write("[CDC] mode=%d current=%d", mCdc.CdcMode, mCdc.CdcValveCurrent);
    gLastMode = mCdc.CdcMode;
    gLastValveCurrent = mCdc.CdcValveCurrent;
  }

  setTimer(tCdcCycle, 100);
}

on stopMeasurement
{
  cancelTimer(tCdcCycle);
}
