includes
{
  #include "..\\common\\CAPL_COMMON.cin"
}

variables
{
  msTimer tAirSuspensionCycle;
  int gSuspensionMode;
  int gSuspensionLevel;
  int gDampingLevel;
  int gLastMode;
  int gLastFrontHeight;
  int gLastRearHeight;
}

on start
{
  gSuspensionMode = 0;
  gSuspensionLevel = 8;
  gDampingLevel = 12;
  gLastMode = -1;
  gLastFrontHeight = -1;
  gLastRearHeight = -1;
  setTimer(tAirSuspensionCycle, 100);
  write("[AIR_SUSPENSION] start");
}

on message frmSuspensionStateMsg
{
  gSuspensionMode = clampRange((int)this.SuspensionMode, 0, 7);
  gSuspensionLevel = clampRange((int)this.SuspensionLevel, 0, 31);
  gDampingLevel = clampRange((int)this.DampingLevel, 0, 255);
}

on timer tAirSuspensionCycle
{
  message frmAirSuspensionStateMsg mAir;
  int frontHeight;
  int rearHeight;

  frontHeight = 110 + gSuspensionLevel;
  rearHeight = 108 + gSuspensionLevel + ((gDampingLevel > 20) ? 2 : 0);

  mAir.RideHeightMode = clampRange(gSuspensionMode, 0, 7);
  mAir.FrontHeight = clampRange(frontHeight, 0, 255);
  mAir.RearHeight = clampRange(rearHeight, 0, 255);
  output(mAir);

  if (mAir.RideHeightMode != gLastMode ||
      mAir.FrontHeight != gLastFrontHeight ||
      mAir.RearHeight != gLastRearHeight)
  {
    write("[AIR_SUSPENSION] mode=%d front=%d rear=%d",
          mAir.RideHeightMode,
          mAir.FrontHeight,
          mAir.RearHeight);
    gLastMode = mAir.RideHeightMode;
    gLastFrontHeight = mAir.FrontHeight;
    gLastRearHeight = mAir.RearHeight;
  }

  setTimer(tAirSuspensionCycle, 100);
}

on stopMeasurement
{
  cancelTimer(tAirSuspensionCycle);
}
