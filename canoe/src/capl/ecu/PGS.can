includes
{
  #include "..\\common\\CAPL_COMMON.cin"
}

variables
{
  msTimer tPgsCycle;
  int gParkActive;
  int gMinDistance;
  int gZoneMask;
  int gLastActive;
  int gLastGuide;
  int gLastQuality;
}

on start
{
  gParkActive = 0;
  gMinDistance = 255;
  gZoneMask = 0;
  gLastActive = -1;
  gLastGuide = -1;
  gLastQuality = -1;
  setTimer(tPgsCycle, 100);
  write("[PGS] start");
}

on message frmParkUltrasonicStateMsg
{
  gParkActive = clampRange((int)this.ParkAssistActive, 0, 1);
  gMinDistance = clampRange((int)this.MinDistanceCm, 0, 255);
  gZoneMask = clampRange((int)this.ZoneMask, 0, 255);
}

on timer tPgsCycle
{
  message frmPgsStateMsg mPgs;
  int speed;
  int guideMode;
  int quality;

  speed = clampRange((int)@Core::vehicleSpeedNorm, 0, 255);
  guideMode = 0;
  if (gParkActive == 1)
  {
    guideMode = (gZoneMask > 0) ? 2 : 1;
  }
  quality = (gParkActive == 1) ? clampRange(100 - (gMinDistance / 2), 0, 100) : 0;
  if (speed > 15)
  {
    quality = 0;
    guideMode = 0;
  }

  mPgs.PgsActive = (guideMode > 0) ? 1 : 0;
  mPgs.GuideMode = clampRange(guideMode, 0, 3);
  mPgs.TrajectoryQuality = clampRange(quality, 0, 100);
  output(mPgs);

  if (mPgs.PgsActive != gLastActive ||
      mPgs.GuideMode != gLastGuide ||
      mPgs.TrajectoryQuality != gLastQuality)
  {
    write("[PGS] active=%d guide=%d quality=%d dist=%d speed=%d",
          mPgs.PgsActive,
          mPgs.GuideMode,
          mPgs.TrajectoryQuality,
          gMinDistance,
          speed);
    gLastActive = mPgs.PgsActive;
    gLastGuide = mPgs.GuideMode;
    gLastQuality = mPgs.TrajectoryQuality;
  }

  setTimer(tPgsCycle, 100);
}

on stopMeasurement
{
  cancelTimer(tPgsCycle);
}
