includes
{
  #include "..\\common\\CAPL_COMMON.cin"
}

variables
{
  msTimer tEngineCycle;
  int gAccelPedal;
  int gBrakePedal;
  int gIgnitionState;
  int gEngineState;
  dword gPedalRxMs;
  dword gIgnitionRxMs;
  int gLastPedalInputStale;
  int gLastIgnitionInputStale;
  int gLastEngineState;
  int gFuelLevel;
  int gBatterySoc;
}

void traceEmsInputHealth(int ignitionInputStale, int pedalInputStale)
{
  if (ignitionInputStale != gLastIgnitionInputStale)
  {
    if (ignitionInputStale == 1)
    {
      write("[EMS] ignition input stale");
    }
    else
    {
      write("[EMS] ignition input restored");
    }
    gLastIgnitionInputStale = ignitionInputStale;
  }

  if (pedalInputStale != gLastPedalInputStale)
  {
    if (pedalInputStale == 1)
    {
      write("[EMS] pedal input stale");
    }
    else
    {
      write("[EMS] pedal input restored");
    }
    gLastPedalInputStale = pedalInputStale;
  }
}

int deriveThrottlePos(int engineState, int accelPedal, int brakePedal)
{
  int throttlePos;

  if (engineState != 3)
  {
    return 0;
  }

  throttlePos = accelPedal;
  if (brakePedal >= 20)
  {
    throttlePos = throttlePos - (brakePedal / 2);
  }
  return clampRange(throttlePos, 0, 100);
}

int deriveEngineLoad(int engineState, int throttlePos, int speed)
{
  if (engineState != 3)
  {
    return 0;
  }
  return clampRange((throttlePos * 7 / 10) + (speed / 8), 0, 100);
}

int deriveEngineTorque(int engineState, int engineLoad, int rpm)
{
  if (engineState != 3)
  {
    return 0;
  }
  return clampRange((engineLoad * 2) + (rpm / 80), 0, 300);
}

on start
{
  gAccelPedal      = 0;
  gBrakePedal      = 0;
  gIgnitionState   = 0;
  gEngineState     = 0;
  gPedalRxMs       = 0;
  gIgnitionRxMs    = 0;
  gLastPedalInputStale = 0;
  gLastIgnitionInputStale = 0;
  gLastEngineState = -1;
  gFuelLevel       = 80;
  gBatterySoc      = 95;
  setTimer(tEngineCycle, 100);
  write("[EMS] start");
}

on message frmIgnitionEngineMsg
{
  gIgnitionState = clampRange((int)this.IgnitionState, 0, 1);
  gEngineState   = clampRange((int)this.EngineState, 0, 3);
  gIgnitionRxMs = getSimulationTimeMs();
}

on message frmPedalInputCanMsg
{
  gAccelPedal = clampRange((int)this.AccelPedal, 0, 100);
  gBrakePedal = clampRange((int)this.BrakePedal, 0, 100);
  gPedalRxMs = getSimulationTimeMs();
}

on timer tEngineCycle
{
  message frmEngineSpeedTempMsg  mSpeedTemp;
  message frmFuelBatteryStateMsg mFuelBat;
  message frmThrottleStateMsg    mThrottle;
  message frmEngineTorqueMsg     mTorque;
  message frmEngineLoadMsg       mLoad;
  message frmThermalMgmtStateMsg mThermal;
  int ignitionInputStale;
  int pedalInputStale;
  int ignitionState;
  int engineState;
  int accelPedal;
  int brakePedal;
  int rpm;
  int throttlePos;
  int engineLoad;
  int torque;
  int speed;
  int coolantTemp;
  int oilTemp;
  int fanDuty;

  ignitionInputStale = (ethIsRecentTick(gIgnitionRxMs, 300) == 1) ? 0 : 1;
  pedalInputStale = (ethIsRecentTick(gPedalRxMs, 300) == 1) ? 0 : 1;
  traceEmsInputHealth(ignitionInputStale, pedalInputStale);

  ignitionState = gIgnitionState;
  engineState = gEngineState;
  accelPedal = gAccelPedal;
  brakePedal = gBrakePedal;
  if (ignitionInputStale == 1)
  {
    ignitionState = 0;
    engineState = 0;
  }
  if (pedalInputStale == 1)
  {
    accelPedal = 0;
    brakePedal = 0;
  }

  if      (engineState == 0) { rpm = 0; }
  else if (engineState == 1) { rpm = 400; }
  else if (engineState == 2) { rpm = 800; }
  else
  {
    speed = (int)@Core::vehicleSpeedNorm;
    rpm   = 800 + (accelPedal * 25) + (speed * 10);
    if (rpm > 6500) rpm = 6500;
  }

  speed = clampRange((int)@Core::vehicleSpeedNorm, 0, 255);
  throttlePos = deriveThrottlePos(engineState, accelPedal, brakePedal);
  engineLoad = deriveEngineLoad(engineState, throttlePos, speed);
  torque = deriveEngineTorque(engineState, engineLoad, rpm);
  coolantTemp = (engineState > 0) ? clampRange(75 + (engineLoad / 5), 20, 120) : 20;
  oilTemp = (engineState > 0) ? clampRange(80 + (engineLoad / 4), 20, 140) : 20;
  fanDuty = (engineState == 3) ? clampRange(engineLoad / 10, 0, 10) : 0;

  mSpeedTemp.EngineRpm   = rpm & 0xFFFF;
  mSpeedTemp.CoolantTemp = coolantTemp;
  mSpeedTemp.OilTemp     = oilTemp;
  output(mSpeedTemp);

  mFuelBat.FuelLevel     = gFuelLevel;
  mFuelBat.BatterySoc    = gBatterySoc;
  mFuelBat.ChargingState = 0;
  output(mFuelBat);

  mThrottle.ThrottlePos = throttlePos;
  mThrottle.ThrottleReq = throttlePos;
  output(mThrottle);

  mTorque.EngineTorqueAct = torque & 0xFFFF;
  output(mTorque);

  mLoad.EngineLoad = engineLoad;
  output(mLoad);

  mThermal.ThermalMode   = (engineState > 0) ? 1 : 0;
  mThermal.FanDuty       = fanDuty;
  mThermal.CoolantTarget = 90;
  output(mThermal);

  if (engineState != gLastEngineState)
  {
    write("[EMS] ignition=%d engine=%d rpm=%d throttle=%d load=%d torque=%d",
          ignitionState, engineState, rpm, throttlePos, engineLoad, torque);
    gLastEngineState = engineState;
  }

  setTimer(tEngineCycle, 100);
}
