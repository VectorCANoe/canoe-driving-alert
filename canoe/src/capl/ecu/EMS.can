includes
{
  #include "..\\common\\CAPL_COMMON.cin"
}

variables
{
  msTimer tEngineCycle;
  int gIgnitionState;
  int gEngineState;
  dword gIgnitionRxMs;
  int gLastIgnitionInputStale;
  int gLastEngineState;
  int gFuelLevel;
  int gBatterySoc;
}

void traceEmsInputHealth(int ignitionInputStale)
{
  if (ignitionInputStale != gLastIgnitionInputStale)
  {
    if (ignitionInputStale == 1)
    {
      write("[EMS] ignition input stale");
    }
    else
    {
      write("[EMS] ignition input restored");
    }
    gLastIgnitionInputStale = ignitionInputStale;
  }
}

on start
{
  gIgnitionState   = 0;
  gEngineState     = 0;
  gIgnitionRxMs    = 0;
  gLastIgnitionInputStale = 0;
  gLastEngineState = -1;
  gFuelLevel       = 80;
  gBatterySoc      = 95;
  setTimer(tEngineCycle, 100);
  write("[EMS] start");
}

on message frmIgnitionEngineMsg
{
  gIgnitionState = clampRange((int)this.IgnitionState, 0, 1);
  gEngineState   = clampRange((int)this.EngineState, 0, 3);
  gIgnitionRxMs = getSimulationTimeMs();
}

on timer tEngineCycle
{
  message frmEngineSpeedTempMsg  mSpeedTemp;
  message frmFuelBatteryStateMsg mFuelBat;
  message frmThrottleStateMsg    mThrottle;
  message frmEngineTorqueMsg     mTorque;
  message frmEngineLoadMsg       mLoad;
  message frmThermalMgmtStateMsg mThermal;
  int ignitionInputStale;
  int ignitionState;
  int engineState;
  int rpm;
  int throttlePos;
  int engineLoad;
  int torque;
  int speed;

  ignitionInputStale = (ethIsRecentTick(gIgnitionRxMs, 300) == 1) ? 0 : 1;
  traceEmsInputHealth(ignitionInputStale);

  ignitionState = gIgnitionState;
  engineState = gEngineState;
  if (ignitionInputStale == 1)
  {
    ignitionState = 0;
    engineState = 0;
  }

  if      (engineState == 0) { rpm = 0; }
  else if (engineState == 1) { rpm = 400; }
  else if (engineState == 2) { rpm = 800; }
  else
  {
    speed = (int)@Core::vehicleSpeedNorm;
    rpm   = 800 + (speed * 25);
    if (rpm > 6500) rpm = 6500;
  }

  throttlePos = (engineState == 3) ? (int)@Core::vehicleSpeedNorm : 0;
  if (throttlePos > 100) throttlePos = 100;
  engineLoad  = (engineState == 3) ? (throttlePos * 8 / 10) : 0;
  if (engineLoad > 100) engineLoad = 100;
  torque      = (engineState == 3) ? (engineLoad * 3) : 0;
  if (torque > 300) torque = 300;

  mSpeedTemp.EngineRpm   = rpm & 0xFFFF;
  mSpeedTemp.CoolantTemp = (engineState > 0) ? 85 : 20;
  mSpeedTemp.OilTemp     = (engineState > 0) ? 90 : 20;
  output(mSpeedTemp);

  mFuelBat.FuelLevel     = gFuelLevel;
  mFuelBat.BatterySoc    = gBatterySoc;
  mFuelBat.ChargingState = 0;
  output(mFuelBat);

  mThrottle.ThrottlePos = throttlePos;
  mThrottle.ThrottleReq = throttlePos;
  output(mThrottle);

  mTorque.EngineTorqueAct = torque & 0xFFFF;
  output(mTorque);

  mLoad.EngineLoad = engineLoad;
  output(mLoad);

  mThermal.ThermalMode   = (engineState > 0) ? 1 : 0;
  mThermal.FanDuty       = (engineState == 3) ? 8 : 0;
  mThermal.CoolantTarget = 90;
  output(mThermal);

  if (engineState != gLastEngineState)
  {
    write("[EMS] ignition=%d engine=%d rpm=%d",
          ignitionState, engineState, rpm);
    gLastEngineState = engineState;
  }

  setTimer(tEngineCycle, 100);
}
