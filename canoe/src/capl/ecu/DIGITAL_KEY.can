includes
{
  #include "..\\common\\CAPL_COMMON.cin"
}

variables
{
  msTimer tDigitalKeyCycle;
  int gTmuServiceMode;
  int gSignalBars;
  int gKeySyncAge;
  int gLastDkeyState;
  int gLastAuthMode;
  int gLastAccessState;
  int gLastSecurityGrade;
}

void publishDigitalKeyState()
{
  message frmDigitalKeyStateMsg mDkey;
  int failSafeMode;
  int driveState;
  int timeoutClear;
  int dkeyState;
  int authMode;
  int accessState;
  int securityGrade;
  int keyPresence;

  failSafeMode = clampRange((int)@Core::failSafeMode, 0, 2);
  driveState = clampRange((int)@Core::driveStateNorm, 0, 3);
  timeoutClear = clampRange((int)@Core::timeoutClear, 0, 1);

  dkeyState = 0;
  if (gTmuServiceMode > 0 && gSignalBars >= 1)
  {
    dkeyState = 1;
  }
  if (driveState == 0 && failSafeMode == 0 && timeoutClear == 0 && gTmuServiceMode == 1 && gSignalBars >= 3)
  {
    dkeyState = 2;
  }
  else if (driveState > 0 && gTmuServiceMode > 0)
  {
    dkeyState = 3;
  }

  authMode = 0;
  if (gTmuServiceMode > 0)
  {
    authMode = 1;
  }
  if (dkeyState == 2 && gSignalBars >= 3)
  {
    authMode = 2;
  }

  accessState = 0;
  if (dkeyState == 1)
  {
    accessState = 1;
  }
  else if (dkeyState == 2)
  {
    accessState = 2;
  }
  else if (dkeyState == 3)
  {
    accessState = 3;
  }

  if (dkeyState == 2)
  {
    gKeySyncAge = 0;
  }
  else
  {
    gKeySyncAge = clampRange(gKeySyncAge + 5, 0, 255);
  }

  securityGrade = 0;
  if (failSafeMode > 0 || timeoutClear == 1)
  {
    securityGrade = 2;
  }
  else if (gSignalBars >= 3 && gTmuServiceMode == 1)
  {
    securityGrade = 1;
  }

  keyPresence = (gTmuServiceMode > 0 && gSignalBars > 0) ? 1 : 0;

  mDkey.DKeyState = clampRange(dkeyState, 0, 7);
  mDkey.AuthMode = clampRange(authMode, 0, 3);
  mDkey.VehicleAccessState = clampRange(accessState, 0, 7);
  mDkey.KeySyncAge = clampRange(gKeySyncAge, 0, 255);
  mDkey.SecurityGrade = clampRange(securityGrade, 0, 15);
  mDkey.KeyPresence = clampRange(keyPresence, 0, 1);
  output(mDkey);

  if (mDkey.DKeyState != gLastDkeyState ||
      mDkey.AuthMode != gLastAuthMode ||
      mDkey.VehicleAccessState != gLastAccessState ||
      mDkey.SecurityGrade != gLastSecurityGrade)
  {
    write("[DIGITAL_KEY] state=%d auth=%d access=%d grade=%d syncAge=%d bars=%d drive=%d",
          mDkey.DKeyState,
          mDkey.AuthMode,
          mDkey.VehicleAccessState,
          mDkey.SecurityGrade,
          mDkey.KeySyncAge,
          gSignalBars,
          driveState);
    gLastDkeyState = mDkey.DKeyState;
    gLastAuthMode = mDkey.AuthMode;
    gLastAccessState = mDkey.VehicleAccessState;
    gLastSecurityGrade = mDkey.SecurityGrade;
  }
}

on start
{
  gTmuServiceMode = 0;
  gSignalBars = 0;
  gKeySyncAge = 0;
  gLastDkeyState = -1;
  gLastAuthMode = -1;
  gLastAccessState = -1;
  gLastSecurityGrade = -1;
  setTimer(tDigitalKeyCycle, 100);
  write("[DIGITAL_KEY] start");
}

on timer tDigitalKeyCycle
{
  publishDigitalKeyState();
  setTimer(tDigitalKeyCycle, 100);
}

on message frmTmuServiceStateMsg
{
  gTmuServiceMode = clampRange((int)this.TmuServiceMode, 0, 3);
  gSignalBars = clampRange((int)this.SignalBars, 0, 15);
}

on stopMeasurement
{
  cancelTimer(tDigitalKeyCycle);
}
