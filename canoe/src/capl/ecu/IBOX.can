includes
{
  #include "..\\common\\CAPL_COMMON.cin"
}

variables
{
  msTimer tIboxCycle;
  long gEthSocket;
  char gEthRxBuffer[64];
  dword gVehTsMs;
  dword gNavTsMs;
  int gDriveState;
  int gVehicleSpeed;
  int gRoadZone;
  int gNavDirection;
  int gZoneDistance;
  int gSpeedLimit;
  int gLastVehInputStale;
  int gLastNavInputStale;
  int gLastLinkMode;
  int gLastRouteState;
  int gLastServiceFlags;
}

void traceIboxInputHealth(int vehInputStale, int navInputStale)
{
  if (vehInputStale != gLastVehInputStale)
  {
    write("[IBOX] vehicle input %s", vehInputStale == 1 ? "stale" : "restored");
    gLastVehInputStale = vehInputStale;
  }

  if (navInputStale != gLastNavInputStale)
  {
    write("[IBOX] nav input %s", navInputStale == 1 ? "stale" : "restored");
    gLastNavInputStale = navInputStale;
  }
}

void publishIboxState()
{
  dword nowMs;
  int vehAgeMs;
  int navAgeMs;
  int vehInputStale;
  int navInputStale;
  int vehicleFresh;
  int navFresh;
  int vehicleLinkActive;
  int navLinkActive;
  int vehicleSpeed;
  int roadZone;
  int navDirection;
  int zoneDistance;
  int speedLimit;
  int linkMode;
  int routeState;
  int serviceFlags;
  int failSafeMode;
  int alertLevel;
  int signalBars;

  nowMs = getSimulationTimeMs();
  vehAgeMs = (gVehTsMs == 0) ? 60000 : clampRange((int)(nowMs - gVehTsMs), 0, 60000);
  navAgeMs = (gNavTsMs == 0) ? 60000 : clampRange((int)(nowMs - gNavTsMs), 0, 60000);
  vehInputStale = (vehAgeMs <= 1000) ? 0 : 1;
  navInputStale = (navAgeMs <= 1000) ? 0 : 1;
  traceIboxInputHealth(vehInputStale, navInputStale);

  vehicleFresh = (vehAgeMs <= 300) ? 1 : 0;
  navFresh = (navAgeMs <= 300) ? 1 : 0;
  vehicleLinkActive = (vehAgeMs <= 1000) ? 1 : 0;
  navLinkActive = (navAgeMs <= 1000) ? 1 : 0;
  vehicleSpeed = vehicleFresh == 1 ? gVehicleSpeed : 0;
  roadZone = navLinkActive == 1 ? gRoadZone : 0;
  navDirection = navFresh == 1 ? gNavDirection : 0;
  zoneDistance = navFresh == 1 ? gZoneDistance : 0;
  speedLimit = navFresh == 1 ? gSpeedLimit : 0;
  failSafeMode = clampRange((int)@Core::failSafeMode, 0, 2);
  alertLevel = clampRange((int)@Core::selectedAlertLevel, 0, 7);

  linkMode = 0;
  if (vehicleLinkActive == 1 || navLinkActive == 1)
  {
    linkMode = 1;
  }
  if (vehicleFresh == 1 && navFresh == 1)
  {
    linkMode = 2;
  }

  routeState = 0;
  if (roadZone > 0 && navLinkActive == 1)
  {
    routeState = 1;
  }
  if (navDirection > 0 && zoneDistance > 0 && navFresh == 1)
  {
    routeState = 2;
  }

  serviceFlags = 0;
  if (roadZone > 0)
  {
    serviceFlags = serviceFlags | 1;
  }
  if (alertLevel > 0)
  {
    serviceFlags = serviceFlags | 2;
  }
  if (failSafeMode > 0)
  {
    serviceFlags = serviceFlags | 4;
  }
  if (vehicleFresh == 1 && navFresh == 1 &&
      vehicleSpeed > speedLimit && speedLimit > 0)
  {
    serviceFlags = serviceFlags | 8;
  }

  if (vehAgeMs > 1000 || navAgeMs > 1000)
  {
    signalBars = 1;
  }
  else if (vehAgeMs > 300 || navAgeMs > 300)
  {
    signalBars = 3;
  }
  else
  {
    signalBars = 4;
  }

  if (failSafeMode > 0 && signalBars > 2)
  {
    signalBars = 2;
  }
  if (routeState == 0 && signalBars > 1)
  {
    signalBars = signalBars - 1;
  }

  if (linkMode != gLastLinkMode ||
      routeState != gLastRouteState ||
      serviceFlags != gLastServiceFlags)
  {
    write("[IBOX] link=%d route=%d bars=%d service=0x%X",
          linkMode, routeState, signalBars, serviceFlags);
    gLastLinkMode = linkMode;
    gLastRouteState = routeState;
    gLastServiceFlags = serviceFlags;
  }
}

void OnUdpReceiveFrom(dword socket, long result, dword address, dword port, char buffer[], dword count)
{
  int msgId;
  int payload0;

  if (socket != gEthSocket)
  {
    return;
  }
  if (result == 0)
  {
    msgId = ethFrameMsgId(buffer, count);
    if (msgId == ethMsgVehicleState() && ethFramePayloadLen(count) >= 2)
    {
      gVehTsMs = getSimulationTimeMs();
      gVehicleSpeed = clampRange(ethGetU8(buffer, 0), 0, 255);
      gDriveState = clampRange(ethGetU8(buffer, 1), 0, 3);
    }
    else if (msgId == ethMsgNavContext() && ethFramePayloadLen(count) >= 3)
    {
      gNavTsMs = getSimulationTimeMs();
      payload0 = ethGetU8(buffer, 0);
      gRoadZone = clampRange(payload0 & 0x3, 0, 3);
      gNavDirection = clampRange((payload0 >> 2) & 0x3, 0, 3);
      gZoneDistance = clampRange(ethGetU8(buffer, 1), 0, 255);
      gSpeedLimit = clampRange(ethGetU8(buffer, 2), 0, 255);
    }
  }

  ethArmReceive(gEthSocket, gEthRxBuffer, elcount(gEthRxBuffer));
}

on start
{
  gEthSocket = ethOpenDefaultSocket();
  gVehTsMs = 0;
  gNavTsMs = 0;
  gDriveState = 0;
  gVehicleSpeed = 0;
  gRoadZone = 0;
  gNavDirection = 0;
  gZoneDistance = 0;
  gSpeedLimit = 0;
  gLastVehInputStale = 1;
  gLastNavInputStale = 1;
  gLastLinkMode = -1;
  gLastRouteState = -1;
  gLastServiceFlags = -1;
  if (gEthSocket != ethInvalidSocket())
  {
    ethStartReceiver(gEthSocket, gEthRxBuffer, elcount(gEthRxBuffer));
  }
  setTimer(tIboxCycle, 100);
  write("[IBOX] start");
}

on timer tIboxCycle
{
  publishIboxState();
  setTimer(tIboxCycle, 100);
}

on stopMeasurement
{
  cancelTimer(tIboxCycle);
  ethCloseSocket(gEthSocket);
  gEthSocket = ethInvalidSocket();
}
