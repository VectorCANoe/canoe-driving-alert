includes
{
  #include "..\\common\\CAPL_COMMON.cin"
}

variables
{
  msTimer tIboxCycle;
  dword gVehTsMs;
  dword gNavTsMs;
  int gDriveState;
  int gVehicleSpeed;
  int gRoadZone;
  int gNavDirection;
  int gZoneDistance;
  int gSpeedLimit;
  int gLastLinkMode;
  int gLastRouteState;
  int gLastServiceFlags;
}

void publishIboxState()
{
  message ethIboxStateMsg mIbox;
  dword nowMs;
  int vehAgeMs;
  int navAgeMs;
  int linkMode;
  int routeState;
  int serviceFlags;
  int failSafeMode;
  int alertLevel;
  int signalBars;

  nowMs = getSimulationTimeMs();
  vehAgeMs = (gVehTsMs == 0) ? 60000 : clampRange((int)(nowMs - gVehTsMs), 0, 60000);
  navAgeMs = (gNavTsMs == 0) ? 60000 : clampRange((int)(nowMs - gNavTsMs), 0, 60000);
  failSafeMode = clampRange((int)@Core::failSafeMode, 0, 2);
  alertLevel = clampRange((int)@Core::selectedAlertLevel, 0, 7);

  linkMode = 0;
  if (vehAgeMs <= 1000 || navAgeMs <= 1000)
  {
    linkMode = 1;
  }
  if (vehAgeMs <= 300 && navAgeMs <= 300)
  {
    linkMode = 2;
  }

  routeState = 0;
  if (gRoadZone > 0)
  {
    routeState = 1;
  }
  if (gNavDirection > 0 && gZoneDistance > 0)
  {
    routeState = 2;
  }

  serviceFlags = 0;
  if (gRoadZone > 0)
  {
    serviceFlags = serviceFlags | 1;
  }
  if (alertLevel > 0)
  {
    serviceFlags = serviceFlags | 2;
  }
  if (failSafeMode > 0)
  {
    serviceFlags = serviceFlags | 4;
  }
  if (gVehicleSpeed > gSpeedLimit && gSpeedLimit > 0)
  {
    serviceFlags = serviceFlags | 8;
  }

  if (vehAgeMs > 1000 || navAgeMs > 1000)
  {
  }
  else if (vehAgeMs > 300 || navAgeMs > 300)
  {
  }

  signalBars = 4;
  if (failSafeMode > 0)
  {
    signalBars = 2;
  }
  {
    signalBars = 1;
  }

  mIbox.IboxLinkMode = clampRange(linkMode, 0, 3);
  mIbox.IboxRouteState = clampRange(routeState, 0, 3);
  mIbox.IboxSignalBars = clampRange(signalBars, 0, 15);
  mIbox.IboxServiceFlags = clampRange(serviceFlags, 0, 15);
  output(mIbox);

  if (mIbox.IboxLinkMode != gLastLinkMode ||
      mIbox.IboxRouteState != gLastRouteState ||
      mIbox.IboxServiceFlags != gLastServiceFlags)
  {
    gLastLinkMode = mIbox.IboxLinkMode;
    gLastRouteState = mIbox.IboxRouteState;
    gLastServiceFlags = mIbox.IboxServiceFlags;
  }
}

on start
{
  gVehTsMs = 0;
  gNavTsMs = 0;
  gDriveState = 0;
  gVehicleSpeed = 0;
  gRoadZone = 0;
  gNavDirection = 0;
  gZoneDistance = 0;
  gSpeedLimit = 0;
  gLastLinkMode = -1;
  gLastRouteState = -1;
  gLastServiceFlags = -1;
  setTimer(tIboxCycle, 100);
  write("[IBOX] start");
}

on timer tIboxCycle
{
  publishIboxState();
  setTimer(tIboxCycle, 100);
}

on message ethVehicleStateMsg
{
  gVehTsMs = getSimulationTimeMs();
  gDriveState = clampRange((int)this.DriveState, 0, 3);
  gVehicleSpeed = clampRange((int)this.VehicleSpeed, 0, 255);
}

on message ethNavContextMsg
{
  gNavTsMs = getSimulationTimeMs();
  gRoadZone = clampRange((int)this.RoadZone, 0, 7);
  gNavDirection = clampRange((int)this.NavDirection, 0, 7);
  gZoneDistance = clampRange((int)this.ZoneDistance, 0, 255);
  gSpeedLimit = clampRange((int)this.SpeedLimit, 0, 255);
}

on stopMeasurement
{
  cancelTimer(tIboxCycle);
}
