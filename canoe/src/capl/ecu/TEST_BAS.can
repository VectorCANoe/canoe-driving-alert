includes
{
  #include "..\\common\\CAPL_COMMON.cin"
}

variables
{
  int gLastBaseScenarioId;
  int gBaseScenarioResult;
  int gFlowCoverage;
  int gTestHealth;
  int gTraceSnapshotId;
}

int resolveBaseScenarioId()
{
  int scenarioId;

  scenarioId = clampRange((int)@Test::testScenario, 0, 255);
  if (scenarioId == 0)
  {
    scenarioId = clampRange((int)@Test::scenarioCommandAck, 0, 255);
  }
  if (scenarioId == 0)
  {
    scenarioId = gLastBaseScenarioId + 1;
    if (scenarioId > 255)
    {
      scenarioId = 1;
    }
  }
  return scenarioId;
}

int resolveTestHealth()
{
  int boundaryHealthy;
  int e2eHealthState;

  boundaryHealthy = ((int)@CoreState::domainBoundaryStatus == 1) ? 1 : 0;
  e2eHealthState = clampRange((int)@CoreState::e2eHealthState, 0, 2);

  if (boundaryHealthy == 1 && e2eHealthState == 2)
  {
    return 0xFF;
  }
  if (boundaryHealthy == 1 || e2eHealthState >= 1)
  {
    return 0x80;
  }
  return 0x40;
}

int resolveFlowCoverageMask(int pass)
{
  if (pass == 1)
  {
    return 0x7FFF;
  }
  return clampRange((int)@CoreState::routingPolicy, 0, 7) << 12;
}

void clearBaseResultState()
{
  gLastBaseScenarioId  = 0;
  gBaseScenarioResult  = 0;
  gFlowCoverage        = 0;
  gTestHealth          = 0;
  gTraceSnapshotId     = 0;

  @Test::baseScenarioId       = 0;
  @Test::baseScenarioResult   = 0;
  @Test::baseFlowCoverageMask = 0;
  @Test::baseTraceSnapshotId  = 0;
  @Test::baseTestHealth       = 0;
}

void publishBaseResultState(int pass)
{
  gBaseScenarioResult  = clampRange(pass, 0, 1);
  gTraceSnapshotId     = (int)@CoreState::arbitrationSnapshotId;
  gTestHealth          = resolveTestHealth();
  gFlowCoverage        = resolveFlowCoverageMask(gBaseScenarioResult);
  gLastBaseScenarioId  = resolveBaseScenarioId();

  @Test::baseScenarioId       = gLastBaseScenarioId & 0xFF;
  @Test::baseScenarioResult   = gBaseScenarioResult & 0x1;
  @Test::baseFlowCoverageMask = gFlowCoverage & 0x7FFF;
  @Test::baseTraceSnapshotId  = gTraceSnapshotId & 0xFFFF;
  @Test::baseTestHealth       = gTestHealth & 0xFF;

  write("[TEST_BAS] scenario id=%d result=%d health=%d",
        gLastBaseScenarioId, gBaseScenarioResult, gTestHealth);
}

on start
{
  clearBaseResultState();
  write("[TEST_BAS] start");
}

on sysvar Test::scenarioResult
{
  publishBaseResultState((int)@Test::scenarioResult);
}

on sysvar Test::scenarioCommandAck
{
  if ((int)@Test::scenarioCommandAck == 0)
  {
    clearBaseResultState();
  }
}
