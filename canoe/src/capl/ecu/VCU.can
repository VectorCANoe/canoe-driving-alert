includes
{
  #include "..\\common\\CAPL_COMMON.cin"
}

variables
{
  msTimer tVcuCycle;
  long gEthSocket;
  long gEthTxSocket;
  dword gEthTargetIp;
  int gSpeed;
  int gAccelPedal;
  int gBrakePedal;
  int gIgnitionState;
  int gEngineState;
  int gGearInput;
  int gGearState;
  int gDriveMode;
  int gRoutingPolicy;
  int gBoundaryStatus;
  int gSpeedLimitNorm;
  int gPtAliveCnt;
}

int getVcuTxPort()
{
  return ethBackbonePort() + 2;
}

void publishBackboneVehicleState()
{
  char frame[4];
  int driveState;
  int vehicleSpeed;
  long txSocket;

  driveState = clampRange((int)@Core::driveStateNorm, 0, 3);
  vehicleSpeed = clampRange((int)@Core::vehicleSpeedNorm, 0, 255);
  txSocket = gEthTxSocket;
  if (txSocket == ethInvalidSocket())
  {
    txSocket = gEthSocket;
  }

  ethInitFrame(frame, ethMsgVehicleState(), 2);
  ethSetU8(frame, 0, vehicleSpeed);
  ethSetU8(frame, 1, driveState);
  ethSendFrame(txSocket, gEthTargetIp, ethMsgVehicleState(), frame, 2);
}

on start
{
  gEthSocket = ethOpenDefaultSocket();
  gEthTxSocket = ethOpenNodeSocket(getVcuTxPort());
  gEthTargetIp = ethGetDefaultIpAddress();
  gSpeed = 0;
  gAccelPedal = 0;
  gBrakePedal = 0;
  gIgnitionState = 0;
  gEngineState = 0;
  gGearInput = 0;
  gGearState = 0;
  gDriveMode = 0;
  gRoutingPolicy = 1;
  gBoundaryStatus = 0;
  gSpeedLimitNorm = 30;
  gPtAliveCnt = 0;
  if (gEthTxSocket == ethInvalidSocket())
  {
    write("[VCU] tx socket fallback to shared backbone port");
  }
  setTimer(tVcuCycle, 100);
  write("[VCU] start");
}

on message frmPedalInputCanMsg
{
  gAccelPedal = clampRange((int)this.AccelPedal, 0, 100);
  gBrakePedal = clampRange((int)this.BrakePedal, 0, 100);
}

on message frmIgnitionEngineMsg
{
  gIgnitionState = clampRange((int)this.IgnitionState, 0, 1);
  gEngineState = clampRange((int)this.EngineState, 0, 3);
}

on message frmGearStateMsg
{
  gGearInput = clampRange((int)this.GearInput, 0, 7);
  gGearState = clampRange((int)this.GearState, 0, 7);
}

on message frmPowertrainGatewayMsg
{
  gRoutingPolicy = clampRange((int)this.RoutingPolicy, 0, 2);
  gBoundaryStatus = clampRange((int)this.BoundaryStatus, 0, 1);
}

on message frmVehicleModeMsg
{
  gDriveMode = clampRange((int)this.DriveMode, 0, 7);
  gEngineState = clampRange((int)this.PowertrainState, 0, 255);
}

on timer tVcuCycle
{
  message frmVehicleStateCanMsg mState;
  message frmAccelStatusMsg mAccel;
  message frmTcsStateMsg mTcs;
  message frmWheelPulseMsg mWheelPulse;
  message frmPowertrainGatewayMsg mPtGw;
  message frmVehicleModeMsg mVehMode;
  message frmPowerLimitMsg mPowerLimit;
  message frmPowertrainHealthMsg mPtHealth;
  message frmEnergyFlowStateMsg mEnergy;
  message frmPowertrainCtrlAuthMsg mCtrlAuth;
  int targetSpeed;
  int delta;
  int driveState;
  int selectedAlertLevel;
  int timeoutClear;
  int failSafeMode;
  int torqueRequest;
  int tcsActive;
  int scenarioActive;
  int scenarioSpeedHint;

  scenarioActive = (((int)@Test::testScenario) > 0) ? 1 : 0;
  scenarioSpeedHint = clampRange((int)@Chassis::vehicleSpeed, 0, 255);

  if (scenarioActive == 1)
  {
    gSpeed = scenarioSpeedHint;
  }
  else
  {
    targetSpeed = gAccelPedal * 2;
    if (targetSpeed > 200) targetSpeed = 200;
    if (gBrakePedal > 20) targetSpeed = 0;

    delta = targetSpeed - gSpeed;
    if (delta > 5) delta = 5;
    if (delta < -15) delta = -15;
    gSpeed = gSpeed + delta;
    if (gSpeed < 0) gSpeed = 0;
    if (gSpeed > 255) gSpeed = 255;
  }

  driveState = (gGearState > 0 || gSpeed > 0) ? 3 : 0;
  gDriveMode = clampRange(gGearState, 0, 7);
  gSpeedLimitNorm = clampRange((int)@Core::speedLimitNorm, 0, 255);
  selectedAlertLevel = clampRange((int)@Core::selectedAlertLevel, 0, 7);
  timeoutClear = (((int)@Core::timeoutClear) == 1) ? 1 : 0;
  failSafeMode = clampRange((int)@Core::failSafeMode, 0, 2);
  gBoundaryStatus = clampRange((int)@CoreState::domainBoundaryStatus, 0, 1);

  if (failSafeMode > 0 || timeoutClear == 1)
  {
    gRoutingPolicy = 0;
  }
  else if (selectedAlertLevel >= 4)
  {
    gRoutingPolicy = 2;
  }
  else
  {
    gRoutingPolicy = 1;
  }

  @Core::vehicleSpeedNorm = gSpeed;
  @Core::driveStateNorm = driveState;
  @CoreState::routingPolicy = gRoutingPolicy;

  mState.gVehicleSpeed = gSpeed;
  mState.gDriveState = driveState;
  output(mState);
  @Chassis::vehicleSpeed = gSpeed;
  @Chassis::driveState = driveState;
  publishBackboneVehicleState();

  torqueRequest = clampRange(gAccelPedal * 2, 0, 255);
  mAccel.AccelRequest = gAccelPedal;
  mAccel.TorqueRequest = torqueRequest;
  output(mAccel);

  tcsActive = ((gAccelPedal > 70) && (gSpeed < 25)) ? 1 : 0;
  mTcs.TcsCtrlState = tcsActive ? 2 : 0;
  mTcs.TcsTorqueCut = tcsActive ? 20 : 0;
  mTcs.TcsSlipRatio = tcsActive ? 12 : 0;
  output(mTcs);

  mWheelPulse.WheelPulseFront = gSpeed;
  mWheelPulse.WheelPulseRear = gSpeed;
  output(mWheelPulse);

  mPtGw.RoutingPolicy = gRoutingPolicy;
  mPtGw.BoundaryStatus = gBoundaryStatus;
  output(mPtGw);

  mVehMode.DriveMode = gDriveMode;
  mVehMode.EcoMode = (gDriveMode == 3) ? 1 : 0;
  mVehMode.SportMode = (gSpeed > 80) ? 1 : 0;
  mVehMode.SnowMode = (gDriveMode == 0 && gSpeed < 20) ? 1 : 0;
  mVehMode.PowertrainState = gEngineState;
  output(mVehMode);
  @CoreState::driveMode = mVehMode.DriveMode;
  @CoreState::ecoMode = mVehMode.EcoMode;
  @CoreState::sportMode = mVehMode.SportMode;

  mPowerLimit.TorqueLimit = torqueRequest;
  mPowerLimit.SpeedLimit = gSpeedLimitNorm;
  output(mPowerLimit);

  mPtHealth.PtAliveCnt = gPtAliveCnt & 0xFF;
  mPtHealth.PtFailCode = 0;
  output(mPtHealth);
  gPtAliveCnt = (gPtAliveCnt + 1) & 0xFF;

  mEnergy.EnergyFlowMode = (gDriveMode == 3) ? 1 : 0;
  mEnergy.RegenLevel = (selectedAlertLevel >= 3) ? 8 : 2;
  mEnergy.PowerBalance = (gRoutingPolicy == 2) ? 60 : 50;
  output(mEnergy);

  mCtrlAuth.CtrlAuthLevel = (gBoundaryStatus == 1) ? 3 : 1;
  mCtrlAuth.CtrlAuthSource = 1;
  output(mCtrlAuth);

  setTimer(tVcuCycle, 100);
}

on stopMeasurement
{
  cancelTimer(tVcuCycle);
  ethCloseSocket(gEthTxSocket);
  gEthTxSocket = ethInvalidSocket();
  ethCloseSocket(gEthSocket);
  gEthSocket = ethInvalidSocket();
}
