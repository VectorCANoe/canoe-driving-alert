includes
{
  #include "..\\common\\CAPL_COMMON.cin"
}

variables
{
  msTimer tLcaCycle;
  int gLastReady;
  int gLastWarn;
  int gLastDirection;
  int gLastMergeConflict;
  int gLastAlertLevel;
}

void publishLcaState()
{
  message frmLcaStateMsg mLca;
  int turnLampState;
  int mergeConflict;
  int objectRiskClass;
  int alertLevel;
  int vehicleSpeed;
  int ready;
  int warn;
  int direction;

  turnLampState = clampRange((int)@CoreState::turnLampState, 0, 3);
  mergeConflict = (((int)@Core::mergeCutInFlag) == 1) ? 1 : 0;
  objectRiskClass = clampRange((int)@Core::objectRiskClass, 0, 7);
  alertLevel = clampRange((int)@Core::selectedAlertLevel, 0, 7);
  vehicleSpeed = clampRange((int)@Core::vehicleSpeedNorm, 0, 255);

  direction = turnLampState;
  ready = 0;
  warn = 0;

  if ((turnLampState == 1 || turnLampState == 2) && vehicleSpeed >= 20 && mergeConflict == 0 && objectRiskClass <= 1)
  {
    ready = 1;
  }
  if ((turnLampState == 1 || turnLampState == 2) && mergeConflict == 1 && objectRiskClass >= 2)
  {
    warn = 1;
  }

  mLca.LcaReady = ready;
  mLca.LcaWarn = warn;
  mLca.LcaDirection = clampRange(direction, 0, 3);
  mLca.MergeConflict = mergeConflict;
  mLca.SelectedAlertLevel = alertLevel;
  output(mLca);

  if (ready != gLastReady ||
      warn != gLastWarn ||
      direction != gLastDirection ||
      mergeConflict != gLastMergeConflict ||
      alertLevel != gLastAlertLevel)
  {
    write("[LCA] ready=%d warn=%d dir=%d merge=%d alert=%d speed=%d riskClass=%d",
          ready,
          warn,
          direction,
          mergeConflict,
          alertLevel,
          vehicleSpeed,
          objectRiskClass);
    gLastReady = ready;
    gLastWarn = warn;
    gLastDirection = direction;
    gLastMergeConflict = mergeConflict;
    gLastAlertLevel = alertLevel;
  }
}

on start
{
  gLastReady = -1;
  gLastWarn = -1;
  gLastDirection = -1;
  gLastMergeConflict = -1;
  gLastAlertLevel = -1;
  setTimer(tLcaCycle, 100);
  write("[LCA] start");
}

on timer tLcaCycle
{
  publishLcaState();
  setTimer(tLcaCycle, 100);
}

on stopMeasurement
{
  cancelTimer(tLcaCycle);
}
