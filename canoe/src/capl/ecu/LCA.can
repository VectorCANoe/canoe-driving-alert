includes
{
  #include "..\\common\\CAPL_COMMON.cin"
}

variables
{
  msTimer tLcaCycle;
  int gLastReady;
  int gLastWarn;
  int gLastDirection;
  int gLastMergeConflict;
  int gLastAlertLevel;
  int gLastPathReady;
}

int lcaPathReady()
{
  int warningPathStatus;
  int e2eHealthState;
  int failSafeMode;

  warningPathStatus = clampRange((int)@CoreState::warningPathStatus, 0, 2);
  e2eHealthState = clampRange((int)@CoreState::e2eHealthState, 0, 2);
  failSafeMode = clampRange((int)@Core::failSafeMode, 0, 2);
  if (warningPathStatus >= 2 || e2eHealthState == 0 || failSafeMode >= 2)
  {
    return 0;
  }
  return 1;
}

int deriveLcaAlertLevel(int warn, int objectRiskClass)
{
  if (warn == 1 && objectRiskClass >= 4)
  {
    return 4;
  }
  if (warn == 1)
  {
    return 3;
  }
  return 0;
}

void publishLcaState()
{
  message frmLcaStateMsg mLca;
  int turnLampState;
  int mergeConflict;
  int objectRiskClass;
  int alertLevel;
  int vehicleSpeed;
  int ready;
  int warn;
  int direction;
  int pathReady;

  turnLampState = clampRange((int)@CoreState::turnLampState, 0, 3);
  mergeConflict = (((int)@Core::mergeCutInFlag) == 1) ? 1 : 0;
  objectRiskClass = clampRange((int)@Core::objectRiskClass, 0, 7);
  vehicleSpeed = clampRange((int)@Core::vehicleSpeedNorm, 0, 255);
  pathReady = lcaPathReady();

  direction = turnLampState;
  ready = 0;
  warn = 0;

  if ((turnLampState == 1 || turnLampState == 2) && vehicleSpeed >= 20 && mergeConflict == 0 && objectRiskClass <= 1)
  {
    ready = 1;
  }
  if ((turnLampState == 1 || turnLampState == 2) && mergeConflict == 1 && objectRiskClass >= 2)
  {
    warn = 1;
  }
  alertLevel = deriveLcaAlertLevel(warn, objectRiskClass);
  if (pathReady == 0)
  {
    ready = 0;
    warn = 0;
    direction = 0;
    mergeConflict = 0;
    alertLevel = 0;
  }

  mLca.LcaReady = ready;
  mLca.LcaWarn = warn;
  mLca.LcaDirection = clampRange(direction, 0, 3);
  mLca.MergeConflict = mergeConflict;
  mLca.SelectedAlertLevel = alertLevel;
  output(mLca);

  if (pathReady != gLastPathReady ||
      ready != gLastReady ||
      warn != gLastWarn ||
      direction != gLastDirection ||
      mergeConflict != gLastMergeConflict ||
      alertLevel != gLastAlertLevel)
  {
    write("[LCA] path=%d ready=%d warn=%d dir=%d merge=%d alert=%d speed=%d riskClass=%d",
          pathReady,
          ready,
          warn,
          direction,
          mergeConflict,
          alertLevel,
          vehicleSpeed,
          objectRiskClass);
    gLastPathReady = pathReady;
    gLastReady = ready;
    gLastWarn = warn;
    gLastDirection = direction;
    gLastMergeConflict = mergeConflict;
    gLastAlertLevel = alertLevel;
  }
}

on start
{
  gLastPathReady = -1;
  gLastReady = -1;
  gLastWarn = -1;
  gLastDirection = -1;
  gLastMergeConflict = -1;
  gLastAlertLevel = -1;
  setTimer(tLcaCycle, 100);
  write("[LCA] start");
}

on timer tLcaCycle
{
  publishLcaState();
  setTimer(tLcaCycle, 100);
}

on stopMeasurement
{
  cancelTimer(tLcaCycle);
}
