includes
{
  #include "..\\common\\CAPL_COMMON.cin"
}

variables
{
  msTimer tWiperCycle;
  int gFrontWiperState;
  int gRearWiperState;
  int gWiperInterval;
  int gLastFrontWiperState;
  int gLastRearWiperState;
  int gLastWiperInterval;
}

void publishWiperState()
{
  message frmWiperStateMsg mWiper;

  mWiper.FrontWiperState = clampRange(gFrontWiperState, 0, 3);
  mWiper.RearWiperState = clampRange(gRearWiperState, 0, 3);
  mWiper.WiperInterval = clampRange(gWiperInterval, 0, 15);
  output(mWiper);

  if (mWiper.FrontWiperState != gLastFrontWiperState ||
      mWiper.RearWiperState != gLastRearWiperState ||
      mWiper.WiperInterval != gLastWiperInterval)
  {
    write("[WIP] front=%d rear=%d interval=%d",
          mWiper.FrontWiperState,
          mWiper.RearWiperState,
          mWiper.WiperInterval);
    gLastFrontWiperState = mWiper.FrontWiperState;
    gLastRearWiperState = mWiper.RearWiperState;
    gLastWiperInterval = mWiper.WiperInterval;
  }
}

on start
{
  gFrontWiperState = 0;
  gRearWiperState = 0;
  gWiperInterval = 0;
  gLastFrontWiperState = -1;
  gLastRearWiperState = -1;
  gLastWiperInterval = -1;
  setTimer(tWiperCycle, 100);
  write("[WIP] start");
}

on timer tWiperCycle
{
  publishWiperState();
  setTimer(tWiperCycle, 100);
}

on stopMeasurement
{
  cancelTimer(tWiperCycle);
}
