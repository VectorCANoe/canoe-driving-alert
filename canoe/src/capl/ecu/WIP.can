includes
{
  #include "..\\common\\CAPL_COMMON.cin"
}

variables
{
  int gDiagPending;
  int gLastDiagSid;
  int gLastDiagDidHigh;
  int gLastDiagDidLow;
  msTimer tWiperCycle;
  int gFrontWiperState;
  int gRearWiperState;
  int gWiperInterval;
  int gLastFrontWiperState;
  int gLastRearWiperState;
  int gLastWiperInterval;
}

void publishWiperState()
{
  message frmWiperStateMsg mWiper;

  mWiper.FrontWiperState = clampRange(gFrontWiperState, 0, 3);
  mWiper.RearWiperState = clampRange(gRearWiperState, 0, 3);
  mWiper.WiperInterval = clampRange(gWiperInterval, 0, 15);
  output(mWiper);

  if (mWiper.FrontWiperState != gLastFrontWiperState ||
      mWiper.RearWiperState != gLastRearWiperState ||
      mWiper.WiperInterval != gLastWiperInterval)
  {
    write("[WIP] front=%d rear=%d interval=%d",
          mWiper.FrontWiperState,
          mWiper.RearWiperState,
          mWiper.WiperInterval);
    gLastFrontWiperState = mWiper.FrontWiperState;
    gLastRearWiperState = mWiper.RearWiperState;
    gLastWiperInterval = mWiper.WiperInterval;
  }
}

on start
{
  gDiagPending = 0;
  gLastDiagSid = 0;
  gLastDiagDidHigh = 0;
  gLastDiagDidLow = 0;
  gFrontWiperState = 0;
  gRearWiperState = 0;
  gWiperInterval = 0;
  gLastFrontWiperState = -1;
  gLastRearWiperState = -1;
  gLastWiperInterval = -1;
  setTimer(tWiperCycle, 100);
  write("[WIP] start");
}

on timer tWiperCycle
{
  if (gDiagPending == 1)
  {
    message frmWipDiagResMsg mDiagRes;

    mDiagRes.WipDiagRespCode = getBasicDiagRespCode(gLastDiagSid);
    mDiagRes.WipDiagData0 = gLastDiagDidHigh;
    mDiagRes.WipDiagData1 = gLastDiagDidLow;
    output(mDiagRes);
    gDiagPending = 0;
  }

  if ((int)@Core::timeoutClear == 1)
  {
    gFrontWiperState = 1;
    gRearWiperState = 0;
    gWiperInterval = 4;
  }
  else
  {
    gFrontWiperState = 0;
    gRearWiperState = 0;
    gWiperInterval = 0;
  }
  publishWiperState();
  setTimer(tWiperCycle, 100);
}

on message frmWipDiagReqMsg
{
  gLastDiagSid = clampRange((int)this.WipDiagServiceId, 0, 255);
  gLastDiagDidHigh = clampRange((int)this.WipDiagDidHigh, 0, 255);
  gLastDiagDidLow = clampRange((int)this.WipDiagDidLow, 0, 255);
  gDiagPending = 1;
}

on stopMeasurement
{
  cancelTimer(tWiperCycle);
}
