includes
{
  #include "..\\common\\CAPL_COMMON.cin"
}

variables
{
  msTimer tInverterCycle;
  int gMcuState;
  int gMotorTorqueCmd;
  long gMotorSpeedRpm;
  int gLastState;
  int gLastTemp;
  int gLastVolt;
}

on start
{
  gMcuState = 0;
  gMotorTorqueCmd = 0;
  gMotorSpeedRpm = 0;
  gLastState = -1;
  gLastTemp = -1;
  gLastVolt = -1;
  setTimer(tInverterCycle, 100);
  write("[INVERTER] start");
}

on message frmMcuStateMsg
{
  gMcuState = clampRange((int)this.McuState, 0, 7);
  gMotorTorqueCmd = clampRange((int)this.MotorTorqueCmd, 0, 255);
  gMotorSpeedRpm = (long)this.MotorSpeedRpm;
}

on timer tInverterCycle
{
  message frmInverterStateMsg mInv;
  int inverterState;
  int invTemp;
  int dcLinkVolt;

  inverterState = (gMcuState >= 2) ? 2 : ((gMcuState == 1) ? 1 : 0);
  invTemp = 40 + (gMotorTorqueCmd / 4);
  if (invTemp > 140) invTemp = 140;
  dcLinkVolt = 110 + clampRange((int)(gMotorSpeedRpm / 200), 0, 110);

  mInv.InverterState = clampRange(inverterState, 0, 7);
  mInv.InvTemp = clampRange(invTemp, 0, 255);
  mInv.DcLinkVolt = clampRange(dcLinkVolt, 0, 255);
  output(mInv);

  if (mInv.InverterState != gLastState ||
      mInv.InvTemp != gLastTemp ||
      mInv.DcLinkVolt != gLastVolt)
  {
    write("[INVERTER] state=%d temp=%d dc=%d torque=%d speed=%ld",
          mInv.InverterState,
          mInv.InvTemp,
          mInv.DcLinkVolt,
          gMotorTorqueCmd,
          gMotorSpeedRpm);
    gLastState = mInv.InverterState;
    gLastTemp = mInv.InvTemp;
    gLastVolt = mInv.DcLinkVolt;
  }

  setTimer(tInverterCycle, 100);
}

on stopMeasurement
{
  cancelTimer(tInverterCycle);
}
