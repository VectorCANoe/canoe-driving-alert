includes
{
  #include "..\\common\\CAPL_COMMON.cin"
}

variables
{
  msTimer tAbsCycle;
  int gBrakePressure;
  int gBrakeMode;
  int gAbsActive;
  int gWheelSpdFL;
  int gWheelSpdFR;
  int gWheelSpdRL;
  int gWheelSpdRR;
  int gLastCtrlState;
  int gLastSlipLevel;
  int gLastPressureCmd;
}

void publishAbsState()
{
  message frmAbsStateMsg mAbs;
  int avgRearSpeed;
  int slipLevel;
  int pressureCmd;

  avgRearSpeed = (gWheelSpdRL + gWheelSpdRR) / 2;
  slipLevel = 0;
  if (gAbsActive == 1)
  {
    slipLevel = clampRange(gBrakePressure - 80, 0, 63);
    if (avgRearSpeed < gWheelSpdFL)
    {
      slipLevel = clampRange(slipLevel + (gWheelSpdFL - avgRearSpeed), 0, 63);
    }
  }

  pressureCmd = (gAbsActive == 1) ? gBrakePressure : 0;

  mAbs.AbsCtrlState = (gAbsActive == 1) ? 2 : ((gBrakeMode > 0) ? 1 : 0);
  mAbs.AbsSlipLevel = slipLevel;
  mAbs.AbsPressureCmd = clampRange(pressureCmd, 0, 255);
  output(mAbs);

  if (mAbs.AbsCtrlState != gLastCtrlState ||
      mAbs.AbsSlipLevel != gLastSlipLevel ||
      mAbs.AbsPressureCmd != gLastPressureCmd)
  {
    write("[ABS] state=%d slip=%d cmd=%d pressure=%d mode=%d rearAvg=%d",
          mAbs.AbsCtrlState,
          mAbs.AbsSlipLevel,
          mAbs.AbsPressureCmd,
          gBrakePressure,
          gBrakeMode,
          avgRearSpeed);
    gLastCtrlState = mAbs.AbsCtrlState;
    gLastSlipLevel = mAbs.AbsSlipLevel;
    gLastPressureCmd = mAbs.AbsPressureCmd;
  }
}

on start
{
  gBrakePressure = 0;
  gBrakeMode = 0;
  gAbsActive = 0;
  gWheelSpdFL = 0;
  gWheelSpdFR = 0;
  gWheelSpdRL = 0;
  gWheelSpdRR = 0;
  gLastCtrlState = -1;
  gLastSlipLevel = -1;
  gLastPressureCmd = -1;
  setTimer(tAbsCycle, 100);
  write("[ABS] start");
}

on timer tAbsCycle
{

  publishAbsState();
  setTimer(tAbsCycle, 100);
}

on message frmBrakeStatusMsg
{
  gBrakePressure = clampRange((int)this.BrakePressure, 0, 255);
  gBrakeMode = clampRange((int)this.BrakeMode, 0, 3);
  gAbsActive = clampRange((int)this.AbsActive, 0, 1);
}

on message frmWheelSpeedMsg
{
  gWheelSpdFL = clampRange((int)this.WheelSpdFL, 0, 255);
  gWheelSpdFR = clampRange((int)this.WheelSpdFR, 0, 255);
  gWheelSpdRL = clampRange((int)this.WheelSpdRL, 0, 255);
  gWheelSpdRR = clampRange((int)this.WheelSpdRR, 0, 255);
}

on stopMeasurement
{
  cancelTimer(tAbsCycle);
}
