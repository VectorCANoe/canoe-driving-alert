includes
{
  #include "..\\common\\CAPL_COMMON.cin"
}

variables
{
  msTimer tFpcmCycle;
  int gBatterySoc;
  int gChargingState;
  int gEngineTorque;
  int gLastState;
  int gLastDuty;
  int gLastPressure;
}

on start
{
  gBatterySoc = 95;
  gChargingState = 0;
  gEngineTorque = 0;
  gLastState = -1;
  gLastDuty = -1;
  gLastPressure = -1;
  setTimer(tFpcmCycle, 100);
  write("[FPCM] start");
}

on message frmFuelBatteryStateMsg
{
  gBatterySoc = clampRange((int)this.BatterySoc, 0, 100);
  gChargingState = clampRange((int)this.ChargingState, 0, 3);
}

on message frmEngineTorqueMsg
{
  gEngineTorque = clampRange((int)this.EngineTorqueAct, 0, 65535);
}

on timer tFpcmCycle
{
  message frmFpcmStateMsg mFpcm;
  int driveState;
  int speed;
  int state;
  int duty;
  int pressure;

  driveState = clampRange((int)@Core::driveStateNorm, 0, 3);
  speed = clampRange((int)@Core::vehicleSpeedNorm, 0, 255);

  if (driveState > 0 || gEngineTorque > 20)
  {
    state = 2;
    duty = 35 + (gEngineTorque / 6) + (speed / 12);
  }
  else if (gChargingState == 2 || gBatterySoc < 25)
  {
    state = 1;
    duty = 25;
  }
  else
  {
    state = 0;
    duty = 0;
  }

  duty = clampRange(duty, 0, 100);
  pressure = (state == 0) ? 0 : clampRange(120 + (duty * 2), 0, 255);

  mFpcm.FpcmState = clampRange(state, 0, 7);
  mFpcm.PumpDuty = duty;
  mFpcm.LinePressure = pressure;
  output(mFpcm);

  if (mFpcm.FpcmState != gLastState ||
      mFpcm.PumpDuty != gLastDuty ||
      mFpcm.LinePressure != gLastPressure)
  {
    write("[FPCM] state=%d duty=%d pressure=%d soc=%d torque=%d",
          mFpcm.FpcmState,
          mFpcm.PumpDuty,
          mFpcm.LinePressure,
          gBatterySoc,
          gEngineTorque);
    gLastState = mFpcm.FpcmState;
    gLastDuty = mFpcm.PumpDuty;
    gLastPressure = mFpcm.LinePressure;
  }

  setTimer(tFpcmCycle, 100);
}

on stopMeasurement
{
  cancelTimer(tFpcmCycle);
}
