includes
{
  #include "..\\common\\CAPL_COMMON.cin"
}

variables
{
  msTimer tDmsCycle;
  int gLastActive;
  int gLastAttention;
  int gLastFatigueWarn;
  int gLastSeatBelt;
}

void publishDmsState()
{
  message frmDmsStateMsg mDms;
  int vehicleSpeed;
  int alertLevel;
  int driverSeatBelt;
  int active;
  int attentionLevel;
  int fatigueWarn;

  vehicleSpeed = clampRange((int)@Core::vehicleSpeedNorm, 0, 255);
  alertLevel = clampRange((int)@Core::selectedAlertLevel, 0, 7);
  driverSeatBelt = clampRange((int)@CoreState::driverSeatBelt, 0, 1);

  active = vehicleSpeed >= 20 ? 1 : 0;
  attentionLevel = 1;
  fatigueWarn = 0;

  if (active == 1)
  {
    if (alertLevel >= 5)
    {
      attentionLevel = 3;
      fatigueWarn = 1;
    }
    else if (alertLevel >= 3 || driverSeatBelt == 0)
    {
      attentionLevel = 2;
    }
  }

  mDms.DriverMonitorActive = active;
  mDms.AttentionLevel = attentionLevel;
  mDms.FatigueWarn = fatigueWarn;
  mDms.DriverSeatBelt = driverSeatBelt;
  mDms.VehicleSpeed = vehicleSpeed;
  output(mDms);

  if (active != gLastActive ||
      attentionLevel != gLastAttention ||
      fatigueWarn != gLastFatigueWarn ||
      driverSeatBelt != gLastSeatBelt)
  {
    write("[DMS] active=%d attention=%d fatigue=%d belt=%d speed=%d alert=%d",
          active,
          attentionLevel,
          fatigueWarn,
          driverSeatBelt,
          vehicleSpeed,
          alertLevel);
    gLastActive = active;
    gLastAttention = attentionLevel;
    gLastFatigueWarn = fatigueWarn;
    gLastSeatBelt = driverSeatBelt;
  }
}

on start
{
  gLastActive = -1;
  gLastAttention = -1;
  gLastFatigueWarn = -1;
  gLastSeatBelt = -1;
  setTimer(tDmsCycle, 100);
  write("[DMS] start");
}

on timer tDmsCycle
{
  publishDmsState();
  setTimer(tDmsCycle, 100);
}

on stopMeasurement
{
  cancelTimer(tDmsCycle);
}
