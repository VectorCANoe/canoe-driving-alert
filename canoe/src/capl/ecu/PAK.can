includes
{
  #include "..\\common\\CAPL_COMMON.cin"
}

variables
{
  msTimer tPaakCycle;
  int gDkeyState;
  int gDkeyAuth;
  int gSignalBars;
  int gLastState;
  int gLastAuth;
  int gLastProx;
  int gLastLatency;
}

on start
{
  gDkeyState = 0;
  gDkeyAuth = 0;
  gSignalBars = 0;
  gLastState = -1;
  gLastAuth = -1;
  gLastProx = -1;
  gLastLatency = -1;
  setTimer(tPaakCycle, 100);
  write("[PAK] start");
}

on message frmDigitalKeyStateMsg
{
  gDkeyState = clampRange((int)this.DKeyState, 0, 7);
  gDkeyAuth = clampRange((int)this.AuthMode, 0, 3);
}

on message frmTmuServiceStateMsg
{
  gSignalBars = clampRange((int)this.SignalBars, 0, 15);
}

on timer tPaakCycle
{
  message frmPhoneAsKeyStateMsg mPaak;
  int driveState;
  int proxState;
  int latency;

  driveState = clampRange((int)@Core::driveStateNorm, 0, 3);
  proxState = 0;
  if (gSignalBars >= 2)
  {
    proxState = 1;
  }
  if (gSignalBars >= 4 && driveState == 0)
  {
    proxState = 2;
  }
  latency = clampRange(200 - (gSignalBars * 30), 20, 255);

  mPaak.PaakState = clampRange(gDkeyState, 0, 7);
  mPaak.AuthLevel = clampRange(gDkeyAuth, 0, 3);
  mPaak.ProximityState = clampRange(proxState, 0, 3);
  mPaak.SyncLatency = latency;
  output(mPaak);

  if (mPaak.PaakState != gLastState ||
      mPaak.AuthLevel != gLastAuth ||
      mPaak.ProximityState != gLastProx ||
      mPaak.SyncLatency != gLastLatency)
  {
    write("[PAK] state=%d auth=%d prox=%d latency=%d bars=%d",
          mPaak.PaakState,
          mPaak.AuthLevel,
          mPaak.ProximityState,
          mPaak.SyncLatency,
          gSignalBars);
    gLastState = mPaak.PaakState;
    gLastAuth = mPaak.AuthLevel;
    gLastProx = mPaak.ProximityState;
    gLastLatency = mPaak.SyncLatency;
  }

  setTimer(tPaakCycle, 100);
}

on stopMeasurement
{
  cancelTimer(tPaakCycle);
}

