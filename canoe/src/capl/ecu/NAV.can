includes
{
  #include "..\\common\\CAPL_COMMON.cin"
}

variables
{
  msTimer tNavModuleCycle;
  int gRoadZone;
  int gNavDirection;
  int gZoneDistance;
  int gSpeedLimit;
  int gLastNavState;
  int gLastRouteClass;
  int gLastGuideType;
  int gLastEtaMinutes;
}

int calcBaseZoneContext(int roadZone, int navDirection)
{
  if (roadZone == 1)
  {
    return 1;
  }
  if (roadZone == 2)
  {
    return 2;
  }
  if (roadZone == 3)
  {
    return (navDirection == 2) ? 4 : 3;
  }
  return 0;
}

void syncNavInputs()
{
  gRoadZone = clampRange((int)@Infotainment::roadZone, 0, 3);
  gNavDirection = clampRange((int)@Infotainment::navDirection, 0, 3);
  gZoneDistance = clampRange((int)@Infotainment::zoneDistance, 0, 255);
  gSpeedLimit = clampRange((int)@Infotainment::speedLimit, 0, 255);

  if (gSpeedLimit == 0)
  {
    gSpeedLimit = 30;
  }

  @Core::baseZoneContext = calcBaseZoneContext(gRoadZone, gNavDirection);
  @Core::speedLimitNorm = gSpeedLimit;
}

void publishNavState()
{
  message frmNaviGuideStateMsg mGuide;
  message frmNavigationRouteMsg mRouteBase;
  message frmMapRenderStateMsg mMap;
  message frmRouteAlertMsg mRoute;
  message frmTrafficEventMsg mTraffic;
  message frmNavModuleStateMsg mNavState;
  int navState;
  int etaMinutes;
  int trafficSeverity;

  navState = (gRoadZone > 0) ? 1 : 0;
  if (gRoadZone == 3)
  {
    navState = 2;
  }
  if (gZoneDistance <= 15 && navState > 0)
  {
    navState = 3;
  }

  etaMinutes = clampRange(gZoneDistance / 10, 0, 255);
  trafficSeverity = (gRoadZone == 1) ? 3 : ((gRoadZone > 0) ? 2 : 0);

  mMap.MapRenderState = (gRoadZone > 0) ? 1 : 0;
  mMap.ZoomLevel = (gRoadZone == 2) ? 12 : 16;
  mMap.TileLoadPercent = (gRoadZone > 0) ? 95 : 70;
  output(mMap);

  mGuide.GuideLaneState = (gRoadZone == 3) ? gNavDirection : 0;
  mGuide.GuideConfidence = (gRoadZone == 3) ? 50 : ((gRoadZone > 0) ? 20 : 10);
  output(mGuide);

  mRouteBase.RouteClass = gRoadZone;
  mRouteBase.GuideType = gNavDirection;
  mRouteBase.RouteProgress = (gZoneDistance > 100) ? 20 : 80;
  mRouteBase.EtaMinutes = etaMinutes;
  output(mRouteBase);

  mRoute.RouteAlertType = gRoadZone;
  mRoute.RouteAlertPrio = (gRoadZone == 1) ? 5 : ((gRoadZone > 0) ? 2 : 0);
  mRoute.RouteAlertActive = (gRoadZone > 0) ? 1 : 0;
  mRoute.RouteAlertEta = gZoneDistance;
  output(mRoute);

  mTraffic.TrafficEventType = gRoadZone;
  mTraffic.TrafficSeverity = trafficSeverity;
  mTraffic.TrafficDistance = gZoneDistance;
  output(mTraffic);

  mNavState.NavSessionState = clampRange(navState, 0, 3);
  mNavState.NavRouteClass = clampRange(gRoadZone, 0, 3);
  mNavState.NavGuideType = clampRange(gNavDirection, 0, 3);
  mNavState.NavTrafficSeverity = clampRange(trafficSeverity, 0, 3);
  mNavState.NavEtaMinutes = etaMinutes;
  mNavState.NavSpeedLimit = clampRange(gSpeedLimit, 0, 255);
  output(mNavState);

  if (mNavState.NavSessionState != gLastNavState ||
      mNavState.NavRouteClass != gLastRouteClass ||
      mNavState.NavGuideType != gLastGuideType ||
      mNavState.NavEtaMinutes != gLastEtaMinutes)
  {
    write("[NAV] state=%d class=%d guide=%d eta=%d dist=%d limit=%d",
          mNavState.NavSessionState,
          mNavState.NavRouteClass,
          mNavState.NavGuideType,
          mNavState.NavEtaMinutes,
          gZoneDistance,
          gSpeedLimit);
    gLastNavState = mNavState.NavSessionState;
    gLastRouteClass = mNavState.NavRouteClass;
    gLastGuideType = mNavState.NavGuideType;
    gLastEtaMinutes = mNavState.NavEtaMinutes;
  }
}

on start
{
  gLastNavState = -1;
  gLastRouteClass = -1;
  gLastGuideType = -1;
  gLastEtaMinutes = -1;
  syncNavInputs();
  setTimer(tNavModuleCycle, 100);
  write("[NAV] start");
}

on timer tNavModuleCycle
{
  publishNavState();
  setTimer(tNavModuleCycle, 100);
}

on message frmNavContextCanMsg
{
  @Infotainment::roadZone = clampRange((int)this.gRoadZone, 0, 3);
  @Infotainment::navDirection = clampRange((int)this.gNavDirection, 0, 3);
  @Infotainment::zoneDistance = clampRange((int)this.gZoneDistance, 0, 255);
  @Infotainment::speedLimit = clampRange((int)this.gSpeedLimit, 0, 255);
  syncNavInputs();
}

on sysvar Infotainment::roadZone
{
  syncNavInputs();
}

on sysvar Infotainment::navDirection
{
  syncNavInputs();
}

on sysvar Infotainment::zoneDistance
{
  syncNavInputs();
}

on sysvar Infotainment::speedLimit
{
  syncNavInputs();
}

on stopMeasurement
{
  cancelTimer(tNavModuleCycle);
}

