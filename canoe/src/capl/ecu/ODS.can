includes
{
  #include "..\\common\\CAPL_COMMON.cin"
}

variables
{
  int gDiagPending;
  int gLastDiagSid;
  int gLastDiagDidHigh;
  int gLastDiagDidLow;
  msTimer tOdsCycle;
  int gPassengerSeatBelt;
  int gPassengerSeatPos;
  int gLastDetected;
  int gLastWeightClass;
  int gLastSuppress;
  int gLastChildSeat;
}

on start
{
  gDiagPending = 0;
  gLastDiagSid = 0;
  gLastDiagDidHigh = 0;
  gLastDiagDidLow = 0;
  gPassengerSeatBelt = 1;
  gPassengerSeatPos = 118;
  gLastDetected = -1;
  gLastWeightClass = -1;
  gLastSuppress = -1;
  gLastChildSeat = -1;
  setTimer(tOdsCycle, 100);
  write("[ODS] start");
}

on message frmSeatBeltStateMsg
{
  gPassengerSeatBelt = clampRange((int)this.PassengerSeatBelt, 0, 1);
}

on message frmSeatStateMsg
{
  gPassengerSeatPos = clampRange((int)this.PassengerSeatPos, 0, 255);
}

on timer tOdsCycle
{
  if (gDiagPending == 1)
  {
    message frmOdsDiagResMsg mDiagRes;

    mDiagRes.OdsDiagRespCode = getBasicDiagRespCode(gLastDiagSid);
    mDiagRes.OdsDiagData0 = gLastDiagDidHigh;
    mDiagRes.OdsDiagData1 = gLastDiagDidLow;
    output(mDiagRes);
    gDiagPending = 0;
  }

  message frmOdsStateMsg mOds;
  int occupantDetected;
  int weightClass;
  int airbagSuppress;
  int childSeatDetected;

  occupantDetected = (gPassengerSeatPos > 20) ? 1 : 0;
  childSeatDetected = (occupantDetected == 1 && gPassengerSeatBelt == 0 && gPassengerSeatPos < 80) ? 1 : 0;
  if (occupantDetected == 0)
  {
    weightClass = 0;
  }
  else if (childSeatDetected == 1)
  {
    weightClass = 1;
  }
  else if (gPassengerSeatPos < 140)
  {
    weightClass = 2;
  }
  else
  {
    weightClass = 3;
  }
  airbagSuppress = (childSeatDetected == 1 || occupantDetected == 0) ? 1 : 0;

  mOds.OccupantDetected = occupantDetected;
  mOds.WeightClass = clampRange(weightClass, 0, 7);
  mOds.AirbagSuppress = airbagSuppress;
  mOds.ChildSeatDetected = childSeatDetected;
  output(mOds);

  if (mOds.OccupantDetected != gLastDetected ||
      mOds.WeightClass != gLastWeightClass ||
      mOds.AirbagSuppress != gLastSuppress ||
      mOds.ChildSeatDetected != gLastChildSeat)
  {
    write("[ODS] occ=%d class=%d suppress=%d child=%d pos=%d",
          mOds.OccupantDetected,
          mOds.WeightClass,
          mOds.AirbagSuppress,
          mOds.ChildSeatDetected,
          gPassengerSeatPos);
    gLastDetected = mOds.OccupantDetected;
    gLastWeightClass = mOds.WeightClass;
    gLastSuppress = mOds.AirbagSuppress;
    gLastChildSeat = mOds.ChildSeatDetected;
  }

  setTimer(tOdsCycle, 100);
}

on message frmOdsDiagReqMsg
{
  gLastDiagSid = clampRange((int)this.OdsDiagServiceId, 0, 255);
  gLastDiagDidHigh = clampRange((int)this.OdsDiagDidHigh, 0, 255);
  gLastDiagDidLow = clampRange((int)this.OdsDiagDidLow, 0, 255);
  gDiagPending = 1;
}

on stopMeasurement
{
  cancelTimer(tOdsCycle);
}
