includes
{
  #include "..\\common\\CAPL_COMMON.cin"
}

variables
{
  msTimer tDatcCycle;
  int gRemoteClimateReq;
  int gTmuLinkState;
  int gTmuServiceMode;
  int gSignalBars;
  int gCabinTemp;
  int gLastCabinSetTemp;
  int gLastBlowerLevel;
  int gLastAcOn;
  int gLastVentMode;
  int gLastDefogMode;
}

void publishDatcState()
{
  message frmHvacStateMsg mHvacState;
  message frmHvacActuatorMsg mHvacAct;
  int failSafeMode;
  int cabinSetTemp;
  int blowerLevel;
  int acOn;
  int ventMode;
  int defogMode;
  int fanRpmStep;

  failSafeMode = clampRange((int)@Core::failSafeMode, 0, 2);

  cabinSetTemp = 22;
  blowerLevel = 2;
  acOn = 0;
  ventMode = 1;
  defogMode = 0;
  fanRpmStep = 35;

  if (gRemoteClimateReq == 1 && gTmuServiceMode == 1 && failSafeMode == 0)
  {
    cabinSetTemp = 24;
    blowerLevel = 5;
    acOn = 1;
    ventMode = 2;
    fanRpmStep = 80;
  }
  else if (gCabinTemp >= 28)
  {
    cabinSetTemp = 21;
    blowerLevel = 4;
    acOn = 1;
    ventMode = 2;
    fanRpmStep = 65;
  }

  if (failSafeMode > 0)
  {
    blowerLevel = 1;
    fanRpmStep = 20;
    defogMode = 1;
  }

  mHvacState.CabinSetTemp = cabinSetTemp;
  mHvacState.BlowerLevel = blowerLevel;
  mHvacState.AcCompressorOn = acOn;
  output(mHvacState);

  mHvacAct.VentMode = ventMode;
  mHvacAct.RecircMode = (acOn == 1) ? 1 : 0;
  mHvacAct.DefogMode = defogMode;
  mHvacAct.FanRpmStep = fanRpmStep;
  output(mHvacAct);

  if (cabinSetTemp != gLastCabinSetTemp ||
      blowerLevel != gLastBlowerLevel ||
      acOn != gLastAcOn ||
      ventMode != gLastVentMode ||
      defogMode != gLastDefogMode)
  {
    write("[DATC] set=%d blower=%d ac=%d vent=%d defog=%d remote=%d link=%d service=%d bars=%d cabin=%d",
          cabinSetTemp,
          blowerLevel,
          acOn,
          ventMode,
          defogMode,
          gRemoteClimateReq,
          gTmuLinkState,
          gTmuServiceMode,
          gSignalBars,
          gCabinTemp);
    gLastCabinSetTemp = cabinSetTemp;
    gLastBlowerLevel = blowerLevel;
    gLastAcOn = acOn;
    gLastVentMode = ventMode;
    gLastDefogMode = defogMode;
  }
}

on start
{
  gRemoteClimateReq = 0;
  gTmuLinkState = 0;
  gTmuServiceMode = 0;
  gSignalBars = 0;
  gCabinTemp = 24;
  gLastCabinSetTemp = -1;
  gLastBlowerLevel = -1;
  gLastAcOn = -1;
  gLastVentMode = -1;
  gLastDefogMode = -1;

  setTimer(tDatcCycle, 100);
  write("[DATC] start");
}

on timer tDatcCycle
{
  publishDatcState();
  setTimer(tDatcCycle, 100);
}

on message frmTmuServiceStateMsg
{
  gTmuLinkState = clampRange((int)this.TmuLinkState, 0, 3);
  gTmuServiceMode = clampRange((int)this.TmuServiceMode, 0, 3);
  gRemoteClimateReq = clampRange((int)this.RemoteClimateReq, 0, 1);
  gSignalBars = clampRange((int)this.SignalBars, 0, 15);
}

on message frmCabinAirStateMsg
{
  gCabinTemp = clampRange((int)this.CabinTemp, 0, 100);
}

on stopMeasurement
{
  cancelTimer(tDatcCycle);
}
