includes
{
  #include "..\\common\\CAPL_COMMON.cin"
}

variables
{
  msTimer tSunroofCycle;
  int gLastPosition;
  int gLastTiltState;
  int gLastSunshadeState;
}

on start
{
  gLastPosition = -1;
  gLastTiltState = -1;
  gLastSunshadeState = -1;
  setTimer(tSunroofCycle, 100);
  write("[SRF] start");
}

on timer tSunroofCycle
{
  message frmSunroofStateMsg mRoof;
  int position;
  int tiltState;
  int sunshadeState;

  position = 0;
  tiltState = 0;
  sunshadeState = 0;

  mRoof.SunroofPosition = clampRange(position, 0, 100);
  mRoof.SunroofTiltState = clampRange(tiltState, 0, 3);
  mRoof.SunshadeState = clampRange(sunshadeState, 0, 3);
  output(mRoof);

  if (mRoof.SunroofPosition != gLastPosition ||
      mRoof.SunroofTiltState != gLastTiltState ||
      mRoof.SunshadeState != gLastSunshadeState)
  {
    write("[SRF] pos=%d tilt=%d shade=%d",
          mRoof.SunroofPosition,
          mRoof.SunroofTiltState,
          mRoof.SunshadeState);
    gLastPosition = mRoof.SunroofPosition;
    gLastTiltState = mRoof.SunroofTiltState;
    gLastSunshadeState = mRoof.SunshadeState;
  }

  setTimer(tSunroofCycle, 100);
}

on stopMeasurement
{
  cancelTimer(tSunroofCycle);
}

