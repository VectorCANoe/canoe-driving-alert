includes
{
  #include "..\\common\\CAPL_COMMON.cin"
}

variables
{
  msTimer tBiometricCycle;
  int gOccupancyState;
  int gAirQualityState;
  int gCabinAlertState;
  int gPresenceScore;
  int gLastAuthState;
  int gLastFactorMode;
  int gLastPresenceConfidence;
}

on start
{
  gOccupancyState = 0;
  gAirQualityState = 0;
  gCabinAlertState = 0;
  gPresenceScore = 0;
  gLastAuthState = -1;
  gLastFactorMode = -1;
  gLastPresenceConfidence = -1;
  setTimer(tBiometricCycle, 100);
  write("[BIOMETRIC_AUTH] start");
}

on message frmCabinSensingStateMsg
{
  gOccupancyState = clampRange((int)this.OccupancyState, 0, 7);
  gAirQualityState = clampRange((int)this.AirQualityState, 0, 7);
  gCabinAlertState = clampRange((int)this.CabinAlertState, 0, 3);
  gPresenceScore = clampRange((int)this.CabinPresenceScore, 0, 100);
}

on timer tBiometricCycle
{
  message frmBiometricAuthStateMsg mAuth;
  int authState;
  int authFactorMode;
  int presenceConfidence;

  presenceConfidence = clampRange(gPresenceScore, 0, 100);
  if (gCabinAlertState >= 2)
  {
    authState = 3;
  }
  else if (gOccupancyState >= 2 && presenceConfidence >= 70)
  {
    authState = 2;
  }
  else if (presenceConfidence >= 40)
  {
    authState = 1;
  }
  else
  {
    authState = 0;
  }

  authFactorMode = (gAirQualityState >= 2) ? 2 : ((presenceConfidence >= 70) ? 1 : 0);

  mAuth.AuthState = clampRange(authState, 0, 7);
  mAuth.AuthFactorMode = clampRange(authFactorMode, 0, 3);
  mAuth.PresenceConfidence = clampRange(presenceConfidence, 0, 100);
  output(mAuth);

  if (mAuth.AuthState != gLastAuthState ||
      mAuth.AuthFactorMode != gLastFactorMode ||
      mAuth.PresenceConfidence != gLastPresenceConfidence)
  {
    write("[BIOMETRIC_AUTH] state=%d factor=%d confidence=%d occ=%d",
          mAuth.AuthState,
          mAuth.AuthFactorMode,
          mAuth.PresenceConfidence,
          gOccupancyState);
    gLastAuthState = mAuth.AuthState;
    gLastFactorMode = mAuth.AuthFactorMode;
    gLastPresenceConfidence = mAuth.PresenceConfidence;
  }

  setTimer(tBiometricCycle, 100);
}

on stopMeasurement
{
  cancelTimer(tBiometricCycle);
}
