includes
{
  #include "..\\common\\CAPL_COMMON.cin"
}

variables
{
  msTimer tMcuCycle;
  int gTorqueLimit;
  int gSpeedLimit;
  int gEnergyFlowMode;
  int gRegenLevel;
  int gLastState;
  int gLastTorque;
  long gLastSpeed;
}

on start
{
  gTorqueLimit = 0;
  gSpeedLimit = 0;
  gEnergyFlowMode = 0;
  gRegenLevel = 0;
  gLastState = -1;
  gLastTorque = -1;
  gLastSpeed = -1;
  setTimer(tMcuCycle, 100);
  write("[MCU] start");
}

on message frmPowerLimitMsg
{
  gTorqueLimit = clampRange((int)this.TorqueLimit, 0, 255);
  gSpeedLimit = clampRange((int)this.SpeedLimit, 0, 255);
}

on message frmEnergyFlowStateMsg
{
  gEnergyFlowMode = clampRange((int)this.EnergyFlowMode, 0, 7);
  gRegenLevel = clampRange((int)this.RegenLevel, 0, 31);
}

on timer tMcuCycle
{
  message frmMcuStateMsg mMcu;
  int mcuState;
  int motorTorqueCmd;
  long motorSpeedRpm;

  if (gTorqueLimit > 0 || gEnergyFlowMode > 0)
  {
    mcuState = 2;
  }
  else
  {
    mcuState = 1;
  }

  motorTorqueCmd = gTorqueLimit;
  if (gEnergyFlowMode > 0)
  {
    motorTorqueCmd = clampRange(motorTorqueCmd + gRegenLevel, 0, 255);
  }

  motorSpeedRpm = (long)clampRange(gSpeedLimit, 0, 255) * 40;

  mMcu.McuState = clampRange(mcuState, 0, 7);
  mMcu.MotorTorqueCmd = clampRange(motorTorqueCmd, 0, 255);
  mMcu.MotorSpeedRpm = motorSpeedRpm & 0xFFFF;
  output(mMcu);

  if (mMcu.McuState != gLastState ||
      mMcu.MotorTorqueCmd != gLastTorque ||
      mMcu.MotorSpeedRpm != gLastSpeed)
  {
    write("[MCU] state=%d torque=%d speed=%ld flow=%d regen=%d",
          mMcu.McuState,
          mMcu.MotorTorqueCmd,
          mMcu.MotorSpeedRpm,
          gEnergyFlowMode,
          gRegenLevel);
    gLastState = mMcu.McuState;
    gLastTorque = mMcu.MotorTorqueCmd;
    gLastSpeed = mMcu.MotorSpeedRpm;
  }

  setTimer(tMcuCycle, 100);
}

on stopMeasurement
{
  cancelTimer(tMcuCycle);
}
