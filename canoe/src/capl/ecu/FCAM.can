includes
{
  #include "..\\common\\CAPL_COMMON.cin"
}

variables
{
  msTimer tFcamCycle;
  int gLastHealth;
  int gLastObjectDetected;
  int gLastLaneModelValid;
  int gLastConfidence;
}

void publishFcamState()
{
  message frmFcamStateMsg mFcam;
  int objectTrackValid;
  int objectConfidence;
  int selectedAlertType;
  int health;
  int objectDetected;
  int laneModelValid;

  objectTrackValid = clampRange((int)@Core::objectTrackValid, 0, 1);
  objectConfidence = clampRange((int)@Core::objectConfidence, 0, 100);
  selectedAlertType = clampRange((int)@Core::selectedAlertType, 0, 7);

  objectDetected = objectTrackValid;
  laneModelValid = ((selectedAlertType == 5 || selectedAlertType == 6) && objectConfidence >= 30) ? 1 : 0;

  if (objectConfidence >= 70)
  {
    health = 2;
  }
  else if (objectConfidence >= 30)
  {
    health = 1;
  }
  else
  {
    health = 0;
  }

  mFcam.CameraHealth = clampRange(health, 0, 3);
  mFcam.ObjectDetected = objectDetected;
  mFcam.LaneModelValid = laneModelValid;
  mFcam.Confidence = objectConfidence;
  output(mFcam);

  if (health != gLastHealth ||
      objectDetected != gLastObjectDetected ||
      laneModelValid != gLastLaneModelValid ||
      objectConfidence != gLastConfidence)
  {
    write("[FCAM] health=%d obj=%d lane=%d conf=%d alertType=%d",
          health,
          objectDetected,
          laneModelValid,
          objectConfidence,
          selectedAlertType);
    gLastHealth = health;
    gLastObjectDetected = objectDetected;
    gLastLaneModelValid = laneModelValid;
    gLastConfidence = objectConfidence;
  }
}

on start
{
  gLastHealth = -1;
  gLastObjectDetected = -1;
  gLastLaneModelValid = -1;
  gLastConfidence = -1;
  setTimer(tFcamCycle, 100);
  write("[FCAM] start");
}

on timer tFcamCycle
{
  publishFcamState();
  setTimer(tFcamCycle, 100);
}

on stopMeasurement
{
  cancelTimer(tFcamCycle);
}
