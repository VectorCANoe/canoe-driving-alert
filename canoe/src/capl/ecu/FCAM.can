includes
{
  #include "..\\common\\CAPL_COMMON.cin"
}

variables
{
  msTimer tFcamCycle;
  int gLastHealth;
  int gLastObjectDetected;
  int gLastLaneModelValid;
  int gLastConfidence;
  int gLastPathReady;
}

int fcamPathReady()
{
  int warningPathStatus;
  int e2eHealthState;
  int failSafeMode;

  warningPathStatus = clampRange((int)@CoreState::warningPathStatus, 0, 2);
  e2eHealthState = clampRange((int)@CoreState::e2eHealthState, 0, 2);
  failSafeMode = clampRange((int)@Core::failSafeMode, 0, 2);
  if (warningPathStatus >= 2 || e2eHealthState == 0 || failSafeMode >= 2)
  {
    return 0;
  }
  return 1;
}

int calcLaneModelValid(int baseZoneContext, int objectConfidence)
{
  if ((baseZoneContext == 2 || baseZoneContext == 3 || baseZoneContext == 4) &&
      objectConfidence >= 30)
  {
    return 1;
  }
  return 0;
}

void publishFcamState()
{
  message frmFcamStateMsg mFcam;
  int baseZoneContext;
  int objectTrackValid;
  int objectConfidence;
  int health;
  int objectDetected;
  int laneModelValid;
  int pathReady;

  baseZoneContext = clampRange((int)@Core::baseZoneContext, 0, 4);
  objectTrackValid = clampRange((int)@Core::objectTrackValid, 0, 1);
  objectConfidence = clampRange((int)@Core::objectConfidence, 0, 100);
  pathReady = fcamPathReady();

  objectDetected = objectTrackValid;
  laneModelValid = calcLaneModelValid(baseZoneContext, objectConfidence);

  if (objectConfidence >= 70)
  {
    health = 2;
  }
  else if (objectConfidence >= 30)
  {
    health = 1;
  }
  else
  {
    health = 0;
  }
  if (pathReady == 0)
  {
    health = 0;
    objectDetected = 0;
    laneModelValid = 0;
    objectConfidence = 0;
  }

  mFcam.CameraHealth = clampRange(health, 0, 3);
  mFcam.ObjectDetected = objectDetected;
  mFcam.LaneModelValid = laneModelValid;
  mFcam.Confidence = objectConfidence;
  output(mFcam);

  if (pathReady != gLastPathReady ||
      health != gLastHealth ||
      objectDetected != gLastObjectDetected ||
      laneModelValid != gLastLaneModelValid ||
      objectConfidence != gLastConfidence)
  {
    write("[FCAM] path=%d health=%d obj=%d lane=%d conf=%d zone=%d",
          pathReady,
          health,
          objectDetected,
          laneModelValid,
          objectConfidence,
          baseZoneContext);
    gLastPathReady = pathReady;
    gLastHealth = health;
    gLastObjectDetected = objectDetected;
    gLastLaneModelValid = laneModelValid;
    gLastConfidence = objectConfidence;
  }
}

on start
{
  gLastPathReady = -1;
  gLastHealth = -1;
  gLastObjectDetected = -1;
  gLastLaneModelValid = -1;
  gLastConfidence = -1;
  setTimer(tFcamCycle, 100);
  write("[FCAM] start");
}

on timer tFcamCycle
{
  publishFcamState();
  setTimer(tFcamCycle, 100);
}

on stopMeasurement
{
  cancelTimer(tFcamCycle);
}
