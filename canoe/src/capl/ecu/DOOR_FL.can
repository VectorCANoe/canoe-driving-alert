includes
{
  #include "..\\common\\CAPL_COMMON.cin"
}

variables
{
  msTimer tDoorFlCycle;
  int gLastLockState;
  int gLastOpenState;
  int gLastWindowPos;
}

on start
{
  gLastLockState = -1;
  gLastOpenState = -1;
  gLastWindowPos = -1;
  setTimer(tDoorFlCycle, 100);
  write("[DOOR_FL] start");
}

on timer tDoorFlCycle
{
  message frmDoorFlStateMsg mDoor;
  int lockState;
  int openState;
  int windowPos;

  lockState = 1;
  openState = 0;
  windowPos = 0;
  if ((int)@Core::timeoutClear == 1)
  {
    lockState = 0;
    openState = 1;
    windowPos = 10;
  }

  mDoor.DoorFlLockState = clampRange(lockState, 0, 3);
  mDoor.DoorFlOpenState = clampRange(openState, 0, 1);
  mDoor.DoorFlWindowPos = clampRange(windowPos, 0, 100);
  output(mDoor);

  if (mDoor.DoorFlLockState != gLastLockState ||
      mDoor.DoorFlOpenState != gLastOpenState ||
      mDoor.DoorFlWindowPos != gLastWindowPos)
  {
    write("[DOOR_FL] lock=%d open=%d win=%d",
          mDoor.DoorFlLockState,
          mDoor.DoorFlOpenState,
          mDoor.DoorFlWindowPos);
    gLastLockState = mDoor.DoorFlLockState;
    gLastOpenState = mDoor.DoorFlOpenState;
    gLastWindowPos = mDoor.DoorFlWindowPos;
  }

  setTimer(tDoorFlCycle, 100);
}

on stopMeasurement
{
  cancelTimer(tDoorFlCycle);
}
