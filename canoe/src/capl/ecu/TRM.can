includes
{
  #include "..\\common\\CAPL_COMMON.cin"
}

variables
{
  msTimer tTrailerCtrlCycle;
  int gLeftDetected;
  int gLeftRisk;
  int gRightDetected;
  int gRightRisk;
  int gLastTrailerDetected;
  int gLastTowMode;
  int gLastSwayRisk;
  int gLastStabilityAssistReq;
  int gLastRearRisk;
}

void publishTrailerCtrlState()
{
  message frmTrailerCtrlStateMsg mTrailer;
  int vehicleSpeed;
  int turnLampState;
  int trailerDetected;
  int towMode;
  int rearRiskLevel;
  int swayRisk;
  int stabilityAssistReq;

  vehicleSpeed = clampRange((int)@Core::vehicleSpeedNorm, 0, 255);
  turnLampState = clampRange((int)@CoreState::turnLampState, 0, 3);
  rearRiskLevel = (gLeftRisk > gRightRisk) ? gLeftRisk : gRightRisk;

  trailerDetected = ((gLeftDetected == 1 && gRightDetected == 1) || vehicleSpeed >= 60) ? 1 : 0;
  towMode = trailerDetected == 1 ? 1 : 0;
  if (trailerDetected == 1 && vehicleSpeed >= 90)
  {
    towMode = 2;
  }

  swayRisk = 0;
  if (trailerDetected == 1 && rearRiskLevel >= 40)
  {
    swayRisk = 2;
  }
  else if (trailerDetected == 1 && turnLampState != 0)
  {
    swayRisk = 1;
  }

  stabilityAssistReq = (swayRisk >= 2) ? 1 : 0;

  mTrailer.TrailerDetected = trailerDetected;
  mTrailer.TowMode = clampRange(towMode, 0, 3);
  mTrailer.SwayRisk = clampRange(swayRisk, 0, 3);
  mTrailer.StabilityAssistReq = stabilityAssistReq;
  mTrailer.TurnLampState = clampRange(turnLampState, 0, 3);
  mTrailer.RearRiskLevel = clampRange(rearRiskLevel, 0, 100);
  output(mTrailer);

  if (trailerDetected != gLastTrailerDetected ||
      towMode != gLastTowMode ||
      swayRisk != gLastSwayRisk ||
      stabilityAssistReq != gLastStabilityAssistReq ||
      rearRiskLevel != gLastRearRisk)
  {
    write("[TRM] trailer=%d tow=%d sway=%d assist=%d risk=%d lamp=%d speed=%d",
          trailerDetected,
          towMode,
          swayRisk,
          stabilityAssistReq,
          rearRiskLevel,
          turnLampState,
          vehicleSpeed);
    gLastTrailerDetected = trailerDetected;
    gLastTowMode = towMode;
    gLastSwayRisk = swayRisk;
    gLastStabilityAssistReq = stabilityAssistReq;
    gLastRearRisk = rearRiskLevel;
  }
}

on start
{
  gLeftDetected = 0;
  gLeftRisk = 0;
  gRightDetected = 0;
  gRightRisk = 0;
  gLastTrailerDetected = -1;
  gLastTowMode = -1;
  gLastSwayRisk = -1;
  gLastStabilityAssistReq = -1;
  gLastRearRisk = -1;
  setTimer(tTrailerCtrlCycle, 100);
  write("[TRM] start");
}

on timer tTrailerCtrlCycle
{
  publishTrailerCtrlState();
  setTimer(tTrailerCtrlCycle, 100);
}

on message frmSrrRlStateMsg
{
  gLeftDetected = clampRange((int)this.SideObjectDetected, 0, 1);
  gLeftRisk = clampRange((int)this.SideRiskLevel, 0, 100);
}

on message frmSrrRrStateMsg
{
  gRightDetected = clampRange((int)this.SideObjectDetected, 0, 1);
  gRightRisk = clampRange((int)this.SideRiskLevel, 0, 100);
}

on stopMeasurement
{
  cancelTimer(tTrailerCtrlCycle);
}
