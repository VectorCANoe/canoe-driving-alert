includes
{
}

variables
{
  msTimer tRoute100;
  int gRoutingPolicy;
  int gBoundaryStatus;
  int gEngineState;
  int gDriveMode;
  int gSpeedNorm;
  int gSpeedLimitNorm;
  int gChassisRxAgeMs;
  int gBodyRxAgeMs;
  int gInfoRxAgeMs;
  int gPtAliveCnt;
  int gDiagPending;
  int gLastDiagSid;
  int gLastDiagDidHigh;
  int gLastDiagDidLow;
}

int clampRange(int value, int minValue, int maxValue)
{
  if (value < minValue)
  {
    return minValue;
  }
  if (value > maxValue)
  {
    return maxValue;
  }
  return value;
}

on start
{
  gRoutingPolicy = 1;
  gBoundaryStatus = 0;
  gEngineState = 0;
  gDriveMode = 0;
  gSpeedNorm = 0;
  gSpeedLimitNorm = 30;
  gChassisRxAgeMs = 10000;
  gBodyRxAgeMs = 10000;
  gInfoRxAgeMs = 10000;
  gPtAliveCnt = 0;
  gDiagPending = 0;
  gLastDiagSid = 0;
  gLastDiagDidHigh = 0;
  gLastDiagDidLow = 0;
  setTimer(tRoute100, 100);
  write("[DOMAIN_GW_ROUTER] start");
}

on message frmPowertrainGatewayMsg
{
  /* Keep input shadow for compatibility with SIL replay blocks. */
  gRoutingPolicy = this.RoutingPolicy;
  gBoundaryStatus = this.BoundaryStatus;
}

on message frmVehicleModeMsg
{
  /* Keep input shadow for compatibility with SIL replay blocks. */
  gDriveMode = clampRange(this.DriveMode, 0, 7);
  gEngineState = clampRange(this.PowertrainState, 0, 255);
}

on message frmIgnitionEngineMsg
{
  gEngineState = clampRange(this.EngineState, 0, 255);
}

on message frmGearStateMsg
{
  gDriveMode = clampRange(this.GearState, 0, 7);
}

on message frmChassisHealthMsg
{
  gChassisRxAgeMs = 0;
}

on message frmBodyHealthMsg
{
  gBodyRxAgeMs = 0;
}

on message frmInfotainmentHealthMsg
{
  gInfoRxAgeMs = 0;
}

on message frmPtDiagReqMsg
{
  gLastDiagSid = clampRange(this.PtDiagServiceId, 0, 255);
  gLastDiagDidHigh = clampRange(this.PtDiagDidHigh, 0, 255);
  gLastDiagDidLow = clampRange(this.PtDiagDidLow, 0, 255);
  gDiagPending = 1;
}

on timer tRoute100
{
  message frmPowertrainGatewayMsg mPtGw;
  message frmVehicleModeMsg mVehMode;
  message frmPowerLimitMsg mPowerLimit;
  message frmCruiseStateMsg mCruise;
  message frmPowertrainHealthMsg mPtHealth;
  message frmPtDiagResMsg mPtDiagRes;
  message frmEnergyFlowStateMsg mEnergy;
  message frmPowertrainCtrlAuthMsg mCtrlAuth;
  int selectedAlertLevel;
  int timeoutClear;

  gSpeedNorm = clampRange((int)@Core::vehicleSpeedNorm, 0, 255);
  gSpeedLimitNorm = clampRange((int)@Core::speedLimitNorm, 0, 255);
  gDriveMode = clampRange((int)@Core::driveStateNorm, 0, 7);
  selectedAlertLevel = clampRange((int)@Core::selectedAlertLevel, 0, 7);
  timeoutClear = clampRange((int)@Core::timeoutClear, 0, 1);

  gChassisRxAgeMs = clampRange(gChassisRxAgeMs + 100, 0, 60000);
  gBodyRxAgeMs = clampRange(gBodyRxAgeMs + 100, 0, 60000);
  gInfoRxAgeMs = clampRange(gInfoRxAgeMs + 100, 0, 60000);
  gBoundaryStatus = ((gChassisRxAgeMs <= 300) && (gBodyRxAgeMs <= 300) && (gInfoRxAgeMs <= 300)) ? 1 : 0;

  if (timeoutClear == 1)
  {
    gRoutingPolicy = 0;
  }
  else if (selectedAlertLevel >= 4)
  {
    gRoutingPolicy = 2;
  }
  else
  {
    gRoutingPolicy = 1;
  }

  /* Req_110/111: expose domain boundary and routing state for SIL verification */
  @CoreState::domainBoundaryStatus = gBoundaryStatus;
  @CoreState::routingPolicy = gRoutingPolicy;

  mPtGw.RoutingPolicy = gRoutingPolicy;
  mPtGw.BoundaryStatus = gBoundaryStatus;
  output(mPtGw);

  mVehMode.DriveMode = gDriveMode;
  mVehMode.EcoMode = (gDriveMode == 3) ? 1 : 0;
  mVehMode.SportMode = (gSpeedNorm > 80) ? 1 : 0;
  mVehMode.SnowMode = (gDriveMode == 0 && gSpeedNorm < 20) ? 1 : 0;
  mVehMode.PowertrainState = gEngineState;
  output(mVehMode);

  mPowerLimit.TorqueLimit = clampRange(gSpeedNorm * 2, 0, 255);
  mPowerLimit.SpeedLimit = gSpeedLimitNorm;
  output(mPowerLimit);

  mCruise.CruiseState = (gDriveMode == 3) ? 1 : 0;
  mCruise.GapLevel = 2;
  mCruise.CruiseSetSpeed = gSpeedLimitNorm;
  output(mCruise);

  mPtHealth.PtAliveCnt = gPtAliveCnt & 0xFF;
  mPtHealth.PtDiagState = 0;
  mPtHealth.PtFailCode = 0;
  output(mPtHealth);
  gPtAliveCnt = (gPtAliveCnt + 1) & 0xFF;

  mEnergy.EnergyFlowMode = (gDriveMode == 3) ? 1 : 0;
  mEnergy.RegenLevel = (selectedAlertLevel >= 3) ? 8 : 2;
  mEnergy.PowerBalance = (gRoutingPolicy == 2) ? 60 : 50;
  output(mEnergy);

  mCtrlAuth.CtrlAuthLevel = (gBoundaryStatus == 1) ? 3 : 1;
  mCtrlAuth.CtrlAuthSource = 1;
  output(mCtrlAuth);

  if (gDiagPending == 1)
  {
    mPtDiagRes.PtDiagRespCode = (gLastDiagSid == 0x22) ? 0x62 : 0x7F;
    mPtDiagRes.PtDiagData0 = gLastDiagDidHigh;
    mPtDiagRes.PtDiagData1 = gLastDiagDidLow;
    output(mPtDiagRes);
    gDiagPending = 0;
  }

  setTimer(tRoute100, 100);
}
