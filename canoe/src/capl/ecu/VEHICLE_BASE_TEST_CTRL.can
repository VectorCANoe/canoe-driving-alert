includes
{
}

variables
{
  int gLastBaseScenarioId;
  int gBaseScenarioResult;
  int gFlowCoverage;
  int gTestHealth;
  int gTraceSnapshotId;
}

on start
{
  gLastBaseScenarioId  = 0;
  gBaseScenarioResult  = 0;
  gFlowCoverage        = 0;
  gTestHealth          = 0xFF;
  gTraceSnapshotId     = 0;
  write("[VAL_BASELINE_CTRL] start");
}

on message frmTestResultMsg
{
  /* Aggregate SIL scenario result into base test result frame */
  message frmBaseTestResultMsg mResult;
  int pass;

  pass = this.ScenarioResult;

  gBaseScenarioResult  = pass;
  gTraceSnapshotId     = (int)@CoreState::arbitrationSnapshotId;
  gTestHealth          = (int)@CoreState::domainBoundaryStatus * 0xFF;
  gFlowCoverage        = pass ? 0x7FFF : 0;
  gLastBaseScenarioId  = gLastBaseScenarioId + 1;
  if (gLastBaseScenarioId > 255) gLastBaseScenarioId = 1;

  mResult.BaseScenarioId     = gLastBaseScenarioId & 0xFF;
  mResult.BaseScenarioResult = gBaseScenarioResult & 0x1;
  mResult.FlowCoverageMask   = gFlowCoverage & 0x7FFF;
  mResult.TraceSnapshotId    = gTraceSnapshotId & 0xFFFF;
  mResult.TestHealth         = gTestHealth & 0xFF;
  output(mResult);

  write("[VAL_BASELINE_CTRL] scenario id=%d result=%d health=%d",
        gLastBaseScenarioId, gBaseScenarioResult, gTestHealth);
}
