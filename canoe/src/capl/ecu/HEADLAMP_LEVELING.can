includes
{
  #include "..\\common\\CAPL_COMMON.cin"
}

variables
{
  msTimer tHeadlampLevelCycle;
  int gAflsMode;
  int gBeamPattern;
  int gLevelStep;
  int gLastLevelStep;
  int gLastLevelMode;
  int gLastCompState;
}

on start
{
  gAflsMode = 0;
  gBeamPattern = 0;
  gLevelStep = 0;
  gLastLevelStep = -1;
  gLastLevelMode = -1;
  gLastCompState = -1;
  setTimer(tHeadlampLevelCycle, 100);
  write("[HEADLAMP_LEVELING] start");
}

on timer tHeadlampLevelCycle
{
  message frmHeadlampLevelStateMsg mLevel;
  int levelMode;
  int compState;

  levelMode = (gAflsMode > 0) ? 1 : 0;
  compState = (gBeamPattern >= 2) ? 1 : 0;

  mLevel.HeadlampLevelStep = clampRange(gLevelStep, 0, 255);
  mLevel.HeadlampLevelMode = clampRange(levelMode, 0, 7);
  mLevel.LevelCompState = clampRange(compState, 0, 3);
  output(mLevel);

  if (mLevel.HeadlampLevelStep != gLastLevelStep ||
      mLevel.HeadlampLevelMode != gLastLevelMode ||
      mLevel.LevelCompState != gLastCompState)
  {
    write("[HEADLAMP_LEVELING] step=%d mode=%d comp=%d beam=%d",
          mLevel.HeadlampLevelStep,
          mLevel.HeadlampLevelMode,
          mLevel.LevelCompState,
          gBeamPattern);
    gLastLevelStep = mLevel.HeadlampLevelStep;
    gLastLevelMode = mLevel.HeadlampLevelMode;
    gLastCompState = mLevel.LevelCompState;
  }

  setTimer(tHeadlampLevelCycle, 100);
}

on message frmAflsStateMsg
{
  gAflsMode = clampRange((int)this.AflsMode, 0, 7);
  gBeamPattern = clampRange((int)this.BeamPattern, 0, 7);
  gLevelStep = clampRange((int)this.LevelStep, 0, 255);
}

on stopMeasurement
{
  cancelTimer(tHeadlampLevelCycle);
}
