includes
{
}

variables
{
  msTimer tClusterCycle;
  int gClusterSpeed;
  int gClusterGear;
  int gClusterStatus;
  int gThemeMode;
  int gClusterBrightness;
  int gClusterSyncState;
  int gClusterSyncError;
  int gClusterSyncAge;
  int gLastSyncState;
}

on start
{
  gClusterSpeed      = 0;
  gClusterGear       = 0;
  gClusterStatus     = 0;
  gThemeMode         = 0;
  gClusterBrightness = 16;
  gClusterSyncState  = 0;
  gClusterSyncError  = 0;
  gClusterSyncAge    = 0;
  gLastSyncState     = -1;
  setTimer(tClusterCycle, 200);
  write("[CLUSTER_BASE_CTRL] start");
}

on message frmClusterBaseStateMsg
{
  gClusterSpeed  = this.ClusterSpeed;
  gClusterGear   = this.ClusterGear;
  gClusterStatus = this.ClusterStatus;
}

on message frmClusterThemeMsg
{
  gThemeMode         = this.ThemeMode;
  gClusterBrightness = this.ClusterBrightness;
}

on message frmClusterSyncStateMsg
{
  gClusterSyncState = this.ClusterSyncState;
  gClusterSyncError = this.ClusterSyncError;
  gClusterSyncAge   = this.ClusterSyncAge;
  if (gClusterSyncState != gLastSyncState)
  {
    write("[CLUSTER_BASE_CTRL] sync state=%d err=%d age=%dms",
          gClusterSyncState, gClusterSyncError, gClusterSyncAge);
    gLastSyncState = gClusterSyncState;
  }
}

on timer tClusterCycle
{
  /* Cluster display refresh: log state change for debugging */
  if (gClusterSyncError > 0)
  {
    write("[CLUSTER_BASE_CTRL] sync_err=%d spd=%d gear=%d",
          gClusterSyncError, gClusterSpeed, gClusterGear);
  }

  setTimer(tClusterCycle, 200);
}
