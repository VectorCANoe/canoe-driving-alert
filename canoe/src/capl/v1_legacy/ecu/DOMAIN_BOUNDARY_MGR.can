includes
{
}

variables
{
  msTimer tBoundaryCheck;
  int gChassisAlive;
  int gBodyAlive;
  int gInfoAlive;
  dword gChassisTsMs;
  dword gBodyTsMs;
  dword gInfoTsMs;
  int gLastBoundaryStatus;
  int gLastWarningPathStatus;
  int gLastE2eHealthState;
  int gLastFailSafeMode;
}

on start
{
  gChassisAlive = 0;
  gBodyAlive    = 0;
  gInfoAlive    = 0;
  gChassisTsMs  = 0;
  gBodyTsMs     = 0;
  gInfoTsMs     = 0;
  gLastBoundaryStatus = -1;
  gLastWarningPathStatus = -1;
  gLastE2eHealthState = -1;
  gLastFailSafeMode = -1;
  @CoreState::domainBoundaryStatus = 0;
  @CoreState::warningPathStatus = 2;
  @CoreState::e2eHealthState = 0;
  @Core::failSafeMode = 1;
  @Core::decelAssistReq = 0;
  setTimer(tBoundaryCheck, 100);
  write("[DOMAIN_BOUNDARY_MGR] start");
}

on message frmChassisHealthMsg
{
  gChassisAlive = this.ChassisAliveCnt;
  gChassisTsMs  = (dword)(timeNow() / 100000);
}

on message frmBodyHealthMsg
{
  gBodyAlive  = this.BodyAliveCnt;
  gBodyTsMs   = (dword)(timeNow() / 100000);
}

on message frmInfotainmentHealthMsg
{
  gInfoAlive  = this.InfoAliveCnt;
  gInfoTsMs   = (dword)(timeNow() / 100000);
}

on timer tBoundaryCheck
{
  message ethFailSafeStateMsg mFailSafe;
  dword nowMs;
  int routingPolicy;
  int forceFailSafe;
  int allAlive;
  int warningPathStatus;
  int e2eHealthState;
  int failSafeMode;

  nowMs    = (dword)(timeNow() / 100000);
  allAlive = 0;
  routingPolicy = (int)@CoreState::routingPolicy;
  forceFailSafe = (((int)@Test::forceFailSafe) == 1) ? 1 : 0;
  if (routingPolicy < 0 || routingPolicy > 2)
  {
    routingPolicy = 0;
  }

  /* All three domains must have been heard within 300 ms */
  if ((nowMs - gChassisTsMs) < 300 &&
      (nowMs - gBodyTsMs)    < 300 &&
      (nowMs - gInfoTsMs)    < 300 &&
      gChassisAlive > 0 &&
      gBodyAlive    > 0 &&
      gInfoAlive    > 0)
  {
    allAlive = 1;
  }

  @CoreState::domainBoundaryStatus = allAlive;
  warningPathStatus = (allAlive == 1) ? 0 : 2;
  if (forceFailSafe == 1)
  {
    warningPathStatus = 2;
    e2eHealthState = 0;
  }
  else if (allAlive == 1 && routingPolicy == 1)
  {
    e2eHealthState = 2;
  }
  else if (allAlive == 1)
  {
    e2eHealthState = 1;
  }
  else
  {
    e2eHealthState = 0;
  }

  failSafeMode = 0;
  if (forceFailSafe == 1)
  {
    failSafeMode = 2;
    @Core::decelAssistReq = 0;
  }
  else if (warningPathStatus >= 2 || e2eHealthState == 0)
  {
    failSafeMode = 1;
    @Core::decelAssistReq = 0;
  }

  @CoreState::warningPathStatus = warningPathStatus;
  @CoreState::e2eHealthState = e2eHealthState;
  @Core::failSafeMode = failSafeMode;

  if (allAlive != gLastBoundaryStatus)
  {
    write("[DOMAIN_BOUNDARY_MGR] boundary=%d ch=%d bd=%d inf=%d",
          allAlive, gChassisAlive, gBodyAlive, gInfoAlive);
    gLastBoundaryStatus = allAlive;
  }
  if (warningPathStatus != gLastWarningPathStatus ||
      e2eHealthState != gLastE2eHealthState ||
      failSafeMode != gLastFailSafeMode)
  {
    write("[DOMAIN_BOUNDARY_MGR] path=%d e2e=%d failSafe=%d routing=%d force=%d",
          warningPathStatus, e2eHealthState, failSafeMode, routingPolicy, forceFailSafe);
    gLastWarningPathStatus = warningPathStatus;
    gLastE2eHealthState = e2eHealthState;
    gLastFailSafeMode = failSafeMode;
  }

  mFailSafe.WarningPathStatus = warningPathStatus;
  mFailSafe.E2eHealthState = e2eHealthState;
  mFailSafe.FailSafeMode = failSafeMode;
  mFailSafe.BoundaryAlive = allAlive;
  output(mFailSafe);

  setTimer(tBoundaryCheck, 100);
}
