includes
{
  #include "..\\common\\CAPL_COMMON.cin"
}

variables
{
  msTimer tIviCycle;
  msTimer tIviBase50;
  msTimer tIviExt100;
  int gLastWarningTextCode;
  int gInfoAliveCnt;
  int gIviBaseTick;
  int gLastIviDiagSid;
  int gLastIviDiagDidHigh;
  int gLastIviDiagDidLow;
  int gEmsBlinkPhase;
  int gAmbientPulsePhase;
  int gIcFlowPhase;
  int gVehicleObjectPos;
}


int calcEmergencyDistanceM(int etaSec, int speedKph)
{
  long distanceM;

  if (etaSec <= 0 || speedKph <= 0)
  {
    return 0;
  }
  distanceM = ((long)etaSec * (long)speedKph * 10) / 36;
  if (distanceM < 0)
  {
    distanceM = 0;
  }
  if (distanceM > 10000)
  {
    distanceM = 10000;
  }
  return (int)distanceM;
}

void publishNavContextCore()
{
  int roadZone;
  int navDirection;
  int speedLimit;
  int baseZoneContext;

  roadZone = clampRange((int)@Infotainment::roadZone, 0, 3);
  navDirection = clampRange((int)@Infotainment::navDirection, 0, 3);
  speedLimit = clampRange((int)@Infotainment::speedLimit, 0, 255);

  if (speedLimit == 0)
  {
    speedLimit = 30;
  }

  baseZoneContext = 0;
  if (roadZone == 1)
  {
    baseZoneContext = 1;
  }
  else if (roadZone == 2)
  {
    baseZoneContext = 2;
  }
  else if (roadZone == 3)
  {
    if (navDirection == 2)
    {
      baseZoneContext = 4;
    }
    else
    {
      baseZoneContext = 3;
    }
  }

  @Core::baseZoneContext = baseZoneContext;
  @Core::speedLimitNorm = speedLimit;
}

void publishBackboneNavContext()
{
  message ethNavContextMsg mNav;

  /* Internal IVI gateway seam for CAN-stub today, transport swap later. */
  mNav.RoadZone = clampRange((int)@Infotainment::roadZone, 0, 7);
  mNav.NavDirection = clampRange((int)@Infotainment::navDirection, 0, 7);
  mNav.ZoneDistance = clampRange((int)@Infotainment::zoneDistance, 0, 255);
  mNav.SpeedLimit = clampRange((int)@Infotainment::speedLimit, 0, 255);
  if (mNav.SpeedLimit == 0)
  {
    mNav.SpeedLimit = 30;
  }
  output(mNav);
}

on start
{
  gLastWarningTextCode = -1;
  gInfoAliveCnt = 0;
  gIviBaseTick = 0;
  gLastIviDiagSid = 0x22;
  gLastIviDiagDidHigh = 0xF1;
  gLastIviDiagDidLow = 0x90;
  gEmsBlinkPhase = 0;
  gAmbientPulsePhase = 0;
  gIcFlowPhase = 0;
  gVehicleObjectPos = 0;
  publishNavContextCore();
  setTimer(tIviCycle, 10);
  setTimer(tIviBase50, 50);
  setTimer(tIviExt100, 100);
  write("[IVI] start");
}

on message frmNavContextCanMsg
{
  @Infotainment::roadZone = clampRange((int)this.gRoadZone, 0, 3);
  @Infotainment::navDirection = clampRange((int)this.gNavDirection, 0, 3);
  @Infotainment::zoneDistance = clampRange((int)this.gZoneDistance, 0, 255);
  @Infotainment::speedLimit = clampRange((int)this.gSpeedLimit, 0, 255);
  publishNavContextCore();
}

on message frmIviDiagReqMsg
{
  gLastIviDiagSid = clampRange((int)this.IviDiagServiceId, 0, 255);
  gLastIviDiagDidHigh = clampRange((int)this.IviDiagDidHigh, 0, 255);
  gLastIviDiagDidLow = clampRange((int)this.IviDiagDidLow, 0, 255);
}

on sysvar Infotainment::roadZone
{
  publishNavContextCore();
}

on sysvar Infotainment::navDirection
{
  publishNavContextCore();
}

on sysvar Infotainment::speedLimit
{
  publishNavContextCore();
}

on timer tIviCycle
{
  int alertLevel;
  int alertType;
  int timeoutClear;
  int emergencyType;
  int emergencyDirection;
  int warningTextCode;
  int speed;
  int emergencyDistanceM;
  int emergencyDistanceBand;
  int baseCode;
  message frmClusterWarningMsg mCluster;

  alertLevel = (int)@Core::selectedAlertLevel;
  alertType = (int)@Core::selectedAlertType;
  timeoutClear = (int)@Core::timeoutClear;
  emergencyType = (int)@V2X::emergencyType;
  emergencyDirection = (int)@V2X::emergencyDirection;
  speed = clampRange((int)@Core::vehicleSpeedNorm, 0, 255);
  if (alertLevel < 0 || alertLevel > 7)
  {
    alertLevel = 0;
  }
  if (alertType < 0 || alertType > 7)
  {
    alertType = 0;
  }
  if (emergencyType < 0 || emergencyType > 2)
  {
    emergencyType = 0;
  }
  if (emergencyDirection < 0 || emergencyDirection > 3)
  {
    emergencyDirection = 0;
  }
  timeoutClear = (timeoutClear == 1) ? 1 : 0;
  emergencyDistanceM = calcEmergencyDistanceM((int)@V2X::eta, speed);
  emergencyDistanceBand = 0;
  if (emergencyDistanceM > 0)
  {
    if (emergencyDistanceM <= 80)
    {
      emergencyDistanceBand = 1;
    }
    else if (emergencyDistanceM <= 180)
    {
      emergencyDistanceBand = 2;
    }
    else
    {
      emergencyDistanceBand = 3;
    }
  }
  @CoreState::emergencyDistanceM = emergencyDistanceM;

  if (timeoutClear == 1 || alertLevel == 0)
  {
    warningTextCode = 0;
  }
  else if (alertLevel >= 6)
  {
    if (emergencyType == 2 || emergencyType == 1)
    {
      baseCode = (emergencyType == 2) ? 200 : 100;
      if (emergencyDistanceBand > 0)
      {
        warningTextCode = baseCode + (emergencyDistanceBand * 10) + emergencyDirection;
      }
      else
      {
        warningTextCode = baseCode + emergencyDirection;
      }
    }
    else
    {
      warningTextCode = 100 + emergencyDirection;
    }
  }
  else if (alertType == 5)
  {
    warningTextCode = 31;
  }
  else if (alertType == 6)
  {
    warningTextCode = 32;
  }
  else
  {
    warningTextCode = (alertType * 10) + alertLevel;
  }

  if (warningTextCode != gLastWarningTextCode)
  {
    mCluster.WarningTextCode = warningTextCode;
    output(mCluster);
    gLastWarningTextCode = warningTextCode;
  }
  setTimer(tIviCycle, 10);
}

on timer tIviBase50
{
  message frmClusterBaseStateMsg mBase;
  message frmClusterThemeMsg mTheme;
  message frmHmiPopupStateMsg mPopup;
  message frmAudioFocusMsg mAudio;
  message frmVoiceAssistStateMsg mVoice;
  message frmMediaStateMsg mMediaState;
  message frmCallStateMsg mCallState;
  message frmPhoneProjectionMsg mProjection;
  message frmClusterNotifMsg mNotif;
  message frmMediaMetaMsg mMedia;
  message frmSpeechTtsStateMsg mTts;
  message frmClusterSyncStateMsg mSync;
  message frmInfotainmentHealthMsg mHealth;
  int speed;
  int driveState;
  int alertLevel;
  int alertType;
  int baseZoneContext;
  int roadZoneColorCode;
  int roadFlowDirection;
  int renderMode;
  int renderColor;
  int renderPattern;
  int renderTextCode;
  int renderDirection;
  int vehicleMotionStep;
  int displayModeSetting;
  int alertVolumeSetting;
  int effectiveVolume;

  speed = clampRange((int)@Core::vehicleSpeedNorm, 0, 255);
  driveState = clampRange((int)@Core::driveStateNorm, 0, 3);
  alertLevel = clampRange((int)@Core::selectedAlertLevel, 0, 7);
  alertType = clampRange((int)@Core::selectedAlertType, 0, 15);
  baseZoneContext = clampRange((int)@Core::baseZoneContext, 0, 4);
  renderMode = clampRange((int)@Body::ambientMode, 0, 7);
  renderColor = clampRange((int)@Body::ambientColor, 0, 15);
  renderPattern = clampRange((int)@Body::ambientPattern, 0, 15);
  renderTextCode = clampRange((int)@Cluster::warningTextCode, 0, 65535);
  displayModeSetting = clampRange((int)@Test::displayModeSetting, 0, 3);
  alertVolumeSetting = clampRange((int)@Test::alertVolumeSetting, 0, 100);
  effectiveVolume = (alertVolumeSetting > 0) ? alertVolumeSetting : ((alertLevel > 0) ? 30 : 20);

  /* CLU owns the mirrored display state after consuming these frames. */

  mBase.ClusterSpeed = speed;
  mBase.ClusterGear = driveState;
  mBase.ClusterStatus = alertLevel;
  output(mBase);

  mTheme.ThemeMode = (displayModeSetting == 1) ? 2 : ((alertLevel > 0) ? 1 : 0);
  mTheme.ClusterBrightness = (alertLevel > 0) ? 28 : 20;
  output(mTheme);

  mPopup.PopupType = alertType;
  mPopup.PopupPriority = clampRange(alertLevel, 0, 7);
  mPopup.PopupActive = (alertLevel > 0) ? 1 : 0;
  if (displayModeSetting == 1)
  {
    mPopup.PopupActive = 1;
    mPopup.PopupPriority = 1;
  }
  else if (displayModeSetting == 2)
  {
    mPopup.PopupActive = 0;
  }
  else if (displayModeSetting == 3)
  {
    mPopup.PopupActive = (alertLevel > 0) ? 1 : 0;
    mPopup.PopupPriority = clampRange(alertLevel + 1, 0, 7);
  }
  output(mPopup);

  mAudio.AudioFocusOwner = (alertLevel > 0) ? 1 : 0;
  if (displayModeSetting == 1)
  {
    mAudio.AudioFocusOwner = 0;
  }
  else if (displayModeSetting == 2 || displayModeSetting == 3)
  {
    mAudio.AudioFocusOwner = (alertLevel > 0) ? 1 : 0;
  }
  mAudio.AudioDuckingLvl = (alertLevel > 0) ? 4 : 1;
  output(mAudio);

  mVoice.VoiceAssistState = 1;
  mVoice.WakeWordState = 1;
  output(mVoice);

  mMediaState.MediaSource = 1;
  mMediaState.MediaState = 1;
  mMediaState.MuteState = 0;
  mMediaState.VolumeLevel = effectiveVolume;
  output(mMediaState);

  mCallState.CallState = 0;
  mCallState.MicMute = 0;
  mCallState.SignalQuality = 10;
  mCallState.BtDeviceCount = 1;
  output(mCallState);

  mProjection.ProjectionType = 1;
  mProjection.ProjectionState = 1;
  output(mProjection);

  mNotif.ClusterNotifType = alertType;
  mNotif.ClusterNotifArg = alertLevel;
  output(mNotif);

  mMedia.MediaTrackType = 1;
  mMedia.MediaRepeatMode = 0;
  mMedia.MediaShuffleMode = 0;
  mMedia.MediaRemainTime = 120;
  output(mMedia);

  mTts.TtsState = (alertLevel > 0 && displayModeSetting != 1) ? 1 : 0;
  mTts.TtsPriority = 0;
  mTts.TtsQueueDepth = 0;
  output(mTts);

  mSync.ClusterSyncState = 1;
  mSync.ClusterSyncError = 0;
  mSync.ClusterSyncAge = 10;
  output(mSync);

  gIviBaseTick = gIviBaseTick + 1;
  if ((gIviBaseTick % 2) == 0)
  {
    mHealth.InfoAliveCnt = gInfoAliveCnt & 0xFF;
    mHealth.InfoDiagState = 0;
    mHealth.InfoFailCode = 0;
    output(mHealth);
    gInfoAliveCnt = (gInfoAliveCnt + 1) & 0xFF;
  }

  if (baseZoneContext == 1)
  {
    roadZoneColorCode = 1;
  }
  else if (baseZoneContext == 2)
  {
    roadZoneColorCode = 2;
  }
  else if (baseZoneContext == 3 || baseZoneContext == 4)
  {
    roadZoneColorCode = 3;
  }
  else
  {
    roadZoneColorCode = 0;
  }

  if (baseZoneContext == 3)
  {
    roadFlowDirection = 1;
  }
  else if (baseZoneContext == 4)
  {
    roadFlowDirection = 2;
  }
  else
  {
    roadFlowDirection = 0;
  }

  vehicleMotionStep = 2;
  if (roadZoneColorCode == 1)
  {
    vehicleMotionStep = 1;
  }
  else if (roadZoneColorCode == 2)
  {
    vehicleMotionStep = 4;
  }
  else if (roadZoneColorCode == 3)
  {
    vehicleMotionStep = 6;
  }

  if (roadFlowDirection == 2)
  {
    gVehicleObjectPos = gVehicleObjectPos - vehicleMotionStep;
    if (gVehicleObjectPos < 0)
    {
      gVehicleObjectPos = gVehicleObjectPos + 101;
    }
  }
  else
  {
    gVehicleObjectPos = gVehicleObjectPos + vehicleMotionStep;
    if (gVehicleObjectPos > 100)
    {
      gVehicleObjectPos = gVehicleObjectPos - 101;
    }
  }

  if (alertLevel >= 6)
  {
    gEmsBlinkPhase = 1 - gEmsBlinkPhase;
  }
  else
  {
    gEmsBlinkPhase = 0;
  }

  if (alertType == 4)
  {
    gAmbientPulsePhase = (gAmbientPulsePhase + 1) & 3;
  }
  else
  {
    gAmbientPulsePhase = 0;
  }

  if (alertType == 5 || alertType == 6)
  {
    gIcFlowPhase = (gIcFlowPhase + 1) & 7;
  }
  else
  {
    gIcFlowPhase = 0;
  }

  if (renderTextCode >= 100 && renderTextCode <= 203)
  {
    renderDirection = renderTextCode % 100;
  }
  else if (alertType == 5)
  {
    renderDirection = 1;
  }
  else if (alertType == 6)
  {
    renderDirection = 2;
  }
  else
  {
    renderDirection = 0;
  }

  renderDirection = clampRange(renderDirection, 0, 3);
  @UiRender::renderMode = renderMode;
  @UiRender::renderColor = renderColor;
  @UiRender::renderPattern = renderPattern;
  @UiRender::renderTextCode = renderTextCode;
  @UiRender::renderDirection = renderDirection;
  @UiRender::roadZoneColorCode = roadZoneColorCode;
  @UiRender::roadFlowDirection = roadFlowDirection;
  @UiRender::vehicleObjectPos = clampRange(gVehicleObjectPos, 0, 100);
  @UiRender::emsBlinkPhase = gEmsBlinkPhase;
  @UiRender::ambientPulsePhase = gAmbientPulsePhase;
  @UiRender::icFlowPhase = gIcFlowPhase;
  @UiRender::activeAlertType = clampRange(alertType, 0, 7);

  setTimer(tIviBase50, 50);
}

on timer tIviExt100
{
  message frmNaviGuideStateMsg mGuide;
  message frmNavigationRouteMsg mRouteBase;
  message frmMapRenderStateMsg mMap;
  message frmRouteAlertMsg mRoute;
  message frmTrafficEventMsg mTraffic;
  message frmConnectivityStateMsg mConn;
  message frmIviHealthDetailMsg mHealthDetail;
  message frmIviDiagResMsg mDiagRes;
  int roadZone;
  int navDirection;
  int zoneDistance;
  int speedLimit;

  roadZone = clampRange((int)@Infotainment::roadZone, 0, 3);
  navDirection = clampRange((int)@Infotainment::navDirection, 0, 3);
  zoneDistance = clampRange((int)@Infotainment::zoneDistance, 0, 255);
  speedLimit = clampRange((int)@Infotainment::speedLimit, 0, 255);

  mMap.MapRenderState = 1;
  mMap.ZoomLevel = (roadZone == 2) ? 12 : 16;
  mMap.TileLoadPercent = 95;
  output(mMap);

  mGuide.GuideLaneState = (roadZone == 3) ? navDirection : 0;
  mGuide.GuideConfidence = (roadZone == 3) ? 50 : 10;
  output(mGuide);

  mRouteBase.RouteClass = roadZone;
  mRouteBase.GuideType = navDirection;
  mRouteBase.RouteProgress = (zoneDistance > 100) ? 20 : 80;
  mRouteBase.EtaMinutes = clampRange(zoneDistance / 10, 0, 255);
  output(mRouteBase);

  mRoute.RouteAlertType = roadZone;
  mRoute.RouteAlertPrio = (roadZone == 1) ? 5 : 2;
  mRoute.RouteAlertActive = (roadZone > 0) ? 1 : 0;
  mRoute.RouteAlertEta = zoneDistance;
  output(mRoute);

  mTraffic.TrafficEventType = roadZone;
  mTraffic.TrafficSeverity = (roadZone == 1) ? 7 : 2;
  mTraffic.TrafficDistance = zoneDistance;
  output(mTraffic);

  mConn.ConnectivityType = 1;
  mConn.ConnectivityState = 1;
  mConn.SignalBars = 4;
  output(mConn);

  mHealthDetail.IviCpuLoad = (speedLimit > 100) ? 45 : 35;
  mHealthDetail.IviMemLoad = 40;
  output(mHealthDetail);

  publishBackboneNavContext();

  mDiagRes.IviDiagRespCode = 0x62;
  mDiagRes.IviDiagData0 = gLastIviDiagDidHigh & 0xFF;
  mDiagRes.IviDiagData1 = gLastIviDiagDidLow & 0xFF;
  output(mDiagRes);

  setTimer(tIviExt100, 100);
}
