includes
{
}

variables
{
  msTimer tIviCycle;
  msTimer tIviBase50;
  int gLastWarningTextCode;
  int gInfoAliveCnt;
  int gIviBaseTick;
}

int clampRange(int value, int minValue, int maxValue)
{
  if (value < minValue)
  {
    return minValue;
  }
  if (value > maxValue)
  {
    return maxValue;
  }
  return value;
}

on start
{
  gLastWarningTextCode = -1;
  gInfoAliveCnt = 0;
  gIviBaseTick = 0;
  setTimer(tIviCycle, 10);
  setTimer(tIviBase50, 50);
  write("[IVI_GW] start");
}

on timer tIviCycle
{
  int alertLevel;
  int alertType;
  int timeoutClear;
  int emergencyType;
  int emergencyDirection;
  int warningTextCode;
  message frmClusterWarningMsg mCluster;

  alertLevel = (int)@Core::selectedAlertLevel;
  alertType = (int)@Core::selectedAlertType;
  timeoutClear = (int)@Core::timeoutClear;
  emergencyType = (int)@V2X::emergencyType;
  emergencyDirection = (int)@V2X::emergencyDirection;
  if (alertLevel < 0 || alertLevel > 7)
  {
    alertLevel = 0;
  }
  if (alertType < 0 || alertType > 7)
  {
    alertType = 0;
  }
  if (emergencyType < 0 || emergencyType > 2)
  {
    emergencyType = 0;
  }
  if (emergencyDirection < 0 || emergencyDirection > 3)
  {
    emergencyDirection = 0;
  }
  timeoutClear = (timeoutClear == 1) ? 1 : 0;

  if (timeoutClear == 1 || alertLevel == 0)
  {
    warningTextCode = 0;
  }
  else if (alertLevel >= 6)
  {
    if (emergencyType == 2)
    {
      warningTextCode = 200 + emergencyDirection;
    }
    else
    {
      warningTextCode = 100 + emergencyDirection;
    }
  }
  else if (alertType == 5)
  {
    warningTextCode = 31;
  }
  else if (alertType == 6)
  {
    warningTextCode = 32;
  }
  else
  {
    warningTextCode = (alertType * 10) + alertLevel;
  }

  if (warningTextCode != gLastWarningTextCode)
  {
    @Cluster::warningTextCode = warningTextCode;
    mCluster.WarningTextCode = warningTextCode;
    output(mCluster);
    gLastWarningTextCode = warningTextCode;
  }
  setTimer(tIviCycle, 10);
}

on timer tIviBase50
{
  message frmClusterBaseStateMsg mBase;
  message frmClusterThemeMsg mTheme;
  message frmHmiPopupStateMsg mPopup;
  message frmInfotainmentHealthMsg mHealth;
  int speed;
  int driveState;
  int alertLevel;
  int alertType;

  speed = clampRange((int)@Core::vehicleSpeedNorm, 0, 255);
  driveState = clampRange((int)@Core::driveStateNorm, 0, 3);
  alertLevel = clampRange((int)@Core::selectedAlertLevel, 0, 7);
  alertType = clampRange((int)@Core::selectedAlertType, 0, 15);

  mBase.ClusterSpeed = speed;
  mBase.ClusterGear = driveState;
  mBase.ClusterStatus = alertLevel;
  output(mBase);

  mTheme.ThemeMode = (alertLevel > 0) ? 1 : 0;
  mTheme.ClusterBrightness = (alertLevel > 0) ? 28 : 20;
  output(mTheme);

  mPopup.PopupType = alertType;
  mPopup.PopupPriority = clampRange(alertLevel, 0, 7);
  mPopup.PopupActive = (alertLevel > 0) ? 1 : 0;
  output(mPopup);

  gIviBaseTick = gIviBaseTick + 1;
  if ((gIviBaseTick % 2) == 0)
  {
    mHealth.InfoAliveCnt = gInfoAliveCnt & 0xFF;
    mHealth.InfoDiagState = 0;
    mHealth.InfoFailCode = 0;
    output(mHealth);
    gInfoAliveCnt = (gInfoAliveCnt + 1) & 0xFF;
  }

  setTimer(tIviBase50, 50);
}
