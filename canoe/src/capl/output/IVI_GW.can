includes
{
}

variables
{
  msTimer tIviCycle;
  int gLastWarningTextCode;
}

on start
{
  gLastWarningTextCode = -1;
  setTimer(tIviCycle, 10);
  write("[IVI_GW] start");
}

on timer tIviCycle
{
  int alertLevel;
  int alertType;
  int timeoutClear;
  int warningTextCode;
  message frmClusterWarningMsg mCluster;

  alertLevel = (int)@Core::selectedAlertLevel;
  alertType = (int)@Core::selectedAlertType;
  timeoutClear = (int)@Core::timeoutClear;
  if (alertLevel < 0 || alertLevel > 7)
  {
    alertLevel = 0;
  }
  if (alertType < 0 || alertType > 7)
  {
    alertType = 0;
  }
  timeoutClear = (timeoutClear == 1) ? 1 : 0;

  if (timeoutClear == 1 || alertLevel == 0)
  {
    warningTextCode = 0;
  }
  else
  {
    warningTextCode = (alertType * 10) + alertLevel;
  }

  if (warningTextCode != gLastWarningTextCode)
  {
    @Cluster::warningTextCode = warningTextCode;
    mCluster.WarningTextCode = warningTextCode;
    output(mCluster);
    gLastWarningTextCode = warningTextCode;
  }
  setTimer(tIviCycle, 10);
}
