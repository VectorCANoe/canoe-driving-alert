includes
{
}

variables
{
  msTimer tDuplicateGuard;
  int gLastDisplayedCode;
  dword gLastDisplayMs;
}

on start
{
  gLastDisplayedCode = 0;
  gLastDisplayMs = 0;
  @CoreState::duplicatePopupGuard = 0;
  write("[CLU_HMI_CTRL] start");
}

on message frmClusterWarningMsg
{
  int code;
  int guardRemainMs;
  dword nowMs;
  dword elapsedMs;

  code = this.WarningTextCode;
  nowMs = timeNow();
  guardRemainMs = 0;

  if (code == 0)
  {
    cancelTimer(tDuplicateGuard);
    gLastDisplayedCode = 0;
    gLastDisplayMs = 0;
    @CoreState::duplicatePopupGuard = 0;
    @Cluster::warningTextCode = 0;
    write("[CLU] clear");
  }
  else
  {
    if (code == gLastDisplayedCode)
    {
      elapsedMs = nowMs - gLastDisplayMs;
      if (elapsedMs < 1000)
      {
        guardRemainMs = 1000 - (int)elapsedMs;
      }
      else
      {
        gLastDisplayMs = nowMs;
        guardRemainMs = 1000;
      }
    }
    else
    {
      gLastDisplayedCode = code;
      gLastDisplayMs = nowMs;
      guardRemainMs = 1000;
    }

    @Cluster::warningTextCode = code;
    @CoreState::duplicatePopupGuard = guardRemainMs;
    if (guardRemainMs > 0)
    {
      setTimer(tDuplicateGuard, 100);
    }

    write("[CLU] warning code=%d", code);
  }
}

on timer tDuplicateGuard
{
  int guardRemainMs;
  dword nowMs;
  dword elapsedMs;

  if (gLastDisplayedCode == 0)
  {
    @CoreState::duplicatePopupGuard = 0;
    return;
  }

  nowMs = timeNow();
  elapsedMs = nowMs - gLastDisplayMs;
  if (elapsedMs >= 1000)
  {
    guardRemainMs = 0;
  }
  else
  {
    guardRemainMs = 1000 - (int)elapsedMs;
  }

  @CoreState::duplicatePopupGuard = guardRemainMs;
  if (guardRemainMs > 0)
  {
    setTimer(tDuplicateGuard, 100);
  }
}
