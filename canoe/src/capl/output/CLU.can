/*@!Encoding:949*/
includes
{
  #include "..\\common\\CAPL_COMMON.cin"
}

variables
{
  // --- 기존 변수 ---
  msTimer tDuplicateGuard;
  int gLastDisplayedCode;
  dword gLastDisplayMs;
  int gBaseClusterSpeed;
  int gBaseClusterGear;
  int gBaseClusterStatus;
  int gLastBaseSyncState;
  int gLastBaseSyncError;
  int gThemeMode;
  int gPopupType;
  int gPopupPriority;
  int gPopupActive;
  int gVolumeLevel;
  int gAudioFocusOwner;
  int gAudioDuckingLvl;
  int gTtsState;
  int gNotifType;
  int gNotifArg;
  int gClusterSyncState;
  int gClusterSyncSeq;
  int gHistoryCodes[16];
  int gHistorySnaps[16];
  int gHistoryWriteIdx;
  int gHistoryCount;

  // --- 이미지 매핑용 신규 변수 ---
  msTimer tEvalTimer;       // 50ms 주기 평가 타이머
  msTimer tGearHold;        // 기어 표시 1초 유지 타이머

  // CAN 메시지에서 읽은 신호 캐시
  int gRearObjectDetected;  // frmRearRadarMasterStateMsg
  int gRearRiskLevel;       // frmRearRadarMasterStateMsg
  int gBcwWarnLeft;         // frmBcwStateMsg
  int gBcwWarnRight;        // frmBcwStateMsg
  int gDoorOpenWarn;        // frmDoorStateMsg
  int gDriverMonitorReq;    // frmHighwayPilotStateMsg

  // 기어 변경 상태
  int gPrevDriveState;
  int gGearHoldCode;
  int gGearHoldActive;
}

// ============================================================
// 기존 함수 (유지)
// ============================================================

int applyDisplayPolicy(int code)
{
  int modeSetting;
  int volumeSetting;
  int effectiveVolume;
  int coded;

  if (code <= 0)
  {
    return 0;
  }

  modeSetting = clampRange((int)@Test::displayModeSetting, 0, 3);
  volumeSetting = clampRange((int)@Test::alertVolumeSetting, 0, 100);
  effectiveVolume = (volumeSetting > 0) ? volumeSetting : gVolumeLevel;
  coded = code;

  if (modeSetting == 2)
  {
    coded = clampRange(code + 40, 0, 255);
  }
  else if (modeSetting == 3)
  {
    coded = clampRange(code + 80, 0, 255);
  }

  if (modeSetting != 1)
  {
    if (gAudioFocusOwner == 0 || effectiveVolume < 15)
    {
      coded = code;
    }
    else if (effectiveVolume >= 70)
    {
      coded = clampRange(coded + 5, 0, 255);
    }
  }

  return coded;
}

int applyRobustPolicy(int code)
{
  int selectedAlertLevel;
  int selectedAlertType;
  int timeoutClear;
  int expectedCode;
  int coded;
  int syncMismatch;

  coded = code;
  if (coded <= 0)
  {
    return 0;
  }

  if (gAudioFocusOwner != 0 && (gAudioDuckingLvl >= 4 || gTtsState >= 1))
  {
    coded = clampRange(coded + 6, 0, 255);
  }

  if (gPopupActive == 1 && gPopupPriority >= 5 &&
      coded < 100 && (coded % 10) < 5)
  {
    coded = 0;
  }

  selectedAlertLevel = clampRange((int)@Core::selectedAlertLevel, 0, 7);
  selectedAlertType = clampRange((int)@Core::selectedAlertType, 0, 15);
  timeoutClear = (((int)@Core::timeoutClear) == 1) ? 1 : 0;
  expectedCode = 0;
  if (timeoutClear == 0 && selectedAlertLevel > 0)
  {
    expectedCode = clampRange((selectedAlertType * 10) + selectedAlertLevel, 0, 255);
  }

  syncMismatch = 0;
  if (selectedAlertLevel > 0 &&
      (gClusterSyncState == 0 || gClusterSyncSeq > 50 || coded == 0))
  {
    syncMismatch = 1;
  }

  if (syncMismatch == 1 && expectedCode > 0)
  {
    coded = expectedCode;
    @CoreState::clusterNotifPrio = clampRange((int)@CoreState::clusterNotifPrio, 0, 255);
    if ((int)@CoreState::clusterNotifPrio < 6)
    {
      @CoreState::clusterNotifPrio = 6;
    }
  }

  return coded;
}

void pushHistory(int code)
{
  int snap;

  if (code <= 0)
  {
    return;
  }

  snap = clampRange((int)@CoreState::arbitrationSnapshotId, 0, 65535);
  gHistoryCodes[gHistoryWriteIdx] = code;
  gHistorySnaps[gHistoryWriteIdx] = snap;
  gHistoryWriteIdx = (gHistoryWriteIdx + 1) & 15;
  if (gHistoryCount < 16)
  {
    gHistoryCount = gHistoryCount + 1;
  }

  @CoreState::alertHistoryCount = ((int)@CoreState::alertHistoryCount + 1) & 0xFFFF;
}

void respondHistoryQuery()
{
  int queryOffset;
  int idx;
  int pos;
  int response;

  queryOffset = clampRange((int)@Test::historyQueryOffset, 0, 15);
  response = 0;

  if (gHistoryCount > 0)
  {
    idx = queryOffset;
    if (idx >= gHistoryCount)
    {
      idx = gHistoryCount - 1;
    }
    pos = gHistoryWriteIdx - 1 - idx;
    if (pos < 0)
    {
      pos = pos + 16;
    }
    response = gHistoryCodes[pos];
  }

  @Test::historyQueryCode = response;
}


// ============================================================
// 신규: 54개 이미지 우선순위 결정 함수
// ============================================================

int resolveClusterImageCode()
{
  int animFrame;
  int emergencyType;
  int alertState;
  int objectRiskClass;
  int vehicleSpeed;
  int speedLimit;
  int roadZone;
  int navDirection;
  int mergeCutIn;

  // ---------------------------------------------------
  // 우선순위 1: 시동 애니메이션 (이미지 23~50)
  // EMS.can: animFrame 23~50 (28프레임) -> warningTextCode 23~50 직접 대응
  // animFrame 0   = 기본 주행 (애니 없음)
  // animFrame 1~9 = EMS 정적 경고 심볼 (CLU가 sysvar로 직접 처리)
  // ---------------------------------------------------
  animFrame = (int)@Display::animFrame;
  if (animFrame >= 23 && animFrame <= 50)
  {
    return animFrame;  // 23->23, 24->24, ..., 50->50 (직접 대응)
  }

  // ---------------------------------------------------
  // 우선순위 2: 긴급차량 경고
  // ---------------------------------------------------
  emergencyType = (int)@V2X::emergencyType;
  alertState    = (int)@V2X::alertState;
  if (alertState == 1)
  {
    if (emergencyType == 2) return 2;  // 구급차 접근 경고
    if (emergencyType == 1) return 1;  // 경찰차 접근 경고
    
  }

  // ---------------------------------------------------
  // 우선순위 3: 충돌 경고
  // ---------------------------------------------------
  objectRiskClass = (int)@Core::objectRiskClass;
  if (objectRiskClass >= 3)
  {
    return 10;  // 전방충돌 경고
  }

  if (gRearObjectDetected == 1 && gRearRiskLevel > 50)
  {
    return 11;  // 후방충돌 경고
  }

  if (gBcwWarnRight == 1) return 12;  // 후측방 우측 경고
  if (gBcwWarnLeft  == 1) return 13;  // 후측방 좌측 경고

  // ---------------------------------------------------
  // 우선순위 4: 과속 경고
  // ---------------------------------------------------
  vehicleSpeed = (int)@Chassis::vehicleSpeed;
  speedLimit   = (int)@Infotainment::speedLimit;
  if (speedLimit > 0 && vehicleSpeed > speedLimit)
  {
    return 9;  // 과속 경고
  }

  // ---------------------------------------------------
  // 우선순위 5: 안전벨트 / 도어 개방
  // ---------------------------------------------------
  if ((int)@Test::driverBeltOff == 1 || (int)@Test::passengerBeltOff == 1)
  {
    return 17;  // 안전벨트 미착용 경고
  }

  if (gDoorOpenWarn == 1)
  {
    return 18;  // 차량 도어 개방 경고
  }

  // ---------------------------------------------------
  // 우선순위 6: 핸들 미조향 경고
  // DriverMonitorReq=1 이면 핸들 잡으라는 요청 (HWP/DMS 기반)
  // 또는 슬라이더가 중앙(35±2) + 주행중(10km/h 이상) -> 미조향
  // ---------------------------------------------------
  if (gDriverMonitorReq == 1)
  {
    return 19;  // HWP/DMS 기반 핸들 미조향 경고
  }

  // 슬라이더 기반 핸들 미조향 (중앙(미조향) + 주행중)
  vehicleSpeed = (int)@Chassis::vehicleSpeed;
  if ((int)@Chassis::steeringInput == 0 && vehicleSpeed > 10)
  {
    return 19;  // 핸들 슬라이더 중앙 + 주행중 = 미조향 경고
  }

  // ---------------------------------------------------
  // 우선순위 7: 도로 구간 / 내비게이션 가이드
  // ---------------------------------------------------
  roadZone     = (int)@Infotainment::roadZone;
  navDirection = (int)@Infotainment::navDirection;
  mergeCutIn   = (int)@Core::mergeCutInFlag;

  if (roadZone == 1)
  {
    return 3;  // 스쿨존 접근 경고
  }

  if (roadZone == 2)
  {
    return 4;  // 고속도로 진입
  }

  // 합류구간 (mergeCutInFlag 우선)
  if (mergeCutIn == 1)
  {
    if (navDirection == 1) return 7;  // 합류구간 좌회전
    if (navDirection == 2) return 8;  // 합류구간 우회전
  }

  // 교차로 가이드 (roadZone=3=Guide)
  if (roadZone == 3)
  {
    if (navDirection == 1) return 5;  // 교차로 좌회전
    if (navDirection == 2) return 6;  // 교차로 우회전
  }

  // ---------------------------------------------------
  // 우선순위 8: 기어 변경 1초 유지
  // ---------------------------------------------------
  if (gGearHoldActive == 1)
  {
    return gGearHoldCode;
  }

  // ---------------------------------------------------
  // 기본: 기본 주행 화면
  // ---------------------------------------------------
  return 0;
}


// ============================================================
// 신규: 이미지 코드 적용 함수
// ============================================================

void applyClusterImage()
{
  int code;
  int prevCode;

  prevCode = gLastDisplayedCode;
  code = resolveClusterImageCode();

  if (code == prevCode)
  {
    return;
  }

  gLastDisplayedCode = code;
  @Cluster::warningTextCode = code;

  if (code > 0)
  {
    pushHistory(code);
    respondHistoryQuery();
  }

  write("[CLU] image=%d (prev=%d)", code, prevCode);
}


// ============================================================
// on start
// ============================================================

on start
{
  int i;

  gLastDisplayedCode = 0;
  gLastDisplayMs     = 0;
  gBaseClusterSpeed  = 0;
  gBaseClusterGear   = 0;
  gBaseClusterStatus = 0;
  gLastBaseSyncState = -1;
  gLastBaseSyncError = -1;
  gThemeMode         = 0;
  gPopupType         = 0;
  gPopupPriority     = 0;
  gPopupActive       = 0;
  gVolumeLevel       = 30;
  gAudioFocusOwner   = 0;
  gAudioDuckingLvl   = 0;
  gTtsState          = 0;
  gNotifType         = 0;
  gNotifArg          = 0;
  gClusterSyncState  = 1;
  gClusterSyncSeq    = 0;
  gHistoryWriteIdx   = 0;
  gHistoryCount      = 0;
  for (i = 0; i < 16; i = i + 1)
  {
    gHistoryCodes[i] = 0;
    gHistorySnaps[i] = 0;
  }

  // 신규 변수 초기화
  gRearObjectDetected = 0;
  gRearRiskLevel      = 0;
  gBcwWarnLeft        = 0;
  gBcwWarnRight       = 0;
  gDoorOpenWarn       = 0;
  gDriverMonitorReq   = 0;
  gPrevDriveState     = -1;
  gGearHoldCode       = 0;
  gGearHoldActive     = 0;

  @CoreState::duplicatePopupGuard = 0;
  @CoreState::themeMode           = 0;
  @CoreState::popupType           = 0;
  @CoreState::popupPriority       = 0;
  @CoreState::popupActive         = 0;
  @CoreState::volumeLevel         = 30;
  @CoreState::audioFocusOwner     = 0;
  @CoreState::audioDuckingLvl     = 0;
  @CoreState::ttsState            = 0;
  @CoreState::clusterNotifType    = 0;
  @CoreState::clusterNotifPrio    = 0;
  @CoreState::clusterSyncState    = 1;
  @CoreState::clusterSyncSeq      = 0;
  @CoreState::alertHistoryCount   = 0;
  @Test::historyQueryCode         = 0;

  // 핸들 기본값: 중앙(69) -> frame=0(직진 strip 0)
  @Chassis::steeringAngle  = 69;
  @Display::steeringFrame  = 0;
  @Chassis::steeringInput  = 0;

  setTimer(tEvalTimer, 50);
  write("[CLU] start");
}


// ============================================================
// 50ms 주기 평가 타이머
// ============================================================

on timer tEvalTimer
{
  applyClusterImage();
  setTimer(tEvalTimer, 50);
}


// ============================================================
// 기어 표시 타이머 (1초 후 해제)
// ============================================================

on timer tGearHold
{
  int animFrame;

  gGearHoldActive = 0;
  applyClusterImage();

  // 기어 표시 프레임(19~22)이면 기본 화면으로 복귀
  animFrame = (int)@Display::animFrame;
  if (animFrame >= 19 && animFrame <= 22)
    @Display::animFrame = 0;

  write("[CLU] gear hold cleared");
}


// ============================================================
// 기어 변경 감지 (driveState 변경 -> 1초 유지)
// ============================================================

on sysvar Chassis::driveState
{
  int newState;
  int code;
  int curFrame;

  newState = (int)@Chassis::driveState;
  if (newState == gPrevDriveState)
  {
    return;
  }

  code = 0;
  if      (newState == 3) code = 20;  // D
  else if (newState == 2) code = 21;  // N
  else if (newState == 1) code = 22;  // R
  else if (newState == 0) code = 23;  // P

  if (code > 0)
  {
    gGearHoldCode   = code;
    gGearHoldActive = 1;
    cancelTimer(tGearHold);
    setTimer(tGearHold, 1000);
    write("[CLU] gear change -> code=%d (1s hold)", code);

    // animFrame 기어 표시 (경고/시동애니 미재생 시에만): 19=D 20=N 21=R 22=P
    curFrame = (int)@Display::animFrame;
    if (curFrame < 23)  // 시동 애니메이션(23~50) 아닐 때
    {
      if (curFrame != 1 && curFrame != 2 && curFrame != 7 && curFrame != 8)
      {
        if      (newState == 3) @Display::animFrame = 19;  // D
        else if (newState == 2) @Display::animFrame = 20;  // N
        else if (newState == 1) @Display::animFrame = 21;  // R
        else if (newState == 0) @Display::animFrame = 22;  // P
      }
    }
  }

  gPrevDriveState = newState;
  applyClusterImage();
}


// ============================================================
// CAN 메시지 핸들러 (신호 캐시 + 즉시 평가)
// ============================================================

// 전방충돌 (frmRearRadarMasterStateMsg ID=475=0x1EB)
// RearObjectDetected: bit0, RearRiskLevel: byte1
on message 0x1EB
{
  gRearObjectDetected = (int)(this.byte(0)) & 0x01;
  gRearRiskLevel      = (int)(this.byte(1));
  applyClusterImage();
}

// 후측방 경고 (frmBcwStateMsg ID=458=0x1CA)
// BcwWarnLeft: bit0, BcwWarnRight: bit1
on message 0x1CA
{
  gBcwWarnLeft  = (int)(this.byte(0)) & 0x01;
  gBcwWarnRight = ((int)(this.byte(0)) >> 1) & 0x01;
  applyClusterImage();
}

// 도어 개방 경고 - Body::doorOpenCmd sysvar 사용 (DBC 미확인 우회)
on sysvar Body::doorOpenCmd
{
  gDoorOpenWarn = (int)@Body::doorOpenCmd;
  applyClusterImage();
}

// 핸들 미조향 (frmHighwayPilotStateMsg ID=477=0x1ED)
// DriverMonitorReq: bit3
on message 0x1ED
{
  gDriverMonitorReq = ((int)(this.byte(0)) >> 3) & 0x01;
  applyClusterImage();
}


// ============================================================
// SysVar 핸들러 (변경 즉시 평가)
// ============================================================

on sysvar V2X::emergencyType      { applyClusterImage(); }
on sysvar V2X::alertState         { applyClusterImage(); }
on sysvar Core::objectRiskClass   { applyClusterImage(); }
on sysvar Chassis::vehicleSpeed   { applyClusterImage(); }
on sysvar Infotainment::speedLimit { applyClusterImage(); }
on sysvar Infotainment::roadZone  { applyClusterImage(); }
on sysvar Infotainment::navDirection { applyClusterImage(); }
on sysvar Core::mergeCutInFlag    { applyClusterImage(); }
on sysvar Test::driverBeltOff     { applyClusterImage(); }
on sysvar Test::passengerBeltOff  { applyClusterImage(); }
on sysvar Display::animFrame      { applyClusterImage(); }

// ============================================================
// 핸들 각도 슬라이더 -> Display::steeringFrame 변환 로직
//
// 슬라이더 범위: 0 ~ 138  (center = 69)
// 스트립이미지: 71프레임 (0~70), 360도 시계방향 회전
//   frame 0  = 12시 직진
//   frame 35 = 6시 (180도 회전)
//   frame 70 ≒ 360도 (12시 근접)
//
// [변환 공식]  (스트립이미지 71장, StateCnt=70, frame 0~69 사용)
//   frame값 = 반시계방향(좌회전), frame값 = 시계방향(우회전)
//   우회전 (angle 69->138): frame = 69-(angle-69)*34/69 -> 69~35 (시계방향 진행)
//   좌회전 (angle 69->0):   frame = (69-angle)*35/69   -> 0~35 (반시계방향 진행)
//
//  angle:   0   69  138
//  frame:  35   0/69  35
//  (frame 0 = 직진, frame 69 ≒ 직진, frame 35 = 최대회전)
//
// steeringInput: 0 = 미조향(중앙±4스텝=±20도) 이내, 1 = 조향 중
// ============================================================
on sysvar Chassis::steeringAngle
{
  int angle;
  int frame;
  int deviation;

  angle = (int)@Chassis::steeringAngle;

  if (angle >= 69)
  {
    // 우회전: frame 69->35 (시계방향)
    frame = 69 - (angle - 69) * 34 / 69;
  }
  else
  {
    // 좌회전: frame 0->35 (반시계방향)
    frame = (69 - angle) * 35 / 69;
  }
  if (frame < 0)  frame = 0;
  if (frame > 69) frame = 69;

  @Display::steeringFrame = frame;

  // 미조향 판정: 중앙(angle=69) ±4스텝(±20도) 이내
  deviation = 69 - angle;
  if (deviation < 0) deviation = angle - 69;  // abs

  if (deviation <= 4)
  {
    @Chassis::steeringInput = 0;  // 핸들 미조향 (중앙)
  }
  else
  {
    @Chassis::steeringInput = 1;  // 핸들 조작 중
    if (angle < 69)
      write("[CLU] steering LEFT  angle=%d frame=%d", angle, frame);
    else
      write("[CLU] steering RIGHT angle=%d frame=%d", angle, frame);
  }

  applyClusterImage();
}


// ============================================================
// 기존 CAN 메시지 핸들러 (sync/audio/popup 상태 관리)
// ============================================================

on message frmClusterBaseStateMsg
{
  gBaseClusterSpeed  = clampRange((int)this.ClusterSpeed,  0, 255);
  gBaseClusterGear   = clampRange((int)this.ClusterGear,   0, 15);
  gBaseClusterStatus = clampRange((int)this.ClusterStatus, 0, 15);
}

on message frmClusterThemeMsg
{
  gThemeMode = clampRange((int)this.ThemeMode, 0, 7);
  @CoreState::themeMode = gThemeMode;
}

on message frmHmiPopupStateMsg
{
  gPopupType     = clampRange((int)this.PopupType,     0, 15);
  gPopupPriority = clampRange((int)this.PopupPriority, 0, 7);
  gPopupActive   = clampRange((int)this.PopupActive,   0, 1);
  @CoreState::popupType     = gPopupType;
  @CoreState::popupPriority = gPopupPriority;
  @CoreState::popupActive   = gPopupActive;
}

on message frmMediaStateMsg
{
  gVolumeLevel = clampRange((int)this.VolumeLevel, 0, 100);
  @CoreState::volumeLevel = gVolumeLevel;
}

on message frmAudioFocusMsg
{
  gAudioFocusOwner = clampRange((int)this.AudioFocusOwner, 0, 7);
  gAudioDuckingLvl = clampRange((int)this.AudioDuckingLvl, 0, 7);
  @CoreState::audioFocusOwner = gAudioFocusOwner;
  @CoreState::audioDuckingLvl = gAudioDuckingLvl;
}

on message frmSpeechTtsStateMsg
{
  gTtsState = clampRange((int)this.TtsState, 0, 7);
  @CoreState::ttsState = gTtsState;
}

on message frmClusterSyncStateMsg
{
  gClusterSyncState = clampRange((int)this.ClusterSyncState, 0, 15);
  gClusterSyncSeq   = clampRange((int)this.ClusterSyncAge,   0, 255);
  @CoreState::clusterSyncState = gClusterSyncState;
  @CoreState::clusterSyncSeq   = gClusterSyncSeq;
  if (gClusterSyncState != gLastBaseSyncState ||
      (int)this.ClusterSyncError != gLastBaseSyncError)
  {
    write("[CLU] base sync state=%d err=%d age=%d spd=%d gear=%d status=%d",
          gClusterSyncState, (int)this.ClusterSyncError, gClusterSyncSeq,
          gBaseClusterSpeed, gBaseClusterGear, gBaseClusterStatus);
    gLastBaseSyncState = gClusterSyncState;
    gLastBaseSyncError = (int)this.ClusterSyncError;
  }
}

on message frmClusterNotifMsg
{
  gNotifType = clampRange((int)this.ClusterNotifType, 0, 255);
  gNotifArg  = clampRange((int)this.ClusterNotifArg,  0, 255);
  @CoreState::clusterNotifType = gNotifType;
  @CoreState::clusterNotifPrio = gNotifArg;
}

// 백본 경고 메시지 (로깅 전용 - warningTextCode는 applyClusterImage()가 관리)
on message frmClusterWarningMsg
{
  int rawCode;
  rawCode = clampRange((int)this.WarningTextCode, 0, 255);
  write("[CLU] backbone warning raw=%d (ignored: image mapper active)", rawCode);
}

on sysvar Test::historyQueryOffset
{
  respondHistoryQuery();
  write("[CLU] history query offset=%d code=%d",
        (int)@Test::historyQueryOffset, (int)@Test::historyQueryCode);
}

on timer tDuplicateGuard
{
  int guardRemainMs;
  dword nowMs;
  dword elapsedMs;

  if (gLastDisplayedCode == 0)
  {
    @CoreState::duplicatePopupGuard = 0;
    return;
  }

  nowMs     = getSimulationTimeMs();
  elapsedMs = nowMs - gLastDisplayMs;
  if (elapsedMs >= 1000)
  {
    guardRemainMs = 0;
  }
  else
  {
    guardRemainMs = 1000 - (int)elapsedMs;
  }

  @CoreState::duplicatePopupGuard = guardRemainMs;
  if (guardRemainMs > 0)
  {
    setTimer(tDuplicateGuard, 100);
  }
}