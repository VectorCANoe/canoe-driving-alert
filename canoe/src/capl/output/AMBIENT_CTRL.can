includes
{
}

variables
{
}

on start
{
  write("[AMBIENT_CTRL] absorbed into BCM runtime; wrapper only");
}
