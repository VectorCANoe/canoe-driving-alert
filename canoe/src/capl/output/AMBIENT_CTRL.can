includes
{
  #include "..\\common\\CAPL_COMMON.cin"
}

variables
{
  msTimer tBcmExt100;
  int gLastBcmDiagReqSid;
  int gLastBcmDiagReqDidHigh;
  int gLastBcmDiagReqDidLow;
  int gLastAlertType;
  int gFlashToggle;
}

void sendBcmDiagResponse()
{
  message frmBcmDiagResMsg mDiagRes;

  mDiagRes.BcmDiagRespCode = (gLastBcmDiagReqSid + 0x40) & 0xFF;
  mDiagRes.BcmDiagData0    = gLastBcmDiagReqDidHigh & 0xFF;
  mDiagRes.BcmDiagData1    = gLastBcmDiagReqDidLow  & 0xFF;
  output(mDiagRes);
}

on start
{
  gLastBcmDiagReqSid     = 0x22;
  gLastBcmDiagReqDidHigh = 0xF1;
  gLastBcmDiagReqDidLow  = 0x90;
  gLastAlertType = -1;
  gFlashToggle   = 0;
  setTimer(tBcmExt100, 100);
  write("[AMBIENT_CTRL] start");
}

on message frmBcmDiagReqMsg
{
  gLastBcmDiagReqSid     = this.BcmDiagServiceId;
  gLastBcmDiagReqDidHigh = this.BcmDiagDidHigh;
  gLastBcmDiagReqDidLow  = this.BcmDiagDidLow;
  sendBcmDiagResponse();
}

on timer tBcmExt100
{
  message frmInteriorLightMsg mLight;
  message frmRainLightAutoMsg mRain;
  int alertType;
  int ambientMode;
  int ambientColor;
  int ambientPattern;
  int flashColor;

  alertType = clampRange((int)@Core::selectedAlertType, 0, 6);

  /* 100ms flash toggle for alternating color patterns. */
  gFlashToggle = 1 - gFlashToggle;

  ambientMode    = 0;
  ambientColor   = 0;
  ambientPattern = 0;
  flashColor     = 0;

  if (alertType == 1)
  {
    ambientMode    = 2;
    flashColor     = gFlashToggle;
    ambientColor   = (flashColor == 1) ? 1 : 5;
    ambientPattern = 2;
  }
  else if (alertType == 2)
  {
    ambientMode    = 2;
    flashColor     = gFlashToggle;
    ambientColor   = (flashColor == 1) ? 1 : 6;
    ambientPattern = 2;
  }
  else if (alertType == 3)
  {
    ambientMode    = 2;
    ambientColor   = 1;
    ambientPattern = 3;
  }
  else if (alertType == 4)
  {
    ambientMode    = 2;
    ambientColor   = 2;
    ambientPattern = 1;
  }
  else if (alertType == 5)
  {
    ambientMode    = 1;
    ambientColor   = 4;
    ambientPattern = 1;
  }
  else if (alertType == 6)
  {
    ambientMode    = 1;
    ambientColor   = 4;
    ambientPattern = 2;
  }

  if (alertType != gLastAlertType)
  {
    write("[BCM] alertType=%d mode=%d color=%d pattern=%d",
          alertType, ambientMode, ambientColor, ambientPattern);
    gLastAlertType = alertType;
  }

  @Body::ambientMode    = ambientMode;
  @Body::ambientColor   = ambientColor;
  @Body::ambientPattern = ambientPattern;

  mLight.CabinLightMode = ambientMode & 0x7;
  mLight.DomeLightLevel = (ambientMode > 0) ? 20 : 4;
  output(mLight);

  /* Keep Comm_202 extension alive without tunneling ambient semantics through rain/light fields. */
  mRain.RainSenseLevel = 0;
  mRain.AutoLightState = 0;
  output(mRain);

  setTimer(tBcmExt100, 100);
}
