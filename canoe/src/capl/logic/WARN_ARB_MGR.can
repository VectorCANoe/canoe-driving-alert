includes
{
}

variables
{
  msTimer tArbiter50;
  int gLastAlertLevel;
  int gLastAlertType;
  int gLastDecelAssistReq;
  int gLastDriverReleaseReason;
  int gPrevEmergencyContext;
  int gPreEmergencyAlertLevel;
  int gPreEmergencyAlertType;
  int gPreEmergencySnapshotValid;
  dword gLastStableAlertMs;
  int gStableAlertLevel;
  int gStableAlertType;
  int gLastStaleInputState;
  int gLastFallbackState;
}

int clampRange(int value, int minValue, int maxValue)
{
  if (value < minValue)
  {
    return minValue;
  }
  if (value > maxValue)
  {
    return maxValue;
  }
  return value;
}

void runArbiter()
{
  message ethDecelAssistReqMsg mDecel;
  message ethSelectedAlertMsg mSelected;
  message ethObjectScenarioAlertMsg mObjAlert;
  int emergencyContext;
  int warningState;
  int baseZoneContext;
  int proximityRiskLevel;
  int failSafeMode;
  int driveState;
  int steeringInput;
  int brakePedal;
  int objectTrackValid;
  int objectConfidence;
  int objectRiskClass;
  int objectTtcMin;
  int intersectionConflictFlag;
  int mergeCutInFlag;
  int objectWarningActive;
  int decelRiskOnThreshold;
  int decelRiskOffThreshold;
  int turnLampState;
  int driveMode;
  int ecoMode;
  int sportMode;
  int driverSeatBelt;
  int passengerSeatBelt;
  int seatBeltWarnLvl;
  int timeoutClear;
  int boundaryStatus;
  int staleInput;
  int fallbackApplied;
  int duplicatePopupGuard;
  dword nowMs;
  dword lastEmergencyRxMs;
  int preAdjustAlertLevel;
  int preAdjustAlertType;
  int prevDecelAssistReq;
  int decelAssistReq;
  int driverReleaseReason;
  int baseAlertLevel;
  int baseAlertType;
  int selectedAlertLevel;
  int selectedAlertType;

  emergencyContext = (int)@Core::emergencyContext;
  warningState = (int)@Core::warningState;
  baseZoneContext = (int)@Core::baseZoneContext;
  if (emergencyContext < 0 || emergencyContext > 2)
  {
    emergencyContext = 0;
  }
  if (warningState < 0 || warningState > 2)
  {
    warningState = 0;
  }
  if (baseZoneContext < 0 || baseZoneContext > 4)
  {
    baseZoneContext = 0;
  }
  proximityRiskLevel = clampRange((int)@Core::proximityRiskLevel, 0, 100);
  failSafeMode = clampRange((int)@Core::failSafeMode, 0, 2);
  driveState = clampRange((int)@Core::driveStateNorm, 0, 3);
  steeringInput = clampRange((int)@Core::steeringInputNorm, 0, 1);
  brakePedal = clampRange((int)@Core::brakePedalNorm, 0, 100);
  objectTrackValid = clampRange((int)@Core::objectTrackValid, 0, 1);
  objectConfidence = clampRange((int)@Core::objectConfidence, 0, 100);
  objectRiskClass = clampRange((int)@Core::objectRiskClass, 0, 7);
  objectTtcMin = clampRange((int)@Core::objectTtcMin, 0, 10000);
  intersectionConflictFlag = clampRange((int)@Core::intersectionConflictFlag, 0, 1);
  mergeCutInFlag = clampRange((int)@Core::mergeCutInFlag, 0, 1);
  timeoutClear = (((int)@Core::timeoutClear) == 1) ? 1 : 0;
  boundaryStatus = clampRange((int)@CoreState::domainBoundaryStatus, 0, 1);
  duplicatePopupGuard = clampRange((int)@CoreState::duplicatePopupGuard, 0, 5000);
  lastEmergencyRxMs = (dword)clampRange((int)@CoreState::lastEmergencyRxMs, 0, 2147483647);
  nowMs = timeNowInt64();
  staleInput = 0;
  fallbackApplied = 0;
  objectWarningActive = 0;
  if (objectTrackValid == 1 && objectConfidence >= 30 && objectRiskClass >= 2)
  {
    objectWarningActive = 1;
  }
  turnLampState = clampRange((int)@CoreState::turnLampState, 0, 3);
  driveMode = clampRange((int)@CoreState::driveMode, 0, 7);
  ecoMode = clampRange((int)@CoreState::ecoMode, 0, 1);
  sportMode = clampRange((int)@CoreState::sportMode, 0, 1);
  driverSeatBelt = clampRange((int)@CoreState::driverSeatBelt, 0, 1);
  passengerSeatBelt = clampRange((int)@CoreState::passengerSeatBelt, 0, 1);
  seatBeltWarnLvl = clampRange((int)@CoreState::seatBeltWarnLvl, 0, 3);

  prevDecelAssistReq = (((int)@Core::decelAssistReq) == 1) ? 1 : 0;
  baseAlertLevel = 0;
  baseAlertType = 0;
  selectedAlertLevel = 0;
  selectedAlertType = 0;
  decelAssistReq = prevDecelAssistReq;
  driverReleaseReason = 0;

  decelRiskOnThreshold = 70;
  decelRiskOffThreshold = 55;
  if (emergencyContext == 0 && objectWarningActive == 1)
  {
    decelRiskOnThreshold = 75;
    decelRiskOffThreshold = 60;
  }

  /* Hysteresis to prevent request chatter around threshold. */
  if (failSafeMode == 0 && driveState == 3 && (emergencyContext > 0 || objectWarningActive == 1))
  {
    if (decelAssistReq == 0 && proximityRiskLevel >= decelRiskOnThreshold)
    {
      decelAssistReq = 1;
    }
    else if (decelAssistReq == 1 && proximityRiskLevel <= decelRiskOffThreshold)
    {
      decelAssistReq = 0;
    }
  }
  else
  {
    decelAssistReq = 0;
  }

  if (decelAssistReq == 1)
  {
    if (brakePedal >= 15)
    {
      decelAssistReq = 0;
      driverReleaseReason = 2;
    }
    else if (steeringInput == 1)
    {
      decelAssistReq = 0;
      driverReleaseReason = 1;
    }
  }

  if (failSafeMode != 0 && prevDecelAssistReq == 1 && decelAssistReq == 0 && driverReleaseReason == 0)
  {
    driverReleaseReason = 3;
  }

  if (baseZoneContext == 3)
  {
    baseAlertLevel = 2;
    baseAlertType = 5;
  }
  else if (baseZoneContext == 4)
  {
    baseAlertLevel = 2;
    baseAlertType = 6;
  }
  else if (warningState > 0)
  {
    if (baseZoneContext == 1)
    {
      baseAlertLevel = 3;
      baseAlertType = 3;
    }
    else if (baseZoneContext == 2)
    {
      baseAlertLevel = 2;
      baseAlertType = 4;
    }
    else if (baseZoneContext == 3)
    {
      baseAlertLevel = 2;
      baseAlertType = 5;
    }
    else if (baseZoneContext == 4)
    {
      baseAlertLevel = 2;
      baseAlertType = 6;
    }
    else
    {
      baseAlertLevel = 1;
      baseAlertType = 1;
    }
  }

  /* Alert Priority preemption entry: snapshot zone state at moment emergency takes over (Req_033) */
  if (emergencyContext > 0 && gPrevEmergencyContext == 0)
  {
    gPreEmergencyAlertLevel = baseAlertLevel;
    gPreEmergencyAlertType = baseAlertType;
    gPreEmergencySnapshotValid = 1;
    write("[WARN_ARB_MGR] Alert Priority preempt: zone lvl=%d type=%d -> emergency=%d",
          gPreEmergencyAlertLevel, gPreEmergencyAlertType, emergencyContext);
  }

  if (emergencyContext == 2)
  {
    /* Alert Priority L4: Ambulance (highest) */
    selectedAlertLevel = 7;
    selectedAlertType = 2;
  }
  else if (emergencyContext == 1)
  {
    /* Alert Priority L3: Police */
    selectedAlertLevel = 6;
    selectedAlertType = 1;
  }
  else if (gPrevEmergencyContext > 0)
  {
    /* Alert Priority recovery: emergency just ended. */
    selectedAlertLevel = baseAlertLevel;
    selectedAlertType = baseAlertType;
    write("[WARN_ARB_MGR] Alert Priority recover: zone lvl=%d type=%d (snapshot was lvl=%d type=%d)",
          selectedAlertLevel, selectedAlertType,
          gPreEmergencyAlertLevel, gPreEmergencyAlertType);
    gPreEmergencySnapshotValid = 0;
  }
  else
  {
    /* Normal zone or idle */
    selectedAlertLevel = baseAlertLevel;
    selectedAlertType = baseAlertType;

    /* Req_134/135/139 pre-activation: object-context arbitration when no emergency. */
    if (objectWarningActive == 1)
    {
      if (intersectionConflictFlag == 1)
      {
        selectedAlertLevel = 4;
        selectedAlertType = 5;
      }
      else if (mergeCutInFlag == 1)
      {
        selectedAlertLevel = 4;
        selectedAlertType = 6;
      }
      else
      {
        selectedAlertLevel = (objectRiskClass >= 4) ? 5 : 3;
        selectedAlertType = 4;
      }
    }
  }

  if (decelAssistReq == 1)
  {
    if (emergencyContext > 0)
    {
      selectedAlertLevel = (emergencyContext == 2) ? 7 : 6;
      selectedAlertType = emergencyContext;
    }
    else if (objectWarningActive == 1)
    {
      if (selectedAlertLevel < 5)
      {
        selectedAlertLevel = 5;
      }
      if (selectedAlertType == 0)
      {
        selectedAlertType = 4;
      }
    }
  }

  /* Req_149: stale input protection for conservative warning policy. */
  if (timeoutClear == 1)
  {
    staleInput = 1;
  }
  else if (emergencyContext > 0 && lastEmergencyRxMs > 0 &&
           (nowMs - lastEmergencyRxMs) >= 1000)
  {
    staleInput = 1;
  }
  else if (boundaryStatus == 0 && (emergencyContext > 0 || selectedAlertLevel > 0))
  {
    staleInput = 1;
  }
  if (staleInput == 1)
  {
    if (selectedAlertLevel < 3)
    {
      selectedAlertLevel = 3;
    }
    if (selectedAlertType == 0)
    {
      selectedAlertType = (emergencyContext > 0) ? emergencyContext : 3;
    }
  }

  /* Req_152: channel fallback warning policy in degraded/blocked output path. */
  if (failSafeMode >= 1 && (selectedAlertLevel > 0 || staleInput == 1))
  {
    fallbackApplied = 1;
    if (selectedAlertLevel < 4)
    {
      selectedAlertLevel = 4;
    }
    if (selectedAlertType == 0)
    {
      selectedAlertType = (emergencyContext > 0) ? emergencyContext : 3;
    }
  }

  preAdjustAlertLevel = selectedAlertLevel;
  preAdjustAlertType = selectedAlertType;

  /* Req_140: turn-lamp context correction for non-emergency guidance alerts. */
  if (emergencyContext == 0 && objectWarningActive == 0 && selectedAlertLevel > 0)
  {
    if (turnLampState == 1)
    {
      selectedAlertType = 5;
    }
    else if (turnLampState == 2)
    {
      selectedAlertType = 6;
    }
  }

  /* Req_141: mode-sensitive warning profile (sport: stricter, eco: softer). */
  if (emergencyContext == 0 && selectedAlertLevel > 0)
  {
    if (sportMode == 1 || driveMode >= 4)
    {
      selectedAlertLevel = clampRange(selectedAlertLevel + 1, 0, 7);
    }
    else if (ecoMode == 1 && selectedAlertLevel > 1)
    {
      selectedAlertLevel = selectedAlertLevel - 1;
    }
  }

  /* Req_142: seat-belt based emphasis on active warnings. */
  if (selectedAlertLevel > 0 &&
      (driverSeatBelt == 0 || passengerSeatBelt == 0 || seatBeltWarnLvl >= 2))
  {
    if (selectedAlertLevel < 5)
    {
      selectedAlertLevel = 5;
    }
    if (selectedAlertType == 0)
    {
      selectedAlertType = 3;
    }
  }

  if (selectedAlertLevel != preAdjustAlertLevel || selectedAlertType != preAdjustAlertType)
  {
    write("[WARN_ARB_MGR] context adjust lvl=%d->%d type=%d->%d turn=%d mode=%d eco=%d sport=%d beltD=%d beltP=%d beltLvl=%d",
          preAdjustAlertLevel, selectedAlertLevel,
          preAdjustAlertType, selectedAlertType,
          turnLampState, driveMode, ecoMode, sportMode,
          driverSeatBelt, passengerSeatBelt, seatBeltWarnLvl);
  }

  /* Req_150: suppress short-window alert oscillation for same-cause alerts. */
  if (gStableAlertLevel < 0)
  {
    gStableAlertLevel = selectedAlertLevel;
    gStableAlertType = selectedAlertType;
    gLastStableAlertMs = nowMs;
  }
  else if (selectedAlertLevel != gStableAlertLevel || selectedAlertType != gStableAlertType)
  {
    if ((nowMs - gLastStableAlertMs) < 1000 &&
        duplicatePopupGuard > 0 &&
        selectedAlertType == gStableAlertType &&
        selectedAlertLevel <= gStableAlertLevel)
    {
      selectedAlertLevel = gStableAlertLevel;
      selectedAlertType = gStableAlertType;
    }
    else
    {
      gStableAlertLevel = selectedAlertLevel;
      gStableAlertType = selectedAlertType;
      gLastStableAlertMs = nowMs;
    }
  }

  if (staleInput != gLastStaleInputState || fallbackApplied != gLastFallbackState)
  {
    write("[WARN_ARB_MGR] robust stale=%d fallback=%d timeout=%d boundary=%d failSafe=%d lastRx=%d",
          staleInput, fallbackApplied, timeoutClear, boundaryStatus, failSafeMode, (int)lastEmergencyRxMs);
    gLastStaleInputState = staleInput;
    gLastFallbackState = fallbackApplied;
  }

  @Core::decelAssistReq = decelAssistReq;
  @Core::selectedAlertLevel = selectedAlertLevel;
  @Core::selectedAlertType = selectedAlertType;
  if (gLastAlertLevel != selectedAlertLevel || gLastAlertType != selectedAlertType)
  {
    @CoreState::arbitrationSnapshotId = ((int)@CoreState::arbitrationSnapshotId + 1) & 0xFFFF;
    gLastAlertLevel = selectedAlertLevel;
    gLastAlertType = selectedAlertType;
  }
  if (gLastDecelAssistReq != decelAssistReq ||
      gLastDriverReleaseReason != driverReleaseReason)
  {
    write("[WARN_ARB_MGR] decelAssistReq=%d risk=%d failSafe=%d steer=%d brake=%d reason=%d objClass=%d objTtc=%d objConf=%d",
          decelAssistReq, proximityRiskLevel, failSafeMode,
          steeringInput, brakePedal, driverReleaseReason,
          objectRiskClass, objectTtcMin, objectConfidence);
    gLastDecelAssistReq = decelAssistReq;
    gLastDriverReleaseReason = driverReleaseReason;
  }

  mDecel.DecelAssistReq = decelAssistReq;
  mDecel.RiskLevel = proximityRiskLevel;
  mDecel.FailSafeMode = failSafeMode;
  mDecel.DriverReleaseReason = driverReleaseReason;
  mDecel.EmergencyContext = emergencyContext;
  output(mDecel);

  mSelected.selectedAlertLevel = clampRange(selectedAlertLevel, 0, 7);
  mSelected.selectedAlertType = clampRange(selectedAlertType, 0, 7);
  mSelected.timeoutClear = timeoutClear;
  output(mSelected);

  mObjAlert.ObjectAlertLevel = clampRange(selectedAlertLevel, 0, 7);
  mObjAlert.ObjectAlertType = clampRange(selectedAlertType, 0, 7);
  mObjAlert.IntersectionConflict = intersectionConflictFlag;
  mObjAlert.MergeCutIn = mergeCutInFlag;
  mObjAlert.ObjectRiskClass = clampRange(objectRiskClass, 0, 7);
  output(mObjAlert);

  gPrevEmergencyContext = emergencyContext;
}

on start
{
  gLastAlertLevel = -1;
  gLastAlertType = -1;
  gLastDecelAssistReq = -1;
  gLastDriverReleaseReason = -1;
  gPrevEmergencyContext = 0;
  gPreEmergencyAlertLevel = 0;
  gPreEmergencyAlertType = 0;
  gPreEmergencySnapshotValid = 0;
  gLastStableAlertMs = 0;
  gStableAlertLevel = -1;
  gStableAlertType = -1;
  gLastStaleInputState = -1;
  gLastFallbackState = -1;
  @Core::decelAssistReq = 0;
  setTimer(tArbiter50, 50);
  write("[WARN_ARB_MGR] start");
}

on timer tArbiter50
{
  runArbiter();
  setTimer(tArbiter50, 50);
}
