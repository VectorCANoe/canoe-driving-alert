includes
{
}

variables
{
  msTimer tArbiter50;
  int gLastAlertLevel;
  int gLastAlertType;
}

void runArbiter()
{
  int emergencyContext;
  int warningState;
  int baseZoneContext;
  int selectedAlertLevel;
  int selectedAlertType;

  emergencyContext = (int)@Core::emergencyContext;
  warningState = (int)@Core::warningState;
  baseZoneContext = (int)@Core::baseZoneContext;
  if (emergencyContext < 0 || emergencyContext > 2)
  {
    emergencyContext = 0;
  }
  if (warningState < 0 || warningState > 2)
  {
    warningState = 0;
  }
  if (baseZoneContext < 0 || baseZoneContext > 4)
  {
    baseZoneContext = 0;
  }
  selectedAlertLevel = 0;
  selectedAlertType = 0;

  if (emergencyContext == 2)
  {
    selectedAlertLevel = 7;
    selectedAlertType = 2;
  }
  else if (emergencyContext == 1)
  {
    selectedAlertLevel = 6;
    selectedAlertType = 1;
  }
  else if (warningState > 0)
  {
    if (baseZoneContext == 1)
    {
      selectedAlertLevel = 3;
      selectedAlertType = 3;
    }
    else if (baseZoneContext == 2)
    {
      selectedAlertLevel = 2;
      selectedAlertType = 4;
    }
    else if (baseZoneContext == 3)
    {
      selectedAlertLevel = 2;
      selectedAlertType = 5;
    }
    else if (baseZoneContext == 4)
    {
      selectedAlertLevel = 2;
      selectedAlertType = 6;
    }
    else
    {
      selectedAlertLevel = 1;
      selectedAlertType = 1;
    }
  }

  @Core::selectedAlertLevel = selectedAlertLevel;
  @Core::selectedAlertType = selectedAlertType;
  if (gLastAlertLevel != selectedAlertLevel || gLastAlertType != selectedAlertType)
  {
    @CoreState::arbitrationSnapshotId = ((int)@CoreState::arbitrationSnapshotId + 1) & 0xFFFF;
    gLastAlertLevel = selectedAlertLevel;
    gLastAlertType = selectedAlertType;
  }
}

on start
{
  gLastAlertLevel = -1;
  gLastAlertType = -1;
  setTimer(tArbiter50, 50);
  write("[WARN_ARB_MGR] start");
}

on timer tArbiter50
{
  runArbiter();
  setTimer(tArbiter50, 50);
}
