includes
{
  #include "..\\common\\CAPL_COMMON.cin"
}

variables
{
  msTimer tAdasCycle;
  msTimer tArbiter50;
  int gLastWarningState;
  dword gHighwayNoSteerStartMs;
  int gLastRiskLevel;
  int gRiskPublishTick;
  int gObjectStatePublishTick;
  dword gLastObjectTrackRxMs;
  int gLastObjectRiskClass;
  int gLastObjectEventCode;
  int gLastInputFilterState;
  int gLastAlertLevel;
  int gLastAlertType;
  int gLastDecelAssistReq;
  int gLastDriverReleaseReason;
  int gPrevEmergencyContext;
  int gPreEmergencyAlertLevel;
  int gPreEmergencyAlertType;
  int gPreEmergencySnapshotValid;
  dword gLastStableAlertMs;
  int gStableAlertLevel;
  int gStableAlertType;
  int gLastStaleInputState;
  int gLastFallbackState;
  int gLastObjectRiskLevel;
  int gLastObjectAlertLevel;
  int gLastObjectAlertType;
}

void publishBackboneDecisionFrames()
{
  message ethEmergencyRiskMsg mRisk;
  message ethDecelAssistReqMsg mDecel;
  message ethSelectedAlertMsg mAlert;
  message ethObjectRiskStateMsg mObjRisk;
  message ethObjectScenarioAlertMsg mObjAlert;
  int emergencyContext;

  emergencyContext = clampRange((int)@Core::emergencyContext, 0, 2);

  /* Internal ADAS gateway seam for CAN-stub today, transport swap later. */
  mRisk.RiskLevel = clampRange((int)@Core::proximityRiskLevel, 0, 100);
  mRisk.EtaSeconds = clampRange((int)@V2X::eta, 0, 255);
  mRisk.VehicleSpeed = clampRange((int)@Core::vehicleSpeedNorm, 0, 255);
  mRisk.EmergencyDirection = clampRange((int)@V2X::emergencyDirection, 0, 3);
  mRisk.EmergencyType = emergencyContext;
  output(mRisk);

  mDecel.DecelAssistReq = (((int)@Core::decelAssistReq) == 1) ? 1 : 0;
  mDecel.FailSafeMode = clampRange((int)@Core::failSafeMode, 0, 2);
  mDecel.DriverReleaseReason = clampRange(gLastDriverReleaseReason, 0, 3);
  mDecel.EmergencyContext = emergencyContext;
  mDecel.RiskLevel = clampRange((int)@Core::proximityRiskLevel, 0, 100);
  output(mDecel);

  mAlert.selectedAlertLevel = clampRange((int)@Core::selectedAlertLevel, 0, 7);
  mAlert.selectedAlertType = clampRange((int)@Core::selectedAlertType, 0, 7);
  mAlert.timeoutClear = (((int)@Core::timeoutClear) == 1) ? 1 : 0;
  output(mAlert);

  mObjRisk.ObjectRiskClass = clampRange((int)@Core::objectRiskClass, 0, 7);
  mObjRisk.ObjectTtcMinMs = clampRange((int)@Core::objectTtcMin, 0, 10000);
  mObjRisk.ObjectRiskLevel = clampRange(gLastObjectRiskLevel, 0, 100);
  mObjRisk.ObjectTrackValid = clampRange((int)@Core::objectTrackValid, 0, 1);
  output(mObjRisk);

  mObjAlert.ObjectAlertLevel = clampRange(gLastObjectAlertLevel, 0, 7);
  mObjAlert.ObjectAlertType = clampRange(gLastObjectAlertType, 0, 7);
  mObjAlert.IntersectionConflict = clampRange((int)@Core::intersectionConflictFlag, 0, 1);
  mObjAlert.MergeCutIn = clampRange((int)@Core::mergeCutInFlag, 0, 1);
  mObjAlert.ObjectRiskClass = clampRange((int)@Core::objectRiskClass, 0, 7);
  output(mObjAlert);
}

int calcProximityRisk(int emergencyContext, int etaSec, int speed, int emergencyDirection, int driveState)
{
  int etaScore;
  int speedScore;
  int directionScore;
  int typeBias;
  int riskLevel;

  if (driveState != 3 || emergencyContext == 0)
  {
    return 0;
  }

  etaScore = 100 - (etaSec * 5);
  etaScore = clampRange(etaScore, 0, 100);
  speedScore = clampRange((speed * 40) / 255, 0, 40);

  if (emergencyDirection == 0)
  {
    directionScore = 25;
  }
  else if (emergencyDirection == 3)
  {
    directionScore = 10;
  }
  else
  {
    directionScore = 18;
  }

  typeBias = (emergencyContext == 2) ? 12 : 6;
  riskLevel = ((etaScore * 55) / 100) + speedScore + directionScore + typeBias;
  return clampRange(riskLevel, 0, 100);
}

int calcObjectTtcMs(int objectRange, int objectRelSpeed)
{
  long closingKph;
  long ttcMs;

  if (objectRelSpeed >= 0 || objectRange <= 0)
  {
    return 10000;
  }

  closingKph = -objectRelSpeed;
  if (closingKph <= 0)
  {
    return 10000;
  }

  ttcMs = ((long)objectRange * 3600) / closingKph;
  if (ttcMs < 0)
  {
    ttcMs = 0;
  }
  if (ttcMs > 10000)
  {
    ttcMs = 10000;
  }
  return (int)ttcMs;
}

int calcObjectRisk(int ttcMs, int confidence, int objectRange,
                   int intersectionConflictFlag, int mergeCutInFlag)
{
  int baseRisk;
  int rangeBias;
  int confidenceBias;
  int scenarioBias;
  int riskLevel;

  if (confidence < 20)
  {
    return 0;
  }

  if (ttcMs <= 1200)
  {
    baseRisk = 85;
  }
  else if (ttcMs <= 2000)
  {
    baseRisk = 72;
  }
  else if (ttcMs <= 3000)
  {
    baseRisk = 58;
  }
  else if (ttcMs <= 4500)
  {
    baseRisk = 40;
  }
  else
  {
    baseRisk = 18;
  }

  rangeBias = clampRange((500 - objectRange) / 10, 0, 20);
  confidenceBias = clampRange((confidence - 50) / 5, -10, 10);
  scenarioBias = 0;
  if (intersectionConflictFlag == 1)
  {
    scenarioBias = scenarioBias + 8;
  }
  if (mergeCutInFlag == 1)
  {
    scenarioBias = scenarioBias + 6;
  }

  riskLevel = baseRisk + rangeBias + confidenceBias + scenarioBias;
  return clampRange(riskLevel, 0, 100);
}

int calcObjectRiskClass(int objectTrackValid, int confidence, int objectRiskLevel)
{
  if (objectTrackValid == 0)
  {
    return 0;
  }
  if (confidence < 30)
  {
    return 1;
  }
  if (objectRiskLevel >= 85)
  {
    return 5;
  }
  if (objectRiskLevel >= 70)
  {
    return 4;
  }
  if (objectRiskLevel >= 55)
  {
    return 3;
  }
  if (objectRiskLevel >= 35)
  {
    return 2;
  }
  return 1;
}

int isObjectWarningActive(int objectTrackValid, int objectConfidence, int objectRiskClass)
{
  if (objectTrackValid == 1 &&
      objectConfidence >= 30 &&
      objectRiskClass >= 2)
  {
    return 1;
  }
  return 0;
}

int getDecelRiskOnThreshold(int emergencyContext, int objectWarningActive)
{
  if (emergencyContext == 0 && objectWarningActive == 1)
  {
    return 75;
  }
  return 70;
}

int getDecelRiskOffThreshold(int emergencyContext, int objectWarningActive)
{
  if (emergencyContext == 0 && objectWarningActive == 1)
  {
    return 60;
  }
  return 55;
}

int getBaseAlertLevel(int baseZoneContext, int warningState)
{
  if (baseZoneContext == 3 || baseZoneContext == 4)
  {
    return 2;
  }
  if (warningState <= 0)
  {
    return 0;
  }
  if (baseZoneContext == 1)
  {
    return 3;
  }
  if (baseZoneContext == 2)
  {
    return 2;
  }
  return 1;
}

int getBaseAlertType(int baseZoneContext, int warningState)
{
  if (baseZoneContext == 3)
  {
    return 5;
  }
  if (baseZoneContext == 4)
  {
    return 6;
  }
  if (warningState <= 0)
  {
    return 0;
  }
  if (baseZoneContext == 1)
  {
    return 3;
  }
  if (baseZoneContext == 2)
  {
    return 4;
  }
  return 1;
}

int getEmergencyAlertLevel(int emergencyContext)
{
  if (emergencyContext == 2)
  {
    return 7;
  }
  if (emergencyContext == 1)
  {
    return 6;
  }
  return 0;
}

int getEmergencyAlertType(int emergencyContext)
{
  if (emergencyContext == 2)
  {
    return 2;
  }
  if (emergencyContext == 1)
  {
    return 1;
  }
  return 0;
}

int getObjectAlertLevel(int intersectionConflictFlag, int mergeCutInFlag, int objectRiskClass)
{
  if (intersectionConflictFlag == 1 || mergeCutInFlag == 1)
  {
    return 4;
  }
  if (objectRiskClass >= 4)
  {
    return 5;
  }
  return 3;
}

int getObjectAlertType(int intersectionConflictFlag, int mergeCutInFlag)
{
  if (intersectionConflictFlag == 1)
  {
    return 5;
  }
  if (mergeCutInFlag == 1)
  {
    return 6;
  }
  return 4;
}

void runArbiter()
{
  int emergencyContext;
  int warningState;
  int baseZoneContext;
  int proximityRiskLevel;
  int failSafeMode;
  int driveState;
  int steeringInput;
  int brakePedal;
  int objectTrackValid;
  int objectConfidence;
  int objectRiskClass;
  int objectTtcMin;
  int intersectionConflictFlag;
  int mergeCutInFlag;
  int objectWarningActive;
  int decelRiskOnThreshold;
  int decelRiskOffThreshold;
  int turnLampState;
  int driveMode;
  int ecoMode;
  int sportMode;
  int driverSeatBelt;
  int passengerSeatBelt;
  int seatBeltWarnLvl;
  int timeoutClear;
  int boundaryStatus;
  int staleInput;
  int fallbackApplied;
  int duplicatePopupGuard;
  dword nowMs;
  dword lastEmergencyRxMs;
  int preAdjustAlertLevel;
  int preAdjustAlertType;
  int prevDecelAssistReq;
  int decelAssistReq;
  int driverReleaseReason;
  int baseAlertLevel;
  int baseAlertType;
  int selectedAlertLevel;
  int selectedAlertType;

  emergencyContext = clampRange((int)@Core::emergencyContext, 0, 2);
  warningState = clampRange((int)@Core::warningState, 0, 2);
  baseZoneContext = clampRange((int)@Core::baseZoneContext, 0, 4);
  proximityRiskLevel = clampRange((int)@Core::proximityRiskLevel, 0, 100);
  failSafeMode = clampRange((int)@Core::failSafeMode, 0, 2);
  driveState = clampRange((int)@Core::driveStateNorm, 0, 3);
  steeringInput = clampRange((int)@Core::steeringInputNorm, 0, 1);
  brakePedal = clampRange((int)@Core::brakePedalNorm, 0, 100);
  objectTrackValid = clampRange((int)@Core::objectTrackValid, 0, 1);
  objectConfidence = clampRange((int)@Core::objectConfidence, 0, 100);
  objectRiskClass = clampRange((int)@Core::objectRiskClass, 0, 7);
  objectTtcMin = clampRange((int)@Core::objectTtcMin, 0, 10000);
  intersectionConflictFlag = clampRange((int)@Core::intersectionConflictFlag, 0, 1);
  mergeCutInFlag = clampRange((int)@Core::mergeCutInFlag, 0, 1);
  timeoutClear = (((int)@Core::timeoutClear) == 1) ? 1 : 0;
  boundaryStatus = clampRange((int)@CoreState::domainBoundaryStatus, 0, 1);
  duplicatePopupGuard = clampRange((int)@CoreState::duplicatePopupGuard, 0, 5000);
  lastEmergencyRxMs = (dword)@CoreState::lastEmergencyRxMs;
  nowMs = getSimulationTimeMs();
  staleInput = 0;
  fallbackApplied = 0;
  objectWarningActive = isObjectWarningActive(objectTrackValid, objectConfidence, objectRiskClass);
  turnLampState = clampRange((int)@CoreState::turnLampState, 0, 3);
  driveMode = clampRange((int)@CoreState::driveMode, 0, 7);
  ecoMode = clampRange((int)@CoreState::ecoMode, 0, 1);
  sportMode = clampRange((int)@CoreState::sportMode, 0, 1);
  driverSeatBelt = clampRange((int)@CoreState::driverSeatBelt, 0, 1);
  passengerSeatBelt = clampRange((int)@CoreState::passengerSeatBelt, 0, 1);
  seatBeltWarnLvl = clampRange((int)@CoreState::seatBeltWarnLvl, 0, 3);

  prevDecelAssistReq = (((int)@Core::decelAssistReq) == 1) ? 1 : 0;
  baseAlertLevel = 0;
  baseAlertType = 0;
  selectedAlertLevel = 0;
  selectedAlertType = 0;
  decelAssistReq = prevDecelAssistReq;
  driverReleaseReason = 0;

  decelRiskOnThreshold = getDecelRiskOnThreshold(emergencyContext, objectWarningActive);
  decelRiskOffThreshold = getDecelRiskOffThreshold(emergencyContext, objectWarningActive);

  if (failSafeMode == 0 && driveState == 3 && (emergencyContext > 0 || objectWarningActive == 1))
  {
    if (decelAssistReq == 0 && proximityRiskLevel >= decelRiskOnThreshold)
    {
      decelAssistReq = 1;
    }
    else if (decelAssistReq == 1 && proximityRiskLevel <= decelRiskOffThreshold)
    {
      decelAssistReq = 0;
    }
  }
  else
  {
    decelAssistReq = 0;
  }

  if (decelAssistReq == 1)
  {
    if (brakePedal >= 15)
    {
      decelAssistReq = 0;
      driverReleaseReason = 2;
    }
    else if (steeringInput == 1)
    {
      decelAssistReq = 0;
      driverReleaseReason = 1;
    }
  }

  if (failSafeMode != 0 && prevDecelAssistReq == 1 && decelAssistReq == 0 && driverReleaseReason == 0)
  {
    driverReleaseReason = 3;
  }

  baseAlertLevel = getBaseAlertLevel(baseZoneContext, warningState);
  baseAlertType = getBaseAlertType(baseZoneContext, warningState);

  if (emergencyContext > 0 && gPrevEmergencyContext == 0)
  {
    gPreEmergencyAlertLevel = baseAlertLevel;
    gPreEmergencyAlertType = baseAlertType;
    gPreEmergencySnapshotValid = 1;
    write("[ADAS] Alert preempt zone lvl=%d type=%d -> emergency=%d",
          gPreEmergencyAlertLevel, gPreEmergencyAlertType, emergencyContext);
  }

  if (emergencyContext == 2)
  {
    selectedAlertLevel = 7;
    selectedAlertType = 2;
  }
  else if (emergencyContext == 1)
  {
    selectedAlertLevel = 6;
    selectedAlertType = 1;
  }
  else if (gPrevEmergencyContext > 0)
  {
    selectedAlertLevel = baseAlertLevel;
    selectedAlertType = baseAlertType;
    gPreEmergencySnapshotValid = 0;
  }
  else
  {
    selectedAlertLevel = baseAlertLevel;
    selectedAlertType = baseAlertType;
    if (objectWarningActive == 1)
    {
      selectedAlertLevel = getObjectAlertLevel(intersectionConflictFlag, mergeCutInFlag, objectRiskClass);
      selectedAlertType = getObjectAlertType(intersectionConflictFlag, mergeCutInFlag);
    }
  }

  if (decelAssistReq == 1)
  {
    if (emergencyContext > 0)
    {
      selectedAlertLevel = getEmergencyAlertLevel(emergencyContext);
      selectedAlertType = getEmergencyAlertType(emergencyContext);
    }
    else if (objectWarningActive == 1)
    {
      if (selectedAlertLevel < 5)
      {
        selectedAlertLevel = 5;
      }
      if (selectedAlertType == 0)
      {
        selectedAlertType = 4;
      }
    }
  }

  if (timeoutClear == 1)
  {
    staleInput = 1;
  }
  else if (emergencyContext > 0 && lastEmergencyRxMs > 0 &&
           (nowMs - lastEmergencyRxMs) >= 1000)
  {
    staleInput = 1;
  }
  else if (boundaryStatus == 0 && (emergencyContext > 0 || selectedAlertLevel > 0))
  {
    staleInput = 1;
  }
  if (staleInput == 1)
  {
    if (selectedAlertLevel < 3)
    {
      selectedAlertLevel = 3;
    }
    if (selectedAlertType == 0)
    {
      selectedAlertType = (emergencyContext > 0) ? getEmergencyAlertType(emergencyContext) : 3;
    }
  }

  if (failSafeMode >= 1 && (selectedAlertLevel > 0 || staleInput == 1))
  {
    fallbackApplied = 1;
    if (selectedAlertLevel < 4)
    {
      selectedAlertLevel = 4;
    }
    if (selectedAlertType == 0)
    {
      selectedAlertType = (emergencyContext > 0) ? getEmergencyAlertType(emergencyContext) : 3;
    }
  }

  preAdjustAlertLevel = selectedAlertLevel;
  preAdjustAlertType = selectedAlertType;

  if (emergencyContext == 0 && objectWarningActive == 0 && selectedAlertLevel > 0)
  {
    if (turnLampState == 1)
    {
      selectedAlertType = 5;
    }
    else if (turnLampState == 2)
    {
      selectedAlertType = 6;
    }
  }

  if (emergencyContext == 0 && selectedAlertLevel > 0)
  {
    if (sportMode == 1 || driveMode >= 4)
    {
      selectedAlertLevel = clampRange(selectedAlertLevel + 1, 0, 7);
    }
    else if (ecoMode == 1 && selectedAlertLevel > 1)
    {
      selectedAlertLevel = selectedAlertLevel - 1;
    }
  }

  if (selectedAlertLevel > 0 &&
      (driverSeatBelt == 0 || passengerSeatBelt == 0 || seatBeltWarnLvl >= 2))
  {
    if (selectedAlertLevel < 5)
    {
      selectedAlertLevel = 5;
    }
    if (selectedAlertType == 0)
    {
      selectedAlertType = 3;
    }
  }

  if (selectedAlertLevel != preAdjustAlertLevel || selectedAlertType != preAdjustAlertType)
  {
    write("[ADAS] context adjust lvl=%d->%d type=%d->%d turn=%d mode=%d eco=%d sport=%d beltD=%d beltP=%d beltLvl=%d",
          preAdjustAlertLevel, selectedAlertLevel,
          preAdjustAlertType, selectedAlertType,
          turnLampState, driveMode, ecoMode, sportMode,
          driverSeatBelt, passengerSeatBelt, seatBeltWarnLvl);
  }

  if (gStableAlertLevel < 0)
  {
    gStableAlertLevel = selectedAlertLevel;
    gStableAlertType = selectedAlertType;
    gLastStableAlertMs = nowMs;
  }
  else if (selectedAlertLevel != gStableAlertLevel || selectedAlertType != gStableAlertType)
  {
    if ((nowMs - gLastStableAlertMs) < 1000 &&
        duplicatePopupGuard > 0 &&
        selectedAlertType == gStableAlertType &&
        selectedAlertLevel <= gStableAlertLevel)
    {
      selectedAlertLevel = gStableAlertLevel;
      selectedAlertType = gStableAlertType;
    }
    else
    {
      gStableAlertLevel = selectedAlertLevel;
      gStableAlertType = selectedAlertType;
      gLastStableAlertMs = nowMs;
    }
  }

  if (staleInput != gLastStaleInputState || fallbackApplied != gLastFallbackState)
  {
    write("[ADAS] robust stale=%d fallback=%d timeout=%d boundary=%d failSafe=%d lastRx=%d",
          staleInput, fallbackApplied, timeoutClear, boundaryStatus, failSafeMode, (int)lastEmergencyRxMs);
    gLastStaleInputState = staleInput;
    gLastFallbackState = fallbackApplied;
  }

  @Core::decelAssistReq = decelAssistReq;
  @Core::selectedAlertLevel = selectedAlertLevel;
  @Core::selectedAlertType = selectedAlertType;
  if (gLastAlertLevel != selectedAlertLevel || gLastAlertType != selectedAlertType)
  {
    @CoreState::arbitrationSnapshotId = ((int)@CoreState::arbitrationSnapshotId + 1) & 0xFFFF;
    gLastAlertLevel = selectedAlertLevel;
    gLastAlertType = selectedAlertType;
  }
  if (gLastDecelAssistReq != decelAssistReq ||
      gLastDriverReleaseReason != driverReleaseReason)
  {
    write("[ADAS] decelAssistReq=%d risk=%d failSafe=%d steer=%d brake=%d reason=%d objClass=%d objTtc=%d objConf=%d",
          decelAssistReq, proximityRiskLevel, failSafeMode,
          steeringInput, brakePedal, driverReleaseReason,
          objectRiskClass, objectTtcMin, objectConfidence);
    gLastDecelAssistReq = decelAssistReq;
    gLastDriverReleaseReason = driverReleaseReason;
  }

  gPrevEmergencyContext = emergencyContext;
}

void updateWarningState()
{
  int speed;
  int driveState;
  int steeringInput;
  int speedLimit;
  int baseZoneContext;
  int emergencyContext;
  int etaSec;
  int emergencyDirection;
  int warningState;
  int riskLevel;
  int objectTrackValid;
  int objectRange;
  int objectRelSpeed;
  int objectConfidence;
  int objectRiskClass;
  int objectRiskLevel;
  int objectTtcMin;
  int intersectionConflictFlag;
  int mergeCutInFlag;
  int objectAlertHoldMs;
  int objectHoldActive;
  int objectInputValid;
  dword nowMs;

  speed = (int)@Core::vehicleSpeedNorm;
  driveState = (int)@Core::driveStateNorm;
  steeringInput = (int)@Core::steeringInputNorm;
  speedLimit = (int)@Core::speedLimitNorm;
  baseZoneContext = (int)@Core::baseZoneContext;
  emergencyContext = (int)@Core::emergencyContext;
  etaSec = (int)@V2X::eta;
  emergencyDirection = (int)@V2X::emergencyDirection;
  objectTrackValid = clampRange((int)@Core::objectTrackValid, 0, 1);
  objectRange = clampRange((int)@Core::objectRange, 0, 500);
  objectRelSpeed = clampRange((int)@Core::objectRelSpeed, -200, 200);
  objectConfidence = clampRange((int)@Core::objectConfidence, 0, 100);
  intersectionConflictFlag = clampRange((int)@Core::intersectionConflictFlag, 0, 1);
  mergeCutInFlag = clampRange((int)@Core::mergeCutInFlag, 0, 1);
  objectAlertHoldMs = clampRange((int)@Core::objectAlertHoldMs, 0, 5000);

  if (objectAlertHoldMs == 0)
  {
    objectAlertHoldMs = 300;
  }
  if (emergencyContext < 0 || emergencyContext > 2)
  {
    emergencyContext = 0;
  }
  etaSec = clampRange(etaSec, 0, 255);
  emergencyDirection = clampRange(emergencyDirection, 0, 3);
  if (speed < 0)
  {
    speed = 0;
  }
  if (speed > 255)
  {
    speed = 255;
  }
  if (driveState < 0 || driveState > 3)
  {
    driveState = 0;
  }
  if (steeringInput < 0 || steeringInput > 1)
  {
    steeringInput = 0;
  }
  if (speedLimit <= 0 || speedLimit > 255)
  {
    speedLimit = 30;
  }
  if (baseZoneContext < 0 || baseZoneContext > 4)
  {
    baseZoneContext = 0;
  }

  nowMs = getSimulationTimeMs();
  objectHoldActive = 0;
  objectInputValid = 0;

  if (objectTrackValid == 1 &&
      objectConfidence >= 25 &&
      objectRange > 0 &&
      objectRange <= 500)
  {
    objectInputValid = 1;
  }

  if (objectInputValid == 0)
  {
    objectTrackValid = 0;
  }

  if (objectTrackValid == 1)
  {
    gLastObjectTrackRxMs = nowMs;
  }
  else if (gLastObjectTrackRxMs != 0 &&
           (nowMs - gLastObjectTrackRxMs) <= (dword)objectAlertHoldMs &&
           gLastObjectRiskClass >= 2)
  {
    objectTrackValid = 1;
    objectHoldActive = 1;
  }

  if (objectTrackValid == 1 && objectConfidence >= 20)
  {
    objectTtcMin = calcObjectTtcMs(objectRange, objectRelSpeed);
    objectRiskLevel = calcObjectRisk(objectTtcMin, objectConfidence, objectRange,
                                     intersectionConflictFlag, mergeCutInFlag);
  }
  else
  {
    objectTtcMin = 10000;
    objectRiskLevel = 0;
  }

  objectRiskClass = calcObjectRiskClass(objectTrackValid, objectConfidence, objectRiskLevel);
  if (objectHoldActive == 1 && objectRiskClass >= 2 && objectRiskClass < 3)
  {
    objectRiskClass = 3;
  }

  if (objectInputValid != gLastInputFilterState)
  {
    write("[ADAS] input filter valid=%d track=%d conf=%d range=%d rel=%d",
          objectInputValid, objectTrackValid, objectConfidence, objectRange, objectRelSpeed);
    gLastInputFilterState = objectInputValid;
  }

  if (objectRiskClass != gLastObjectRiskClass)
  {
    if (objectRiskClass >= 2 && gLastObjectRiskClass < 2)
    {
      @Core::objectEventCode = 1381;
    }
    else if (objectRiskClass < 2 && gLastObjectRiskClass >= 2)
    {
      @Core::objectEventCode = 1382;
    }
    else if (objectRiskClass >= 2)
    {
      @Core::objectEventCode = 1383;
    }
    else
    {
      @Core::objectEventCode = 0;
    }
    gLastObjectRiskClass = objectRiskClass;
  }

  @Core::objectTrackValid = objectTrackValid;
  @Core::objectRange = objectRange;
  @Core::objectRelSpeed = objectRelSpeed;
  @Core::objectConfidence = objectConfidence;
  @Core::objectRiskClass = objectRiskClass;
  @Core::objectTtcMin = objectTtcMin;
  @Core::intersectionConflictFlag = intersectionConflictFlag;
  @Core::mergeCutInFlag = mergeCutInFlag;
  @Core::objectAlertHoldMs = objectAlertHoldMs;
  gLastObjectRiskLevel = objectRiskLevel;
  if (objectRiskClass >= 2)
  {
    gLastObjectAlertLevel = getObjectAlertLevel(intersectionConflictFlag, mergeCutInFlag, objectRiskClass);
    gLastObjectAlertType = getObjectAlertType(intersectionConflictFlag, mergeCutInFlag);
  }
  else
  {
    gLastObjectAlertLevel = 0;
    gLastObjectAlertType = 0;
  }

  riskLevel = calcProximityRisk(emergencyContext, etaSec, speed, emergencyDirection, driveState);
  if (objectRiskLevel > riskLevel)
  {
    riskLevel = objectRiskLevel;
  }
  @Core::proximityRiskLevel = riskLevel;
  warningState = 0;

  if (driveState == 3)
  {
    if (baseZoneContext == 1 && speed > speedLimit)
    {
      warningState = 1;
    }
    else if (baseZoneContext == 2 && speed >= 60 && steeringInput == 0)
    {
      if (gHighwayNoSteerStartMs == 0)
      {
        gHighwayNoSteerStartMs = nowMs;
      }
      if ((nowMs - gHighwayNoSteerStartMs) >= 10000)
      {
        warningState = 2;
      }
    }
    else
    {
      /* Alert Priority timer freeze: do not reset highway timer during active emergency (Req_033).
         Prevents steeringInput glitches during emergency from invalidating the 10s count. */
      if (emergencyContext == 0)
      {
        gHighwayNoSteerStartMs = 0;
      }
    }
  }
  else
  {
    if (emergencyContext == 0)
    {
      gHighwayNoSteerStartMs = 0;
    }
  }

  if (warningState == 0 && objectRiskClass >= 3)
  {
    warningState = 2;
  }

  if (warningState != gLastWarningState)
  {
    message frmAdasChassisStatusMsg mAdas;

    @Core::warningState = warningState;
    mAdas.AdasChassisState = warningState;
    mAdas.AdasHealthLevel = (warningState > 0) ? 1 : 0;
    output(mAdas);
    gLastWarningState = warningState;
  }

  if (riskLevel != gLastRiskLevel)
  {
    gLastRiskLevel = riskLevel;
  }

  if ((int)@Core::objectEventCode != gLastObjectEventCode)
  {
    write("[ADAS] objectEvent=%d riskClass=%d ttcMs=%d conf=%d hold=%d",
          (int)@Core::objectEventCode, objectRiskClass, objectTtcMin,
          objectConfidence, objectHoldActive);
    gLastObjectEventCode = (int)@Core::objectEventCode;
  }
}

on message ethObjectRiskInputMsg
{
  int trackValid;
  int rangeM;
  int relSpeedKph;
  int confidence;
  int intersectionConflict;
  int mergeCutIn;
  int alertHoldMs;

  trackValid = clampRange((int)this.ObjectTrackValid, 0, 1);
  rangeM = clampRange((int)this.ObjectRangeM, 0, 500);
  relSpeedKph = clampRange((int)this.ObjectRelSpeedKph, -200, 200);
  confidence = clampRange((int)this.ObjectConfidence, 0, 100);
  intersectionConflict = clampRange((int)this.IntersectionConflict, 0, 1);
  mergeCutIn = clampRange((int)this.MergeCutIn, 0, 1);
  alertHoldMs = clampRange((int)this.ObjectAlertHoldMs, 0, 5000);
  if (alertHoldMs == 0)
  {
    alertHoldMs = 300;
  }

  @Core::objectTrackValid = trackValid;
  @Core::objectRange = rangeM;
  @Core::objectRelSpeed = relSpeedKph;
  @Core::objectConfidence = confidence;
  @Core::intersectionConflictFlag = intersectionConflict;
  @Core::mergeCutInFlag = mergeCutIn;
  @Core::objectAlertHoldMs = alertHoldMs;
  if (trackValid == 1)
  {
    gLastObjectTrackRxMs = getSimulationTimeMs();
  }
}

on start
{
  gLastWarningState = -1;
  gHighwayNoSteerStartMs = 0;
  gLastRiskLevel = -1;
  gRiskPublishTick = 0;
  gObjectStatePublishTick = 0;
  gLastObjectTrackRxMs = 0;
  gLastObjectRiskClass = 0;
  gLastObjectEventCode = -1;
  gLastInputFilterState = -1;
  gLastAlertLevel = -1;
  gLastAlertType = -1;
  gLastDecelAssistReq = -1;
  gLastDriverReleaseReason = -1;
  gPrevEmergencyContext = 0;
  gPreEmergencyAlertLevel = 0;
  gPreEmergencyAlertType = 0;
  gPreEmergencySnapshotValid = 0;
  gLastStableAlertMs = 0;
  gStableAlertLevel = -1;
  gStableAlertType = -1;
  gLastStaleInputState = -1;
  gLastFallbackState = -1;
  gLastObjectRiskLevel = 0;
  gLastObjectAlertLevel = 0;
  gLastObjectAlertType = 0;
  @Core::proximityRiskLevel = 0;
  @Core::objectTrackValid = 0;
  @Core::objectRange = 0;
  @Core::objectRelSpeed = 0;
  @Core::objectConfidence = 0;
  @Core::objectRiskClass = 0;
  @Core::objectTtcMin = 10000;
  @Core::intersectionConflictFlag = 0;
  @Core::mergeCutInFlag = 0;
  @Core::objectAlertHoldMs = 300;
  @Core::objectEventCode = 0;
  @Core::decelAssistReq = 0;
  setTimer(tAdasCycle, 10);
  setTimer(tArbiter50, 50);
  write("[ADAS] start");
}

on timer tAdasCycle
{
  updateWarningState();
  setTimer(tAdasCycle, 10);
}

on timer tArbiter50
{
  runArbiter();
  publishBackboneDecisionFrames();
  setTimer(tArbiter50, 50);
}
