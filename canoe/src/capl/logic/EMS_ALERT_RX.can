includes
{
}

variables
{
  msTimer tRxCycle;
  msTimer tWatchdog;
  int gPoliceActive;
  int gAmbulanceActive;
  dword gPoliceLastRxMs;
  dword gAmbulanceLastRxMs;
  int gLastEmergencyContext;
  int gLastTimeoutClear;
}

void updateEmergencyContext()
{
  int contextValue;

  contextValue = 0;
  if (gAmbulanceActive == 1)
  {
    contextValue = 2;
  }
  else if (gPoliceActive == 1)
  {
    contextValue = 1;
  }

  if (contextValue != gLastEmergencyContext)
  {
    @Core::emergencyContext = contextValue;
    gLastEmergencyContext = contextValue;
  }
}

void setTimeoutClear(int value)
{
  if (value != gLastTimeoutClear)
  {
    @Core::timeoutClear = value;
    gLastTimeoutClear = value;
  }
}

on start
{
  gPoliceActive = 0;
  gAmbulanceActive = 0;
  gPoliceLastRxMs = 0;
  gAmbulanceLastRxMs = 0;
  gLastEmergencyContext = -1;
  gLastTimeoutClear = -1;
  updateEmergencyContext();
  setTimeoutClear(0);
  setTimer(tRxCycle, 10);
  setTimer(tWatchdog, 1000);
  write("[EMS_ALERT_RX] start");
}

on timer tRxCycle
{
  int emergencyType;
  int alertState;
  dword nowMs;

  emergencyType = (int)@V2X::emergencyType;
  alertState = (int)@V2X::alertState;
  nowMs = timeNow();

  if (alertState == 1 && (emergencyType == 1 || emergencyType == 2))
  {
    setTimeoutClear(0);
    @CoreState::lastEmergencyRxMs = (int)nowMs;
    if (emergencyType == 2)
    {
      gAmbulanceActive = 1;
      gAmbulanceLastRxMs = nowMs;
      gPoliceActive = 0;
    }
    else if (emergencyType == 1)
    {
      gPoliceActive = 1;
      gPoliceLastRxMs = nowMs;
      gAmbulanceActive = 0;
    }
    setTimer(tWatchdog, 1000);
  }
  else
  {
    gPoliceActive = 0;
    gAmbulanceActive = 0;
  }

  updateEmergencyContext();
  setTimer(tRxCycle, 10);
}

on timer tWatchdog
{
  dword nowMs;
  int hadEmergency;

  nowMs = timeNow();
  hadEmergency = ((gPoliceActive == 1) || (gAmbulanceActive == 1));

  if (gPoliceActive == 1 && (nowMs - gPoliceLastRxMs) >= 1000)
  {
    gPoliceActive = 0;
  }

  if (gAmbulanceActive == 1 && (nowMs - gAmbulanceLastRxMs) >= 1000)
  {
    gAmbulanceActive = 0;
  }

  updateEmergencyContext();

  if (hadEmergency == 1 && ((gPoliceActive == 0) && (gAmbulanceActive == 0))
  )
  {
    setTimeoutClear(1);
    write("[EMS_ALERT_RX] watchdog clear");
  }
  setTimer(tWatchdog, 1000);
}
