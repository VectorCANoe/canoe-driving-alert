includes
{
}

variables
{
  msTimer tRxCycle;
  msTimer tWatchdog;
  msTimer tTimeoutClearPulse;
  int gActiveEmergencyType;
  int gActiveEmergencyDirection;
  int gActiveEta;
  int gActiveSourceId;
  dword gActiveLastRxMs;
  int gLastEmergencyContext;
  int gLastTimeoutClear;
}

int clampRange(int value, int minValue, int maxValue)
{
  if (value < minValue)
  {
    return minValue;
  }
  if (value > maxValue)
  {
    return maxValue;
  }
  return value;
}

int isHigherPriority(int newType, int newEta, int newSourceId,
                     int activeType, int activeEta, int activeSourceId)
{
  if (activeType == 0)
  {
    return 1;
  }
  if (newType != activeType)
  {
    return (newType > activeType);
  }
  if (newEta != activeEta)
  {
    return (newEta < activeEta);
  }
  return (newSourceId < activeSourceId);
}

void setTimeoutClear(int value)
{
  if (value != gLastTimeoutClear)
  {
    @Core::timeoutClear = value;
    gLastTimeoutClear = value;
  }
}

void updateEmergencyContext()
{
  int contextValue;

  contextValue = gActiveEmergencyType;
  if (contextValue < 0 || contextValue > 2)
  {
    contextValue = 0;
  }

  if (contextValue != gLastEmergencyContext)
  {
    @Core::emergencyContext = contextValue;
    gLastEmergencyContext = contextValue;
  }
}

void clearEmergencyState()
{
  gActiveEmergencyType = 0;
  gActiveEmergencyDirection = 0;
  gActiveEta = 255;
  gActiveSourceId = 255;
}

void publishActiveEmergencyToV2X()
{
  @V2X::emergencyType = gActiveEmergencyType;
  @V2X::emergencyDirection = gActiveEmergencyDirection;
  @V2X::eta = gActiveEta;
  @V2X::sourceId = gActiveSourceId;
}

on start
{
  clearEmergencyState();
  gActiveLastRxMs = 0;
  gLastEmergencyContext = -1;
  gLastTimeoutClear = -1;
  updateEmergencyContext();
  setTimeoutClear(0);
  setTimer(tRxCycle, 10);
  setTimer(tWatchdog, 1000);
  write("[EMS_ALERT_RX] start");
}

on timer tRxCycle
{
  message frmEmergencyMonitorMsg mMon;
  int emergencyType;
  int emergencyDirection;
  int eta;
  int sourceId;
  int alertState;
  dword nowMs;
  int accepted;

  emergencyType = clampRange((int)@V2X::emergencyType, 0, 2);
  emergencyDirection = clampRange((int)@V2X::emergencyDirection, 0, 3);
  eta = clampRange((int)@V2X::eta, 0, 255);
  sourceId = clampRange((int)@V2X::sourceId, 0, 255);
  alertState = (((int)@V2X::alertState) == 1) ? 1 : 0;
  nowMs = timeNow();
  accepted = 0;

  if (alertState == 1 && (emergencyType == 1 || emergencyType == 2))
  {
    if (isHigherPriority(emergencyType, eta, sourceId,
                         gActiveEmergencyType, gActiveEta, gActiveSourceId))
    {
      gActiveEmergencyType = emergencyType;
      gActiveEmergencyDirection = emergencyDirection;
      gActiveEta = eta;
      gActiveSourceId = sourceId;
      accepted = 1;
    }
    else if (emergencyType == gActiveEmergencyType &&
             sourceId == gActiveSourceId)
    {
      gActiveEmergencyDirection = emergencyDirection;
      gActiveEta = eta;
      accepted = 1;
    }

    if (accepted == 1)
    {
      gActiveLastRxMs = nowMs;
      @CoreState::lastEmergencyRxMs = (int)nowMs;
      publishActiveEmergencyToV2X();
      setTimeoutClear(0);
      setTimer(tWatchdog, 1000);
    }
  }
  else
  {
    if (gActiveEmergencyType != 0)
    {
      clearEmergencyState();
      publishActiveEmergencyToV2X();
      updateEmergencyContext();
    }
  }

  updateEmergencyContext();

  mMon.EmergencyContext = clampRange((int)@Core::emergencyContext, 0, 255);
  mMon.TimeoutClearMon = (((int)@Core::timeoutClear) == 1) ? 1 : 0;
  output(mMon);
  setTimer(tRxCycle, 10);
}

on timer tWatchdog
{
  dword nowMs;

  nowMs = timeNow();
  if (gActiveEmergencyType != 0 && (nowMs - gActiveLastRxMs) >= 1000)
  {
    clearEmergencyState();
    publishActiveEmergencyToV2X();
    updateEmergencyContext();
    setTimeoutClear(1);
    setTimer(tTimeoutClearPulse, 200);
    write("[EMS_ALERT_RX] watchdog clear");
  }
  setTimer(tWatchdog, 1000);
}

on timer tTimeoutClearPulse
{
  setTimeoutClear(0);
}
