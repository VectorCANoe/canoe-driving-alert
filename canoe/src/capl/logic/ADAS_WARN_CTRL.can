includes
{
}

variables
{
  msTimer tAdasCycle;
  int gLastWarningState;
  dword gHighwayNoSteerStartMs;
}

void updateWarningState()
{
  int speed;
  int driveState;
  int steeringInput;
  int speedLimit;
  int baseZoneContext;
  int warningState;
  dword nowMs;

  speed = (int)@Core::vehicleSpeedNorm;
  driveState = (int)@Core::driveStateNorm;
  steeringInput = (int)@Core::steeringInputNorm;
  speedLimit = (int)@Core::speedLimitNorm;
  baseZoneContext = (int)@Core::baseZoneContext;
  if (speed < 0)
  {
    speed = 0;
  }
  if (speed > 255)
  {
    speed = 255;
  }
  if (driveState < 0 || driveState > 3)
  {
    driveState = 0;
  }
  if (steeringInput < 0 || steeringInput > 1)
  {
    steeringInput = 0;
  }
  if (speedLimit <= 0 || speedLimit > 255)
  {
    speedLimit = 30;
  }
  if (baseZoneContext < 0 || baseZoneContext > 4)
  {
    baseZoneContext = 0;
  }
  warningState = 0;
  nowMs = timeNow();

  if (driveState == 3)
  {
    if (baseZoneContext == 1 && speed > speedLimit)
    {
      warningState = 1;
    }
    else if (baseZoneContext == 2 && speed >= 60 && steeringInput == 0)
    {
      if (gHighwayNoSteerStartMs == 0)
      {
        gHighwayNoSteerStartMs = nowMs;
      }
      if ((nowMs - gHighwayNoSteerStartMs) >= 10000)
      {
        warningState = 2;
      }
    }
    else
    {
      gHighwayNoSteerStartMs = 0;
    }
  }
  else
  {
    gHighwayNoSteerStartMs = 0;
  }

  if (warningState != gLastWarningState)
  {
    @Core::warningState = warningState;
    gLastWarningState = warningState;
  }
}

on start
{
  gLastWarningState = -1;
  gHighwayNoSteerStartMs = 0;
  setTimer(tAdasCycle, 10);
  write("[ADAS_WARN_CTRL] start");
}

on timer tAdasCycle
{
  updateWarningState();
  setTimer(tAdasCycle, 10);
}
