includes
{
}

variables
{
  msTimer tAdasCycle;
  int gLastWarningState;
}

void updateWarningState()
{
  int speed;
  int driveState;
  int steeringInput;
  int baseZoneContext;
  int warningState;

  speed = (int)@Core::vehicleSpeedNorm;
  driveState = (int)@Core::driveStateNorm;
  steeringInput = (int)@Core::steeringInputNorm;
  baseZoneContext = (int)@Core::baseZoneContext;
  if (speed < 0)
  {
    speed = 0;
  }
  if (speed > 255)
  {
    speed = 255;
  }
  if (driveState < 0 || driveState > 3)
  {
    driveState = 0;
  }
  if (steeringInput < 0 || steeringInput > 1)
  {
    steeringInput = 0;
  }
  warningState = 0;

  if (driveState == 3)
  {
    if (baseZoneContext == 1 && speed > 30)
    {
      warningState = 1;
    }
    else if (baseZoneContext == 2 && steeringInput == 0)
    {
      warningState = 2;
    }
  }

  if (warningState != gLastWarningState)
  {
    @Core::warningState = warningState;
    gLastWarningState = warningState;
  }
}

on start
{
  gLastWarningState = -1;
  setTimer(tAdasCycle, 10);
  write("[ADAS_WARN_CTRL] start");
}

on timer tAdasCycle
{
  updateWarningState();
  setTimer(tAdasCycle, 10);
}
