includes
{
}

variables
{
}

on start
{
  write("[NAV_CTX_MGR] absorbed into IVI runtime; wrapper only");
}
