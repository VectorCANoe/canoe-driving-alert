includes
{
}

variables
{
  msTimer tAmbCycle;
  int gPrevDispatch;
}

on start
{
  gPrevDispatch = 0;
  setTimer(tAmbCycle, 100);
  write("[EMS_AMB_TX] start");
}

on timer tAmbCycle
{
  int dispatch;

  dispatch = (int)@V2X::ambulanceDispatch;
  if (dispatch < 0) dispatch = 0;
  if (dispatch > 1) dispatch = 1;

  if (dispatch == 1 && gPrevDispatch == 0)
  {
    /* Panel: ambulance dispatch activated (higher priority than police) */
    @V2X::emergencyType      = 2;
    @V2X::alertState         = 1;
    @V2X::sourceId           = 2;
    @V2X::eta                = 20;
    @V2X::emergencyDirection = 0;
    write("[EMS_AMB_TX] ACTIVE  type=2 src=2 eta=20");
  }
  else if (dispatch == 0 && gPrevDispatch == 1)
  {
    /* clear only if ambulance still owns the channel */
    if ((int)@V2X::sourceId == 2)
    {
      @V2X::alertState = 0;
      write("[EMS_AMB_TX] CLEAR");
    }
  }
  gPrevDispatch = dispatch;

  setTimer(tAmbCycle, 100);
}
