includes
{
}

variables
{
  msTimer tAmbCycle;
  int gPrevDispatch;
}

on start
{
  gPrevDispatch = 0;
  setTimer(tAmbCycle, 100);
  write("[EMS_AMB_TX] start");
}

on timer tAmbCycle
{
  message frmEmergencyBroadcastMsg mBcast;
  int dispatch;

  dispatch = (int)@V2X::ambulanceDispatch;
  if (dispatch < 0) dispatch = 0;
  if (dispatch > 1) dispatch = 1;

  if (dispatch == 1 && gPrevDispatch == 0)
  {
    /* rising edge: ambulance dispatch activated (higher priority than police) */
    /* v1 sysvar path (panel/legacy compat) */
    @V2X::emergencyType      = 2;
    @V2X::alertState         = 1;
    @V2X::sourceId           = 2;
    @V2X::eta                = 20;
    @V2X::emergencyDirection = 0;

    /* v2: broadcast CAN frame on ETH backbone ch5 (stub for CANoe.Ethernet) */
    mBcast.VehicleType = 2;
    mBcast.Status      = 1;
    mBcast.SourceId    = 2;
    mBcast.EtaSeconds  = 20;
    mBcast.Direction   = 0;
    output(mBcast);

    write("[EMS_AMB_TX] ACTIVE  type=2 src=2 eta=20");
  }
  else if (dispatch == 0 && gPrevDispatch == 1)
  {
    /* falling edge: clear if ambulance still owns the channel */
    if ((int)@V2X::sourceId == 2)
    {
      /* v1 sysvar path */
      @V2X::alertState = 0;

      /* v2: broadcast CLEAR frame on ETH backbone ch5 */
      mBcast.VehicleType = 2;
      mBcast.Status      = 0;
      mBcast.SourceId    = 2;
      mBcast.EtaSeconds  = 0;
      mBcast.Direction   = 0;
      output(mBcast);

      write("[EMS_AMB_TX] CLEAR");
    }
  }
  gPrevDispatch = dispatch;

  setTimer(tAmbCycle, 100);
}
