includes
{
}

variables
{
}

on start
{
  write("[EMS_AMB_TX] start");
}
