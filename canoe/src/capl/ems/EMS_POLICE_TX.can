includes
{
}

variables
{
}

on start
{
  write("[EMS_POLICE_TX] start");
}
