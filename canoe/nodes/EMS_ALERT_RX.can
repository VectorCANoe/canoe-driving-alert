includes
{
}

variables
{
  msTimer tRxCycle;
  msTimer tWatchdog;
  int gPoliceActive;
  int gAmbulanceActive;
  dword gPoliceLastRxMs;
  dword gAmbulanceLastRxMs;
}

void updateEmergencyContext()
{
  if (gAmbulanceActive == 1)
  {
    @Core::emergencyContext = 2;
  }
  else if (gPoliceActive == 1)
  {
    @Core::emergencyContext = 1;
  }
  else
  {
    @Core::emergencyContext = 0;
  }
}

on start
{
  gPoliceActive = 0;
  gAmbulanceActive = 0;
  gPoliceLastRxMs = 0;
  gAmbulanceLastRxMs = 0;
  @Core::emergencyContext = 0;
  @Core::timeoutClear = 0;
  setTimer(tRxCycle, 10);
  setTimer(tWatchdog, 1000);
  write("[EMS_ALERT_RX] start");
}

on stopMeasurement
{
}

on timer tRxCycle
{
  int emergencyType;
  int alertState;
  dword nowMs;

  emergencyType = (int)@V2X::emergencyType;
  alertState = (int)@V2X::alertState;
  nowMs = timeNow();

  if (alertState == 1)
  {
    @Core::timeoutClear = 0;
    @CoreState::lastEmergencyRxMs = (int)nowMs;
    if (emergencyType == 2)
    {
      gAmbulanceActive = 1;
      gAmbulanceLastRxMs = nowMs;
      gPoliceActive = 0;
    }
    else if (emergencyType == 1)
    {
      gPoliceActive = 1;
      gPoliceLastRxMs = nowMs;
      gAmbulanceActive = 0;
    }
    setTimer(tWatchdog, 1000);
  }
  else
  {
    gPoliceActive = 0;
    gAmbulanceActive = 0;
  }

  updateEmergencyContext();
  setTimer(tRxCycle, 10);
}

on timer tWatchdog
{
  dword nowMs;
  int hadEmergency;

  nowMs = timeNow();
  hadEmergency = ((gPoliceActive == 1) || (gAmbulanceActive == 1));

  if (gPoliceActive == 1 && (nowMs - gPoliceLastRxMs) >= 1000)
  {
    gPoliceActive = 0;
  }

  if (gAmbulanceActive == 1 && (nowMs - gAmbulanceLastRxMs) >= 1000)
  {
    gAmbulanceActive = 0;
  }

  updateEmergencyContext();

  if (hadEmergency == 1 && ((gPoliceActive == 0) && (gAmbulanceActive == 0))
  )
  {
    @Core::timeoutClear = 1;
    write("[EMS_ALERT_RX] watchdog clear");
  }
  setTimer(tWatchdog, 1000);
}
