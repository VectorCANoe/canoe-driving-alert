includes
{
}

variables
{
  dword gUdpSocket;
  msTimer tRxCycle;
  msTimer tWatchdog;
  byte gRxBuf[16];
  long gRxLen;
  int gPoliceActive;
  int gAmbulanceActive;
  dword gPoliceLastRxMs;
  dword gAmbulanceLastRxMs;
}

void updateEmergencyContext()
{
  if (gAmbulanceActive == 1)
  {
    @Core::emergencyContext = 2;
  }
  else if (gPoliceActive == 1)
  {
    @Core::emergencyContext = 1;
  }
  else
  {
    @Core::emergencyContext = 0;
  }
}

on start
{
  gUdpSocket = UdpSocket::Open(5000);
  gPoliceActive = 0;
  gAmbulanceActive = 0;
  gPoliceLastRxMs = 0;
  gAmbulanceLastRxMs = 0;
  @Core::emergencyContext = 0;
  @Core::timeoutClear = 0;
  setTimer(tRxCycle, 10);
  setTimer(tWatchdog, 1000);
  write("[EMS_ALERT_RX] start");
}

on stopMeasurement
{
  UdpSocket::Close(gUdpSocket);
}

on timer tRxCycle
{
  int emergencyType;
  int emergencyDirection;
  int eta;
  int sourceId;
  int alertState;

  gRxLen = UdpSocket::ReceiveFrom(gUdpSocket, gRxBuf, elcount(gRxBuf));
  if (gRxLen == 5 && gRxBuf[0] == 0xE1)
  {
    emergencyType = (int)(gRxBuf[1] & 0x03);
    emergencyDirection = (int)((gRxBuf[1] >> 2) & 0x03);
    eta = (int)gRxBuf[2];
    sourceId = (int)gRxBuf[3];
    alertState = (int)(gRxBuf[4] & 0x01);

    @V2X::emergencyType = emergencyType;
    @V2X::emergencyDirection = emergencyDirection;
    @V2X::eta = eta;
    @V2X::sourceId = sourceId;
    @V2X::alertState = alertState;
    @Core::timeoutClear = 0;

    if (alertState == 1)
    {
      @CoreState::lastEmergencyRxMs = (int)timeNow();
      if (emergencyType == 2 || sourceId == 2)
      {
        gAmbulanceActive = 1;
        gAmbulanceLastRxMs = timeNow();
      }
      else if (emergencyType == 1 || sourceId == 1)
      {
        gPoliceActive = 1;
        gPoliceLastRxMs = timeNow();
      }
      updateEmergencyContext();
      setTimer(tWatchdog, 1000);
    }
    else
    {
      if (emergencyType == 2 || sourceId == 2)
      {
        gAmbulanceActive = 0;
      }
      else if (emergencyType == 1 || sourceId == 1)
      {
        gPoliceActive = 0;
      }
      updateEmergencyContext();
    }
  }

  setTimer(tRxCycle, 10);
}

on timer tWatchdog
{
  dword nowMs;
  int hadEmergency;

  nowMs = timeNow();
  hadEmergency = ((gPoliceActive == 1) || (gAmbulanceActive == 1));

  if (gPoliceActive == 1 && (nowMs - gPoliceLastRxMs) >= 1000)
  {
    gPoliceActive = 0;
  }

  if (gAmbulanceActive == 1 && (nowMs - gAmbulanceLastRxMs) >= 1000)
  {
    gAmbulanceActive = 0;
  }

  updateEmergencyContext();

  if (hadEmergency == 1 && ((gPoliceActive == 0) && (gAmbulanceActive == 0))
  )
  {
    @Core::timeoutClear = 1;
    write("[EMS_ALERT_RX] watchdog clear");
  }
  setTimer(tWatchdog, 1000);
}
