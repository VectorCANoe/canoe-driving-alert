includes
{
}

variables
{
}

on start
{
  write("[INFOTAINMENT_GW] start");
}

on message frmNavContextCanMsg
{
  int roadZone;
  int navDirection;
  int zoneDistance;

  roadZone = this.gRoadZone;
  navDirection = this.gNavDirection;
  zoneDistance = this.gZoneDistance;
  @Infotainment::roadZone = roadZone;
  @Infotainment::navDirection = navDirection;
  @Infotainment::zoneDistance = zoneDistance;
}
