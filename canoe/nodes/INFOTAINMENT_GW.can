includes
{
}

variables
{
  dword gUdpSocket;
  byte gTxBuf[8];
}

on start
{
  gUdpSocket = UdpSocket::Open(5000);
  write("[INFOTAINMENT_GW] start");
}

on stopMeasurement
{
  UdpSocket::Close(gUdpSocket);
}

on message frmNavContextCanMsg
{
  int roadZone;
  int navDirection;
  int zoneDistance;

  roadZone = this.gRoadZone;
  navDirection = this.gNavDirection;
  zoneDistance = this.gZoneDistance;

  gTxBuf[0] = (byte)((roadZone & 0x03) | ((navDirection & 0x03) << 2));
  gTxBuf[1] = (byte)(((zoneDistance + 2) > 255) ? 255 : (zoneDistance + 2));
  UdpSocket::SendTo(gUdpSocket, "127.0.0.1", 5000, gTxBuf, 2);
}
