includes
{
}

variables
{
  dword gUdpSocket;
  byte gTxBuf[8];
}

on start
{
  gUdpSocket = UdpSocket::Open(5000);
  write("[CHASSIS_GW] start");
}

on stopMeasurement
{
  UdpSocket::Close(gUdpSocket);
}

on message frmVehicleStateCanMsg
{
  int speed;
  int driveState;

  speed = this.gVehicleSpeed;
  driveState = this.gDriveState;

  @Core::vehicleSpeedNorm = speed;
  @Core::driveStateNorm = driveState;

  gTxBuf[0] = (byte)(speed & 0xFF);
  gTxBuf[1] = (byte)((driveState + 2) & 0xFF);
  UdpSocket::SendTo(gUdpSocket, "127.0.0.1", 5000, gTxBuf, 2);
}

on message frmSteeringCanMsg
{
  int steering;

  steering = this.SteeringInput;
  @Core::steeringInputNorm = steering;

  gTxBuf[0] = (byte)(steering & 0x01);
  UdpSocket::SendTo(gUdpSocket, "127.0.0.1", 5000, gTxBuf, 1);
}
