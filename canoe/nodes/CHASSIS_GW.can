includes
{
}

variables
{
}

on start
{
  write("[CHASSIS_GW] start");
}

on message frmVehicleStateCanMsg
{
  int speed;
  int driveState;

  speed = this.gVehicleSpeed;
  driveState = this.gDriveState;

  @Core::vehicleSpeedNorm = speed;
  @Core::driveStateNorm = driveState;
}

on message frmSteeringCanMsg
{
  int steering;

  steering = this.SteeringInput;
  @Core::steeringInputNorm = steering;
}
