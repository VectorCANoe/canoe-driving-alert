includes
{
}

variables
{
  msTimer tAdasCycle;
}

void updateWarningState()
{
  int speed;
  int driveState;
  int steeringInput;
  int baseZoneContext;
  int warningState;

  speed = (int)@Core::vehicleSpeedNorm;
  driveState = (int)@Core::driveStateNorm;
  steeringInput = (int)@Core::steeringInputNorm;
  baseZoneContext = (int)@Core::baseZoneContext;
  warningState = 0;

  if (driveState == 3)
  {
    if (baseZoneContext == 1 && speed > 30)
    {
      warningState = 1;
    }
    else if (baseZoneContext == 2 && steeringInput == 0)
    {
      warningState = 2;
    }
  }

  @Core::warningState = warningState;
}

on start
{
  setTimer(tAdasCycle, 10);
  write("[ADAS_WARN_CTRL] start");
}

on timer tAdasCycle
{
  updateWarningState();
  setTimer(tAdasCycle, 10);
}
