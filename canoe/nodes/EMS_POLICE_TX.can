includes
{
}

variables
{
  dword gUdpSocket;
  msTimer tE100Police;
  byte gTxBuf[8];
}

on start
{
  gUdpSocket = UdpSocket::Open(5000);
  setTimer(tE100Police, 100);
  write("[EMS_POLICE_TX] start");
}

on stopMeasurement
{
  UdpSocket::Close(gUdpSocket);
}

on timer tE100Police
{
  int emergencyType;
  int emergencyDirection;
  int eta;
  int alertState;

  emergencyType = 1;
  emergencyDirection = (int)@V2X::emergencyDirection;
  eta = (int)@V2X::eta;
  alertState = (int)@V2X::alertState;

  gTxBuf[0] = (byte)((emergencyType & 0x03) | ((emergencyDirection & 0x03) << 2));
  gTxBuf[1] = (byte)(eta & 0xFF);
  gTxBuf[2] = (byte)1;
  gTxBuf[3] = (byte)(alertState & 0x01);

  UdpSocket::SendTo(gUdpSocket, "127.0.0.1", 5000, gTxBuf, 4);
  setTimer(tE100Police, 100);
}
