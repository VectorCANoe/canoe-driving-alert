includes
{
}

variables
{
  msTimer tE100Police;
}

on start
{
  setTimer(tE100Police, 100);
  write("[EMS_POLICE_TX] start");
}

on timer tE100Police
{
  setTimer(tE100Police, 100);
}
