/*
 * Cluster_ECU.can — Instrument Cluster Warning Display
 *
 * 역할:
 *   - Cluster_Warning CAN (0x221) 수신 → 경고 종류에 따라 텍스트 출력
 *   - 긴급차량 접근 시: 차종 + 방향 + 양보 유도 문구 표시 (Req_021, Req_029)
 *   - 구간 경고 시: 해당 구간 경고 문구 표시
 *   - 경고 해제 시: 정상 상태로 복귀 (Req_004, Req_026)
 *
 * Panel 표시 구조 (CANoe Panel에서 Static Text로 연결):
 *   - 경고 텍스트 영역: 2줄 (메인 메시지 + 보조 메시지)
 *   - 긴급 경고 시: 배경색 변경 (빨강 테두리)
 *   - 방향 인디케이터: 화살표 아이콘 (Direction 값 기반)
 *
 * V-Model: SWE.3 (구현)
 * Req 추적: Req_019 (종류 표시), Req_020 (방향 표시), Req_021 (양보 문구),
 *           Req_040 (문구 간결성), Req_043 (경고 문구 간결성)
 */

includes
{
}

variables
{
  /* WarningType 상수 (DBC VAL_ 기준) */
  const int WARN_NONE       = 0;
  const int WARN_SCHOOLZONE = 1;
  const int WARN_HIGHWAY    = 2;
  const int WARN_IC_GUIDE   = 3;
  const int WARN_POLICE     = 4;
  const int WARN_AMBULANCE  = 5;

  /* Direction 상수 */
  const int DIR_FRONT = 0;
  const int DIR_LEFT  = 1;
  const int DIR_RIGHT = 2;
  const int DIR_REAR  = 3;

  /* 현재 표시 중인 경고 */
  int gCurrentWarning = 0;
}

/*============================================================
 * 초기화
 *============================================================*/
on start
{
  write("[Cluster_ECU] 노드 시작 — 정상 주행");
  write("[Cluster_ECU] ───────────────────────────────");
  write("[Cluster_ECU] 상태: 정상 주행 중");
  write("[Cluster_ECU] ───────────────────────────────");
}

/*============================================================
 * Cluster_Warning CAN 수신 (0x221)
 * Civ_Node Alert Arbiter 결과 표시
 * Req_005: 경고 발생 이유 운전자가 이해 가능한 형태로 표시
 *============================================================*/
on message Cluster_Warning
{
  int warnType  = this.WarningType;
  int active    = this.WarningActive;
  int emgVeh    = this.EmergencyVehicle;
  int direction = this.Direction;

  if (warnType == gCurrentWarning && active == 1)
    return; /* 동일 경고 반복 수신 → 무시 (Req_006: 반복 억제) */

  gCurrentWarning = (active == 1) ? warnType : WARN_NONE;

  write("[Cluster_ECU] ═══════════════════════════════");

  switch (warnType)
  {
    case WARN_NONE:
      write("[Cluster_ECU] 상태: 정상 주행 중");
      break;

    case WARN_SCHOOLZONE:
      if (active == 1)
      {
        write("[Cluster_ECU] ⚠  스쿨존 과속 경고  ⚠");
        write("[Cluster_ECU] 제한속도: 30 km/h  속도를 줄이세요");
      }
      else
      {
        write("[Cluster_ECU] 스쿨존 경고 해제");
      }
      break;

    case WARN_HIGHWAY:
      if (active == 1)
      {
        write("[Cluster_ECU] ⚠  고속도로 주의 저하 감지  ⚠");
        write("[Cluster_ECU] 조향을 확인하세요");
      }
      else
      {
        write("[Cluster_ECU] 고속도로 경고 해제");
      }
      break;

    case WARN_IC_GUIDE:
      if (active == 1)
      {
        if (direction == 0) /* LeftExit */
          write("[Cluster_ECU] ← IC 출구 안내: 좌측 진출");
        else
          write("[Cluster_ECU] → IC 출구 안내: 우측 진출");
        write("[Cluster_ECU] 앰비언트 방향 유도를 확인하세요");
      }
      else
      {
        write("[Cluster_ECU] IC 안내 해제");
      }
      break;

    case WARN_POLICE:
      if (active == 1)
      {
        write("[Cluster_ECU] ★★  경찰차 긴급 접근  ★★");
        writeDirectionMsg(direction);
        write("[Cluster_ECU] ▶ 우측 차선으로 양보하세요");
      }
      else
      {
        write("[Cluster_ECU] 경찰차 긴급 상황 해제");
        write("[Cluster_ECU] 정상 주행으로 복귀합니다");
      }
      break;

    case WARN_AMBULANCE:
      if (active == 1)
      {
        write("[Cluster_ECU] ★★  구급차 긴급 접근  ★★");
        writeDirectionMsg(direction);
        write("[Cluster_ECU] ▶ 즉시 우측 양보 — 생명을 살릴 수 있습니다");
      }
      else
      {
        write("[Cluster_ECU] 구급차 긴급 상황 해제");
        write("[Cluster_ECU] 정상 주행으로 복귀합니다");
      }
      break;

    default:
      write("[Cluster_ECU] 알 수 없는 경고 유형 (%d)", warnType);
      break;
  }

  write("[Cluster_ECU] ═══════════════════════════════");
}

/*============================================================
 * 방향 문구 출력 헬퍼
 * Req_020: 긴급차량 진행 방향 정보 표시
 *============================================================*/
void writeDirectionMsg(int dir)
{
  switch (dir)
  {
    case DIR_FRONT: write("[Cluster_ECU] 접근 방향: 전방"); break;
    case DIR_LEFT:  write("[Cluster_ECU] 접근 방향: 좌측"); break;
    case DIR_RIGHT: write("[Cluster_ECU] 접근 방향: 우측"); break;
    case DIR_REAR:  write("[Cluster_ECU] 접근 방향: 후방"); break;
    default:        write("[Cluster_ECU] 접근 방향: 확인 중"); break;
  }
}
