includes
{
}

variables
{
  msTimer tIviCycle;
}

on start
{
  setTimer(tIviCycle, 10);
  write("[IVI_GW] start");
}

on timer tIviCycle
{
  int alertLevel;
  int alertType;
  int timeoutClear;
  int warningTextCode;
  message frmClusterWarningMsg mCluster;

  alertLevel = (int)@Core::selectedAlertLevel;
  alertType = (int)@Core::selectedAlertType;
  timeoutClear = (int)@Core::timeoutClear;

  if (timeoutClear == 1 || alertLevel == 0)
  {
    warningTextCode = 0;
  }
  else
  {
    warningTextCode = (alertType * 10) + alertLevel;
  }

  @Cluster::warningTextCode = warningTextCode;
  mCluster.WarningTextCode = warningTextCode;
  output(mCluster);

  if (timeoutClear == 1)
  {
    @Core::timeoutClear = 0;
  }
  setTimer(tIviCycle, 10);
}
