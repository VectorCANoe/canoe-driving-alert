includes
{
}

variables
{
  msTimer tNavCycle;
}

on start
{
  setTimer(tNavCycle, 10);
  write("[NAV_CONTEXT_MGR] start");
}

on timer tNavCycle
{
  int roadZone;
  int navDirection;
  int zoneDistance;
  int baseZoneContext;

  roadZone = (int)@Infotainment::roadZone;
  navDirection = (int)@Infotainment::navDirection;
  zoneDistance = (int)@Infotainment::zoneDistance;

  baseZoneContext = 0;
  if (roadZone == 1)
  {
    baseZoneContext = 1;
  }
  else if (roadZone == 2)
  {
    baseZoneContext = 2;
  }
  else if (roadZone == 3)
  {
    if (navDirection == 1)
    {
      baseZoneContext = 3;
    }
    else if (navDirection == 2)
    {
      baseZoneContext = 4;
    }
    else
    {
      baseZoneContext = 3;
    }
  }
  else
  {
    baseZoneContext = 0;
  }

  @Core::baseZoneContext = baseZoneContext;

  setTimer(tNavCycle, 10);
}
