includes
{
}

variables
{
  dword gUdpSocket;
  msTimer tE100Ambulance;
  byte gTxBuf[8];
}

on start
{
  gUdpSocket = UdpSocket::Open(5000);
  setTimer(tE100Ambulance, 100);
  write("[EMS_AMB_TX] start");
}

on stopMeasurement
{
  UdpSocket::Close(gUdpSocket);
}

on timer tE100Ambulance
{
  int emergencyType;
  int emergencyDirection;
  int eta;
  int alertState;

  emergencyType = 2;
  emergencyDirection = (int)@V2X::emergencyDirection;
  eta = (int)@V2X::eta;
  alertState = (int)@V2X::alertState;

  gTxBuf[0] = 0xE1;
  gTxBuf[1] = (byte)((emergencyType & 0x03) | ((emergencyDirection & 0x03) << 2));
  gTxBuf[2] = (byte)(eta & 0xFF);
  gTxBuf[3] = (byte)2;
  gTxBuf[4] = (byte)(alertState & 0x01);

  UdpSocket::SendTo(gUdpSocket, "255.255.255.255", 5000, gTxBuf, 5);
  setTimer(tE100Ambulance, 100);
}
