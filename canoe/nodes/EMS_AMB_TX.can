includes
{
}

variables
{
  msTimer tE100Ambulance;
}

on start
{
  setTimer(tE100Ambulance, 100);
  write("[EMS_AMB_TX] start");
}

on timer tE100Ambulance
{
  setTimer(tE100Ambulance, 100);
}
