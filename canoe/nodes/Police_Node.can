/*
 * Police_Node.can — V2V Police Emergency Vehicle
 *
 * 역할:
 *   - Panel [긴급 출동] 버튼 → sysvar V2V::Police_Active = 1
 *   - Panel [해제] 버튼      → sysvar V2V::Police_Active = 0
 *   - 긴급 활성 시 500ms 주기 keepAlive 브로드캐스트 (ETH 시뮬)
 *
 * Ethernet 시뮬레이션 방식:
 *   실제 배포 시 아래 코드를 사용:
 *     UdpSocket::SendTo(gSocket, "255.255.255.255", 5000, data, 4)
 *     data[0]=VEHICLE_TYPE_POLICE(1), data[1]=Status, data[2]=Direction, data[3]=ETA
 *   CANoe SIL에서는 sysvar V2V::Police_* 가 동일 역할 수행.
 *   Civ_Node의 on sysvar V2V::Police_Active 핸들러가 수신처.
 *
 * Panel 연결 sysvar:
 *   V2V::Police_Active     — [긴급 출동] 토글 버튼 (0/1)
 *   V2V::Police_Direction  — 방향 선택 (0=Front 1=Left 2=Right 3=Rear)
 *   V2V::Police_ETA        — ETA TrackBar (0~999초)
 *
 * V-Model: SWE.3 (구현)
 * Req 추적: Req_017 (경찰차 접근 경고), Req_022 (긴급 우선 표시)
 */

includes
{
}

variables
{
  /* 타이머 */
  msTimer tPoliceAlive;          /* 500ms keepAlive 브로드캐스트 */

  /* 상태 */
  int    gPoliceActive         = 0;
  int    gPoliceDispatchCount  = 0;

  /* 상수 */
  const int VEHICLE_TYPE_POLICE = 1;
  const int STATUS_ACTIVE       = 1;
  const int STATUS_CLEAR        = 0;
  const int KEEPALIVE_PERIOD_MS = 500;
}

/*============================================================
 * 초기화
 *============================================================*/
on start
{
  write("[Police_Node] start -- waiting for dispatch cmd");
}

/*============================================================
 * Panel [긴급 출동] / [해제] 버튼 수신
 * sysvar V2V::Police_Active 변경 감지
 * Req_017: 경찰차 긴급 접근 시 일반차에 즉시 경고 전달
 *============================================================*/
on sysvar V2V::Police_Active
{
  if (@V2V::Police_Active == STATUS_ACTIVE)
  {
    gPoliceActive = 1;
    gPoliceDispatchCount++;

    write("[Police_Node] ** DISPATCH #%d broadcast start **",
          gPoliceDispatchCount);
    write("[Police_Node]   VehicleType=POLICE  Status=ACTIVE  Direction=%d  ETA=%ds",
          @V2V::Police_Direction, @V2V::Police_ETA);
    write("[Police_Node]   [ETH UDP] -> 255.255.255.255:5000 broadcast (SIL: via sysvar)");

    /* keepAlive 시작 */
    setTimer(tPoliceAlive, KEEPALIVE_PERIOD_MS);
  }
  else
  {
    gPoliceActive = 0;
    cancelTimer(tPoliceAlive);

    write("[Police_Node] CLEAR broadcast");
    write("[Police_Node]   VehicleType=POLICE  Status=CLEAR");
  }
}

/*============================================================
 * ETA / Direction 변경 감지 (활성 중에 값 변경 시 재알림)
 *============================================================*/
on sysvar V2V::Police_ETA
{
  if (gPoliceActive == 1)
  {
    write("[Police_Node] ETA update -> %ds (dispatch active)", @V2V::Police_ETA);
  }
}

on sysvar V2V::Police_Direction
{
  if (gPoliceActive == 1)
  {
    write("[Police_Node] direction update -> %d (dispatch active)", @V2V::Police_Direction);
  }
}

/*============================================================
 * keepAlive 타이머 (500ms 주기)
 * 실제 Ethernet에서는 500ms 마다 UDP 패킷 재전송
 * SIL에서는 로그로 브로드캐스트 확인
 *============================================================*/
on timer tPoliceAlive
{
  if (gPoliceActive == 1)
  {
    write("[Police_Node] keepAlive broadcast (POLICE ACTIVE | ETA=%ds | Dir=%d)",
          @V2V::Police_ETA, @V2V::Police_Direction);
    setTimer(tPoliceAlive, KEEPALIVE_PERIOD_MS);
  }
}
