includes
{
}

variables
{
  msTimer tInput100;
}

on start
{
  setTimer(tInput100, 100);
  write("[SIL_TEST_CTRL] start");
}

on timer tInput100
{
  message frmVehicleStateCanMsg mVeh;
  message frmSteeringCanMsg mStr;
  message frmNavContextCanMsg mNav;

  mVeh.gVehicleSpeed = (int)@Chassis::vehicleSpeed;
  mVeh.gDriveState = (int)@Chassis::driveState;
  output(mVeh);

  mStr.SteeringInput = (int)@Chassis::steeringInput;
  output(mStr);

  mNav.gRoadZone = (int)@Infotainment::roadZone;
  mNav.gNavDirection = (int)@Infotainment::navDirection;
  mNav.gZoneDistance = (int)@Infotainment::zoneDistance;
  output(mNav);

  setTimer(tInput100, 100);
}

on sysvar Test::scenarioResult
{
  message frmTestResultMsg mRes;
  mRes.ScenarioResult = (int)@Test::scenarioResult;
  output(mRes);
}
