includes
{
}

variables
{
  dword gUdpSocket;
  msTimer tBodyCycle;
  byte gRxBuf[16];
  long gRxLen;
}

on start
{
  gUdpSocket = UdpSocket::Open(5000);
  setTimer(tBodyCycle, 10);
  write("[BODY_GW] start");
}

on stopMeasurement
{
  UdpSocket::Close(gUdpSocket);
}

on timer tBodyCycle
{
  int alertLevel;
  int alertType;
  int timeoutClear;
  int ambientMode;
  int ambientColor;
  int ambientPattern;
  message frmAmbientControlMsg mAmbient;

  gRxLen = UdpSocket::ReceiveFrom(gUdpSocket, gRxBuf, elcount(gRxBuf));
  if (gRxLen == 2)
  {
    alertLevel = (int)(gRxBuf[0] & 0x07);
    alertType = (int)((gRxBuf[0] >> 3) & 0x07);
    timeoutClear = (int)(gRxBuf[1] & 0x01);

    if ((int)gRxBuf[1] <= 1)
    {
      if (timeoutClear == 1)
      {
        ambientMode = 0;
        ambientColor = 0;
        ambientPattern = 0;
      }
      else
      {
        ambientMode = alertLevel;
        ambientColor = alertType;
        ambientPattern = (alertLevel > 0) ? 1 : 0;
      }

      @Body::ambientMode = ambientMode;
      @Body::ambientColor = ambientColor;
      @Body::ambientPattern = ambientPattern;

      mAmbient.AmbientMode = ambientMode;
      mAmbient.AmbientColor = ambientColor;
      mAmbient.AmbientPattern = ambientPattern;
      output(mAmbient);
    }
  }

  setTimer(tBodyCycle, 10);
}
