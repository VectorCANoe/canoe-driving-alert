includes
{
}

variables
{
  msTimer tBodyCycle;
}

on start
{
  setTimer(tBodyCycle, 10);
  write("[BODY_GW] start");
}

on timer tBodyCycle
{
  int alertLevel;
  int alertType;
  int timeoutClear;
  int ambientMode;
  int ambientColor;
  int ambientPattern;
  message frmAmbientControlMsg mAmbient;

  alertLevel = (int)@Core::selectedAlertLevel;
  alertType = (int)@Core::selectedAlertType;
  timeoutClear = (int)@Core::timeoutClear;

  if (timeoutClear == 1)
  {
    ambientMode = 0;
    ambientColor = 0;
    ambientPattern = 0;
  }
  else
  {
    ambientMode = alertLevel;
    ambientColor = alertType;
    ambientPattern = (alertLevel > 0) ? 1 : 0;
  }

  @Body::ambientMode = ambientMode;
  @Body::ambientColor = ambientColor;
  @Body::ambientPattern = ambientPattern;

  mAmbient.AmbientMode = ambientMode;
  mAmbient.AmbientColor = ambientColor;
  mAmbient.AmbientPattern = ambientPattern;
  output(mAmbient);

  if (timeoutClear == 1)
  {
    @Core::timeoutClear = 0;
  }

  setTimer(tBodyCycle, 10);
}
