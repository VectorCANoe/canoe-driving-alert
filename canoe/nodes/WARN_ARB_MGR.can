includes
{
}

variables
{
  msTimer tArbiter50;
}

void runArbiter()
{
  int emergencyContext;
  int warningState;
  int baseZoneContext;
  int selectedAlertLevel;
  int selectedAlertType;

  emergencyContext = (int)@Core::emergencyContext;
  warningState = (int)@Core::warningState;
  baseZoneContext = (int)@Core::baseZoneContext;
  selectedAlertLevel = 0;
  selectedAlertType = 0;

  if (emergencyContext == 2)
  {
    selectedAlertLevel = 7;
    selectedAlertType = 2;
  }
  else if (emergencyContext == 1)
  {
    selectedAlertLevel = 6;
    selectedAlertType = 1;
  }
  else if (warningState > 0)
  {
    if (baseZoneContext == 1)
    {
      selectedAlertLevel = 3;
      selectedAlertType = 3;
    }
    else if (baseZoneContext == 2)
    {
      selectedAlertLevel = 2;
      selectedAlertType = 4;
    }
    else if (baseZoneContext == 3 || baseZoneContext == 4)
    {
      selectedAlertLevel = 2;
      selectedAlertType = 5;
    }
    else
    {
      selectedAlertLevel = 1;
      selectedAlertType = 6;
    }
  }

  @Core::selectedAlertLevel = selectedAlertLevel;
  @Core::selectedAlertType = selectedAlertType;
  @CoreState::arbitrationSnapshotId = ((int)@CoreState::arbitrationSnapshotId + 1) & 0xFFFF;
}

on start
{
  setTimer(tArbiter50, 50);
  write("[WARN_ARB_MGR] start");
}

on timer tArbiter50
{
  int timeoutClear;

  runArbiter();

  timeoutClear = (int)@Core::timeoutClear;
  if (timeoutClear == 1)
  {
    @Core::timeoutClear = 0;
  }
  setTimer(tArbiter50, 50);
}
