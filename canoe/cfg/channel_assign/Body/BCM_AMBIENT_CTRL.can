includes
{
}

variables
{
  msTimer tBcmExt100;
  int gLastBcmDiagReqSid;
  int gLastBcmDiagReqDidHigh;
  int gLastBcmDiagReqDidLow;
  int gLastAlertType;
  int gFlashToggle;
}

on start
{
  gLastBcmDiagReqSid     = 0x22;
  gLastBcmDiagReqDidHigh = 0xF1;
  gLastBcmDiagReqDidLow  = 0x90;
  gLastAlertType = -1;
  gFlashToggle   = 0;
  setTimer(tBcmExt100, 100);
  write("[BCM_AMBIENT_CTRL] start");
}

on message frmBcmDiagReqMsg
{
  gLastBcmDiagReqSid     = this.BcmDiagServiceId;
  gLastBcmDiagReqDidHigh = this.BcmDiagDidHigh;
  gLastBcmDiagReqDidLow  = this.BcmDiagDidLow;
}

on timer tBcmExt100
{
  message frmInteriorLightMsg mLight;
  message frmRainLightAutoMsg mRain;
  message frmBcmDiagResMsg    mDiagRes;
  int alertType;
  int ambientMode;
  int ambientColor;
  int ambientPattern;
  int flashColor;

  alertType = (int)@Core::selectedAlertType;
  if (alertType < 0 || alertType > 6) alertType = 0;

  /* 100ms flash toggle for alternating color patterns */
  gFlashToggle = 1 - gFlashToggle;

  ambientMode    = 0;
  ambientColor   = 0;
  ambientPattern = 0;
  flashColor     = 0;

  /* alertType:
     0 = off
     1 = Police      RED/BLUE alternate flash
     2 = Ambulance   RED/WHITE alternate flash
     3 = School zone RED fast flash
     4 = Highway     ORANGE wave
     5 = IC left     GREEN steady
     6 = IC right    GREEN steady
     Color: 0=off 1=red 2=orange 3=amber 4=green 5=blue 6=white
     Pattern: 0=off 1=steady 2=slow-flash 3=fast-flash
     Mode: 0=off 1=steady 2=flash/wave */

  if (alertType == 1)
  {
    ambientMode    = 2;
    flashColor     = gFlashToggle;
    ambientColor   = (flashColor == 1) ? 1 : 5;
    ambientPattern = 2;
  }
  else if (alertType == 2)
  {
    ambientMode    = 2;
    flashColor     = gFlashToggle;
    ambientColor   = (flashColor == 1) ? 1 : 6;
    ambientPattern = 2;
  }
  else if (alertType == 3)
  {
    ambientMode    = 2;
    ambientColor   = 1;
    ambientPattern = 3;
  }
  else if (alertType == 4)
  {
    ambientMode    = 2;
    ambientColor   = 2;
    ambientPattern = 1;
  }
  else if (alertType == 5)
  {
    ambientMode    = 1;
    ambientColor   = 4;
    ambientPattern = 1;
  }
  else if (alertType == 6)
  {
    ambientMode    = 1;
    ambientColor   = 4;
    ambientPattern = 2;
  }

  if (alertType != gLastAlertType)
  {
    write("[BCM] alertType=%d mode=%d color=%d pattern=%d",
          alertType, ambientMode, ambientColor, ambientPattern);
    gLastAlertType = alertType;
  }

  @Body::ambientMode    = ambientMode;
  @Body::ambientColor   = ambientColor;
  @Body::ambientPattern = ambientPattern;

  mLight.CabinLightMode = ambientMode & 0x7;
  mLight.DomeLightLevel = (ambientMode > 0) ? 20 : 4;
  output(mLight);

  mRain.RainSenseLevel = ambientPattern & 0xF;
  mRain.AutoLightState = (ambientMode > 0) ? 1 : 0;
  output(mRain);

  mDiagRes.BcmDiagRespCode = 0x62;
  mDiagRes.BcmDiagData0    = gLastBcmDiagReqDidHigh & 0xFF;
  mDiagRes.BcmDiagData1    = gLastBcmDiagReqDidLow  & 0xFF;
  output(mDiagRes);

  setTimer(tBcmExt100, 100);
}
