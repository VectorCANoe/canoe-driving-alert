/*@!Encoding:65001*/
// WINDOW_CTRL.can  (cfg/channel_assign — CANoe 실제 로드 파일)
// Body Domain — 도어 잠금 + 창문 제어
// 입력  : @Body::windowUp   (0=해제 1=누름) — 유리 올라감=닫힘 (state 감소)
//         @Body::windowDown (0=해제 1=누름) — 유리 내려감=열림 (state 증가)
//         @Body::doorLockCmd
// 출력  : @Body::windowState (0=완전열림 ~ 9=완전닫힘)
//         frmDoorControlMsg
//
// 단클릭: 1프레임 즉시 / 장기 누름: 100ms 간격 연속 (10단계)

includes
{
}

variables
{
  msTimer tWindowUp;
  msTimer tWindowDown;
  msTimer tDoorCycle;
  int gWindowState;
  int gDoorLockState;
  int gChildLockState;
}

on start
{
  gWindowState    = 0;
  gDoorLockState  = 0;
  gChildLockState = 0;
  @Body::windowState = 0;
  setTimer(tDoorCycle, 100);
  write("[WINDOW_CTRL] start — Up=close(state-) Down=open(state+) 313ms/frame");
}

// ── 창문 업: 유리 올라감 = 닫힘 (state 감소) ─────────────────────
on sysvar Body::windowUp
{
  if ((int)@Powertrain::ignitionKey == 0)
  {
    cancelTimer(tWindowUp);
    write("[WINDOW] 시동 OFF - 창문 조작 불가");
    return;
  }
  if ((int)@Body::windowUp == 1)
  {
    if (gWindowState > 0)
    {
      gWindowState -= 1;
      @Body::windowState = gWindowState;
      write("[WINDOW] Up click -> state=%d", gWindowState);
    }
    setTimer(tWindowUp, 100);
  }
  else
  {
    cancelTimer(tWindowUp);
  }
}

on timer tWindowUp
{
  if ((int)@Powertrain::ignitionKey == 0) return;
  if ((int)@Body::windowUp == 1 && gWindowState > 0)
  {
    gWindowState -= 1;
    @Body::windowState = gWindowState;
    write("[WINDOW] Up hold -> state=%d", gWindowState);
    setTimer(tWindowUp, 100);
  }
}

// ── 창문 다운: 유리 내려감 = 열림 (state 증가) ───────────────────
on sysvar Body::windowDown
{
  if ((int)@Powertrain::ignitionKey == 0)
  {
    cancelTimer(tWindowDown);
    write("[WINDOW] 시동 OFF - 창문 조작 불가");
    return;
  }
  if ((int)@Body::windowDown == 1)
  {
    if (gWindowState < 9)
    {
      gWindowState += 1;
      @Body::windowState = gWindowState;
      write("[WINDOW] Down click -> state=%d", gWindowState);
    }
    setTimer(tWindowDown, 100);
  }
  else
  {
    cancelTimer(tWindowDown);
  }
}

on timer tWindowDown
{
  if ((int)@Powertrain::ignitionKey == 0) return;
  if ((int)@Body::windowDown == 1 && gWindowState < 9)
  {
    gWindowState += 1;
    @Body::windowState = gWindowState;
    write("[WINDOW] Down hold -> state=%d", gWindowState);
    setTimer(tWindowDown, 100);
  }
}

// ── 도어 잠금 CAN 출력 ──────────────────────────────────────────
on sysvar Body::doorLockCmd
{
  if ((int)@Powertrain::ignitionKey == 0)
  {
    write("[DOOR] 시동 OFF - 도어 잠금 명령 차단");
    return;
  }
  gDoorLockState = (int)@Body::doorLockCmd;
  write("[WINDOW_CTRL] doorLockCmd=%d", gDoorLockState);
}

on timer tDoorCycle
{
  message frmDoorControlMsg mDoor;
  int doorCmd;
  int childLockCmd;

  if      (gDoorLockState == 1) doorCmd = 1;
  else if (gDoorLockState == 2) doorCmd = 2;
  else if (gDoorLockState == 3) doorCmd = 3;
  else                          doorCmd = 0;

  childLockCmd = gChildLockState & 0x1;

  mDoor.DoorControlCmd = doorCmd & 0x7;
  mDoor.ChildLockCmd   = childLockCmd;
  output(mDoor);

  setTimer(tDoorCycle, 100);
}

on message frmDoorStateMsg
{
  gDoorLockState  = this.DoorLockState;
  gChildLockState = this.ChildLockState;
}
