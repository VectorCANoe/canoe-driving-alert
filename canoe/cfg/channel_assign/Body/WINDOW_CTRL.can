includes
{
}

variables
{
}

on start
{
  write("[WINDOW_CTRL] absorbed into BCM runtime; wrapper only");
}
