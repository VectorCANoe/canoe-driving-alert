/*@!Encoding:65001*/
// BLINKER_WIPER_CTRL.can (Frame 3 version)

includes
{
}

variables
{
  msTimer tBlink;
  msTimer tWiper;

  int gBlinkState;  
  // 0=off 1=left 2=right 3=hazard

  int gBlinkFrame;  
  // 0-2 (3 frame cycle)

  int gWiperPos;
  int gWiperDir;
}

on start
{
  gBlinkState = 0;
  gBlinkFrame = 0;
  gWiperPos   = 0;
  gWiperDir   = 1;

  @Body::blinkLeft  = 0;
  @Body::blinkRight = 0;
  @Body::wiperState = 0;

  write("[BLINKER_WIPER] start");
}

int isEngineOn()
{
  return (int)@Powertrain::ignitionKey;
}

void stopBlink()
{
  cancelTimer(tBlink);

  @Body::blinkLeft  = 0;
  @Body::blinkRight = 0;

  gBlinkState = 0;
  gBlinkFrame = 0;
}

// 좌측 깜빡이
on sysvar Body::turnLeft
{
  stopBlink();

  if (isEngineOn() == 0)
  {
    write("[BLINKER] LEFT blocked - engine off");
    return;
  }

  if ((int)@Body::turnLeft == 1)
  {
    gBlinkState      = 1;
    gBlinkFrame      = 1;

    @Body::blinkLeft = 1;

    setTimer(tBlink, 50);

    write("[BLINKER] LEFT ON");
  }
}

// 우측 깜빡이
on sysvar Body::turnRight
{
  stopBlink();

  if (isEngineOn() == 0)
  {
    write("[BLINKER] RIGHT blocked - engine off");
    return;
  }

  if ((int)@Body::turnRight == 1)
  {
    gBlinkState       = 2;
    gBlinkFrame       = 1;

    @Body::blinkRight = 1;

    setTimer(tBlink, 50);

    write("[BLINKER] RIGHT ON");
  }
}

// 비상등
on sysvar Body::hazard
{
  stopBlink();

  if (isEngineOn() == 0)
  {
    write("[BLINKER] HAZARD blocked - engine off");
    return;
  }

  if ((int)@Body::hazard == 1)
  {
    gBlinkState = 3;
    gBlinkFrame = 1;

    @Body::blinkLeft  = 1;
    @Body::blinkRight = 1;

    setTimer(tBlink, 50);

    write("[BLINKER] HAZARD ON");
  }
}

// 깜빡이 타이머
on timer tBlink
{
  if (isEngineOn() == 0) return;
  if (gBlinkState == 0) return;

  // 3 frame cycle
  gBlinkFrame = (gBlinkFrame + 1) % 3;

  if (gBlinkState == 1)
  {
    @Body::blinkLeft  = gBlinkFrame;
    @Body::blinkRight = 0;
  }

  else if (gBlinkState == 2)
  {
    @Body::blinkLeft  = 0;
    @Body::blinkRight = gBlinkFrame;
  }

  else if (gBlinkState == 3)
  {
    @Body::blinkLeft  = gBlinkFrame;
    @Body::blinkRight = gBlinkFrame;
  }

  setTimer(tBlink, 500);
}

// 와이퍼
on sysvar Body::wiperMode
{
  int mode;

  cancelTimer(tWiper);

  if (isEngineOn() == 0)
  {
    gWiperPos         = 0;
    gWiperDir         = 1;
    @Body::wiperState = 0;

    write("[WIPER] blocked - engine off");
    return;
  }

  mode = (int)@Body::wiperMode;

  if (mode == 0)
  {
    gWiperPos         = 0;
    gWiperDir         = 1;
    @Body::wiperState = 0;

    write("[WIPER] OFF");
  }
  else
  {
    gWiperPos += gWiperDir;

    if (gWiperPos >= 22) gWiperDir = -1;
    if (gWiperPos <= 0)  gWiperDir =  1;

    @Body::wiperState = gWiperPos;

    if (mode == 1)
    {
      setTimer(tWiper, 50);
      write("[WIPER] SLOW");
    }
    else
    {
      setTimer(tWiper, 25);
      write("[WIPER] FAST");
    }
  }
}

on timer tWiper
{
  int mode;
  int interval;

  if (isEngineOn() == 0) return;

  mode = (int)@Body::wiperMode;
  if (mode == 0) return;

  gWiperPos += gWiperDir;

  if (gWiperPos >= 22) gWiperDir = -1;
  if (gWiperPos <= 0)  gWiperDir =  1;

  @Body::wiperState = gWiperPos;

  if (mode == 1) interval = 50;
  else           interval = 25;

  setTimer(tWiper, interval);
}

// 기어 잠금
on sysvar Chassis::driveState
{
  if ((int)@Powertrain::ignitionKey == 0)
  {
    @Chassis::driveState = 0;
    write("[GEAR] engine off - locked to P");
  }
}

// 시동 키
on sysvar Powertrain::ignitionKey
{
  int ignVal;
  int gearVal;

  ignVal  = (int)@Powertrain::ignitionKey;
  gearVal = (int)@Chassis::driveState;

  if (ignVal == 0)
  {
    if (gearVal != 0)
    {
      @Powertrain::ignitionKey = 1;
      write("[ENGINE] OFF blocked - gear P required");
      return;
    }

    stopBlink();
    cancelTimer(tWiper);

    @Body::wiperState = 0;

    gWiperPos = 0;
    gWiperDir = 1;

    write("[ENGINE] OFF");
  }
  else
  {
    write("[ENGINE] ON");
  }
}