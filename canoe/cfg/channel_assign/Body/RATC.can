includes
{
  #include "..\\common\\CAPL_COMMON.cin"
}

variables
{
  msTimer tRearClimateCycle;
  int gCabinSetTemp;
  int gBlowerLevel;
  int gVentMode;
  int gAcOn;
  int gLastRearTemp;
  int gLastRearBlower;
  int gLastRearVent;
  int gLastSyncMode;
}

void publishRearClimateState()
{
  message frmRearClimateStateMsg mRear;
  int rearTemp;
  int rearBlower;
  int rearVent;
  int rearSyncMode;

  rearTemp = gCabinSetTemp;
  rearBlower = gBlowerLevel;
  rearVent = gVentMode;
  rearSyncMode = 1;

  if (gAcOn == 1 && rearTemp < 24)
  {
    rearTemp = rearTemp + 1;
  }
  if (rearBlower > 0)
  {
    rearBlower = clampRange(rearBlower - 1, 0, 15);
  }

  mRear.RearSetTemp = clampRange(rearTemp, 0, 100);
  mRear.RearBlowerLevel = clampRange(rearBlower, 0, 15);
  mRear.RearVentMode = clampRange(rearVent, 0, 7);
  mRear.RearSyncMode = clampRange(rearSyncMode, 0, 1);
  output(mRear);

  if (mRear.RearSetTemp != gLastRearTemp ||
      mRear.RearBlowerLevel != gLastRearBlower ||
      mRear.RearVentMode != gLastRearVent ||
      mRear.RearSyncMode != gLastSyncMode)
  {
    write("[REAR_CLIMATE_MODULE] temp=%d blower=%d vent=%d sync=%d",
          mRear.RearSetTemp,
          mRear.RearBlowerLevel,
          mRear.RearVentMode,
          mRear.RearSyncMode);
    gLastRearTemp = mRear.RearSetTemp;
    gLastRearBlower = mRear.RearBlowerLevel;
    gLastRearVent = mRear.RearVentMode;
    gLastSyncMode = mRear.RearSyncMode;
  }
}

on start
{
  gCabinSetTemp = 22;
  gBlowerLevel = 2;
  gVentMode = 1;
  gAcOn = 0;
  gLastRearTemp = -1;
  gLastRearBlower = -1;
  gLastRearVent = -1;
  gLastSyncMode = -1;
  setTimer(tRearClimateCycle, 100);
  write("[REAR_CLIMATE_MODULE] start");
}

on timer tRearClimateCycle
{
  publishRearClimateState();
  setTimer(tRearClimateCycle, 100);
}

on message frmHvacStateMsg
{
  gCabinSetTemp = clampRange((int)this.CabinSetTemp, 0, 100);
  gBlowerLevel = clampRange((int)this.BlowerLevel, 0, 15);
  gAcOn = clampRange((int)this.AcCompressorOn, 0, 1);
}

on message frmHvacActuatorMsg
{
  gVentMode = clampRange((int)this.VentMode, 0, 7);
}

on stopMeasurement
{
  cancelTimer(tRearClimateCycle);
}
