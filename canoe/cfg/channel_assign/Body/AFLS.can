includes
{
  #include "..\\common\\CAPL_COMMON.cin"
}

variables
{
  msTimer tAflsCycle;
  int gSteeringAngle;
  int gHeadLampState;
  int gLastAflsMode;
  int gLastBeamPattern;
  int gLastCornerLampState;
  int gLastLevelStep;
}

void publishAflsState()
{
  message frmAflsStateMsg mAfls;
  int aflsMode;
  int beamPattern;
  int cornerLampState;
  int levelStep;

  aflsMode = (gHeadLampState >= 2) ? 1 : 0;
  beamPattern = (gHeadLampState >= 2) ? 2 : 0;
  cornerLampState = (abs(gSteeringAngle) >= 120) ? 1 : 0;
  levelStep = clampRange(abs(gSteeringAngle) / 20, 0, 255);

  mAfls.AflsMode = clampRange(aflsMode, 0, 7);
  mAfls.BeamPattern = clampRange(beamPattern, 0, 7);
  mAfls.CornerLampState = clampRange(cornerLampState, 0, 1);
  mAfls.LevelStep = levelStep;
  output(mAfls);

  if (mAfls.AflsMode != gLastAflsMode ||
      mAfls.BeamPattern != gLastBeamPattern ||
      mAfls.CornerLampState != gLastCornerLampState ||
      mAfls.LevelStep != gLastLevelStep)
  {
    write("[AFLS] mode=%d beam=%d corner=%d level=%d steer=%d lamp=%d",
          mAfls.AflsMode,
          mAfls.BeamPattern,
          mAfls.CornerLampState,
          mAfls.LevelStep,
          gSteeringAngle,
          gHeadLampState);
    gLastAflsMode = mAfls.AflsMode;
    gLastBeamPattern = mAfls.BeamPattern;
    gLastCornerLampState = mAfls.CornerLampState;
    gLastLevelStep = mAfls.LevelStep;
  }
}

on start
{
  gSteeringAngle = 0;
  gHeadLampState = 1;
  gLastAflsMode = -1;
  gLastBeamPattern = -1;
  gLastCornerLampState = -1;
  gLastLevelStep = -1;
  setTimer(tAflsCycle, 100);
  write("[AFLS] start");
}

on timer tAflsCycle
{

  publishAflsState();
  setTimer(tAflsCycle, 100);
}

on message frmSteeringAngleMsg
{
  gSteeringAngle = clampRange((int)(this.SteeringAngleRaw / 10), 0, 720);
}

on message frmLampControlMsg
{
  gHeadLampState = clampRange((int)this.HeadLampState, 0, 3);
}

on stopMeasurement
{
  cancelTimer(tAflsCycle);
}
