includes
{
  #include "..\\common\\CAPL_COMMON.cin"
}

variables
{
  msTimer tPowerTailgateCycle;
  int gTailgateLockState;
  int gTailgateOpenState;
  int gTailgatePowerState;
  int gTailgatePosition;
  int gLastAssistMode;
  int gLastOpenReq;
  int gLastActuatorCmd;
}

on start
{
  gTailgateLockState = 1;
  gTailgateOpenState = 0;
  gTailgatePowerState = 0;
  gTailgatePosition = 0;
  gLastAssistMode = -1;
  gLastOpenReq = -1;
  gLastActuatorCmd = -1;
  setTimer(tPowerTailgateCycle, 100);
  write("[PTG] start");
}

on message frmTailgateStateMsg
{
  gTailgateLockState = clampRange((int)this.TailgateLockState, 0, 3);
  gTailgateOpenState = clampRange((int)this.TailgateOpenState, 0, 1);
  gTailgatePowerState = clampRange((int)this.TailgatePowerState, 0, 3);
  gTailgatePosition = clampRange((int)this.TailgatePosition, 0, 100);
}

on timer tPowerTailgateCycle
{
  message frmPowerTailgateCtrlStateMsg mTailgateCtrl;
  int driveState;
  int timeoutClear;
  int assistMode;
  int openRequestState;
  int actuatorCmd;

  driveState = clampRange((int)@Core::driveStateNorm, 0, 3);
  timeoutClear = clampRange((int)@Core::timeoutClear, 0, 1);

  assistMode = (gTailgatePowerState > 0) ? 2 : 1;
  openRequestState = 0;
  actuatorCmd = 0;

  if (driveState == 0 && timeoutClear == 1 && gTailgateLockState == 0)
  {
    openRequestState = 2;
    actuatorCmd = clampRange(100 - gTailgatePosition, 0, 100);
  }
  else if (gTailgateOpenState == 1)
  {
    openRequestState = 1;
    actuatorCmd = 0;
  }

  mTailgateCtrl.TailgateAssistMode = clampRange(assistMode, 0, 7);
  mTailgateCtrl.OpenRequestState = clampRange(openRequestState, 0, 3);
  mTailgateCtrl.TailgateActuatorCmd = clampRange(actuatorCmd, 0, 100);
  output(mTailgateCtrl);

  if (mTailgateCtrl.TailgateAssistMode != gLastAssistMode ||
      mTailgateCtrl.OpenRequestState != gLastOpenReq ||
      mTailgateCtrl.TailgateActuatorCmd != gLastActuatorCmd)
  {
    write("[PTG] mode=%d req=%d cmd=%d pos=%d",
          mTailgateCtrl.TailgateAssistMode,
          mTailgateCtrl.OpenRequestState,
          mTailgateCtrl.TailgateActuatorCmd,
          gTailgatePosition);
    gLastAssistMode = mTailgateCtrl.TailgateAssistMode;
    gLastOpenReq = mTailgateCtrl.OpenRequestState;
    gLastActuatorCmd = mTailgateCtrl.TailgateActuatorCmd;
  }

  setTimer(tPowerTailgateCycle, 100);
}

on stopMeasurement
{
  cancelTimer(tPowerTailgateCycle);
}

