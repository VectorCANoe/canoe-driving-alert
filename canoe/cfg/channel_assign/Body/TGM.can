includes
{
  #include "..\\common\\CAPL_COMMON.cin"
}

variables
{
  msTimer tTailgateCycle;
  int gDriveState;
  dword gVehicleRxMs;
  int gLastVehicleInputStale;
  int gLastLockState;
  int gLastOpenState;
  int gLastPowerState;
  int gLastPosition;
}

void traceTgmInputHealth(int vehicleInputStale)
{
  if (vehicleInputStale != gLastVehicleInputStale)
  {
    if (vehicleInputStale == 1)
    {
      write("[TGM] vehicle input stale");
    }
    else
    {
      write("[TGM] vehicle input restored");
    }
    gLastVehicleInputStale = vehicleInputStale;
  }
}

on start
{
  gDriveState = 0;
  gVehicleRxMs = 0;
  gLastVehicleInputStale = 0;
  gLastLockState = -1;
  gLastOpenState = -1;
  gLastPowerState = -1;
  gLastPosition = -1;
  setTimer(tTailgateCycle, 100);
  write("[TGM] start");
}

on timer tTailgateCycle
{
  message frmTailgateStateMsg mTailgate;
  int vehicleInputStale;
  int driveState;
  int lockState;
  int openState;
  int powerState;
  int position;

  vehicleInputStale = (ethIsRecentTick(gVehicleRxMs, 300) == 1) ? 0 : 1;
  traceTgmInputHealth(vehicleInputStale);

  driveState = gDriveState;
  if (vehicleInputStale == 1)
  {
    driveState = 3;
  }

  lockState = 1;
  openState = 0;
  powerState = 0;
  position = 0;

  if (driveState == 0)
  {
    powerState = 1;
  }

  mTailgate.TailgateLockState = clampRange(lockState, 0, 3);
  mTailgate.TailgateOpenState = clampRange(openState, 0, 1);
  mTailgate.TailgatePowerState = clampRange(powerState, 0, 3);
  mTailgate.TailgatePosition = clampRange(position, 0, 100);
  output(mTailgate);

  if (mTailgate.TailgateLockState != gLastLockState ||
      mTailgate.TailgateOpenState != gLastOpenState ||
      mTailgate.TailgatePowerState != gLastPowerState ||
      mTailgate.TailgatePosition != gLastPosition)
  {
    write("[TGM] lock=%d open=%d power=%d pos=%d drive=%d",
          mTailgate.TailgateLockState,
          mTailgate.TailgateOpenState,
          mTailgate.TailgatePowerState,
          mTailgate.TailgatePosition,
          driveState);
    gLastLockState = mTailgate.TailgateLockState;
    gLastOpenState = mTailgate.TailgateOpenState;
    gLastPowerState = mTailgate.TailgatePowerState;
    gLastPosition = mTailgate.TailgatePosition;
  }

  setTimer(tTailgateCycle, 100);
}

on stopMeasurement
{
  cancelTimer(tTailgateCycle);
}

on message frmVehicleStateCanMsg
{
  gDriveState = clampRange((int)this.gDriveState, 0, 3);
  gVehicleRxMs = getSimulationTimeMs();
}

