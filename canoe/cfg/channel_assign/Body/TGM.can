includes
{
  #include "..\\common\\CAPL_COMMON.cin"
}

variables
{
  msTimer tTailgateCycle;
  int gLastLockState;
  int gLastOpenState;
  int gLastPowerState;
  int gLastPosition;
}

on start
{
  gLastLockState = -1;
  gLastOpenState = -1;
  gLastPowerState = -1;
  gLastPosition = -1;
  setTimer(tTailgateCycle, 100);
  write("[TGM] start");
}

on timer tTailgateCycle
{
  message frmTailgateStateMsg mTailgate;
  int driveState;
  int lockState;
  int openState;
  int powerState;
  int position;

  driveState = clampRange((int)@Core::driveStateNorm, 0, 3);

  lockState = 1;
  openState = 0;
  powerState = 0;
  position = 0;

  if (driveState == 0)
  {
    powerState = 1;
  }

  mTailgate.TailgateLockState = clampRange(lockState, 0, 3);
  mTailgate.TailgateOpenState = clampRange(openState, 0, 1);
  mTailgate.TailgatePowerState = clampRange(powerState, 0, 3);
  mTailgate.TailgatePosition = clampRange(position, 0, 100);
  output(mTailgate);

  if (mTailgate.TailgateLockState != gLastLockState ||
      mTailgate.TailgateOpenState != gLastOpenState ||
      mTailgate.TailgatePowerState != gLastPowerState ||
      mTailgate.TailgatePosition != gLastPosition)
  {
    write("[TGM] lock=%d open=%d power=%d pos=%d drive=%d",
          mTailgate.TailgateLockState,
          mTailgate.TailgateOpenState,
          mTailgate.TailgatePowerState,
          mTailgate.TailgatePosition,
          driveState);
    gLastLockState = mTailgate.TailgateLockState;
    gLastOpenState = mTailgate.TailgateOpenState;
    gLastPowerState = mTailgate.TailgatePowerState;
    gLastPosition = mTailgate.TailgatePosition;
  }

  setTimer(tTailgateCycle, 100);
}

on stopMeasurement
{
  cancelTimer(tTailgateCycle);
}

