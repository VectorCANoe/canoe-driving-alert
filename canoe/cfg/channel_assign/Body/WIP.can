/*@!Encoding:949*/
includes
{
  #include "..\\common\\CAPL_COMMON.cin"
}

variables
{
  msTimer tWiperCycle;
  int gFrontWiperState;
  // int gFrontWiperImageIndex;  // ?ㅼ젣 ?꾨젅???몃씝??0~21
  int gRearWiperState;
  int gWiperInterval;
  int gRainSenseLevel;
  int gAutoLightState;
  dword gRainRxMs;
  int gLastRainInputStale;
  int gLastFrontWiperState;
  int gLastRearWiperState;
  int gLastWiperInterval;
  int gWiperPos;
  int gWiperDir;
}

void traceWipInputHealth(int rainInputStale)
{
  if (rainInputStale != gLastRainInputStale)
  {
    if (rainInputStale == 1)
    {
      write("[WIP] rain/light input stale");
    }
    else
    {
      write("[WIP] rain/light input restored");
    }
    gLastRainInputStale = rainInputStale;
  }
}

void publishWiperState()
{
  message frmWiperStateMsg mWiper;
  int rainInputStale;
  int rainSenseLevel;
  int autoLightState;
  int frontWiperState;
  int rearWiperState;
  int wiperInterval;

  rainInputStale = (ethIsRecentTick(gRainRxMs, 300) == 1) ? 0 : 1;
  traceWipInputHealth(rainInputStale);

  rainSenseLevel = gRainSenseLevel;
  autoLightState = gAutoLightState;
  if (rainInputStale == 1)
  {
    rainSenseLevel = 0;
    autoLightState = 0;
  }

  frontWiperState = 0;
  rearWiperState = 0;
  wiperInterval = 0;
  if (rainSenseLevel >= 5)
  {
    frontWiperState = 3;
  }
  else if (rainSenseLevel >= 3)
  {
    frontWiperState = 2;
  }
  else if (rainSenseLevel >= 1 || autoLightState >= 1)
  {
    frontWiperState = 1;
  }

  if (frontWiperState == 1)
  {
    wiperInterval = clampRange(6 - rainSenseLevel, 1, 15);
  }

  if (rainSenseLevel >= 4)
  {
    rearWiperState = 1;
  }

  mWiper.FrontWiperState = clampRange(frontWiperState, 0, 3);
  mWiper.RearWiperState = clampRange(rearWiperState, 0, 3);
  mWiper.WiperInterval = clampRange(wiperInterval, 0, 15);

  // gFrontWiperImageIndex = clampRange(gFrontWiperImageIndex, 0, 21);
  output(mWiper);

  if (mWiper.FrontWiperState != gLastFrontWiperState ||
      mWiper.RearWiperState != gLastRearWiperState ||
      mWiper.WiperInterval != gLastWiperInterval)
  {
    write("[WIP] front=%d rear=%d interval=%d rain=%d auto=%d",
          mWiper.FrontWiperState,
          mWiper.RearWiperState,
          mWiper.WiperInterval,
          rainSenseLevel,
          autoLightState);
    gLastFrontWiperState = mWiper.FrontWiperState;
    gLastRearWiperState = mWiper.RearWiperState;
    gLastWiperInterval = mWiper.WiperInterval;
  }
}

on start
{
  gRainSenseLevel = 0;
  gAutoLightState = 0;
  gRainRxMs = 0;
  gLastRainInputStale = 0;
  gLastFrontWiperState = -1;
  gLastRearWiperState = -1;
  gLastWiperInterval = -1;
  gWiperPos = 0;
  gWiperDir = 1;
  @Body::wiperPos = 0;
  @Body::frontWiperAnimFrame = 0;
  setTimer(tWiperCycle, 100);
  write("[WIP] start");
}

on message frmRainLightAutoMsg
{
  gRainSenseLevel = clampRange((int)this.RainSenseLevel, 0, 15);
  gAutoLightState = clampRange((int)this.AutoLightState, 0, 3);
  gRainRxMs = getSimulationTimeMs();
}

on timer tWiperCycle
{
  int cmd;
  int step;

  if ((int)@Test::testScenario == 0)
  {
    // ?섎쓾 紐⑤뱶: MyDriverPanel ?�?댄씪 ?щ씪?대쓷 sysvar 吏앹젒 ?쎄린
    cmd = clampRange((int)@Body::wiperCmd, 0, 2);
    // gFrontWiperImageIndex = cmd;
    gWiperInterval   = 0;
  }
  else if ((int)@Core::timeoutClear == 1)
  {
    cmd = 1;  // ?뚯뒪???쒕굹由ъ삤: LOW 怨좎젙
    // gFrontWiperImageIndex = 1;
    gWiperInterval   = 4;
  }
  else
  {
    cmd = 0;
    // gFrontWiperImageIndex = 0;
    gWiperInterval   = 0;
  }

  // ?�?댄씪 ?뺣났 ?좊땲硫붿씠??(?꾨젅??0~21, 22??
  // LOW(1) : 100ms留덈떎 1?꾨젅??????踰??뺣났 ??4.4珥?  // HIGH(2): 100ms留덈떎 2?꾨젅??????踰??뺣났 ??2.2珥?  if (cmd == 1)
  if (cmd == 1)
    step = 1;
  else if (cmd == 2)
    step = 2;
  else
    step = 0;

  if (step > 0)
  {
    gWiperPos = gWiperPos + gWiperDir * step;
    if (gWiperPos >= 21)
    {
      gWiperPos = 21;
      gWiperDir = -1;
    }
    if (gWiperPos <= 0)
    {
      gWiperPos = 0;
      gWiperDir = 1;
    }
  }
  else
  {
    gWiperPos = 0;
    gWiperDir = 1;
  }

  // gFrontWiperImageIndex = gWiperPos;   // ?꾨젅???몃씝?ㅻ? CAN ?좏샇濡??꾩넚
  @Body::wiperPos = gWiperPos;
  @Body::frontWiperAnimFrame = gWiperPos;

  publishWiperState();
  setTimer(tWiperCycle, 100);
}

on stopMeasurement
{
  cancelTimer(tWiperCycle);
}
