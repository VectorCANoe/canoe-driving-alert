includes
{
  #include "..\\common\\CAPL_COMMON.cin"
}

variables
{
  msTimer tWiperCycle;
  int gFrontWiperState;  // 실제 프레임 인덱스 0~21
  int gFrontWiperImageIndex;
  int gRearWiperState;
  int gRearWiperImageIndex;
  int gWiperInterval;
  int gRainSenseLevel;
  int gAutoLightState;
  dword gRainRxMs;
  int gLastRainInputStale;
  int gLastFrontWiperState;
  int gLastRearWiperState;
  int gLastWiperInterval;
}

void publishWiperState()
{
  message frmWiperStateMsg mWiper;
  int rainInputStale;
  int rainSenseLevel;
  int autoLightState;
  int frontWiperState;
  int rearWiperState;
  int wiperInterval;

  rainInputStale = (ethIsRecentTick(gRainRxMs, 300) == 1) ? 0 : 1;
  traceWipInputHealth(rainInputStale);

  rainSenseLevel = gRainSenseLevel;
  autoLightState = gAutoLightState;
  if (rainInputStale == 1)
  {
    rainSenseLevel = 0;
    autoLightState = 0;
  }

  frontWiperState = 0;
  rearWiperState = 0;
  wiperInterval = 0;
  if (rainSenseLevel >= 5)
  {
    frontWiperState = 3;
  }
  else if (rainSenseLevel >= 3)
  {
    frontWiperState = 2;
  }
  else if (rainSenseLevel >= 1 || autoLightState >= 1)
  {
    frontWiperState = 1;
  }

  if (frontWiperState == 1)
  {
    wiperInterval = clampRange(6 - rainSenseLevel, 1, 15);
  }

  if (rainSenseLevel >= 4)
  {
    rearWiperState = 1;
  }

  mWiper.FrontWiperState = clampRange(frontWiperState, 0, 3);
  mWiper.RearWiperState = clampRange(rearWiperState, 0, 3);
  mWiper.WiperInterval = clampRange(wiperInterval, 0, 15);

  mWiper.gFrontWiperImageIndex = clampRange(gFrontWiperState, 0, 21);
  mWiper.gRearWiperImageIndex = clampRange(gRearWiperState, 0, 3);
  output(mWiper);

  if (mWiper.FrontWiperState != gLastFrontWiperState ||
      mWiper.RearWiperState != gLastRearWiperState ||
      mWiper.WiperInterval != gLastWiperInterval)
  {
    write("[WIP] front=%d rear=%d interval=%d rain=%d auto=%d",
          mWiper.FrontWiperState,
          mWiper.RearWiperState,
          mWiper.WiperInterval,
          rainSenseLevel,
          autoLightState);
    gLastFrontWiperState = mWiper.FrontWiperState;
    gLastRearWiperState = mWiper.RearWiperState;
    gLastWiperInterval = mWiper.WiperInterval;
  }
}

on start
{
  gRainSenseLevel = 0;
  gAutoLightState = 0;
  gRainRxMs = 0;
  gLastRainInputStale = 0;
  gLastFrontWiperState = -1;
  gLastRearWiperState = -1;
  gLastWiperInterval = -1;
  gWiperPos = 0;
  gWiperDir = 1;
  setTimer(tWiperCycle, 100);
  write("[WIP] start");
}

on message frmRainLightAutoMsg
{
  gRainSenseLevel = clampRange((int)this.RainSenseLevel, 0, 15);
  gAutoLightState = clampRange((int)this.AutoLightState, 0, 3);
  gRainRxMs = getSimulationTimeMs();
}

on timer tWiperCycle
{
  int cmd;
  int step;

  if ((int)@Test::testScenario == 0)
  {
    // 수동 모드: MyDriverPanel 와이퍼 슬라이더 sysvar 직접 읽기
    cmd = clampRange((int)@Body::wiperCmd, 0, 2);
    gFrontWiperImageIndex = cmd;
    gRearWiperImageIndex  = 0;
    gWiperInterval   = 0;
  }
  else if ((int)@Core::timeoutClear == 1)
  {
    cmd = 1;  // 테스트 시나리오: LOW 고정
    gFrontWiperImageIndex = 1;
    gRearWiperImageIndex  = 0;
    gWiperInterval   = 4;
  }
  else
  {
    cmd = 0;
    gFrontWiperImageIndex = 0;
    gRearWiperImageIndex  = 0;
    gWiperInterval   = 0;
  }

  // 와이퍼 왕복 애니메이션 (프레임 0~21, 22장)
  // LOW(1) : 100ms마다 1프레임 → 한 번 왕복 약 4.4초
  // HIGH(2): 100ms마다 2프레임 → 한 번 왕복 약 2.2초
  if (cmd == 1)
    step = 1;
  else if (cmd == 2)
    step = 2;
  else
    step = 0;

  if (step > 0)
  {
    gWiperPos = gWiperPos + gWiperDir * step;
    if (gWiperPos >= 21)
    {
      gWiperPos = 21;
      gWiperDir = -1;
    }
    if (gWiperPos <= 0)
    {
      gWiperPos = 0;
      gWiperDir = 1;
    }
  }
  else
  {
    gWiperPos = 0;
    gWiperDir = 1;
  }

  gFrontWiperImageIndex = gWiperPos;   // 프레임 인덱스를 CAN 신호로 전송
  @Body::wiperPos  = gWiperPos;

  publishWiperState();
  setTimer(tWiperCycle, 100);
}

on stopMeasurement
{
  cancelTimer(tWiperCycle);
}
