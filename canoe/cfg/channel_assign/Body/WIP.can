includes
{
  #include "..\\common\\CAPL_COMMON.cin"
}

variables
{
  msTimer tWiperCycle;
  int gFrontWiperState;  // 실제 프레임 인덱스 0~21
  int gRearWiperState;
  int gWiperInterval;
  int gLastFrontWiperState;
  int gLastRearWiperState;
  int gLastWiperInterval;
  int gWiperPos;   // 현재 프레임 0~21
  int gWiperDir;   // 1=전진(0→21)  -1=후진(21→0)
}

void publishWiperState()
{
  message frmWiperStateMsg mWiper;

  mWiper.FrontWiperState = clampRange(gFrontWiperState, 0, 21);
  mWiper.RearWiperState = clampRange(gRearWiperState, 0, 3);
  mWiper.WiperInterval = clampRange(gWiperInterval, 0, 15);
  output(mWiper);

  if (mWiper.FrontWiperState != gLastFrontWiperState ||
      mWiper.RearWiperState != gLastRearWiperState ||
      mWiper.WiperInterval != gLastWiperInterval)
  {
    write("[WIP] front=%d rear=%d interval=%d",
          mWiper.FrontWiperState,
          mWiper.RearWiperState,
          mWiper.WiperInterval);
    gLastFrontWiperState = mWiper.FrontWiperState;
    gLastRearWiperState = mWiper.RearWiperState;
    gLastWiperInterval = mWiper.WiperInterval;
  }
}

on start
{
  gFrontWiperState = 0;
  gRearWiperState = 0;
  gWiperInterval = 0;
  gLastFrontWiperState = -1;
  gLastRearWiperState = -1;
  gLastWiperInterval = -1;
  gWiperPos = 0;
  gWiperDir = 1;
  setTimer(tWiperCycle, 100);
  write("[WIP] start");
}

on timer tWiperCycle
{
  int cmd;
  int step;

  if ((int)@Test::testScenario == 0)
  {
    // 수동 모드: MyDriverPanel 와이퍼 슬라이더 sysvar 직접 읽기
    cmd = clampRange((int)@Body::wiperCmd, 0, 2);
    gFrontWiperState = cmd;
    gRearWiperState  = 0;
    gWiperInterval   = 0;
  }
  else if ((int)@Core::timeoutClear == 1)
  {
    cmd = 1;  // 테스트 시나리오: LOW 고정
    gFrontWiperState = 1;
    gRearWiperState  = 0;
    gWiperInterval   = 4;
  }
  else
  {
    cmd = 0;
    gFrontWiperState = 0;
    gRearWiperState  = 0;
    gWiperInterval   = 0;
  }

  // 와이퍼 왕복 애니메이션 (프레임 0~21, 22장)
  // LOW(1) : 100ms마다 1프레임 → 한 번 왕복 약 4.4초
  // HIGH(2): 100ms마다 2프레임 → 한 번 왕복 약 2.2초
  if (cmd == 1)
    step = 1;
  else if (cmd == 2)
    step = 2;
  else
    step = 0;

  if (step > 0)
  {
    gWiperPos = gWiperPos + gWiperDir * step;
    if (gWiperPos >= 21)
    {
      gWiperPos = 21;
      gWiperDir = -1;
    }
    if (gWiperPos <= 0)
    {
      gWiperPos = 0;
      gWiperDir = 1;
    }
  }
  else
  {
    gWiperPos = 0;
    gWiperDir = 1;
  }

  gFrontWiperState = gWiperPos;   // 프레임 인덱스를 CAN 신호로 전송
  @Body::wiperPos  = gWiperPos;

  publishWiperState();
  setTimer(tWiperCycle, 100);
}

on stopMeasurement
{
  cancelTimer(tWiperCycle);
}
