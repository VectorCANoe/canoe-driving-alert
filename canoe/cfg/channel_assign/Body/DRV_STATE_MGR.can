includes
{
}

variables
{
}

on start
{
  write("[DRV_STATE_MGR] start (inactive placeholder; product path not used)");
}
