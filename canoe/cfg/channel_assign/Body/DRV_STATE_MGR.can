includes
{
}

variables
{
}

on start
{
  write("[DRV_STATE_MGR] absorbed into BCM runtime; wrapper only");
}
