includes
{
  #include "..\\common\\CAPL_COMMON.cin"
}

variables
{
  msTimer tSeatDrvCycle;
  int gLastPos;
  int gLastHeat;
  int gLastVent;
}

on start
{
  gLastPos = -1;
  gLastHeat = -1;
  gLastVent = -1;
  setTimer(tSeatDrvCycle, 100);
  write("[SEAT_DRV] start");
}

on timer tSeatDrvCycle
{
  message frmSeatDrvStateMsg mSeat;
  int pos;
  int heat;
  int vent;

  pos = 120;
  heat = 0;
  vent = 0;

  mSeat.SeatDrvPos = clampRange(pos, 0, 255);
  mSeat.SeatDrvHeatLvl = clampRange(heat, 0, 15);
  mSeat.SeatDrvVentLvl = clampRange(vent, 0, 15);
  output(mSeat);

  if (mSeat.SeatDrvPos != gLastPos ||
      mSeat.SeatDrvHeatLvl != gLastHeat ||
      mSeat.SeatDrvVentLvl != gLastVent)
  {
    write("[SEAT_DRV] pos=%d heat=%d vent=%d",
          mSeat.SeatDrvPos,
          mSeat.SeatDrvHeatLvl,
          mSeat.SeatDrvVentLvl);
    gLastPos = mSeat.SeatDrvPos;
    gLastHeat = mSeat.SeatDrvHeatLvl;
    gLastVent = mSeat.SeatDrvVentLvl;
  }

  setTimer(tSeatDrvCycle, 100);
}

on stopMeasurement
{
  cancelTimer(tSeatDrvCycle);
}
