includes
{
  #include "..\\common\\CAPL_COMMON.cin"
}

variables
{
  msTimer tAutoDoorCycle;
  int gDoorFlLockState;
  int gDoorFrLockState;
  int gDoorFlOpenState;
  int gDoorFrOpenState;
  int gLastAutoDoorState;
  int gLastAutoUnlockState;
  int gLastApproachScore;
}

on start
{
  gDoorFlLockState = 1;
  gDoorFrLockState = 1;
  gDoorFlOpenState = 0;
  gDoorFrOpenState = 0;
  gLastAutoDoorState = -1;
  gLastAutoUnlockState = -1;
  gLastApproachScore = -1;
  setTimer(tAutoDoorCycle, 100);
  write("[ADM] start");
}

on message frmDoorFlStateMsg
{
  gDoorFlLockState = clampRange((int)this.DoorFlLockState, 0, 3);
  gDoorFlOpenState = clampRange((int)this.DoorFlOpenState, 0, 1);
}

on message frmDoorFrStateMsg
{
  gDoorFrLockState = clampRange((int)this.DoorFrLockState, 0, 3);
  gDoorFrOpenState = clampRange((int)this.DoorFrOpenState, 0, 1);
}

on timer tAutoDoorCycle
{
  message frmAutoDoorCtrlStateMsg mDoor;
  int driveState;
  int timeoutClear;
  int autoDoorState;
  int autoUnlockState;
  int approachScore;

  driveState = clampRange((int)@Core::driveStateNorm, 0, 3);
  timeoutClear = clampRange((int)@Core::timeoutClear, 0, 1);

  autoDoorState = (driveState == 0) ? 1 : 0;
  autoUnlockState = (driveState == 0 && timeoutClear == 1) ? 2 : 0;
  if (gDoorFlOpenState == 1 || gDoorFrOpenState == 1)
  {
    autoUnlockState = 1;
  }

  approachScore = 40;
  if (gDoorFlLockState == 0 || gDoorFrLockState == 0) approachScore += 20;
  if (timeoutClear == 1) approachScore += 20;
  if (driveState == 0) approachScore += 20;
  approachScore = clampRange(approachScore, 0, 100);

  mDoor.AutoDoorState = clampRange(autoDoorState, 0, 7);
  mDoor.AutoUnlockState = clampRange(autoUnlockState, 0, 3);
  mDoor.DoorApproachScore = clampRange(approachScore, 0, 100);
  output(mDoor);

  if (mDoor.AutoDoorState != gLastAutoDoorState ||
      mDoor.AutoUnlockState != gLastAutoUnlockState ||
      mDoor.DoorApproachScore != gLastApproachScore)
  {
    write("[ADM] state=%d unlock=%d score=%d drive=%d",
          mDoor.AutoDoorState,
          mDoor.AutoUnlockState,
          mDoor.DoorApproachScore,
          driveState);
    gLastAutoDoorState = mDoor.AutoDoorState;
    gLastAutoUnlockState = mDoor.AutoUnlockState;
    gLastApproachScore = mDoor.DoorApproachScore;
  }

  setTimer(tAutoDoorCycle, 100);
}

on stopMeasurement
{
  cancelTimer(tAutoDoorCycle);
}

