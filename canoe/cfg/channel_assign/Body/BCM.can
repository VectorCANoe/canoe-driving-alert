/*@!Encoding:949*/
includes
{
  #include "..\\common\\CAPL_COMMON.cin"
}

variables
{
  msTimer tBodyCycle;
  msTimer tBodyBase100;
  long gEthSocket;
  dword gEthTargetIp;
  char gEthRxBuffer[64];
  int gLastAmbientMode;
  int gLastAmbientColor;
  int gLastAmbientPattern;
  int gBodyAliveCnt;
  int gBackboneAlertLevel;
  int gBackboneAlertType;
  int gBackboneTimeoutClear;
  dword gBackboneAlertTsMs;
  
  //Timer for GuideLED
  msTimer guideLedTimer;
  int guideMode = 0;   // 0=off, 5=left, 6=right
  int step = 0;
  int ms = 200;
  //for led name
  char prev[10]="";
  //for display name
  char display[22]="SDV_Ambient_Top_View";
}

int useBackboneAlertState()
{
  dword nowMs;

  if (gBackboneAlertTsMs == 0)
  {
    return 0;
  }

  nowMs = getSimulationTimeMs();
  if ((nowMs - gBackboneAlertTsMs) > 500)
  {
    return 0;
  }

  return 1;
}

void updateBackboneAlertState(int alertLevel, int alertType, int timeoutClear)
{
  gBackboneAlertLevel = clampRange(alertLevel, 0, 7);
  gBackboneAlertType = clampRange(alertType, 0, 7);
  gBackboneTimeoutClear = (timeoutClear == 1) ? 1 : 0;
  gBackboneAlertTsMs = getSimulationTimeMs();
}

void OnUdpReceiveFrom(dword socket, long result, dword address, dword port, char buffer[], dword count)
{
  int msgId;

  if (socket != gEthSocket)
  {
    return;
  }
  if (result == 0)
  {
    msgId = ethFrameMsgId(buffer, count);
    if (msgId == ethMsgSelectedAlert() && ethFramePayloadLen(count) >= 2)
    {
      updateBackboneAlertState(ethGetU8(buffer, 0) & 0x7,
                               (ethGetU8(buffer, 0) >> 3) & 0x7,
                               ethGetU8(buffer, 1) & 0x1);
    }
  }

  ethArmReceive(gEthSocket, gEthRxBuffer, elcount(gEthRxBuffer));
}



on start
{
  gEthSocket = ethOpenDefaultSocket();
  gEthTargetIp = ethGetDefaultIpAddress();
  gLastAmbientMode = -1;
  gLastAmbientColor = -1;
  gLastAmbientPattern = -1;
  gBodyAliveCnt = 0;
  gBackboneAlertLevel = 0;
  gBackboneAlertType = 0;
  gBackboneTimeoutClear = 0;
  gBackboneAlertTsMs = 0;
  if (gEthSocket != ethInvalidSocket())
  {
    ethStartReceiver(gEthSocket, gEthRxBuffer, elcount(gEthRxBuffer));
  }
  setTimer(tBodyCycle, 10);
  setTimer(tBodyBase100, 100);
  write("[BCM] start");
}

on timer tBodyCycle
{
  int alertLevel;
  int alertType;
  int timeoutClear;
  int ambientMode;
  int ambientColor;
  int ambientPattern;
  int useBackbone;
  message frmAmbientControlMsg mAmbient;

  useBackbone = useBackboneAlertState();
  if (useBackbone == 1)
  {
    alertLevel = gBackboneAlertLevel;
    alertType = gBackboneAlertType;
    timeoutClear = gBackboneTimeoutClear;
  }
  else
  {
    alertLevel = (int)@Core::selectedAlertLevel;
    alertType = (int)@Core::selectedAlertType;
    timeoutClear = (int)@Core::timeoutClear;
  }
  if (alertLevel < 0 || alertLevel > 7)
  {
    alertLevel = 0;
  }
  if (alertType < 0 || alertType > 7)
  {
    alertType = 0;
  }
  timeoutClear = (timeoutClear == 1) ? 1 : 0;

  if (timeoutClear == 1)
  {
    ambientMode = 0;
    ambientColor = 0;
    ambientPattern = 0;
  }
  else
  {
    ambientMode = alertLevel;
    ambientColor = 0;
    ambientPattern = 0;
    if (alertLevel >= 6)
    {
      /* Req_035: emergency color/pattern distinct from zone policies
         Legacy Req_036 merged into Req_035
         6=RED/BLUE(police)  7=RED/WHITE(ambulance) */
      ambientColor   = (alertType == 2) ? 7 : 6;
      ambientPattern = (alertType == 2) ? 7 : 6;
    }
    else if (alertType == 3)
    {
      ambientColor   = 3; /* red   - Req_037 school zone fixed color */
      ambientPattern = 5; /* fast flash - Req_037 school zone fixed pattern */
    }
    else if (alertType == 4)
    {
      ambientColor   = 4; /* orange - Req_037 highway fixed color (Legacy Req_038) */
      ambientPattern = 4; /* pulse  - Req_037 highway fixed pattern (Legacy Req_038) */
    }
    else if (alertType == 5)
    {
      ambientColor   = 5; /* cyan      - Req_037 guide left (Legacy Req_039) */
      ambientPattern = 2; /* flow-left - Req_037 guide left fixed pattern (Legacy Req_039) */
    }
    else if (alertType == 6)
    {
      ambientColor   = 5; /* cyan       - Req_037 guide right (Legacy Req_039) */
      ambientPattern = 3; /* flow-right - Req_037 guide right fixed pattern (Legacy Req_039) */
    }
    else if (alertLevel > 0)
    {
      ambientColor   = 1; /* green - general fallback */
      ambientPattern = 1; /* solid */
    }
  }

  if (ambientMode != gLastAmbientMode ||
      ambientColor != gLastAmbientColor ||
      ambientPattern != gLastAmbientPattern)
  {
    @Body::ambientMode = ambientMode;
    @Body::ambientColor = ambientColor;
    @Body::ambientPattern = ambientPattern;

    mAmbient.AmbientMode = ambientMode;
    mAmbient.AmbientColor = ambientColor;
    mAmbient.AmbientPattern = ambientPattern;
    output(mAmbient);

    gLastAmbientMode = ambientMode;
    gLastAmbientColor = ambientColor;
    gLastAmbientPattern = ambientPattern;
  }

  setTimer(tBodyCycle, 10);
}

on timer tBodyBase100
{
  message frmHazardControlMsg mHazard;
  message frmWindowControlMsg mWindow;
  message frmDoorStateMsg mDoorState;
  message frmLampControlMsg mLamp;
  message frmSeatBeltStateMsg mSeatBelt;
  message frmCabinAirStateMsg mCabinAir;
  message frmBodyHealthMsg mHealth;
  message frmSeatStateMsg mSeatState;
  message frmSeatControlMsg mSeatCtrl;
  message frmDoorControlMsg mDoorCtrl;
  message frmBodyGatewayStateMsg mBodyGwState;
  message frmBodyComfortStateMsg mComfort;
  message frmInteriorLightMsg mLight;
  message frmRainLightAutoMsg mRain;
  int hazardActive;
  int navDirection;
  int seatBeltOverride;
  int ambientMode;
  if (useBackboneAlertState() == 1)
  {
    hazardActive = (gBackboneAlertLevel >= 6) ? 1 : 0;
  }
  else
  {
    hazardActive = ((int)@Core::selectedAlertLevel >= 6) ? 1 : 0;
  }
  navDirection = (int)@Infotainment::navDirection;
  seatBeltOverride = (int)@Test::seatBeltOverride;
  ambientMode = clampRange((int)@Body::ambientMode, 0, 7);
  if (navDirection < 0 || navDirection > 3)
  {
    navDirection = 0;
  }
  if (seatBeltOverride < 0 || seatBeltOverride > 3)
  {
    seatBeltOverride = 0;
  }

  mHazard.HazardSwitch = hazardActive;
  mHazard.HazardState = hazardActive;
  output(mHazard);

  mWindow.WindowCommand = 0;
  mWindow.WindowState = 0;
  output(mWindow);

  mLight.CabinLightMode = ambientMode & 0x7;
  mLight.DomeLightLevel = (ambientMode > 0) ? 20 : 4;
  output(mLight);

  mRain.RainSenseLevel = 0;
  mRain.AutoLightState = 0;
  output(mRain);

  mDoorState.DoorStateMask = 0;
  mDoorState.DoorLockState = 1;
  mDoorState.ChildLockState = 0;
  mDoorState.DoorOpenWarn = 0;
  output(mDoorState);

  mLamp.HeadLampState = (hazardActive == 1) ? 2 : 1;
  mLamp.TailLampState = 1;
  if (hazardActive == 1)
  {
    mLamp.TurnLampState = 3;
  }
  else if (navDirection == 1)
  {
    mLamp.TurnLampState = 1;
  }
  else if (navDirection == 2)
  {
    mLamp.TurnLampState = 2;
  }
  else
  {
    mLamp.TurnLampState = 0;
  }
  mLamp.HazardLampReq = hazardActive;
  output(mLamp);

  mSeatBelt.DriverSeatBelt = 1;
  mSeatBelt.PassengerSeatBelt = 1;
  if (seatBeltOverride == 1 || seatBeltOverride == 3)
  {
    mSeatBelt.DriverSeatBelt = 0;
  }
  if (seatBeltOverride == 2 || seatBeltOverride == 3)
  {
    mSeatBelt.PassengerSeatBelt = 0;
  }
  mSeatBelt.RearSeatBelt = 3;
  mSeatBelt.SeatBeltWarnLvl = 0;
  if (mSeatBelt.DriverSeatBelt == 0 || mSeatBelt.PassengerSeatBelt == 0)
  {
    mSeatBelt.SeatBeltWarnLvl = 2;
  }
  else if (hazardActive == 1)
  {
    mSeatBelt.SeatBeltWarnLvl = 1;
  }
  output(mSeatBelt);

  @CoreState::turnLampState = mLamp.TurnLampState;
  @CoreState::driverSeatBelt = mSeatBelt.DriverSeatBelt;
  @CoreState::passengerSeatBelt = mSeatBelt.PassengerSeatBelt;
  @CoreState::seatBeltWarnLvl = mSeatBelt.SeatBeltWarnLvl;

  mCabinAir.CabinTemp = 24;
  mCabinAir.AirQualityIndex = 90;
  output(mCabinAir);

  mHealth.BodyAliveCnt = gBodyAliveCnt & 0xFF;
  mHealth.BodyFailCode = 0;
  output(mHealth);

  mSeatState.DriverSeatPos = 120;
  mSeatState.PassengerSeatPos = 118;
  output(mSeatState);

  mSeatCtrl.DriverSeatCmd = 0;
  mSeatCtrl.PassengerSeatCmd = 0;
  mSeatCtrl.SeatHeatLevel = 0;
  mSeatCtrl.SeatVentLevel = 0;
  output(mSeatCtrl);

  mDoorCtrl.DoorControlCmd = 0;
  mDoorCtrl.ChildLockCmd = 0;
  output(mDoorCtrl);


  mBodyGwState.BodyGwRouteState = 1;
  mBodyGwState.BodyGwHealth = 0;
  output(mBodyGwState);

  mComfort.ComfortProfile = 1;
  mComfort.ComfortStatus = 0;
  mComfort.ComfortError = 0;
  output(mComfort);
  gBodyAliveCnt = (gBodyAliveCnt + 1) & 0xFF;

  setTimer(tBodyBase100, 100);
}

on stopMeasurement
{
  cancelTimer(tBodyCycle);
  cancelTimer(tBodyBase100);
  ethCloseSocket(gEthSocket);
  gEthSocket = ethInvalidSocket();
}

on sysvar Body::ambientMode{
  char curr[10];
  char num[5];
  
  //for guideLED Animation
  cancelTimer(guideLedTimer);
  guideMode = 0;
  guideLedAllOff();
  switch(@Body::ambientMode){
    case 5: 
    case 6:
      guideLedStart(@Body::ambientMode);
      break;
  }
  
  //set LED Image
  //prev off
  if(strlen(prev) > 0)
  {
    setControlVisibility(display, prev, 0);
  }
  snprintf(curr, elcount(curr), "led%d", @Body::ambientMode); //set curr led name
  setControlVisibility(display, curr, 1);  //curr on
  snprintf(prev, elcount(prev), "%s", curr);  //set prev
  
}

void guideLedStart(int mode){
  guideMode = mode;
  step = 0;
  setTimer(guideLedTimer, ms);
}

void guideLedAllOff(){
  int i;
  char name[20];

  for(i=1;i<=5;i++){
    snprintf(name, elcount(name), "led5_%d", i);
    setControlVisibility(display, name, 0);

    snprintf(name, elcount(name), "led6_%d", i);
    setControlVisibility(display, name, 0);
  }
}

on timer guideLedTimer{
  char name[20];

  if(guideMode != 5 && guideMode != 6){
    guideLedAllOff();
    return;
  }

  step++;
  if(step > 5) step = 1;

  guideLedAllOff();

  setControlVisibility(display, "led0", 1);

  snprintf(name, elcount(name), "led%d_%d", guideMode, step);
  setControlVisibility(display, name, 1);

  setTimer(guideLedTimer, ms);
}