includes
{
  #include "..\\common\\CAPL_COMMON.cin"
}

variables
{
  msTimer tBodyCycle;
  msTimer tBodyBase100;
  long gEthSocket;
  dword gEthTargetIp;
  char gEthRxBuffer[64];
  int gLastAmbientMode;
  int gLastAmbientColor;
  int gLastAmbientPattern;
  int gBodyAliveCnt;
  int gBackboneAlertLevel;
  int gBackboneAlertType;
  int gBackboneTimeoutClear;
  dword gBackboneAlertTsMs;
  int gAmbientModeWork;
  int gAmbientColorWork;
  int gAmbientPatternWork;
  
  const int BCM_BACKBONE_ALERT_TIMEOUT_MS = 500;
  const int BCM_ALERT_LEVEL_MAX = 7;
  const int BCM_ALERT_TYPE_MAX = 7;
  const int BCM_NAV_DIRECTION_MAX = 3;
  const int BCM_SEAT_BELT_OVERRIDE_MAX = 3;
  const int BCM_HAZARD_INACTIVE = 0;
  const int BCM_HAZARD_ACTIVE = 1;
  const int BCM_TIMEOUT_CLEAR_ACTIVE = 1;
  const int BCM_HAZARD_ALERT_THRESHOLD = 6;
  const int BCM_ALERT_TYPE_AMBULANCE = 2;
  const int BCM_ALERT_TYPE_SCHOOL_ZONE = 3;
  const int BCM_ALERT_TYPE_HIGHWAY = 4;
  const int BCM_ALERT_TYPE_GUIDE_LEFT = 5;
  const int BCM_ALERT_TYPE_GUIDE_RIGHT = 6;
  const int BCM_DRIVER_OVERRIDE = 1;
  const int BCM_PASSENGER_OVERRIDE = 2;
  const int BCM_DRIVER_AND_PASSENGER_OVERRIDE = 3;
  const int BCM_TURN_LAMP_OFF = 0;
  const int BCM_TURN_LAMP_LEFT = 1;
  const int BCM_TURN_LAMP_RIGHT = 2;
  const int BCM_TURN_LAMP_HAZARD = 3;
  const int BCM_SEAT_BELT_UNBUCKLED = 0;
  const int BCM_SEAT_BELT_BUCKLED = 1;
  const int BCM_REAR_SEAT_BELT_ALL_BUCKLED = 3;
  const int BCM_SEAT_BELT_WARN_OFF = 0;
  const int BCM_SEAT_BELT_WARN_HAZARD = 1;
  const int BCM_SEAT_BELT_WARN_UNBUCKLED = 2;
  const int BCM_SELECTED_ALERT_PAYLOAD_MIN_LEN = 2;
  const int BCM_AMBIENT_OFF = 0;
  const int BCM_AMBIENT_EMERGENCY_POLICE = 6;
  const int BCM_AMBIENT_EMERGENCY_AMBULANCE = 7;
  const int BCM_AMBIENT_SCHOOL_ZONE_COLOR = 3;
  const int BCM_AMBIENT_SCHOOL_ZONE_PATTERN = 5;
  const int BCM_AMBIENT_HIGHWAY_COLOR = 4;
  const int BCM_AMBIENT_HIGHWAY_PATTERN = 4;
  const int BCM_AMBIENT_GUIDE_COLOR = 5;
  const int BCM_AMBIENT_GUIDE_LEFT_PATTERN = 2;
  const int BCM_AMBIENT_GUIDE_RIGHT_PATTERN = 3;
  const int BCM_AMBIENT_FALLBACK_COLOR = 1;
  const int BCM_AMBIENT_FALLBACK_PATTERN = 1;
  const int BCM_WINDOW_COMMAND_DEFAULT = 0;
  const int BCM_WINDOW_STATE_DEFAULT = 0;
  const int BCM_DOME_LIGHT_LEVEL_ACTIVE = 20;
  const int BCM_DOME_LIGHT_LEVEL_IDLE = 4;
  const int BCM_RAIN_SENSE_LEVEL_DEFAULT = 0;
  const int BCM_AUTO_LIGHT_STATE_DEFAULT = 0;
  const int BCM_DOOR_STATE_MASK_DEFAULT = 0;
  const int BCM_DOOR_LOCK_STATE_LOCKED = 1;
  const int BCM_CHILD_LOCK_STATE_OFF = 0;
  const int BCM_DOOR_OPEN_WARN_OFF = 0;
  const int BCM_HEAD_LAMP_STATE_NORMAL = 1;
  const int BCM_HEAD_LAMP_STATE_HAZARD = 2;
  const int BCM_TAIL_LAMP_STATE_ON = 1;
  const int BCM_CABIN_TEMP_DEFAULT = 24;
  const int BCM_AIR_QUALITY_INDEX_DEFAULT = 90;
  const int BCM_BODY_FAIL_CODE_NONE = 0;
  const int BCM_DRIVER_SEAT_POS_DEFAULT = 120;
  const int BCM_PASSENGER_SEAT_POS_DEFAULT = 118;
  const int BCM_SEAT_CONTROL_CMD_DEFAULT = 0;
  const int BCM_SEAT_HEAT_LEVEL_DEFAULT = 0;
  const int BCM_SEAT_VENT_LEVEL_DEFAULT = 0;
  const int BCM_DOOR_CONTROL_CMD_DEFAULT = 0;
  const int BCM_BODY_GW_ROUTE_STATE_NORMAL = 1;
  const int BCM_BODY_GW_HEALTH_OK = 0;
  const int BCM_COMFORT_PROFILE_DEFAULT = 1;
  const int BCM_COMFORT_STATUS_DEFAULT = 0;
  const int BCM_COMFORT_ERROR_NONE = 0;
}

int isUsingBackboneAlertState()
{
  dword nowMs;

  if (gBackboneAlertTsMs == 0)
  {
    return 0;
  }

  nowMs = getSimulationTimeMs();
  if ((nowMs - gBackboneAlertTsMs) > BCM_BACKBONE_ALERT_TIMEOUT_MS)
  {
    return 0;
  }

  return 1;
}

int normalizeAmbientAlertLevel(int alertLevel)
{
  if (alertLevel < 0 || alertLevel > BCM_ALERT_LEVEL_MAX)
  {
    return 0;
  }

  return alertLevel;
}

int normalizeAmbientAlertType(int alertType)
{
  if (alertType < 0 || alertType > BCM_ALERT_TYPE_MAX)
  {
    return 0;
  }

  return alertType;
}

int normalizeTimeoutClear(int timeoutClear)
{
  return ((timeoutClear == BCM_TIMEOUT_CLEAR_ACTIVE) ? 1 : 0);
}

int deriveHazardActiveState()
{
  if (isUsingBackboneAlertState())
  {
    return ((gBackboneAlertLevel >= BCM_HAZARD_ALERT_THRESHOLD) ? BCM_HAZARD_ACTIVE : BCM_HAZARD_INACTIVE);
  }

  return ((((int)@Core::selectedAlertLevel) >= BCM_HAZARD_ALERT_THRESHOLD) ? BCM_HAZARD_ACTIVE : BCM_HAZARD_INACTIVE);
}

int normalizeNavDirection(int navDirection)
{
  if (navDirection < 0 || navDirection > BCM_NAV_DIRECTION_MAX)
  {
    return 0;
  }

  return navDirection;
}

int normalizeSeatBeltOverride(int seatBeltOverride)
{
  if (seatBeltOverride < 0 || seatBeltOverride > BCM_SEAT_BELT_OVERRIDE_MAX)
  {
    return 0;
  }

  return seatBeltOverride;
}

int deriveTurnLampState(int hazardActive, int navDirection)
{
  if (hazardActive == BCM_HAZARD_ACTIVE)
  {
    return BCM_TURN_LAMP_HAZARD;
  }
  if (navDirection == BCM_TURN_LAMP_LEFT)
  {
    return BCM_TURN_LAMP_LEFT;
  }
  if (navDirection == BCM_TURN_LAMP_RIGHT)
  {
    return BCM_TURN_LAMP_RIGHT;
  }

  return BCM_TURN_LAMP_OFF;
}

int deriveDriverSeatBeltState(int seatBeltOverride)
{
  if (seatBeltOverride == BCM_DRIVER_OVERRIDE ||
      seatBeltOverride == BCM_DRIVER_AND_PASSENGER_OVERRIDE)
  {
    return BCM_SEAT_BELT_UNBUCKLED;
  }

  return BCM_SEAT_BELT_BUCKLED;
}

int derivePassengerSeatBeltState(int seatBeltOverride)
{
  if (seatBeltOverride == BCM_PASSENGER_OVERRIDE ||
      seatBeltOverride == BCM_DRIVER_AND_PASSENGER_OVERRIDE)
  {
    return BCM_SEAT_BELT_UNBUCKLED;
  }

  return BCM_SEAT_BELT_BUCKLED;
}

int deriveSeatBeltWarnLevel(int driverSeatBelt, int passengerSeatBelt, int hazardActive)
{
  if (driverSeatBelt == BCM_SEAT_BELT_UNBUCKLED ||
      passengerSeatBelt == BCM_SEAT_BELT_UNBUCKLED)
  {
    return BCM_SEAT_BELT_WARN_UNBUCKLED;
  }
  if (hazardActive == BCM_HAZARD_ACTIVE)
  {
    return BCM_SEAT_BELT_WARN_HAZARD;
  }

  return BCM_SEAT_BELT_WARN_OFF;
}

int isSelectedAlertPayload(int msgId, dword count)
{
  return ((msgId == ethMsgSelectedAlert()) &&
          (ethFramePayloadLen(count) >= BCM_SELECTED_ALERT_PAYLOAD_MIN_LEN));
}

void updateBackboneAlertState(int alertLevel, int alertType, int timeoutClear)
{
  gBackboneAlertLevel = clampRange(alertLevel, 0, BCM_ALERT_LEVEL_MAX);
  gBackboneAlertType = clampRange(alertType, 0, BCM_ALERT_TYPE_MAX);
  gBackboneTimeoutClear = (timeoutClear == BCM_TIMEOUT_CLEAR_ACTIVE) ? 1 : 0;
  gBackboneAlertTsMs = getSimulationTimeMs();
}

void setAmbientOutputValues(int ambientMode, int ambientColor, int ambientPattern)
{
  gAmbientModeWork = ambientMode;
  gAmbientColorWork = ambientColor;
  gAmbientPatternWork = ambientPattern;
}

void resolveAmbientOutputValues(int alertLevel, int alertType, int timeoutClear)
{
  if (timeoutClear == BCM_TIMEOUT_CLEAR_ACTIVE)
  {
    setAmbientOutputValues(BCM_AMBIENT_OFF, BCM_AMBIENT_OFF, BCM_AMBIENT_OFF);
  }
  else
  {
    // Use the alert level as the base ambient mode.
    setAmbientOutputValues(alertLevel, BCM_AMBIENT_OFF, BCM_AMBIENT_OFF);

    // Highlight emergency alerts with dedicated color and pattern.
    if (alertLevel >= BCM_HAZARD_ALERT_THRESHOLD)
    {
      /* Req_035: emergency color/pattern distinct from zone policies
         Legacy Req_036 merged into Req_035
         6=RED/BLUE(police)  7=RED/WHITE(ambulance) */
      setAmbientOutputValues(alertLevel,
                             (alertType == BCM_ALERT_TYPE_AMBULANCE) ? BCM_AMBIENT_EMERGENCY_AMBULANCE : BCM_AMBIENT_EMERGENCY_POLICE,
                             (alertType == BCM_ALERT_TYPE_AMBULANCE) ? BCM_AMBIENT_EMERGENCY_AMBULANCE : BCM_AMBIENT_EMERGENCY_POLICE);
    }
    // Use a fixed color and pattern for school-zone alerts.
    else if (alertType == BCM_ALERT_TYPE_SCHOOL_ZONE)
    {
      setAmbientOutputValues(alertLevel, BCM_AMBIENT_SCHOOL_ZONE_COLOR, BCM_AMBIENT_SCHOOL_ZONE_PATTERN);
    }
    // Use a fixed color and pattern for highway alerts.
    else if (alertType == BCM_ALERT_TYPE_HIGHWAY)
    {
      setAmbientOutputValues(alertLevel, BCM_AMBIENT_HIGHWAY_COLOR, BCM_AMBIENT_HIGHWAY_PATTERN);
    }
    // Use the left-flow pattern for left guidance alerts.
    else if (alertType == BCM_ALERT_TYPE_GUIDE_LEFT)
    {
      setAmbientOutputValues(alertLevel, BCM_AMBIENT_GUIDE_COLOR, BCM_AMBIENT_GUIDE_LEFT_PATTERN);
    }
    // Use the right-flow pattern for right guidance alerts.
    else if (alertType == BCM_ALERT_TYPE_GUIDE_RIGHT)
    {
      setAmbientOutputValues(alertLevel, BCM_AMBIENT_GUIDE_COLOR, BCM_AMBIENT_GUIDE_RIGHT_PATTERN);
    }
    // Use the generic fallback color and pattern for other alerts.
    else if (alertLevel > 0)
    {
      setAmbientOutputValues(alertLevel, BCM_AMBIENT_FALLBACK_COLOR, BCM_AMBIENT_FALLBACK_PATTERN);
    }
  }
}

int hasAmbientOutputChanged()
{
  return ((gAmbientModeWork != gLastAmbientMode) ||
          (gAmbientColorWork != gLastAmbientColor) ||
          (gAmbientPatternWork != gLastAmbientPattern));
}

void OnUdpReceiveFrom(dword socket, long result, dword address, dword port, char buffer[], dword count)
{
  int msgId;

  if (socket != gEthSocket)
  {
    return;
  }
  if (result == 0)
  {
    msgId = ethFrameMsgId(buffer, count);
    if (isSelectedAlertPayload(msgId, count))
    {
      updateBackboneAlertState(ethGetU8(buffer, 0) & 0x7,
                               (ethGetU8(buffer, 0) >> 3) & 0x7,
                               ethGetU8(buffer, 1) & 0x1);
    }
  }

  ethArmReceive(gEthSocket, gEthRxBuffer, elcount(gEthRxBuffer));
}



on start
{
  gEthSocket = ethOpenDefaultSocket();
  gEthTargetIp = ethGetDefaultIpAddress();
  gLastAmbientMode = -1;
  gLastAmbientColor = -1;
  gLastAmbientPattern = -1;
  gBodyAliveCnt = 0;
  gBackboneAlertLevel = 0;
  gBackboneAlertType = 0;
  gBackboneTimeoutClear = 0;
  gBackboneAlertTsMs = 0;
  if (gEthSocket != ethInvalidSocket())
  {
    ethStartReceiver(gEthSocket, gEthRxBuffer, elcount(gEthRxBuffer));
  }
  setTimer(tBodyCycle, 10);
  setTimer(tBodyBase100, 100);
  write("[BCM] start");
}

on timer tBodyCycle
{
  int alertLevel;
  int alertType;
  int timeoutClear;
  message frmAmbientControlMsg mAmbient;

  if (isUsingBackboneAlertState())
  {
    alertLevel = gBackboneAlertLevel;
    alertType = gBackboneAlertType;
    timeoutClear = gBackboneTimeoutClear;
  }
  else
  {
    // Read the arbitration result for ambient control.
  alertLevel = (int)@Core::selectedAlertLevel;
    alertType = (int)@Core::selectedAlertType;
    timeoutClear = (int)@Core::timeoutClear;
  }
  // Clamp out-of-range inputs back to defaults.
  alertLevel = normalizeAmbientAlertLevel(alertLevel);
  alertType = normalizeAmbientAlertType(alertType);
  timeoutClear = normalizeTimeoutClear(timeoutClear);

  resolveAmbientOutputValues(alertLevel, alertType, timeoutClear);

  // Update sysvars and the message only when ambient outputs change.
  if (hasAmbientOutputChanged())
  {
    @Body::ambientMode = gAmbientModeWork;
    @Body::ambientColor = gAmbientColorWork;
    @Body::ambientPattern = gAmbientPatternWork;

    mAmbient.AmbientMode = gAmbientModeWork;
    mAmbient.AmbientColor = gAmbientColorWork;
    mAmbient.AmbientPattern = gAmbientPatternWork;
    output(mAmbient);

    gLastAmbientMode = gAmbientModeWork;
    gLastAmbientColor = gAmbientColorWork;
    gLastAmbientPattern = gAmbientPatternWork;
  }

  setTimer(tBodyCycle, 10);
}

on timer tBodyBase100
{
  message frmHazardControlMsg mHazard;
  message frmWindowControlMsg mWindow;
  message frmDoorStateMsg mDoorState;
  message frmLampControlMsg mLamp;
  message frmSeatBeltStateMsg mSeatBelt;
  message frmCabinAirStateMsg mCabinAir;
  message frmBodyHealthMsg mHealth;
  message frmSeatStateMsg mSeatState;
  message frmSeatControlMsg mSeatCtrl;
  message frmDoorControlMsg mDoorCtrl;
  message frmBodyGatewayStateMsg mBodyGwState;
  message frmBodyComfortStateMsg mComfort;
  message frmInteriorLightMsg mLight;
  message frmRainLightAutoMsg mRain;
  int hazardActive;
  int navDirection;
  int seatBeltOverride;
  int ambientMode;

  // Read and normalize the inputs needed for periodic transmission.
  hazardActive = deriveHazardActiveState();
  navDirection = normalizeNavDirection((int)@Infotainment::navDirection);
  seatBeltOverride = normalizeSeatBeltOverride((int)@Test::seatBeltOverride);
  ambientMode = clampRange((int)@Body::ambientMode, 0, BCM_ALERT_LEVEL_MAX);

  // Publish the hazard state periodically.
  mHazard.HazardSwitch = hazardActive;
  mHazard.HazardState = hazardActive;
  output(mHazard);

  // Publish the window state with default values.
  mWindow.WindowCommand = BCM_WINDOW_COMMAND_DEFAULT;
  mWindow.WindowState = BCM_WINDOW_STATE_DEFAULT;
  output(mWindow);

  // Publish the interior light state based on the ambient mode.
  mLight.CabinLightMode = ambientMode & 0x7;
  mLight.DomeLightLevel = (ambientMode > 0) ? BCM_DOME_LIGHT_LEVEL_ACTIVE : BCM_DOME_LIGHT_LEVEL_IDLE;
  output(mLight);

  // Publish default auto-light and rain-sensor states.
  mRain.RainSenseLevel = BCM_RAIN_SENSE_LEVEL_DEFAULT;
  mRain.AutoLightState = BCM_AUTO_LIGHT_STATE_DEFAULT;
  output(mRain);

  // Publish the default door state.
  mDoorState.DoorStateMask = BCM_DOOR_STATE_MASK_DEFAULT;
  mDoorState.DoorLockState = BCM_DOOR_LOCK_STATE_LOCKED;
  mDoorState.ChildLockState = BCM_CHILD_LOCK_STATE_OFF;
  mDoorState.DoorOpenWarn = BCM_DOOR_OPEN_WARN_OFF;
  output(mDoorState);

  // Determine lamp states from hazard status and navigation direction.
  mLamp.HeadLampState = (hazardActive == BCM_HAZARD_ACTIVE) ? BCM_HEAD_LAMP_STATE_HAZARD : BCM_HEAD_LAMP_STATE_NORMAL;
  mLamp.TailLampState = BCM_TAIL_LAMP_STATE_ON;
  mLamp.TurnLampState = deriveTurnLampState(hazardActive, navDirection);
  mLamp.HazardLampReq = hazardActive;
  output(mLamp);

  // Build seat-belt states from the override input.
  mSeatBelt.DriverSeatBelt = deriveDriverSeatBeltState(seatBeltOverride);
  mSeatBelt.PassengerSeatBelt = derivePassengerSeatBeltState(seatBeltOverride);
  mSeatBelt.RearSeatBelt = BCM_REAR_SEAT_BELT_ALL_BUCKLED;
  mSeatBelt.SeatBeltWarnLvl = deriveSeatBeltWarnLevel(mSeatBelt.DriverSeatBelt,
                                                       mSeatBelt.PassengerSeatBelt,
                                                       hazardActive);
  output(mSeatBelt);

  // Mirror key states into CoreState for other ECUs.
  @CoreState::turnLampState = mLamp.TurnLampState;
  @CoreState::driverSeatBelt = mSeatBelt.DriverSeatBelt;
  @CoreState::passengerSeatBelt = mSeatBelt.PassengerSeatBelt;
  @CoreState::seatBeltWarnLvl = mSeatBelt.SeatBeltWarnLvl;

  // Publish the cabin environment state with default values.
  mCabinAir.CabinTemp = BCM_CABIN_TEMP_DEFAULT;
  mCabinAir.AirQualityIndex = BCM_AIR_QUALITY_INDEX_DEFAULT;
  output(mCabinAir);

  // Publish body health and the alive counter.
  mHealth.BodyAliveCnt = gBodyAliveCnt & 0xFF;
  mHealth.BodyFailCode = BCM_BODY_FAIL_CODE_NONE;
  output(mHealth);

  // Publish seat position states.
  mSeatState.DriverSeatPos = BCM_DRIVER_SEAT_POS_DEFAULT;
  mSeatState.PassengerSeatPos = BCM_PASSENGER_SEAT_POS_DEFAULT;
  output(mSeatState);

  // Publish default seat control commands.
  mSeatCtrl.DriverSeatCmd = BCM_SEAT_CONTROL_CMD_DEFAULT;
  mSeatCtrl.PassengerSeatCmd = BCM_SEAT_CONTROL_CMD_DEFAULT;
  mSeatCtrl.SeatHeatLevel = BCM_SEAT_HEAT_LEVEL_DEFAULT;
  mSeatCtrl.SeatVentLevel = BCM_SEAT_VENT_LEVEL_DEFAULT;
  output(mSeatCtrl);

  // Publish default door control commands.
  mDoorCtrl.DoorControlCmd = BCM_DOOR_CONTROL_CMD_DEFAULT;
  mDoorCtrl.ChildLockCmd = BCM_CHILD_LOCK_STATE_OFF;
  output(mDoorCtrl);


  // Publish the body gateway state.
  mBodyGwState.BodyGwRouteState = BCM_BODY_GW_ROUTE_STATE_NORMAL;
  mBodyGwState.BodyGwHealth = BCM_BODY_GW_HEALTH_OK;
  output(mBodyGwState);

  // Publish the comfort state and advance the alive counter.
  mComfort.ComfortProfile = BCM_COMFORT_PROFILE_DEFAULT;
  mComfort.ComfortStatus = BCM_COMFORT_STATUS_DEFAULT;
  mComfort.ComfortError = BCM_COMFORT_ERROR_NONE;
  output(mComfort);
  gBodyAliveCnt = (gBodyAliveCnt + 1) & 0xFF;

  setTimer(tBodyBase100, 100);
}

on stopMeasurement
{
  cancelTimer(tBodyCycle);
  cancelTimer(tBodyBase100);
  ethCloseSocket(gEthSocket);
  gEthSocket = ethInvalidSocket();
}
