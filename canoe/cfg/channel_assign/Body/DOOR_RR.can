includes
{
  #include "..\\common\\CAPL_COMMON.cin"
}

variables
{
  msTimer tDoorRrCycle;
  int gLastLockState;
  int gLastOpenState;
  int gLastWindowPos;
}

on start
{
  gLastLockState = -1;
  gLastOpenState = -1;
  gLastWindowPos = -1;
  setTimer(tDoorRrCycle, 100);
  write("[DOOR_RR] start");
}

on timer tDoorRrCycle
{
  message frmDoorRrStateMsg mDoor;
  int lockState;
  int openState;
  int windowPos;

  lockState = 1;
  openState = 0;
  windowPos = 0;

  mDoor.DoorRrLockState = clampRange(lockState, 0, 3);
  mDoor.DoorRrOpenState = clampRange(openState, 0, 1);
  mDoor.DoorRrWindowPos = clampRange(windowPos, 0, 100);
  output(mDoor);

  if (mDoor.DoorRrLockState != gLastLockState ||
      mDoor.DoorRrOpenState != gLastOpenState ||
      mDoor.DoorRrWindowPos != gLastWindowPos)
  {
    write("[DOOR_RR] lock=%d open=%d win=%d",
          mDoor.DoorRrLockState,
          mDoor.DoorRrOpenState,
          mDoor.DoorRrWindowPos);
    gLastLockState = mDoor.DoorRrLockState;
    gLastOpenState = mDoor.DoorRrOpenState;
    gLastWindowPos = mDoor.DoorRrWindowPos;
  }

  setTimer(tDoorRrCycle, 100);
}

on stopMeasurement
{
  cancelTimer(tDoorRrCycle);
}
