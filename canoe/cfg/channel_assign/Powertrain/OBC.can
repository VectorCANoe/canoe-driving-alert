includes
{
  #include "..\\common\\CAPL_COMMON.cin"
}

variables
{
  msTimer tObcCycle;
  int gBatterySoc;
  int gChargingState;
  dword gFuelBatteryRxMs;
  int gLastState;
  int gLastPlug;
  int gLastPower;
  int gLastInputStale;
}

on start
{
  gBatterySoc = 95;
  gChargingState = 0;
  gFuelBatteryRxMs = 0;
  gLastState = -1;
  gLastPlug = -1;
  gLastPower = -1;
  gLastInputStale = 1;
  setTimer(tObcCycle, 100);
  write("[OBC] start");
}

on message frmFuelBatteryStateMsg
{
  gBatterySoc = clampRange((int)this.BatterySoc, 0, 100);
  gChargingState = clampRange((int)this.ChargingState, 0, 3);
  gFuelBatteryRxMs = getSimulationTimeMs();
}

on timer tObcCycle
{
  message frmObcStateMsg mObc;
  int driveState;
  int inputStale;
  int batterySoc;
  int chargingState;
  int obcState;
  int acPlugState;
  int chargePowerKw;

  driveState = clampRange((int)@Core::driveStateNorm, 0, 3);
  inputStale = 1;
  if (gFuelBatteryRxMs != 0 &&
      (getSimulationTimeMs() - gFuelBatteryRxMs) <= 300)
  {
    inputStale = 0;
  }

  batterySoc = gBatterySoc;
  chargingState = gChargingState;
  if (inputStale == 1)
  {
    batterySoc = 50;
    chargingState = 0;
  }

  if (inputStale != gLastInputStale)
  {
    if (inputStale == 1)
    {
      write("[OBC] fuel-battery input stale");
    }
    else
    {
      write("[OBC] fuel-battery input restored");
    }
    gLastInputStale = inputStale;
  }

  acPlugState = (driveState == 0) ? 1 : 0;

  if (chargingState == 1 && acPlugState == 1)
  {
    obcState = 2;
    chargePowerKw = clampRange((100 - batterySoc) / 2, 0, 22);
  }
  else if (acPlugState == 1)
  {
    obcState = 1;
    chargePowerKw = 0;
  }
  else
  {
    obcState = 0;
    chargePowerKw = 0;
  }

  mObc.ObcState = clampRange(obcState, 0, 7);
  mObc.AcPlugState = clampRange(acPlugState, 0, 1);
  mObc.ChargePowerKw = clampRange(chargePowerKw, 0, 255);
  output(mObc);

  if (mObc.ObcState != gLastState ||
      mObc.AcPlugState != gLastPlug ||
      mObc.ChargePowerKw != gLastPower)
  {
    write("[OBC] state=%d plug=%d power=%d soc=%d",
          mObc.ObcState,
          mObc.AcPlugState,
          mObc.ChargePowerKw,
          batterySoc);
    gLastState = mObc.ObcState;
    gLastPlug = mObc.AcPlugState;
    gLastPower = mObc.ChargePowerKw;
  }

  setTimer(tObcCycle, 100);
}

on stopMeasurement
{
  cancelTimer(tObcCycle);
}
