/*@!Encoding:65001*/
// TCM.can  (cfg/channel_assign — CANoe 실제 로드 파일)
// Powertrain Domain — 변속기 제어 + sysvar 브릿지
// 입력  : frmGearStateMsg (Panel: GearState 0=P 1=R 2=N 3=D 4=S 5=M)
//         frmVehicleModeMsg
//         @Chassis::vehicleSpeed
// 출력  : @Chassis::driveMode    (0=P 1=R 2=N 3=D)
//         @Chassis::driveState   (VAL_SCENARIO_CTRL 동기화용)
//         @Chassis::gearPosition (1-4 자동)
//         @Chassis::driveModeLabel (P/R/N/D 텍스트 → 패널 Text Display)
//         frmTransmissionTempMsg, frmTransShiftStateMsg

includes
{
}

variables
{
  msTimer tTransCycle;
  int gGearInput;
  int gGearState;
  int gDriveMode;
  int gLastGearState;
  int gShiftCounter;
}

on start
{
  gGearInput     = 0;
  gGearState     = 0;
  gDriveMode     = 0;
  gLastGearState = -1;
  gShiftCounter  = 0;
  @Chassis::driveState = 0;    // VAL_SCENARIO_CTRL 동기화 초기값
  setTimer(tTransCycle, 100);
  write("[TCM] start");
}

// ── Panel driveMode → driveState 동기화 ────────────────────────────
// VAL_SCENARIO_CTRL은 @Chassis::driveState를 읽어 브레이크 강제 여부 결정.
// driveState != driveMode 이면 VAL이 매 100ms brakePedal=30 강제.
on sysvar Chassis::driveMode
{
  int mode;
  mode = (int)@Chassis::driveMode;
  @Chassis::driveState = mode;
  switch (mode)
  {
    case 0:  sysSetVariableString(sysvar::Chassis::driveModeLabel, "P"); break;
    case 1:  sysSetVariableString(sysvar::Chassis::driveModeLabel, "R"); break;
    case 2:  sysSetVariableString(sysvar::Chassis::driveModeLabel, "N"); break;
    default: sysSetVariableString(sysvar::Chassis::driveModeLabel, "D"); break;
  }
  write("[TCM] driveMode=%d label synced", mode);
}

on message frmGearStateMsg
{
  gGearInput = this.GearInput;
  gGearState = this.GearState;

  // GearState: 0=P 1=R 2=N 3=D 4=S 5=M → driveMode: 0=P 1=R 2=N 3=D
  if      (gGearState == 0) @Chassis::driveMode = 0;
  else if (gGearState == 1) @Chassis::driveMode = 1;
  else if (gGearState == 2) @Chassis::driveMode = 2;
  else                      @Chassis::driveMode = 3;
}

on message frmVehicleModeMsg
{
  gDriveMode = this.DriveMode;
}

on timer tTransCycle
{
  message frmTransmissionTempMsg mTemp;
  message frmTransShiftStateMsg  mShift;
  int transOilTemp;
  int clutchTemp;
  int shiftState;
  int shiftSlip;
  int speed;
  int autoGear;

  speed = (int)@Chassis::vehicleSpeed;

  // ── 자동 기어 단수 계산 (D 모드, 6단) ────────────────────────────
  if ((int)@Chassis::driveMode == 3)
  {
    if      (speed <  20) autoGear = 1;
    else if (speed <  40) autoGear = 2;
    else if (speed <  65) autoGear = 3;
    else if (speed <  90) autoGear = 4;
    else if (speed < 130) autoGear = 5;
    else                  autoGear = 6;
  }
  else
  {
    autoGear = 1;
  }
  @Chassis::gearPosition = autoGear;

  // 오일 온도
  transOilTemp = 60;
  if (gGearState > 0)
  {
    transOilTemp = 75 + (speed / 20);
    if (gDriveMode == 2) transOilTemp = transOilTemp + 10;
  }
  if (transOilTemp > 255) transOilTemp = 255;

  // 클러치 온도 (변속 중 상승)
  clutchTemp = 50;
  if (gShiftCounter > 0)
  {
    clutchTemp    = 100 + gShiftCounter * 5;
    gShiftCounter = gShiftCounter - 1;
  }
  if (clutchTemp > 255) clutchTemp = 255;

  mTemp.TransOilTemp = transOilTemp;
  mTemp.ClutchTemp   = clutchTemp;
  output(mTemp);

  // 시프트 이벤트 감지
  if (gGearState != gLastGearState && gLastGearState >= 0)
  {
    shiftState    = 2;
    gShiftCounter = 4;
    write("[TCM] shift %d->%d  driveMode=%d  autoGear=%d",
          gLastGearState, gGearState,
          (int)@Chassis::driveMode, autoGear);
  }
  else
  {
    shiftState = 0;
  }

  shiftSlip = (shiftState == 2) ? 10 : 0;

  mShift.ShiftState      = shiftState & 0x7;
  mShift.ShiftTargetGear = gGearState & 0x7;
  mShift.ShiftSlip       = shiftSlip;
  output(mShift);

  gLastGearState = gGearState;

  setTimer(tTransCycle, 100);
}
