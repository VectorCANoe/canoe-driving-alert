includes
{
  #include "..\\common\\CAPL_COMMON.cin"
}

variables
{
  msTimer tEngineCycle;
  int gAccelPedal;
  int gBrakePedal;
  msTimer tAnimStep;          // 시동 애니메이션 프레임 타이머
  msTimer tHighwayEntry;      // 고속도로 진입 메시지 자동 복귀 타이머
  int gIgnitionState;
  int gEngineState;
  int gVehicleSpeed;
  dword gPedalRxMs;
  dword gIgnitionRxMs;
  dword gVehicleRxMs;
  int gLastPedalInputStale;
  int gLastIgnitionInputStale;
  int gLastVehicleInputStale;
  int gLastEngineState;
  int gLastRoadZone;          // 이전 도로 구역 (고속도로 진입 감지용)
  int gFuelLevel;
  int gBatterySoc;
  int gCoolantTemp;           // 현재 냉각수 온도: 20°C(냉간) → 90°C(정상) 서서히 변화
  int gFuelDisplay;           // 연료 게이지 표시값: 시동 시 0→gFuelLevel 서서히 상승
  int gAnimFrame;             // 현재 표시 중인 애니메이션 프레임 번호
  int gAnimEndFrame;          // 마지막 프레임 번호 (총 41장)
  int gAnimRunning;           // 애니메이션 재생 중 여부 (0=정지, 1=재생)
  int gAnimInterval;          // 프레임 간격 ms = 4000 / 30프레임 = 133ms
  int gInitDone;              // 초기화 완료 플래그 (0=초기화 중, 1=완료)
}

void traceEmsInputHealth(int ignitionInputStale, int pedalInputStale, int vehicleInputStale)
{
  if (ignitionInputStale != gLastIgnitionInputStale)
  {
    if (ignitionInputStale == 1)
    {
      write("[EMS] ignition input stale");
    }
    else
    {
      write("[EMS] ignition input restored");
    }
    gLastIgnitionInputStale = ignitionInputStale;
  }

  if (pedalInputStale != gLastPedalInputStale)
  {
    if (pedalInputStale == 1)
    {
      write("[EMS] pedal input stale");
    }
    else
    {
      write("[EMS] pedal input restored");
    }
    gLastPedalInputStale = pedalInputStale;
  }

  if (vehicleInputStale != gLastVehicleInputStale)
  {
    if (vehicleInputStale == 1)
    {
      write("[EMS] vehicle input stale");
    }
    else
    {
      write("[EMS] vehicle input restored");
    }
    gLastVehicleInputStale = vehicleInputStale;
  }
}

int deriveThrottlePos(int engineState, int accelPedal, int brakePedal)
{
  int throttlePos;

  if (engineState != 3)
  {
    return 0;
  }

  throttlePos = accelPedal;
  if (brakePedal >= 20)
  {
    throttlePos = throttlePos - (brakePedal / 2);
  }
  return clampRange(throttlePos, 0, 100);
}

int deriveEngineRpm(int engineState, int accelPedal, int brakePedal, int speed)
{
  int rpm;

  if (engineState == 0)
  {
    return 0;
  }
  if (engineState == 1)
  {
    return 500;
  }
  if (engineState == 2)
  {
    return 850;
  }

  rpm = 850 + (speed * 12);
  rpm = rpm + (accelPedal * 18);
  if (speed < 10 && accelPedal >= 40)
  {
    rpm = rpm + 250;
  }
  if (brakePedal >= 20)
  {
    rpm = rpm - (brakePedal * 4);
  }

  return clampRange(rpm, 700, 6500);
}

int deriveEngineLoad(int engineState, int throttlePos, int brakePedal, int speed)
{
  int engineLoad;

  if (engineState != 3)
  {
    return 0;
  }

  engineLoad = (throttlePos * 3 / 4) + (speed / 10);
  if (speed < 15 && throttlePos >= 30)
  {
    engineLoad = engineLoad + 10;
  }
  if (brakePedal >= 20)
  {
    engineLoad = engineLoad - 5;
  }

  return clampRange(engineLoad, 0, 100);
}

int deriveEngineTorque(int engineState, int engineLoad, int rpm)
{
  int torque;

  if (engineState != 3)
  {
    return 0;
  }

  torque = engineLoad * 2;
  if (rpm < 2000)
  {
    torque = torque + (rpm / 40);
  }
  else if (rpm < 3500)
  {
    torque = torque + 50 + ((3500 - rpm) / 30);
  }
  else
  {
    torque = torque + 20 + ((5000 - rpm) / 60);
  }

  return clampRange(torque, 0, 300);
}

void traceEmsInputHealth(int ignitionInputStale, int pedalInputStale, int vehicleInputStale)
{
  if (ignitionInputStale != gLastIgnitionInputStale)
  {
    if (ignitionInputStale == 1)
    {
      write("[EMS] ignition input stale");
    }
    else
    {
      write("[EMS] ignition input restored");
    }
    gLastIgnitionInputStale = ignitionInputStale;
  }

  if (pedalInputStale != gLastPedalInputStale)
  {
    if (pedalInputStale == 1)
    {
      write("[EMS] pedal input stale");
    }
    else
    {
      write("[EMS] pedal input restored");
    }
    gLastPedalInputStale = pedalInputStale;
  }

  if (vehicleInputStale != gLastVehicleInputStale)
  {
    if (vehicleInputStale == 1)
    {
      write("[EMS] vehicle input stale");
    }
    else
    {
      write("[EMS] vehicle input restored");
    }
    gLastVehicleInputStale = vehicleInputStale;
  }
}

int deriveThrottlePos(int engineState, int accelPedal, int brakePedal)
{
  int throttlePos;

  if (engineState != 3)
  {
    return 0;
  }

  throttlePos = accelPedal;
  if (brakePedal >= 20)
  {
    throttlePos = throttlePos - (brakePedal / 2);
  }
  return clampRange(throttlePos, 0, 100);
}

int deriveEngineRpm(int engineState, int accelPedal, int brakePedal, int speed)
{
  int rpm;

  if (engineState == 0)
  {
    return 0;
  }
  if (engineState == 1)
  {
    return 500;
  }
  if (engineState == 2)
  {
    return 850;
  }

  rpm = 850 + (speed * 12);
  rpm = rpm + (accelPedal * 18);
  if (speed < 10 && accelPedal >= 40)
  {
    rpm = rpm + 250;
  }
  if (brakePedal >= 20)
  {
    rpm = rpm - (brakePedal * 4);
  }

  return clampRange(rpm, 700, 6500);
}

int deriveEngineLoad(int engineState, int throttlePos, int brakePedal, int speed)
{
  int engineLoad;

  if (engineState != 3)
  {
    return 0;
  }

  engineLoad = (throttlePos * 3 / 4) + (speed / 10);
  if (speed < 15 && throttlePos >= 30)
  {
    engineLoad = engineLoad + 10;
  }
  if (brakePedal >= 20)
  {
    engineLoad = engineLoad - 5;
  }

  return clampRange(engineLoad, 0, 100);
}

int deriveEngineTorque(int engineState, int engineLoad, int rpm)
{
  int torque;

  if (engineState != 3)
  {
    return 0;
  }

  torque = engineLoad * 2;
  if (rpm < 2000)
  {
    torque = torque + (rpm / 40);
  }
  else if (rpm < 3500)
  {
    torque = torque + 50 + ((3500 - rpm) / 30);
  }
  else
  {
    torque = torque + 20 + ((5000 - rpm) / 60);
  }

  return clampRange(torque, 0, 300);
}

on start
{
  gAccelPedal      = 0;
  gBrakePedal      = 0;
  gIgnitionState   = 0;
  gEngineState     = 0;
  gVehicleSpeed    = 0;
  gPedalRxMs       = 0;
  gIgnitionRxMs    = 0;
  gVehicleRxMs     = 0;
  gLastPedalInputStale = 0;
  gLastIgnitionInputStale = 0;
  gLastVehicleInputStale = 0;
  gLastEngineState = 0; // merge: Current에는 -1로 대입되어 있었음
  gLastRoadZone    = -1;
  gFuelLevel       = 80;
  gBatterySoc      = 95;
  gCoolantTemp     = 20;   // 시동 전 냉간 온도
  gFuelDisplay     = 0;    // 시동 전 게이지 0
  @Powertrain::coolantTemp = gCoolantTemp;
  @Powertrain::fuelLevel   = gFuelDisplay;

  // ── 시동 애니메이션 초기화 ──────────────────────────────────
  // 슬롯 배치 (0-based, 총 40장):
  //  0 = 기본 주행 화면 (여백 없음)
  //  1 = 경찰차 접근 경고
  //  2 = 구급차 접근 경고
  //  3 = 스쿨존 접근 경고
  //  4 = 고속도로 진입 경고
  //  5 = 교차로 진입 좌회전
  //  6 = 합류구간 진입 우회전
  //  7 = 안전벨트 미착용 경고
  //  8 = 차량 도어 열림 경고
  //  9 = 핸들 조향 없을 시 경고
  // 10~39 = 시동 애니메이션 (30장, 4초)
  gAnimEndFrame  = 39;
  gAnimFrame     = 0;
  gAnimRunning   = 0;
  gAnimInterval  = 4000 / (gAnimEndFrame - 10 + 1);  // 4초 / 30프레임 = 133ms
  gInitDone      = 0;         // 첫 tEngineCycle 전까지 sysvar 핸들러 차단
  @Display::animFrame = 0;
  // ─────────────────────────────────────────────────────────────

  setTimer(tEngineCycle, 100);
  write("[EMS] start");
}

// ── 시동 애니메이션 프레임 스텝 타이머 ─────────────────────────────
// 12번 프레임부터 41번까지 4초 동안 순차 재생
// 재생 완료 후 → 2번 프레임(기본 주행 화면)으로 고정
on timer tAnimStep
{
  if (gAnimRunning == 0)
    return;

  gAnimFrame = gAnimFrame + 1;

  if (gAnimFrame > gAnimEndFrame)
  {
    // 마지막 프레임 도달 → 1번 이미지(기본 주행 화면)로 고정
    gAnimFrame   = 0;
    gAnimRunning = 0;
    @Display::animFrame = gAnimFrame;
    write("[EMS] anim complete: hold frame=0");
    return;
  }

  @Display::animFrame = gAnimFrame;
  setTimer(tAnimStep, gAnimInterval);
}
// ─────────────────────────────────────────────────────────────────────

// ── 고속도로 진입 메시지 자동 복귀 (3초 후 기본 주행 화면으로) ────────
on timer tHighwayEntry
{
  if (gAnimRunning == 1)
    return;
  if ((int)@Test::testScenario > 0)
    return;  // 시나리오 모드에서는 TEST_SCN.can이 제어
  if ((int)@Core::selectedAlertLevel == 0)
  {
    @Display::animFrame = 0;  // 기본 주행 화면으로 복귀
  }
}
// ─────────────────────────────────────────────────────────────────────

// ── 경고 타입 → animFrame 매핑 (애니메이션 미재생 시에만 적용) ──────────
// 슬롯 배치: 0=기본주행, 1=경찰, 2=구급차, 3=스쿨존,
//            4=고속도로진입, 5=교차로좌, 6=합류우, 7=안전벨트,
//            8=도어열림, 9=핸들미조작, 10~39=시동애니
void updateWarningFrame()
{
  int beltWarn;
  int doorOpen;

  if (gInitDone == 0)
    return;  // 초기화 완료 전 → 이전 세션 잔류값으로 화면 변경 방지

  if (gAnimRunning == 1)
    return;  // 시동 애니메이션 재생 중이면 경고 무시 (애니메이션 우선)

  beltWarn = (int)@CoreState::seatBeltWarnLvl;
  doorOpen = (int)@Body::doorOpenCmd;

  // 수동 모드(testScenario=0): 시동 ON일 때만 경고 표시
  if ((int)@Test::testScenario == 0)
  {
    if (gEngineState == 0)
    {
      @Display::animFrame = 0;
      return;
    }
    if (doorOpen == 1)
      @Display::animFrame = 8;
    else if (beltWarn >= 2)
      @Display::animFrame = 7;
    else
      @Display::animFrame = 0;
    return;
  }

  // 시나리오 모드: 도어/안전벨트 경고 발생 시만 덮어씀
  // (그 외에는 TEST_SCN.can이 마지막에 설정한 값 유지)
  if (doorOpen == 1)
    @Display::animFrame = 8;
  else if (beltWarn >= 2)
    @Display::animFrame = 7;
}

on sysvar Core::selectedAlertType   { updateWarningFrame(); }
on sysvar Core::selectedAlertLevel  { updateWarningFrame(); }
on sysvar CoreState::seatBeltWarnLvl { updateWarningFrame(); }
on sysvar Body::doorOpenCmd
{
  // 잠금 상태에서 열기 시도 시 즉시 차단 (인터록)
  if ((int)@Body::doorLockCmd == 1 && (int)@Body::doorOpenCmd == 1)
  {
    @Body::doorOpenCmd = 0;
    return;
  }
  updateWarningFrame();
}
on sysvar Body::doorLockCmd
{
  // 잠금 전환 시 열림 상태 강제 해제
  if ((int)@Body::doorLockCmd == 1)
    @Body::doorOpenCmd = 0;
  updateWarningFrame();
}

// ── 고속도로 진입 감지 (roadZone이 2로 바뀌는 순간 → 슬롯 6 표시) ───────
on sysvar Infotainment::roadZone
{
  int zone;

  if (gAnimRunning == 1)
    return;

  // 시나리오 모드: TEST_SCN.can이 animFrame을 직접 제어하므로 개입하지 않음
  if ((int)@Test::testScenario > 0)
  {
    gLastRoadZone = (int)@Infotainment::roadZone;
    return;
  }

  zone = (int)@Infotainment::roadZone;

  if (zone == 2 && gLastRoadZone != 2
      && (int)@Core::selectedAlertLevel == 0
      && gEngineState > 0)
  {
    @Display::animFrame = 4;           // 고속도로 진입 경고
    setTimer(tHighwayEntry, 3000);     // 3초 후 기본 주행 화면으로 자동 복귀
  }

  gLastRoadZone = zone;
}
// ─────────────────────────────────────────────────────────────────────

on message frmIgnitionEngineMsg
{
  if ((int)@Test::testScenario == 0) // merge: 이 줄만 추가되어 있었는데 왜 이런 코드가 있는지 파악 필요
    return;

  gIgnitionState = clampRange((int)this.IgnitionState, 0, 1);
  gEngineState   = clampRange((int)this.EngineState, 0, 3);
  gIgnitionRxMs = getSimulationTimeMs();
}

on message frmPedalInputCanMsg
{
  gAccelPedal = clampRange((int)this.AccelPedal, 0, 100);
  gBrakePedal = clampRange((int)this.BrakePedal, 0, 100);
  gPedalRxMs = getSimulationTimeMs();
}

on message frmVehicleStateCanMsg
{
  gVehicleSpeed = clampRange((int)this.gVehicleSpeed, 0, 255);
  gVehicleRxMs = getSimulationTimeMs();
}

on timer tEngineCycle
{
  message frmEngineSpeedTempMsg  mSpeedTemp;
  message frmFuelBatteryStateMsg mFuelBat;
  message frmThrottleStateMsg    mThrottle;
  message frmEngineTorqueMsg     mTorque;
  message frmEngineLoadMsg       mLoad;
  message frmThermalMgmtStateMsg mThermal;
  int ignitionInputStale;
  int pedalInputStale;
  int vehicleInputStale;
  int ignitionState;
  int engineState;
  int accelPedal;
  int brakePedal;
  int rpm;
  int throttlePos;
  int engineLoad;
  int torque;
  int speed;

  if      (gEngineState == 0) { rpm = 0; }
  else if (gEngineState == 1) { rpm = 400; }
  else if (gEngineState == 2) { rpm = 800; }
  else
  {
    speed = (int)@Core::vehicleSpeedNorm;
    rpm   = 800 + (speed * 25);
    if (rpm > 6500) rpm = 6500;
  }

  throttlePos = (gEngineState == 3) ? (int)@Core::vehicleSpeedNorm : 0;
  if (throttlePos > 100) throttlePos = 100;
  engineLoad  = (gEngineState == 3) ? (throttlePos * 8 / 10) : 0;
  if (engineLoad > 100) engineLoad = 100;
  torque      = (gEngineState == 3) ? (engineLoad * 3) : 0;
  if (torque > 300) torque = 300;

  mSpeedTemp.EngineRpm   = rpm & 0xFFFF;
  mSpeedTemp.CoolantTemp = (gEngineState > 0) ? 85 : 20;
  mSpeedTemp.OilTemp     = (gEngineState > 0) ? 90 : 20;
  output(mSpeedTemp);

  mFuelBat.FuelLevel     = gFuelDisplay;
  mFuelBat.BatterySoc    = gBatterySoc;
  mFuelBat.ChargingState = 0;
  output(mFuelBat);

  mThrottle.ThrottlePos = throttlePos;
  mThrottle.ThrottleReq = throttlePos;
  output(mThrottle);

  mTorque.EngineTorqueAct = torque & 0xFFFF;
  output(mTorque);

  mLoad.EngineLoad = engineLoad;
  output(mLoad);

  mThermal.ThermalMode   = (engineState > 0) ? 1 : 0;
  mThermal.FanDuty       = fanDuty;
  mThermal.CoolantTarget = 90;
  output(mThermal);

  if (engineState != gLastEngineState)
  {
    write("[EMS] ignition=%d engine=%d rpm=%d",
          gIgnitionState, gEngineState, rpm);
    gLastEngineState = gEngineState;
  }

  setTimer(tEngineCycle, 100);
}
