includes
{
}

variables
{
  msTimer tEngineCycle;
  msTimer tAnimStep;          // 시동 애니메이션 프레임 타이머
  msTimer tHighwayEntry;      // 고속도로 진입 메시지 자동 복귀 타이머
  int gIgnitionState;
  int gEngineState;
  int gLastEngineState;
  int gLastRoadZone;          // 이전 도로 구역 (고속도로 진입 감지용)
  int gFuelLevel;
  int gBatterySoc;
  int gCoolantTemp;           // 현재 냉각수 온도: 20°C(냉간) → 90°C(정상) 서서히 변화
  int gFuelDisplay;           // 연료 게이지 표시값: 시동 시 0→gFuelLevel 서서히 상승
  int gAnimFrame;             // 현재 표시 중인 애니메이션 프레임 번호
  int gAnimEndFrame;          // 마지막 프레임 번호 (총 41장)
  int gAnimRunning;           // 애니메이션 재생 중 여부 (0=정지, 1=재생)
  int gAnimInterval;          // 프레임 간격 ms = 4000 / 30프레임 = 133ms
  int gInitDone;              // 초기화 완료 플래그 (0=초기화 중, 1=완료)
}

on start
{
  gIgnitionState   = 0;
  gEngineState     = 0;
  gLastEngineState = 0;
  gLastRoadZone    = -1;
  gFuelLevel       = 80;
  gBatterySoc      = 95;
  gCoolantTemp     = 20;   // 시동 전 냉간 온도
  gFuelDisplay     = 0;    // 시동 전 게이지 0
  @Powertrain::coolantTemp = gCoolantTemp;
  @Powertrain::fuelLevel   = gFuelDisplay;

  // ── 시동 애니메이션 초기화 ──────────────────────────────────
  // 슬롯 배치 (0-based, 총 40장):
  //  0 = 기본 주행 화면 (여백 없음)
  //  1 = 경찰차 접근 경고
  //  2 = 구급차 접근 경고
  //  3 = 스쿨존 접근 경고
  //  4 = 고속도로 진입 경고
  //  5 = 교차로 진입 좌회전
  //  6 = 합류구간 진입 우회전
  //  7 = 안전벨트 미착용 경고
  //  8 = 차량 도어 열림 경고
  //  9 = 핸들 조향 없을 시 경고
  // 10~39 = 시동 애니메이션 (30장, 4초)
  gAnimEndFrame  = 39;
  gAnimFrame     = 0;
  gAnimRunning   = 0;
  gAnimInterval  = 4000 / (gAnimEndFrame - 10 + 1);  // 4초 / 30프레임 = 133ms
  gInitDone      = 0;         // 첫 tEngineCycle 전까지 sysvar 핸들러 차단
  @Display::animFrame = 0;
  // ─────────────────────────────────────────────────────────────

  setTimer(tEngineCycle, 100);
  write("[EMS] start");
}

// ── 시동 애니메이션 프레임 스텝 타이머 ─────────────────────────────
// 12번 프레임부터 41번까지 4초 동안 순차 재생
// 재생 완료 후 → 2번 프레임(기본 주행 화면)으로 고정
on timer tAnimStep
{
  if (gAnimRunning == 0)
    return;

  gAnimFrame = gAnimFrame + 1;

  if (gAnimFrame > gAnimEndFrame)
  {
    // 마지막 프레임 도달 → 1번 이미지(기본 주행 화면)로 고정
    gAnimFrame   = 0;
    gAnimRunning = 0;
    @Display::animFrame = gAnimFrame;
    write("[EMS] anim complete: hold frame=0");
    return;
  }

  @Display::animFrame = gAnimFrame;
  setTimer(tAnimStep, gAnimInterval);
}
// ─────────────────────────────────────────────────────────────────────

// ── 고속도로 진입 메시지 자동 복귀 (3초 후 기본 주행 화면으로) ────────
on timer tHighwayEntry
{
  if (gAnimRunning == 1)
    return;
  if ((int)@Test::testScenario > 0)
    return;  // 시나리오 모드에서는 TEST_SCN.can이 제어
  if ((int)@Core::selectedAlertLevel == 0)
  {
    @Display::animFrame = 0;  // 기본 주행 화면으로 복귀
  }
}
// ─────────────────────────────────────────────────────────────────────

// ── 경고 타입 → animFrame 매핑 (애니메이션 미재생 시에만 적용) ──────────
// 슬롯 배치: 0=기본주행, 1=경찰, 2=구급차, 3=스쿨존,
//            4=고속도로진입, 5=교차로좌, 6=합류우, 7=안전벨트,
//            8=도어열림, 9=핸들미조작, 10~39=시동애니
void updateWarningFrame()
{
  int beltWarn;
  int doorOpen;

  if (gInitDone == 0)
    return;  // 초기화 완료 전 → 이전 세션 잔류값으로 화면 변경 방지

  if (gAnimRunning == 1)
    return;  // 시동 애니메이션 재생 중이면 경고 무시 (애니메이션 우선)

  beltWarn = (int)@CoreState::seatBeltWarnLvl;
  doorOpen = (int)@Body::doorOpenCmd;

  // 수동 모드(testScenario=0): 시동 ON일 때만 경고 표시
  if ((int)@Test::testScenario == 0)
  {
    if (gEngineState == 0)
    {
      @Display::animFrame = 0;
      return;
    }
    if (doorOpen == 1)
      @Display::animFrame = 8;
    else if (beltWarn >= 2)
      @Display::animFrame = 7;
    else
      @Display::animFrame = 0;
    return;
  }

  // 시나리오 모드: 도어/안전벨트 경고 발생 시만 덮어씀
  // (그 외에는 TEST_SCN.can이 마지막에 설정한 값 유지)
  if (doorOpen == 1)
    @Display::animFrame = 8;
  else if (beltWarn >= 2)
    @Display::animFrame = 7;
}

on sysvar Core::selectedAlertType   { updateWarningFrame(); }
on sysvar Core::selectedAlertLevel  { updateWarningFrame(); }
on sysvar CoreState::seatBeltWarnLvl { updateWarningFrame(); }
on sysvar Body::doorOpenCmd
{
  // 잠금 상태에서 열기 시도 시 즉시 차단 (인터록)
  if ((int)@Body::doorLockCmd == 1 && (int)@Body::doorOpenCmd == 1)
  {
    @Body::doorOpenCmd = 0;
    return;
  }
  updateWarningFrame();
}
on sysvar Body::doorLockCmd
{
  // 잠금 전환 시 열림 상태 강제 해제
  if ((int)@Body::doorLockCmd == 1)
    @Body::doorOpenCmd = 0;
  updateWarningFrame();
}

// ── 고속도로 진입 감지 (roadZone이 2로 바뀌는 순간 → 슬롯 6 표시) ───────
on sysvar Infotainment::roadZone
{
  int zone;

  if (gAnimRunning == 1)
    return;

  // 시나리오 모드: TEST_SCN.can이 animFrame을 직접 제어하므로 개입하지 않음
  if ((int)@Test::testScenario > 0)
  {
    gLastRoadZone = (int)@Infotainment::roadZone;
    return;
  }

  zone = (int)@Infotainment::roadZone;

  if (zone == 2 && gLastRoadZone != 2
      && (int)@Core::selectedAlertLevel == 0
      && gEngineState > 0)
  {
    @Display::animFrame = 4;           // 고속도로 진입 경고
    setTimer(tHighwayEntry, 3000);     // 3초 후 기본 주행 화면으로 자동 복귀
  }

  gLastRoadZone = zone;
}
// ─────────────────────────────────────────────────────────────────────

on message frmIgnitionEngineMsg
{
  if ((int)@Test::testScenario == 0)
    return;

  gIgnitionState = this.IgnitionState;
  gEngineState   = this.EngineState;
  if (gIgnitionState < 0 || gIgnitionState > 1) gIgnitionState = 0;
  if (gEngineState   < 0 || gEngineState   > 3) gEngineState   = 0;
}

on timer tEngineCycle
{
  message frmEngineSpeedTempMsg  mSpeedTemp;
  message frmFuelBatteryStateMsg mFuelBat;
  message frmThrottleStateMsg    mThrottle;
  message frmEngineTorqueMsg     mTorque;
  message frmEngineLoadMsg       mLoad;
  message frmThermalMgmtStateMsg mThermal;
  int rpm;
  int throttlePos;
  int engineLoad;
  int torque;
  int speed;
  int transGear;

  gInitDone = 1;  // 첫 tEngineCycle 도달 → sysvar 핸들러 허용

  if ((int)@Test::testScenario == 0)
  {
    gIgnitionState = (int)@Chassis::ignitionCmd;
    gEngineState   = (gIgnitionState == 1) ? 3 : 0;
  }

  if      (gEngineState == 0) { rpm = 0; }
  else if (gEngineState == 1) { rpm = 400; }
  else if (gEngineState == 2) { rpm = 800; }
  else
  {
    speed    = (int)@Core::vehicleSpeedNorm;
    transGear = (int)@Chassis::transGear;
    if      (transGear <= 1) rpm = 800 + speed * 80;
    else if (transGear == 2) rpm = 800 + speed * 50;
    else if (transGear == 3) rpm = 800 + speed * 35;
    else if (transGear == 4) rpm = 800 + speed * 25;
    else if (transGear == 5) rpm = 800 + speed * 18;
    else                     rpm = 800 + speed * 13;
    if (rpm > 6500) rpm = 6500;
  }

  throttlePos = (gEngineState == 3) ? (int)@Core::vehicleSpeedNorm : 0;
  if (throttlePos > 100) throttlePos = 100;
  engineLoad  = (gEngineState == 3) ? (throttlePos * 8 / 10) : 0;
  if (engineLoad > 100) engineLoad = 100;
  torque      = (gEngineState == 3) ? (engineLoad * 3) : 0;
  if (torque > 300) torque = 300;

  // ── 냉각수 온도 서서히 변화 (+1°C/100ms 상승, -2°C/100ms 냉각) ──
  if (gEngineState > 0)
  {
    if (gCoolantTemp < 90) gCoolantTemp = gCoolantTemp + 1;
  }
  else
  {
    if (gCoolantTemp > 20) gCoolantTemp = gCoolantTemp - 2;
    if (gCoolantTemp < 20) gCoolantTemp = 20;
  }

  // ── 연료 게이지 서서히 변화 (+2%/100ms 상승, -3%/100ms 하강) ──
  if (gEngineState > 0)
  {
    if (gFuelDisplay < gFuelLevel) gFuelDisplay = gFuelDisplay + 2;
    if (gFuelDisplay > gFuelLevel) gFuelDisplay = gFuelLevel;
  }
  else
  {
    if (gFuelDisplay > 0) gFuelDisplay = gFuelDisplay - 3;
    if (gFuelDisplay < 0) gFuelDisplay = 0;
  }

  @Powertrain::coolantTemp = gCoolantTemp;
  @Powertrain::fuelLevel   = gFuelDisplay;

  mSpeedTemp.EngineRpm   = rpm & 0xFFFF;
  mSpeedTemp.CoolantTemp = gCoolantTemp;
  mSpeedTemp.OilTemp     = (gEngineState > 0) ? 90 : 20;
  output(mSpeedTemp);

  mFuelBat.FuelLevel     = gFuelDisplay;
  mFuelBat.BatterySoc    = gBatterySoc;
  mFuelBat.ChargingState = 0;
  output(mFuelBat);

  mThrottle.ThrottlePos = throttlePos;
  mThrottle.ThrottleReq = throttlePos;
  output(mThrottle);

  mTorque.EngineTorqueAct = torque & 0xFFFF;
  output(mTorque);

  mLoad.EngineLoad = engineLoad;
  output(mLoad);

  mThermal.ThermalMode   = (gEngineState > 0) ? 1 : 0;
  mThermal.FanDuty       = (gEngineState == 3) ? 8 : 0;
  mThermal.CoolantTarget = 90;
  output(mThermal);

  if (gEngineState != gLastEngineState)
  {
    write("[EMS] ignition=%d engine=%d rpm=%d",
          gIgnitionState, gEngineState, rpm);

    // ── 시동 ON 감지: 12번 프레임부터 애니메이션 시작 ──────────
    if (gEngineState > 0 && gLastEngineState == 0)
    {
      gAnimFrame    = 10;
      gAnimRunning  = 1;
      gAnimInterval = 4000 / (gAnimEndFrame - 10 + 1);  // 133ms
      @Display::animFrame = gAnimFrame;
      setTimer(tAnimStep, gAnimInterval);
      write("[EMS] anim start: frame=10 end=%d interval=%dms",
            gAnimEndFrame, gAnimInterval);
    }
    // ── 시동 OFF: 애니메이션 중단, 프레임 0으로 ───────
    else if (gEngineState == 0 && gLastEngineState > 0)
    {
      gAnimRunning = 0;
      cancelTimer(tAnimStep);
      cancelTimer(tHighwayEntry);
      gAnimFrame = 0;
      @Display::animFrame = 0;
      write("[EMS] anim stop: engine off");
    }
    // ─────────────────────────────────────────────────────────────

    gLastEngineState = gEngineState;
  }

  setTimer(tEngineCycle, 100);
}
