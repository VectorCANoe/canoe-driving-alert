includes
{
  #include "..\\common\\CAPL_COMMON.cin"
}

variables
{
  msTimer tDcdcCycle;
  int gBatterySoc;
  int gChargingState;
  dword gFuelBatteryRxMs;
  int gLastMode;
  int gLastVolt;
  int gLastCurr;
  int gLastInputStale;
}

on start
{
  gBatterySoc = 95;
  gChargingState = 0;
  gFuelBatteryRxMs = 0;
  gLastMode = -1;
  gLastVolt = -1;
  gLastCurr = -1;
  gLastInputStale = 1;
  setTimer(tDcdcCycle, 100);
  write("[DCDC] start");
}

on message frmFuelBatteryStateMsg
{
  gBatterySoc = clampRange((int)this.BatterySoc, 0, 100);
  gChargingState = clampRange((int)this.ChargingState, 0, 3);
  gFuelBatteryRxMs = getSimulationTimeMs();
}

on timer tDcdcCycle
{
  message frmDcdcStateMsg mDcdc;
  int driveState;
  int inputStale;
  int batterySoc;
  int chargingState;
  int dcdcMode;
  int lvOutputVolt;
  int lvOutputCurr;

  driveState = clampRange((int)@Core::driveStateNorm, 0, 3);
  inputStale = 1;
  if (gFuelBatteryRxMs != 0 &&
      (getSimulationTimeMs() - gFuelBatteryRxMs) <= 300)
  {
    inputStale = 0;
  }

  batterySoc = gBatterySoc;
  chargingState = gChargingState;
  if (inputStale == 1)
  {
    batterySoc = 50;
    chargingState = 0;
  }

  if (inputStale != gLastInputStale)
  {
    if (inputStale == 1)
    {
      write("[DCDC] fuel-battery input stale");
    }
    else
    {
      write("[DCDC] fuel-battery input restored");
    }
    gLastInputStale = inputStale;
  }

  if (chargingState == 1)
  {
    dcdcMode = 2;
  }
  else if (driveState > 0)
  {
    dcdcMode = 1;
  }
  else
  {
    dcdcMode = 0;
  }

  lvOutputVolt = (dcdcMode > 0) ? 140 : 124;
  lvOutputCurr = (dcdcMode == 2) ? 35 : ((dcdcMode == 1) ? 18 : 4);
  if (batterySoc < 40) lvOutputCurr = clampRange(lvOutputCurr + 10, 0, 255);

  mDcdc.DcdcMode = clampRange(dcdcMode, 0, 7);
  mDcdc.LvOutputVolt = clampRange(lvOutputVolt, 0, 255);
  mDcdc.LvOutputCurr = clampRange(lvOutputCurr, 0, 255);
  output(mDcdc);

  if (mDcdc.DcdcMode != gLastMode ||
      mDcdc.LvOutputVolt != gLastVolt ||
      mDcdc.LvOutputCurr != gLastCurr)
  {
    write("[DCDC] mode=%d volt=%d curr=%d soc=%d",
          mDcdc.DcdcMode,
          mDcdc.LvOutputVolt,
          mDcdc.LvOutputCurr,
          batterySoc);
    gLastMode = mDcdc.DcdcMode;
    gLastVolt = mDcdc.LvOutputVolt;
    gLastCurr = mDcdc.LvOutputCurr;
  }

  setTimer(tDcdcCycle, 100);
}

on stopMeasurement
{
  cancelTimer(tDcdcCycle);
}
