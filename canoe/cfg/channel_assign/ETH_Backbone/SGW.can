includes
{
  #include "..\\common\\CAPL_COMMON.cin"
}

variables
{
  msTimer tSgwCycle;
  int gIboxLinkMode;
  int gIboxRouteState;
  int gIboxServiceFlags;
  int gFailSafeMode;
  int gBoundaryAlive;
  int gWarningPathStatus;
  int gLastSecuritySession;
  int gLastAuthState;
  int gLastSecurityFault;
  int gLastSecurityPolicy;
}

void publishReservedDiagSecuritySeam(int securitySession, int authState, int securityFault)
{
  int securityState;
  int routeOwner;

  securityState = 0;
  if (securityFault >= 2 || gFailSafeMode >= 2)
  {
    securityState = 3;
  }
  else if (authState >= 2 && gBoundaryAlive == 1 && securityFault == 0)
  {
    securityState = 1;
  }
  else if (securitySession > 0 || authState > 0 || securityFault == 1)
  {
    securityState = 2;
  }

  routeOwner = 0;
  if (gBoundaryAlive == 1 &&
      gFailSafeMode == 0 &&
      gWarningPathStatus == 0 &&
      (gIboxRouteState > 0 || gIboxServiceFlags > 0))
  {
    routeOwner = 3;
  }
  else if (securitySession > 0 || authState > 0)
  {
    routeOwner = 2;
  }
  else if (gIboxLinkMode > 0 || gIboxRouteState > 0 || gIboxServiceFlags > 0)
  {
    routeOwner = 1;
  }

  @Diag::SecurityState = securityState;
  @Diag::RouteOwner = routeOwner;
}

void publishSecurityState()
{
  int securitySession;
  int authState;
  int keyPresence;
  int securityFault;
  int securityPolicy;
  int baseZoneContext;
  int routeActive;
  int guidedRouteActive;
  int speedLimit;
  int vehicleSpeed;
  int alertLevel;

  baseZoneContext = clampRange((int)@Core::baseZoneContext, 0, 4);
  routeActive = (baseZoneContext > 0) ? 1 : 0;
  guidedRouteActive = (baseZoneContext == 3 || baseZoneContext == 4) ? 1 : 0;
  speedLimit = clampRange((int)@Core::speedLimitNorm, 0, 255);
  vehicleSpeed = clampRange((int)@Chassis::vehicleSpeed, 0, 255);
  alertLevel = clampRange((int)@Core::selectedAlertLevel, 0, 7);
  gWarningPathStatus = clampRange((int)@CoreState::warningPathStatus, 0, 2);
  gFailSafeMode = clampRange((int)@Core::failSafeMode, 0, 2);
  gBoundaryAlive = clampRange((int)@CoreState::domainBoundaryStatus, 0, 1);

  gIboxLinkMode = 0;
  if (routeActive == 1 || alertLevel > 0)
  {
    gIboxLinkMode = 1;
  }
  if (gBoundaryAlive == 1 && routeActive == 1)
  {
    gIboxLinkMode = 2;
  }

  gIboxRouteState = 0;
  if (routeActive == 1)
  {
    gIboxRouteState = 1;
  }
  if (guidedRouteActive == 1)
  {
    gIboxRouteState = 2;
  }

  gIboxServiceFlags = 0;
  if (routeActive == 1)
  {
    gIboxServiceFlags = gIboxServiceFlags | 1;
  }
  if (alertLevel > 0)
  {
    gIboxServiceFlags = gIboxServiceFlags | 2;
  }
  if (gFailSafeMode > 0)
  {
    gIboxServiceFlags = gIboxServiceFlags | 4;
  }
  if (routeActive == 1 && speedLimit > 0 && vehicleSpeed > speedLimit)
  {
    gIboxServiceFlags = gIboxServiceFlags | 8;
  }

  securitySession = 0;
  if (gIboxLinkMode > 0)
  {
    securitySession = 1;
  }
  if (gBoundaryAlive == 1 && gIboxLinkMode >= 2)
  {
    securitySession = 2;
  }

  authState = 0;
  if (securitySession > 0)
  {
    authState = 1;
  }
  if (gFailSafeMode == 0 && gBoundaryAlive == 1)
  {
    authState = 2;
  }

  keyPresence = ((gIboxServiceFlags & 1) != 0) ? 1 : 0;

  securityFault = 0;
  if (gFailSafeMode >= 2 || gWarningPathStatus >= 2)
  {
    securityFault = 2;
  }
  else if (gFailSafeMode == 1 || gWarningPathStatus == 1)
  {
    securityFault = 1;
  }

  securityPolicy = gWarningPathStatus;
  if (securityPolicy < 0 || securityPolicy > 3)
  {
    securityPolicy = 0;
  }

  publishReservedDiagSecuritySeam(securitySession, authState, securityFault);

  if (securitySession != gLastSecuritySession ||
      authState != gLastAuthState ||
      securityFault != gLastSecurityFault ||
      securityPolicy != gLastSecurityPolicy)
  {
    write("[SGW] session=%d auth=%d key=%d fault=%d policy=%d route=%d service=0x%X",
          securitySession,
          authState,
          keyPresence,
          securityFault,
          securityPolicy,
          gIboxRouteState,
          gIboxServiceFlags);
    gLastSecuritySession = securitySession;
    gLastAuthState = authState;
    gLastSecurityFault = securityFault;
    gLastSecurityPolicy = securityPolicy;
  }
}

on start
{
  gIboxLinkMode = 0;
  gIboxRouteState = 0;
  gIboxServiceFlags = 0;
  gFailSafeMode = 1;
  gBoundaryAlive = 0;
  gWarningPathStatus = 2;
  gLastSecuritySession = -1;
  gLastAuthState = -1;
  gLastSecurityFault = -1;
  gLastSecurityPolicy = -1;
  @Diag::SecurityState = 0;
  @Diag::RouteOwner = 0;
  setTimer(tSgwCycle, 100);
  write("[SGW] start");
}

on timer tSgwCycle
{
  publishSecurityState();
  setTimer(tSgwCycle, 100);
}

on stopMeasurement
{
  cancelTimer(tSgwCycle);
}
