includes
{
}

variables
{
  msTimer tNavCycle;
}

on start
{
  setTimer(tNavCycle, 10);
  write("[NAV_CTX_MGR] start");
}

on timer tNavCycle
{
  int roadZone;
  int navDirection;
  int speedLimit;
  int baseZoneContext;

  roadZone = (int)@Infotainment::roadZone;
  navDirection = (int)@Infotainment::navDirection;
  speedLimit = (int)@Infotainment::speedLimit;

  if (speedLimit < 0 || speedLimit > 255)
  {
    speedLimit = 30;
  }
  if (speedLimit == 0)
  {
    speedLimit = 30;
  }

  baseZoneContext = 0;
  if (roadZone == 1)
  {
    baseZoneContext = 1;
  }
  else if (roadZone == 2)
  {
    baseZoneContext = 2;
  }
  else if (roadZone == 3)
  {
    if (navDirection == 1)
    {
      baseZoneContext = 3;
    }
    else if (navDirection == 2)
    {
      baseZoneContext = 4;
    }
    else
    {
      baseZoneContext = 3;
    }
  }
  else
  {
    baseZoneContext = 0;
  }

  @Core::baseZoneContext = baseZoneContext;
  @Core::speedLimitNorm = speedLimit;

  setTimer(tNavCycle, 10);
}
