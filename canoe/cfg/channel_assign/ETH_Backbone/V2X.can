includes
{
  #include "..\\common\\CAPL_COMMON.cin"
}

variables
{
  msTimer tRxCycle;
  msTimer tWatchdog;
  msTimer tTimeoutClearPulse;
  msTimer tEventTrace100;
  msTimer tTransport100;
  long gEthSocket;
  long gEthTxSocket;
  dword gEthTargetIp;
  char gEthRxBuffer[64];
  int gActiveEmergencyType;
  int gActiveEmergencyDirection;
  int gActiveEta;
  int gActiveSourceId;
  dword gActiveLastRxMs;
  int gIngressEmergencyType;
  int gIngressEmergencyDirection;
  int gIngressEta;
  int gIngressSourceId;
  int gIngressAlertState;
  int gIngressPending;
  int gLastEmergencyContext;
  int gLastTimeoutClear;
  int gLastRecordedAlertType;
  int gLastRecordedAlertLevel;
  int gLastRecordedWarningCode;
  int gPrevPoliceDispatch;
  int gPrevAmbDispatch;
  int gLastMonContext;
  int gLastMonTimeoutClear;
  int gLastTransportStatus;
  int gLastTransportType;
  int gLastTransportSourceId;
  int gLastTransportDirection;
  int gLastIngressHeartbeatSeen;
}


dword getCurrentTick32()
{
  return getSimulationTimeMs();
}

void mirrorLastEmergencyRx(dword tickValue)
{
  gActiveLastRxMs = tickValue;
  @CoreState::lastEmergencyRxMs = tickValue;
}

int getEmergencyPriorityRank(int emergencyType)
{
  if (emergencyType == 2)
  {
    return 2;
  }
  if (emergencyType == 1)
  {
    return 1;
  }
  return 0;
}

int getV2XTxPort()
{
  return ethBackbonePort() + 1;
}

dword getV2xLocalIp()
{
  return IpGetAddressAsNumber("192.168.1.9");
}

int isHigherPriority(int newType, int newEta, int newSourceId,
                     int activeType, int activeEta, int activeSourceId)
{
  int newRank;
  int activeRank;

  if (activeType == 0)
  {
    return 1;
  }
  newRank = getEmergencyPriorityRank(newType);
  activeRank = getEmergencyPriorityRank(activeType);
  if (newRank != activeRank)
  {
    return (newRank > activeRank);
  }
  if (newEta != activeEta)
  {
    return (newEta < activeEta);
  }
  return (newSourceId < activeSourceId);
}

void setTimeoutClear(int value)
{
  value = (value == 1) ? 1 : 0;
  if (value != gLastTimeoutClear)
  {
    @Core::timeoutClear = value;
    gLastTimeoutClear = value;
  }
}

void updateEmergencyContext()
{
  int contextValue;

  contextValue = gActiveEmergencyType;
  if (contextValue < 0 || contextValue > 2)
  {
    contextValue = 0;
  }

  if (contextValue != gLastEmergencyContext)
  {
    @Core::emergencyContext = contextValue;
    gLastEmergencyContext = contextValue;
  }
}

void clearEmergencyState()
{
  gActiveEmergencyType = 0;
  gActiveEmergencyDirection = 0;
  gActiveEta = 255;
  gActiveSourceId = 255;
}

void stageEmergencyIngress(int vehicleType, int status, int sourceId, int etaSec, int direction)
{
  gIngressEmergencyType = clampRange(vehicleType, 0, 2);
  gIngressEmergencyDirection = clampRange(direction, 0, 3);
  gIngressEta = clampRange(etaSec, 0, 255);
  gIngressSourceId = clampRange(sourceId, 0, 255);
  gIngressAlertState = (status == 1) ? 1 : 0;
  gIngressPending = 1;
}

void emitEmergencyBroadcast(int vehicleType, int status, int sourceId, int etaSec, int direction)
{
  char frame[8];
  long txSocket;

  txSocket = gEthTxSocket;
  if (txSocket == ethInvalidSocket())
  {
    return;
  }

  ethInitFrame(frame, ethMsgEmergencyAlert(), 4);
  ethSetU8(frame, 0,
           clampRange(vehicleType, 0, 2) |
           (clampRange(direction, 0, 3) << 2));
  ethSetU8(frame, 1, clampRange(etaSec, 0, 255));
  ethSetU8(frame, 2, clampRange(sourceId, 0, 255));
  ethSetU8(frame, 3, (status == 1) ? 1 : 0);
  ethSendFrame(txSocket, gEthTargetIp, ethMsgEmergencyAlert(), frame, 4);
}

void pushEmergencyMonitor()
{
  char frame[4];
  int emergencyContext;
  int timeoutClear;

  emergencyContext = clampRange(gLastEmergencyContext, 0, 255);
  timeoutClear = (gLastTimeoutClear == 1) ? 1 : 0;

  if (gEthTxSocket != ethInvalidSocket())
  {
    ethInitFrame(frame, ethMsgEmergencyMonitor(), 2);
    ethSetU8(frame, 0, emergencyContext);
    ethSetU8(frame, 1, timeoutClear);
    ethSendFrame(gEthTxSocket, gEthTargetIp, ethMsgEmergencyMonitor(), frame, 2);
  }

  if (emergencyContext != gLastMonContext || timeoutClear != gLastMonTimeoutClear)
  {
    write("[V2X] mon(context=%d timeoutClear=%d)", emergencyContext, timeoutClear);
    gLastMonContext = emergencyContext;
    gLastMonTimeoutClear = timeoutClear;
  }
}

void applyEmergencyIngress(int vehicleType, int status, int sourceId, int etaSec, int direction)
{
  stageEmergencyIngress(vehicleType, status, sourceId, etaSec, direction);
}

void OnUdpReceiveFrom(dword socket, long result, dword address, dword port, char buffer[], dword count)
{
  int msgId;
  int typeAndDirection;

  if (socket != gEthSocket)
  {
    return;
  }
  if (result == 0)
  {
    msgId = ethFrameMsgId(buffer, count);
    if (msgId == ethMsgEmergencyAlert() && ethFramePayloadLen(count) >= 4)
    {
      if (gEthTxSocket != ethInvalidSocket() && port == (dword)getV2XTxPort())
      {
        ethArmReceive(gEthSocket, gEthRxBuffer, elcount(gEthRxBuffer));
        return;
      }
      typeAndDirection = ethGetU8(buffer, 0);
      applyEmergencyIngress(typeAndDirection & 0x3,
                            ethGetU8(buffer, 3) & 0x1,
                            ethGetU8(buffer, 2),
                            ethGetU8(buffer, 1),
                            (typeAndDirection >> 2) & 0x3);
    }
  }

  ethArmReceive(gEthSocket, gEthRxBuffer, elcount(gEthRxBuffer));
}

void publishActiveEmergencyToV2X()
{
  @V2X::emergencyType = gActiveEmergencyType;
  @V2X::emergencyDirection = gActiveEmergencyDirection;
  @V2X::eta = gActiveEta;
  @V2X::sourceId = gActiveSourceId;
  @V2X::alertState = (gActiveEmergencyType > 0) ? 1 : 0;
}

void syncLegacyDispatchInputs()
{
  int policeDispatch;
  int ambulanceDispatch;
  int direction;
  int eta;

  policeDispatch = (((int)@V2X::policeDispatch) > 0) ? 1 : 0;
  ambulanceDispatch = (((int)@V2X::ambulanceDispatch) > 0) ? 1 : 0;
  direction = clampRange((int)@V2X::emergencyDirection, 0, 3);
  eta = clampRange((int)@V2X::eta, 0, 255);

  if (ambulanceDispatch == 1)
  {
    if (eta == 0 || eta == 255)
    {
      eta = 20;
    }
    stageEmergencyIngress(2, 1, 2, eta, direction);
  }
  else if (policeDispatch == 1)
  {
    if (eta == 0 || eta == 255)
    {
      eta = 30;
    }
    stageEmergencyIngress(1, 1, 1, eta, direction);
  }
  else if (gPrevAmbDispatch == 1)
  {
    stageEmergencyIngress(2, 0, 2, 0, gActiveEmergencyDirection);
  }
  else if (gPrevPoliceDispatch == 1)
  {
    stageEmergencyIngress(1, 0, 1, 0, gActiveEmergencyDirection);
  }

  gPrevPoliceDispatch = policeDispatch;
  gPrevAmbDispatch = ambulanceDispatch;
}

void publishTransportFrames()
{
  int txStatus;
  int txType;
  int txSourceId;
  int txEta;
  int txDirection;

  txStatus = (gActiveEmergencyType > 0) ? 1 : 0;
  txType = clampRange(gActiveEmergencyType, 0, 2);
  txSourceId = clampRange(gActiveSourceId, 0, 255);
  txEta = clampRange(gActiveEta, 0, 255);
  txDirection = clampRange(gActiveEmergencyDirection, 0, 3);

  if (txStatus == 1)
  {
    emitEmergencyBroadcast(txType, 1, txSourceId, txEta, txDirection);
    gLastTransportStatus = 1;
    gLastTransportType = txType;
    gLastTransportSourceId = txSourceId;
    gLastTransportDirection = txDirection;
  }
  else if (gLastTransportStatus == 1)
  {
    emitEmergencyBroadcast(clampRange(gLastTransportType, 1, 2),
                           0,
                           clampRange(gLastTransportSourceId, 0, 255),
                           0,
                           clampRange(gLastTransportDirection, 0, 3));
    gLastTransportStatus = 0;
  }

  pushEmergencyMonitor();
}

void recordAlertEvent()
{
  int alertType;
  int alertLevel;
  int warningCode;
  int eventPhase;
  int alertSnapshotId;

  alertType = clampRange((int)@Core::selectedAlertType, 0, 15);
  alertLevel = clampRange((int)@Core::selectedAlertLevel, 0, 7);
  alertSnapshotId = clampRange((int)@CoreState::arbitrationSnapshotId, 0, 65535);
  warningCode = clampRange((int)@Cluster::warningTextCode, 0, 255);
  eventPhase = 0;

  if (alertLevel > 0 && gLastRecordedAlertLevel == 0)
  {
    eventPhase = 1;
  }
  else if (alertLevel == 0 && gLastRecordedAlertLevel > 0)
  {
    eventPhase = 2;
  }
  else if (alertType != gLastRecordedAlertType ||
           alertLevel != gLastRecordedAlertLevel ||
           warningCode != gLastRecordedWarningCode)
  {
    eventPhase = 3;
  }

  if (eventPhase != 0)
  {
    @CoreState::lastAlertEventType = alertType;
    @CoreState::lastAlertEventLevel = alertLevel;
    @CoreState::lastAlertEventCode = warningCode;
    @CoreState::lastAlertEventPhase = eventPhase;
    write("[EMS_ALERT] event phase=%d type=%d level=%d code=%d snap=%d",
          eventPhase, alertType, alertLevel, warningCode,
          alertSnapshotId);
    gLastRecordedAlertType = alertType;
    gLastRecordedAlertLevel = alertLevel;
    gLastRecordedWarningCode = warningCode;
  }
}

on start
{
  gEthSocket = ethOpenDefaultSocket();
  gEthTxSocket = ethOpenNodeSocketAt(getV2xLocalIp(), getV2XTxPort());
  gEthTargetIp = ethGetDefaultIpAddress();
  clearEmergencyState();
  gActiveLastRxMs = 0;
  gIngressEmergencyType = 0;
  gIngressEmergencyDirection = 0;
  gIngressEta = 255;
  gIngressSourceId = 255;
  gIngressAlertState = 0;
  gIngressPending = 0;
  @CoreState::lastEmergencyRxMs = 0;
  gLastEmergencyContext = -1;
  gLastTimeoutClear = -1;
  gLastRecordedAlertType = -1;
  gLastRecordedAlertLevel = -1;
  gLastRecordedWarningCode = -1;
  gPrevPoliceDispatch = 0;
  gPrevAmbDispatch = 0;
  gLastMonContext = -1;
  gLastMonTimeoutClear = -1;
  gLastTransportStatus = 0;
  gLastTransportType = 0;
  gLastTransportSourceId = 0;
  gLastTransportDirection = 0;
  gLastIngressHeartbeatSeen = 0;
  if (gEthTxSocket == ethInvalidSocket())
  {
    write("[V2X] tx socket unavailable");
  }
  publishActiveEmergencyToV2X();
  updateEmergencyContext();
  setTimeoutClear(0);
  if (gEthSocket != ethInvalidSocket())
  {
    ethStartReceiver(gEthSocket, gEthRxBuffer, elcount(gEthRxBuffer));
  }
  setTimer(tRxCycle, 10);
  setTimer(tWatchdog, 1000);
  setTimer(tEventTrace100, 100);
  setTimer(tTransport100, 100);
  write("[V2X] start");
}

/* Legacy panel compat: dispatch-level sysvar inputs only.
   Native verification and runtime ingress use transport frames. */
on timer tRxCycle
{
  dword nowMs;
  int accepted;
  int hasIngressEvent;
  int emergencyType;
  int emergencyDirection;
  int eta;
  int sourceId;
  int alertState;

  syncLegacyDispatchInputs();
  nowMs              = getCurrentTick32();
  accepted           = 0;
  hasIngressEvent    = 0;

  emergencyType = 0;
  emergencyDirection = 0;
  eta = 255;
  sourceId = 255;
  alertState = 0;
  if (gIngressPending == 1)
  {
    emergencyType = gIngressEmergencyType;
    emergencyDirection = gIngressEmergencyDirection;
    eta = gIngressEta;
    sourceId = gIngressSourceId;
    alertState = gIngressAlertState;
    gIngressPending = 0;
    hasIngressEvent = 1;
  }

  if (hasIngressEvent == 1 && alertState == 1 &&
      (emergencyType == 1 || emergencyType == 2))
  {
    if (isHigherPriority(emergencyType, eta, sourceId,
                         gActiveEmergencyType, gActiveEta, gActiveSourceId))
    {
      gActiveEmergencyType      = emergencyType;
      gActiveEmergencyDirection = emergencyDirection;
      gActiveEta                = eta;
      gActiveSourceId           = sourceId;
      accepted = 1;
    }
    else if (emergencyType == gActiveEmergencyType &&
             sourceId == gActiveSourceId)
    {
      gActiveEmergencyDirection = emergencyDirection;
      gActiveEta                = eta;
      accepted = 1;
    }

    if (accepted == 1)
    {
      mirrorLastEmergencyRx(nowMs);
      publishActiveEmergencyToV2X();
      setTimeoutClear(0);
      setTimer(tWatchdog, 1000);
    }
  }
  else if (hasIngressEvent == 1 && alertState == 0)
  {
    if (gActiveEmergencyType != 0 &&
        emergencyType == gActiveEmergencyType &&
        sourceId == gActiveSourceId)
    {
      clearEmergencyState();
      publishActiveEmergencyToV2X();
      updateEmergencyContext();
    }
  }

  updateEmergencyContext();
  setTimer(tRxCycle, 10);
}

on timer tWatchdog
{
  dword nowMs;

  nowMs = getCurrentTick32();
  if (gActiveEmergencyType != 0 && (nowMs - gActiveLastRxMs) >= 1000)
  {
    clearEmergencyState();
    publishActiveEmergencyToV2X();
    updateEmergencyContext();
    setTimeoutClear(1);
    setTimer(tTimeoutClearPulse, 200);
    write("[V2X] watchdog clear");
  }
  setTimer(tWatchdog, 1000);
}

on timer tTimeoutClearPulse
{
  setTimeoutClear(0);
}

on timer tEventTrace100
{
  recordAlertEvent();
  setTimer(tEventTrace100, 100);
}

on timer tTransport100
{
  publishTransportFrames();
  setTimer(tTransport100, 100);
}

on stopMeasurement
{
  cancelTimer(tRxCycle);
  cancelTimer(tWatchdog);
  cancelTimer(tTimeoutClearPulse);
  cancelTimer(tEventTrace100);
  cancelTimer(tTransport100);
  ethCloseSocket(gEthTxSocket);
  gEthTxSocket = ethInvalidSocket();
  ethCloseSocket(gEthSocket);
  gEthSocket = ethInvalidSocket();
}
