includes
{
  #include "..\\common\\CAPL_COMMON.cin"
}

variables
{
  msTimer tRxCycle;
  msTimer tWatchdog;
  msTimer tTimeoutClearPulse;
  msTimer tEventTrace100;
  msTimer tTransport100;
  long gEthSocket;
  dword gEthTargetIp;
  char gEthRxBuffer[64];
  int gActiveEmergencyType;
  int gActiveEmergencyDirection;
  int gActiveEta;
  int gActiveSourceId;
  dword gActiveLastRxMs;
  int gLastEmergencyContext;
  int gLastTimeoutClear;
  int gLastRecordedAlertType;
  int gLastRecordedAlertLevel;
  int gLastRecordedWarningCode;
  int gPrevPoliceDispatch;
  int gPrevAmbDispatch;
  int gLastMonContext;
  int gLastMonTimeoutClear;
  int gLastTransportStatus;
  int gLastTransportType;
  int gLastTransportSourceId;
  int gLastTransportDirection;
}


dword getCurrentTick32()
{
  return getSimulationTimeMs();
}

void mirrorLastEmergencyRx(dword tickValue)
{
  gActiveLastRxMs = tickValue;
  @CoreState::lastEmergencyRxMs = tickValue;
}

int isHigherPriority(int newType, int newEta, int newSourceId,
                     int activeType, int activeEta, int activeSourceId)
{
  // Prefer the new event if no active emergency is present.
  if (activeType == 0)
  {
    return 1;
  }
  // If vehicle types differ, select the higher-priority type.
  if (newType != activeType)
  {
    return (newType > activeType);
  }
  // If types match, select the event with the shorter ETA.
  if (newEta != activeEta)
  {
    return (newEta < activeEta);
  }
  // Use sourceId as the final stable tie-breaker.
  return (newSourceId < activeSourceId);
}

void setTimeoutClear(int value)
{
  // Update Core timeoutClear only when the value changes.
  if (value != gLastTimeoutClear)
  {
    @Core::timeoutClear = value;
    gLastTimeoutClear = value;
  }
}

void updateEmergencyContext()
{
  int contextValue;

  // Normalize the active emergency type into emergencyContext.
  contextValue = gActiveEmergencyType;
  if (contextValue < 0 || contextValue > 2)
  {
    contextValue = 0;
  }

  // Reflect the context into Core only when it changes.
  if (contextValue != gLastEmergencyContext)
  {
    @Core::emergencyContext = contextValue;
    gLastEmergencyContext = contextValue;
  }
}

void clearEmergencyState()
{
  // Reset the active emergency state to its defaults.
  gActiveEmergencyType = 0;
  gActiveEmergencyDirection = 0;
  gActiveEta = 255;
  gActiveSourceId = 255;
}

void emitEmergencyBroadcast(int vehicleType, int status, int sourceId, int etaSec, int direction)
{
  char frame[8];

  if (gEthSocket == ethInvalidSocket())
  {
    return;
  }

  ethInitFrame(frame, ethMsgEmergencyAlert(), 4);
  ethSetU8(frame, 0,
           clampRange(vehicleType, 0, 2) |
           (clampRange(direction, 0, 3) << 2));
  ethSetU8(frame, 1, clampRange(etaSec, 0, 255));
  ethSetU8(frame, 2, clampRange(sourceId, 0, 255));
  ethSetU8(frame, 3, (status == 1) ? 1 : 0);
  ethSendFrame(gEthSocket, gEthTargetIp, ethMsgEmergencyAlert(), frame, 4);
}

void pushEmergencyMonitor()
{
  char frame[4];
  int emergencyContext;
  int timeoutClear;

  // Read the current context and timeout state for monitoring.
  emergencyContext = clampRange((int)@Core::emergencyContext, 0, 255);
  timeoutClear = (((int)@Core::timeoutClear) == 1) ? 1 : 0;
  @CoreState::lastEmergencyRxMs = getCurrentTick32();

  if (gEthSocket != ethInvalidSocket())
  {
    ethInitFrame(frame, ethMsgEmergencyMonitor(), 2);
    ethSetU8(frame, 0, emergencyContext);
    ethSetU8(frame, 1, timeoutClear);
    ethSendFrame(gEthSocket, gEthTargetIp, ethMsgEmergencyMonitor(), frame, 2);
  }

  // Log only when monitored values change.
  if (emergencyContext != gLastMonContext || timeoutClear != gLastMonTimeoutClear)
  {
    write("[V2X] mon(context=%d timeoutClear=%d)", emergencyContext, timeoutClear);
    gLastMonContext = emergencyContext;
    gLastMonTimeoutClear = timeoutClear;
  }
}

void applyEmergencyIngress(int vehicleType, int status, int sourceId, int etaSec, int direction)
{
  if (status == 1 && (vehicleType == 1 || vehicleType == 2))
  {
    @V2X::emergencyType = vehicleType;
    @V2X::emergencyDirection = direction;
    @V2X::eta = etaSec;
    @V2X::sourceId = sourceId;
    @V2X::alertState = 1;
  }
  else if (status == 0)
  {
    @V2X::alertState = 0;
  }
}

void OnUdpReceiveFrom(dword socket, long result, dword address, dword port, char buffer[], dword count)
{
  int msgId;
  int typeAndDirection;

  if (socket != gEthSocket)
  {
    return;
  }
  if (result == 0)
  {
    msgId = ethFrameMsgId(buffer, count);
    if (msgId == ethMsgEmergencyAlert() && ethFramePayloadLen(count) >= 4)
    {
      typeAndDirection = ethGetU8(buffer, 0);
      applyEmergencyIngress(typeAndDirection & 0x3,
                            ethGetU8(buffer, 3) & 0x1,
                            ethGetU8(buffer, 2),
                            ethGetU8(buffer, 1),
                            (typeAndDirection >> 2) & 0x3);
    }
  }

  ethArmReceive(gEthSocket, gEthRxBuffer, elcount(gEthRxBuffer));
}

void publishActiveEmergencyToV2X()
{
  // Mirror the selected active emergency into V2X sysvars.
  @V2X::emergencyType = gActiveEmergencyType;
  @V2X::emergencyDirection = gActiveEmergencyDirection;
  @V2X::eta = gActiveEta;
  @V2X::sourceId = gActiveSourceId;
  @V2X::alertState = (gActiveEmergencyType > 0) ? 1 : 0;
}

void syncLegacyDispatchInputs()
{
  int policeDispatch;
  int ambulanceDispatch;
  int direction;
  int eta;

  policeDispatch = (((int)@V2X::policeDispatch) > 0) ? 1 : 0;
  ambulanceDispatch = (((int)@V2X::ambulanceDispatch) > 0) ? 1 : 0;
  direction = clampRange((int)@V2X::emergencyDirection, 0, 3);
  eta = clampRange((int)@V2X::eta, 0, 255);

  if (ambulanceDispatch == 1)
  {
    if (eta == 0 || eta == 255)
    {
      eta = 20;
    }
    @V2X::emergencyType = 2;
    @V2X::emergencyDirection = direction;
    @V2X::eta = eta;
    @V2X::sourceId = 2;
    @V2X::alertState = 1;
  }
  else if (policeDispatch == 1)
  {
    if (eta == 0 || eta == 255)
    {
      eta = 30;
    }
    @V2X::emergencyType = 1;
    @V2X::emergencyDirection = direction;
    @V2X::eta = eta;
    @V2X::sourceId = 1;
    @V2X::alertState = 1;
  }
  else if ((gPrevAmbDispatch == 1 && (int)@V2X::sourceId == 2) ||
           (gPrevPoliceDispatch == 1 && (int)@V2X::sourceId == 1))
  {
    @V2X::alertState = 0;
  }

  gPrevPoliceDispatch = policeDispatch;
  gPrevAmbDispatch = ambulanceDispatch;
}

void publishTransportFrames()
{
  int txStatus;
  int txType;
  int txSourceId;
  int txEta;
  int txDirection;

  txStatus = (gActiveEmergencyType > 0) ? 1 : 0;
  txType = clampRange(gActiveEmergencyType, 0, 2);
  txSourceId = clampRange(gActiveSourceId, 0, 255);
  txEta = clampRange(gActiveEta, 0, 255);
  txDirection = clampRange(gActiveEmergencyDirection, 0, 3);

  if (txStatus == 1)
  {
    emitEmergencyBroadcast(txType, 1, txSourceId, txEta, txDirection);
    gLastTransportStatus = 1;
    gLastTransportType = txType;
    gLastTransportSourceId = txSourceId;
    gLastTransportDirection = txDirection;
  }
  else if (gLastTransportStatus == 1)
  {
    emitEmergencyBroadcast(clampRange(gLastTransportType, 1, 2),
                           0,
                           clampRange(gLastTransportSourceId, 0, 255),
                           0,
                           clampRange(gLastTransportDirection, 0, 3));
    gLastTransportStatus = 0;
  }

  pushEmergencyMonitor();
}

void recordAlertEvent()
{
  int alertType;
  int alertLevel;
  int warningCode;
  int eventPhase;

  // Normalize the current arbitration result and warning code for logging.
  alertType = clampRange((int)@Core::selectedAlertType, 0, 15);
  alertLevel = clampRange((int)@Core::selectedAlertLevel, 0, 7);
  warningCode = clampRange((int)@Cluster::warningTextCode, 0, 255);
  eventPhase = 0;

  // Classify the alert as start, end, or change.
  if (alertLevel > 0 && gLastRecordedAlertLevel == 0)
  {
    eventPhase = 1;
  }
  else if (alertLevel == 0 && gLastRecordedAlertLevel > 0)
  {
    eventPhase = 2;
  }
  else if (alertType != gLastRecordedAlertType ||
           alertLevel != gLastRecordedAlertLevel ||
           warningCode != gLastRecordedWarningCode)
  {
    eventPhase = 3;
  }

  // Update CoreState and logs only when an event is detected.
  if (eventPhase != 0)
  {
    @CoreState::lastAlertEventType = alertType;
    @CoreState::lastAlertEventLevel = alertLevel;
    @CoreState::lastAlertEventCode = warningCode;
    @CoreState::lastAlertEventPhase = eventPhase;
    write("[EMS_ALERT] event phase=%d type=%d level=%d code=%d snap=%d",
          eventPhase, alertType, alertLevel, warningCode,
          (int)@CoreState::arbitrationSnapshotId);
    gLastRecordedAlertType = alertType;
    gLastRecordedAlertLevel = alertLevel;
    gLastRecordedWarningCode = warningCode;
  }
}

on start
{
  gEthSocket = ethOpenDefaultSocket();
  gEthTargetIp = ethGetDefaultIpAddress();
  clearEmergencyState();
  gActiveLastRxMs = 0;
  @CoreState::lastEmergencyRxMs = 0;
  gLastEmergencyContext = -1;
  gLastTimeoutClear = -1;
  gLastRecordedAlertType = -1;
  gLastRecordedAlertLevel = -1;
  gLastRecordedWarningCode = -1;
  gPrevPoliceDispatch = 0;
  gPrevAmbDispatch = 0;
  gLastMonContext = -1;
  gLastMonTimeoutClear = -1;
  gLastTransportStatus = 0;
  gLastTransportType = 0;
  gLastTransportSourceId = 0;
  gLastTransportDirection = 0;
  updateEmergencyContext();
  setTimeoutClear(0);
  if (gEthSocket != ethInvalidSocket())
  {
    ethStartReceiver(gEthSocket, gEthRxBuffer, elcount(gEthRxBuffer));
  }
  setTimer(tRxCycle, 10);
  setTimer(tWatchdog, 1000);
  setTimer(tEventTrace100, 100);
  setTimer(tTransport100, 100);
  write("[V2X] start");
}

/* v1 fallback: sysvar polling (panel/legacy compat, kept for backward compat) */
on timer tRxCycle
{
  int emergencyType;
  int emergencyDirection;
  int eta;
  int sourceId;
  int alertState;
  dword nowMs;
  int accepted;

  syncLegacyDispatchInputs();
  emergencyType      = clampRange((int)@V2X::emergencyType, 0, 2);
  emergencyDirection = clampRange((int)@V2X::emergencyDirection, 0, 3);
  eta                = clampRange((int)@V2X::eta, 0, 255);
  sourceId           = clampRange((int)@V2X::sourceId, 0, 255);
  alertState         = (((int)@V2X::alertState) == 1) ? 1 : 0;
  nowMs              = getCurrentTick32();
  accepted           = 0;

  // For a valid emergency event, compare priority and update the active state.
  if (alertState == 1 && (emergencyType == 1 || emergencyType == 2))
  {
    if (isHigherPriority(emergencyType, eta, sourceId,
                         gActiveEmergencyType, gActiveEta, gActiveSourceId))
    {
      gActiveEmergencyType      = emergencyType;
      gActiveEmergencyDirection = emergencyDirection;
      gActiveEta                = eta;
      gActiveSourceId           = sourceId;
      accepted = 1;
    }
    else if (emergencyType == gActiveEmergencyType &&
             sourceId == gActiveSourceId)
    {
      gActiveEmergencyDirection = emergencyDirection;
      gActiveEta                = eta;
      accepted = 1;
    }

    // If the event is accepted, refresh the receive timestamp and watchdog.
    if (accepted == 1)
    {
      mirrorLastEmergencyRx(nowMs);
      publishActiveEmergencyToV2X();
      setTimeoutClear(0);
      setTimer(tWatchdog, 1000);
    }
  }
  else
  {
    // Clear the active state when the valid event disappears.
    if (gActiveEmergencyType != 0)
    {
      clearEmergencyState();
      publishActiveEmergencyToV2X();
      updateEmergencyContext();
    }
  }

  // Sync the context and reschedule polling for the next cycle.
  updateEmergencyContext();
  setTimer(tRxCycle, 10);
}

on timer tWatchdog
{
  dword nowMs;

  nowMs = getCurrentTick32();
  if (gActiveEmergencyType != 0 && (nowMs - gActiveLastRxMs) >= 1000)
  {
    clearEmergencyState();
    publishActiveEmergencyToV2X();
    updateEmergencyContext();
    setTimeoutClear(1);
    setTimer(tTimeoutClearPulse, 200);
    write("[V2X] watchdog clear");
  }
  setTimer(tWatchdog, 1000);
}

on timer tTimeoutClearPulse
{
  setTimeoutClear(0);
}

on timer tEventTrace100
{
  recordAlertEvent();
  setTimer(tEventTrace100, 100);
}

on timer tTransport100
{
  publishTransportFrames();
  setTimer(tTransport100, 100);
}

on stopMeasurement
{
  cancelTimer(tRxCycle);
  cancelTimer(tWatchdog);
  cancelTimer(tTimeoutClearPulse);
  cancelTimer(tEventTrace100);
  cancelTimer(tTransport100);
  ethCloseSocket(gEthSocket);
  gEthSocket = ethInvalidSocket();
}
