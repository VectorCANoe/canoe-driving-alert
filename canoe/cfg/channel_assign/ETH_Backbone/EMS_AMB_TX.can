includes
{
}

variables
{
}

on start
{
  write("[EMS_AMB_TX] absorbed into V2X runtime; wrapper only");
}
