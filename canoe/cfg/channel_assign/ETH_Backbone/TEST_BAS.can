includes
{
  #include "..\\common\\CAPL_COMMON.cin"
}

variables
{
  long gEthSocket;
  char gEthRxBuffer[64];
  int gLastBaseScenarioId;
  int gBaseScenarioResult;
  int gFlowCoverage;
  int gTestHealth;
  int gTraceSnapshotId;
  int gBoundaryStatus;
  int gE2eHealthState;
  int gFailSafeMode;
  int gEmergencyContext;
  int gLastSelectedAlertLevel;
  int gLastSelectedAlertType;
  dword gFailSafeRxMs;
  dword gEmergencyMonRxMs;
}

int resolveBaseScenarioId()
{
  int scenarioId;

  scenarioId = clampRange((int)@Test::testScenario, 0, 255);
  if (scenarioId == 0)
  {
    scenarioId = clampRange((int)@Test::scenarioCommandAck, 0, 255);
  }
  if (scenarioId == 0)
  {
    scenarioId = gLastBaseScenarioId + 1;
    if (scenarioId > 255)
    {
      scenarioId = 1;
    }
  }
  return scenarioId;
}

int resolveTestHealth()
{
  int boundaryHealthy;
  int e2eHealthState;

  if (ethIsRecentTick(gFailSafeRxMs, 300) == 1)
  {
    boundaryHealthy = clampRange(gBoundaryStatus, 0, 1);
    e2eHealthState = clampRange(gE2eHealthState, 0, 2);
  }
  else
  {
    boundaryHealthy = 0;
    e2eHealthState = 0;
  }

  if (boundaryHealthy == 1 && e2eHealthState == 2)
  {
    return 0xFF;
  }
  if (boundaryHealthy == 1 || e2eHealthState >= 1)
  {
    return 0x80;
  }
  return 0x40;
}

int resolveFlowCoverageMask(int pass)
{
  int routingPolicy;

  if (pass == 1)
  {
    return 0x7FFF;
  }

  routingPolicy = 0;
  if (ethIsRecentTick(gFailSafeRxMs, 300) == 1)
  {
    if (gFailSafeMode > 0)
    {
      routingPolicy = 0;
    }
    else if (ethIsRecentTick(gEmergencyMonRxMs, 300) == 1 &&
             gEmergencyContext > 0)
    {
      routingPolicy = 2;
    }
    else
    {
      routingPolicy = 1;
    }
  }

  return clampRange(routingPolicy, 0, 7) << 12;
}

void clearBaseResultState()
{
  gLastBaseScenarioId  = 0;
  gBaseScenarioResult  = 0;
  gFlowCoverage        = 0;
  gTestHealth          = 0;
  gTraceSnapshotId     = 0;
  gBoundaryStatus      = 0;
  gE2eHealthState      = 0;
  gFailSafeMode        = 2;
  gEmergencyContext    = 0;
  gLastSelectedAlertLevel = 0;
  gLastSelectedAlertType = 0;
  gFailSafeRxMs        = 0;
  gEmergencyMonRxMs    = 0;

  @Test::baseScenarioId       = 0;
  @Test::baseScenarioResult   = 0;
  @Test::baseFlowCoverageMask = 0;
  @Test::baseTraceSnapshotId  = 0;
  @Test::baseTestHealth       = 0;
}

void publishBaseResultState(int pass)
{
  gBaseScenarioResult  = clampRange(pass, 0, 1);
  gTestHealth          = resolveTestHealth();
  gFlowCoverage        = resolveFlowCoverageMask(gBaseScenarioResult);
  gLastBaseScenarioId  = resolveBaseScenarioId();

  @Test::baseScenarioId       = gLastBaseScenarioId & 0xFF;
  @Test::baseScenarioResult   = gBaseScenarioResult & 0x1;
  @Test::baseFlowCoverageMask = gFlowCoverage & 0x7FFF;
  @Test::baseTraceSnapshotId  = gTraceSnapshotId & 0xFFFF;
  @Test::baseTestHealth       = gTestHealth & 0xFF;

  write("[TEST_BAS] scenario id=%d result=%d health=%d",
        gLastBaseScenarioId, gBaseScenarioResult, gTestHealth);
}

on start
{
  gEthSocket = ethOpenDefaultSocket();
  clearBaseResultState();
  if (gEthSocket != ethInvalidSocket())
  {
    ethStartReceiver(gEthSocket, gEthRxBuffer, elcount(gEthRxBuffer));
  }
  write("[TEST_BAS] start");
}

void OnUdpReceiveFrom(dword socket, long result, dword address, dword port, char buffer[], dword count)
{
  int msgId;
  int payload0;

  if (socket != gEthSocket)
  {
    return;
  }

  if (result == 0)
  {
    msgId = ethFrameMsgId(buffer, count);
    if (msgId == ethMsgFailSafe() && ethFramePayloadLen(count) >= 1)
    {
      payload0 = ethGetU8(buffer, 0);
      gBoundaryStatus = clampRange((payload0 >> 6) & 0x1, 0, 1);
      gE2eHealthState = clampRange((payload0 >> 2) & 0x3, 0, 2);
      gFailSafeMode = clampRange((payload0 >> 4) & 0x3, 0, 2);
      gFailSafeRxMs = getSimulationTimeMs();
    }
    else if (msgId == ethMsgEmergencyMonitor() && ethFramePayloadLen(count) >= 1)
    {
      gEmergencyContext = clampRange(ethGetU8(buffer, 0), 0, 2);
      gEmergencyMonRxMs = getSimulationTimeMs();
    }
    else if (msgId == ethMsgSelectedAlert() && ethFramePayloadLen(count) >= 1)
    {
      payload0 = ethGetU8(buffer, 0);
      if ((payload0 & 0x7) != gLastSelectedAlertLevel ||
          ((payload0 >> 3) & 0x7) != gLastSelectedAlertType)
      {
        gTraceSnapshotId = (gTraceSnapshotId + 1) & 0xFFFF;
        @Test::baseTraceSnapshotId = gTraceSnapshotId & 0xFFFF;
      }
      gLastSelectedAlertLevel = clampRange(payload0 & 0x7, 0, 7);
      gLastSelectedAlertType = clampRange((payload0 >> 3) & 0x7, 0, 7);
    }
  }

  ethArmReceive(gEthSocket, gEthRxBuffer, elcount(gEthRxBuffer));
}

on sysvar Test::scenarioResult
{
  publishBaseResultState((int)@Test::scenarioResult);
}

on sysvar Test::scenarioCommandAck
{
  if ((int)@Test::scenarioCommandAck == 0)
  {
    clearBaseResultState();
  }
}

on stopMeasurement
{
  ethCloseSocket(gEthSocket);
  gEthSocket = ethInvalidSocket();
}
