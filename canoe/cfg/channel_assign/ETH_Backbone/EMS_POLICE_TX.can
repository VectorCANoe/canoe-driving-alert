includes
{
}

variables
{
}

on start
{
  write("[EMS_POLICE_TX] absorbed into V2X runtime; wrapper only");
}
