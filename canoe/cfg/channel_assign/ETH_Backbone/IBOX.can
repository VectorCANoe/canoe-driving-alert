includes
{
  #include "..\\common\\CAPL_COMMON.cin"
}

variables
{
  msTimer tIboxCycle;
  long gEthSocket;
  char gEthRxBuffer[64];
  dword gVehTsMs;
  dword gNavTsMs;
  int gDriveState;
  int gVehicleSpeed;
  int gRoadZone;
  int gNavDirection;
  int gZoneDistance;
  int gSpeedLimit;
  int gAlertLevel;
  int gWarningPathStatus;
  int gFailSafeMode;
  int gLastVehInputStale;
  int gLastNavInputStale;
  int gLastLinkMode;
  int gLastRouteState;
  int gLastServiceFlags;
  dword gAlertTsMs;
  dword gFailSafeTsMs;
}

void traceIboxInputHealth(int vehInputStale, int navInputStale)
{
  if (vehInputStale != gLastVehInputStale)
  {
    if (vehInputStale == 1)
    {
      write("[IBOX] vehicle input stale");
    }
    else
    {
      write("[IBOX] vehicle input restored");
    }
    gLastVehInputStale = vehInputStale;
  }

  if (navInputStale != gLastNavInputStale)
  {
    if (navInputStale == 1)
    {
      write("[IBOX] nav input stale");
    }
    else
    {
      write("[IBOX] nav input restored");
    }
    gLastNavInputStale = navInputStale;
  }
}

void publishIboxState()
{
  int diagStage;
  dword nowMs;
  int vehAgeMs;
  int navAgeMs;
  int boundaryAlive;
  int routeActive;
  int serviceContext;
  int vehInputStale;
  int navInputStale;
  int vehicleFresh;
  int navFresh;
  int vehicleLinkActive;
  int navLinkActive;
  int vehicleSpeed;
  int roadZone;
  int navDirection;
  int zoneDistance;
  int speedLimit;
  int linkMode;
  int routeState;
  int serviceFlags;
  int failSafeMode;
  int alertLevel;
  int signalBars;

  nowMs = getSimulationTimeMs();
  vehAgeMs = (gVehTsMs == 0) ? 60000 : clampRange((int)(nowMs - gVehTsMs), 0, 60000);
  navAgeMs = (gNavTsMs == 0) ? 60000 : clampRange((int)(nowMs - gNavTsMs), 0, 60000);
  vehInputStale = (vehAgeMs <= 1000) ? 0 : 1;
  navInputStale = (navAgeMs <= 1000) ? 0 : 1;
  traceIboxInputHealth(vehInputStale, navInputStale);

  vehicleFresh = (vehAgeMs <= 300) ? 1 : 0;
  navFresh = (navAgeMs <= 300) ? 1 : 0;
  vehicleLinkActive = (vehAgeMs <= 1000) ? 1 : 0;
  navLinkActive = (navAgeMs <= 1000) ? 1 : 0;
  vehicleSpeed = vehicleFresh == 1 ? gVehicleSpeed : 0;
  roadZone = navLinkActive == 1 ? gRoadZone : 0;
  navDirection = navFresh == 1 ? gNavDirection : 0;
  zoneDistance = navFresh == 1 ? gZoneDistance : 0;
  speedLimit = navFresh == 1 ? gSpeedLimit : 0;
  failSafeMode = (ethIsRecentTick(gFailSafeTsMs, 300) == 1) ? gFailSafeMode : 2;
  alertLevel = (ethIsRecentTick(gAlertTsMs, 300) == 1) ? gAlertLevel : 0;
  boundaryAlive = (ethIsRecentTick(gFailSafeTsMs, 300) == 1) ? 1 : 0;
  routeActive = (roadZone > 0) ? 1 : 0;
  serviceContext = ethHasBoundaryServiceContext(routeActive, alertLevel);
  diagStage = ethDiagBoundaryStage(routeActive,
                                   alertLevel,
                                   boundaryAlive,
                                   gWarningPathStatus,
                                   failSafeMode);

  linkMode = 0;
  if (serviceContext == 1 || vehicleLinkActive == 1 || navLinkActive == 1)
  {
    linkMode = 1;
  }
  if (diagStage == 1 && vehicleFresh == 1 && navFresh == 1 && routeActive == 1)
  {
    linkMode = 2;
  }

  routeState = 0;
  if (roadZone > 0 && navLinkActive == 1)
  {
    routeState = 1;
  }
  if (navDirection > 0 && zoneDistance > 0 && navFresh == 1)
  {
    routeState = 2;
  }

  serviceFlags = 0;
  if (roadZone > 0)
  {
    serviceFlags = serviceFlags | 1;
  }
  if (alertLevel > 0)
  {
    serviceFlags = serviceFlags | 2;
  }
  if (diagStage >= 2)
  {
    serviceFlags = serviceFlags | 4;
  }
  if (diagStage == 1 &&
      vehicleFresh == 1 && navFresh == 1 &&
      vehicleSpeed > speedLimit && speedLimit > 0)
  {
    serviceFlags = serviceFlags | 8;
  }

  signalBars = 0;
  if (serviceContext == 1 || vehicleLinkActive == 1 || navLinkActive == 1)
  {
    signalBars = 1;
  }
  if (diagStage == 2 && signalBars < 3)
  {
    signalBars = 3;
  }
  if (diagStage == 1)
  {
    signalBars = 4;
  }

  if (vehAgeMs > 1000 || navAgeMs > 1000)
  {
    signalBars = 1;
  }
  else if ((vehAgeMs > 300 || navAgeMs > 300) && signalBars > 3)
  {
    signalBars = 3;
  }
  if (routeState == 0 && signalBars > 1)
  {
    signalBars = signalBars - 1;
  }

  if (linkMode != gLastLinkMode ||
      routeState != gLastRouteState ||
      serviceFlags != gLastServiceFlags)
  {
    write("[IBOX] link=%d route=%d bars=%d service=0x%X",
          linkMode, routeState, signalBars, serviceFlags);
    gLastLinkMode = linkMode;
    gLastRouteState = routeState;
    gLastServiceFlags = serviceFlags;
  }
}

void OnUdpReceiveFrom(dword socket, long result, dword address, dword port, char buffer[], dword count)
{
  int msgId;
  int payload0;

  if (socket != gEthSocket)
  {
    return;
  }
  if (result == 0)
  {
    msgId = ethFrameMsgId(buffer, count);
    if (msgId == ethMsgVehicleState() && ethFramePayloadLen(count) >= 2)
    {
      gVehTsMs = getSimulationTimeMs();
      gVehicleSpeed = clampRange(ethGetU8(buffer, 0), 0, 255);
      gDriveState = clampRange(ethGetU8(buffer, 1), 0, 3);
    }
    else if (msgId == ethMsgNavContext() && ethFramePayloadLen(count) >= 3)
    {
      gNavTsMs = getSimulationTimeMs();
      payload0 = ethGetU8(buffer, 0);
      gRoadZone = clampRange(payload0 & 0x3, 0, 3);
      gNavDirection = clampRange((payload0 >> 2) & 0x3, 0, 3);
      gZoneDistance = clampRange(ethGetU8(buffer, 1), 0, 255);
      gSpeedLimit = clampRange(ethGetU8(buffer, 2), 0, 255);
    }
    else if (msgId == ethMsgSelectedAlert() && ethFramePayloadLen(count) >= 1)
    {
      gAlertLevel = clampRange(ethGetU8(buffer, 0) & 0x7, 0, 7);
      gAlertTsMs = getSimulationTimeMs();
    }
    else if (msgId == ethMsgFailSafe() && ethFramePayloadLen(count) >= 1)
    {
      payload0 = ethGetU8(buffer, 0);
      gWarningPathStatus = clampRange(payload0 & 0x3, 0, 2);
      gFailSafeMode = clampRange((payload0 >> 4) & 0x3, 0, 2);
      gFailSafeTsMs = getSimulationTimeMs();
    }
  }

  ethArmReceive(gEthSocket, gEthRxBuffer, elcount(gEthRxBuffer));
}

on start
{
  gEthSocket = ethOpenDefaultSocket();
  gVehTsMs = 0;
  gNavTsMs = 0;
  gDriveState = 0;
  gVehicleSpeed = 0;
  gRoadZone = 0;
  gNavDirection = 0;
  gZoneDistance = 0;
  gSpeedLimit = 0;
  gAlertLevel = 0;
  gWarningPathStatus = 2;
  gFailSafeMode = 2;
  gLastVehInputStale = 1;
  gLastNavInputStale = 1;
  gLastLinkMode = -1;
  gLastRouteState = -1;
  gLastServiceFlags = -1;
  gAlertTsMs = 0;
  gFailSafeTsMs = 0;
  if (gEthSocket != ethInvalidSocket())
  {
    ethStartReceiver(gEthSocket, gEthRxBuffer, elcount(gEthRxBuffer));
  }
  setTimer(tIboxCycle, 100);
  write("[IBOX] start");
}

on timer tIboxCycle
{
  publishIboxState();
  setTimer(tIboxCycle, 100);
}

on stopMeasurement
{
  cancelTimer(tIboxCycle);
  ethCloseSocket(gEthSocket);
  gEthSocket = ethInvalidSocket();
}
