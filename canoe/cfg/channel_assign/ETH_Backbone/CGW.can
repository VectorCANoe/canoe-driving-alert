/*@!Encoding:949*/
includes {
  #include "..\\common\\CAPL_COMMON.cin"
}

variables
{
  const int CGW_SIGNAL_MIN = 0;
  const int CGW_BOOL_FALSE = 0;
  const int CGW_BOOL_TRUE = 1;
  const int CGW_STATUS_SENTINEL_UNINITIALIZED = -1;
  const int CGW_AGE_MISSING_MS = 10000;
  const int CGW_AGE_MAX_MS = 10000;
  const int CGW_BOUNDARY_AGE_THRESHOLD_MS = 300;
  const int CGW_WARNING_PATH_NORMAL_AGE_THRESHOLD_MS = 150;
  const int CGW_WARNING_PATH_DEGRADED_AGE_THRESHOLD_MS = 300;
  const int CGW_WARNING_PATH_STATUS_NORMAL = 0;
  const int CGW_WARNING_PATH_STATUS_DEGRADED = 1;
  const int CGW_WARNING_PATH_STATUS_BROKEN = 2;
  const int CGW_E2E_HEALTH_BROKEN = 0;
  const int CGW_E2E_HEALTH_DEGRADED = 1;
  const int CGW_E2E_HEALTH_NORMAL = 2;
  const int CGW_FAIL_SAFE_MODE_OFF = 0;
  const int CGW_FAIL_SAFE_MODE_DEGRADED = 1;
  const int CGW_FAIL_SAFE_MODE_ACTIVE = 2;
  const int CGW_ROUTING_POLICY_FAIL_SAFE = 0;
  const int CGW_ROUTING_POLICY_NORMAL = 1;
  const int CGW_ROUTING_POLICY_EMERGENCY = 2;
  const int CGW_OBJECT_CONFIDENCE_MAX = 100;
  const int CGW_OBJECT_EVENT_CODE_MAX = 65535;
  const int CGW_FAIL_SAFE_FRAME_PAYLOAD_LEN = 1;
  const int CGW_OBJECT_SAFETY_FRAME_PAYLOAD_LEN = 4;
  const int CGW_ETH_RX_BUFFER_LEN = 64;
  const int CGW_VEHICLE_STATE_FRAME_MIN_LEN = 2;
  const int CGW_NAV_CONTEXT_FRAME_MIN_LEN = 3;
  const int CGW_STEERING_FRAME_MIN_LEN = 1;
  const int CGW_LAST_EMERGENCY_RX_MAX = 2147483647;
  const int CGW_TIMER_PERIOD_MS = 100;

  msTimer tBoundaryCheck;
  long gEthSocket;
  dword gEthTargetIp;
  char gEthRxBuffer[CGW_ETH_RX_BUFFER_LEN];
  int gChassisAliveCount;
  int gBodyAliveCount;
  int gInfoAliveCount;
  dword gChassisTsMs;
  dword gBodyTsMs;
  dword gInfoTsMs;
  int gLastIsBoundaryAlive;
  int gLastWarningPathStatusCode;
  int gLastE2eHealthStateCode;
  int gLastFailSafeModeCode;
  int gVehicleStateAgeMs;
  int gNavContextAgeMs;
  int gSteeringAgeMs;
  int gEmergencyMonAgeMs;
  dword gVehicleStateTsMs;
  dword gNavContextTsMs;
  dword gSteeringTsMs;
  dword gEmergencyMonTsMs;
  int gLastRoutingPolicyCode;
  int gLastIsObjectTrackValid;
  int gLastObjectFailSafeModeCode;
  int gLastObjectEventCode;
}

int calcAgeMs(dword lastTsMs, dword nowMs)
{
  if (lastTsMs == CGW_SIGNAL_MIN)
  {
    return CGW_AGE_MISSING_MS;
  }
  return clampRange((int)(nowMs - lastTsMs), CGW_SIGNAL_MIN, CGW_AGE_MAX_MS);
}

int isBoundaryAliveCondition(int chassisAgeMs, int bodyAgeMs, int infoAgeMs)
{
  return (chassisAgeMs <= CGW_BOUNDARY_AGE_THRESHOLD_MS &&
          bodyAgeMs <= CGW_BOUNDARY_AGE_THRESHOLD_MS &&
          infoAgeMs <= CGW_BOUNDARY_AGE_THRESHOLD_MS);
}

int isWarningPathNormal(int isBoundaryAlive,
                        int vehicleStateAgeMs,
                        int navContextAgeMs,
                        int steeringAgeMs,
                        int emergencyMonAgeMs)
{
  return (isBoundaryAlive == CGW_BOOL_TRUE &&
          vehicleStateAgeMs <= CGW_WARNING_PATH_NORMAL_AGE_THRESHOLD_MS &&
          navContextAgeMs <= CGW_WARNING_PATH_NORMAL_AGE_THRESHOLD_MS &&
          steeringAgeMs <= CGW_WARNING_PATH_NORMAL_AGE_THRESHOLD_MS &&
          emergencyMonAgeMs <= CGW_WARNING_PATH_NORMAL_AGE_THRESHOLD_MS);
}

int isWarningPathDegraded(int isBoundaryAlive,
                          int vehicleStateAgeMs,
                          int navContextAgeMs,
                          int steeringAgeMs,
                          int emergencyMonAgeMs)
{
  return (isBoundaryAlive == CGW_BOOL_TRUE &&
          vehicleStateAgeMs <= CGW_WARNING_PATH_DEGRADED_AGE_THRESHOLD_MS &&
          navContextAgeMs <= CGW_WARNING_PATH_DEGRADED_AGE_THRESHOLD_MS &&
          steeringAgeMs <= CGW_WARNING_PATH_DEGRADED_AGE_THRESHOLD_MS &&
          emergencyMonAgeMs <= CGW_WARNING_PATH_DEGRADED_AGE_THRESHOLD_MS);
}

int isBoundarySupervisionChanged(int isBoundaryAlive,
                                 int warningPathStatusCode,
                                 int e2eHealthStateCode,
                                 int failSafeModeCode,
                                 int routingPolicyCode)
{
  return (isBoundaryAlive != gLastIsBoundaryAlive ||
          warningPathStatusCode != gLastWarningPathStatusCode ||
          e2eHealthStateCode != gLastE2eHealthStateCode ||
          failSafeModeCode != gLastFailSafeModeCode ||
          routingPolicyCode != gLastRoutingPolicyCode);
}

int deriveWarningPathStatus(int isForceFailSafeRequested,
                            int isBoundaryAlive,
                            int vehicleStateAgeMs,
                            int navContextAgeMs,
                            int steeringAgeMs,
                            int emergencyMonAgeMs)
{
  if (isForceFailSafeRequested == CGW_BOOL_TRUE)
  {
    return CGW_WARNING_PATH_STATUS_BROKEN;
  }
  if (isWarningPathNormal(isBoundaryAlive,
                          vehicleStateAgeMs,
                          navContextAgeMs,
                          steeringAgeMs,
                          emergencyMonAgeMs))
  {
    return CGW_WARNING_PATH_STATUS_NORMAL;
  }
  if (isWarningPathDegraded(isBoundaryAlive,
                            vehicleStateAgeMs,
                            navContextAgeMs,
                            steeringAgeMs,
                            emergencyMonAgeMs))
  {
    return CGW_WARNING_PATH_STATUS_DEGRADED;
  }
  return CGW_WARNING_PATH_STATUS_BROKEN;
}

int deriveE2eHealthState(int warningPathStatusCode)
{
  if (warningPathStatusCode == CGW_WARNING_PATH_STATUS_NORMAL)
  {
    return CGW_E2E_HEALTH_NORMAL;
  }
  if (warningPathStatusCode == CGW_WARNING_PATH_STATUS_DEGRADED)
  {
    return CGW_E2E_HEALTH_DEGRADED;
  }
  return CGW_E2E_HEALTH_BROKEN;
}

int deriveFailSafeMode(int warningPathStatusCode)
{
  if (warningPathStatusCode == CGW_WARNING_PATH_STATUS_NORMAL)
  {
    return CGW_FAIL_SAFE_MODE_OFF;
  }
  if (warningPathStatusCode == CGW_WARNING_PATH_STATUS_DEGRADED)
  {
    return CGW_FAIL_SAFE_MODE_DEGRADED;
  }
  return CGW_FAIL_SAFE_MODE_ACTIVE;
}

int deriveRoutingPolicy(int failSafeModeCode, int emergencyContextCode)
{
  if (failSafeModeCode > CGW_FAIL_SAFE_MODE_OFF)
  {
    return CGW_ROUTING_POLICY_FAIL_SAFE;
  }
  if (emergencyContextCode > CGW_SIGNAL_MIN)
  {
    return CGW_ROUTING_POLICY_EMERGENCY;
  }
  return CGW_ROUTING_POLICY_NORMAL;
}

void publishFailSafeState(int warningPathStatusCode,
                          int e2eHealthStateCode,
                          int failSafeModeCode,
                          int isBoundaryAlive)
{
  char frame[4];

  ethInitFrame(frame, ethMsgFailSafe(), CGW_FAIL_SAFE_FRAME_PAYLOAD_LEN);
  ethSetU8(frame, 0, clampRange(warningPathStatusCode, CGW_SIGNAL_MIN, CGW_WARNING_PATH_STATUS_BROKEN) |
                    (clampRange(e2eHealthStateCode, CGW_SIGNAL_MIN, CGW_E2E_HEALTH_NORMAL) << 2) |
                    (clampRange(failSafeModeCode, CGW_SIGNAL_MIN, CGW_FAIL_SAFE_MODE_ACTIVE) << 4) |
                    (clampRange(isBoundaryAlive, CGW_SIGNAL_MIN, CGW_BOOL_TRUE) << 6));
  ethSendFrame(gEthSocket, gEthTargetIp, ethMsgFailSafe(), frame, CGW_FAIL_SAFE_FRAME_PAYLOAD_LEN);
}

void publishObjectSafetyState(int failSafeModeCode)
{
  char frame[8];
  int objectConfidence;
  int objectEventCode;
  int isObjectTrackValid;

  objectConfidence = clampRange((int)@Core::objectConfidence, CGW_SIGNAL_MIN, CGW_OBJECT_CONFIDENCE_MAX);
  objectEventCode = clampRange((int)@Core::objectEventCode, CGW_SIGNAL_MIN, CGW_OBJECT_EVENT_CODE_MAX);
  isObjectTrackValid = clampRange((int)@Core::objectTrackValid, CGW_SIGNAL_MIN, CGW_BOOL_TRUE);

  ethInitFrame(frame, ethMsgObjectSafety(), CGW_OBJECT_SAFETY_FRAME_PAYLOAD_LEN);
  ethSetU8(frame, 0, objectConfidence);
  ethSetU16Le(frame, 1, objectEventCode);
  ethSetU8(frame, 3, clampRange(failSafeModeCode, CGW_SIGNAL_MIN, CGW_FAIL_SAFE_MODE_ACTIVE) |
                    (isObjectTrackValid << 2));
  ethSendFrame(gEthSocket, gEthTargetIp, ethMsgObjectSafety(), frame, CGW_OBJECT_SAFETY_FRAME_PAYLOAD_LEN);

  if (isObjectTrackValid != gLastIsObjectTrackValid ||
      failSafeModeCode != gLastObjectFailSafeModeCode ||
      objectEventCode != gLastObjectEventCode)
  {
    write("[CGW] objectSafety track=%d conf=%d event=%d failSafe=%d",
          isObjectTrackValid, objectConfidence, objectEventCode, failSafeModeCode);
    gLastIsObjectTrackValid = isObjectTrackValid;
    gLastObjectFailSafeModeCode = failSafeModeCode;
    gLastObjectEventCode = objectEventCode;
  }
}

void OnUdpReceiveFrom(dword socket, long result, dword address, dword port, char buffer[], dword count)
{
  int msgId;

  if (socket != gEthSocket)
  {
    return;
  }
  if (result == CGW_SIGNAL_MIN)
  {
    msgId = ethFrameMsgId(buffer, count);
    if (msgId == ethMsgVehicleState() && ethFramePayloadLen(count) >= CGW_VEHICLE_STATE_FRAME_MIN_LEN)
    {
      gVehicleStateTsMs = getSimulationTimeMs();
    }
    else if (msgId == ethMsgNavContext() && ethFramePayloadLen(count) >= CGW_NAV_CONTEXT_FRAME_MIN_LEN)
    {
      gNavContextTsMs = getSimulationTimeMs();
    }
    else if (msgId == ethMsgSteering() && ethFramePayloadLen(count) >= CGW_STEERING_FRAME_MIN_LEN)
    {
      gSteeringTsMs = getSimulationTimeMs();
    }
  }

  ethArmReceive(gEthSocket, gEthRxBuffer, elcount(gEthRxBuffer));
}

on start
{
  gEthSocket = ethOpenDefaultSocket();
  gEthTargetIp = ethGetDefaultIpAddress();
  gChassisAliveCount = CGW_SIGNAL_MIN;
  gBodyAliveCount = CGW_SIGNAL_MIN;
  gInfoAliveCount = CGW_SIGNAL_MIN;
  gChassisTsMs = CGW_SIGNAL_MIN;
  gBodyTsMs = CGW_SIGNAL_MIN;
  gInfoTsMs = CGW_SIGNAL_MIN;
  gLastIsBoundaryAlive = CGW_STATUS_SENTINEL_UNINITIALIZED;
  gLastWarningPathStatusCode = CGW_STATUS_SENTINEL_UNINITIALIZED;
  gLastE2eHealthStateCode = CGW_STATUS_SENTINEL_UNINITIALIZED;
  gLastFailSafeModeCode = CGW_STATUS_SENTINEL_UNINITIALIZED;
  gVehicleStateAgeMs = CGW_AGE_MISSING_MS;
  gNavContextAgeMs = CGW_AGE_MISSING_MS;
  gSteeringAgeMs = CGW_AGE_MISSING_MS;
  gEmergencyMonAgeMs = CGW_AGE_MISSING_MS;
  gVehicleStateTsMs = CGW_SIGNAL_MIN;
  gNavContextTsMs = CGW_SIGNAL_MIN;
  gSteeringTsMs = CGW_SIGNAL_MIN;
  gEmergencyMonTsMs = CGW_SIGNAL_MIN;
  gLastRoutingPolicyCode = CGW_STATUS_SENTINEL_UNINITIALIZED;
  gLastIsObjectTrackValid = CGW_STATUS_SENTINEL_UNINITIALIZED;
  gLastObjectFailSafeModeCode = CGW_STATUS_SENTINEL_UNINITIALIZED;
  gLastObjectEventCode = CGW_STATUS_SENTINEL_UNINITIALIZED;
  @CoreState::domainBoundaryStatus = CGW_SIGNAL_MIN;
  // @CoreState::warningPathStatus = CGW_WARNING_PATH_STATUS_BROKEN;
  @CoreState::e2eHealthState = CGW_E2E_HEALTH_BROKEN;
  @Core::failSafeMode = CGW_FAIL_SAFE_MODE_DEGRADED;
  @Core::decelAssistReq = CGW_SIGNAL_MIN;
  if (gEthSocket != ethInvalidSocket())
  {
    ethStartReceiver(gEthSocket, gEthRxBuffer, elcount(gEthRxBuffer));
  }
  setTimer(tBoundaryCheck, CGW_TIMER_PERIOD_MS);
  write("[CGW] start");
}

on message frmChassisHealthMsg
{
  gChassisAliveCount = this.ChassisAliveCnt;
  gChassisTsMs = getSimulationTimeMs();
}

on message frmBodyHealthMsg
{
  gBodyAliveCount = this.BodyAliveCnt;
  gBodyTsMs = getSimulationTimeMs();
}

on message frmInfotainmentHealthMsg
{
  gInfoAliveCount = this.InfoAliveCnt;
  gInfoTsMs = getSimulationTimeMs();
}

on timer tBoundaryCheck
{
  dword nowMs;
  dword emergencyHeartbeatMs;
  int chassisAgeMs;
  int bodyAgeMs;
  int infoAgeMs;
  int isBoundaryAlive;
  int warningPathStatusCode;
  int e2eHealthStateCode;
  int failSafeModeCode;
  int routingPolicyCode;
  int emergencyContextCode;
  int isForceFailSafeRequested;

  // Collect the latest domain and monitor ages for boundary supervision.
  nowMs = getSimulationTimeMs();
  chassisAgeMs = calcAgeMs(gChassisTsMs, nowMs);
  bodyAgeMs = calcAgeMs(gBodyTsMs, nowMs);
  infoAgeMs = calcAgeMs(gInfoTsMs, nowMs);
  gVehicleStateAgeMs = calcAgeMs(gVehicleStateTsMs, nowMs);
  gNavContextAgeMs = calcAgeMs(gNavContextTsMs, nowMs);
  gSteeringAgeMs = calcAgeMs(gSteeringTsMs, nowMs);
  emergencyHeartbeatMs = (dword)clampRange((int)@CoreState::lastEmergencyRxMs, CGW_SIGNAL_MIN, CGW_LAST_EMERGENCY_RX_MAX);
  gEmergencyMonAgeMs = calcAgeMs(emergencyHeartbeatMs, nowMs);

  // Mark the backbone boundary alive only when all domain heartbeats are fresh.
  isBoundaryAlive = CGW_BOOL_FALSE;
  if (isBoundaryAliveCondition(chassisAgeMs, bodyAgeMs, infoAgeMs))
  {
    isBoundaryAlive = CGW_BOOL_TRUE;
  }

  // Classify the warning path as normal, degraded, or broken.
  isForceFailSafeRequested = (((int)@Test::forceFailSafe) == CGW_BOOL_TRUE) ? CGW_BOOL_TRUE : CGW_BOOL_FALSE;
  warningPathStatusCode = deriveWarningPathStatus(isForceFailSafeRequested,
                                                  isBoundaryAlive,
                                                  gVehicleStateAgeMs,
                                                  gNavContextAgeMs,
                                                  gSteeringAgeMs,
                                                  gEmergencyMonAgeMs);

  // Convert the warning path state into E2E health and fail-safe mode.
  e2eHealthStateCode = deriveE2eHealthState(warningPathStatusCode);
  failSafeModeCode = deriveFailSafeMode(warningPathStatusCode);

  // Select the routing policy from fail-safe state and emergency context.
  emergencyContextCode = clampRange((int)@Core::emergencyContext, CGW_SIGNAL_MIN, CGW_ROUTING_POLICY_EMERGENCY);
  routingPolicyCode = deriveRoutingPolicy(failSafeModeCode, emergencyContextCode);

  // Mirror the boundary supervision result into Core and CoreState.
  @CoreState::domainBoundaryStatus = isBoundaryAlive;
  @CoreState::warningPathStatus = warningPathStatusCode;
  @CoreState::e2eHealthState = e2eHealthStateCode;
  @CoreState::routingPolicy = routingPolicyCode;
  @Core::failSafeMode = failSafeModeCode;
  if (failSafeModeCode > CGW_FAIL_SAFE_MODE_OFF)
  {
    @Core::decelAssistReq = CGW_SIGNAL_MIN;
  }

  // Publish the fail-safe and object-safety state for downstream consumers.
  publishFailSafeState(warningPathStatusCode, e2eHealthStateCode, failSafeModeCode, isBoundaryAlive);
  publishObjectSafetyState(failSafeModeCode);

  // Emit a log only when any boundary supervision result changes.
  if (isBoundarySupervisionChanged(isBoundaryAlive,
                                   warningPathStatusCode,
                                   e2eHealthStateCode,
                                   failSafeModeCode,
                                   routingPolicyCode))
  {
    write("[CGW] boundary=%d warnPath=%d e2e=%d failSafe=%d routing=%d ages(ch=%d body=%d info=%d veh=%d nav=%d str=%d mon=%d)",
          isBoundaryAlive,
          warningPathStatusCode,
          e2eHealthStateCode,
          failSafeModeCode,
          routingPolicyCode,
          chassisAgeMs,
          bodyAgeMs,
          infoAgeMs,
          gVehicleStateAgeMs,
          gNavContextAgeMs,
          gSteeringAgeMs,
          gEmergencyMonAgeMs);
    gLastIsBoundaryAlive = isBoundaryAlive;
    gLastWarningPathStatusCode = warningPathStatusCode;
    gLastE2eHealthStateCode = e2eHealthStateCode;
    gLastFailSafeModeCode = failSafeModeCode;
    gLastRoutingPolicyCode = routingPolicyCode;
  }

  setTimer(tBoundaryCheck, CGW_TIMER_PERIOD_MS);
}

on stopMeasurement
{
  cancelTimer(tBoundaryCheck);
  ethCloseSocket(gEthSocket);
  gEthSocket = ethInvalidSocket();
}
