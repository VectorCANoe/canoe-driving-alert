/*@!Encoding:949*/
includes {
  #include "..\\common\\CAPL_COMMON.cin"
}

variables
{
  msTimer tBoundaryCheck;
  long gEthSocket;
  dword gEthTargetIp;
  char gEthRxBuffer[64];
  int gChassisAliveCount;
  int gBodyAliveCount;
  int gInfoAliveCount;
  dword gChassisTsMs;
  dword gBodyTsMs;
  dword gInfoTsMs;
  int gLastIsBoundaryAlive;
  int gLastWarningPathStatusCode;
  int gLastE2eHealthStateCode;
  int gLastFailSafeModeCode;
  int gVehicleStateAgeMs;
  int gNavContextAgeMs;
  int gSteeringAgeMs;
  int gEmergencyMonAgeMs;
  dword gVehicleStateTsMs;
  dword gNavContextTsMs;
  dword gSteeringTsMs;
  dword gEmergencyMonTsMs;
  int gLastRoutingPolicyCode;
  int gLastIsObjectTrackValid;
  int gLastObjectFailSafeModeCode;
  int gLastObjectEventCode;
}

int calcAgeMs(dword lastTsMs, dword nowMs)
{
  if (lastTsMs == 0)
  {
    return 10000;
  }
  return clampRange((int)(nowMs - lastTsMs), 0, 10000);
}

int isBoundaryAliveCondition(int chassisAgeMs, int bodyAgeMs, int infoAgeMs)
{
  return (chassisAgeMs <= 300 &&
          bodyAgeMs <= 300 &&
          infoAgeMs <= 300);
}

int isWarningPathNormal(int isBoundaryAlive,
                        int vehicleStateAgeMs,
                        int navContextAgeMs,
                        int steeringAgeMs,
                        int emergencyMonAgeMs)
{
  return (isBoundaryAlive == 1 &&
          vehicleStateAgeMs <= 150 &&
          navContextAgeMs <= 150 &&
          steeringAgeMs <= 150 &&
          emergencyMonAgeMs <= 150);
}

int isWarningPathDegraded(int isBoundaryAlive,
                          int vehicleStateAgeMs,
                          int navContextAgeMs,
                          int steeringAgeMs,
                          int emergencyMonAgeMs)
{
  return (isBoundaryAlive == 1 &&
          vehicleStateAgeMs <= 300 &&
          navContextAgeMs <= 300 &&
          steeringAgeMs <= 300 &&
          emergencyMonAgeMs <= 300);
}

int isBoundarySupervisionChanged(int isBoundaryAlive,
                                 int warningPathStatusCode,
                                 int e2eHealthStateCode,
                                 int failSafeModeCode,
                                 int routingPolicyCode)
{
  return (isBoundaryAlive != gLastIsBoundaryAlive ||
          warningPathStatusCode != gLastWarningPathStatusCode ||
          e2eHealthStateCode != gLastE2eHealthStateCode ||
          failSafeModeCode != gLastFailSafeModeCode ||
          routingPolicyCode != gLastRoutingPolicyCode);
}

int deriveWarningPathStatus(int isForceFailSafeRequested,
                            int isBoundaryAlive,
                            int vehicleStateAgeMs,
                            int navContextAgeMs,
                            int steeringAgeMs,
                            int emergencyMonAgeMs)
{
  if (isForceFailSafeRequested == 1)
  {
    return 2;
  }
  if (isWarningPathNormal(isBoundaryAlive,
                          vehicleStateAgeMs,
                          navContextAgeMs,
                          steeringAgeMs,
                          emergencyMonAgeMs))
  {
    return 0;
  }
  if (isWarningPathDegraded(isBoundaryAlive,
                            vehicleStateAgeMs,
                            navContextAgeMs,
                            steeringAgeMs,
                            emergencyMonAgeMs))
  {
    return 1;
  }
  return 2;
}

int deriveE2eHealthState(int warningPathStatusCode)
{
  if (warningPathStatusCode == 0)
  {
    return 2;
  }
  if (warningPathStatusCode == 1)
  {
    return 1;
  }
  return 0;
}

int deriveFailSafeMode(int warningPathStatusCode)
{
  if (warningPathStatusCode == 0)
  {
    return 0;
  }
  if (warningPathStatusCode == 1)
  {
    return 1;
  }
  return 2;
}

int deriveRoutingPolicy(int failSafeModeCode, int emergencyContextCode)
{
  if (failSafeModeCode > 0)
  {
    return 0;
  }
  if (emergencyContextCode > 0)
  {
    return 2;
  }
  return 1;
}

void publishFailSafeState(int warningPathStatusCode,
                          int e2eHealthStateCode,
                          int failSafeModeCode,
                          int isBoundaryAlive)
{
  char frame[4];

  ethInitFrame(frame, ethMsgFailSafe(), 1);
  ethSetU8(frame, 0, clampRange(warningPathStatusCode, 0, 2) |
                    (clampRange(e2eHealthStateCode, 0, 2) << 2) |
                    (clampRange(failSafeModeCode, 0, 2) << 4) |
                    (clampRange(isBoundaryAlive, 0, 1) << 6));
  ethSendFrame(gEthSocket, gEthTargetIp, ethMsgFailSafe(), frame, 1);
}

void publishObjectSafetyState(int failSafeModeCode)
{
  char frame[8];
  int objectConfidence;
  int objectEventCode;
  int isObjectTrackValid;

  objectConfidence = clampRange((int)@Core::objectConfidence, 0, 100);
  objectEventCode = clampRange((int)@Core::objectEventCode, 0, 65535);
  isObjectTrackValid = clampRange((int)@Core::objectTrackValid, 0, 1);

  ethInitFrame(frame, ethMsgObjectSafety(), 4);
  ethSetU8(frame, 0, objectConfidence);
  ethSetU16Le(frame, 1, objectEventCode);
  ethSetU8(frame, 3, clampRange(failSafeModeCode, 0, 2) |
                    (isObjectTrackValid << 2));
  ethSendFrame(gEthSocket, gEthTargetIp, ethMsgObjectSafety(), frame, 4);

  if (isObjectTrackValid != gLastIsObjectTrackValid ||
      failSafeModeCode != gLastObjectFailSafeModeCode ||
      objectEventCode != gLastObjectEventCode)
  {
    write("[CGW] objectSafety track=%d conf=%d event=%d failSafe=%d",
          isObjectTrackValid, objectConfidence, objectEventCode, failSafeModeCode);
    gLastIsObjectTrackValid = isObjectTrackValid;
    gLastObjectFailSafeModeCode = failSafeModeCode;
    gLastObjectEventCode = objectEventCode;
  }
}

void OnUdpReceiveFrom(dword socket, long result, dword address, dword port, char buffer[], dword count)
{
  int msgId;

  if (socket != gEthSocket)
  {
    return;
  }
  if (result == 0)
  {
    msgId = ethFrameMsgId(buffer, count);
    if (msgId == ethMsgVehicleState() && ethFramePayloadLen(count) >= 2)
    {
      gVehicleStateTsMs = getSimulationTimeMs();
    }
    else if (msgId == ethMsgNavContext() && ethFramePayloadLen(count) >= 3)
    {
      gNavContextTsMs = getSimulationTimeMs();
    }
    else if (msgId == ethMsgSteering() && ethFramePayloadLen(count) >= 1)
    {
      gSteeringTsMs = getSimulationTimeMs();
    }
  }

  ethArmReceive(gEthSocket, gEthRxBuffer, elcount(gEthRxBuffer));
}

on start
{
  gEthSocket = ethOpenDefaultSocket();
  gEthTargetIp = ethGetDefaultIpAddress();
  gChassisAliveCount = 0;
  gBodyAliveCount = 0;
  gInfoAliveCount = 0;
  gChassisTsMs = 0;
  gBodyTsMs = 0;
  gInfoTsMs = 0;
  gLastIsBoundaryAlive = -1;
  gLastWarningPathStatusCode = -1;
  gLastE2eHealthStateCode = -1;
  gLastFailSafeModeCode = -1;
  gVehicleStateAgeMs = 10000;
  gNavContextAgeMs = 10000;
  gSteeringAgeMs = 10000;
  gEmergencyMonAgeMs = 10000;
  gVehicleStateTsMs = 0;
  gNavContextTsMs = 0;
  gSteeringTsMs = 0;
  gEmergencyMonTsMs = 0;
  gLastRoutingPolicyCode = -1;
  gLastIsObjectTrackValid = -1;
  gLastObjectFailSafeModeCode = -1;
  gLastObjectEventCode = -1;
  @CoreState::domainBoundaryStatus = 0;
  // @CoreState::warningPathStatus = 2;
  @CoreState::e2eHealthState = 0;
  @Core::failSafeMode = 1;
  @Core::decelAssistReq = 0;
  if (gEthSocket != ethInvalidSocket())
  {
    ethStartReceiver(gEthSocket, gEthRxBuffer, elcount(gEthRxBuffer));
  }
  setTimer(tBoundaryCheck, 100);
  write("[CGW] start");
}

on message frmChassisHealthMsg
{
  gChassisAliveCount = this.ChassisAliveCnt;
  gChassisTsMs = getSimulationTimeMs();
}

on message frmBodyHealthMsg
{
  gBodyAliveCount = this.BodyAliveCnt;
  gBodyTsMs = getSimulationTimeMs();
}

on message frmInfotainmentHealthMsg
{
  gInfoAliveCount = this.InfoAliveCnt;
  gInfoTsMs = getSimulationTimeMs();
}

on timer tBoundaryCheck
{
  dword nowMs;
  dword emergencyHeartbeatMs;
  int chassisAgeMs;
  int bodyAgeMs;
  int infoAgeMs;
  int isBoundaryAlive;
  int warningPathStatusCode;
  int e2eHealthStateCode;
  int failSafeModeCode;
  int routingPolicyCode;
  int emergencyContextCode;
  int isForceFailSafeRequested;

  // Collect the latest domain and monitor ages for boundary supervision.
  nowMs = getSimulationTimeMs();
  chassisAgeMs = calcAgeMs(gChassisTsMs, nowMs);
  bodyAgeMs = calcAgeMs(gBodyTsMs, nowMs);
  infoAgeMs = calcAgeMs(gInfoTsMs, nowMs);
  gVehicleStateAgeMs = calcAgeMs(gVehicleStateTsMs, nowMs);
  gNavContextAgeMs = calcAgeMs(gNavContextTsMs, nowMs);
  gSteeringAgeMs = calcAgeMs(gSteeringTsMs, nowMs);
  emergencyHeartbeatMs = (dword)clampRange((int)@CoreState::lastEmergencyRxMs, 0, 2147483647);
  gEmergencyMonAgeMs = calcAgeMs(emergencyHeartbeatMs, nowMs);

  // Mark the backbone boundary alive only when all domain heartbeats are fresh.
  isBoundaryAlive = 0;
  if (isBoundaryAliveCondition(chassisAgeMs, bodyAgeMs, infoAgeMs))
  {
    isBoundaryAlive = 1;
  }

  // Classify the warning path as normal, degraded, or broken.
  isForceFailSafeRequested = (((int)@Test::forceFailSafe) == 1) ? 1 : 0;
  warningPathStatusCode = deriveWarningPathStatus(isForceFailSafeRequested,
                                                  isBoundaryAlive,
                                                  gVehicleStateAgeMs,
                                                  gNavContextAgeMs,
                                                  gSteeringAgeMs,
                                                  gEmergencyMonAgeMs);

  // Convert the warning path state into E2E health and fail-safe mode.
  e2eHealthStateCode = deriveE2eHealthState(warningPathStatusCode);
  failSafeModeCode = deriveFailSafeMode(warningPathStatusCode);

  // Select the routing policy from fail-safe state and emergency context.
  emergencyContextCode = clampRange((int)@Core::emergencyContext, 0, 2);
  routingPolicyCode = deriveRoutingPolicy(failSafeModeCode, emergencyContextCode);

  // Mirror the boundary supervision result into Core and CoreState.
  @CoreState::domainBoundaryStatus = isBoundaryAlive;
  @CoreState::warningPathStatus = warningPathStatusCode;
  @CoreState::e2eHealthState = e2eHealthStateCode;
  @CoreState::routingPolicy = routingPolicyCode;
  @Core::failSafeMode = failSafeModeCode;
  if (failSafeModeCode > 0)
  {
    @Core::decelAssistReq = 0;
  }

  // Publish the fail-safe and object-safety state for downstream consumers.
  publishFailSafeState(warningPathStatusCode, e2eHealthStateCode, failSafeModeCode, isBoundaryAlive);
  publishObjectSafetyState(failSafeModeCode);

  // Emit a log only when any boundary supervision result changes.
  if (isBoundarySupervisionChanged(isBoundaryAlive,
                                   warningPathStatusCode,
                                   e2eHealthStateCode,
                                   failSafeModeCode,
                                   routingPolicyCode))
  {
    write("[CGW] boundary=%d warnPath=%d e2e=%d failSafe=%d routing=%d ages(ch=%d body=%d info=%d veh=%d nav=%d str=%d mon=%d)",
          isBoundaryAlive,
          warningPathStatusCode,
          e2eHealthStateCode,
          failSafeModeCode,
          routingPolicyCode,
          chassisAgeMs,
          bodyAgeMs,
          infoAgeMs,
          gVehicleStateAgeMs,
          gNavContextAgeMs,
          gSteeringAgeMs,
          gEmergencyMonAgeMs);
    gLastIsBoundaryAlive = isBoundaryAlive;
    gLastWarningPathStatusCode = warningPathStatusCode;
    gLastE2eHealthStateCode = e2eHealthStateCode;
    gLastFailSafeModeCode = failSafeModeCode;
    gLastRoutingPolicyCode = routingPolicyCode;
  }

  setTimer(tBoundaryCheck, 100);
}

on stopMeasurement
{
  cancelTimer(tBoundaryCheck);
  ethCloseSocket(gEthSocket);
  gEthSocket = ethInvalidSocket();
}
