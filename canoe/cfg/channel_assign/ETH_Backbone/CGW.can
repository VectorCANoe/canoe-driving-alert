/*@!Encoding:949*/
includes {
  #include "..\\common\\CAPL_COMMON.cin"
}

variables
{
  msTimer tBoundaryCheck;
  int gChassisAlive;
  int gBodyAlive;
  int gInfoAlive;
  dword gChassisTsMs;
  dword gBodyTsMs;
  dword gInfoTsMs;
  int gLastBoundaryStatus;
  int gLastWarningPathStatus;
  int gLastE2eHealthState;
  int gLastFailSafeMode;
  int gVehicleStateAgeMs;
  int gNavContextAgeMs;
  int gSteeringAgeMs;
  int gEmergencyMonAgeMs;
  dword gVehicleStateTsMs;
  dword gNavContextTsMs;
  dword gSteeringTsMs;
  dword gEmergencyMonTsMs;
  int gLastEthPathState;
}

on start
{
  gChassisAlive = 0;
  gBodyAlive = 0;
  gInfoAlive = 0;
  gChassisTsMs = 0;
  gBodyTsMs = 0;
  gInfoTsMs = 0;
  gLastBoundaryStatus = -1;
  gLastWarningPathStatus = -1;
  gLastE2eHealthState = -1;
  gLastFailSafeMode = -1;
  gVehicleStateAgeMs = 10000;
  gNavContextAgeMs = 10000;
  gSteeringAgeMs = 10000;
  gEmergencyMonAgeMs = 10000;
  gVehicleStateTsMs = 0;
  gNavContextTsMs = 0;
  gSteeringTsMs = 0;
  gEmergencyMonTsMs = 0;
  gLastEthPathState = -1;
  @CoreState::domainBoundaryStatus = 0;
  @CoreState::warningPathStatus = 2;
  @CoreState::e2eHealthState = 0;
  @Core::failSafeMode = 1;
  @Core::decelAssistReq = 0;
  setTimer(tBoundaryCheck, 100);
  write("[CGW] start");
}

on message frmChassisHealthMsg
{
  gChassisAlive = this.ChassisAliveCnt;
  gChassisTsMs = getSimulationTimeMs();
}

on message frmBodyHealthMsg
{
  gBodyAlive = this.BodyAliveCnt;
  gBodyTsMs = getSimulationTimeMs();
}

on message frmInfotainmentHealthMsg
{
  gInfoAlive = this.InfoAliveCnt;
  gInfoTsMs = getSimulationTimeMs();
}

on message ethVehicleStateMsg
{
  gVehicleStateTsMs = getSimulationTimeMs();
}

on message ethNavContextMsg
{
  gNavContextTsMs = getSimulationTimeMs();
}

on message ethSteeringMsg
{
  gSteeringTsMs = getSimulationTimeMs();
}

on message frmEmergencyMonitorMsg
{
  gEmergencyMonTsMs = getSimulationTimeMs();
}

on timer tBoundaryCheck
{
  setTimer(tBoundaryCheck, 100);
}
