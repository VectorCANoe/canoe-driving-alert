includes
{
  #include "..\\common\\CAPL_COMMON.cin"
}

variables
{
  msTimer tDcmCycle;
  int gSecuritySession;
  int gAuthState;
  int gSecurityFault;
  int gSecurityPolicy;
  int gLastTraceSession;
  int gLastTraceAuth;
  int gLastTraceFault;
  int gLastTracePolicy;
  int gLastTraceServiceState;
  int gLastTraceResponseKind;
  int gLastTraceReasonCode;
}

void publishReservedDiagServiceSeam()
{
  int serviceState;
  int responseKind;
  int reasonCode;

  serviceState = 0;
  responseKind = 0;
  reasonCode = 0;

  if (gSecurityFault >= 2)
  {
    serviceState = 2;
    responseKind = 4;
    reasonCode = 2;
  }
  else if (gSecurityFault == 1 || gSecurityPolicy == 1)
  {
    serviceState = 3;
    responseKind = 2;
    reasonCode = 3;
  }
  else if (gSecuritySession >= 2 && gAuthState >= 2)
  {
    serviceState = 1;
    responseKind = 1;
    reasonCode = 0;
  }
  else if (gSecuritySession > 0 || gAuthState > 0)
  {
    serviceState = 3;
    responseKind = 4;
    reasonCode = 4;
  }

  @Diag::ServiceState = serviceState;
  @Diag::ResponseKind = responseKind;
  @Diag::ReasonCode = reasonCode;
  @Diag::LastRequestSid = 0x22;
  @Diag::LastResponseOk = (responseKind == 1) ? 1 : 0;

  if (responseKind == 1)
  {
    @Diag::LastResponseCode = 0x62;
  }
  else if (responseKind == 2)
  {
    @Diag::LastResponseCode = 0x7F;
  }
  else if (responseKind == 3)
  {
    @Diag::LastResponseCode = 0x78;
  }
  else if (responseKind == 4)
  {
    @Diag::LastResponseCode = 0x7F;
  }
  else
  {
    @Diag::LastResponseCode = 0x00;
  }
}

void publishDcmStateTrace()
{
  int serviceState;
  int responseKind;
  int reasonCode;

  serviceState = clampRange((int)@Diag::ServiceState, 0, 3);
  responseKind = clampRange((int)@Diag::ResponseKind, 0, 4);
  reasonCode = clampRange((int)@Diag::ReasonCode, 0, 65535);
  if (gSecuritySession != gLastTraceSession ||
      gAuthState != gLastTraceAuth ||
      gSecurityFault != gLastTraceFault ||
      gSecurityPolicy != gLastTracePolicy ||
      serviceState != gLastTraceServiceState ||
      responseKind != gLastTraceResponseKind ||
      reasonCode != gLastTraceReasonCode)
  {
    write("[DCM] session=%d service=%d resp=%d reason=%d auth=%d fault=%d policy=%d",
          gSecuritySession,
          serviceState,
          responseKind,
          reasonCode,
          gAuthState,
          gSecurityFault,
          gSecurityPolicy);
    gLastTraceSession = gSecuritySession;
    gLastTraceAuth = gAuthState;
    gLastTraceFault = gSecurityFault;
    gLastTracePolicy = gSecurityPolicy;
    gLastTraceServiceState = serviceState;
    gLastTraceResponseKind = responseKind;
    gLastTraceReasonCode = reasonCode;
  }
}

on start
{
  gSecuritySession = 0;
  gAuthState = 0;
  gSecurityFault = 0;
  gSecurityPolicy = 0;
  gLastTraceSession = -1;
  gLastTraceAuth = -1;
  gLastTraceFault = -1;
  gLastTracePolicy = -1;
  gLastTraceServiceState = -1;
  gLastTraceResponseKind = -1;
  gLastTraceReasonCode = -1;
  @Diag::ServiceState = 0;
  @Diag::ResponseKind = 0;
  @Diag::ReasonCode = 0;
  @Diag::LastRequestSid = 0;
  @Diag::LastResponseCode = 0;
  @Diag::LastResponseOk = 0;
  setTimer(tDcmCycle, 100);
  write("[DCM] start");
}

on timer tDcmCycle
{
  int baseZoneContext;
  int routeActive;
  int alertLevel;
  int boundaryAlive;
  int warningPathStatus;
  int failSafeMode;

  baseZoneContext = clampRange((int)@Core::baseZoneContext, 0, 4);
  routeActive = (baseZoneContext > 0) ? 1 : 0;
  alertLevel = clampRange((int)@Core::selectedAlertLevel, 0, 7);
  boundaryAlive = clampRange((int)@CoreState::domainBoundaryStatus, 0, 1);
  warningPathStatus = clampRange((int)@CoreState::warningPathStatus, 0, 2);
  failSafeMode = clampRange((int)@Core::failSafeMode, 0, 2);

  gSecuritySession = 0;
  if (routeActive == 1 || alertLevel > 0)
  {
    gSecuritySession = 1;
  }
  if (boundaryAlive == 1 && routeActive == 1)
  {
    gSecuritySession = 2;
  }

  gAuthState = (gSecuritySession > 0) ? 1 : 0;
  if (failSafeMode == 0 && boundaryAlive == 1)
  {
    gAuthState = 2;
  }

  gSecurityFault = 0;
  if (failSafeMode >= 2 || warningPathStatus >= 2)
  {
    gSecurityFault = 2;
  }
  else if (failSafeMode == 1 || warningPathStatus == 1)
  {
    gSecurityFault = 1;
  }
  gSecurityPolicy = warningPathStatus;
  publishReservedDiagServiceSeam();
  publishDcmStateTrace();
  setTimer(tDcmCycle, 100);
}

on stopMeasurement
{
  cancelTimer(tDcmCycle);
}
