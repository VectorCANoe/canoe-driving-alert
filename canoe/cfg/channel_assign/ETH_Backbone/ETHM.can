includes
{
  #include "..\\common\\CAPL_COMMON.cin"
}

variables
{
  msTimer tEthMonitor100;
  int gEthHeartbeat;
  int gVehicleStateAgeMs;
  int gNavContextAgeMs;
  int gSteeringAgeMs;
  int gEmergencyMonAgeMs;
  int gEthPathHealthy;
  int gLastEthPathHealthy;
}


on start
{
  gEthHeartbeat = 0;
  gVehicleStateAgeMs = 10000;
  gNavContextAgeMs = 10000;
  gSteeringAgeMs = 10000;
  gEmergencyMonAgeMs = 10000;
  gEthPathHealthy = 0;
  gLastEthPathHealthy = -1;
  setTimer(tEthMonitor100, 100);
  write("[ETHM] start");
}

on message frmVehicleStateCanMsg
{
  gVehicleStateAgeMs = 0;
}

on message frmNavContextCanMsg
{
  gNavContextAgeMs = 0;
}

on message frmSteeringCanMsg
{
  gSteeringAgeMs = 0;
}

on message frmEmergencyMonitorMsg
{
  gEmergencyMonAgeMs = 0;
}

on timer tEthMonitor100
{
  gEthHeartbeat = (gEthHeartbeat + 1) & 0xFF;
  gVehicleStateAgeMs = clampRange(gVehicleStateAgeMs + 100, 0, 60000);
  gNavContextAgeMs = clampRange(gNavContextAgeMs + 100, 0, 60000);
  gSteeringAgeMs = clampRange(gSteeringAgeMs + 100, 0, 60000);
  gEmergencyMonAgeMs = clampRange(gEmergencyMonAgeMs + 100, 0, 60000);

  gEthPathHealthy = ((gVehicleStateAgeMs <= 300) &&
                     (gNavContextAgeMs <= 300) &&
                     (gSteeringAgeMs <= 300) &&
                     (gEmergencyMonAgeMs <= 500)) ? 1 : 0;
  if (gEthPathHealthy != gLastEthPathHealthy)
  {
    write("[ETHM] path health=%d (veh=%dms nav=%dms steer=%dms ems=%dms)",
          gEthPathHealthy,
          gVehicleStateAgeMs,
          gNavContextAgeMs,
          gSteeringAgeMs,
          gEmergencyMonAgeMs);
    gLastEthPathHealthy = gEthPathHealthy;
  }

  setTimer(tEthMonitor100, 100);
}



