includes
{
  #include "..\\common\\CAPL_COMMON.cin"
}

variables
{
  msTimer tEdrCycle;
  long gEthSocket;
  char gEthRxBuffer[64];
  int gFailSafeMode;
  int gWarningPathStatus;
  int gE2eHealthState;
  int gObjectTrackValid;
  int gObjectEventCode;
  int gLastRecordState;
  int gLastEventSeverity;
  int gLastRecordReason;
  int gLastStorageLevel;
  int gLastEventCode;
}

void publishEdrState()
{
  int alertLevel;
  int recordState;
  int eventSeverity;
  int recordReason;
  int storageLevel;
  int lastEventCode;

  alertLevel = clampRange((int)@Core::selectedAlertLevel, 0, 7);

  if (alertLevel >= 5)
  {
    eventSeverity = 3;
  }
  else if (alertLevel >= 3 || gFailSafeMode > 0)
  {
    eventSeverity = 2;
  }
  else if (alertLevel > 0 || gObjectTrackValid == 1)
  {
    eventSeverity = 1;
  }
  else
  {
    eventSeverity = 0;
  }

  if (gFailSafeMode == 2 || eventSeverity >= 3)
  {
    recordState = 2;
  }
  else if (eventSeverity > 0)
  {
    recordState = 1;
  }
  else
  {
    recordState = 0;
  }

  if (gFailSafeMode > 0)
  {
    recordReason = 1;
  }
  else if (gObjectTrackValid == 1)
  {
    recordReason = 2;
  }
  else if (alertLevel > 0)
  {
    recordReason = 3;
  }
  else
  {
    recordReason = 0;
  }

  storageLevel = clampRange((eventSeverity * 20) + (gWarningPathStatus * 10) + (gE2eHealthState == 0 ? 30 : 0), 0, 100);
  lastEventCode = clampRange(gObjectEventCode, 0, 255);

  if (recordState != gLastRecordState ||
      eventSeverity != gLastEventSeverity ||
      recordReason != gLastRecordReason ||
      storageLevel != gLastStorageLevel ||
      lastEventCode != gLastEventCode)
  {
    write("[EDR] state=%d severity=%d reason=%d storage=%d lastCode=%d failSafe=%d alert=%d",
          recordState,
          eventSeverity,
          recordReason,
          storageLevel,
          lastEventCode,
          gFailSafeMode,
          alertLevel);
    gLastRecordState = recordState;
    gLastEventSeverity = eventSeverity;
    gLastRecordReason = recordReason;
    gLastStorageLevel = storageLevel;
    gLastEventCode = lastEventCode;
  }
}

void OnUdpReceiveFrom(dword socket, long result, dword address, dword port, char buffer[], dword count)
{
  int msgId;
  int payload0;
  int payload3;

  if (socket != gEthSocket)
  {
    return;
  }
  if (result == 0)
  {
    msgId = ethFrameMsgId(buffer, count);
    if (msgId == ethMsgFailSafe() && ethFramePayloadLen(count) >= 1)
    {
      payload0 = ethGetU8(buffer, 0);
      gWarningPathStatus = clampRange(payload0 & 0x3, 0, 2);
      gE2eHealthState = clampRange((payload0 >> 2) & 0x3, 0, 2);
      gFailSafeMode = clampRange((payload0 >> 4) & 0x3, 0, 2);
    }
    else if (msgId == ethMsgObjectSafety() && ethFramePayloadLen(count) >= 4)
    {
      payload3 = ethGetU8(buffer, 3);
      gObjectTrackValid = clampRange((payload3 >> 2) & 0x1, 0, 1);
      gObjectEventCode = clampRange(ethGetU16Le(buffer, 1), 0, 65535);
    }
  }

  ethArmReceive(gEthSocket, gEthRxBuffer, elcount(gEthRxBuffer));
}

on start
{
  gEthSocket = ethOpenDefaultSocket();
  gFailSafeMode = 0;
  gWarningPathStatus = 0;
  gE2eHealthState = 2;
  gObjectTrackValid = 0;
  gObjectEventCode = 0;
  gLastRecordState = -1;
  gLastEventSeverity = -1;
  gLastRecordReason = -1;
  gLastStorageLevel = -1;
  gLastEventCode = -1;
  if (gEthSocket != ethInvalidSocket())
  {
    ethStartReceiver(gEthSocket, gEthRxBuffer, elcount(gEthRxBuffer));
  }
  setTimer(tEdrCycle, 100);
  write("[EDR] start");
}

on timer tEdrCycle
{
  publishEdrState();
  setTimer(tEdrCycle, 100);
}

on stopMeasurement
{
  cancelTimer(tEdrCycle);
  ethCloseSocket(gEthSocket);
  gEthSocket = ethInvalidSocket();
}
