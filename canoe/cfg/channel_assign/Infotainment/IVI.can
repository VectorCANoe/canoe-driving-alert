includes
{
  #include "..\\common\\CAPL_COMMON.cin"
}

variables
{
  msTimer tIviCycle;
  msTimer tIviBase50;
  msTimer tIviExt100;
  long gEthSocket;
  long gEthTxSocket;
  dword gEthTargetIp;
  char gEthRxBuffer[64];
  int gLastWarningTextCode;
  int gInfoAliveCnt;
  int gIviBaseTick;
  int gEmsBlinkPhase;
  int gAmbientPulsePhase;
  int gIcFlowPhase;
  int gVehicleObjectPos;
  int gBackboneAlertLevel;
  int gBackboneAlertType;
  int gBackboneTimeoutClear;
  dword gBackboneAlertTsMs;
}

int getIviTxPort()
{
  return ethBackbonePort() + 4;
}


int calcEmergencyDistanceM(int etaSec, int speedKph)
{
  long distanceM;

  if (etaSec <= 0 || speedKph <= 0)
  {
    return 0;
  }
  distanceM = ((long)etaSec * (long)speedKph * 10) / 36;
  if (distanceM < 0)
  {
    distanceM = 0;
  }
  if (distanceM > 10000)
  {
    distanceM = 10000;
  }
  return (int)distanceM;
}

int deriveEmergencyWarningCode(int emergencyType, int emergencyDistanceBand, int emergencyDirection)
{
  int baseCode;

  emergencyDirection = clampRange(emergencyDirection, 0, 3);
  emergencyDistanceBand = clampRange(emergencyDistanceBand, 0, 3);

  if (emergencyType == 2)
  {
    baseCode = 200;
  }
  else if (emergencyType == 1)
  {
    baseCode = 100;
  }
  else
  {
    return 100 + emergencyDirection;
  }

  if (emergencyDistanceBand > 0)
  {
    return baseCode + (emergencyDistanceBand * 10) + emergencyDirection;
  }
  return baseCode + emergencyDirection;
}

int deriveWarningTextCode(int alertLevel, int alertType, int timeoutClear,
                          int emergencyType, int emergencyDirection, int emergencyDistanceBand)
{
  if (timeoutClear == 1 || alertLevel == 0)
  {
    return 0;
  }
  if (alertLevel >= 6)
  {
    return deriveEmergencyWarningCode(emergencyType, emergencyDistanceBand, emergencyDirection);
  }
  if (alertType == 5)
  {
    return 31;
  }
  if (alertType == 6)
  {
    return 32;
  }
  return clampRange((alertType * 10) + alertLevel, 0, 255);
}

int deriveRenderDirection(int renderTextCode, int alertType)
{
  if (renderTextCode >= 100 && renderTextCode <= 203)
  {
    return clampRange(renderTextCode % 100, 0, 3);
  }
  if (alertType == 5)
  {
    return 1;
  }
  if (alertType == 6)
  {
    return 2;
  }
  return 0;
}

void publishBackboneNavContext()
{
  char frame[8];
  int baseZoneContext;
  int roadZone;
  int navDirection;
  int zoneDistance;
  int speedLimit;
  long txSocket;

  baseZoneContext = clampRange((int)@Core::baseZoneContext, 0, 4);
  roadZone = 0;
  navDirection = 0;
  zoneDistance = 0;
  speedLimit = 0;

  if (baseZoneContext == 1)
  {
    roadZone = 1;
  }
  else if (baseZoneContext == 2)
  {
    roadZone = 2;
  }
  else if (baseZoneContext == 3 || baseZoneContext == 4)
  {
    roadZone = 3;
    navDirection = clampRange((int)@Infotainment::navDirection, 0, 3);
    if (navDirection == 0)
    {
      navDirection = (baseZoneContext == 4) ? 2 : 1;
    }
  }

  if (roadZone > 0)
  {
    zoneDistance = clampRange((int)@Infotainment::zoneDistance, 0, 255);
    speedLimit = clampRange((int)@Core::speedLimitNorm, 0, 255);
    if (speedLimit == 0)
    {
      speedLimit = 30;
    }
  }
  txSocket = gEthTxSocket;
  if (txSocket == ethInvalidSocket())
  {
    txSocket = gEthSocket;
  }

  ethInitFrame(frame, ethMsgNavContext(), 3);
  ethSetU8(frame, 0, (roadZone & 0x3) | ((navDirection & 0x3) << 2));
  ethSetU8(frame, 1, zoneDistance);
  ethSetU8(frame, 2, speedLimit);
  ethSendFrame(txSocket, gEthTargetIp, ethMsgNavContext(), frame, 3);
}

void updateBackboneAlertState(int alertLevel, int alertType, int timeoutClear)
{
  gBackboneAlertLevel = clampRange(alertLevel, 0, 7);
  gBackboneAlertType = clampRange(alertType, 0, 7);
  gBackboneTimeoutClear = (timeoutClear == 1) ? 1 : 0;
  gBackboneAlertTsMs = getSimulationTimeMs();
}

void OnUdpReceiveFrom(dword socket, long result, dword address, dword port, char buffer[], dword count)
{
  int msgId;

  if (socket != gEthSocket)
  {
    return;
  }
  if (result == 0)
  {
    msgId = ethFrameMsgId(buffer, count);
    if (msgId == ethMsgSelectedAlert() && ethFramePayloadLen(count) >= 2)
    {
      updateBackboneAlertState(ethGetU8(buffer, 0) & 0x7,
                               (ethGetU8(buffer, 0) >> 3) & 0x7,
                               ethGetU8(buffer, 1) & 0x1);
    }
  }

  ethArmReceive(gEthSocket, gEthRxBuffer, elcount(gEthRxBuffer));
}

int useBackboneAlertState()
{
  dword nowMs;

  if (gBackboneAlertTsMs == 0)
  {
    return 0;
  }

  nowMs = getSimulationTimeMs();
  if ((nowMs - gBackboneAlertTsMs) > 500)
  {
    return 0;
  }

  return 1;
}

on start
{
  gEthSocket = ethOpenDefaultSocket();
  gEthTxSocket = ethOpenNodeSocket(getIviTxPort());
  gEthTargetIp = ethGetDefaultIpAddress();
  gLastWarningTextCode = -1;
  gInfoAliveCnt = 0;
  gIviBaseTick = 0;
  gEmsBlinkPhase = 0;
  gAmbientPulsePhase = 0;
  gIcFlowPhase = 0;
  gVehicleObjectPos = 0;
  gBackboneAlertLevel = 0;
  gBackboneAlertType = 0;
  gBackboneTimeoutClear = 0;
  gBackboneAlertTsMs = 0;
  @CoreState::infoHealthTick = 0;
  if (gEthTxSocket == ethInvalidSocket())
  {
    write("[IVI] tx socket fallback to shared backbone port");
  }
  if (gEthSocket != ethInvalidSocket())
  {
    ethStartReceiver(gEthSocket, gEthRxBuffer, elcount(gEthRxBuffer));
  }
  setTimer(tIviCycle, 10);
  setTimer(tIviBase50, 50);
  setTimer(tIviExt100, 100);
  write("[IVI] start");
}

on timer tIviCycle
{
  int alertLevel;
  int alertType;
  int timeoutClear;
  int emergencyType;
  int emergencyDirection;
  int warningTextCode;
  int speed;
  int emergencyDistanceM;
  int emergencyDistanceBand;
  int useBackbone;
  message frmClusterWarningMsg mCluster;

  useBackbone = useBackboneAlertState();
  if (useBackbone == 1)
  {
    alertLevel = gBackboneAlertLevel;
    alertType = gBackboneAlertType;
    timeoutClear = gBackboneTimeoutClear;
  }
  else
  {
    alertLevel = (int)@Core::selectedAlertLevel;
    alertType = (int)@Core::selectedAlertType;
    timeoutClear = (int)@Core::timeoutClear;
  }
  emergencyType = (int)@V2X::emergencyType;
  emergencyDirection = (int)@V2X::emergencyDirection;
  speed = clampRange((int)@Core::vehicleSpeedNorm, 0, 255);
  if (alertLevel < 0 || alertLevel > 7)
  {
    alertLevel = 0;
  }
  if (alertType < 0 || alertType > 7)
  {
    alertType = 0;
  }
  if (emergencyType < 0 || emergencyType > 2)
  {
    emergencyType = 0;
  }
  if (emergencyDirection < 0 || emergencyDirection > 3)
  {
    emergencyDirection = 0;
  }
  timeoutClear = (timeoutClear == 1) ? 1 : 0;
  emergencyDistanceM = calcEmergencyDistanceM((int)@V2X::eta, speed);
  emergencyDistanceBand = 0;
  if (emergencyDistanceM > 0)
  {
    if (emergencyDistanceM <= 80)
    {
      emergencyDistanceBand = 1;
    }
    else if (emergencyDistanceM <= 180)
    {
      emergencyDistanceBand = 2;
    }
    else
    {
      emergencyDistanceBand = 3;
    }
  }
  @CoreState::emergencyDistanceM = emergencyDistanceM;

  warningTextCode = deriveWarningTextCode(alertLevel, alertType, timeoutClear,
                                          emergencyType, emergencyDirection, emergencyDistanceBand);

  if (warningTextCode != gLastWarningTextCode)
  {
    mCluster.WarningTextCode = warningTextCode;
    output(mCluster);
    gLastWarningTextCode = warningTextCode;
  }
  setTimer(tIviCycle, 10);
}

on timer tIviBase50
{
  message frmClusterBaseStateMsg mBase;
  message frmClusterThemeMsg mTheme;
  message frmHmiPopupStateMsg mPopup;
  message frmAudioFocusMsg mAudio;
  message frmMediaStateMsg mMediaState;
  message frmCallStateMsg mCallState;
  message frmPhoneProjectionMsg mProjection;
  message frmClusterNotifMsg mNotif;
  message frmMediaMetaMsg mMedia;
  message frmClusterSyncStateMsg mSync;
  message frmInfotainmentHealthMsg mHealth;
  int speed;
  int driveState;
  int alertLevel;
  int alertType;
  int baseZoneContext;
  int roadZoneColorCode;
  int roadFlowDirection;
  int renderMode;
  int renderColor;
  int renderPattern;
  int renderTextCode;
  int renderDirection;
  int vehicleMotionStep;
  int displayModeSetting;
  int alertVolumeSetting;
  int effectiveVolume;
  int useBackbone;

  speed = clampRange((int)@Core::vehicleSpeedNorm, 0, 255);
  driveState = clampRange((int)@Core::driveStateNorm, 0, 3);
  useBackbone = useBackboneAlertState();
  if (useBackbone == 1)
  {
    alertLevel = clampRange(gBackboneAlertLevel, 0, 7);
    alertType = clampRange(gBackboneAlertType, 0, 15);
  }
  else
  {
    alertLevel = clampRange((int)@Core::selectedAlertLevel, 0, 7);
    alertType = clampRange((int)@Core::selectedAlertType, 0, 15);
  }
  baseZoneContext = clampRange((int)@Core::baseZoneContext, 0, 4);
  renderMode = clampRange((int)@Body::ambientMode, 0, 7);
  renderColor = clampRange((int)@Body::ambientColor, 0, 15);
  renderPattern = clampRange((int)@Body::ambientPattern, 0, 15);
  renderTextCode = clampRange((int)@Cluster::warningTextCode, 0, 65535);
  displayModeSetting = clampRange((int)@Test::displayModeSetting, 0, 3);
  alertVolumeSetting = clampRange((int)@Test::alertVolumeSetting, 0, 100);
  effectiveVolume = (alertVolumeSetting > 0) ? alertVolumeSetting : ((alertLevel > 0) ? 30 : 20);

  /* CLU owns the mirrored display state after consuming these frames. */

  mBase.ClusterSpeed = speed;
  mBase.ClusterGear = driveState;
  mBase.ClusterStatus = alertLevel;
  output(mBase);

  mTheme.ThemeMode = (displayModeSetting == 1) ? 2 : ((alertLevel > 0) ? 1 : 0);
  mTheme.ClusterBrightness = (alertLevel > 0) ? 28 : 20;
  output(mTheme);

  mPopup.PopupType = alertType;
  mPopup.PopupPriority = clampRange(alertLevel, 0, 7);
  mPopup.PopupActive = (alertLevel > 0) ? 1 : 0;
  if (displayModeSetting == 1)
  {
    mPopup.PopupActive = 1;
    mPopup.PopupPriority = 1;
  }
  else if (displayModeSetting == 2)
  {
    mPopup.PopupActive = 0;
  }
  else if (displayModeSetting == 3)
  {
    mPopup.PopupActive = (alertLevel > 0) ? 1 : 0;
    mPopup.PopupPriority = clampRange(alertLevel + 1, 0, 7);
  }
  output(mPopup);

  mAudio.AudioFocusOwner = (alertLevel > 0) ? 1 : 0;
  if (displayModeSetting == 1)
  {
    mAudio.AudioFocusOwner = 0;
  }
  else if (displayModeSetting == 2 || displayModeSetting == 3)
  {
    mAudio.AudioFocusOwner = (alertLevel > 0) ? 1 : 0;
  }
  mAudio.AudioDuckingLvl = (alertLevel > 0) ? 4 : 1;
  output(mAudio);

  mMediaState.MediaSource = 1;
  mMediaState.MediaState = 1;
  mMediaState.MuteState = 0;
  mMediaState.VolumeLevel = effectiveVolume;
  output(mMediaState);

  mCallState.CallState = 0;
  mCallState.MicMute = 0;
  mCallState.SignalQuality = 10;
  mCallState.BtDeviceCount = 1;
  output(mCallState);

  mProjection.ProjectionType = 1;
  mProjection.ProjectionState = 1;
  output(mProjection);

  mNotif.ClusterNotifType = alertType;
  mNotif.ClusterNotifArg = alertLevel;
  output(mNotif);

  mMedia.MediaTrackType = 1;
  mMedia.MediaRepeatMode = 0;
  mMedia.MediaShuffleMode = 0;
  mMedia.MediaRemainTime = 120;
  output(mMedia);

  mSync.ClusterSyncState = 1;
  mSync.ClusterSyncError = 0;
  mSync.ClusterSyncAge = 10;
  output(mSync);

  gIviBaseTick = gIviBaseTick + 1;
  if ((gIviBaseTick % 2) == 0)
  {
    mHealth.InfoAliveCnt = gInfoAliveCnt & 0xFF;
    mHealth.InfoFailCode = 0;
    output(mHealth);
    @CoreState::infoHealthTick = mHealth.InfoAliveCnt;
    gInfoAliveCnt = (gInfoAliveCnt + 1) & 0xFF;
  }

  if (baseZoneContext == 1)
  {
    roadZoneColorCode = 1;
  }
  else if (baseZoneContext == 2)
  {
    roadZoneColorCode = 2;
  }
  else if (baseZoneContext == 3 || baseZoneContext == 4)
  {
    roadZoneColorCode = 3;
  }
  else
  {
    roadZoneColorCode = 0;
  }

  if (baseZoneContext == 3)
  {
    roadFlowDirection = 1;
  }
  else if (baseZoneContext == 4)
  {
    roadFlowDirection = 2;
  }
  else
  {
    roadFlowDirection = 0;
  }

  vehicleMotionStep = 2;
  if (roadZoneColorCode == 1)
  {
    vehicleMotionStep = 1;
  }
  else if (roadZoneColorCode == 2)
  {
    vehicleMotionStep = 4;
  }
  else if (roadZoneColorCode == 3)
  {
    vehicleMotionStep = 6;
  }

  if (roadFlowDirection == 2)
  {
    gVehicleObjectPos = gVehicleObjectPos - vehicleMotionStep;
    if (gVehicleObjectPos < 0)
    {
      gVehicleObjectPos = gVehicleObjectPos + 101;
    }
  }
  else
  {
    gVehicleObjectPos = gVehicleObjectPos + vehicleMotionStep;
    if (gVehicleObjectPos > 100)
    {
      gVehicleObjectPos = gVehicleObjectPos - 101;
    }
  }

  if (alertLevel >= 6)
  {
    gEmsBlinkPhase = 1 - gEmsBlinkPhase;
  }
  else
  {
    gEmsBlinkPhase = 0;
  }

  if (alertType == 4)
  {
    gAmbientPulsePhase = (gAmbientPulsePhase + 1) & 3;
  }
  else
  {
    gAmbientPulsePhase = 0;
  }

  if (alertType == 5 || alertType == 6)
  {
    gIcFlowPhase = (gIcFlowPhase + 1) & 7;
  }
  else
  {
    gIcFlowPhase = 0;
  }

  renderDirection = deriveRenderDirection(renderTextCode, alertType);
  @UiRender::renderMode = renderMode;
  @UiRender::renderColor = renderColor;
  @UiRender::renderPattern = renderPattern;
  @UiRender::renderTextCode = renderTextCode;
  @UiRender::renderDirection = renderDirection;
  @UiRender::roadZoneColorCode = roadZoneColorCode;
  @UiRender::roadFlowDirection = roadFlowDirection;
  @UiRender::vehicleObjectPos = clampRange(gVehicleObjectPos, 0, 100);
  @UiRender::emsBlinkPhase = gEmsBlinkPhase;
  @UiRender::ambientPulsePhase = gAmbientPulsePhase;
  @UiRender::icFlowPhase = gIcFlowPhase;
  @UiRender::activeAlertType = clampRange(alertType, 0, 7);

  setTimer(tIviBase50, 50);
}

on timer tIviExt100
{
  message frmConnectivityStateMsg mConn;
  message frmIviHealthDetailMsg mHealthDetail;
  int speedLimit;

  speedLimit = clampRange((int)@Core::speedLimitNorm, 0, 255);
  if (speedLimit == 0)
  {
    speedLimit = 30;
  }

  mConn.ConnectivityType = 1;
  mConn.ConnectivityState = 1;
  mConn.SignalBars = 4;
  output(mConn);

  mHealthDetail.IviCpuLoad = (speedLimit > 100) ? 45 : 35;
  mHealthDetail.IviMemLoad = 40;
  output(mHealthDetail);

  publishBackboneNavContext();


  setTimer(tIviExt100, 100);
}

on stopMeasurement
{
  cancelTimer(tIviCycle);
  cancelTimer(tIviBase50);
  cancelTimer(tIviExt100);
  ethCloseSocket(gEthTxSocket);
  gEthTxSocket = ethInvalidSocket();
  ethCloseSocket(gEthSocket);
  gEthSocket = ethInvalidSocket();
}
