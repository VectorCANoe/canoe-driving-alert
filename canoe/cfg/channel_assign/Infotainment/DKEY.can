includes
{
  #include "..\\common\\CAPL_COMMON.cin"
}

variables
{
  msTimer tDigitalKeyCycle;
  int gTmuServiceMode;
  int gSignalBars;
  int gKeySyncAge;
  dword gTmuServiceRxMs;
  int gLastTmuInputStale;
  int gLastDkeyState;
  int gLastAuthMode;
  int gLastAccessState;
  int gLastSecurityGrade;
}

void traceDkeyInputHealth(int tmuInputStale)
{
  if (tmuInputStale != gLastTmuInputStale)
  {
    if (tmuInputStale == 1)
    {
      write("[DKEY] tmu input stale");
    }
    else
    {
      write("[DKEY] tmu input restored");
    }
    gLastTmuInputStale = tmuInputStale;
  }
}

void publishDigitalKeyState()
{
  message frmDigitalKeyStateMsg mDkey;
  int tmuInputStale;
  int failSafeMode;
  int driveState;
  int timeoutClear;
  int tmuServiceMode;
  int signalBars;
  int dkeyState;
  int authMode;
  int accessState;
  int securityGrade;
  int keyPresence;

  tmuInputStale = (ethIsRecentTick(gTmuServiceRxMs, 300) == 1) ? 0 : 1;
  traceDkeyInputHealth(tmuInputStale);

  failSafeMode = clampRange((int)@Core::failSafeMode, 0, 2);
  driveState = clampRange((int)@Core::driveStateNorm, 0, 3);
  timeoutClear = clampRange((int)@Core::timeoutClear, 0, 1);
  tmuServiceMode = gTmuServiceMode;
  signalBars = gSignalBars;
  if (tmuInputStale == 1)
  {
    tmuServiceMode = 0;
    signalBars = 0;
  }

  dkeyState = 0;
  if (tmuServiceMode > 0 && signalBars >= 1)
  {
    dkeyState = 1;
  }
  if (driveState == 0 && failSafeMode == 0 && timeoutClear == 0 && tmuServiceMode == 1 && signalBars >= 3)
  {
    dkeyState = 2;
  }
  else if (driveState > 0 && tmuServiceMode > 0)
  {
    dkeyState = 3;
  }

  authMode = 0;
  if (tmuServiceMode > 0)
  {
    authMode = 1;
  }
  if (dkeyState == 2 && signalBars >= 3)
  {
    authMode = 2;
  }

  accessState = 0;
  if (dkeyState == 1)
  {
    accessState = 1;
  }
  else if (dkeyState == 2)
  {
    accessState = 2;
  }
  else if (dkeyState == 3)
  {
    accessState = 3;
  }

  if (dkeyState == 2)
  {
    gKeySyncAge = 0;
  }
  else
  {
    gKeySyncAge = clampRange(gKeySyncAge + 5, 0, 255);
  }

  securityGrade = 0;
  if (failSafeMode > 0 || timeoutClear == 1)
  {
    securityGrade = 2;
  }
  else if (signalBars >= 3 && tmuServiceMode == 1)
  {
    securityGrade = 1;
  }

  keyPresence = (tmuServiceMode > 0 && signalBars > 0) ? 1 : 0;

  mDkey.DKeyState = clampRange(dkeyState, 0, 7);
  mDkey.AuthMode = clampRange(authMode, 0, 3);
  mDkey.VehicleAccessState = clampRange(accessState, 0, 7);
  mDkey.KeySyncAge = clampRange(gKeySyncAge, 0, 255);
  mDkey.SecurityGrade = clampRange(securityGrade, 0, 15);
  mDkey.KeyPresence = clampRange(keyPresence, 0, 1);
  output(mDkey);

  if (mDkey.DKeyState != gLastDkeyState ||
      mDkey.AuthMode != gLastAuthMode ||
      mDkey.VehicleAccessState != gLastAccessState ||
      mDkey.SecurityGrade != gLastSecurityGrade)
  {
    write("[DKEY] state=%d auth=%d access=%d grade=%d syncAge=%d bars=%d drive=%d",
          mDkey.DKeyState,
          mDkey.AuthMode,
          mDkey.VehicleAccessState,
          mDkey.SecurityGrade,
          mDkey.KeySyncAge,
          signalBars,
          driveState);
    gLastDkeyState = mDkey.DKeyState;
    gLastAuthMode = mDkey.AuthMode;
    gLastAccessState = mDkey.VehicleAccessState;
    gLastSecurityGrade = mDkey.SecurityGrade;
  }
}

on start
{
  gTmuServiceMode = 0;
  gSignalBars = 0;
  gKeySyncAge = 0;
  gTmuServiceRxMs = 0;
  gLastTmuInputStale = 0;
  gLastDkeyState = -1;
  gLastAuthMode = -1;
  gLastAccessState = -1;
  gLastSecurityGrade = -1;
  setTimer(tDigitalKeyCycle, 100);
  write("[DKEY] start");
}

on timer tDigitalKeyCycle
{
  publishDigitalKeyState();
  setTimer(tDigitalKeyCycle, 100);
}

on message frmTmuServiceStateMsg
{
  gTmuServiceMode = clampRange((int)this.TmuServiceMode, 0, 3);
  gSignalBars = clampRange((int)this.SignalBars, 0, 15);
  gTmuServiceRxMs = getSimulationTimeMs();
}

on stopMeasurement
{
  cancelTimer(tDigitalKeyCycle);
}
