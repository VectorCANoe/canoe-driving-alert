includes
{
  #include "..\\common\\CAPL_COMMON.cin"
}

variables
{
  msTimer tNavModuleCycle;
  int gRoadZone;
  int gNavDirection;
  int gZoneDistance;
  int gSpeedLimit;
  dword gNavInputTouchMs;
  int gNavInputDirty;
  int gLastNavInputStale;
  int gLastNavState;
  int gLastRouteClass;
  int gLastGuideType;
  int gLastEtaMinutes;
}

int calcBaseZoneContext(int roadZone, int navDirection)
{
  if (roadZone == 1)
  {
    return 1;
  }
  if (roadZone == 2)
  {
    return 2;
  }
  if (roadZone == 3)
  {
    return (navDirection == 2) ? 4 : 3;
  }
  return 0;
}

int calcEffectiveSpeedLimit(int speedLimit)
{
  speedLimit = clampRange(speedLimit, 0, 255);
  if (speedLimit == 0)
  {
    return 30;
  }
  return speedLimit;
}

int hasNavContext(int roadZone, int navDirection, int zoneDistance, int speedLimit)
{
  if (roadZone > 0 || navDirection > 0 || zoneDistance > 0 || speedLimit > 0)
  {
    return 1;
  }
  return 0;
}

int navLeaseWindowMs()
{
  return 2000;
}

void markNavInputDirty()
{
  gNavInputTouchMs = getSimulationTimeMs();
  gNavInputDirty = 1;
}

void latchNavInputs()
{
  int roadZone;
  int navDirection;
  int zoneDistance;
  int speedLimit;

  roadZone = clampRange((int)@Infotainment::roadZone, 0, 3);
  navDirection = clampRange((int)@Infotainment::navDirection, 0, 3);
  zoneDistance = clampRange((int)@Infotainment::zoneDistance, 0, 255);
  speedLimit = clampRange((int)@Infotainment::speedLimit, 0, 255);

  if (hasNavContext(roadZone, navDirection, zoneDistance, speedLimit) == 1)
  {
    gRoadZone = roadZone;
    gNavDirection = navDirection;
    gZoneDistance = zoneDistance;
    gSpeedLimit = speedLimit;
  }
  else
  {
    gRoadZone = 0;
    gNavDirection = 0;
    gZoneDistance = 0;
    gSpeedLimit = 0;
  }

  gNavInputDirty = 0;
}

void traceNavInputHealth(int navInputStale)
{
  if (navInputStale != gLastNavInputStale)
  {
    write("[NAV] input %s", navInputStale == 1 ? "stale" : "restored");
    gLastNavInputStale = navInputStale;
  }
}

void publishNavState()
{
  message frmNaviGuideStateMsg mGuide;
  message frmNavigationRouteMsg mRouteBase;
  message frmMapRenderStateMsg mMap;
  message frmRouteAlertMsg mRoute;
  message frmTrafficEventMsg mTraffic;
  message frmNavModuleStateMsg mNavState;
  int navInputStale;
  int navState;
  int etaMinutes;
  int trafficSeverity;
  int routeVisualActive;
  int speedLimit;

  navInputStale = 0;
  if (hasNavContext(gRoadZone, gNavDirection, gZoneDistance, gSpeedLimit) == 1 &&
      ethIsRecentTick(gNavInputTouchMs, navLeaseWindowMs()) == 0)
  {
    navInputStale = 1;
  }
  traceNavInputHealth(navInputStale);

  if (navInputStale == 1)
  {
    @Core::baseZoneContext = 0;
    @Core::speedLimitNorm = 30;
    return;
  }

  speedLimit = calcEffectiveSpeedLimit(gSpeedLimit);
  @Core::baseZoneContext = calcBaseZoneContext(gRoadZone, gNavDirection);
  @Core::speedLimitNorm = speedLimit;

  navState = (gRoadZone > 0) ? 1 : 0;
  if (gRoadZone == 3)
  {
    navState = 2;
  }
  if (gZoneDistance <= 15 && navState > 0)
  {
    navState = 3;
  }

  etaMinutes = clampRange(gZoneDistance / 10, 0, 255);
  trafficSeverity = (gRoadZone == 1) ? 3 : ((gRoadZone > 0) ? 2 : 0);
  routeVisualActive = (gRoadZone > 0 || gNavDirection > 0 || gZoneDistance > 0) ? 1 : 0;

  mMap.MapRenderState = routeVisualActive;
  mMap.ZoomLevel = (gRoadZone == 2) ? 12 : 16;
  mMap.TileLoadPercent = (routeVisualActive == 1) ? 95 : 70;
  output(mMap);

  mGuide.GuideLaneState = (gRoadZone == 3) ? gNavDirection : 0;
  mGuide.GuideConfidence = (gRoadZone == 3) ? 50 : ((routeVisualActive == 1) ? 20 : 0);
  output(mGuide);

  mRouteBase.RouteClass = gRoadZone;
  mRouteBase.GuideType = gNavDirection;
  mRouteBase.RouteProgress = (routeVisualActive == 1) ? ((gZoneDistance > 100) ? 20 : 80) : 0;
  mRouteBase.EtaMinutes = etaMinutes;
  output(mRouteBase);

  mRoute.RouteAlertType = gRoadZone;
  mRoute.RouteAlertPrio = (gRoadZone == 1) ? 5 : ((gRoadZone > 0) ? 2 : 0);
  mRoute.RouteAlertActive = (gRoadZone > 0) ? 1 : 0;
  mRoute.RouteAlertEta = gZoneDistance;
  output(mRoute);

  mTraffic.TrafficEventType = gRoadZone;
  mTraffic.TrafficSeverity = trafficSeverity;
  mTraffic.TrafficDistance = gZoneDistance;
  output(mTraffic);

  mNavState.NavSessionState = clampRange(navState, 0, 3);
  mNavState.NavRouteClass = clampRange(gRoadZone, 0, 3);
  mNavState.NavGuideType = clampRange(gNavDirection, 0, 3);
  mNavState.NavTrafficSeverity = clampRange(trafficSeverity, 0, 3);
  mNavState.NavEtaMinutes = etaMinutes;
  mNavState.NavSpeedLimit = clampRange(speedLimit, 0, 255);
  output(mNavState);

  if (mNavState.NavSessionState != gLastNavState ||
      mNavState.NavRouteClass != gLastRouteClass ||
      mNavState.NavGuideType != gLastGuideType ||
      mNavState.NavEtaMinutes != gLastEtaMinutes)
  {
    write("[NAV] state=%d class=%d guide=%d eta=%d dist=%d limit=%d",
          mNavState.NavSessionState,
          mNavState.NavRouteClass,
          mNavState.NavGuideType,
          mNavState.NavEtaMinutes,
          gZoneDistance,
          speedLimit);
    gLastNavState = mNavState.NavSessionState;
    gLastRouteClass = mNavState.NavRouteClass;
    gLastGuideType = mNavState.NavGuideType;
    gLastEtaMinutes = mNavState.NavEtaMinutes;
  }
}

on start
{
  gRoadZone = 0;
  gNavDirection = 0;
  gZoneDistance = 0;
  gSpeedLimit = 0;
  gNavInputTouchMs = 0;
  gNavInputDirty = 0;
  gLastNavInputStale = 0;
  gLastNavState = -1;
  gLastRouteClass = -1;
  gLastGuideType = -1;
  gLastEtaMinutes = -1;
  markNavInputDirty();
  latchNavInputs();
  setTimer(tNavModuleCycle, 100);
  write("[NAV] start");
}

on timer tNavModuleCycle
{
  if (gNavInputDirty == 1)
  {
    latchNavInputs();
  }
  publishNavState();
  setTimer(tNavModuleCycle, 100);
}

on message frmNavContextCanMsg
{
  @Infotainment::roadZone = clampRange((int)this.gRoadZone, 0, 3);
  @Infotainment::navDirection = clampRange((int)this.gNavDirection, 0, 3);
  @Infotainment::zoneDistance = clampRange((int)this.gZoneDistance, 0, 255);
  @Infotainment::speedLimit = clampRange((int)this.gSpeedLimit, 0, 255);
  markNavInputDirty();
  latchNavInputs();
}

on sysvar Infotainment::roadZone
{
  markNavInputDirty();
}

on sysvar Infotainment::navDirection
{
  markNavInputDirty();
}

on sysvar Infotainment::zoneDistance
{
  markNavInputDirty();
}

on sysvar Infotainment::speedLimit
{
  markNavInputDirty();
}

on stopMeasurement
{
  cancelTimer(tNavModuleCycle);
}

