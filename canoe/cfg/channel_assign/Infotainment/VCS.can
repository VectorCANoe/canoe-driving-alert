includes
{
  #include "..\\common\\CAPL_COMMON.cin"
}

variables
{
  msTimer tVoiceCycle;
  int gAudioFocusOwner;
  int gAudioDuckingLvl;
  int gTmuServiceMode;
  int gSignalBars;
  int gLastVoiceAssistState;
  int gLastWakeWordState;
  int gLastTtsState;
  int gLastTtsPriority;
  int gLastTtsQueueDepth;
}

void publishVoiceAssistState()
{
  message frmVoiceAssistStateMsg mVoice;
  message frmSpeechTtsStateMsg mTts;
  int alertLevel;
  int displayModeSetting;
  int voiceAssistState;
  int wakeWordState;
  int ttsState;
  int ttsPriority;
  int ttsQueueDepth;

  alertLevel = clampRange((int)@Core::selectedAlertLevel, 0, 7);
  displayModeSetting = clampRange((int)@Test::displayModeSetting, 0, 3);

  voiceAssistState = 0;
  if (gTmuServiceMode > 0)
  {
    voiceAssistState = 1;
  }
  if (gAudioFocusOwner > 0)
  {
    voiceAssistState = 2;
  }

  wakeWordState = 0;
  if (gTmuServiceMode == 1 && gSignalBars >= 2)
  {
    wakeWordState = 1;
  }

  ttsState = 0;
  if (alertLevel > 0 && displayModeSetting != 1)
  {
    ttsState = 1;
  }

  ttsPriority = 0;
  if (ttsState > 0)
  {
    ttsPriority = alertLevel;
    if (gAudioDuckingLvl >= 4 && ttsPriority < 4)
    {
      ttsPriority = 4;
    }
  }

  ttsQueueDepth = (ttsState > 0) ? 1 : 0;

  mVoice.VoiceAssistState = clampRange(voiceAssistState, 0, 7);
  mVoice.WakeWordState = clampRange(wakeWordState, 0, 1);
  output(mVoice);

  mTts.TtsState = clampRange(ttsState, 0, 7);
  mTts.TtsPriority = clampRange(ttsPriority, 0, 7);
  mTts.TtsQueueDepth = clampRange(ttsQueueDepth, 0, 255);
  output(mTts);

  if (mVoice.VoiceAssistState != gLastVoiceAssistState ||
      mVoice.WakeWordState != gLastWakeWordState ||
      mTts.TtsState != gLastTtsState ||
      mTts.TtsPriority != gLastTtsPriority ||
      mTts.TtsQueueDepth != gLastTtsQueueDepth)
  {
    write("[VCS] voice=%d wake=%d tts=%d prio=%d q=%d focus=%d duck=%d service=%d bars=%d",
          mVoice.VoiceAssistState,
          mVoice.WakeWordState,
          mTts.TtsState,
          mTts.TtsPriority,
          mTts.TtsQueueDepth,
          gAudioFocusOwner,
          gAudioDuckingLvl,
          gTmuServiceMode,
          gSignalBars);
    gLastVoiceAssistState = mVoice.VoiceAssistState;
    gLastWakeWordState = mVoice.WakeWordState;
    gLastTtsState = mTts.TtsState;
    gLastTtsPriority = mTts.TtsPriority;
    gLastTtsQueueDepth = mTts.TtsQueueDepth;
  }
}

on start
{
  gAudioFocusOwner = 0;
  gAudioDuckingLvl = 0;
  gTmuServiceMode = 0;
  gSignalBars = 0;
  gLastVoiceAssistState = -1;
  gLastWakeWordState = -1;
  gLastTtsState = -1;
  gLastTtsPriority = -1;
  gLastTtsQueueDepth = -1;
  setTimer(tVoiceCycle, 50);
  write("[VCS] start");
}

on timer tVoiceCycle
{
  publishVoiceAssistState();
  setTimer(tVoiceCycle, 50);
}

on message frmAudioFocusMsg
{
  gAudioFocusOwner = clampRange((int)this.AudioFocusOwner, 0, 7);
  gAudioDuckingLvl = clampRange((int)this.AudioDuckingLvl, 0, 7);
}

on message frmTmuServiceStateMsg
{
  gTmuServiceMode = clampRange((int)this.TmuServiceMode, 0, 3);
  gSignalBars = clampRange((int)this.SignalBars, 0, 15);
}

on stopMeasurement
{
  cancelTimer(tVoiceCycle);
}

