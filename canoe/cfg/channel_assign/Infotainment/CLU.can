includes
{
  #include "..\\common\\CAPL_COMMON.cin"
}

variables
{
  const int CLU_BACKBONE_ALERT_FRESHNESS_MS = 500;
  const int CLU_DISPLAY_MODE_OFFSET_ALT_1 = 40;
  const int CLU_DISPLAY_MODE_OFFSET_ALT_2 = 80;
  const int CLU_EFFECTIVE_VOLUME_MIN = 15;
  const int CLU_EFFECTIVE_VOLUME_HIGH = 70;
  const int CLU_EFFECTIVE_VOLUME_CODE_BONUS = 5;
  const int CLU_AUDIO_DUCKING_ALERT_THRESHOLD = 4;
  const int CLU_TTS_ACTIVE_THRESHOLD = 1;
  const int CLU_AUDIO_ACTIVITY_CODE_BONUS = 6;
  const int CLU_POPUP_PRIORITY_SUPPRESS_THRESHOLD = 5;
  const int CLU_POPUP_CODE_SUPPRESS_MAX = 100;
  const int CLU_POPUP_LEVEL_SUPPRESS_MAX = 5;
  const int CLU_CLUSTER_SYNC_AGE_STALE_THRESHOLD = 50;
  const int CLU_SYNC_RECOVERY_NOTIF_PRIORITY = 6;
  const int CLU_DUPLICATE_GUARD_MS = 1000;
  const int CLU_DUPLICATE_GUARD_TIMER_MS = 100;
  const int CLU_DEFAULT_VOLUME_LEVEL = 30;
  const int CLU_HISTORY_CAPACITY = 16;
  const int CLU_HISTORY_RING_MASK = 15;
  const int CLU_HISTORY_QUERY_MAX_OFFSET = 15;

  msTimer tDuplicateGuard;
  long gEthSocket;
  dword gEthTargetIp;
  char gEthRxBuffer[64];
  int gLastDisplayedCode;
  dword gLastDisplayMs;
  int gBaseClusterSpeed;
  int gBaseClusterGear;
  int gBaseClusterStatus;
  int gLastBaseSyncState;
  int gLastBaseSyncError;
  int gThemeMode;
  int gPopupType;
  int gPopupPriority;
  int gPopupActive;
  int gVolumeLevel;
  int gAudioFocusOwner;
  int gAudioDuckingLvl;
  int gTtsState;
  int gNotifType;
  int gNotifArg;
  int gClusterSyncState;
  int gClusterSyncSeq;
  int gHistoryCodes[CLU_HISTORY_CAPACITY];
  int gHistorySnaps[CLU_HISTORY_CAPACITY];
  int gHistoryWriteIdx;
  int gHistoryCount;
  int gBackboneAlertLevel;
  int gBackboneAlertType;
  int gBackboneTimeoutClear;
  dword gBackboneAlertTsMs;
}

int useBackboneAlertState()
{
  dword nowMs;

  if (gBackboneAlertTsMs == 0)
  {
    return 0;
  }

  nowMs = getSimulationTimeMs();
  if ((nowMs - gBackboneAlertTsMs) > CLU_BACKBONE_ALERT_FRESHNESS_MS)
  {
    return 0;
  }

  return 1;
}

void updateBackboneAlertState(int alertLevel, int alertType, int timeoutClear)
{
  gBackboneAlertLevel = clampRange(alertLevel, 0, 7);
  gBackboneAlertType = clampRange(alertType, 0, 7);
  gBackboneTimeoutClear = (timeoutClear == 1) ? 1 : 0;
  gBackboneAlertTsMs = getSimulationTimeMs();
}

int calcEffectiveVolume(int volumeSetting)
{
  if (volumeSetting > 0)
  {
    return volumeSetting;
  }

  return gVolumeLevel;
}

int applyModeDisplayOffset(int code, int modeSetting)
{
  int coded;

  coded = code;
  if (modeSetting == 2)
  {
      coded = clampRange(code + CLU_DISPLAY_MODE_OFFSET_ALT_1, 0, 255);
  }
  else if (modeSetting == 3)
  {
      coded = clampRange(code + CLU_DISPLAY_MODE_OFFSET_ALT_2, 0, 255);
  }

  return coded;
}

int applyVolumeDisplayBias(int code, int coded, int modeSetting, int effectiveVolume)
{
  int adjustedCode;

  adjustedCode = coded;
  if (modeSetting != 1)
  {
    if (gAudioFocusOwner == 0 || effectiveVolume < CLU_EFFECTIVE_VOLUME_MIN)
    {
      adjustedCode = code;
    }
    else if (effectiveVolume >= CLU_EFFECTIVE_VOLUME_HIGH)
    {
      adjustedCode = clampRange(coded + CLU_EFFECTIVE_VOLUME_CODE_BONUS, 0, 255);
    }
  }

  return adjustedCode;
}

int getRobustPolicySelectedAlertLevel()
{
  if (useBackboneAlertState() == 1)
  {
    return clampRange(gBackboneAlertLevel, 0, 7);
  }

  return clampRange((int)@Core::selectedAlertLevel, 0, 7);
}

int getRobustPolicySelectedAlertType()
{
  if (useBackboneAlertState() == 1)
  {
    return clampRange(gBackboneAlertType, 0, 15);
  }

  return clampRange((int)@Core::selectedAlertType, 0, 15);
}

int getRobustPolicyTimeoutClear()
{
  if (useBackboneAlertState() == 1)
  {
    return (gBackboneTimeoutClear == 1) ? 1 : 0;
  }

  return (((int)@Core::timeoutClear) == 1) ? 1 : 0;
}

int calcExpectedWarningCode(int selectedAlertLevel, int selectedAlertType, int timeoutClear)
{
  if (timeoutClear == 0 && selectedAlertLevel > 0)
  {
    return clampRange((selectedAlertType * 10) + selectedAlertLevel, 0, 255);
  }

  return 0;
}

int shouldForceExpectedWarningCode(int coded, int selectedAlertLevel)
{
  if (selectedAlertLevel > 0 &&
      (gClusterSyncState == 0 || gClusterSyncSeq > CLU_CLUSTER_SYNC_AGE_STALE_THRESHOLD || coded == 0))
  {
    return 1;
  }

  return 0;
}

void elevateClusterNotifPriorityForSyncRecovery()
{
  @CoreState::clusterNotifPrio = clampRange((int)@CoreState::clusterNotifPrio, 0, 255);
  if ((int)@CoreState::clusterNotifPrio < CLU_SYNC_RECOVERY_NOTIF_PRIORITY)
  {
    @CoreState::clusterNotifPrio = CLU_SYNC_RECOVERY_NOTIF_PRIORITY;
  }
}

void clearDisplayedWarningState()
{
  cancelTimer(tDuplicateGuard);
  gLastDisplayedCode = 0;
  gLastDisplayMs = 0;
  @CoreState::duplicatePopupGuard = 0;
  @Cluster::warningTextCode = 0;
}

int calcGuardRemainMsForCode(int code, dword nowMs)
{
  dword elapsedMs;

  if (code == gLastDisplayedCode)
  {
    elapsedMs = nowMs - gLastDisplayMs;
    if (elapsedMs < CLU_DUPLICATE_GUARD_MS)
    {
      return CLU_DUPLICATE_GUARD_MS - (int)elapsedMs;
    }

    gLastDisplayMs = nowMs;
    return CLU_DUPLICATE_GUARD_MS;
  }

  gLastDisplayedCode = code;
  gLastDisplayMs = nowMs;
  return CLU_DUPLICATE_GUARD_MS;
}

void publishDisplayedWarningState(int code, int guardRemainMs)
{
  @Cluster::warningTextCode = code;
  @CoreState::duplicatePopupGuard = guardRemainMs;
  if (guardRemainMs > 0)
  {
    setTimer(tDuplicateGuard, CLU_DUPLICATE_GUARD_TIMER_MS);
  }
}

void updateWarningHistoryIfChanged(int code, int prevCode)
{
  if (code != prevCode)
  {
    pushHistory(code);
    respondHistoryQuery();
  }
}

void logDisplayedWarningState(int code, int rawCode)
{
  write("[CLU] warning code=%d raw=%d focus=%d duck=%d tts=%d popup=%d/%d sync=%d age=%d",
        code, rawCode, gAudioFocusOwner, gAudioDuckingLvl, gTtsState,
        gPopupPriority, gPopupActive, gClusterSyncState, gClusterSyncSeq);
}

void OnUdpReceiveFrom(dword socket, long result, dword address, dword port, char buffer[], dword count)
{
  int msgId;

  if (socket != gEthSocket)
  {
    return;
  }
  if (result == 0)
  {
    msgId = ethFrameMsgId(buffer, count);
    if (msgId == ethMsgSelectedAlert() && ethFramePayloadLen(count) >= 2)
    {
      updateBackboneAlertState(ethGetU8(buffer, 0) & 0x7,
                               (ethGetU8(buffer, 0) >> 3) & 0x7,
                               ethGetU8(buffer, 1) & 0x1);
    }
  }

  ethArmReceive(gEthSocket, gEthRxBuffer, elcount(gEthRxBuffer));
}


int applyDisplayPolicy(int code)
{
  int modeSetting;
  int volumeSetting;
  int effectiveVolume;
  int coded;

  if (code <= 0)
  {
    return 0;
  }

  modeSetting = clampRange((int)@Test::displayModeSetting, 0, 3);
  volumeSetting = clampRange((int)@Test::alertVolumeSetting, 0, 100);
  effectiveVolume = calcEffectiveVolume(volumeSetting);
  coded = applyModeDisplayOffset(code, modeSetting);
  coded = applyVolumeDisplayBias(code, coded, modeSetting, effectiveVolume);

  return coded;
}

int applyRobustPolicy(int code)
{
  int selectedAlertLevel;
  int selectedAlertType;
  int timeoutClear;
  int expectedCode;
  int coded;

  coded = code;
  if (coded <= 0)
  {
    return 0;
  }

  if (gAudioFocusOwner != 0 &&
      (gAudioDuckingLvl >= CLU_AUDIO_DUCKING_ALERT_THRESHOLD ||
       gTtsState >= CLU_TTS_ACTIVE_THRESHOLD))
  {
    coded = clampRange(coded + CLU_AUDIO_ACTIVITY_CODE_BONUS, 0, 255);
  }

  if (gPopupActive == 1 &&
      gPopupPriority >= CLU_POPUP_PRIORITY_SUPPRESS_THRESHOLD &&
      coded < CLU_POPUP_CODE_SUPPRESS_MAX &&
      (coded % 10) < CLU_POPUP_LEVEL_SUPPRESS_MAX)
  {
      coded = 0;
  }

  selectedAlertLevel = getRobustPolicySelectedAlertLevel();
  selectedAlertType = getRobustPolicySelectedAlertType();
  timeoutClear = getRobustPolicyTimeoutClear();
  expectedCode = calcExpectedWarningCode(selectedAlertLevel, selectedAlertType, timeoutClear);

  if (shouldForceExpectedWarningCode(coded, selectedAlertLevel) == 1 &&
      expectedCode > 0)
  {
    coded = expectedCode;
    elevateClusterNotifPriorityForSyncRecovery();
  }

  return coded;
}

void pushHistory(int code)
{
  int snap;

  if (code <= 0)
  {
    return;
  }

  snap = clampRange((int)@CoreState::arbitrationSnapshotId, 0, 65535);
  gHistoryCodes[gHistoryWriteIdx] = code;
  gHistorySnaps[gHistoryWriteIdx] = snap;
  gHistoryWriteIdx = (gHistoryWriteIdx + 1) & CLU_HISTORY_RING_MASK;
  if (gHistoryCount < CLU_HISTORY_CAPACITY)
  {
    gHistoryCount = gHistoryCount + 1;
  }

  @CoreState::alertHistoryCount = ((int)@CoreState::alertHistoryCount + 1) & 0xFFFF;
}

void respondHistoryQuery()
{
  int queryOffset;
  int idx;
  int pos;
  int response;

  queryOffset = clampRange((int)@Test::historyQueryOffset, 0, CLU_HISTORY_QUERY_MAX_OFFSET);
  response = 0;

  if (gHistoryCount > 0)
  {
    idx = queryOffset;
    if (idx >= gHistoryCount)
    {
      idx = gHistoryCount - 1;
    }
    pos = gHistoryWriteIdx - 1 - idx;
    if (pos < 0)
    {
      pos = pos + CLU_HISTORY_CAPACITY;
    }
    response = gHistoryCodes[pos];
  }

  @Test::historyQueryCode = response;
}

on start
{
  int i;

  gEthSocket = ethOpenDefaultSocket();
  gEthTargetIp = ethGetDefaultIpAddress();
  gLastDisplayedCode = 0;
  gLastDisplayMs = 0;
  gBaseClusterSpeed = 0;
  gBaseClusterGear = 0;
  gBaseClusterStatus = 0;
  gLastBaseSyncState = -1;
  gLastBaseSyncError = -1;
  gThemeMode = 0;
  gPopupType = 0;
  gPopupPriority = 0;
  gPopupActive = 0;
  gVolumeLevel = CLU_DEFAULT_VOLUME_LEVEL;
  gAudioFocusOwner = 0;
  gAudioDuckingLvl = 0;
  gTtsState = 0;
  gNotifType = 0;
  gNotifArg = 0;
  gClusterSyncState = 1;
  gClusterSyncSeq = 0;
  gHistoryWriteIdx = 0;
  gHistoryCount = 0;
  gBackboneAlertLevel = 0;
  gBackboneAlertType = 0;
  gBackboneTimeoutClear = 0;
  gBackboneAlertTsMs = 0;
  if (gEthSocket != ethInvalidSocket())
  {
    ethStartReceiver(gEthSocket, gEthRxBuffer, elcount(gEthRxBuffer));
  }
  for (i = 0; i < CLU_HISTORY_CAPACITY; i = i + 1)
  {
    gHistoryCodes[i] = 0;
    gHistorySnaps[i] = 0;
  }
  @CoreState::duplicatePopupGuard = 0;
  @CoreState::themeMode = 0;
  @CoreState::popupType = 0;
  @CoreState::popupPriority = 0;
  @CoreState::popupActive = 0;
  @CoreState::volumeLevel = CLU_DEFAULT_VOLUME_LEVEL;
  @CoreState::audioFocusOwner = 0;
  @CoreState::audioDuckingLvl = 0;
  @CoreState::ttsState = 0;
  @CoreState::clusterNotifType = 0;
  @CoreState::clusterNotifPrio = 0;
  @CoreState::clusterSyncState = 1;
  @CoreState::clusterSyncSeq = 0;
  @CoreState::alertHistoryCount = 0;
  @Test::historyQueryCode = 0;
  write("[CLU] start");
}

on message frmClusterBaseStateMsg
{
  gBaseClusterSpeed = clampRange((int)this.ClusterSpeed, 0, 255);
  gBaseClusterGear = clampRange((int)this.ClusterGear, 0, 15);
  gBaseClusterStatus = clampRange((int)this.ClusterStatus, 0, 15);
}

on message frmClusterThemeMsg
{
  gThemeMode = clampRange((int)this.ThemeMode, 0, 7);
  @CoreState::themeMode = gThemeMode;
}

on message frmHmiPopupStateMsg
{
  gPopupType = clampRange((int)this.PopupType, 0, 15);
  gPopupPriority = clampRange((int)this.PopupPriority, 0, 7);
  gPopupActive = clampRange((int)this.PopupActive, 0, 1);
  @CoreState::popupType = gPopupType;
  @CoreState::popupPriority = gPopupPriority;
  @CoreState::popupActive = gPopupActive;
}

on message frmMediaStateMsg
{
  gVolumeLevel = clampRange((int)this.VolumeLevel, 0, 100);
  @CoreState::volumeLevel = gVolumeLevel;
}

on message frmAudioFocusMsg
{
  gAudioFocusOwner = clampRange((int)this.AudioFocusOwner, 0, 7);
  gAudioDuckingLvl = clampRange((int)this.AudioDuckingLvl, 0, 7);
  @CoreState::audioFocusOwner = gAudioFocusOwner;
  @CoreState::audioDuckingLvl = gAudioDuckingLvl;
}

on message frmSpeechTtsStateMsg
{
  gTtsState = clampRange((int)this.TtsState, 0, 7);
  @CoreState::ttsState = gTtsState;
}

on message frmClusterSyncStateMsg
{
  gClusterSyncState = clampRange((int)this.ClusterSyncState, 0, 15);
  gClusterSyncSeq = clampRange((int)this.ClusterSyncAge, 0, 255);
  @CoreState::clusterSyncState = gClusterSyncState;
  @CoreState::clusterSyncSeq = gClusterSyncSeq;
  if (gClusterSyncState != gLastBaseSyncState ||
      (int)this.ClusterSyncError != gLastBaseSyncError)
  {
    write("[CLU] base sync state=%d err=%d age=%d spd=%d gear=%d status=%d",
          gClusterSyncState, (int)this.ClusterSyncError, gClusterSyncSeq,
          gBaseClusterSpeed, gBaseClusterGear, gBaseClusterStatus);
    gLastBaseSyncState = gClusterSyncState;
    gLastBaseSyncError = (int)this.ClusterSyncError;
  }
}

on stopMeasurement
{
  cancelTimer(tDuplicateGuard);
  ethCloseSocket(gEthSocket);
  gEthSocket = ethInvalidSocket();
}

on message frmClusterNotifMsg
{
  gNotifType = clampRange((int)this.ClusterNotifType, 0, 255);
  gNotifArg = clampRange((int)this.ClusterNotifArg, 0, 255);
  @CoreState::clusterNotifType = gNotifType;
  @CoreState::clusterNotifPrio = gNotifArg;
}

on message frmClusterWarningMsg
{
  int code;
  int rawCode;
  int prevCode;
  int guardRemainMs;
  dword nowMs;

  // Normalize the incoming warning code through display policies.
  prevCode = gLastDisplayedCode;
  rawCode = clampRange((int)this.WarningTextCode, 0, 255);
  code = applyDisplayPolicy(rawCode);
  code = applyRobustPolicy(code);
  nowMs = getSimulationTimeMs();
  guardRemainMs = 0;

  // Clear the display state and duplicate guard when the code is zero.
  if (code == 0)
  {
    clearDisplayedWarningState();
    write("[CLU] clear");
  }
  else
  {
    // Recalculate the remaining guard time and publish the new display state.
    guardRemainMs = calcGuardRemainMsForCode(code, nowMs);
    publishDisplayedWarningState(code, guardRemainMs);
    updateWarningHistoryIfChanged(code, prevCode);
    logDisplayedWarningState(code, rawCode);
  }
}

on sysvar Test::historyQueryOffset
{
  // Recompute the history response when the query offset changes.
  respondHistoryQuery();
  write("[CLU] history query offset=%d code=%d",
        (int)@Test::historyQueryOffset, (int)@Test::historyQueryCode);
}

on timer tDuplicateGuard
{
  int guardRemainMs;
  dword nowMs;
  dword elapsedMs;

  // Drop the guard state immediately if no code is being displayed.
  if (gLastDisplayedCode == 0)
  {
    @CoreState::duplicatePopupGuard = 0;
    return;
  }

  // Compute the remaining guard time from the last display timestamp.
  nowMs = getSimulationTimeMs();
  elapsedMs = nowMs - gLastDisplayMs;
  if (elapsedMs >= CLU_DUPLICATE_GUARD_MS)
  {
    guardRemainMs = 0;
  }
  else
  {
    guardRemainMs = CLU_DUPLICATE_GUARD_MS - (int)elapsedMs;
  }

  // Reschedule the timer while guard time remains.
  @CoreState::duplicatePopupGuard = guardRemainMs;
  if (guardRemainMs > 0)
  {
    setTimer(tDuplicateGuard, CLU_DUPLICATE_GUARD_TIMER_MS);
  }
}
