includes
{
  #include "..\\common\\CAPL_COMMON.cin"
}

variables
{
  msTimer tHudCycle;
  int gDiagPending;
  int gLastDiagSid;
  int gLastDiagDidHigh;
  int gLastDiagDidLow;
  int gWarningCode;
  int gPopupPriority;
  int gPopupActive;
  int gGuideType;
  int gThemeMode;
  int gBrightness;
  int gLastHudMode;
  int gLastHudWarning;
  int gLastHudGuide;
  int gLastHudBrightness;
}

void publishHudState()
{
  message frmHudStateMsg mHud;
  int hudMode;
  int hudBrightness;

  hudMode = 0;
  if (gPopupActive == 1 && gPopupPriority >= 5)
  {
    hudMode = 2;
  }
  else if (gWarningCode > 0)
  {
    hudMode = 1;
  }
  else if (gGuideType > 0)
  {
    hudMode = 3;
  }

  hudBrightness = gBrightness;
  if (hudBrightness <= 0)
  {
    hudBrightness = 18;
  }
  if (gPopupActive == 1 && hudBrightness < 24)
  {
    hudBrightness = 24;
  }

  mHud.HudMode = clampRange(hudMode, 0, 7);
  mHud.HudWarningCode = clampRange(gWarningCode, 0, 255);
  mHud.HudGuideType = clampRange(gGuideType, 0, 15);
  mHud.HudBrightness = clampRange(hudBrightness, 0, 31);
  output(mHud);

  if (mHud.HudMode != gLastHudMode ||
      mHud.HudWarningCode != gLastHudWarning ||
      mHud.HudGuideType != gLastHudGuide ||
      mHud.HudBrightness != gLastHudBrightness)
  {
    write("[HUD] mode=%d warn=%d guide=%d bright=%d theme=%d popup=%d/%d",
          mHud.HudMode,
          mHud.HudWarningCode,
          mHud.HudGuideType,
          mHud.HudBrightness,
          gThemeMode,
          gPopupPriority,
          gPopupActive);
    gLastHudMode = mHud.HudMode;
    gLastHudWarning = mHud.HudWarningCode;
    gLastHudGuide = mHud.HudGuideType;
    gLastHudBrightness = mHud.HudBrightness;
  }
}

on start
{
  gDiagPending = 0;
  gLastDiagSid = 0;
  gLastDiagDidHigh = 0;
  gLastDiagDidLow = 0;
  gWarningCode = 0;
  gPopupPriority = 0;
  gPopupActive = 0;
  gGuideType = 0;
  gThemeMode = 0;
  gBrightness = 18;
  gLastHudMode = -1;
  gLastHudWarning = -1;
  gLastHudGuide = -1;
  gLastHudBrightness = -1;
  setTimer(tHudCycle, 50);
  write("[HUD] start");
}

on timer tHudCycle
{
  publishHudState();
  if (gDiagPending == 1)
  {
    message frmHudDiagResMsg mDiagRes;
    mDiagRes.HudDiagRespCode = (gLastDiagSid == 0x22) ? 0x62 : 0x7F;
    mDiagRes.HudDiagData0 = gLastDiagDidHigh;
    mDiagRes.HudDiagData1 = gLastDiagDidLow;
    output(mDiagRes);
    gDiagPending = 0;
  }
  setTimer(tHudCycle, 50);
}

on message frmClusterWarningMsg
{
  gWarningCode = clampRange((int)this.WarningTextCode, 0, 255);
}

on message frmHmiPopupStateMsg
{
  gPopupPriority = clampRange((int)this.PopupPriority, 0, 7);
  gPopupActive = clampRange((int)this.PopupActive, 0, 1);
}

on message frmNavigationRouteMsg
{
  gGuideType = clampRange((int)this.GuideType, 0, 3);
}

on message frmClusterThemeMsg
{
  gThemeMode = clampRange((int)this.ThemeMode, 0, 7);
  gBrightness = clampRange((int)this.ClusterBrightness, 0, 31);
}

on message frmHudDiagReqMsg
{
  gLastDiagSid = (int)this.HudDiagServiceId;
  gLastDiagDidHigh = (int)this.HudDiagDidHigh;
  gLastDiagDidLow = (int)this.HudDiagDidLow;
  gDiagPending = 1;
}

on stopMeasurement
{
  cancelTimer(tHudCycle);
}
