includes
{
  #include "..\\common\\CAPL_COMMON.cin"
}

variables
{
  msTimer tPgsCycle;
  int gParkActive;
  int gMinDistance;
  int gZoneMask;
  dword gParkAssistRxMs;
  int gLastParkAssistInputStale;
  int gLastActive;
  int gLastGuide;
  int gLastQuality;
}

void tracePgsInputHealth(int parkAssistInputStale)
{
  if (parkAssistInputStale != gLastParkAssistInputStale)
  {
    if (parkAssistInputStale == 1)
    {
      write("[PGS] park-ultrasonic input stale");
    }
    else
    {
      write("[PGS] park-ultrasonic input restored");
    }
    gLastParkAssistInputStale = parkAssistInputStale;
  }
}

on start
{
  gParkActive = 0;
  gMinDistance = 255;
  gZoneMask = 0;
  gParkAssistRxMs = 0;
  gLastParkAssistInputStale = 0;
  gLastActive = -1;
  gLastGuide = -1;
  gLastQuality = -1;
  setTimer(tPgsCycle, 100);
  write("[PGS] start");
}

on message frmParkUltrasonicStateMsg
{
  gParkActive = clampRange((int)this.ParkAssistActive, 0, 1);
  gMinDistance = clampRange((int)this.MinDistanceCm, 0, 255);
  gZoneMask = clampRange((int)this.ZoneMask, 0, 255);
  gParkAssistRxMs = getSimulationTimeMs();
}

on timer tPgsCycle
{
  message frmPgsStateMsg mPgs;
  int parkAssistInputStale;
  int speed;
  int parkActive;
  int minDistance;
  int zoneMask;
  int guideMode;
  int quality;

  parkAssistInputStale = (ethIsRecentTick(gParkAssistRxMs, 300) == 1) ? 0 : 1;
  tracePgsInputHealth(parkAssistInputStale);

  speed = clampRange((int)@Core::vehicleSpeedNorm, 0, 255);
  parkActive = gParkActive;
  minDistance = gMinDistance;
  zoneMask = gZoneMask;
  if (parkAssistInputStale == 1)
  {
    parkActive = 0;
    minDistance = 255;
    zoneMask = 0;
  }

  guideMode = 0;
  if (parkActive == 1)
  {
    guideMode = (zoneMask > 0) ? 2 : 1;
  }
  quality = (parkActive == 1) ? clampRange(100 - (minDistance / 2), 0, 100) : 0;
  if (speed > 15)
  {
    quality = 0;
    guideMode = 0;
  }

  mPgs.PgsActive = (guideMode > 0) ? 1 : 0;
  mPgs.GuideMode = clampRange(guideMode, 0, 3);
  mPgs.TrajectoryQuality = clampRange(quality, 0, 100);
  output(mPgs);

  if (mPgs.PgsActive != gLastActive ||
      mPgs.GuideMode != gLastGuide ||
      mPgs.TrajectoryQuality != gLastQuality)
  {
    write("[PGS] active=%d guide=%d quality=%d dist=%d speed=%d",
          mPgs.PgsActive,
          mPgs.GuideMode,
          mPgs.TrajectoryQuality,
          minDistance,
          speed);
    gLastActive = mPgs.PgsActive;
    gLastGuide = mPgs.GuideMode;
    gLastQuality = mPgs.TrajectoryQuality;
  }

  setTimer(tPgsCycle, 100);
}

on stopMeasurement
{
  cancelTimer(tPgsCycle);
}
