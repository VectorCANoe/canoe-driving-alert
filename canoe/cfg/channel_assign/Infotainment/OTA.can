includes
{
  #include "..\\common\\CAPL_COMMON.cin"
}

variables
{
  msTimer tOtaCycle;
  int gConnType;
  int gConnState;
  int gSignalBars;
  int gIviCpuLoad;
  int gIviMemLoad;
  int gTmuServiceMode;
  int gDownloadPercent;
  int gLastSessionState;
  int gLastPackageReady;
  int gLastWindowOpen;
}

void publishOtaState()
{
  message frmOtaMasterStateMsg mOta;
  int failSafeMode;
  int driveState;
  int sessionState;
  int packageReady;
  int updateWindowOpen;
  int rolloutStage;

  failSafeMode = clampRange((int)@Core::failSafeMode, 0, 2);
  driveState = clampRange((int)@Core::driveStateNorm, 0, 3);

  packageReady = (gTmuServiceMode == 1 &&
                  gConnState > 0 &&
                  gSignalBars >= 2 &&
                  gIviCpuLoad < 80 &&
                  gIviMemLoad < 80) ? 1 : 0;

  updateWindowOpen = (driveState == 0 && failSafeMode == 0) ? 1 : 0;

  sessionState = 0;
  if (failSafeMode > 0 || gConnState == 0)
  {
    sessionState = 3;
  }
  else if (packageReady == 1 && updateWindowOpen == 1)
  {
    sessionState = 2;
  }
  else if (packageReady == 1 || gConnState > 0)
  {
    sessionState = 1;
  }

  if (sessionState == 2)
  {
    gDownloadPercent = clampRange(gDownloadPercent + 10, 0, 100);
  }
  else if (sessionState == 1)
  {
    gDownloadPercent = 0;
  }
  else if (sessionState == 3)
  {
    gDownloadPercent = 0;
  }

  {
  }
  {
  }

  rolloutStage = 0;
  if (gDownloadPercent >= 100)
  {
    rolloutStage = 3;
  }
  else if (gDownloadPercent >= 60)
  {
    rolloutStage = 2;
  }
  else if (gDownloadPercent > 0)
  {
    rolloutStage = 1;
  }

  mOta.OtaSessionState = clampRange(sessionState, 0, 3);
  mOta.PackageReady = clampRange(packageReady, 0, 1);
  mOta.UpdateWindowOpen = clampRange(updateWindowOpen, 0, 1);
  mOta.OtaTargetDomain = 1;
  mOta.DownloadPercent = clampRange(gDownloadPercent, 0, 100);
  mOta.OtaRolloutStage = clampRange(rolloutStage, 0, 15);
  output(mOta);

  if (mOta.OtaSessionState != gLastSessionState ||
      mOta.PackageReady != gLastPackageReady ||
      mOta.UpdateWindowOpen != gLastWindowOpen)
  {
    gLastSessionState = mOta.OtaSessionState;
    gLastPackageReady = mOta.PackageReady;
    gLastWindowOpen = mOta.UpdateWindowOpen;
  }
}

on start
{
  gConnType = 0;
  gConnState = 0;
  gSignalBars = 0;
  gIviCpuLoad = 0;
  gIviMemLoad = 0;
  gTmuServiceMode = 0;
  gDownloadPercent = 0;
  gLastSessionState = -1;
  gLastPackageReady = -1;
  gLastWindowOpen = -1;
  setTimer(tOtaCycle, 100);
  write("[OTA] start");
}

on timer tOtaCycle
{
  publishOtaState();
  setTimer(tOtaCycle, 100);
}

on message frmConnectivityStateMsg
{
  gConnType = clampRange((int)this.ConnectivityType, 0, 7);
  gConnState = clampRange((int)this.ConnectivityState, 0, 7);
  gSignalBars = clampRange((int)this.SignalBars, 0, 15);
}

on message frmIviHealthDetailMsg
{
  gIviCpuLoad = clampRange((int)this.IviCpuLoad, 0, 100);
  gIviMemLoad = clampRange((int)this.IviMemLoad, 0, 100);
}

on message frmTmuServiceStateMsg
{
  gTmuServiceMode = clampRange((int)this.TmuServiceMode, 0, 3);
}

on stopMeasurement
{
  cancelTimer(tOtaCycle);
}

