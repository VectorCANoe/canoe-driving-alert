includes
{
  #include "..\\common\\CAPL_COMMON.cin"
}

variables
{
  msTimer tTmuCycle;
  int gConnType;
  int gConnState;
  int gSignalBars;
  int gIviCpuLoad;
  int gIviMemLoad;
  int gLastLinkState;
  int gLastServiceMode;
  int gLastRemoteClimateReq;
  int gLastDiagState;
  int gDiagPending;
  int gLastDiagSid;
  int gLastDiagDidHigh;
  int gLastDiagDidLow;
}

void publishTmuState()
{
  message frmTmuServiceStateMsg mTmu;
  int failSafeMode;
  int linkState;
  int serviceMode;
  int remoteClimateReq;
  int diagState;

  failSafeMode = clampRange((int)@Core::failSafeMode, 0, 2);

  linkState = 0;
  if (gConnState > 0)
  {
    linkState = 1;
    if (gSignalBars >= 3)
    {
      linkState = 2;
    }
  }

  serviceMode = 0;
  if (linkState > 0)
  {
    serviceMode = 1;
  }
  if (failSafeMode > 0)
  {
    serviceMode = 2;
  }

  diagState = 0;
  if (gIviCpuLoad >= 85 || gIviMemLoad >= 85)
  {
    diagState = 2;
  }
  else if (gIviCpuLoad >= 60 || gIviMemLoad >= 60)
  {
    diagState = 1;
  }

  remoteClimateReq = 0;
  if (serviceMode == 1 && gConnType == 1 && gSignalBars >= 3)
  {
    remoteClimateReq = 1;
  }

  mTmu.TmuLinkState = linkState;
  mTmu.TmuServiceMode = serviceMode;
  mTmu.RemoteClimateReq = remoteClimateReq;
  mTmu.SignalBars = clampRange(gSignalBars, 0, 15);
  mTmu.TmuDiagState = diagState;
  output(mTmu);

  if (linkState != gLastLinkState ||
      serviceMode != gLastServiceMode ||
      remoteClimateReq != gLastRemoteClimateReq ||
      diagState != gLastDiagState)
  {
    write("[TMU] link=%d service=%d remoteClimate=%d diag=%d bars=%d cpu=%d mem=%d",
          linkState,
          serviceMode,
          remoteClimateReq,
          diagState,
          gSignalBars,
          gIviCpuLoad,
          gIviMemLoad);
    gLastLinkState = linkState;
    gLastServiceMode = serviceMode;
    gLastRemoteClimateReq = remoteClimateReq;
    gLastDiagState = diagState;
  }
}

on start
{
  gConnType = 0;
  gConnState = 0;
  gSignalBars = 0;
  gIviCpuLoad = 0;
  gIviMemLoad = 0;
  gLastLinkState = -1;
  gLastServiceMode = -1;
  gLastRemoteClimateReq = -1;
  gLastDiagState = -1;
  gDiagPending = 0;
  gLastDiagSid = 0;
  gLastDiagDidHigh = 0;
  gLastDiagDidLow = 0;

  setTimer(tTmuCycle, 100);
  write("[TMU] start");
}

on timer tTmuCycle
{
  if (gDiagPending == 1)
  {
    message frmTmuDiagResMsg mDiagRes;

    mDiagRes.TmuDiagRespCode = (gLastDiagSid == 0x22) ? 0x62 : 0x7F;
    mDiagRes.TmuDiagData0 = gLastDiagDidHigh;
    mDiagRes.TmuDiagData1 = gLastDiagDidLow;
    output(mDiagRes);
    gDiagPending = 0;
  }

  publishTmuState();
  setTimer(tTmuCycle, 100);
}

on message frmConnectivityStateMsg
{
  gConnType = clampRange((int)this.ConnectivityType, 0, 7);
  gConnState = clampRange((int)this.ConnectivityState, 0, 7);
  gSignalBars = clampRange((int)this.SignalBars, 0, 15);
}

on message frmIviHealthDetailMsg
{
  gIviCpuLoad = clampRange((int)this.IviCpuLoad, 0, 100);
  gIviMemLoad = clampRange((int)this.IviMemLoad, 0, 100);
}

on message frmTmuDiagReqMsg
{
  gLastDiagSid = clampRange((int)this.TmuDiagServiceId, 0, 255);
  gLastDiagDidHigh = clampRange((int)this.TmuDiagDidHigh, 0, 255);
  gLastDiagDidLow = clampRange((int)this.TmuDiagDidLow, 0, 255);
  gDiagPending = 1;
}

on stopMeasurement
{
  cancelTimer(tTmuCycle);
}
