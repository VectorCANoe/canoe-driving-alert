/*@!Encoding:65001*/
// ACCEL_CTRL.can  (cfg/channel_assign — CANoe 실제 로드 파일)
// Chassis Domain — 버튼 직접 읽기 + 드라이브 모드 체크 + CC
// 입력  : @Body::AccelButton, @Body::BrakeButton (Panel 버튼 직접)
//         @Chassis::driveMode (from TCM bridge)
//         @Chassis::ccActive, @Chassis::ccTargetSpeed (Panel CC)
// 출력  : @Chassis::vehicleSpeed, @Chassis::throttlePosition, @Chassis::brakePressure
//         frmVehicleStateCanMsg

includes
{
}

variables
{
  msTimer tAccelCycle;
  double  gSpeed;
  int     gAccelPedal;    // 0-100, ramped (+5/-3 per 100ms)
  int     gBrakePedal;    // 0-100, ramped (+10/-8 per 100ms)
  int     gCCActive;
  double  gCCTargetSpeed;
}

on start
{
  gSpeed         = 0.0;
  gAccelPedal    = 0;
  gBrakePedal    = 0;
  gCCActive      = 0;
  gCCTargetSpeed = 0.0;
  setTimer(tAccelCycle, 100);
  write("[ACCEL_CTRL] start — button-driven physics + CC");
}

// CC 버튼 변경 시 즉시 처리
on sysvar Chassis::ccActive
{
  if (@Chassis::ccActive == 0)
  {
    gCCActive = 0;
    write("[CC] OFF");
  }
  else
  {
    if ((int)@Chassis::driveMode == 3)
    {
      gCCActive      = 1;
      gCCTargetSpeed = (double)@Chassis::ccTargetSpeed;
      write("[CC] ON — target=%.1f km/h", gCCTargetSpeed);
    }
    else
    {
      @Chassis::ccActive = 0;
      gCCActive = 0;
      write("[CC] REJECTED — D gear required");
    }
  }
}

on timer tAccelCycle
{
  message frmVehicleStateCanMsg mState;
  int    driveMode;
  int    accelBtn;
  int    brakeBtn;

  driveMode = (int)@Chassis::driveMode;
  accelBtn  = (int)@Body::AccelButton;
  brakeBtn  = (int)@Body::BrakeButton;

  // ── 페달 램프 ─────────────────────────────────────────────────────
  // 액셀: 누름 +5 / 해제 -3 (0->100 약 2초 — 페달 느낌용)
  if (accelBtn > 0)
  {
    gAccelPedal += 5;
    if (gAccelPedal > 100) gAccelPedal = 100;
  }
  else
  {
    gAccelPedal -= 3;
    if (gAccelPedal < 0) gAccelPedal = 0;
  }

  // 브레이크: 누름 +20 / 해제 -10 (즉각 반응)
  if (brakeBtn > 0)
  {
    gBrakePedal += 20;
    if (gBrakePedal > 100) gBrakePedal = 100;
  }
  else
  {
    gBrakePedal -= 10;
    if (gBrakePedal < 0) gBrakePedal = 0;
  }

  // sysvar 업데이트 (패널 표시용)
  @Chassis::throttlePosition = gAccelPedal;
  @Chassis::brakePressure    = gBrakePedal;

  // ── CC 취소 조건 ──────────────────────────────────────────────────
  if (gBrakePedal > 5 && gCCActive == 1)
  {
    gCCActive          = 0;
    @Chassis::ccActive = 0;
    write("[CC] CANCELLED — brake");
  }
  if (driveMode != 3 && gCCActive == 1)
  {
    gCCActive          = 0;
    @Chassis::ccActive = 0;
    write("[CC] CANCELLED — gear change");
  }

  // ── 속도 계산 (100ms 주기) ────────────────────────────────────────
  // 물리 기준 (실시간 모드 기준): 풀액셀 0->100 약 250초 | 풀브레이크 100->0 약 50초
  // ※ CANoe 시뮬레이션 속도가 빠를수록 이 값은 더 빠르게 동작함
  if (gBrakePedal > 5)
  {
    // 제동: 페달 비례, 풀브레이크 -0.1 km/h per 100ms
    gSpeed -= ((double)gBrakePedal / 100.0) * 0.1;
    if (gSpeed < 0.0) gSpeed = 0.0;
  }
  else if (gCCActive == 1)
  {
    // CC 유지: ±0.05 km/h per 100ms
    if      (gSpeed < gCCTargetSpeed - 0.05) gSpeed += 0.05;
    else if (gSpeed > gCCTargetSpeed + 0.05) gSpeed -= 0.05;
  }
  else if (gAccelPedal > 0 && (driveMode == 3 || driveMode == 1))
  {
    // 가속: 페달 비례, 풀액셀 +0.04 km/h per 100ms
    gSpeed += ((double)gAccelPedal / 100.0) * 0.04;
    if (driveMode == 1 && gSpeed > 30.0)  gSpeed = 30.0;   // R 최대 30
    if (driveMode == 3 && gSpeed > 200.0) gSpeed = 200.0;  // D 최대 200
  }
  else
  {
    // 코스팅: -0.002 km/h per 100ms
    gSpeed -= 0.002;
    if (gSpeed < 0.0) gSpeed = 0.0;
  }
  // ──────────────────────────────────────────────────────────────────

  @Chassis::vehicleSpeed = (int)gSpeed;

  mState.gVehicleSpeed = (int)gSpeed;
  mState.gDriveState   = ((int)gSpeed == 0) ? 0 : 3;
  output(mState);

  setTimer(tAccelCycle, 100);
}
