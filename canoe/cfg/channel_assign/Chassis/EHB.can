includes
{
  #include "..\\common\\CAPL_COMMON.cin"
}

variables
{
  int gDiagPending;
  int gLastDiagSid;
  int gLastDiagDidHigh;
  int gLastDiagDidLow;
  msTimer tEhbCycle;
  int gBrakePressure;
  int gLastCtrlState;
  int gLastPressureCmd;
}

on start
{
  gDiagPending = 0;
  gLastDiagSid = 0;
  gLastDiagDidHigh = 0;
  gLastDiagDidLow = 0;
  gBrakePressure = 0;
  gLastCtrlState = -1;
  gLastPressureCmd = -1;
  setTimer(tEhbCycle, 100);
  write("[EHB] start");
}

on message frmBrakeStatusMsg
{
  gBrakePressure = clampRange((int)this.BrakePressure, 0, 255);
}

on timer tEhbCycle
{
  if (gDiagPending == 1)
  {
    message frmEhbDiagResMsg mDiagRes;

    mDiagRes.EhbDiagRespCode = getBasicDiagRespCode(gLastDiagSid);
    mDiagRes.EhbDiagData0 = gLastDiagDidHigh;
    mDiagRes.EhbDiagData1 = gLastDiagDidLow;
    output(mDiagRes);
    gDiagPending = 0;
  }

  message frmEhbStateMsg mEhb;
  int ctrlState;

  ctrlState = (gBrakePressure > 0) ? 1 : 0;
  if ((int)@Core::decelAssistReq == 1)
  {
    ctrlState = 2;
  }

  mEhb.EhbCtrlState = clampRange(ctrlState, 0, 7);
  mEhb.EhbPressureCmd = gBrakePressure;
  output(mEhb);

  if (mEhb.EhbCtrlState != gLastCtrlState ||
      mEhb.EhbPressureCmd != gLastPressureCmd)
  {
    write("[EHB] state=%d pressure=%d", mEhb.EhbCtrlState, mEhb.EhbPressureCmd);
    gLastCtrlState = mEhb.EhbCtrlState;
    gLastPressureCmd = mEhb.EhbPressureCmd;
  }

  setTimer(tEhbCycle, 100);
}

on message frmEhbDiagReqMsg
{
  gLastDiagSid = clampRange((int)this.EhbDiagServiceId, 0, 255);
  gLastDiagDidHigh = clampRange((int)this.EhbDiagDidHigh, 0, 255);
  gLastDiagDidLow = clampRange((int)this.EhbDiagDidLow, 0, 255);
  gDiagPending = 1;
}

on stopMeasurement
{
  cancelTimer(tEhbCycle);
}
