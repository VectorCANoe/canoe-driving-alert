/*@!Encoding:949*/
includes
{
  #include "..\\common\\CAPL_COMMON.cin"
}

variables
{
  msTimer tOdsCycle;
  int gPassengerSeatBelt;
  int gPassengerSeatPos;
  int gLastDetected;
  int gLastWeightClass;
  int gLastSuppress;
  int gLastChildSeat;
}

on start
{
  gPassengerSeatBelt = 1;
  gPassengerSeatPos = 118;
  gLastDetected = -1;
  gLastWeightClass = -1;
  gLastSuppress = -1;
  gLastChildSeat = -1;
  setTimer(tOdsCycle, 100);
  write("[ODS] start");
}

on message frmSeatBeltStateMsg
{
  gPassengerSeatBelt = clampRange((int)this.PassengerSeatBelt, 0, 1);
}

on message frmSeatStateMsg
{
  gPassengerSeatPos = clampRange((int)this.PassengerSeatPos, 0, 255);
}

on timer tOdsCycle
{
  message frmOdsStateMsg mOds;
  int occupantDetected;
  int weightClass;
  int airbagSuppress;
  int childSeatDetected;


  occupantDetected = (gPassengerSeatPos > 20) ? 1 : 0;
  childSeatDetected = (occupantDetected == 1 && gPassengerSeatBelt == 0 && gPassengerSeatPos < 80) ? 1 : 0;
  if (occupantDetected == 0)
  {
    weightClass = 0;
  }
  else if (childSeatDetected == 1)
  {
    weightClass = 1;
  }
  else if (gPassengerSeatPos < 140)
  {
    weightClass = 2;
  }
  else
  {
    weightClass = 3;
  }
  airbagSuppress = (childSeatDetected == 1 || occupantDetected == 0) ? 1 : 0;

  mOds.OccupantDetected = occupantDetected;
  mOds.WeightClass = clampRange(weightClass, 0, 7);
  mOds.AirbagSuppress = airbagSuppress;
  mOds.ChildSeatDetected = childSeatDetected;
  output(mOds);

  if (mOds.OccupantDetected != gLastDetected ||
      mOds.WeightClass != gLastWeightClass ||
      mOds.AirbagSuppress != gLastSuppress ||
      mOds.ChildSeatDetected != gLastChildSeat)
  {
    write("[ODS] occ=%d class=%d suppress=%d child=%d pos=%d",
          mOds.OccupantDetected,
          mOds.WeightClass,
          mOds.AirbagSuppress,
          mOds.ChildSeatDetected,
          gPassengerSeatPos);
    gLastDetected = mOds.OccupantDetected;
    gLastWeightClass = mOds.WeightClass;
    gLastSuppress = mOds.AirbagSuppress;
    gLastChildSeat = mOds.ChildSeatDetected;
  }

  setTimer(tOdsCycle, 100);
}

on stopMeasurement
{
  cancelTimer(tOdsCycle);
}
