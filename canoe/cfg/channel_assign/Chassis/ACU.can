/*@!Encoding:949*/
includes
{
  #include "..\\common\\CAPL_COMMON.cin"
}

variables
{
  int gDiagPending;
  int gLastDiagSid;
  int gLastDiagDidHigh;
  int gLastDiagDidLow;
  msTimer tAcuCycle;
  int gDriverSeatBelt;
  int gPassengerSeatBelt;
  int gSeatBeltWarnLvl;
  int gLastArmed;
  int gLastSeverity;
  int gLastPretension;
  int gLastWarn;
}

on start
{
  gDiagPending = 0;
  gLastDiagSid = 0;
  gLastDiagDidHigh = 0;
  gLastDiagDidLow = 0;
  gDriverSeatBelt = 1;
  gPassengerSeatBelt = 1;
  gSeatBeltWarnLvl = 0;
  gLastArmed = -1;
  gLastSeverity = -1;
  gLastPretension = -1;
  gLastWarn = -1;
  setTimer(tAcuCycle, 100);
  write("[ACU] start");
}

on message frmSeatBeltStateMsg
{
  gDriverSeatBelt = clampRange((int)this.DriverSeatBelt, 0, 1);
  gPassengerSeatBelt = clampRange((int)this.PassengerSeatBelt, 0, 1);
  gSeatBeltWarnLvl = clampRange((int)this.SeatBeltWarnLvl, 0, 3);
}

on timer tAcuCycle
{
  message frmAcuStateMsg mAcu;
  int alertLevel;
  int deploymentArmed;
  int crashSeverity;
  int pretensionReq;
  int airbagWarn;
  
  if (gDiagPending == 1)
  {
    message frmAcuDiagResMsg mDiagRes;

    mDiagRes.AcuDiagRespCode = getBasicDiagRespCode(gLastDiagSid);
    mDiagRes.AcuDiagData0 = gLastDiagDidHigh;
    mDiagRes.AcuDiagData1 = gLastDiagDidLow;
    output(mDiagRes);
    gDiagPending = 0;
  }
  
  alertLevel = clampRange((int)@Core::selectedAlertLevel, 0, 7);
  deploymentArmed = (gDriverSeatBelt == 1 || gPassengerSeatBelt == 1) ? 1 : 0;
  crashSeverity = (alertLevel >= 6) ? 4 : ((alertLevel >= 4) ? 2 : 0);
  pretensionReq = (gSeatBeltWarnLvl >= 2 || alertLevel >= 6) ? 1 : 0;
  airbagWarn = (deploymentArmed == 0 && alertLevel >= 4) ? 1 : 0;

  mAcu.DeploymentArmed = deploymentArmed;
  mAcu.CrashSeverity = clampRange(crashSeverity, 0, 7);
  mAcu.PretensionReq = pretensionReq;
  mAcu.AirbagWarn = airbagWarn;
  output(mAcu);

  if (mAcu.DeploymentArmed != gLastArmed ||
      mAcu.CrashSeverity != gLastSeverity ||
      mAcu.PretensionReq != gLastPretension ||
      mAcu.AirbagWarn != gLastWarn)
  {
    write("[ACU] armed=%d sev=%d pretension=%d warn=%d alert=%d",
          mAcu.DeploymentArmed,
          mAcu.CrashSeverity,
          mAcu.PretensionReq,
          mAcu.AirbagWarn,
          alertLevel);
    gLastArmed = mAcu.DeploymentArmed;
    gLastSeverity = mAcu.CrashSeverity;
    gLastPretension = mAcu.PretensionReq;
    gLastWarn = mAcu.AirbagWarn;
  }

  setTimer(tAcuCycle, 100);
}

on message frmAcuDiagReqMsg
{
  gLastDiagSid = clampRange((int)this.AcuDiagServiceId, 0, 255);
  gLastDiagDidHigh = clampRange((int)this.AcuDiagDidHigh, 0, 255);
  gLastDiagDidLow = clampRange((int)this.AcuDiagDidLow, 0, 255);
  gDiagPending = 1;
}

on stopMeasurement
{
  cancelTimer(tAcuCycle);
}
