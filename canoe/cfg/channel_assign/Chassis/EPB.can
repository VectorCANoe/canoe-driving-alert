includes
{
  #include "..\\common\\CAPL_COMMON.cin"
}

variables
{
  int gDiagPending;
  int gLastDiagSid;
  int gLastDiagDidHigh;
  int gLastDiagDidLow;
  msTimer tEpbCycle;
  int gBrakePressure;
  int gBrakeMode;
  int gDriveState;
  int gLastState;
  int gLastWarn;
  int gLastForce;
}

void publishEpbState()
{
  message frmEpbStateMsg mEpb;
  int epbState;
  int epbWarn;
  int holdForce;

  epbState = 0;
  if (gDriveState == 0 && gBrakePressure > 20)
  {
    epbState = 2;
  }
  else if (gBrakeMode > 0)
  {
    epbState = 1;
  }

  epbWarn = 0;
  if (gBrakePressure > 180)
  {
    epbWarn = 2;
  }
  else if (gBrakePressure > 100)
  {
    epbWarn = 1;
  }

  holdForce = 0;
  if (epbState > 0)
  {
    holdForce = clampRange(gBrakePressure, 0, 255);
  }

  mEpb.EpbState = clampRange(epbState, 0, 3);
  mEpb.EpbWarnLevel = clampRange(epbWarn, 0, 3);
  mEpb.EpbHoldForce = clampRange(holdForce, 0, 255);
  output(mEpb);

  if (mEpb.EpbState != gLastState ||
      mEpb.EpbWarnLevel != gLastWarn ||
      mEpb.EpbHoldForce != gLastForce)
  {
    write("[EPB] state=%d warn=%d hold=%d pressure=%d drive=%d",
          mEpb.EpbState,
          mEpb.EpbWarnLevel,
          mEpb.EpbHoldForce,
          gBrakePressure,
          gDriveState);
    gLastState = mEpb.EpbState;
    gLastWarn = mEpb.EpbWarnLevel;
    gLastForce = mEpb.EpbHoldForce;
  }
}

on start
{
  gDiagPending = 0;
  gLastDiagSid = 0;
  gLastDiagDidHigh = 0;
  gLastDiagDidLow = 0;
  gBrakePressure = 0;
  gBrakeMode = 0;
  gDriveState = 0;
  gLastState = -1;
  gLastWarn = -1;
  gLastForce = -1;
  setTimer(tEpbCycle, 100);
  write("[EPB] start");
}

on timer tEpbCycle
{
  if (gDiagPending == 1)
  {
    message frmEpbDiagResMsg mDiagRes;

    mDiagRes.EpbDiagRespCode = getBasicDiagRespCode(gLastDiagSid);
    mDiagRes.EpbDiagData0 = gLastDiagDidHigh;
    mDiagRes.EpbDiagData1 = gLastDiagDidLow;
    output(mDiagRes);
    gDiagPending = 0;
  }

  publishEpbState();
  setTimer(tEpbCycle, 100);
}

on message frmBrakeStatusMsg
{
  gBrakePressure = clampRange((int)this.BrakePressure, 0, 255);
  gBrakeMode = clampRange((int)this.BrakeMode, 0, 3);
}

on message frmVehicleStateCanMsg
{
  gDriveState = clampRange((int)this.gDriveState, 0, 3);
}

on message frmEpbDiagReqMsg
{
  gLastDiagSid = clampRange((int)this.EpbDiagServiceId, 0, 255);
  gLastDiagDidHigh = clampRange((int)this.EpbDiagDidHigh, 0, 255);
  gLastDiagDidLow = clampRange((int)this.EpbDiagDidLow, 0, 255);
  gDiagPending = 1;
}

on stopMeasurement
{
  cancelTimer(tEpbCycle);
}
