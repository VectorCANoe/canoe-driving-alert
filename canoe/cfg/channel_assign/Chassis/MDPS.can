includes
{
  #include "..\\common\\CAPL_COMMON.cin"
}

variables
{
  msTimer tMdpsCycle;
  long gEthSocket;
  dword gEthTargetIp;
  int gIsSteeringInputActive;
  int gSpeedNorm;
  int gPrevIsSteeringInputActive;

  const int MDPS_BOOL_FALSE = 0;
  const int MDPS_BOOL_TRUE = 1;
  const int MDPS_MIN_VEHICLE_SPEED_KPH = 0;
  const int MDPS_MAX_VEHICLE_SPEED_KPH = 255;
  const int MDPS_MIN_STEERING_INPUT_FLAG = 0;
  const int MDPS_MAX_STEERING_INPUT_FLAG = 1;
  const int MDPS_STEERING_ANGLE_PER_INPUT = 30;
  const int MDPS_STEERING_TORQUE_PER_INPUT = 20;
  const int MDPS_HIGH_SPEED_THRESHOLD_KPH = 80;
  const int MDPS_ASSIST_LEVEL_HIGH_SPEED = 1;
  const int MDPS_ASSIST_LEVEL_LOW_SPEED = 2;
  const int MDPS_EPS_FAULT_NONE = 0;
  const int MDPS_EPS_TEMP_DEFAULT_C = 55;
  const int MDPS_STATUS_SENTINEL_UNINITIALIZED = -1;
  const int MDPS_TIMER_PERIOD_MS = 50;
}

int normalizeSteeringInputFlag(int steeringInputRawValue)
{
  return clampRange(steeringInputRawValue,
                    MDPS_MIN_STEERING_INPUT_FLAG,
                    MDPS_MAX_STEERING_INPUT_FLAG);
}

int deriveSteeringAngleRaw(int isSteeringInputActive)
{
  return isSteeringInputActive * MDPS_STEERING_ANGLE_PER_INPUT;
}

int deriveAssistLevel(int speedNorm)
{
  if (speedNorm > MDPS_HIGH_SPEED_THRESHOLD_KPH)
  {
    return MDPS_ASSIST_LEVEL_HIGH_SPEED;
  }

  return MDPS_ASSIST_LEVEL_LOW_SPEED;
}

int deriveSteeringTorque(int isSteeringInputActive)
{
  return isSteeringInputActive * MDPS_STEERING_TORQUE_PER_INPUT;
}

int isSteeringLogUpdateRequired(void)
{
  return (gIsSteeringInputActive != gPrevIsSteeringInputActive);
}

void publishBackboneSteeringState(void)
{
  char frame[3];

  ethInitFrame(frame, ethMsgSteering(), 1);
  ethSetU8(frame, 0, gIsSteeringInputActive);
  ethSendFrame(gEthSocket, gEthTargetIp, ethMsgSteering(), frame, 1);
}

on start
{
  gEthSocket = ethOpenDefaultSocket();
  gEthTargetIp = ethGetDefaultIpAddress();
  gIsSteeringInputActive = MDPS_BOOL_FALSE;
  gSpeedNorm = MDPS_MIN_VEHICLE_SPEED_KPH;
  gPrevIsSteeringInputActive = MDPS_STATUS_SENTINEL_UNINITIALIZED;
  setTimer(tMdpsCycle, MDPS_TIMER_PERIOD_MS);
  write("[MDPS] start");
}

on message frmSteeringCanMsg
{
  gIsSteeringInputActive = normalizeSteeringInputFlag((int)this.SteeringInput);
  @Core::steeringInputNorm = gIsSteeringInputActive;
}

on message frmVehicleStateCanMsg
{
  gSpeedNorm = clampRange((int)this.gVehicleSpeed,
                          MDPS_MIN_VEHICLE_SPEED_KPH,
                          MDPS_MAX_VEHICLE_SPEED_KPH);
}

on timer tMdpsCycle
{
  message frmSteeringStateCanMsg mSteerState;
  message frmSteeringTorqueMsg mSteerTorque;
  message frmEpsStateMsg mEps;
  int steeringAngleRaw;
  int assistLevel;
  int steeringTorque;

  steeringAngleRaw = deriveSteeringAngleRaw(gIsSteeringInputActive);
  assistLevel = deriveAssistLevel(gSpeedNorm);
  steeringTorque = deriveSteeringTorque(gIsSteeringInputActive);

  if (isSteeringLogUpdateRequired() == MDPS_BOOL_TRUE)
  {
    write("[MDPS] input=%d assist=%d angle=%d",
          gIsSteeringInputActive, assistLevel, steeringAngleRaw);
    gPrevIsSteeringInputActive = gIsSteeringInputActive;
  }

  mSteerState.SteeringState = gIsSteeringInputActive;
  output(mSteerState);

  mSteerTorque.SteeringTorque = steeringTorque;
  mSteerTorque.SteeringAssistLv = assistLevel;
  output(mSteerTorque);

  mEps.EpsAssistState = assistLevel;
  mEps.EpsFaultState = MDPS_EPS_FAULT_NONE;
  mEps.EpsTemp = MDPS_EPS_TEMP_DEFAULT_C;
  output(mEps);

  publishBackboneSteeringState();

  setTimer(tMdpsCycle, MDPS_TIMER_PERIOD_MS);
}

on stopMeasurement
{
  cancelTimer(tMdpsCycle);
  ethCloseSocket(gEthSocket);
  gEthSocket = ethInvalidSocket();
}
