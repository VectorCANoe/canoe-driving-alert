includes
{
  #include "..\\common\\CAPL_COMMON.cin"
}

variables
{
  int gDiagPending;
  int gLastDiagSid;
  int gLastDiagDidHigh;
  int gLastDiagDidLow;
  msTimer tSasCycle;
  int gSteeringInput;
  int gVehicleSpeed;
  int gLastAngle;
}

void publishSasState()
{
  message frmSteeringAngleMsg mSas;
  int steeringAngleRaw;

  steeringAngleRaw = gSteeringInput * 30;
  if (gVehicleSpeed > 90)
  {
    steeringAngleRaw = steeringAngleRaw * 2;
  }

  mSas.SteeringAngleRaw = clampRange(steeringAngleRaw, 0, 65535);
  output(mSas);

  if (mSas.SteeringAngleRaw != gLastAngle)
  {
    write("[SAS] angleRaw=%d input=%d speed=%d",
          mSas.SteeringAngleRaw,
          gSteeringInput,
          gVehicleSpeed);
    gLastAngle = mSas.SteeringAngleRaw;
  }
}

on start
{
  gDiagPending = 0;
  gLastDiagSid = 0;
  gLastDiagDidHigh = 0;
  gLastDiagDidLow = 0;
  gSteeringInput = 0;
  gVehicleSpeed = 0;
  gLastAngle = -1;
  setTimer(tSasCycle, 100);
  write("[SAS] start");
}

on timer tSasCycle
{
  if (gDiagPending == 1)
  {
    message frmSasDiagResMsg mDiagRes;

    mDiagRes.SasDiagRespCode = getBasicDiagRespCode(gLastDiagSid);
    mDiagRes.SasDiagData0 = gLastDiagDidHigh;
    mDiagRes.SasDiagData1 = gLastDiagDidLow;
    output(mDiagRes);
    gDiagPending = 0;
  }

  publishSasState();
  setTimer(tSasCycle, 100);
}

on message frmSteeringCanMsg
{
  gSteeringInput = clampRange((int)this.SteeringInput, 0, 1);
}

on message frmVehicleStateCanMsg
{
  gVehicleSpeed = clampRange((int)this.gVehicleSpeed, 0, 255);
}

on message frmSasDiagReqMsg
{
  gLastDiagSid = clampRange((int)this.SasDiagServiceId, 0, 255);
  gLastDiagDidHigh = clampRange((int)this.SasDiagDidHigh, 0, 255);
  gLastDiagDidLow = clampRange((int)this.SasDiagDidLow, 0, 255);
  gDiagPending = 1;
}

on stopMeasurement
{
  cancelTimer(tSasCycle);
}
