/*@!Encoding:949*/
includes
{
  #include "..\\common\\CAPL_COMMON.cin"
}

variables
{
  msTimer tVsmCycle;
  int gLastCtrlState;
  int gLastAlertLevel;
  int gLastIntervention;
}

on start
{
  gLastCtrlState = -1;
  gLastAlertLevel = -1;
  gLastIntervention = -1;
  setTimer(tVsmCycle, 100);
  write("[VSM] start");
}

on timer tVsmCycle
{
  message frmVsmStateMsg mVsm;
  int ctrlState;
  int alertLevel;
  int intervention;


  ctrlState = ((int)@Core::failSafeMode == 1) ? 2 : 1;
  alertLevel = clampRange((int)@Core::selectedAlertLevel, 0, 7);
  intervention = ((int)@Core::decelAssistReq == 1) ? 40 : 0;

  mVsm.VsmCtrlState = clampRange(ctrlState, 0, 7);
  mVsm.VsmAlertLevel = alertLevel;
  mVsm.VsmIntervention = clampRange(intervention, 0, 255);
  output(mVsm);

  if (mVsm.VsmCtrlState != gLastCtrlState ||
      mVsm.VsmAlertLevel != gLastAlertLevel ||
      mVsm.VsmIntervention != gLastIntervention)
  {
    write("[VSM] state=%d alert=%d intervention=%d",
          mVsm.VsmCtrlState,
          mVsm.VsmAlertLevel,
          mVsm.VsmIntervention);
    gLastCtrlState = mVsm.VsmCtrlState;
    gLastAlertLevel = mVsm.VsmAlertLevel;
    gLastIntervention = mVsm.VsmIntervention;
  }

  setTimer(tVsmCycle, 100);
}

on stopMeasurement
{
  cancelTimer(tVsmCycle);
}
