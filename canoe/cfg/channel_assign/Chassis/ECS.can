/*@!Encoding:949*/
includes
{
  #include "..\\common\\CAPL_COMMON.cin"
}

variables
{
  msTimer tEcsCycle;
  int gSuspensionMode;
  int gSuspensionLevel;
  int gDampingLevel;
  int gLastMode;
  int gLastHeight;
  int gLastDamping;
}

on start
{
  gSuspensionMode = 0;
  gSuspensionLevel = 8;
  gDampingLevel = 12;
  gLastMode = -1;
  gLastHeight = -1;
  gLastDamping = -1;
  setTimer(tEcsCycle, 100);
  write("[ECS] start");
}

on message frmSuspensionStateMsg
{
  gSuspensionMode = clampRange((int)this.SuspensionMode, 0, 7);
  gSuspensionLevel = clampRange((int)this.SuspensionLevel, 0, 31);
  gDampingLevel = clampRange((int)this.DampingLevel, 0, 255);
}

on timer tEcsCycle
{
  message frmEcsStateMsg mEcs;


  mEcs.EcsMode = gSuspensionMode;
  mEcs.EcsHeightLevel = gSuspensionLevel;
  mEcs.EcsDampingLevel = gDampingLevel;
  output(mEcs);

  if (mEcs.EcsMode != gLastMode ||
      mEcs.EcsHeightLevel != gLastHeight ||
      mEcs.EcsDampingLevel != gLastDamping)
  {
    write("[ECS] mode=%d height=%d damping=%d",
          mEcs.EcsMode,
          mEcs.EcsHeightLevel,
          mEcs.EcsDampingLevel);
    gLastMode = mEcs.EcsMode;
    gLastHeight = mEcs.EcsHeightLevel;
    gLastDamping = mEcs.EcsDampingLevel;
  }

  setTimer(tEcsCycle, 100);
}

on stopMeasurement
{
  cancelTimer(tEcsCycle);
}
