includes
{
  #include "..\\common\\CAPL_COMMON.cin"
}

variables
{
  int gDiagPending;
  int gLastDiagSid;
  int gLastDiagDidHigh;
  int gLastDiagDidLow;
  msTimer tEcsCycle;
  int gSuspensionMode;
  int gSuspensionLevel;
  int gDampingLevel;
  int gLastMode;
  int gLastHeight;
  int gLastDamping;
}

on start
{
  gDiagPending = 0;
  gLastDiagSid = 0;
  gLastDiagDidHigh = 0;
  gLastDiagDidLow = 0;
  gSuspensionMode = 0;
  gSuspensionLevel = 8;
  gDampingLevel = 12;
  gLastMode = -1;
  gLastHeight = -1;
  gLastDamping = -1;
  setTimer(tEcsCycle, 100);
  write("[ECS] start");
}

on message frmSuspensionStateMsg
{
  gSuspensionMode = clampRange((int)this.SuspensionMode, 0, 7);
  gSuspensionLevel = clampRange((int)this.SuspensionLevel, 0, 31);
  gDampingLevel = clampRange((int)this.DampingLevel, 0, 255);
}

on timer tEcsCycle
{
  if (gDiagPending == 1)
  {
    message frmEcsDiagResMsg mDiagRes;

    mDiagRes.EcsDiagRespCode = getBasicDiagRespCode(gLastDiagSid);
    mDiagRes.EcsDiagData0 = gLastDiagDidHigh;
    mDiagRes.EcsDiagData1 = gLastDiagDidLow;
    output(mDiagRes);
    gDiagPending = 0;
  }

  message frmEcsStateMsg mEcs;

  mEcs.EcsMode = gSuspensionMode;
  mEcs.EcsHeightLevel = gSuspensionLevel;
  mEcs.EcsDampingLevel = gDampingLevel;
  output(mEcs);

  if (mEcs.EcsMode != gLastMode ||
      mEcs.EcsHeightLevel != gLastHeight ||
      mEcs.EcsDampingLevel != gLastDamping)
  {
    write("[ECS] mode=%d height=%d damping=%d",
          mEcs.EcsMode,
          mEcs.EcsHeightLevel,
          mEcs.EcsDampingLevel);
    gLastMode = mEcs.EcsMode;
    gLastHeight = mEcs.EcsHeightLevel;
    gLastDamping = mEcs.EcsDampingLevel;
  }

  setTimer(tEcsCycle, 100);
}

on message frmEcsDiagReqMsg
{
  gLastDiagSid = clampRange((int)this.EcsDiagServiceId, 0, 255);
  gLastDiagDidHigh = clampRange((int)this.EcsDiagDidHigh, 0, 255);
  gLastDiagDidLow = clampRange((int)this.EcsDiagDidLow, 0, 255);
  gDiagPending = 1;
}

on stopMeasurement
{
  cancelTimer(tEcsCycle);
}
