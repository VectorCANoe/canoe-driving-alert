includes
{
  #include "..\\common\\CAPL_COMMON.cin"
}

variables
{
  msTimer tTpmsCycle;
  int gWheelSpdFL;
  int gWheelSpdFR;
  int gWheelSpdRL;
  int gWheelSpdRR;
  int gLastFl;
  int gLastFr;
  int gLastRl;
  int gLastRr;
}

void publishTireState()
{
  message frmTirePressureMsg mTire;
  int dropFront;
  int dropRear;

  dropFront = (gWheelSpdFL + gWheelSpdFR) > 220 ? 4 : 0;
  dropRear = (gWheelSpdRL + gWheelSpdRR) > 220 ? 4 : 0;

  mTire.TirePressFL = clampRange(232 - dropFront, 0, 255);
  mTire.TirePressFR = clampRange(231 - dropFront, 0, 255);
  mTire.TirePressRL = clampRange(229 - dropRear, 0, 255);
  mTire.TirePressRR = clampRange(228 - dropRear, 0, 255);
  output(mTire);

  if (mTire.TirePressFL != gLastFl ||
      mTire.TirePressFR != gLastFr ||
      mTire.TirePressRL != gLastRl ||
      mTire.TirePressRR != gLastRr)
  {
    write("[TPMS] fl=%d fr=%d rl=%d rr=%d",
          mTire.TirePressFL,
          mTire.TirePressFR,
          mTire.TirePressRL,
          mTire.TirePressRR);
    gLastFl = mTire.TirePressFL;
    gLastFr = mTire.TirePressFR;
    gLastRl = mTire.TirePressRL;
    gLastRr = mTire.TirePressRR;
  }
}

on start
{
  gWheelSpdFL = 0;
  gWheelSpdFR = 0;
  gWheelSpdRL = 0;
  gWheelSpdRR = 0;
  gLastFl = -1;
  gLastFr = -1;
  gLastRl = -1;
  gLastRr = -1;
  setTimer(tTpmsCycle, 100);
  write("[TPMS] start");
}

on timer tTpmsCycle
{

  publishTireState();
  setTimer(tTpmsCycle, 100);
}

on message frmWheelSpeedMsg
{
  gWheelSpdFL = clampRange((int)this.WheelSpdFL, 0, 255);
  gWheelSpdFR = clampRange((int)this.WheelSpdFR, 0, 255);
  gWheelSpdRL = clampRange((int)this.WheelSpdRL, 0, 255);
  gWheelSpdRR = clampRange((int)this.WheelSpdRR, 0, 255);
}

on stopMeasurement
{
  cancelTimer(tTpmsCycle);
}
