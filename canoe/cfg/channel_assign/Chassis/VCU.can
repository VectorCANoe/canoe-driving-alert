includes
{
  #include "..\\common\\CAPL_COMMON.cin"
}

variables
{
  msTimer tVcuCycle;
  long gEthSocket;
  long gEthTxSocket;
  dword gEthTargetIp;
  int gSpeed;
  int gAccelPedal;
  int gBrakePedal;
  int gIgnitionState;
  int gEngineState;
  int gGearInput;
  int gGearState;
  int gDriveMode;
  int gRoutingPolicy;
  int gBoundaryStatus;
  int gSpeedLimitNorm;
  int gPtAliveCnt;
  dword gPedalRxMs;
  dword gIgnitionRxMs;
  dword gGearRxMs;
  int gLastPedalInputStale;
  int gLastIgnitionInputStale;
  int gLastGearInputStale;
}

int getVcuTxPort()
{
  return ethBackbonePort() + 2;
}

int deriveDriveMode(int driveState, int speed, int accelPedal, int brakePedal)
{
  if (driveState == 0)
  {
    return 0;
  }
  if (brakePedal >= 25 && speed <= 30)
  {
    return 3;
  }
  if (accelPedal >= 70)
  {
    return 2;
  }
  if (speed >= 20 && accelPedal <= 20)
  {
    return 1;
  }
  return 0;
}

int deriveEnergyFlowMode(int driveState, int accelPedal, int brakePedal)
{
  if (driveState == 0)
  {
    return 0;
  }
  if (brakePedal >= 10)
  {
    return 2;
  }
  if (accelPedal > 0)
  {
    return 1;
  }
  return 1;
}

int deriveRegenLevel(int driveMode, int brakePedal)
{
  if (brakePedal >= 40)
  {
    return 12;
  }
  if (brakePedal >= 20)
  {
    return 8;
  }
  if (brakePedal >= 5)
  {
    return 4;
  }
  if (driveMode == 3)
  {
    return 6;
  }
  if (driveMode == 1)
  {
    return 3;
  }
  return 2;
}

int derivePowerBalance(int driveMode, int accelPedal, int brakePedal)
{
  if (brakePedal >= 20)
  {
    return 40;
  }
  if (driveMode == 2 || accelPedal >= 60)
  {
    return 60;
  }
  if (driveMode == 1)
  {
    return 45;
  }
  if (driveMode == 3)
  {
    return 55;
  }
  return 50;
}

void traceVcuInputHealth(int pedalInputStale, int ignitionInputStale, int gearInputStale)
{
  if (pedalInputStale != gLastPedalInputStale)
  {
    if (pedalInputStale == 1)
    {
      write("[VCU] pedal input stale");
    }
    else
    {
      write("[VCU] pedal input restored");
    }
    gLastPedalInputStale = pedalInputStale;
  }

  if (ignitionInputStale != gLastIgnitionInputStale)
  {
    if (ignitionInputStale == 1)
    {
      write("[VCU] ignition input stale");
    }
    else
    {
      write("[VCU] ignition input restored");
    }
    gLastIgnitionInputStale = ignitionInputStale;
  }

  if (gearInputStale != gLastGearInputStale)
  {
    if (gearInputStale == 1)
    {
      write("[VCU] gear input stale");
    }
    else
    {
      write("[VCU] gear input restored");
    }
    gLastGearInputStale = gearInputStale;
  }
}

void publishBackboneVehicleState()
{
  char frame[4];
  int driveState;
  int vehicleSpeed;
  long txSocket;

  driveState = clampRange((int)@Core::driveStateNorm, 0, 3);
  vehicleSpeed = clampRange((int)@Core::vehicleSpeedNorm, 0, 255);
  txSocket = gEthTxSocket;
  if (txSocket == ethInvalidSocket())
  {
    txSocket = gEthSocket;
  }

  ethInitFrame(frame, ethMsgVehicleState(), 2);
  ethSetU8(frame, 0, vehicleSpeed);
  ethSetU8(frame, 1, driveState);
  ethSendFrame(txSocket, gEthTargetIp, ethMsgVehicleState(), frame, 2);
}

on start
{
  gEthSocket = ethOpenDefaultSocket();
  gEthTxSocket = ethOpenNodeSocket(getVcuTxPort());
  gEthTargetIp = ethGetDefaultIpAddress();
  gSpeed = 0;
  gAccelPedal = 0;
  gBrakePedal = 0;
  gIgnitionState = 0;
  gEngineState = 0;
  gGearInput = 0;
  gGearState = 0;
  gDriveMode = 0;
  gRoutingPolicy = 0;
  gBoundaryStatus = 0;
  gSpeedLimitNorm = 30;
  gPtAliveCnt = 0;
  gPedalRxMs = 0;
  gIgnitionRxMs = 0;
  gGearRxMs = 0;
  gLastPedalInputStale = 0;
  gLastIgnitionInputStale = 0;
  gLastGearInputStale = 0;
  if (gEthTxSocket == ethInvalidSocket())
  {
    write("[VCU] tx socket fallback to shared backbone port");
  }
  setTimer(tVcuCycle, 100);
  write("[VCU] start");
}

on message frmPedalInputCanMsg
{
  gAccelPedal = clampRange((int)this.AccelPedal, 0, 100);
  gBrakePedal = clampRange((int)this.BrakePedal, 0, 100);
  gPedalRxMs = getSimulationTimeMs();
}

on message frmIgnitionEngineMsg
{
  gIgnitionState = clampRange((int)this.IgnitionState, 0, 1);
  gEngineState = clampRange((int)this.EngineState, 0, 3);
  gIgnitionRxMs = getSimulationTimeMs();
}

on message frmGearStateMsg
{
  gGearInput = clampRange((int)this.GearInput, 0, 7);
  gGearState = clampRange((int)this.GearState, 0, 7);
  gGearRxMs = getSimulationTimeMs();
}

on message frmPowertrainGatewayMsg
{
  gRoutingPolicy = clampRange((int)this.RoutingPolicy, 0, 2);
  gBoundaryStatus = clampRange((int)this.BoundaryStatus, 0, 1);
}

on message frmVehicleModeMsg
{
  gDriveMode = clampRange((int)this.DriveMode, 0, 7);
  gEngineState = clampRange((int)this.PowertrainState, 0, 255);
}

on timer tVcuCycle
{
  message frmVehicleStateCanMsg mState;
  message frmAccelStatusMsg mAccel;
  message frmTcsStateMsg mTcs;
  message frmWheelPulseMsg mWheelPulse;
  message frmPowertrainGatewayMsg mPtGw;
  message frmVehicleModeMsg mVehMode;
  message frmPowerLimitMsg mPowerLimit;
  message frmPowertrainHealthMsg mPtHealth;
  message frmEnergyFlowStateMsg mEnergy;
  message frmPowertrainCtrlAuthMsg mCtrlAuth;
  int targetSpeed;
  int delta;
  int driveState;
  int coreRoutingPolicy;
  int driveMode;
  int energyFlowMode;
  int regenLevel;
  int powerBalance;
  int torqueRequest;
  int tcsActive;
  int externalSpeedHint;
  int externalSpeedDelta;
  int externalSpeedOverride;
  int pedalInputStale;
  int ignitionInputStale;
  int gearInputStale;
  int accelPedal;
  int brakePedal;
  int engineState;
  int gearState;

  externalSpeedHint = clampRange((int)@Chassis::vehicleSpeed, 0, 255);
  pedalInputStale = (ethIsRecentTick(gPedalRxMs, 300) == 1) ? 0 : 1;
  ignitionInputStale = (ethIsRecentTick(gIgnitionRxMs, 300) == 1) ? 0 : 1;
  gearInputStale = (ethIsRecentTick(gGearRxMs, 300) == 1) ? 0 : 1;
  traceVcuInputHealth(pedalInputStale, ignitionInputStale, gearInputStale);

  accelPedal = gAccelPedal;
  brakePedal = gBrakePedal;
  engineState = gEngineState;
  gearState = gGearState;
  if (pedalInputStale == 1)
  {
    accelPedal = 0;
    brakePedal = 0;
  }
  if (ignitionInputStale == 1)
  {
    engineState = 0;
  }
  if (gearInputStale == 1)
  {
    gearState = 0;
  }

  externalSpeedDelta = externalSpeedHint - gSpeed;
  if (externalSpeedDelta < 0)
  {
    externalSpeedDelta = -externalSpeedDelta;
  }
  externalSpeedOverride = ((accelPedal == 0) &&
                           (brakePedal == 0) &&
                           (externalSpeedDelta >= 3)) ? 1 : 0;

  if (externalSpeedOverride == 1)
  {
    gSpeed = externalSpeedHint;
  }
  else
  {
    targetSpeed = gSpeed;
    if (accelPedal > 0)
    {
      targetSpeed = accelPedal * 2;
      if (targetSpeed > 200) targetSpeed = 200;
    }
    else if (brakePedal > 20 || gearState == 0)
    {
      targetSpeed = 0;
    }
    else if (targetSpeed > 0)
    {
      targetSpeed = targetSpeed - 2;
    }

    delta = targetSpeed - gSpeed;
    if (delta > 5) delta = 5;
    if (delta < -15) delta = -15;
    gSpeed = gSpeed + delta;
    if (gSpeed < 0) gSpeed = 0;
    if (gSpeed > 255) gSpeed = 255;
  }

  driveState = (gearState > 0 || gSpeed > 0) ? 3 : 0;
  driveMode = deriveDriveMode(driveState, gSpeed, accelPedal, brakePedal);
  gDriveMode = clampRange(driveMode, 0, 7);
  gSpeedLimitNorm = clampRange((int)@Core::speedLimitNorm, 0, 255);
  gBoundaryStatus = clampRange((int)@CoreState::domainBoundaryStatus, 0, 1);
  coreRoutingPolicy = clampRange((int)@CoreState::routingPolicy, 0, 2);
  gRoutingPolicy = coreRoutingPolicy;

  @Core::vehicleSpeedNorm = gSpeed;
  @Core::driveStateNorm = driveState;

  mState.gVehicleSpeed = gSpeed;
  mState.gDriveState = driveState;
  output(mState);
  @Chassis::vehicleSpeed = gSpeed;
  @Chassis::driveState = driveState;
  publishBackboneVehicleState();

  torqueRequest = clampRange(accelPedal * 2, 0, 255);
  mAccel.AccelRequest = accelPedal;
  mAccel.TorqueRequest = torqueRequest;
  output(mAccel);

  tcsActive = ((accelPedal > 70) && (gSpeed < 25)) ? 1 : 0;
  mTcs.TcsCtrlState = tcsActive ? 2 : 0;
  mTcs.TcsTorqueCut = tcsActive ? 20 : 0;
  mTcs.TcsSlipRatio = tcsActive ? 12 : 0;
  output(mTcs);

  mWheelPulse.WheelPulseFront = gSpeed;
  mWheelPulse.WheelPulseRear = gSpeed;
  output(mWheelPulse);

  mPtGw.RoutingPolicy = gRoutingPolicy;
  mPtGw.BoundaryStatus = gBoundaryStatus;
  output(mPtGw);

  mVehMode.DriveMode = gDriveMode;
  mVehMode.EcoMode = (gDriveMode == 3) ? 1 : 0;
  mVehMode.SportMode = (gSpeed > 80) ? 1 : 0;
  mVehMode.SnowMode = (gDriveMode == 0 && gSpeed < 20) ? 1 : 0;
  mVehMode.PowertrainState = engineState;
  output(mVehMode);
  @CoreState::driveMode = mVehMode.DriveMode;
  @CoreState::ecoMode = mVehMode.EcoMode;
  @CoreState::sportMode = mVehMode.SportMode;

  mPowerLimit.TorqueLimit = torqueRequest;
  mPowerLimit.SpeedLimit = gSpeedLimitNorm;
  output(mPowerLimit);

  mPtHealth.PtAliveCnt = gPtAliveCnt & 0xFF;
  mPtHealth.PtFailCode = 0;
  output(mPtHealth);
  gPtAliveCnt = (gPtAliveCnt + 1) & 0xFF;

  energyFlowMode = deriveEnergyFlowMode(driveState, accelPedal, brakePedal);
  regenLevel = deriveRegenLevel(gDriveMode, brakePedal);
  powerBalance = derivePowerBalance(gDriveMode, accelPedal, brakePedal);
  mEnergy.EnergyFlowMode = energyFlowMode;
  mEnergy.RegenLevel = regenLevel;
  mEnergy.PowerBalance = powerBalance;
  output(mEnergy);

  mCtrlAuth.CtrlAuthLevel = (gBoundaryStatus == 1) ? 3 : 1;
  mCtrlAuth.CtrlAuthSource = 1;
  output(mCtrlAuth);

  setTimer(tVcuCycle, 100);
}

on stopMeasurement
{
  cancelTimer(tVcuCycle);
  ethCloseSocket(gEthTxSocket);
  gEthTxSocket = ethInvalidSocket();
  ethCloseSocket(gEthSocket);
  gEthSocket = ethInvalidSocket();
}
