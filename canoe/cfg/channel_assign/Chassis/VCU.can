includes
{
  #include "..\\common\\CAPL_COMMON.cin"
}

variables
{
  msTimer tVcuCycle;
  double  gSpeed;
  int gAccelPedal;
  int gBrakePedal;
  int gIgnitionState;
  int gEngineState;
  int gGearInput;
  int gGearState;
  int gDriveMode;
  int gRoutingPolicy;
  int gBoundaryStatus;
  int gSpeedLimitNorm;
  int gPtAliveCnt;
  int gTransGear;
}

void publishBackboneVehicleState()
{
  message ethVehicleStateMsg mEthVeh;

  /* Internal powertrain/vehicle-state gateway seam for CAN-stub today, transport swap later. */
  mEthVeh.DriveState = clampRange((int)@Core::driveStateNorm, 0, 3);
  mEthVeh.VehicleSpeed = clampRange((int)@Core::vehicleSpeedNorm, 0, 255);  // already int via sysvar
  mEthVeh.BrakePedalNorm = clampRange(gBrakePedal, 0, 100);
  mEthVeh.TurnLampState = clampRange((int)@CoreState::turnLampState, 0, 3);
  mEthVeh.SeatBeltWarnLvl = clampRange((int)@CoreState::seatBeltWarnLvl, 0, 3);
  output(mEthVeh);
}

on start
{
  gSpeed = 0.0;
  gAccelPedal = 0;
  gBrakePedal = 0;
  gIgnitionState = 0;
  gEngineState = 0;
  gGearInput = 0;
  gGearState = 0;
  gDriveMode = 0;
  gRoutingPolicy = 1;
  gBoundaryStatus = 0;
  gSpeedLimitNorm = 30;
  gPtAliveCnt = 0;
  gTransGear = 0;
  setTimer(tVcuCycle, 100);
  write("[VCU] start");
}

on message frmPedalInputCanMsg
{
  gAccelPedal = clampRange((int)this.AccelPedal, 0, 100);
  gBrakePedal = clampRange((int)this.BrakePedal, 0, 100);
}

on message frmIgnitionEngineMsg
{
  gIgnitionState = clampRange((int)this.IgnitionState, 0, 1);
  gEngineState = clampRange((int)this.EngineState, 0, 3);
}

on message frmGearStateMsg
{
  gGearInput = clampRange((int)this.GearInput, 0, 7);
  gGearState = clampRange((int)this.GearState, 0, 7);
}

on message frmPowertrainGatewayMsg
{
  gRoutingPolicy = clampRange((int)this.RoutingPolicy, 0, 2);
  gBoundaryStatus = clampRange((int)this.BoundaryStatus, 0, 1);
}

on message frmVehicleModeMsg
{
  gDriveMode = clampRange((int)this.DriveMode, 0, 7);
  gEngineState = clampRange((int)this.PowertrainState, 0, 255);
}

on timer tVcuCycle
{
  message frmVehicleStateCanMsg mState;
  message frmAccelStatusMsg mAccel;
  message frmTcsStateMsg mTcs;
  message frmWheelPulseMsg mWheelPulse;
  message frmPowertrainGatewayMsg mPtGw;
  message frmVehicleModeMsg mVehMode;
  message frmPowerLimitMsg mPowerLimit;
  message frmPowertrainHealthMsg mPtHealth;
  message frmEnergyFlowStateMsg mEnergy;
  message frmPowertrainCtrlAuthMsg mCtrlAuth;
  double throttle;
  double brakePres;
  int targetSpeed;
  int delta;
  int driveState;
  int selectedAlertLevel;
  int timeoutClear;
  int failSafeMode;
  int torqueRequest;
  int tcsActive;
  int transGear;
  int spd;

  // ── 기어 동기화 ────────────────────────────────────────────────
  // testScenario=0: MyDriverPanel 기어레버 슬라이더(@Chassis::driveState) → gDriveMode
  // testScenario≠0: TEST_SCN → frmGearStateMsg → on message → gGearState → gDriveMode
  if ((int)@Test::testScenario == 0)
  {
    gDriveMode = clampRange((int)@Chassis::driveState, 0, 3);
    gGearState = gDriveMode;
  }
  else
    gDriveMode = clampRange(gGearState, 0, 7);
  // ──────────────────────────────────────────────────────────────

  // ── 속도 계산 ──────────────────────────────────────────────────
  if ((int)@Test::testScenario == 0)
  {
    // 수동 모드: 버튼 누름에 따라 throttlePosition 서서히 증감
    // 눌림: +8%/100ms (1.25초에 100%), 뗌: -15%/100ms (0.67초에 0%)
    if ((int)@Chassis::throttlePedalBtn == 1)
      @Chassis::throttlePosition = clampRange((int)@Chassis::throttlePosition + 8, 0, 100);
    else
      @Chassis::throttlePosition = clampRange((int)@Chassis::throttlePosition - 15, 0, 100);

    throttle  = (double)@Chassis::throttlePosition;
    brakePres = (double)@Chassis::brakePressure;

    if (brakePres > 10)
    {
      // 제동: -1.5 km/h per 100ms
      gSpeed -= 1.5;
      if (gSpeed < 0.0) gSpeed = 0.0;
    }
    else if (throttle > 0.0 && (gDriveMode == 3 || gDriveMode == 1))
    {
      // 가속: D/R 기어만 작동, 풀액셀 +1.5 km/h per 100ms
      gSpeed += (throttle / 100.0) * 1.5;
      if (gDriveMode == 1 && gSpeed > 30.0)  gSpeed = 30.0;   // R 최대 30 km/h
      else if (gDriveMode == 3 && gSpeed > 200.0) gSpeed = 200.0;
    }
    else
    {
      // P/N 기어 또는 코스팅: -0.5 km/h per 100ms
      gSpeed -= 0.5;
      if (gSpeed < 0.0) gSpeed = 0.0;
    }
  }
  else
  {
    // 시나리오 모드: 기존 CAN 기반 로직 유지
    targetSpeed = gAccelPedal * 2;
    if (targetSpeed > 200) targetSpeed = 200;
    if (gBrakePedal > 20) targetSpeed = 0;

    delta = targetSpeed - (int)gSpeed;
    if (delta > 5) delta = 5;
    if (delta < -15) delta = -15;
    gSpeed = gSpeed + (double)delta;
    if (gSpeed < 0.0) gSpeed = 0.0;
    if (gSpeed > 255.0) gSpeed = 255.0;

    // 시나리오 모드에서도 프로그레스바 표시 동기화
    @Chassis::throttlePosition = clampRange(gAccelPedal, 0, 100);
  }
  // ──────────────────────────────────────────────────────────────

  driveState = (gGearState > 0 || gSpeed > 0.0) ? 3 : 0;
  gSpeedLimitNorm = clampRange((int)@Core::speedLimitNorm, 0, 255);
  selectedAlertLevel = clampRange((int)@Core::selectedAlertLevel, 0, 7);
  timeoutClear = (((int)@Core::timeoutClear) == 1) ? 1 : 0;
  failSafeMode = clampRange((int)@Core::failSafeMode, 0, 2);
  gBoundaryStatus = clampRange((int)@CoreState::domainBoundaryStatus, 0, 1);

  if (failSafeMode > 0 || timeoutClear == 1)
  {
    gRoutingPolicy = 0;
  }
  else if (selectedAlertLevel >= 4)
  {
    gRoutingPolicy = 2;
  }
  else
  {
    gRoutingPolicy = 1;
  }

  // ── 자동변속기 단수 계산 (D기어 주행 시만) ─────────────────────────
  if (gDriveMode == 3 && (int)gSpeed > 0)
  {
    spd = (int)gSpeed;
    if      (spd < 15)  transGear = 1;
    else if (spd < 35)  transGear = 2;
    else if (spd < 65)  transGear = 3;
    else if (spd < 100) transGear = 4;
    else if (spd < 140) transGear = 5;
    else                transGear = 6;
  }
  else
  {
    transGear = 0;  // P/R/N 또는 정지
  }
  gTransGear = transGear;
  @Chassis::transGear = transGear;
  // ──────────────────────────────────────────────────────────────────

  @Core::vehicleSpeedNorm = (int)gSpeed;
  @Core::driveStateNorm = driveState;
  @CoreState::routingPolicy = gRoutingPolicy;

  mState.gVehicleSpeed = (int)gSpeed;
  mState.gDriveState = driveState;
  output(mState);
  @Chassis::vehicleSpeed = (int)gSpeed;
  // driveState sysvar = 실제 기어 위치 (0=P 1=R 2=N 3=D)
  // testScenario=0: 패널 슬라이더가 직접 제어 - 덮어쓰지 않음
  if ((int)@Test::testScenario != 0)
    @Chassis::driveState = driveState;
  publishBackboneVehicleState();

  torqueRequest = clampRange(gAccelPedal * 2, 0, 255);
  mAccel.AccelRequest = gAccelPedal;
  mAccel.TorqueRequest = torqueRequest;
  output(mAccel);

  tcsActive = ((gAccelPedal > 70) && (gSpeed < 25.0)) ? 1 : 0;
  mTcs.TcsCtrlState = tcsActive ? 2 : 0;
  mTcs.TcsTorqueCut = tcsActive ? 20 : 0;
  mTcs.TcsSlipRatio = tcsActive ? 12 : 0;
  output(mTcs);

  mWheelPulse.WheelPulseFront = (int)gSpeed;
  mWheelPulse.WheelPulseRear = (int)gSpeed;
  output(mWheelPulse);

  mPtGw.RoutingPolicy = gRoutingPolicy;
  mPtGw.BoundaryStatus = gBoundaryStatus;
  output(mPtGw);

  mVehMode.DriveMode = gDriveMode;
  mVehMode.EcoMode = (gDriveMode == 3) ? 1 : 0;
  mVehMode.SportMode = (gSpeed > 80) ? 1 : 0;
  mVehMode.SnowMode = (gDriveMode == 0 && gSpeed < 20) ? 1 : 0;
  mVehMode.PowertrainState = gEngineState;
  output(mVehMode);
  @CoreState::driveMode = mVehMode.DriveMode;
  @CoreState::ecoMode = mVehMode.EcoMode;
  @CoreState::sportMode = mVehMode.SportMode;

  mPowerLimit.TorqueLimit = torqueRequest;
  mPowerLimit.SpeedLimit = gSpeedLimitNorm;
  output(mPowerLimit);

  mPtHealth.PtAliveCnt = gPtAliveCnt & 0xFF;
  mPtHealth.PtFailCode = 0;
  output(mPtHealth);
  gPtAliveCnt = (gPtAliveCnt + 1) & 0xFF;

  mEnergy.EnergyFlowMode = (gDriveMode == 3) ? 1 : 0;
  mEnergy.RegenLevel = (selectedAlertLevel >= 3) ? 8 : 2;
  mEnergy.PowerBalance = (gRoutingPolicy == 2) ? 60 : 50;
  output(mEnergy);

  mCtrlAuth.CtrlAuthLevel = (gBoundaryStatus == 1) ? 3 : 1;
  mCtrlAuth.CtrlAuthSource = 1;
  output(mCtrlAuth);
  {
  }

  setTimer(tVcuCycle, 100);
}
