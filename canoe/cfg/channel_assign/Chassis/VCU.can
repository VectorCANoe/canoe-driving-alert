/* --- VCU.can: 무편집 원본 복구 버전 --- */
includes
{
  #include "..\\common\\CAPL_COMMON.cin"
}

variables
{
  msTimer tVcuCycle;
  double  gSpeed;
  int gAccelPedal;
  int gBrakePedal;
  int gIgnitionState;
  int gEngineState;
  int gGearInput;
  int gGearState;
  int gDriveMode;
  int gRoutingPolicy;
  int gBoundaryStatus;
  int gSpeedLimitNorm;
  int gPtAliveCnt;
  int gTransGear;
}

void publishBackboneVehicleState()
{
  message ethVehicleStateMsg mEthVeh;

  mEthVeh.DriveState = clampRange((int)@Core::driveStateNorm, 0, 3);
  mEthVeh.VehicleSpeed = clampRange((int)@Core::vehicleSpeedNorm, 0, 255);
  mEthVeh.BrakePedalNorm = clampRange(gBrakePedal, 0, 100);
  mEthVeh.TurnLampState = clampRange((int)@CoreState::turnLampState, 0, 3);
  mEthVeh.SeatBeltWarnLvl = clampRange((int)@CoreState::seatBeltWarnLvl, 0, 3);
  output(mEthVeh);
}

on start
{
  gSpeed = 0.0;
  gAccelPedal = 0;
  gBrakePedal = 0;
  gIgnitionState = 0;
  gEngineState = 0;
  gGearInput = 0;
  gGearState = 0;
  gDriveMode = 0;
  gRoutingPolicy = 1;
  gBoundaryStatus = 0;
  gSpeedLimitNorm = 30;
  gPtAliveCnt = 0;
  gTransGear = 0;
  setTimer(tVcuCycle, 100);
  write("[VCU] start");
}

on message frmPedalInputCanMsg { gAccelPedal = clampRange((int)this.AccelPedal, 0, 100); gBrakePedal = clampRange((int)this.BrakePedal, 0, 100); }
on message frmIgnitionEngineMsg { gIgnitionState = clampRange((int)this.IgnitionState, 0, 1); gEngineState = clampRange((int)this.EngineState, 0, 3); }
on message frmGearStateMsg { gGearInput = clampRange((int)this.GearInput, 0, 7); gGearState = clampRange((int)this.GearState, 0, 7); }
on message frmPowertrainGatewayMsg { gRoutingPolicy = clampRange((int)this.RoutingPolicy, 0, 2); gBoundaryStatus = clampRange((int)this.BoundaryStatus, 0, 1); }
on message frmVehicleModeMsg { gDriveMode = clampRange((int)this.DriveMode, 0, 7); gEngineState = clampRange((int)this.PowertrainState, 0, 255); }

on timer tVcuCycle
{
  message frmVehicleStateCanMsg mState;
  message frmAccelStatusMsg mAccel;
  message frmTcsStateMsg mTcs;
  message frmWheelPulseMsg mWheelPulse;
  message frmPowertrainGatewayMsg mPtGw;
  message frmVehicleModeMsg mVehMode;
  message frmPowerLimitMsg mPowerLimit;
  message frmPowertrainHealthMsg mPtHealth;
  message frmEnergyFlowStateMsg mEnergy;
  message frmPowertrainCtrlAuthMsg mCtrlAuth;
  double throttle;
  double brakePres;
  int targetSpeed;
  int delta;
  int driveState;
  int selectedAlertLevel;
  int timeoutClear;
  int failSafeMode;
  int torqueRequest;
  int tcsActive;
  int transGear;
  int spd;

  // ── 기어 동기화 ────────────────────────────────────────────────
  if ((int)@Test::testScenario == 0)
  {
    gDriveMode = clampRange((int)@Chassis::driveState, 0, 3);
    gGearState = gDriveMode;
  }
  else
    gDriveMode = clampRange(gGearState, 0, 7);
  // ──────────────────────────────────────────────────────────────

  // ── 속도 계산 ──────────────────────────────────────────────────
  if ((int)@Test::testScenario == 0)
  {
    if ((int)@Chassis::throttlePedalBtn == 1)
      @Chassis::throttlePosition = clampRange((int)@Chassis::throttlePosition + 8, 0, 100);
    else
      @Chassis::throttlePosition = clampRange((int)@Chassis::throttlePosition - 15, 0, 100);

    throttle  = (double)@Chassis::throttlePosition;
    brakePres = (double)@Chassis::brakePressure;

    if (brakePres > 10)
    {
      gSpeed -= 1.5;
      if (gSpeed < 0.0) gSpeed = 0.0;
    }
    else if (throttle > 0.0 && (gDriveMode == 3 || gDriveMode == 1))
    {
      gSpeed += (throttle / 100.0) * 1.5;
      if (gDriveMode == 1 && gSpeed > 30.0)  gSpeed = 30.0; 
      else if (gDriveMode == 3 && gSpeed > 200.0) gSpeed = 200.0;
    }
    else
    {
      gSpeed -= 0.5;
      if (gSpeed < 0.0) gSpeed = 0.0;
    }
  }
  else
  {
    targetSpeed = gAccelPedal * 2;
    if (targetSpeed > 200) targetSpeed = 200;
    if (gBrakePedal > 20) targetSpeed = 0;

    delta = targetSpeed - (int)gSpeed;
    if (delta > 5) delta = 5;
    if (delta < -15) delta = -15;
    gSpeed = gSpeed + (double)delta;
    if (gSpeed < 0.0) gSpeed = 0.0;
    if (gSpeed > 255.0) gSpeed = 255.0;

    @Chassis::throttlePosition = clampRange(gAccelPedal, 0, 100);
  }
  // ──────────────────────────────────────────────────────────────

  driveState = (gGearState > 0 || gSpeed > 0.0) ? 3 : 0;
  gSpeedLimitNorm = clampRange((int)@Core::speedLimitNorm, 0, 255);
  selectedAlertLevel = clampRange((int)@Core::selectedAlertLevel, 0, 7);
  timeoutClear = (((int)@Core::timeoutClear) == 1) ? 1 : 0;
  failSafeMode = clampRange((int)@Core::failSafeMode, 0, 2);
  gBoundaryStatus = clampRange((int)@CoreState::domainBoundaryStatus, 0, 1);

  if (failSafeMode > 0 || timeoutClear == 1) gRoutingPolicy = 0;
  else if (selectedAlertLevel >= 4) gRoutingPolicy = 2;
  else gRoutingPolicy = 1;

  if (gDriveMode == 3 && (int)gSpeed > 0)
  {
    spd = (int)gSpeed;
    if      (spd < 15)  transGear = 1;
    else if (spd < 35)  transGear = 2;
    else if (spd < 65)  transGear = 3;
    else if (spd < 100) transGear = 4;
    else if (spd < 140) transGear = 5;
    else                transGear = 6;
  }
  else transGear = 0;

  gTransGear = transGear;
  @Chassis::transGear = transGear;
  @Core::vehicleSpeedNorm = (int)gSpeed;
  @Core::driveStateNorm = driveState;
  @CoreState::routingPolicy = gRoutingPolicy;

  mState.gVehicleSpeed = (int)gSpeed;
  mState.gDriveState = driveState;
  output(mState);
  @Chassis::vehicleSpeed = (int)gSpeed;

  if ((int)@Test::testScenario != 0) @Chassis::driveState = driveState;
  publishBackboneVehicleState();

  torqueRequest = clampRange(gAccelPedal * 2, 0, 255);
  mAccel.AccelRequest = gAccelPedal;
  mAccel.TorqueRequest = torqueRequest;
  output(mAccel);

  tcsActive = ((gAccelPedal > 70) && (gSpeed < 25.0)) ? 1 : 0;
  mTcs.TcsCtrlState = tcsActive ? 2 : 0;
  mTcs.TcsTorqueCut = tcsActive ? 20 : 0;
  mTcs.TcsSlipRatio = tcsActive ? 12 : 0;
  output(mTcs);

  mWheelPulse.WheelPulseFront = (int)gSpeed;
  mWheelPulse.WheelPulseRear = (int)gSpeed;
  output(mWheelPulse);

  mPtGw.RoutingPolicy = gRoutingPolicy;
  mPtGw.BoundaryStatus = gBoundaryStatus;
  output(mPtGw);

  mVehMode.DriveMode = gDriveMode;
  mVehMode.EcoMode = (gDriveMode == 3) ? 1 : 0;
  mVehMode.SportMode = (gSpeed > 80) ? 1 : 0;
  mVehMode.SnowMode = (gDriveMode == 0 && gSpeed < 20) ? 1 : 0;
  mVehMode.PowertrainState = gEngineState;
  output(mVehMode);
  @CoreState::driveMode = mVehMode.DriveMode;
  @CoreState::ecoMode = mVehMode.EcoMode;
  @CoreState::sportMode = mVehMode.SportMode;

  mPowerLimit.TorqueLimit = torqueRequest;
  mPowerLimit.SpeedLimit = gSpeedLimitNorm;
  output(mPowerLimit);

  mPtHealth.PtAliveCnt = gPtAliveCnt & 0xFF;
  mPtHealth.PtFailCode = 0;
  output(mPtHealth);
  gPtAliveCnt = (gPtAliveCnt + 1) & 0xFF;

  mEnergy.EnergyFlowMode = (gDriveMode == 3) ? 1 : 0;
  mEnergy.RegenLevel = (selectedAlertLevel >= 3) ? 8 : 2;
  mEnergy.PowerBalance = (gRoutingPolicy == 2) ? 60 : 50;
  output(mEnergy);

  mCtrlAuth.CtrlAuthLevel = (gBoundaryStatus == 1) ? 3 : 1;
  mCtrlAuth.CtrlAuthSource = 1;
  output(mCtrlAuth);

  setTimer(tVcuCycle, 100);
}

on sysvar Chassis::vehicleSpeed 
{
  if ((int)gSpeed != (int)@this) 
  {
    gSpeed = (double)@this; // CLU가 주입한 50을 VCU의 실제 물리 속도로 인정해줌
  }
}