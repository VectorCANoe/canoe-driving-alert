includes
{
  #include "..\\common\\CAPL_COMMON.cin"
}

variables
{
  const int ADAS_TIMER_CYCLE_MS = 10;
  const int ADAS_TIMER_ARBITER_MS = 50;
  const int ADAS_U8_MAX = 255;
  const int ADAS_EVENT_CODE_NONE = 0;
  const int ADAS_SPEED_LIMIT_DEFAULT_KPH = 30;
  const int ADAS_TTC_MAX_MS = 10000;
  const int ADAS_OBJECT_RANGE_MAX_M = 500;
  const int ADAS_OBJECT_REL_SPEED_MIN_KPH = -200;
  const int ADAS_OBJECT_REL_SPEED_MAX_KPH = 200;
  const int ADAS_OBJECT_HOLD_DEFAULT_MS = 300;
  const int ADAS_HOLD_WINDOW_MAX_MS = 5000;
  const int ADAS_TIMEOUT_CLEAR_MS = 1000;
  const int ADAS_HIGHWAY_NO_STEER_TRIGGER_MS = 10000;
  const int ADAS_HIGHWAY_NO_STEER_MIN_SPEED_KPH = 60;
  const int ADAS_BRAKE_OVERRIDE_THRESHOLD = 15;
  const int ADAS_DECEL_RISK_ON_THRESHOLD = 70;
  const int ADAS_DECEL_RISK_ON_OBJECT_THRESHOLD = 75;
  const int ADAS_DECEL_RISK_OFF_THRESHOLD = 55;
  const int ADAS_DECEL_RISK_OFF_OBJECT_THRESHOLD = 60;
  const int ADAS_STEERING_INPUT_INACTIVE = 0;
  const int ADAS_STEERING_INPUT_ACTIVE = 1;
  const int ADAS_DRIVER_RELEASE_REASON_NONE = 0;
  const int ADAS_DRIVER_RELEASE_REASON_STEER = 1;
  const int ADAS_DRIVER_RELEASE_REASON_BRAKE = 2;
  const int ADAS_DRIVER_RELEASE_REASON_FAILSAFE = 3;
  const int ADAS_DRIVE_STATE_DRIVE = 3;
  const int ADAS_BASE_ZONE_CONTEXT_NONE = 0;
  const int ADAS_BASE_ZONE_CONTEXT_SCHOOL = 1;
  const int ADAS_BASE_ZONE_CONTEXT_HIGHWAY = 2;
  const int ADAS_BASE_ZONE_CONTEXT_GUIDE_LEFT = 3;
  const int ADAS_BASE_ZONE_CONTEXT_GUIDE_RIGHT = 4;
  const int ADAS_WARNING_STATE_NONE = 0;
  const int ADAS_WARNING_STATE_CAUTION = 1;
  const int ADAS_WARNING_STATE_CRITICAL = 2;
  const int ADAS_EMERGENCY_CONTEXT_NONE = 0;
  const int ADAS_EMERGENCY_CONTEXT_POLICE = 1;
  const int ADAS_EMERGENCY_CONTEXT_AMBULANCE = 2;
  const int ADAS_EMERGENCY_DIRECTION_FRONT = 0;
  const int ADAS_EMERGENCY_DIRECTION_REAR = 3;
  const int ADAS_OBJECT_CONFIDENCE_RISK_MIN = 20;
  const int ADAS_OBJECT_CONFIDENCE_VALID_MIN = 25;
  const int ADAS_OBJECT_CONFIDENCE_WARNING_MIN = 30;
  const int ADAS_OBJECT_RISK_CLASS_WARNING_MIN = 2;
  const int ADAS_OBJECT_RISK_CLASS_CRITICAL_MIN = 3;
  const int ADAS_OBJECT_RISK_CLASS_HIGH_MIN = 4;
  const int ADAS_OBJECT_RISK_CLASS_HOLD_FLOOR = 3;
  const int ADAS_OBJECT_EVENT_ENTER = 1381;
  const int ADAS_OBJECT_EVENT_EXIT = 1382;
  const int ADAS_OBJECT_EVENT_UPDATE = 1383;
  const int ADAS_DUPLICATE_POPUP_GUARD_MAX_MS = 5000;
  const int ADAS_DUPLICATE_POPUP_HOLD_MS = 1000;
  const int ADAS_SEAT_BELT_WARN_LEVEL_HIGH = 2;
  const int ADAS_ALERT_LEVEL_NONE = 0;
  const int ADAS_ALERT_LEVEL_STALE_MIN = 3;
  const int ADAS_ALERT_LEVEL_FAILSAFE_MIN = 4;
  const int ADAS_ALERT_LEVEL_OBJECT_DECEL_MIN = 5;
  const int ADAS_ALERT_LEVEL_POLICE = 6;
  const int ADAS_ALERT_LEVEL_AMBULANCE = 7;
  const int ADAS_ALERT_TYPE_NONE = 0;
  const int ADAS_ALERT_TYPE_EMERGENCY_POLICE = 1;
  const int ADAS_ALERT_TYPE_EMERGENCY_AMBULANCE = 2;
  const int ADAS_ALERT_TYPE_STALE_FALLBACK = 3;
  const int ADAS_ALERT_TYPE_OBJECT = 4;
  const int ADAS_ALERT_TYPE_LEFT_GUIDE = 5;
  const int ADAS_ALERT_TYPE_RIGHT_GUIDE = 6;
  const int ADAS_TURN_LAMP_LEFT = 1;
  const int ADAS_TURN_LAMP_RIGHT = 2;
  const int ADAS_ARBITRATION_SNAPSHOT_MASK = 0xFFFF;

  msTimer tAdasCycle;
  msTimer tArbiter50;
  long gEthSocket;
  dword gEthTargetIp;
  char gEthRxBuffer[64];
  int gLastWarningState;
  dword gHighwayNoSteerStartMs;
  int gLastRiskLevel;
  int gRiskPublishTick;
  int gObjectStatePublishTick;
  dword gLastObjectTrackRxMs;
  int gLastObjectRiskClass;
  int gLastObjectEventCode;
  int gLastInputFilterState;
  int gLastAlertLevel;
  int gLastAlertType;
  int gLastDecelAssistReq;
  int gLastDriverReleaseReason;
  int gLastObjectRiskLevel;
  int gLastObjectAlertLevel;
  int gLastObjectAlertType;
  int gObjectHoldActiveWork;
  int gPrevEmergencyContext;
  int gPreEmergencyAlertLevel;
  int gPreEmergencyAlertType;
  int gPreEmergencySnapshotValid;
  int gWorkDecelAssistReq;
  int gWorkDriverReleaseReason;
  int gWorkSelectedAlertLevel;
  int gWorkSelectedAlertType;

  // ethSelectedAlertMsg
  //   - selectedAlertLevel
  //   - selectedAlertType
  // ethDecelAssistReqMsg
  //   - FailSafeMode
  dword gLastStableAlertMs;
  int gStableAlertLevel;
  int gStableAlertType;
  int gLastStaleInputState;
  int gLastFallbackState;
}

void publishBackboneDecisionFrames()
{
  char riskFrame[8];
  char decelFrame[8];
  char alertFrame[4];
  char objRiskFrame[8];
  char objAlertFrame[6];
  int emergencyContext;

  emergencyContext = clampRange((int)@Core::emergencyContext, 0, 2);

  ethInitFrame(riskFrame, ethMsgEmergencyRisk(), 4);
  ethSetU8(riskFrame, 0, clampRange((int)@Core::proximityRiskLevel, 0, 100));
  ethSetU8(riskFrame, 1, clampRange((int)@V2X::eta, 0, ADAS_U8_MAX));
  ethSetU8(riskFrame, 2, clampRange((int)@Core::vehicleSpeedNorm, 0, ADAS_U8_MAX));
  ethSetU8(riskFrame, 3, clampRange((int)@V2X::emergencyDirection, 0, 3) |
                       (clampRange(emergencyContext, 0, 3) << 2));
  ethSendFrame(gEthSocket, gEthTargetIp, ethMsgEmergencyRisk(), riskFrame, 4);

  ethInitFrame(decelFrame, ethMsgDecelAssist(), 2);
  ethSetU8(decelFrame, 0, ((((int)@Core::decelAssistReq) == 1) ? 1 : 0) |
                          (clampRange((int)@Core::failSafeMode, 0, 2) << 1) |
                          (clampRange(gLastDriverReleaseReason, 0, 3) << 3) |
                          (clampRange(emergencyContext, 0, 3) << 5));
  ethSetU8(decelFrame, 1, clampRange((int)@Core::proximityRiskLevel, 0, 100));
  ethSendFrame(gEthSocket, gEthTargetIp, ethMsgDecelAssist(), decelFrame, 2);

  ethInitFrame(alertFrame, ethMsgSelectedAlert(), 2);
  ethSetU8(alertFrame, 0, clampRange((int)@Core::selectedAlertLevel, 0, 7) |
                          (clampRange((int)@Core::selectedAlertType, 0, 7) << 3));
  ethSetU8(alertFrame, 1, (((int)@Core::timeoutClear) == 1) ? 1 : 0);
  ethSendFrame(gEthSocket, gEthTargetIp, ethMsgSelectedAlert(), alertFrame, 2);

  ethInitFrame(objRiskFrame, ethMsgObjectRiskState(), 6);
  ethSetU8(objRiskFrame, 0, clampRange((int)@Core::objectRiskClass, 0, 7));
  ethSetU16Le(objRiskFrame, 1, clampRange((int)@Core::objectTtcMin, 0, ADAS_TTC_MAX_MS));
  ethSetU8(objRiskFrame, 3, clampRange(gLastObjectRiskLevel, 0, 100));
  ethSetU8(objRiskFrame, 4, clampRange((int)@Core::objectTrackValid, 0, 1));
  ethSetU8(objRiskFrame, 5, clampRange((int)@Core::objectConfidence, 0, 100));
  ethSendFrame(gEthSocket, gEthTargetIp, ethMsgObjectRiskState(), objRiskFrame, 6);

  ethInitFrame(objAlertFrame, ethMsgObjectScenarioAlert(), 3);
  ethSetU8(objAlertFrame, 0, clampRange(gLastObjectAlertLevel, 0, 7) |
                            (clampRange(gLastObjectAlertType, 0, 7) << 3));
  ethSetU8(objAlertFrame, 1, clampRange((int)@Core::intersectionConflictFlag, 0, 1) |
                            (clampRange((int)@Core::mergeCutInFlag, 0, 1) << 1));
  ethSetU8(objAlertFrame, 2, clampRange((int)@Core::objectRiskClass, 0, 7));
  ethSendFrame(gEthSocket, gEthTargetIp, ethMsgObjectScenarioAlert(), objAlertFrame, 3);
}

int calcProximityRisk(int emergencyContext, int etaSec, int speed, int emergencyDirection, int driveState)
{
  int etaScore;
  int speedScore;
  int directionScore;
  int typeBias;
  int riskLevel;

  if (isDriveStateDriving(driveState) == 0 || emergencyContext == ADAS_EMERGENCY_CONTEXT_NONE)
  {
    return 0;
  }

  etaScore = 100 - (etaSec * 5);
  etaScore = clampRange(etaScore, 0, 100);
  speedScore = clampRange((speed * 40) / ADAS_U8_MAX, 0, 40);

  if (emergencyDirection == ADAS_EMERGENCY_DIRECTION_FRONT)
  {
    directionScore = 25;
  }
  else if (emergencyDirection == ADAS_EMERGENCY_DIRECTION_REAR)
  {
    directionScore = 10;
  }
  else
  {
    directionScore = 18;
  }

  typeBias = (emergencyContext == ADAS_EMERGENCY_CONTEXT_AMBULANCE) ? 12 : 6;
  riskLevel = ((etaScore * 55) / 100) + speedScore + directionScore + typeBias;
  return clampRange(riskLevel, 0, 100);
}

int calcObjectTtcMs(int objectRange, int objectRelSpeed)
{
  long closingKph;
  long ttcMs;

  if (objectRelSpeed >= 0 || objectRange <= 0)
  {
    return ADAS_TTC_MAX_MS;
  }

  closingKph = -objectRelSpeed;
  if (closingKph <= 0)
  {
    return ADAS_TTC_MAX_MS;
  }

  ttcMs = ((long)objectRange * 3600) / closingKph;
  if (ttcMs < 0)
  {
    ttcMs = 0;
  }
  if (ttcMs > ADAS_TTC_MAX_MS)
  {
    ttcMs = ADAS_TTC_MAX_MS;
  }
  return (int)ttcMs;
}

int calcObjectRisk(int ttcMs, int confidence, int objectRange,
                   int intersectionConflictFlag, int mergeCutInFlag)
{
  int baseRisk;
  int rangeBias;
  int confidenceBias;
  int scenarioBias;
  int riskLevel;

  if (confidence < ADAS_OBJECT_CONFIDENCE_RISK_MIN)
  {
    return 0;
  }

  if (ttcMs <= 1200)
  {
    baseRisk = 85;
  }
  else if (ttcMs <= 2000)
  {
    baseRisk = 72;
  }
  else if (ttcMs <= 3000)
  {
    baseRisk = 58;
  }
  else if (ttcMs <= 4500)
  {
    baseRisk = 40;
  }
  else
  {
    baseRisk = 18;
  }

  rangeBias = clampRange((ADAS_OBJECT_RANGE_MAX_M - objectRange) / 10, 0, 20);
  confidenceBias = clampRange((confidence - 50) / 5, -10, 10);
  scenarioBias = 0;
  if (intersectionConflictFlag == 1)
  {
    scenarioBias = scenarioBias + 8;
  }
  if (mergeCutInFlag == 1)
  {
    scenarioBias = scenarioBias + 6;
  }

  riskLevel = baseRisk + rangeBias + confidenceBias + scenarioBias;
  return clampRange(riskLevel, 0, 100);
}

int calcObjectRiskClass(int objectTrackValid, int confidence, int objectRiskLevel)
{
  if (objectTrackValid == 0)
  {
    return 0;
  }
  if (confidence < ADAS_OBJECT_CONFIDENCE_WARNING_MIN)
  {
    return 1;
  }
  if (objectRiskLevel >= 85)
  {
    return 5;
  }
  if (objectRiskLevel >= 70)
  {
    return 4;
  }
  if (objectRiskLevel >= 55)
  {
    return 3;
  }
  if (objectRiskLevel >= 35)
  {
    return 2;
  }
  return 1;
}

int isObjectWarningActive(int objectTrackValid, int objectConfidence, int objectRiskClass)
{
  if (objectTrackValid == 1 &&
      objectConfidence >= ADAS_OBJECT_CONFIDENCE_WARNING_MIN &&
      objectRiskClass >= ADAS_OBJECT_RISK_CLASS_WARNING_MIN)
  {
    return 1;
  }
  return 0;
}

int isDriveStateDriving(int driveState)
{
  if (driveState == ADAS_DRIVE_STATE_DRIVE)
  {
    return 1;
  }
  return 0;
}

int isEmergencyContextActive(int emergencyContext)
{
  if (emergencyContext > ADAS_EMERGENCY_CONTEXT_NONE)
  {
    return 1;
  }
  return 0;
}

int isAlertLevelActive(int alertLevel)
{
  if (alertLevel > ADAS_ALERT_LEVEL_NONE)
  {
    return 1;
  }
  return 0;
}

int isDecelAssistControlAllowed(int failSafeMode, int driveState, int emergencyContext, int isObjectWarningActiveState)
{
  if (failSafeMode == 0 &&
      isDriveStateDriving(driveState) == 1 &&
      (isEmergencyContextActive(emergencyContext) == 1 || isObjectWarningActiveState == 1))
  {
    return 1;
  }
  return 0;
}

int calcDecelAssistRequest(int isPrevDecelAssistReq, int proximityRiskLevel,
                           int decelRiskOnThreshold, int decelRiskOffThreshold,
                           int isDecelControlAllowed)
{
  if (isDecelControlAllowed == 0)
  {
    return 0;
  }

  if (isPrevDecelAssistReq == 0 && proximityRiskLevel >= decelRiskOnThreshold)
  {
    return 1;
  }
  if (isPrevDecelAssistReq == 1 && proximityRiskLevel <= decelRiskOffThreshold)
  {
    return 0;
  }
  return isPrevDecelAssistReq;
}

void applyDriverOverrideToDecelAssist(int isDecelAssistReq, int brakePedal, int isSteeringInputActive)
{
  gWorkDecelAssistReq = isDecelAssistReq;
  gWorkDriverReleaseReason = ADAS_DRIVER_RELEASE_REASON_NONE;

  if (isDecelAssistReq == 0)
  {
    return;
  }

  if (brakePedal >= ADAS_BRAKE_OVERRIDE_THRESHOLD)
  {
    gWorkDecelAssistReq = 0;
    gWorkDriverReleaseReason = ADAS_DRIVER_RELEASE_REASON_BRAKE;
  }
  else if (isSteeringInputActive == 1)
  {
    gWorkDecelAssistReq = 0;
    gWorkDriverReleaseReason = ADAS_DRIVER_RELEASE_REASON_STEER;
  }
}

int getDecelRiskOnThreshold(int emergencyContext, int isObjectWarningActiveState)
{
  if (emergencyContext == ADAS_EMERGENCY_CONTEXT_NONE && isObjectWarningActiveState == 1)
  {
    return ADAS_DECEL_RISK_ON_OBJECT_THRESHOLD;
  }
  return ADAS_DECEL_RISK_ON_THRESHOLD;
}

int getDecelRiskOffThreshold(int emergencyContext, int isObjectWarningActiveState)
{
  if (emergencyContext == ADAS_EMERGENCY_CONTEXT_NONE && isObjectWarningActiveState == 1)
  {
    return ADAS_DECEL_RISK_OFF_OBJECT_THRESHOLD;
  }
  return ADAS_DECEL_RISK_OFF_THRESHOLD;
}

int getBaseAlertLevel(int baseZoneContext, int warningState)
{
  if (baseZoneContext == ADAS_BASE_ZONE_CONTEXT_GUIDE_LEFT ||
      baseZoneContext == ADAS_BASE_ZONE_CONTEXT_GUIDE_RIGHT)
  {
    return ADAS_WARNING_STATE_CRITICAL;
  }
  if (warningState <= ADAS_WARNING_STATE_NONE)
  {
    return ADAS_ALERT_LEVEL_NONE;
  }
  if (baseZoneContext == ADAS_BASE_ZONE_CONTEXT_SCHOOL)
  {
    return 3;
  }
  if (baseZoneContext == ADAS_BASE_ZONE_CONTEXT_HIGHWAY)
  {
    return ADAS_WARNING_STATE_CRITICAL;
  }
  return ADAS_WARNING_STATE_CAUTION;
}

int getBaseAlertType(int baseZoneContext, int warningState)
{
  if (baseZoneContext == ADAS_BASE_ZONE_CONTEXT_GUIDE_LEFT)
  {
    return ADAS_ALERT_TYPE_LEFT_GUIDE;
  }
  if (baseZoneContext == ADAS_BASE_ZONE_CONTEXT_GUIDE_RIGHT)
  {
    return ADAS_ALERT_TYPE_RIGHT_GUIDE;
  }
  if (warningState <= ADAS_WARNING_STATE_NONE)
  {
    return ADAS_ALERT_TYPE_NONE;
  }
  if (baseZoneContext == ADAS_BASE_ZONE_CONTEXT_SCHOOL)
  {
    return 3;
  }
  if (baseZoneContext == ADAS_BASE_ZONE_CONTEXT_HIGHWAY)
  {
    return ADAS_ALERT_TYPE_OBJECT;
  }
  return ADAS_ALERT_TYPE_EMERGENCY_POLICE;
}

int getEmergencyAlertLevel(int emergencyContext)
{
  if (emergencyContext == ADAS_EMERGENCY_CONTEXT_AMBULANCE)
  {
    return ADAS_ALERT_LEVEL_AMBULANCE;
  }
  if (emergencyContext == ADAS_EMERGENCY_CONTEXT_POLICE)
  {
    return ADAS_ALERT_LEVEL_POLICE;
  }
  return ADAS_ALERT_LEVEL_NONE;
}

int getEmergencyAlertType(int emergencyContext)
{
  if (emergencyContext == ADAS_EMERGENCY_CONTEXT_AMBULANCE)
  {
    return ADAS_ALERT_TYPE_EMERGENCY_AMBULANCE;
  }
  if (emergencyContext == ADAS_EMERGENCY_CONTEXT_POLICE)
  {
    return ADAS_ALERT_TYPE_EMERGENCY_POLICE;
  }
  return ADAS_ALERT_TYPE_NONE;
}

int getObjectAlertLevel(int intersectionConflictFlag, int mergeCutInFlag, int objectRiskClass)
{
  if (intersectionConflictFlag == 1 || mergeCutInFlag == 1)
  {
    return ADAS_ALERT_LEVEL_FAILSAFE_MIN;
  }
  if (objectRiskClass >= ADAS_OBJECT_RISK_CLASS_HIGH_MIN)
  {
    return ADAS_ALERT_LEVEL_OBJECT_DECEL_MIN;
  }
  return 3;
}

int getObjectAlertType(int intersectionConflictFlag, int mergeCutInFlag)
{
  if (intersectionConflictFlag == 1)
  {
    return ADAS_ALERT_TYPE_LEFT_GUIDE;
  }
  if (mergeCutInFlag == 1)
  {
    return ADAS_ALERT_TYPE_RIGHT_GUIDE;
  }
  return ADAS_ALERT_TYPE_OBJECT;
}

void deriveSelectedAlertFromPriority(int emergencyContext, int baseAlertLevel, int baseAlertType,
                                     int isObjectWarningActiveState, int intersectionConflictFlag,
                                     int mergeCutInFlag, int objectRiskClass)
{
  gWorkSelectedAlertLevel = baseAlertLevel;
  gWorkSelectedAlertType = baseAlertType;

  if (emergencyContext == ADAS_EMERGENCY_CONTEXT_AMBULANCE)
  {
    gWorkSelectedAlertLevel = ADAS_ALERT_LEVEL_AMBULANCE;
    gWorkSelectedAlertType = ADAS_ALERT_TYPE_EMERGENCY_AMBULANCE;
  }
  else if (emergencyContext == ADAS_EMERGENCY_CONTEXT_POLICE)
  {
    gWorkSelectedAlertLevel = ADAS_ALERT_LEVEL_POLICE;
    gWorkSelectedAlertType = ADAS_ALERT_TYPE_EMERGENCY_POLICE;
  }
  else if (gPrevEmergencyContext > ADAS_EMERGENCY_CONTEXT_NONE)
  {
    gPreEmergencySnapshotValid = 0;
  }
  else if (isObjectWarningActiveState == 1)
  {
    gWorkSelectedAlertLevel = getObjectAlertLevel(intersectionConflictFlag, mergeCutInFlag, objectRiskClass);
    gWorkSelectedAlertType = getObjectAlertType(intersectionConflictFlag, mergeCutInFlag);
  }
}

void applyDecelAssistAlertOverride(int isDecelAssistReq, int emergencyContext, int isObjectWarningActiveState,
                                   int selectedAlertLevel, int selectedAlertType)
{
  gWorkSelectedAlertLevel = selectedAlertLevel;
  gWorkSelectedAlertType = selectedAlertType;

  if (isDecelAssistReq == 0)
  {
    return;
  }

  if (isEmergencyContextActive(emergencyContext) == 1)
  {
    gWorkSelectedAlertLevel = getEmergencyAlertLevel(emergencyContext);
    gWorkSelectedAlertType = getEmergencyAlertType(emergencyContext);
  }
  else if (isObjectWarningActiveState == 1)
  {
    if (gWorkSelectedAlertLevel < ADAS_ALERT_LEVEL_OBJECT_DECEL_MIN)
    {
      gWorkSelectedAlertLevel = ADAS_ALERT_LEVEL_OBJECT_DECEL_MIN;
    }
    if (gWorkSelectedAlertType == ADAS_ALERT_TYPE_NONE)
    {
      gWorkSelectedAlertType = ADAS_ALERT_TYPE_OBJECT;
    }
  }
}

int isStaleAlertInput(int isTimeoutClear, int emergencyContext, dword lastEmergencyRxMs,
                      dword nowMs, int boundaryStatus, int selectedAlertLevel)
{
  if (isTimeoutClear == 1)
  {
    return 1;
  }

  if (isEmergencyContextActive(emergencyContext) == 1 &&
      lastEmergencyRxMs > 0 &&
      (nowMs - lastEmergencyRxMs) >= ADAS_TIMEOUT_CLEAR_MS)
  {
    return 1;
  }

  if (boundaryStatus == 0 &&
      (isEmergencyContextActive(emergencyContext) == 1 || isAlertLevelActive(selectedAlertLevel) == 1))
  {
    return 1;
  }

  return 0;
}

void applyStaleAlertFallback(int isStaleInput, int emergencyContext, int selectedAlertLevel, int selectedAlertType)
{
  gWorkSelectedAlertLevel = selectedAlertLevel;
  gWorkSelectedAlertType = selectedAlertType;

  if (isStaleInput == 0)
  {
    return;
  }

  if (gWorkSelectedAlertLevel < ADAS_ALERT_LEVEL_STALE_MIN)
  {
    gWorkSelectedAlertLevel = ADAS_ALERT_LEVEL_STALE_MIN;
  }
  if (gWorkSelectedAlertType == ADAS_ALERT_TYPE_NONE)
  {
    if (isEmergencyContextActive(emergencyContext) == 1)
    {
      gWorkSelectedAlertType = getEmergencyAlertType(emergencyContext);
    }
    else
    {
      gWorkSelectedAlertType = ADAS_ALERT_TYPE_STALE_FALLBACK;
    }
  }
}

int isFailSafeFallbackRequired(int failSafeMode, int selectedAlertLevel, int isStaleInput)
{
  if (failSafeMode >= 1 &&
      (isAlertLevelActive(selectedAlertLevel) == 1 || isStaleInput == 1))
  {
    return 1;
  }
  return 0;
}

void applyFailSafeAlertFallback(int isFallbackRequired, int emergencyContext, int selectedAlertLevel, int selectedAlertType)
{
  gWorkSelectedAlertLevel = selectedAlertLevel;
  gWorkSelectedAlertType = selectedAlertType;

  if (isFallbackRequired == 0)
  {
    return;
  }

  if (gWorkSelectedAlertLevel < ADAS_ALERT_LEVEL_FAILSAFE_MIN)
  {
    gWorkSelectedAlertLevel = ADAS_ALERT_LEVEL_FAILSAFE_MIN;
  }
  if (gWorkSelectedAlertType == ADAS_ALERT_TYPE_NONE)
  {
    if (isEmergencyContextActive(emergencyContext) == 1)
    {
      gWorkSelectedAlertType = getEmergencyAlertType(emergencyContext);
    }
    else
    {
      gWorkSelectedAlertType = ADAS_ALERT_TYPE_STALE_FALLBACK;
    }
  }
}

void applyContextAlertAdjustments(int emergencyContext, int isObjectWarningActiveState, int turnLampState,
                                  int driveMode, int ecoMode, int sportMode,
                                  int isDriverSeatBeltLatched, int isPassengerSeatBeltLatched,
                                  int seatBeltWarnLvl, int selectedAlertLevel, int selectedAlertType)
{
  gWorkSelectedAlertLevel = selectedAlertLevel;
  gWorkSelectedAlertType = selectedAlertType;

  if (isEmergencyContextActive(emergencyContext) == 0 &&
      isObjectWarningActiveState == 0 &&
      isAlertLevelActive(gWorkSelectedAlertLevel) == 1)
  {
    if (turnLampState == ADAS_TURN_LAMP_LEFT)
    {
      gWorkSelectedAlertType = ADAS_ALERT_TYPE_LEFT_GUIDE;
    }
    else if (turnLampState == ADAS_TURN_LAMP_RIGHT)
    {
      gWorkSelectedAlertType = ADAS_ALERT_TYPE_RIGHT_GUIDE;
    }
  }

  if (isEmergencyContextActive(emergencyContext) == 0 &&
      isAlertLevelActive(gWorkSelectedAlertLevel) == 1)
  {
    if (sportMode == 1 || driveMode >= 4)
    {
      gWorkSelectedAlertLevel = clampRange(gWorkSelectedAlertLevel + 1, 0, 7);
    }
    else if (ecoMode == 1 && gWorkSelectedAlertLevel > 1)
    {
      gWorkSelectedAlertLevel = gWorkSelectedAlertLevel - 1;
    }
  }

  if (isAlertLevelActive(gWorkSelectedAlertLevel) == 1 &&
      (isDriverSeatBeltLatched == 0 || isPassengerSeatBeltLatched == 0 ||
       seatBeltWarnLvl >= ADAS_SEAT_BELT_WARN_LEVEL_HIGH))
  {
    if (gWorkSelectedAlertLevel < ADAS_ALERT_LEVEL_OBJECT_DECEL_MIN)
    {
      gWorkSelectedAlertLevel = ADAS_ALERT_LEVEL_OBJECT_DECEL_MIN;
    }
    if (gWorkSelectedAlertType == ADAS_ALERT_TYPE_NONE)
    {
      gWorkSelectedAlertType = ADAS_ALERT_TYPE_STALE_FALLBACK;
    }
  }
}

int shouldKeepStableAlert(int selectedAlertLevel, int selectedAlertType, dword nowMs, int duplicatePopupGuard)
{
  if ((nowMs - gLastStableAlertMs) < ADAS_DUPLICATE_POPUP_HOLD_MS &&
      duplicatePopupGuard > 0 &&
      selectedAlertType == gStableAlertType &&
      selectedAlertLevel <= gStableAlertLevel)
  {
    return 1;
  }
  return 0;
}

int normalizeSpeedValue(int speed)
{
  if (speed < 0)
  {
    return 0;
  }
  if (speed > ADAS_U8_MAX)
  {
    return ADAS_U8_MAX;
  }
  return speed;
}

int normalizeDriveStateValue(int driveState)
{
  if (driveState < 0 || driveState > ADAS_DRIVE_STATE_DRIVE)
  {
    return 0;
  }
  return driveState;
}

int normalizeSteeringInputValue(int isSteeringInputActive)
{
  if (isSteeringInputActive < 0 || isSteeringInputActive > ADAS_STEERING_INPUT_ACTIVE)
  {
    return 0;
  }
  return isSteeringInputActive;
}

int normalizeSpeedLimitValue(int speedLimit)
{
  if (speedLimit <= 0 || speedLimit > ADAS_U8_MAX)
  {
    return ADAS_SPEED_LIMIT_DEFAULT_KPH;
  }
  return speedLimit;
}

int normalizeBaseZoneContextValue(int baseZoneContext)
{
  if (baseZoneContext < 0 || baseZoneContext > ADAS_BASE_ZONE_CONTEXT_GUIDE_RIGHT)
  {
    return 0;
  }
  return baseZoneContext;
}

int normalizeEmergencyContextValue(int emergencyContext)
{
  if (emergencyContext < 0 || emergencyContext > ADAS_EMERGENCY_CONTEXT_AMBULANCE)
  {
    return 0;
  }
  return emergencyContext;
}

int isObjectInputValid(int isObjectTrackValid, int objectConfidence, int objectRange)
{
  if (isObjectTrackValid == 1 &&
      objectConfidence >= ADAS_OBJECT_CONFIDENCE_VALID_MIN &&
      objectRange > 0 &&
      objectRange <= ADAS_OBJECT_RANGE_MAX_M)
  {
    return 1;
  }
  return 0;
}

int applyObjectTrackHold(int isObjectTrackValid, int isObjectInputValidState, int objectAlertHoldMs, dword nowMs)
{
  gObjectHoldActiveWork = 0;

  if (isObjectInputValidState == 0)
  {
    isObjectTrackValid = 0;
  }

  if (isObjectTrackValid == 1)
  {
    gLastObjectTrackRxMs = nowMs;
  }
  else if (gLastObjectTrackRxMs != 0 &&
           (nowMs - gLastObjectTrackRxMs) <= (dword)objectAlertHoldMs &&
           gLastObjectRiskClass >= ADAS_OBJECT_RISK_CLASS_WARNING_MIN)
  {
    isObjectTrackValid = 1;
    gObjectHoldActiveWork = 1;
  }

  return isObjectTrackValid;
}

int calcHeldObjectRiskClass(int isObjectTrackValid, int objectConfidence, int objectRiskLevel, int isObjectHoldActive)
{
  int objectRiskClass;

  objectRiskClass = calcObjectRiskClass(isObjectTrackValid, objectConfidence, objectRiskLevel);
  if (isObjectHoldActive == 1 &&
      objectRiskClass >= ADAS_OBJECT_RISK_CLASS_WARNING_MIN &&
      objectRiskClass < ADAS_OBJECT_RISK_CLASS_HOLD_FLOOR)
  {
    objectRiskClass = ADAS_OBJECT_RISK_CLASS_HOLD_FLOOR;
  }
  return objectRiskClass;
}

void updateObjectEventCode(int objectRiskClass)
{
  if (objectRiskClass != gLastObjectRiskClass)
  {
    if (objectRiskClass >= ADAS_OBJECT_RISK_CLASS_WARNING_MIN &&
        gLastObjectRiskClass < ADAS_OBJECT_RISK_CLASS_WARNING_MIN)
    {
      @Core::objectEventCode = ADAS_OBJECT_EVENT_ENTER;
    }
    else if (objectRiskClass < ADAS_OBJECT_RISK_CLASS_WARNING_MIN &&
             gLastObjectRiskClass >= ADAS_OBJECT_RISK_CLASS_WARNING_MIN)
    {
      @Core::objectEventCode = ADAS_OBJECT_EVENT_EXIT;
    }
    else if (objectRiskClass >= ADAS_OBJECT_RISK_CLASS_WARNING_MIN)
    {
      @Core::objectEventCode = ADAS_OBJECT_EVENT_UPDATE;
    }
    else
    {
      @Core::objectEventCode = ADAS_EVENT_CODE_NONE;
    }
    gLastObjectRiskClass = objectRiskClass;
  }
}

void publishObjectSnapshot(int objectTrackValid, int objectRange, int objectRelSpeed,
                           int objectConfidence, int objectRiskClass, int objectTtcMin,
                           int intersectionConflictFlag, int mergeCutInFlag,
                           int objectAlertHoldMs, int objectRiskLevel)
{
  @Core::objectTrackValid = objectTrackValid;
  @Core::objectRange = objectRange;
  @Core::objectRelSpeed = objectRelSpeed;
  @Core::objectConfidence = objectConfidence;
  @Core::objectRiskClass = objectRiskClass;
  @Core::objectTtcMin = objectTtcMin;
  @Core::intersectionConflictFlag = intersectionConflictFlag;
  @Core::mergeCutInFlag = mergeCutInFlag;
  @Core::objectAlertHoldMs = objectAlertHoldMs;
  gLastObjectRiskLevel = objectRiskLevel;

  if (objectRiskClass >= ADAS_OBJECT_RISK_CLASS_WARNING_MIN)
  {
    gLastObjectAlertLevel = getObjectAlertLevel(intersectionConflictFlag, mergeCutInFlag, objectRiskClass);
    gLastObjectAlertType = getObjectAlertType(intersectionConflictFlag, mergeCutInFlag);
  }
  else
  {
    gLastObjectAlertLevel = ADAS_ALERT_LEVEL_NONE;
    gLastObjectAlertType = ADAS_ALERT_TYPE_NONE;
  }
}

int calcMergedRiskLevel(int emergencyContext, int etaSec, int speed, int emergencyDirection,
                        int driveState, int objectRiskLevel)
{
  int riskLevel;

  riskLevel = calcProximityRisk(emergencyContext, etaSec, speed, emergencyDirection, driveState);
  if (objectRiskLevel > riskLevel)
  {
    riskLevel = objectRiskLevel;
  }
  return riskLevel;
}

int deriveWarningState(int driveState, int baseZoneContext, int speed, int speedLimit,
                       int steeringInput, int emergencyContext, int objectRiskClass, dword nowMs)
{
  int warningState;

  warningState = ADAS_WARNING_STATE_NONE;
  if (isDriveStateDriving(driveState) == 1)
  {
    if (baseZoneContext == ADAS_BASE_ZONE_CONTEXT_SCHOOL && speed > speedLimit)
    {
      warningState = ADAS_WARNING_STATE_CAUTION;
    }
    else if (baseZoneContext == ADAS_BASE_ZONE_CONTEXT_HIGHWAY &&
             speed >= ADAS_HIGHWAY_NO_STEER_MIN_SPEED_KPH &&
             steeringInput == ADAS_STEERING_INPUT_INACTIVE)
    {
      if (gHighwayNoSteerStartMs == 0)
      {
        gHighwayNoSteerStartMs = nowMs;
      }
      if ((nowMs - gHighwayNoSteerStartMs) >= ADAS_HIGHWAY_NO_STEER_TRIGGER_MS)
      {
        warningState = ADAS_WARNING_STATE_CRITICAL;
      }
    }
    /* Preserve the 10 s highway timer during active emergency so steering glitches do not reset it. */
    else if (isEmergencyContextActive(emergencyContext) == 0)
    {
      gHighwayNoSteerStartMs = 0;
    }
  }
  else if (isEmergencyContextActive(emergencyContext) == 0)
  {
    gHighwayNoSteerStartMs = 0;
  }

  if (warningState == ADAS_WARNING_STATE_NONE &&
      objectRiskClass >= ADAS_OBJECT_RISK_CLASS_CRITICAL_MIN)
  {
    warningState = ADAS_WARNING_STATE_CRITICAL;
  }

  return warningState;
}

void publishWarningStateIfChanged(int warningState)
{
  if (warningState != gLastWarningState)
  {
    message frmAdasChassisStatusMsg mAdas;

    @Core::warningState = warningState;
    mAdas.AdasChassisState = warningState;
    mAdas.AdasHealthLevel = (warningState > ADAS_WARNING_STATE_NONE) ? 1 : 0;
    output(mAdas);
    gLastWarningState = warningState;
  }
}

void logObjectEventIfChanged(int objectRiskClass, int objectTtcMin, int objectConfidence, int isObjectHoldActive)
{
  if ((int)@Core::objectEventCode != gLastObjectEventCode)
  {
    write("[ADAS] objectEvent=%d riskClass=%d ttcMs=%d conf=%d hold=%d",
          (int)@Core::objectEventCode, objectRiskClass, objectTtcMin,
          objectConfidence, isObjectHoldActive);
    gLastObjectEventCode = (int)@Core::objectEventCode;
  }
}

void runArbiter()
{
  int emergencyContext;
  int warningState;
  int baseZoneContext;
  int proximityRiskLevel;
  int failSafeMode;
  int driveState;
  int isSteeringInputActive;
  int brakePedal;
  int isObjectTrackValid;
  int objectConfidence;
  int objectRiskClass;
  int objectTtcMin;
  int isIntersectionConflict;
  int isMergeCutIn;
  int isObjectWarningActiveState;
  int decelRiskOnThreshold;
  int decelRiskOffThreshold;
  int turnLampState;
  int driveMode;
  int ecoMode;
  int sportMode;
  int isDriverSeatBeltLatched;
  int isPassengerSeatBeltLatched;
  int seatBeltWarnLvl;
  int isTimeoutClear;
  int boundaryStatus;
  int isStaleInput;
  int isFallbackApplied;
  int duplicatePopupGuard;
  dword nowMs;
  dword lastEmergencyRxMs;
  int preAdjustAlertLevel;
  int preAdjustAlertType;
  int isPrevDecelAssistReq;
  int isDecelAssistReq;
  int driverReleaseReason;
  int baseAlertLevel;
  int baseAlertType;
  int selectedAlertLevel;
  int selectedAlertType;

  emergencyContext = clampRange((int)@Core::emergencyContext, 0, 2);
  warningState = clampRange((int)@Core::warningState, 0, 2);
  baseZoneContext = clampRange((int)@Core::baseZoneContext, 0, 4);
  proximityRiskLevel = clampRange((int)@Core::proximityRiskLevel, 0, 100);
  failSafeMode = clampRange((int)@Core::failSafeMode, 0, 2);
  driveState = clampRange((int)@Core::driveStateNorm, 0, ADAS_DRIVE_STATE_DRIVE);
  isSteeringInputActive = clampRange((int)@Core::steeringInputNorm, 0, ADAS_STEERING_INPUT_ACTIVE);
  brakePedal = clampRange((int)@Core::brakePedalNorm, 0, 100);
  isObjectTrackValid = clampRange((int)@Core::objectTrackValid, 0, 1);
  objectConfidence = clampRange((int)@Core::objectConfidence, 0, 100);
  objectRiskClass = clampRange((int)@Core::objectRiskClass, 0, 7);
  objectTtcMin = clampRange((int)@Core::objectTtcMin, 0, ADAS_TTC_MAX_MS);
  isIntersectionConflict = clampRange((int)@Core::intersectionConflictFlag, 0, 1);
  isMergeCutIn = clampRange((int)@Core::mergeCutInFlag, 0, 1);
  isTimeoutClear = (((int)@Core::timeoutClear) == 1) ? 1 : 0;
  boundaryStatus = clampRange((int)@CoreState::domainBoundaryStatus, 0, 1);
  duplicatePopupGuard = clampRange((int)@CoreState::duplicatePopupGuard, 0, ADAS_DUPLICATE_POPUP_GUARD_MAX_MS);
  lastEmergencyRxMs = (dword)@CoreState::lastEmergencyRxMs;
  nowMs = getSimulationTimeMs();
  isStaleInput = 0;
  isFallbackApplied = 0;
  isObjectWarningActiveState = isObjectWarningActive(isObjectTrackValid, objectConfidence, objectRiskClass);
  turnLampState = clampRange((int)@CoreState::turnLampState, 0, 3);
  driveMode = clampRange((int)@CoreState::driveMode, 0, 7);
  ecoMode = clampRange((int)@CoreState::ecoMode, 0, 1);
  sportMode = clampRange((int)@CoreState::sportMode, 0, 1);
  isDriverSeatBeltLatched = clampRange((int)@CoreState::driverSeatBelt, 0, 1);
  isPassengerSeatBeltLatched = clampRange((int)@CoreState::passengerSeatBelt, 0, 1);
  seatBeltWarnLvl = clampRange((int)@CoreState::seatBeltWarnLvl, 0, 3);

  isPrevDecelAssistReq = (((int)@Core::decelAssistReq) == 1) ? 1 : 0;
  baseAlertLevel = ADAS_ALERT_LEVEL_NONE;
  baseAlertType = ADAS_ALERT_TYPE_NONE;
  selectedAlertLevel = ADAS_ALERT_LEVEL_NONE;
  selectedAlertType = ADAS_ALERT_TYPE_NONE;
  isDecelAssistReq = isPrevDecelAssistReq;
  driverReleaseReason = ADAS_DRIVER_RELEASE_REASON_NONE;

  decelRiskOnThreshold = getDecelRiskOnThreshold(emergencyContext, isObjectWarningActiveState);
  decelRiskOffThreshold = getDecelRiskOffThreshold(emergencyContext, isObjectWarningActiveState);
  isDecelAssistReq = calcDecelAssistRequest(isPrevDecelAssistReq, proximityRiskLevel,
                                            decelRiskOnThreshold, decelRiskOffThreshold,
                                            isDecelAssistControlAllowed(failSafeMode, driveState,
                                                                        emergencyContext, isObjectWarningActiveState));
  applyDriverOverrideToDecelAssist(isDecelAssistReq, brakePedal, isSteeringInputActive);
  isDecelAssistReq = gWorkDecelAssistReq;
  driverReleaseReason = gWorkDriverReleaseReason;

  if (failSafeMode != 0 &&
      isPrevDecelAssistReq == 1 &&
      isDecelAssistReq == 0 &&
      driverReleaseReason == ADAS_DRIVER_RELEASE_REASON_NONE)
  {
    driverReleaseReason = ADAS_DRIVER_RELEASE_REASON_FAILSAFE;
  }

  baseAlertLevel = getBaseAlertLevel(baseZoneContext, warningState);
  baseAlertType = getBaseAlertType(baseZoneContext, warningState);

  if (isEmergencyContextActive(emergencyContext) == 1 &&
      gPrevEmergencyContext == ADAS_EMERGENCY_CONTEXT_NONE)
  {
    gPreEmergencyAlertLevel = baseAlertLevel;
    gPreEmergencyAlertType = baseAlertType;
    gPreEmergencySnapshotValid = 1;
    write("[ADAS] Alert preempt zone lvl=%d type=%d -> emergency=%d",
          gPreEmergencyAlertLevel, gPreEmergencyAlertType, emergencyContext);
  }

  deriveSelectedAlertFromPriority(emergencyContext, baseAlertLevel, baseAlertType,
                                  isObjectWarningActiveState, isIntersectionConflict,
                                  isMergeCutIn, objectRiskClass);
  selectedAlertLevel = gWorkSelectedAlertLevel;
  selectedAlertType = gWorkSelectedAlertType;

  applyDecelAssistAlertOverride(isDecelAssistReq, emergencyContext, isObjectWarningActiveState,
                                selectedAlertLevel, selectedAlertType);
  selectedAlertLevel = gWorkSelectedAlertLevel;
  selectedAlertType = gWorkSelectedAlertType;

  isStaleInput = isStaleAlertInput(isTimeoutClear, emergencyContext, lastEmergencyRxMs,
                                   nowMs, boundaryStatus, selectedAlertLevel);
  applyStaleAlertFallback(isStaleInput, emergencyContext, selectedAlertLevel, selectedAlertType);
  selectedAlertLevel = gWorkSelectedAlertLevel;
  selectedAlertType = gWorkSelectedAlertType;

  isFallbackApplied = isFailSafeFallbackRequired(failSafeMode, selectedAlertLevel, isStaleInput);
  applyFailSafeAlertFallback(isFallbackApplied, emergencyContext, selectedAlertLevel, selectedAlertType);
  selectedAlertLevel = gWorkSelectedAlertLevel;
  selectedAlertType = gWorkSelectedAlertType;

  preAdjustAlertLevel = selectedAlertLevel;
  preAdjustAlertType = selectedAlertType;
  applyContextAlertAdjustments(emergencyContext, isObjectWarningActiveState, turnLampState,
                               driveMode, ecoMode, sportMode,
                               isDriverSeatBeltLatched, isPassengerSeatBeltLatched,
                               seatBeltWarnLvl, selectedAlertLevel, selectedAlertType);
  selectedAlertLevel = gWorkSelectedAlertLevel;
  selectedAlertType = gWorkSelectedAlertType;

  if (selectedAlertLevel != preAdjustAlertLevel || selectedAlertType != preAdjustAlertType)
  {
    write("[ADAS] context adjust lvl=%d->%d type=%d->%d turn=%d mode=%d eco=%d sport=%d beltD=%d beltP=%d beltLvl=%d",
          preAdjustAlertLevel, selectedAlertLevel,
          preAdjustAlertType, selectedAlertType,
          turnLampState, driveMode, ecoMode, sportMode,
          isDriverSeatBeltLatched, isPassengerSeatBeltLatched, seatBeltWarnLvl);
  }

  if (gStableAlertLevel < 0)
  {
    gStableAlertLevel = selectedAlertLevel;
    gStableAlertType = selectedAlertType;
    gLastStableAlertMs = nowMs;
  }
  else if (selectedAlertLevel != gStableAlertLevel || selectedAlertType != gStableAlertType)
  {
    if (shouldKeepStableAlert(selectedAlertLevel, selectedAlertType, nowMs, duplicatePopupGuard) == 1)
    {
      selectedAlertLevel = gStableAlertLevel;
      selectedAlertType = gStableAlertType;
    }
    else
    {
      gStableAlertLevel = selectedAlertLevel;
      gStableAlertType = selectedAlertType;
      gLastStableAlertMs = nowMs;
    }
  }

  if (isStaleInput != gLastStaleInputState || isFallbackApplied != gLastFallbackState)
  {
    write("[ADAS] robust stale=%d fallback=%d timeout=%d boundary=%d failSafe=%d lastRx=%d",
          isStaleInput, isFallbackApplied, isTimeoutClear, boundaryStatus, failSafeMode, (int)lastEmergencyRxMs);
    gLastStaleInputState = isStaleInput;
    gLastFallbackState = isFallbackApplied;
  }

  @Core::decelAssistReq = isDecelAssistReq;
  @Core::selectedAlertLevel = selectedAlertLevel;
  @Core::selectedAlertType = selectedAlertType;
  if (gLastAlertLevel != selectedAlertLevel || gLastAlertType != selectedAlertType)
  {
    @CoreState::arbitrationSnapshotId = ((int)@CoreState::arbitrationSnapshotId + 1) & ADAS_ARBITRATION_SNAPSHOT_MASK;
    gLastAlertLevel = selectedAlertLevel;
    gLastAlertType = selectedAlertType;
  }
  if (gLastDecelAssistReq != isDecelAssistReq ||
      gLastDriverReleaseReason != driverReleaseReason)
  {
    write("[ADAS] decelAssistReq=%d risk=%d failSafe=%d steer=%d brake=%d reason=%d objClass=%d objTtc=%d objConf=%d",
          isDecelAssistReq, proximityRiskLevel, failSafeMode,
          isSteeringInputActive, brakePedal, driverReleaseReason,
          objectRiskClass, objectTtcMin, objectConfidence);
    gLastDecelAssistReq = isDecelAssistReq;
    gLastDriverReleaseReason = driverReleaseReason;
  }

  gPrevEmergencyContext = emergencyContext;
}

void updateWarningState()
{
  int speed;
  int driveState;
  int isSteeringInputActive;
  int speedLimit;
  int baseZoneContext;
  int emergencyContext;
  int etaSec;
  int emergencyDirection;
  int warningState;
  int riskLevel;
  int isObjectTrackValid;
  int objectRange;
  int objectRelSpeed;
  int objectConfidence;
  int objectRiskClass;
  int objectRiskLevel;
  int objectTtcMin;
  int isIntersectionConflict;
  int isMergeCutIn;
  int objectAlertHoldMs;
  int isObjectHoldActive;
  int isObjectInputValidState;
  dword nowMs;

  speed = (int)@Core::vehicleSpeedNorm;
  driveState = (int)@Core::driveStateNorm;
  isSteeringInputActive = (int)@Core::steeringInputNorm;
  speedLimit = (int)@Core::speedLimitNorm;
  baseZoneContext = (int)@Core::baseZoneContext;
  emergencyContext = (int)@Core::emergencyContext;
  etaSec = (int)@V2X::eta;
  emergencyDirection = (int)@V2X::emergencyDirection;
  isObjectTrackValid = clampRange((int)@Core::objectTrackValid, 0, 1);
  objectRange = clampRange((int)@Core::objectRange, 0, ADAS_OBJECT_RANGE_MAX_M);
  objectRelSpeed = clampRange((int)@Core::objectRelSpeed, ADAS_OBJECT_REL_SPEED_MIN_KPH, ADAS_OBJECT_REL_SPEED_MAX_KPH);
  objectConfidence = clampRange((int)@Core::objectConfidence, 0, 100);
  isIntersectionConflict = clampRange((int)@Core::intersectionConflictFlag, 0, 1);
  isMergeCutIn = clampRange((int)@Core::mergeCutInFlag, 0, 1);
  objectAlertHoldMs = clampRange((int)@Core::objectAlertHoldMs, 0, ADAS_HOLD_WINDOW_MAX_MS);

  /* Normalize object, emergency, and zone inputs before running the risk logic. */
  if (objectAlertHoldMs == 0)
  {
    objectAlertHoldMs = ADAS_OBJECT_HOLD_DEFAULT_MS;
  }
  emergencyContext = normalizeEmergencyContextValue(emergencyContext);
  etaSec = clampRange(etaSec, 0, ADAS_U8_MAX);
  emergencyDirection = clampRange(emergencyDirection, 0, 3);
  speed = normalizeSpeedValue(speed);
  driveState = normalizeDriveStateValue(driveState);
  isSteeringInputActive = normalizeSteeringInputValue(isSteeringInputActive);
  speedLimit = normalizeSpeedLimitValue(speedLimit);
  baseZoneContext = normalizeBaseZoneContextValue(baseZoneContext);

  /* Determine whether the latest object sample is valid and whether the hold window is active. */
  nowMs = getSimulationTimeMs();
  isObjectInputValidState = isObjectInputValid(isObjectTrackValid, objectConfidence, objectRange);
  isObjectTrackValid = applyObjectTrackHold(isObjectTrackValid, isObjectInputValidState, objectAlertHoldMs, nowMs);
  isObjectHoldActive = gObjectHoldActiveWork;

  /* Convert object kinematics into TTC and risk, then keep a minimum warning class during hold. */
  if (isObjectTrackValid == 1 && objectConfidence >= ADAS_OBJECT_CONFIDENCE_RISK_MIN)
  {
    objectTtcMin = calcObjectTtcMs(objectRange, objectRelSpeed);
    objectRiskLevel = calcObjectRisk(objectTtcMin, objectConfidence, objectRange,
                                     isIntersectionConflict, isMergeCutIn);
  }
  else
  {
    objectTtcMin = ADAS_TTC_MAX_MS;
    objectRiskLevel = 0;
  }

  objectRiskClass = calcHeldObjectRiskClass(isObjectTrackValid, objectConfidence, objectRiskLevel, isObjectHoldActive);

  if (isObjectInputValidState != gLastInputFilterState)
  {
    write("[ADAS] input filter valid=%d track=%d conf=%d range=%d rel=%d",
          isObjectInputValidState, isObjectTrackValid, objectConfidence, objectRange, objectRelSpeed);
    gLastInputFilterState = isObjectInputValidState;
  }

  updateObjectEventCode(objectRiskClass);

  /* Publish the filtered object snapshot so downstream arbitration sees one consistent view. */
  publishObjectSnapshot(isObjectTrackValid, objectRange, objectRelSpeed,
                        objectConfidence, objectRiskClass, objectTtcMin,
                        isIntersectionConflict, isMergeCutIn,
                        objectAlertHoldMs, objectRiskLevel);

  /* Merge emergency proximity risk with object risk, then derive the active warning state. */
  riskLevel = calcMergedRiskLevel(emergencyContext, etaSec, speed, emergencyDirection, driveState, objectRiskLevel);
  @Core::proximityRiskLevel = riskLevel;
  warningState = deriveWarningState(driveState, baseZoneContext, speed, speedLimit,
                                    isSteeringInputActive, emergencyContext, objectRiskClass, nowMs);

  /* Emit chassis-facing ADAS state only on change and keep debug traces edge-triggered. */
  publishWarningStateIfChanged(warningState);

  if (riskLevel != gLastRiskLevel)
  {
    gLastRiskLevel = riskLevel;
  }

  logObjectEventIfChanged(objectRiskClass, objectTtcMin, objectConfidence, isObjectHoldActive);
}

void applyObjectRiskInput(int trackValid,
                          int rangeM,
                          int relSpeedKph,
                          int confidence,
                          int intersectionConflict,
                          int mergeCutIn,
                          int alertHoldMs)
{
  if (alertHoldMs == 0)
  {
    alertHoldMs = ADAS_OBJECT_HOLD_DEFAULT_MS;
  }

  @Core::objectTrackValid = trackValid;
  @Core::objectRange = rangeM;
  @Core::objectRelSpeed = relSpeedKph;
  @Core::objectConfidence = confidence;
  @Core::intersectionConflictFlag = intersectionConflict;
  @Core::mergeCutInFlag = mergeCutIn;
  @Core::objectAlertHoldMs = alertHoldMs;
  if (trackValid == 1)
  {
    gLastObjectTrackRxMs = getSimulationTimeMs();
  }
}

void OnUdpReceiveFrom(dword socket, long result, dword address, dword port, char buffer[], dword count)
{
  int msgId;

  if (socket != gEthSocket)
  {
    return;
  }
  if (result == 0)
  {
    msgId = ethFrameMsgId(buffer, count);
    if (msgId == ethMsgObjectRiskInput() && ethFramePayloadLen(count) >= 8)
    {
      applyObjectRiskInput(ethGetU8(buffer, 0) & 0x1,
                           clampRange(ethGetU16Le(buffer, 1), 0, ADAS_OBJECT_RANGE_MAX_M),
                           clampRange(ethGetS16Le(buffer, 3), ADAS_OBJECT_REL_SPEED_MIN_KPH, ADAS_OBJECT_REL_SPEED_MAX_KPH),
                           clampRange(ethGetU8(buffer, 5), 0, 100),
                           (ethGetU8(buffer, 0) >> 1) & 0x1,
                           (ethGetU8(buffer, 0) >> 2) & 0x1,
                           clampRange(ethGetU16Le(buffer, 6), 0, ADAS_HOLD_WINDOW_MAX_MS));
    }
  }

  ethArmReceive(gEthSocket, gEthRxBuffer, elcount(gEthRxBuffer));
}

on start
{
  gEthSocket = ethOpenDefaultSocket();
  gEthTargetIp = ethGetDefaultIpAddress();
  gLastWarningState = -1;
  gHighwayNoSteerStartMs = 0;
  gLastRiskLevel = -1;
  gRiskPublishTick = 0;
  gObjectStatePublishTick = 0;
  gLastObjectTrackRxMs = 0;
  gLastObjectRiskClass = 0;
  gLastObjectEventCode = -1;
  gLastInputFilterState = -1;
  gLastAlertLevel = -1;
  gLastAlertType = -1;
  gLastDecelAssistReq = -1;
  gLastDriverReleaseReason = -1;
  gPrevEmergencyContext = 0;
  gPreEmergencyAlertLevel = 0;
  gPreEmergencyAlertType = 0;
  gPreEmergencySnapshotValid = 0;
  gLastStableAlertMs = 0;
  gStableAlertLevel = -1;
  gStableAlertType = -1;
  gLastStaleInputState = -1;
  gLastFallbackState = -1;
  gLastObjectRiskLevel = 0;
  gLastObjectAlertLevel = 0;
  gLastObjectAlertType = 0;
  gObjectHoldActiveWork = 0;
  gWorkDecelAssistReq = 0;
  gWorkDriverReleaseReason = ADAS_DRIVER_RELEASE_REASON_NONE;
  gWorkSelectedAlertLevel = ADAS_ALERT_LEVEL_NONE;
  gWorkSelectedAlertType = ADAS_ALERT_TYPE_NONE;
  @Core::proximityRiskLevel = 0;
  @Core::objectTrackValid = 0;
  @Core::objectRange = 0;
  @Core::objectRelSpeed = 0;
  @Core::objectConfidence = 0;
  @Core::objectRiskClass = 0;
  @Core::objectTtcMin = ADAS_TTC_MAX_MS;
  @Core::intersectionConflictFlag = 0;
  @Core::mergeCutInFlag = 0;
  @Core::objectAlertHoldMs = ADAS_OBJECT_HOLD_DEFAULT_MS;
  @Core::objectEventCode = ADAS_EVENT_CODE_NONE;
  @Core::decelAssistReq = 0;
  if (gEthSocket != ethInvalidSocket())
  {
    ethStartReceiver(gEthSocket, gEthRxBuffer, elcount(gEthRxBuffer));
  }
  setTimer(tAdasCycle, ADAS_TIMER_CYCLE_MS);
  setTimer(tArbiter50, ADAS_TIMER_ARBITER_MS);
  write("[ADAS] start");
}

on timer tAdasCycle
{
  updateWarningState();
  setTimer(tAdasCycle, ADAS_TIMER_CYCLE_MS);
}

on timer tArbiter50
{
  runArbiter();
  publishBackboneDecisionFrames();
  setTimer(tArbiter50, ADAS_TIMER_ARBITER_MS);
}

on stopMeasurement
{
  cancelTimer(tAdasCycle);
  cancelTimer(tArbiter50);
  ethCloseSocket(gEthSocket);
  gEthSocket = ethInvalidSocket();
}
