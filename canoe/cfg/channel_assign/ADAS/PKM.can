includes
{
  #include "..\\common\\CAPL_COMMON.cin"
}

variables
{
  msTimer tParkMasterCycle;
  int gSpasActive;
  int gSpasStage;
  int gRspaReady;
  int gAvmActive;
  int gViewMode;
  int gParkAssistActive;
  int gMinDistanceCm;
  int gLastActive;
  int gLastReady;
  int gLastPhase;
  int gLastViewMode;
  int gLastDistance;
}

void publishParkMasterState()
{
  message frmParkMasterStateMsg mParkMaster;
  int parkMasterActive;
  int autoManeuverReady;
  int parkPhase;
  int surroundHealth;

  parkMasterActive = (gSpasActive == 1 || gRspaReady == 1 || gAvmActive == 1 || gParkAssistActive == 1) ? 1 : 0;
  autoManeuverReady = (gSpasActive == 1 || gRspaReady == 1) ? 1 : 0;

  parkPhase = 0;
  if (gRspaReady == 1)
  {
    parkPhase = 3;
  }
  else if (gSpasActive == 1)
  {
    parkPhase = clampRange(gSpasStage, 0, 3);
  }
  else if (gParkAssistActive == 1)
  {
    parkPhase = 1;
  }

  surroundHealth = 0;
  if (gAvmActive == 1)
  {
    surroundHealth = 2;
  }
  else if (gParkAssistActive == 1)
  {
    surroundHealth = 1;
  }

  mParkMaster.ParkMasterActive = parkMasterActive;
  mParkMaster.AutoManeuverReady = autoManeuverReady;
  mParkMaster.ParkPhase = clampRange(parkPhase, 0, 3);
  mParkMaster.ViewMode = clampRange(gViewMode, 0, 7);
  mParkMaster.MinDistanceCm = clampRange(gMinDistanceCm, 0, 255);
  mParkMaster.AssistStage = clampRange(gSpasStage, 0, 3);
  mParkMaster.SurroundHealth = clampRange(surroundHealth, 0, 3);
  output(mParkMaster);

  if (parkMasterActive != gLastActive ||
      autoManeuverReady != gLastReady ||
      parkPhase != gLastPhase ||
      gViewMode != gLastViewMode ||
      gMinDistanceCm != gLastDistance)
  {
    write("[PKM] active=%d ready=%d phase=%d view=%d dist=%d spas=%d rspa=%d",
          parkMasterActive,
          autoManeuverReady,
          parkPhase,
          gViewMode,
          gMinDistanceCm,
          gSpasActive,
          gRspaReady);
    gLastActive = parkMasterActive;
    gLastReady = autoManeuverReady;
    gLastPhase = parkPhase;
    gLastViewMode = gViewMode;
    gLastDistance = gMinDistanceCm;
  }
}

on start
{
  gSpasActive = 0;
  gSpasStage = 0;
  gRspaReady = 0;
  gAvmActive = 0;
  gViewMode = 0;
  gParkAssistActive = 0;
  gMinDistanceCm = 255;
  gLastActive = -1;
  gLastReady = -1;
  gLastPhase = -1;
  gLastViewMode = -1;
  gLastDistance = -1;
  setTimer(tParkMasterCycle, 100);
  write("[PKM] start");
}

on timer tParkMasterCycle
{
  publishParkMasterState();
  setTimer(tParkMasterCycle, 100);
}

on message frmSpasStateMsg
{
  gSpasActive = clampRange((int)this.SpasActive, 0, 1);
  gSpasStage = clampRange((int)this.SpasStage, 0, 3);
}

on message frmRspaStateMsg
{
  gRspaReady = clampRange((int)this.RspaReady, 0, 1);
}

on message frmAvmStateMsg
{
  gAvmActive = clampRange((int)this.AvmActive, 0, 1);
  gViewMode = clampRange((int)this.ViewMode, 0, 7);
}

on message frmParkUltrasonicStateMsg
{
  gParkAssistActive = clampRange((int)this.ParkAssistActive, 0, 1);
  gMinDistanceCm = clampRange((int)this.MinDistanceCm, 0, 255);
}

on stopMeasurement
{
  cancelTimer(tParkMasterCycle);
}
