includes
{
}

variables
{
}

on start
{
  write("[WARN_ARB_MGR] absorbed into ADAS runtime; wrapper only");
}
