includes
{
  #include "..\\common\\CAPL_COMMON.cin"
}

variables
{
  msTimer tRearRadarCycle;
  int gLeftDetected;
  int gLeftRisk;
  int gLeftMergeConflict;
  int gLeftTurnLamp;
  int gRightDetected;
  int gRightRisk;
  int gRightMergeConflict;
  int gRightTurnLamp;
  int gLastDetected;
  int gLastLaneChangeBlock;
  int gLastRisk;
  int gLastConflict;
  int gLastHealth;
}

void publishRearRadarMasterState()
{
  message frmRearRadarMasterStateMsg mRear;
  int detected;
  int laneChangeBlock;
  int rearRiskLevel;
  int mergeConflict;
  int turnLampState;
  int sensorHealth;

  detected = (gLeftDetected == 1 || gRightDetected == 1) ? 1 : 0;
  laneChangeBlock = (gLeftRisk >= 40 || gRightRisk >= 40) ? 1 : 0;
  rearRiskLevel = max(gLeftRisk, gRightRisk);
  mergeConflict = (gLeftMergeConflict == 1 || gRightMergeConflict == 1) ? 1 : 0;
  turnLampState = (gLeftTurnLamp != 0) ? gLeftTurnLamp : gRightTurnLamp;

  sensorHealth = 0;
  if (detected == 1)
  {
    sensorHealth = 2;
  }
  else if (rearRiskLevel > 0)
  {
    sensorHealth = 1;
  }

  mRear.RearObjectDetected = detected;
  mRear.LaneChangeBlock = laneChangeBlock;
  mRear.RearRiskLevel = clampRange(rearRiskLevel, 0, 100);
  mRear.MergeConflict = mergeConflict;
  mRear.TurnLampState = clampRange(turnLampState, 0, 3);
  mRear.SensorHealth = clampRange(sensorHealth, 0, 3);
  output(mRear);

  if (detected != gLastDetected ||
      laneChangeBlock != gLastLaneChangeBlock ||
      rearRiskLevel != gLastRisk ||
      mergeConflict != gLastConflict ||
      sensorHealth != gLastHealth)
  {
    write("[REAR_RADAR_MASTER] detected=%d lcb=%d risk=%d conflict=%d lamp=%d health=%d",
          detected,
          laneChangeBlock,
          rearRiskLevel,
          mergeConflict,
          turnLampState,
          sensorHealth);
    gLastDetected = detected;
    gLastLaneChangeBlock = laneChangeBlock;
    gLastRisk = rearRiskLevel;
    gLastConflict = mergeConflict;
    gLastHealth = sensorHealth;
  }
}

on start
{
  gLeftDetected = 0;
  gLeftRisk = 0;
  gLeftMergeConflict = 0;
  gLeftTurnLamp = 0;
  gRightDetected = 0;
  gRightRisk = 0;
  gRightMergeConflict = 0;
  gRightTurnLamp = 0;
  gLastDetected = -1;
  gLastLaneChangeBlock = -1;
  gLastRisk = -1;
  gLastConflict = -1;
  gLastHealth = -1;
  setTimer(tRearRadarCycle, 100);
  write("[REAR_RADAR_MASTER] start");
}

on timer tRearRadarCycle
{
  publishRearRadarMasterState();
  setTimer(tRearRadarCycle, 100);
}

on message frmSrrRlStateMsg
{
  gLeftDetected = clampRange((int)this.SideObjectDetected, 0, 1);
  gLeftRisk = clampRange((int)this.SideRiskLevel, 0, 100);
  gLeftMergeConflict = clampRange((int)this.MergeConflict, 0, 1);
  gLeftTurnLamp = clampRange((int)this.TurnLampState, 0, 3);
}

on message frmSrrRrStateMsg
{
  gRightDetected = clampRange((int)this.SideObjectDetected, 0, 1);
  gRightRisk = clampRange((int)this.SideRiskLevel, 0, 100);
  gRightMergeConflict = clampRange((int)this.MergeConflict, 0, 1);
  gRightTurnLamp = clampRange((int)this.TurnLampState, 0, 3);
}

on stopMeasurement
{
  cancelTimer(tRearRadarCycle);
}