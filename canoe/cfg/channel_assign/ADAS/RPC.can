includes
{
  #include "..\\common\\CAPL_COMMON.cin"
}

variables
{
  msTimer tRoadPreviewCycle;
  int gCameraHealth;
  int gObjectDetected;
  int gLaneModelValid;
  int gConfidence;
  int gLastHealth;
  int gLastLanePreview;
  int gLastZonePreview;
  int gLastSpeedLimit;
  int gLastConfidence;
}

void publishRoadPreviewState()
{
  message frmRoadPreviewCameraStateMsg mPreview;
  int zonePreview;
  int speedLimit;
  int previewHealth;

  zonePreview = clampRange((int)@Core::baseZoneContext, 0, 7);
  speedLimit = clampRange((int)@Core::speedLimitNorm, 0, 255);

  previewHealth = 0;
  if (gCameraHealth >= 2 && gConfidence >= 60)
  {
    previewHealth = 2;
  }
  else if (gCameraHealth >= 1 && gConfidence >= 30)
  {
    previewHealth = 1;
  }

  mPreview.PreviewHealth = clampRange(previewHealth, 0, 3);
  mPreview.LanePreviewValid = clampRange(gLaneModelValid, 0, 1);
  mPreview.ZonePreview = clampRange(zonePreview, 0, 7);
  mPreview.SpeedLimit = speedLimit;
  mPreview.PreviewConfidence = clampRange(gConfidence, 0, 100);
  output(mPreview);

  if (previewHealth != gLastHealth ||
      gLaneModelValid != gLastLanePreview ||
      zonePreview != gLastZonePreview ||
      speedLimit != gLastSpeedLimit ||
      gConfidence != gLastConfidence)
  {
    write("[RPC] health=%d lane=%d zone=%d speedLimit=%d conf=%d obj=%d",
          previewHealth,
          gLaneModelValid,
          zonePreview,
          speedLimit,
          gConfidence,
          gObjectDetected);
    gLastHealth = previewHealth;
    gLastLanePreview = gLaneModelValid;
    gLastZonePreview = zonePreview;
    gLastSpeedLimit = speedLimit;
    gLastConfidence = gConfidence;
  }
}

on start
{
  gCameraHealth = 0;
  gObjectDetected = 0;
  gLaneModelValid = 0;
  gConfidence = 0;
  gLastHealth = -1;
  gLastLanePreview = -1;
  gLastZonePreview = -1;
  gLastSpeedLimit = -1;
  gLastConfidence = -1;
  setTimer(tRoadPreviewCycle, 100);
  write("[RPC] start");
}

on timer tRoadPreviewCycle
{
  publishRoadPreviewState();
  setTimer(tRoadPreviewCycle, 100);
}

on message frmFcamStateMsg
{
  gCameraHealth = clampRange((int)this.CameraHealth, 0, 3);
  gObjectDetected = clampRange((int)this.ObjectDetected, 0, 1);
  gLaneModelValid = clampRange((int)this.LaneModelValid, 0, 1);
  gConfidence = clampRange((int)this.Confidence, 0, 100);
}

on stopMeasurement
{
  cancelTimer(tRoadPreviewCycle);
}
