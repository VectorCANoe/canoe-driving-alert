/*
Rx
  frmVehicleStateCanMsg
  - gVehicleSpeed
  - gDriveState

Tx
  frmCruiseStateMsg
  - CruiseState
  - GapLevel
  - CruiseSetSpeed
*/
includes
{
  #include "..\\common\\CAPL_COMMON.cin"
}

variables
{
  enum SccGapLevel
  {
    SCC_DEFAULT_GAP_LEVEL = 2,
    SCC_EXPANDED_GAP_LEVEL = 3
  };

  enum SccDriveState
  {
    SCC_DRIVE_STATE_DRIVE = 3
  };

  enum SccFailSafeMode
  {
    SCC_FAIL_SAFE_OFF = 0
  };

  enum SccCruiseState
  {
    SCC_STATE_OFF = 0,
    SCC_STATE_READY = 1,
    SCC_STATE_DECEL_CONTROL = 2
  };

  enum SccEmergencyContext
  {
    SCC_EMERGENCY_CONTEXT_NONE = 0
  };
  const int SCC_SPEED_LIMIT_UNSET = 0;
  const int SCC_MIN_CRUISE_SET_SPEED_KPH = 30;
  const int SCC_DEFAULT_SPEED_LIMIT_KPH = 60;

  const int SCC_HIGH_RISK_THRESHOLD = 70;
  const int SCC_HIGH_ALERT_LEVEL_THRESHOLD = 6;
  const int SCC_MEDIUM_RISK_THRESHOLD = 40;
  const int SCC_MEDIUM_ALERT_LEVEL_THRESHOLD = 4;

  const int SCC_HIGH_RISK_SPEED_REDUCTION_KPH = 10;
  const int SCC_MEDIUM_RISK_SPEED_REDUCTION_KPH = 5;

  msTimer tSccCycle;
  int gVehicleSpeed;
  int gDriveState;
  int gLastCruiseState;
  int gLastGapLevel;
  int gLastCruiseSetSpeed;
}

int isSccActivationAllowed(int driveState, int failSafeMode)
{
  return ((driveState == SCC_DRIVE_STATE_DRIVE) &&
          (failSafeMode == SCC_FAIL_SAFE_OFF));
}

int isHighRiskCruiseCondition(int riskLevel, int selectedAlertLevel, int emergencyContext)
{
  return ((riskLevel >= SCC_HIGH_RISK_THRESHOLD) ||
          (selectedAlertLevel >= SCC_HIGH_ALERT_LEVEL_THRESHOLD) ||
          (emergencyContext > SCC_EMERGENCY_CONTEXT_NONE));
}

int isMediumRiskCruiseCondition(int riskLevel, int selectedAlertLevel)
{
  return ((riskLevel >= SCC_MEDIUM_RISK_THRESHOLD) ||
          (selectedAlertLevel >= SCC_MEDIUM_ALERT_LEVEL_THRESHOLD));
}

int isCruiseSetSpeedBelowActiveMinimum(int cruiseSetSpeed, int cruiseState)
{
  return ((cruiseSetSpeed < SCC_MIN_CRUISE_SET_SPEED_KPH) &&
          (cruiseState > SCC_STATE_OFF));
}

int hasCruiseOutputChanged(int cruiseState, int gapLevel, int cruiseSetSpeed)
{
  return ((cruiseState != gLastCruiseState) ||
          (gapLevel != gLastGapLevel) ||
          (cruiseSetSpeed != gLastCruiseSetSpeed));
}

void publishCruiseState()
{
  message frmCruiseStateMsg mCruise;
  int speedLimit;
  int riskLevel;
  int failSafeMode;
  int selectedAlertLevel;
  int emergencyContext;
  int cruiseState;
  int gapLevel;
  int cruiseSetSpeed;

  speedLimit = clampRange((int)@Core::speedLimitNorm, 0, 255);
  riskLevel = clampRange((int)@Core::proximityRiskLevel, 0, 100);
  failSafeMode = clampRange((int)@Core::failSafeMode, 0, 2);
  selectedAlertLevel = clampRange((int)@Core::selectedAlertLevel, 0, 7);
  emergencyContext = clampRange((int)@Core::emergencyContext, 0, 2);

  /* Use the default speed limit when the incoming limit is unset. */
  if (speedLimit == SCC_SPEED_LIMIT_UNSET)
  {
    speedLimit = SCC_DEFAULT_SPEED_LIMIT_KPH;
  }

  /* Initialize the default SCC state, gap level, and set speed. */
  cruiseState = SCC_STATE_OFF;
  gapLevel = SCC_DEFAULT_GAP_LEVEL;
  cruiseSetSpeed = speedLimit;

  /* Enable SCC only when the vehicle is driving and fail-safe is inactive. */
  if (isSccActivationAllowed(gDriveState, failSafeMode))
  {
    cruiseState = SCC_STATE_READY;

    /* Increase the gap and lower the set speed more aggressively under high risk. */
    if (isHighRiskCruiseCondition(riskLevel, selectedAlertLevel, emergencyContext))
    {
      cruiseState = SCC_STATE_DECEL_CONTROL;
      gapLevel = SCC_EXPANDED_GAP_LEVEL;
      cruiseSetSpeed = gVehicleSpeed - SCC_HIGH_RISK_SPEED_REDUCTION_KPH;
    }
    /* Under medium risk, adjust only the gap and set speed conservatively. */
    else if (isMediumRiskCruiseCondition(riskLevel, selectedAlertLevel))
    {
      gapLevel = SCC_EXPANDED_GAP_LEVEL;
      cruiseSetSpeed = gVehicleSpeed - SCC_MEDIUM_RISK_SPEED_REDUCTION_KPH;
    }
  }

  /* Clamp the set speed to the allowed minimum and speed-limit bounds. */
  if (isCruiseSetSpeedBelowActiveMinimum(cruiseSetSpeed, cruiseState))
  {
    cruiseSetSpeed = SCC_MIN_CRUISE_SET_SPEED_KPH;
  }
  cruiseSetSpeed = clampRange(cruiseSetSpeed, 0, speedLimit);

  /* Publish the calculated SCC state through the output message. */
  mCruise.CruiseState = cruiseState;
  mCruise.GapLevel = gapLevel;
  mCruise.CruiseSetSpeed = cruiseSetSpeed;
  output(mCruise);

  /* Update the log and last-state cache only when the state changes. */
  if (hasCruiseOutputChanged(cruiseState, gapLevel, cruiseSetSpeed))
  {
    write("[SCC] cruise=%d gap=%d set=%d risk=%d failSafe=%d alert=%d ems=%d speed=%d",
          cruiseState,
          gapLevel,
          cruiseSetSpeed,
          riskLevel,
          failSafeMode,
          selectedAlertLevel,
          emergencyContext,
          gVehicleSpeed);
    gLastCruiseState = cruiseState;
    gLastGapLevel = gapLevel;
    gLastCruiseSetSpeed = cruiseSetSpeed;
  }
}

on start
{
  gVehicleSpeed = 0;
  gDriveState = 0;
  gLastCruiseState = -1;
  gLastGapLevel = -1;
  gLastCruiseSetSpeed = -1;
  setTimer(tSccCycle, 50);
  write("[SCC] start");
}

on message frmVehicleStateCanMsg
{
  gVehicleSpeed = clampRange((int)this.gVehicleSpeed, 0, 255);
  gDriveState = clampRange((int)this.gDriveState, 0, 3);
}

on timer tSccCycle
{

  publishCruiseState();
  setTimer(tSccCycle, 50);
}

on stopMeasurement
{
  cancelTimer(tSccCycle);
}
