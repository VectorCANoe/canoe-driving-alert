includes
{
  #include "..\\common\\CAPL_COMMON.cin"
}

variables
{
  msTimer tSccCycle;
  long gEthSocket;
  int gVehicleSpeed;
  int gDriveState;
  int gNavSpeedLimit;
  int gRiskLevel;
  int gFailSafeMode;
  int gSelectedAlertLevel;
  int gEmergencyContext;
  dword gDecelAssistRxMs;
  dword gSelectedAlertRxMs;
  dword gNavStateRxMs;
  char gEthRxBuffer[64];
  int gLastCruiseState;
  int gLastGapLevel;
  int gLastCruiseSetSpeed;
}

void publishCruiseState()
{
  message frmCruiseStateMsg mCruise;
  int speedLimit;
  int riskLevel;
  int failSafeMode;
  int selectedAlertLevel;
  int emergencyContext;
  int cruiseState;
  int gapLevel;
  int cruiseSetSpeed;

  if (ethIsRecentTick(gNavStateRxMs, 300) == 1)
  {
    speedLimit = clampRange(gNavSpeedLimit, 0, 255);
  }
  else
  {
    speedLimit = 0;
  }
  if (ethIsRecentTick(gDecelAssistRxMs, 300) == 1)
  {
    riskLevel = clampRange(gRiskLevel, 0, 100);
    failSafeMode = clampRange(gFailSafeMode, 0, 2);
    emergencyContext = clampRange(gEmergencyContext, 0, 2);
  }
  else
  {
    riskLevel = 0;
    failSafeMode = 1;
    emergencyContext = 0;
  }
  if (ethIsRecentTick(gSelectedAlertRxMs, 300) == 1)
  {
    selectedAlertLevel = clampRange(gSelectedAlertLevel, 0, 7);
  }
  else
  {
    selectedAlertLevel = 0;
  }

  if (speedLimit == 0)
  {
    speedLimit = 60;
  }

  cruiseState = 0;
  gapLevel = 2;
  cruiseSetSpeed = speedLimit;

  if (gDriveState == 3 && failSafeMode == 0)
  {
    cruiseState = 1;

    if (riskLevel >= 70 || selectedAlertLevel >= 6 || emergencyContext > 0)
    {
      cruiseState = 2;
      gapLevel = 3;
      cruiseSetSpeed = gVehicleSpeed - 10;
    }
    else if (riskLevel >= 40 || selectedAlertLevel >= 4)
    {
      cruiseState = 2;
      gapLevel = 3;
      cruiseSetSpeed = gVehicleSpeed - 5;
    }
  }

  if (cruiseSetSpeed < 30 && cruiseState > 0)
  {
    cruiseSetSpeed = 30;
  }
  if (cruiseSetSpeed > speedLimit)
  {
    cruiseSetSpeed = speedLimit;
  }
  cruiseSetSpeed = clampRange(cruiseSetSpeed, 0, 255);

  mCruise.CruiseState = cruiseState;
  mCruise.GapLevel = gapLevel;
  mCruise.CruiseSetSpeed = cruiseSetSpeed;
  output(mCruise);

  if (cruiseState != gLastCruiseState ||
      gapLevel != gLastGapLevel ||
      cruiseSetSpeed != gLastCruiseSetSpeed)
  {
    write("[SCC] cruise=%d gap=%d set=%d risk=%d failSafe=%d alert=%d ems=%d speed=%d",
          cruiseState,
          gapLevel,
          cruiseSetSpeed,
          riskLevel,
          failSafeMode,
          selectedAlertLevel,
          emergencyContext,
          gVehicleSpeed);
    gLastCruiseState = cruiseState;
    gLastGapLevel = gapLevel;
    gLastCruiseSetSpeed = cruiseSetSpeed;
  }
}

void OnUdpReceiveFrom(dword socket, long result, dword address, dword port, char buffer[], dword count)
{
  int msgId;
  int payload0;

  if (socket != gEthSocket)
  {
    return;
  }

  if (result == 0)
  {
    msgId = ethFrameMsgId(buffer, count);
    if (msgId == ethMsgDecelAssist() && ethFramePayloadLen(count) >= 2)
    {
      payload0 = ethGetU8(buffer, 0);
      gRiskLevel = clampRange(ethGetU8(buffer, 1), 0, 100);
      gFailSafeMode = clampRange((payload0 >> 1) & 0x3, 0, 2);
      gEmergencyContext = clampRange((payload0 >> 5) & 0x3, 0, 2);
      gDecelAssistRxMs = getSimulationTimeMs();
    }
    else if (msgId == ethMsgSelectedAlert() && ethFramePayloadLen(count) >= 1)
    {
      gSelectedAlertLevel = clampRange(ethGetU8(buffer, 0) & 0x7, 0, 7);
      gSelectedAlertRxMs = getSimulationTimeMs();
    }
  }

  ethArmReceive(gEthSocket, gEthRxBuffer, elcount(gEthRxBuffer));
}

on start
{
  gEthSocket = ethOpenDefaultSocket();
  gVehicleSpeed = 0;
  gDriveState = 0;
  gNavSpeedLimit = 0;
  gRiskLevel = 0;
  gFailSafeMode = 1;
  gSelectedAlertLevel = 0;
  gEmergencyContext = 0;
  gDecelAssistRxMs = 0;
  gSelectedAlertRxMs = 0;
  gNavStateRxMs = 0;
  gLastCruiseState = -1;
  gLastGapLevel = -1;
  gLastCruiseSetSpeed = -1;
  if (gEthSocket != ethInvalidSocket())
  {
    ethStartReceiver(gEthSocket, gEthRxBuffer, elcount(gEthRxBuffer));
  }
  setTimer(tSccCycle, 50);
  write("[SCC] start");
}

on message frmVehicleStateCanMsg
{
  gVehicleSpeed = clampRange((int)this.gVehicleSpeed, 0, 255);
  gDriveState = clampRange((int)this.gDriveState, 0, 3);
}

on message frmNavModuleStateMsg
{
  gNavSpeedLimit = clampRange((int)this.NavSpeedLimit, 0, 255);
  gNavStateRxMs = getSimulationTimeMs();
}

on timer tSccCycle
{

  publishCruiseState();
  setTimer(tSccCycle, 50);
}

on stopMeasurement
{
  cancelTimer(tSccCycle);
  ethCloseSocket(gEthSocket);
  gEthSocket = ethInvalidSocket();
}
