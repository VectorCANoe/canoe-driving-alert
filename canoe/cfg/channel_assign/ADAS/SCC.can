includes
{
  #include "..\\common\\CAPL_COMMON.cin"
}

variables
{
  msTimer tSccCycle;
  int gVehicleSpeed;
  int gDriveState;
  int gLastCruiseState;
  int gLastGapLevel;
  int gLastCruiseSetSpeed;
}

void publishCruiseState()
{
  message frmCruiseStateMsg mCruise;
  int speedLimit;
  int riskLevel;
  int failSafeMode;
  int selectedAlertLevel;
  int emergencyContext;
  int cruiseState;
  int gapLevel;
  int cruiseSetSpeed;

  speedLimit = clampRange((int)@Core::speedLimitNorm, 0, 255);
  riskLevel = clampRange((int)@Core::proximityRiskLevel, 0, 100);
  failSafeMode = clampRange((int)@Core::failSafeMode, 0, 2);
  selectedAlertLevel = clampRange((int)@Core::selectedAlertLevel, 0, 7);
  emergencyContext = clampRange((int)@Core::emergencyContext, 0, 2);

  if (speedLimit == 0)
  {
    speedLimit = 60;
  }

  cruiseState = 0;
  gapLevel = 2;
  cruiseSetSpeed = speedLimit;

  if (gDriveState == 3 && failSafeMode == 0)
  {
    cruiseState = 1;

    if (riskLevel >= 70 || selectedAlertLevel >= 6 || emergencyContext > 0)
    {
      cruiseState = 2;
      gapLevel = 3;
      cruiseSetSpeed = gVehicleSpeed - 10;
    }
    else if (riskLevel >= 40 || selectedAlertLevel >= 4)
    {
      gapLevel = 3;
      cruiseSetSpeed = gVehicleSpeed - 5;
    }
  }

  if (cruiseSetSpeed < 30 && cruiseState > 0)
  {
    cruiseSetSpeed = 30;
  }
  if (cruiseSetSpeed > speedLimit)
  {
    cruiseSetSpeed = speedLimit;
  }
  cruiseSetSpeed = clampRange(cruiseSetSpeed, 0, 255);

  mCruise.CruiseState = cruiseState;
  mCruise.GapLevel = gapLevel;
  mCruise.CruiseSetSpeed = cruiseSetSpeed;
  output(mCruise);

  if (cruiseState != gLastCruiseState ||
      gapLevel != gLastGapLevel ||
      cruiseSetSpeed != gLastCruiseSetSpeed)
  {
    write("[SCC] cruise=%d gap=%d set=%d risk=%d failSafe=%d alert=%d ems=%d speed=%d",
          cruiseState,
          gapLevel,
          cruiseSetSpeed,
          riskLevel,
          failSafeMode,
          selectedAlertLevel,
          emergencyContext,
          gVehicleSpeed);
    gLastCruiseState = cruiseState;
    gLastGapLevel = gapLevel;
    gLastCruiseSetSpeed = cruiseSetSpeed;
  }
}

on start
{
  gVehicleSpeed = 0;
  gDriveState = 0;
  gLastCruiseState = -1;
  gLastGapLevel = -1;
  gLastCruiseSetSpeed = -1;
  setTimer(tSccCycle, 50);
  write("[SCC] start");
}

on message frmVehicleStateCanMsg
{
  gVehicleSpeed = clampRange((int)this.gVehicleSpeed, 0, 255);
  gDriveState = clampRange((int)this.gDriveState, 0, 3);
}

on timer tSccCycle
{

  publishCruiseState();
  setTimer(tSccCycle, 50);
}

on stopMeasurement
{
  cancelTimer(tSccCycle);
}
