includes
{
  #include "..\\common\\CAPL_COMMON.cin"
}

variables
{
  msTimer tOmsCycle;
  int gDiagPending;
  int gLastDiagSid;
  int gLastDiagDidHigh;
  int gLastDiagDidLow;
  int gLastDetected;
  int gLastChildWarn;
  int gLastSeatBelt;
  int gLastWarnLevel;
  int gLastAlert;
}

void publishOmsState()
{
  message frmOmsStateMsg mOms;
  int passengerSeatBelt;
  int seatBeltWarnLevel;
  int alertLevel;
  int detected;
  int childWarn;
  int alertActive;

  passengerSeatBelt = clampRange((int)@CoreState::passengerSeatBelt, 0, 1);
  seatBeltWarnLevel = clampRange((int)@CoreState::seatBeltWarnLvl, 0, 7);
  alertLevel = clampRange((int)@Core::selectedAlertLevel, 0, 7);

  detected = (passengerSeatBelt == 1 || seatBeltWarnLevel > 0) ? 1 : 0;
  childWarn = (detected == 1 && passengerSeatBelt == 0 && seatBeltWarnLevel >= 2) ? 1 : 0;
  alertActive = (detected == 1 && (seatBeltWarnLevel >= 2 || alertLevel >= 4)) ? 1 : 0;

  mOms.OccupantDetected = detected;
  mOms.ChildPresenceWarn = childWarn;
  mOms.PassengerSeatBelt = passengerSeatBelt;
  mOms.SeatBeltWarnLevel = seatBeltWarnLevel;
  mOms.OccupantAlertActive = alertActive;
  output(mOms);

  if (detected != gLastDetected ||
      childWarn != gLastChildWarn ||
      passengerSeatBelt != gLastSeatBelt ||
      seatBeltWarnLevel != gLastWarnLevel ||
      alertActive != gLastAlert)
  {
    write("[OMS] detected=%d child=%d belt=%d warn=%d alert=%d core=%d",
          detected,
          childWarn,
          passengerSeatBelt,
          seatBeltWarnLevel,
          alertActive,
          alertLevel);
    gLastDetected = detected;
    gLastChildWarn = childWarn;
    gLastSeatBelt = passengerSeatBelt;
    gLastWarnLevel = seatBeltWarnLevel;
    gLastAlert = alertActive;
  }
}

on start
{
  gDiagPending = 0;
  gLastDiagSid = 0;
  gLastDiagDidHigh = 0;
  gLastDiagDidLow = 0;
  gLastDetected = -1;
  gLastChildWarn = -1;
  gLastSeatBelt = -1;
  gLastWarnLevel = -1;
  gLastAlert = -1;
  setTimer(tOmsCycle, 100);
  write("[OMS] start");
}

on timer tOmsCycle
{
  publishOmsState();
  if (gDiagPending == 1)
  {
    message frmOmsDiagResMsg mDiagRes;
    mDiagRes.OmsDiagRespCode = (gLastDiagSid == 0x22) ? 0x62 : 0x7F;
    mDiagRes.OmsDiagData0 = gLastDiagDidHigh;
    mDiagRes.OmsDiagData1 = gLastDiagDidLow;
    output(mDiagRes);
    gDiagPending = 0;
  }
  setTimer(tOmsCycle, 100);
}

on message frmOmsDiagReqMsg
{
  gLastDiagSid = (int)this.OmsDiagServiceId;
  gLastDiagDidHigh = (int)this.OmsDiagDidHigh;
  gLastDiagDidLow = (int)this.OmsDiagDidLow;
  gDiagPending = 1;
}

on stopMeasurement
{
  cancelTimer(tOmsCycle);
}
