includes
{
  #include "..\\common\\CAPL_COMMON.cin"
}

variables
{
  msTimer tOmsCycle;
  int gLastDetected;
  int gLastChildWarn;
  int gLastSeatBelt;
  int gLastWarnLevel;
  int gLastAlert;
}

void publishOmsState()
{
  message frmOmsStateMsg mOms;
  int passengerSeatBelt;
  int seatBeltWarnLevel;
  int detected;
  int childWarn;
  int alertActive;

  passengerSeatBelt = clampRange((int)@CoreState::passengerSeatBelt, 0, 1);
  seatBeltWarnLevel = clampRange((int)@CoreState::seatBeltWarnLvl, 0, 7);

  detected = (passengerSeatBelt == 1 || seatBeltWarnLevel > 0) ? 1 : 0;
  childWarn = (detected == 1 && passengerSeatBelt == 0 && seatBeltWarnLevel >= 2) ? 1 : 0;
  alertActive = (detected == 1 && seatBeltWarnLevel >= 2) ? 1 : 0;

  mOms.OccupantDetected = detected;
  mOms.ChildPresenceWarn = childWarn;
  mOms.PassengerSeatBelt = passengerSeatBelt;
  mOms.SeatBeltWarnLevel = seatBeltWarnLevel;
  mOms.OccupantAlertActive = alertActive;
  output(mOms);

  if (detected != gLastDetected ||
      childWarn != gLastChildWarn ||
      passengerSeatBelt != gLastSeatBelt ||
      seatBeltWarnLevel != gLastWarnLevel ||
      alertActive != gLastAlert)
  {
    write("[OMS] detected=%d child=%d belt=%d warn=%d alert=%d",
          detected,
          childWarn,
          passengerSeatBelt,
          seatBeltWarnLevel,
          alertActive);
    gLastDetected = detected;
    gLastChildWarn = childWarn;
    gLastSeatBelt = passengerSeatBelt;
    gLastWarnLevel = seatBeltWarnLevel;
    gLastAlert = alertActive;
  }
}

on start
{
  gLastDetected = -1;
  gLastChildWarn = -1;
  gLastSeatBelt = -1;
  gLastWarnLevel = -1;
  gLastAlert = -1;
  setTimer(tOmsCycle, 100);
  write("[OMS] start");
}

on timer tOmsCycle
{
  publishOmsState();
  setTimer(tOmsCycle, 100);
}

on stopMeasurement
{
  cancelTimer(tOmsCycle);
}
