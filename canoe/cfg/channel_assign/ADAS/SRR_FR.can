includes
{
  #include "..\\common\\CAPL_COMMON.cin"
}

variables
{
  msTimer tSrrFrCycle;
  int gLastDetected;
  int gLastRisk;
  int gLastMerge;
  int gLastTurn;
  int gLastPathReady;
}

int srrFrPathReady()
{
  int warningPathStatus;
  int e2eHealthState;
  int failSafeMode;

  warningPathStatus = clampRange((int)@CoreState::warningPathStatus, 0, 2);
  e2eHealthState = clampRange((int)@CoreState::e2eHealthState, 0, 2);
  failSafeMode = clampRange((int)@Core::failSafeMode, 0, 2);
  if (warningPathStatus >= 2 || e2eHealthState == 0 || failSafeMode >= 2)
  {
    return 0;
  }
  return 1;
}

void publishSrrFrState()
{
  message frmSrrFrStateMsg mSrrFr;
  int mergeConflict;
  int riskClass;
  int turnLampState;
  int detected;
  int riskLevel;
  int pathReady;

  mergeConflict = (((int)@Core::mergeCutInFlag) == 1) ? 1 : 0;
  riskClass = clampRange((int)@Core::objectRiskClass, 0, 7);
  turnLampState = clampRange((int)@CoreState::turnLampState, 0, 3);
  pathReady = srrFrPathReady();

  detected = (mergeConflict == 1 && turnLampState == 2 && riskClass >= 2) ? 1 : 0;
  riskLevel = detected == 1 ? clampRange(40 + (riskClass * 10), 0, 100) : 0;
  if (pathReady == 0)
  {
    mergeConflict = 0;
    riskClass = 0;
    detected = 0;
    riskLevel = 0;
  }

  mSrrFr.SideObjectDetected = detected;
  mSrrFr.SideRiskLevel = riskLevel;
  mSrrFr.MergeConflict = mergeConflict;
  mSrrFr.TurnLampState = turnLampState;
  output(mSrrFr);

  if (pathReady != gLastPathReady ||
      detected != gLastDetected ||
      riskLevel != gLastRisk ||
      mergeConflict != gLastMerge ||
      turnLampState != gLastTurn)
  {
    write("[SRR_FR] path=%d detected=%d risk=%d merge=%d turn=%d class=%d",
          pathReady,
          detected,
          riskLevel,
          mergeConflict,
          turnLampState,
          riskClass);
    gLastPathReady = pathReady;
    gLastDetected = detected;
    gLastRisk = riskLevel;
    gLastMerge = mergeConflict;
    gLastTurn = turnLampState;
  }
}

on start
{
  gLastPathReady = -1;
  gLastDetected = -1;
  gLastRisk = -1;
  gLastMerge = -1;
  gLastTurn = -1;
  setTimer(tSrrFrCycle, 100);
  write("[SRR_FR] start");
}

on timer tSrrFrCycle
{
  publishSrrFrState();
  setTimer(tSrrFrCycle, 100);
}

on stopMeasurement
{
  cancelTimer(tSrrFrCycle);
}
