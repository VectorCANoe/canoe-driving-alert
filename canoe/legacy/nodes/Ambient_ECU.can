/*
 * Ambient_ECU.can — Ambient Light Pattern Executor
 *
 * 역할:
 *   - Ambient_Control CAN (0x220) 수신 → 패턴 ID에 따라 앰비언트 실행
 *   - 각 패턴마다 고유한 타이머 주기 + RGB 색상 적용
 *   - sysvar Ambient::R/G/B_Value 실시간 업데이트 → Panel LED 인디케이터 반영
 *
 * 패턴 정의 (DBC VAL_ 참조):
 *   0 IDLE            — 비활성 (흰색 매우 어두움: 20,20,20)
 *   1 NORMAL          — 일반 주행 (흰색: 60,60,60)
 *   2 SCHOOLZONE_AMB  — 스쿨존 진입 (주황 저조도 파동, 800ms)
 *   3 SCHOOLZONE_WARN — 스쿨존 과속 (빨강 빠른 점멸, 200ms)  <- Req_009
 *   4 HIGHWAY_ALERT   — 고속도로 조향 없음 (주황 파동, 500ms)  <- Req_011
 *   5 IC_LEFT         — IC 좌측 출구 유도 (초록->분홍->빨강, 400ms)  <- Req_013
 *   6 IC_RIGHT        — IC 우측 출구 유도 (동일 패턴)
 *   7 POLICE          — 경찰차 긴급 (빨강<->파랑 교차 점멸, 150ms)  <- Req_017
 *   8 AMBULANCE       — 구급차 긴급 (빨강<->흰색 교차 점멸, 150ms)  <- Req_018
 *
 * V-Model: SWE.3 (구현)
 * Req 추적: Req_035~Req_040 (표시 정책)
 */

includes
{
}

variables
{
  /* 패턴 상수 (Civ_Node.can과 동일하게 유지) */
  const int PATTERN_IDLE        = 0;
  const int PATTERN_NORMAL      = 1;
  const int PATTERN_SCHOOL_AMB  = 2;
  const int PATTERN_SCHOOL_WARN = 3;
  const int PATTERN_HWY_ALERT   = 4;
  const int PATTERN_IC_LEFT     = 5;
  const int PATTERN_IC_RIGHT    = 6;
  const int PATTERN_POLICE      = 7;
  const int PATTERN_AMBULANCE   = 8;

  /* 타이머 */
  msTimer tBlink;   /* 점멸 패턴 (Police/Ambulance/SchoolWarn) */
  msTimer tPulse;   /* 파동 패턴 (SchoolAmb/Highway) */
  msTimer tIcAnim;  /* IC 방향 유도 애니메이션 */

  /* 현재 실행 중인 패턴 */
  int gCurrentPattern = 0;   /* PATTERN_IDLE */
  int gBlinkState     = 0;   /* 0/1 교차 상태 */
  int gPulseStep      = 0;   /* 0~5 밝기 단계 */
  int gIcStep         = 0;   /* 0~2 IC 애니메이션 스텝 */
  int gIcDirection    = 0;   /* 0=Left 1=Right */

  /* 파동 패턴 밝기 테이블 (6단계 사인파 근사)
   * 초기값은 on start에서 설정 — CAPL 배열 초기화 호환성 보장 */
  int gBright[6];

  /* IC 유도선 색상은 runIcStep() 내 switch-case로 직접 처리
   * (const 배열 초기화 대신 명시적 switch → 모든 CAPL 버전 호환) */
}

/*============================================================
 * 초기화
 *============================================================*/
on start
{
  /* gBright 배열 초기화 (6단계 밝기: 어두움->최대->어두움 사인파 근사) */
  gBright[0] = 40;
  gBright[1] = 120;
  gBright[2] = 200;
  gBright[3] = 255;
  gBright[4] = 200;
  gBright[5] = 120;

  write("[Ambient_ECU] start -- waiting for pattern cmd");
  setColor(20, 20, 20);  /* IDLE default */
}

/*============================================================
 * Ambient_Control CAN 수신 (0x220)
 * Civ_Node -> Ambient_ECU 패턴 명령
 *============================================================*/
on message Ambient_Control
{
  int newPattern;
  newPattern = this.AmbientPattern;

  if (newPattern == gCurrentPattern)
    return;  /* 동일 패턴 재수신 -> 무시 */

  write("[Ambient_ECU] pattern: %d -> %d", gCurrentPattern, newPattern);

  /* 기존 타이머 모두 취소 (Req_015: 구간 전환 안정성) */
  cancelTimer(tBlink);
  cancelTimer(tPulse);
  cancelTimer(tIcAnim);
  gBlinkState = 0;
  gPulseStep  = 0;
  gIcStep     = 0;

  gCurrentPattern = newPattern;

  switch (newPattern)
  {
    case PATTERN_IDLE:
      setColor(20, 20, 20);
      break;

    case PATTERN_NORMAL:
      setColor(60, 60, 60);
      break;

    case PATTERN_SCHOOL_AMB:
      /* 스쿨존 진입: 주황 저조도 파동 */
      setColor(200, 80, 0);
      setTimer(tPulse, 800);
      break;

    case PATTERN_SCHOOL_WARN:
      /* 스쿨존 과속: 빨강 빠른 점멸 즉시 시작 (Req_009, Req_037) */
      gBlinkState = 1;
      setColor(255, 0, 0);
      setTimer(tBlink, 200);
      write("[Ambient_ECU] [!] SCHOOL ZONE SPEED WARN -- RED 200ms blink");
      break;

    case PATTERN_HWY_ALERT:
      /* 고속도로 조향 없음: 주황 파동 (Req_038) */
      setColor(255, 100, 0);
      setTimer(tPulse, 500);
      write("[Ambient_ECU] [!] HIGHWAY ALERT -- ORANGE 500ms pulse");
      break;

    case PATTERN_IC_LEFT:
      /* IC 좌측 출구 유도 (Req_039) */
      gIcDirection = 0;
      gIcStep      = 0;
      runIcStep();
      setTimer(tIcAnim, 400);
      write("[Ambient_ECU] IC LEFT exit guide start (GREEN->PINK->RED 400ms)");
      break;

    case PATTERN_IC_RIGHT:
      /* IC 우측 출구 유도 (Req_039) */
      gIcDirection = 1;
      gIcStep      = 0;
      runIcStep();
      setTimer(tIcAnim, 400);
      write("[Ambient_ECU] IC RIGHT exit guide start (GREEN->PINK->RED 400ms)");
      break;

    case PATTERN_POLICE:
      /* 경찰차 긴급: 빨강<->파랑 교차 점멸 150ms (Req_035, Req_036) */
      gBlinkState = 0;
      setColor(255, 0, 0);  /* RED first */
      setTimer(tBlink, 150);
      write("[Ambient_ECU] ** POLICE emergency -- RED/BLUE 150ms blink");
      break;

    case PATTERN_AMBULANCE:
      /* 구급차 긴급: 빨강<->흰색 교차 점멸 150ms (Req_035, Req_036) */
      gBlinkState = 0;
      setColor(255, 0, 0);  /* RED first */
      setTimer(tBlink, 150);
      write("[Ambient_ECU] ** AMBULANCE emergency -- RED/WHITE 150ms blink");
      break;

    default:
      setColor(20, 20, 20);
      break;
  }
}

/*============================================================
 * 점멸 타이머 — Police / Ambulance / SchoolZone_Warn
 *============================================================*/
on timer tBlink
{
  gBlinkState = 1 - gBlinkState;  /* 0<->1 교차 */
  @Ambient::BlinkState = gBlinkState;

  switch (gCurrentPattern)
  {
    case PATTERN_SCHOOL_WARN:
      if (gBlinkState == 1)
        setColor(255, 0, 0);  /* RED */
      else
        setColor(0, 0, 0);    /* OFF */
      setTimer(tBlink, 200);
      break;

    case PATTERN_POLICE:
      if (gBlinkState == 0)
        setColor(255, 0, 0);  /* RED */
      else
        setColor(0, 0, 255);  /* BLUE */
      setTimer(tBlink, 150);
      break;

    case PATTERN_AMBULANCE:
      if (gBlinkState == 0)
        setColor(255, 0, 0);    /* RED */
      else
        setColor(255, 255, 255); /* WHITE */
      setTimer(tBlink, 150);
      break;

    default:
      /* 패턴이 변경된 후 잔여 이벤트 -> 무시 */
      break;
  }
}

/*============================================================
 * 파동 타이머 — SchoolZone_Ambient / Highway_Alert
 * gBright[6] 배열로 6단계 밝기 순환 (variables 블록에 선언)
 *============================================================*/
on timer tPulse
{
  int bv;
  int r_val;
  int g_val;

  gPulseStep = (gPulseStep + 1) % 6;
  bv = gBright[gPulseStep];

  switch (gCurrentPattern)
  {
    case PATTERN_SCHOOL_AMB:
      r_val = bv;
      g_val = (int)(bv * 0.4);
      setColor(r_val, g_val, 0);
      setTimer(tPulse, 800);
      break;

    case PATTERN_HWY_ALERT:
      r_val = bv;
      g_val = (int)(bv * 0.4);
      setColor(r_val, g_val, 0);
      setTimer(tPulse, 500);
      break;

    default:
      /* 패턴이 변경된 후 잔여 이벤트 -> 무시 (setColor 호출 안 함) */
      break;
  }
}

/*============================================================
 * IC 방향 유도 애니메이션 타이머 (400ms 스텝)
 * 초록(직진) -> 분홍(전환) -> 빨강(출구) 순환
 * Req_013, Req_014, Req_039
 *============================================================*/
on timer tIcAnim
{
  if (gCurrentPattern != PATTERN_IC_LEFT && gCurrentPattern != PATTERN_IC_RIGHT)
    return;  /* 패턴 변경 후 잔여 이벤트 -> 무시 */

  gIcStep = (gIcStep + 1) % 3;
  @Ambient::AnimStep = gIcStep;
  runIcStep();
  setTimer(tIcAnim, 400);
}

/*============================================================
 * IC 스텝별 색상 적용
 * Step 0: GREEN  (직진 유지 차선)
 * Step 1: PINK   (전환 구간)
 * Step 2: RED    (출구 진입 차선)
 *============================================================*/
void runIcStep()
{
  int r_val;
  int g_val;
  int b_val;

  /* IC 유도선 색상 (한국 고속도로 바닥 유도선 재현)
   * Step 0: GREEN  (직진 유지 차선)  RGB(  0, 200,   0)
   * Step 1: PINK   (전환 구간)       RGB(255, 100, 150)
   * Step 2: RED    (출구 진입 차선)  RGB(255,   0,   0) */
  switch (gIcStep)
  {
    case 0:  r_val =   0; g_val = 200; b_val =   0; break;  /* GREEN */
    case 1:  r_val = 255; g_val = 100; b_val = 150; break;  /* PINK */
    case 2:  r_val = 255; g_val =   0; b_val =   0; break;  /* RED */
    default: r_val =  60; g_val =  60; b_val =  60; break;  /* fallback */
  }

  if (gIcDirection == 0)
    write("[Ambient_ECU] IC LEFT  Step %d -> RGB(%d,%d,%d)", gIcStep, r_val, g_val, b_val);
  else
    write("[Ambient_ECU] IC RIGHT Step %d -> RGB(%d,%d,%d)", gIcStep, r_val, g_val, b_val);

  setColor(r_val, g_val, b_val);
}

/*============================================================
 * RGB 색상 적용 + sysvar 업데이트 (Panel LED 반영)
 *============================================================*/
void setColor(int r, int g, int b)
{
  @Ambient::R_Value = r;
  @Ambient::G_Value = g;
  @Ambient::B_Value = b;
}
