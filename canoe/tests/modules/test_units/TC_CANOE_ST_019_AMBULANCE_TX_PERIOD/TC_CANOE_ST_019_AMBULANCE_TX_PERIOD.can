/*@!Encoding:65001*/
includes
{
  #include "..\common\ValidationHarnessTestCommon.cin"
}

variables
{
}

/*
  This asset fixes the system-level stimulus contract for the ambulance
  external transport path, but the final 100ms periodicity verdict must be
  closed by Ethernet trace evidence rather than CAPL-only oracle values.
*/
export testcase TC_CANOE_ST_019_AMBULANCE_TX_PERIOD()
{
  if (!resetValidationHarnessIfNeeded())
  {
    return;
  }

  if (!launchScenarioAndWait(5, 700, 1200))
  {
    return;
  }

  assertIntEq("eth-ambulance-active-pass", 1, (long)@Test::scenarioResult, "scenarioResult");
  assertIntEq("eth-ambulance-alert-state", 1, (long)@V2X::alertState, "alertState");
  assertIntEq("eth-ambulance-type", 2, (long)@V2X::emergencyType, "emergencyType");
  if (!waitForObservedSelectedAlert(800))
  {
    resetValidationHarnessIfNeeded();
    return;
  }
  assertIntEq("eth-ambulance-level", 7, (long)@Test::obsSelectedAlertLevel, "ethSelectedAlertLevel");

  /*
    Final verdict closure for ST_019:
    - Ethernet trace must show the ambulance external TX path at 100ms cadence
    - CAPL assertions here only confirm scenario contract and alert activation
  */

  resetValidationHarnessIfNeeded();
}
