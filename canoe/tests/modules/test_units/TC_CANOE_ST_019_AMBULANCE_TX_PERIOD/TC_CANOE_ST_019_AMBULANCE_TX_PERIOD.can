/*@!Encoding:65001*/
includes
{
  #include "..\common\ValidationHarnessTestCommon.cin"
}

variables
{
}

export testcase TC_CANOE_ST_019_AMBULANCE_TX_PERIOD()
{
  if (!resetValidationHarnessIfNeeded())
  {
    return;
  }

  if (!launchScenarioAndWait(5, 700, 1200))
  {
    return;
  }

  assertIntEq("eth-ambulance-active-pass", 1, (long)@Test::scenarioResult, "scenarioResult");
  assertIntEq("eth-ambulance-alert-state", 1, (long)@V2X::alertState, "alertState");
  assertIntEq("eth-ambulance-type", 2, (long)@V2X::emergencyType, "emergencyType");
  if (!waitForObservedSelectedAlert(800))
  {
    resetValidationHarnessIfNeeded();
    return;
  }
  assertIntEq("eth-ambulance-level", 7, (long)@Test::obsSelectedAlertLevel, "ethSelectedAlertLevel");

  resetValidationHarnessIfNeeded();
}
