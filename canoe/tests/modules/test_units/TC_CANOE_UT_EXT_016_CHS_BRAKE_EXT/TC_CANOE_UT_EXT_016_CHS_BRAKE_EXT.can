/*@!Encoding:65001*/
includes
{
  #include "..\\common\\ValidationHarnessTestCommon.cin"
}

variables
{
}

export testcase TC_CANOE_UT_EXT_016_CHS_BRAKE_EXT()
{
  if (!resetValidationHarnessIfNeeded())
  {
    return;
  }

  if (!launchScenarioAndWait(216, 800, 1300))
  {
    return;
  }
  assertIntEq("chs-brake-park-pass", 1, (long)@Test::scenarioResult, "scenarioResult");
  assertIntEq("chs-brake-park-drive", 0, (long)@Core::driveStateNorm, "driveStateNorm");
  assertIntMin("chs-brake-park-pedal", 30, (long)@Core::brakePedalNorm, "brakePedalNorm");

  if (!resetValidationHarnessIfNeeded())
  {
    return;
  }
  if (!launchScenarioAndWait(219, 800, 1300))
  {
    return;
  }
  assertIntEq("chs-brake-stop-pass", 1, (long)@Test::scenarioResult, "scenarioResult");
  assertIntEq("chs-brake-stop-drive", 0, (long)@Core::driveStateNorm, "driveStateNorm");
  assertIntMin("chs-brake-stop-pedal", 30, (long)@Core::brakePedalNorm, "brakePedalNorm");
  assertIntEq("chs-brake-stop-failsafe", 0, (long)@Core::failSafeMode, "failSafeMode");

  resetValidationHarnessIfNeeded();
}
