/*@!Encoding:65001*/
includes
{
  #include "..\common\ValidationHarnessTestCommon.cin"
}

variables
{
}

export testcase TC_CANOE_IT_015_TURN_LAMP_CONTEXT()
{
  if (!resetValidationHarnessIfNeeded())
  {
    return;
  }

  if (!launchScenarioAndWait(239, 900, 1300))
  {
    return;
  }

  if (!waitForCoreSelectedAlertState(3, 6, 800) ||
      !waitForCoreTurnLampState(2, 800))
  {
    resetValidationHarnessIfNeeded();
    return;
  }

  assertIntEq("turn-lamp-context-level", 3, (long)@Core::selectedAlertLevel, "selectedAlertLevel");
  assertIntEq("turn-lamp-context-type", 6, (long)@Core::selectedAlertType, "selectedAlertType");
  assertIntEq("turn-lamp-context-state", 2, (long)@CoreState::turnLampState, "turnLampState");

  resetValidationHarnessIfNeeded();
}
