/*@!Encoding:65001*/
includes
{
  #include "..\\common\\ValidationHarnessTestCommon.cin"
}

variables
{
}

export testcase TC_CANOE_ST_EXT_032_USER_SETTING_CHANGE()
{
  if (!resetValidationHarnessIfNeeded())
  {
    return;
  }

  if (!launchScenarioAndWait(215, 900, 1300))
  {
    return;
  }

  assertIntEq("user-setting-pass", 1, (long)@Test::scenarioResult, "scenarioResult");
  assertIntEq("user-setting-warning-code", 142, (long)@Cluster::warningTextCode, "warningTextCode");
  assertIntEq("user-setting-audio-focus", 1, (long)@CoreState::audioFocusOwner, "audioFocusOwner");
  assertIntEq("user-setting-audio-ducking", 4, (long)@CoreState::audioDuckingLvl, "audioDuckingLvl");
  assertIntEq("user-setting-volume", 80, (long)@CoreState::volumeLevel, "volumeLevel");
  if (!waitForObservedFailSafe(800)) { resetValidationHarnessIfNeeded(); return; }
  assertIntEq("user-setting-failsafe", 0, (long)@Test::obsFailSafeMode, "ethFailSafeMode");

  resetValidationHarnessIfNeeded();
}
