/*@!Encoding:65001*/
includes
{
  #include "..\\common\\ValidationHarnessTestCommon.cin"
}

variables
{
}

export testcase TC_CANOE_IT_V2_004_TIMEOUT_CLEAR()
{
  if (!resetValidationHarnessIfNeeded())
  {
    return;
  }

  if (!launchScenarioAndWait(35, 1800, 2300))
  {
    return;
  }

  assertIntEq("scenario-pass", 1, (long)@Test::scenarioResult, "scenarioResult");
  assertIntEq("selected-alert-level", 3, (long)@Core::selectedAlertLevel, "selectedAlertLevel");
  assertIntEq("selected-alert-type", 3, (long)@Core::selectedAlertType, "selectedAlertType");
  assertIntEq("emergency-context-cleared", 0, (long)@Core::emergencyContext, "emergencyContext");
  assertIntEq("fail-safe-clear", 0, (long)@Core::failSafeMode, "failSafeMode");

  resetValidationHarnessIfNeeded();
}