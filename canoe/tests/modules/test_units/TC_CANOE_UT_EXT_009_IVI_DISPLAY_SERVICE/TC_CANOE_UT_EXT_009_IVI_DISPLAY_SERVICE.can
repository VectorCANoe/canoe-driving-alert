/*@!Encoding:65001*/
includes
{
  #include "..\\common\\ValidationHarnessTestCommon.cin"
}

variables
{
  long gHudMode;
  long gHudWarningCode;
  long gHudBrightness;
  long gAmpMode;
  long gAmpMute;
  long gAmpDuckingLvl;
  long gAmpVolumeLevel;
  long gTmuLinkState;
  long gTmuServiceMode;
  long gRemoteClimateReq;
  long gSignalBars;
}

on message frmHudStateMsg
{
  gHudMode = this.HudMode;
  gHudWarningCode = this.HudWarningCode;
  gHudBrightness = this.HudBrightness;
}

on message frmAmpStateMsg
{
  gAmpMode = this.AmpMode;
  gAmpMute = this.AmpMute;
  gAmpDuckingLvl = this.AmpDuckingLvl;
  gAmpVolumeLevel = this.AmpVolumeLevel;
}

on message frmTmuServiceStateMsg
{
  gTmuLinkState = this.TmuLinkState;
  gTmuServiceMode = this.TmuServiceMode;
  gRemoteClimateReq = this.RemoteClimateReq;
  gSignalBars = this.SignalBars;
}

export testcase TC_CANOE_UT_EXT_009_IVI_DISPLAY_SERVICE()
{
  if (!resetValidationHarnessIfNeeded())
  {
    return;
  }
  if (!launchScenarioAndWait(229, 1500, 450))
  {
    return;
  }
  assertIntEq("ivi-display-tmu-link", 2, gTmuLinkState, "TmuLinkState");
  assertIntEq("ivi-display-tmu-service", 1, gTmuServiceMode, "TmuServiceMode");
  assertIntEq("ivi-display-tmu-remote", 1, gRemoteClimateReq, "RemoteClimateReq");
  assertIntEq("ivi-display-tmu-bars", 4, gSignalBars, "SignalBars");

  if (!resetValidationHarnessIfNeeded())
  {
    return;
  }
  if (!launchScenarioAndWait(30, 1500, 450))
  {
    return;
  }
  assertIntEq("ivi-display-hud-mode", 1, gHudMode, "HudMode");
  assertIntEq("ivi-display-hud-warning", 102, gHudWarningCode, "HudWarningCode");

  if (!resetValidationHarnessIfNeeded())
  {
    return;
  }
  if (!launchScenarioAndWait(215, 1500, 450))
  {
    return;
  }
  assertIntEq("ivi-display-amp-mute", 0, gAmpMute, "AmpMute");
  assertIntEq("ivi-display-amp-ducking", 4, gAmpDuckingLvl, "AmpDuckingLvl");
  assertIntEq("ivi-display-amp-volume", 80, gAmpVolumeLevel, "AmpVolumeLevel");

  resetValidationHarnessIfNeeded();
}
