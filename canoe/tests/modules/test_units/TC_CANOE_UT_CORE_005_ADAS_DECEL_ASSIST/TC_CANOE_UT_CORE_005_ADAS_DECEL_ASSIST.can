/*@!Encoding:65001*/
includes
{
  #include "..\\common\\ValidationHarnessTestCommon.cin"
}

variables
{
}

export testcase TC_CANOE_UT_CORE_005_ADAS_DECEL_ASSIST()
{
  if (!resetValidationHarnessIfNeeded())
  {
    return;
  }

  if (!launchScenarioAndWait(16, 800, 1300))
  {
    return;
  }

  assertIntEq("scenario-pass", 1, (long)@Test::scenarioResult, "scenarioResult");
  assertLongGe("proximity-risk-level", (long)@Core::proximityRiskLevel, 70, "proximityRiskLevel");
  assertIntEq("decel-assist-req", 1, (long)@Core::decelAssistReq, "decelAssistReq");
  assertIntEq("fail-safe-clear", 0, (long)@Core::failSafeMode, "failSafeMode");
  assertIntEq("selected-alert-level", 7, (long)@Core::selectedAlertLevel, "selectedAlertLevel");
  assertIntEq("selected-alert-type", 2, (long)@Core::selectedAlertType, "selectedAlertType");

  resetValidationHarnessIfNeeded();
}
