/*@!Encoding:65001*/
includes
{
  #include "..\common\ValidationHarnessTestCommon.cin"
}

variables
{
}

export testcase TC_CANOE_ST_031_DISTANCE_DISPLAY_CONSISTENCY()
{
  if (!resetValidationHarnessIfNeeded())
  {
    return;
  }

  if (!launchScenarioAndWait(222, 900, 1300))
  {
    return;
  }

  assertIntEq("context-adjust-distance-pass", 1, (long)@Test::scenarioResult, "scenarioResult");
  assertIntEq("context-adjust-distance", 180, (long)@CoreState::emergencyDistanceM, "emergencyDistanceM");
  assertIntEq("context-adjust-code", 102, (long)@Cluster::warningTextCode, "warningTextCode");
  assertIntEq("context-adjust-failsafe-clear", 0, (long)@Core::failSafeMode, "failSafeMode");

  resetValidationHarnessIfNeeded();
}
