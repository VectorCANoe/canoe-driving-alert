/*@!Encoding:65001*/
includes
{
  #include "..\\common\\ValidationHarnessTestCommon.cin"
}

variables
{
}

export testcase TC_CANOE_ST_CORE_010_GUIDE_RIGHT_CLEAR()
{
  if (!resetValidationHarnessIfNeeded())
  {
    return;
  }

  if (!launchScenarioAndWait(8, 700, 1200))
  {
    return;
  }

  assertIntEq("st010-guide-pass", 1, (long)@Test::scenarioResult, "scenarioResult");
  assertIntEq("st010-guide-level", 2, (long)@Core::selectedAlertLevel, "selectedAlertLevel");
  assertIntEq("st010-guide-type", 6, (long)@Core::selectedAlertType, "selectedAlertType");
  assertIntEq("st010-guide-code", 32, (long)@Cluster::warningTextCode, "warningTextCode");
  assertIntEq("st010-guide-ambient-pattern", 3, (long)@Body::ambientPattern, "ambientPattern");

  if (!launchScenarioAndWait(1, 700, 1000))
  {
    return;
  }

  assertIntEq("st010-clear-pass", 1, (long)@Test::scenarioResult, "scenarioResult");
  assertIntEq("st010-clear-level", 0, (long)@Core::selectedAlertLevel, "selectedAlertLevel");
  assertIntEq("st010-clear-type", 0, (long)@Core::selectedAlertType, "selectedAlertType");
  assertIntEq("st010-clear-code", 0, (long)@Cluster::warningTextCode, "warningTextCode");

  resetValidationHarnessIfNeeded();
}
