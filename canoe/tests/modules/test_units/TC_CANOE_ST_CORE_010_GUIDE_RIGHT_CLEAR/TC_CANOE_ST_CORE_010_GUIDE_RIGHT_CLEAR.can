/*@!Encoding:65001*/
includes
{
  #include "..\\common\\ValidationHarnessTestCommon.cin"
}

variables
{
}

export testcase TC_CANOE_ST_CORE_010_GUIDE_RIGHT_CLEAR()
{
  if (!resetValidationHarnessIfNeeded())
  {
    return;
  }

  if (!launchScenarioAndWait(8, 700, 1200))
  {
    return;
  }

  if (!waitForNavContextState(4, -1, 800) ||
      !waitForCoreSelectedAlertState(2, 6, 800) ||
      !waitForStableWarningRender(32, -1, 800))
  {
    resetValidationHarnessIfNeeded();
    return;
  }

  assertIntEq("st010-guide-level", 2, (long)@Core::selectedAlertLevel, "selectedAlertLevel");
  assertIntEq("st010-guide-type", 6, (long)@Core::selectedAlertType, "selectedAlertType");
  assertIntEq("st010-guide-code", 32, (long)@Cluster::warningTextCode, "warningTextCode");
  assertIntEq("st010-guide-ambient-pattern", 3, (long)@Body::ambientPattern, "ambientPattern");

  if (!launchScenarioAndWait(1, 700, 1000))
  {
    return;
  }

  if (!waitForCoreSelectedAlertState(0, 0, 800) ||
      !waitForStableWarningRender(0, -1, 800))
  {
    resetValidationHarnessIfNeeded();
    return;
  }

  assertIntEq("st010-clear-level", 0, (long)@Core::selectedAlertLevel, "selectedAlertLevel");
  assertIntEq("st010-clear-type", 0, (long)@Core::selectedAlertType, "selectedAlertType");
  assertIntEq("st010-clear-code", 0, (long)@Cluster::warningTextCode, "warningTextCode");

  resetValidationHarnessIfNeeded();
}
