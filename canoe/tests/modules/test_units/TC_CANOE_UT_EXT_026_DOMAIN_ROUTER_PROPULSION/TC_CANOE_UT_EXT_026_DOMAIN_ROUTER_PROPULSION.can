/*@!Encoding:65001*/
includes
{
  #include "..\\common\\ValidationHarnessTestCommon.cin"
}

variables
{
  long gEopState;
  long gPumpRpm;
  long gOilPressure;
  long gMcuState;
  long gMotorTorqueCmd;
  long gMotorSpeedRpm;
  long gInverterState;
  long gInvTemp;
  long gDcLinkVolt;
}

on message frmEopStateMsg
{
  gEopState = this.EopState;
  gPumpRpm = this.PumpRpm;
  gOilPressure = this.OilPressure;
}

on message frmMcuStateMsg
{
  gMcuState = this.McuState;
  gMotorTorqueCmd = this.MotorTorqueCmd;
  gMotorSpeedRpm = this.MotorSpeedRpm;
}

on message frmInverterStateMsg
{
  gInverterState = this.InverterState;
  gInvTemp = this.InvTemp;
  gDcLinkVolt = this.DcLinkVolt;
}

long waitForPropulsionRouterState(dword timeoutMs)
{
  dword waitedMs;

  waitedMs = 0;
  while ((gEopState != 2 ||
          gPumpRpm < 1000 ||
          gOilPressure < 80 ||
          gMcuState != 2 ||
          gMotorTorqueCmd < 80 ||
          gMotorSpeedRpm < 3000 ||
          gInverterState != 2 ||
          gInvTemp < 50 ||
          gDcLinkVolt < 100) &&
         waitedMs < timeoutMs)
  {
    TestWaitForTimeout(50);
    waitedMs += 50;
  }

  if (gEopState != 2 ||
      gPumpRpm < 1000 ||
      gOilPressure < 80 ||
      gMcuState != 2 ||
      gMotorTorqueCmd < 80 ||
      gMotorSpeedRpm < 3000 ||
      gInverterState != 2 ||
      gInvTemp < 50 ||
      gDcLinkVolt < 100)
  {
    testStepFail("propulsion-router-state", "Propulsion router timeout waited=%d eop=%d pump=%d oil=%d mcu=%d torque=%d speed=%d inverter=%d invTemp=%d dcLink=%d minimumPump=%d minimumOil=%d minimumTorque=%d minimumSpeed=%d minimumTemp=%d minimumDcLink=%d",
                 waitedMs,
                 gEopState,
                 gPumpRpm,
                 gOilPressure,
                 gMcuState,
                 gMotorTorqueCmd,
                 gMotorSpeedRpm,
                 gInverterState,
                 gInvTemp,
                 gDcLinkVolt,
                 1000,
                 80,
                 80,
                 3000,
                 50,
                 100);
    return 0;
  }

  return 1;
}

export testcase TC_CANOE_UT_EXT_026_DOMAIN_ROUTER_PROPULSION()
{
  if (!resetValidationHarnessIfNeeded())
  {
    return;
  }
  if (!launchScenarioAndWait(232, 1500, 450))
  {
    return;
  }
  if (!waitForPropulsionRouterState(800))
  {
    resetValidationHarnessIfNeeded();
    return;
  }
  assertIntEq("router-propulsion-eop-state", 2, gEopState, "EopState");
  assertIntMin("router-propulsion-pump-rpm", 1000, gPumpRpm, "PumpRpm");
  assertIntMin("router-propulsion-oil-pressure", 80, gOilPressure, "OilPressure");
  assertIntEq("router-propulsion-mcu-state", 2, gMcuState, "McuState");
  assertIntMin("router-propulsion-torque", 80, gMotorTorqueCmd, "MotorTorqueCmd");
  assertIntMin("router-propulsion-speed", 3000, gMotorSpeedRpm, "MotorSpeedRpm");
  assertIntEq("router-propulsion-inverter-state", 2, gInverterState, "InverterState");
  assertIntMin("router-propulsion-inv-temp", 50, gInvTemp, "InvTemp");
  assertIntMin("router-propulsion-dc-link", 100, gDcLinkVolt, "DcLinkVolt");

  resetValidationHarnessIfNeeded();
}
