/*@!Encoding:65001*/
includes
{
  #include "..\\common\\ValidationHarnessTestCommon.cin"
}

variables
{
}

export testcase TC_CANOE_UT_EXT_001_OBJECT_RISK()
{
  if (!resetValidationHarnessIfNeeded())
  {
    return;
  }

  if (!launchScenarioAndWait(20, 700, 1200))
  {
    return;
  }

  assertIntEq("object-forward-pass", 1, (long)@Test::scenarioResult, "scenarioResult");
  if (!waitForObservedObjectRisk(800))
  {
    resetValidationHarnessIfNeeded();
    return;
  }
  assertIntMin("object-forward-risk-class", 3, (long)@Test::obsObjectRiskClass, "ethObjectRiskClass");
  assertIntMin("object-forward-proximity", 60, (long)@Test::obsObjectRiskLevel, "ethObjectRiskLevel");

  if (!resetValidationHarnessIfNeeded())
  {
    return;
  }

  if (!launchScenarioAndWait(21, 700, 1200))
  {
    return;
  }

  assertIntEq("object-intersection-pass", 1, (long)@Test::scenarioResult, "scenarioResult");
  if (!waitForObservedObjectRisk(800) ||
      !waitForObservedObjectScenario(800) ||
      !waitForObservedSelectedAlert(800))
  {
    resetValidationHarnessIfNeeded();
    return;
  }
  assertIntEq("object-intersection-flag", 1, (long)@Test::obsIntersectionConflictFlag, "ethIntersectionConflictFlag");
  assertIntEq("object-intersection-alert", 5, (long)@Test::obsSelectedAlertType, "ethSelectedAlertType");

  if (!resetValidationHarnessIfNeeded())
  {
    return;
  }

  if (!launchScenarioAndWait(22, 700, 1200))
  {
    return;
  }

  assertIntEq("object-merge-pass", 1, (long)@Test::scenarioResult, "scenarioResult");
  if (!waitForObservedObjectRisk(800) ||
      !waitForObservedObjectScenario(800) ||
      !waitForObservedSelectedAlert(800))
  {
    resetValidationHarnessIfNeeded();
    return;
  }
  assertIntEq("object-merge-flag", 1, (long)@Test::obsMergeCutInFlag, "ethMergeCutInFlag");
  assertIntEq("object-merge-alert", 6, (long)@Test::obsSelectedAlertType, "ethSelectedAlertType");

  if (!resetValidationHarnessIfNeeded())
  {
    return;
  }

  if (!launchScenarioAndWait(24, 700, 1200))
  {
    return;
  }

  assertIntEq("object-degrade-pass", 1, (long)@Test::scenarioResult, "scenarioResult");
  if (!waitForObservedObjectRisk(800) ||
      !waitForObservedFailSafe(800) ||
      !waitForObservedDecelAssist(800))
  {
    resetValidationHarnessIfNeeded();
    return;
  }
  assertIntEq("object-confidence", 20, (long)@Test::obsObjectConfidence, "ethObjectConfidence");
  assertIntMin("object-degrade-failsafe", 1, (long)@Test::obsFailSafeMode, "ethFailSafeMode");
  assertIntEq("object-decel-off", 0, (long)@Test::obsDecelAssistReq, "ethDecelAssistReq");

  resetValidationHarnessIfNeeded();
}
