/*@!Encoding:65001*/
includes
{
  #include "..\\common\\ValidationHarnessTestCommon.cin"
}

variables
{
}

/*
  UT_076
  External TX unit contract for police emergency transport context.
  Final frame-level closure remains trace-gated.
*/
export testcase TC_CANOE_UT_OUT_007_POLICE_TX()
{
  if (!resetValidationHarnessIfNeeded())
  {
    return;
  }

  if (!launchScenarioAndWait(4, 700, 1200))
  {
    return;
  }

  assertIntEq("police-tx-pass", 1, (long)@Test::scenarioResult, "scenarioResult");
  assertIntEq("police-tx-alert-state", 1, (long)@V2X::alertState, "alertState");
  assertIntEq("police-tx-type", 1, (long)@V2X::emergencyType, "emergencyType");
  assertIntEq("police-tx-eta", 12, (long)@V2X::eta, "eta");
  assertIntEq("police-tx-source", 11, (long)@V2X::sourceId, "sourceId");
  assertIntEq("police-tx-level", 6, (long)@Core::selectedAlertLevel, "selectedAlertLevel");
  assertIntEq("police-tx-code", 101, (long)@Cluster::warningTextCode, "warningTextCode");

  resetValidationHarnessIfNeeded();
}
