/*@!Encoding:65001*/
includes
{
  #include "..\\common\\ValidationHarnessTestCommon.cin"
}

variables
{
}

export testcase TC_CANOE_IT_EXT_004_OUTPUT_AVAILABILITY()
{
  if (!resetValidationHarnessIfNeeded())
  {
    return;
  }

  if (!launchScenarioAndWait(18, 900, 1300))
  {
    return;
  }

  assertIntEq("output-availability-failsafe-pass", 1, (long)@Test::scenarioResult, "scenarioResult");
  assertIntMin("output-availability-failsafe-level", 6, (long)@Core::selectedAlertLevel, "selectedAlertLevel");
  assertIntMin("output-availability-failsafe-mode", 1, (long)@Core::failSafeMode, "failSafeMode");

  if (!resetValidationHarnessIfNeeded())
  {
    return;
  }

  if (!launchScenarioAndWait(12, 900, 1400))
  {
    return;
  }

  assertIntEq("output-availability-guard-pass", 1, (long)@Test::scenarioResult, "scenarioResult");
  assertIntMin("output-availability-duplicate-guard", 1, (long)@CoreState::duplicatePopupGuard, "duplicatePopupGuard");

  if (!resetValidationHarnessIfNeeded())
  {
    return;
  }

  if (!launchScenarioAndWait(35, 900, 1300))
  {
    return;
  }

  assertIntEq("output-availability-restore-pass", 1, (long)@Test::scenarioResult, "scenarioResult");
  assertIntEq("output-availability-restore-failsafe", 0, (long)@Core::failSafeMode, "failSafeMode");

  resetValidationHarnessIfNeeded();
}