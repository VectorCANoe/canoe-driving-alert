/*@!Encoding:65001*/
includes
{
  #include "..\common\ValidationHarnessTestCommon.cin"
}

variables
{
}

export testcase TC_CANOE_IT_021_CHASSIS_STEERING_BASELINE()
{
  if (!resetValidationHarnessIfNeeded())
  {
    return;
  }

  if (!launchScenarioAndWait(218, 900, 1300))
  {
    return;
  }
  if (!waitForCoreChassisState(68, 1, 0, -1, 800))
  {
    resetValidationHarnessIfNeeded();
    return;
  }

  assertIntEq("chassis-steer-speed", 68, (long)@Core::vehicleSpeedNorm, "vehicleSpeedNorm");
  assertIntEq("chassis-steer-input", 1, (long)@Core::steeringInputNorm, "steeringInputNorm");
  assertIntEq("chassis-steer-brake", 0, (long)@Core::brakePedalNorm, "brakePedalNorm");

  resetValidationHarnessIfNeeded();
}
