/*@!Encoding:65001*/
includes
{
  #include "..\common\ValidationHarnessTestCommon.cin"
}

variables
{
}

export testcase TC_CANOE_IT_014_DISPLAY_POLICY()
{
  if (!resetValidationHarnessIfNeeded())
  {
    return;
  }

  if (!launchScenarioAndWait(215, 900, 1700))
  {
    return;
  }

  if (!waitForStableWarningRender(deriveExpectedEmergencyWarningCode(1, 2, 11, 40), 2, 1200))
  {
    resetValidationHarnessIfNeeded();
    return;
  }
  assertIntEq("display-policy-level", 6, getCanonicalSelectedAlertLevel(), "selectedAlertLevel");
  assertIntEq("display-policy-type", 1, getCanonicalSelectedAlertType(), "selectedAlertType");
  assertIntEq("display-policy-code", deriveExpectedEmergencyWarningCode(1, 2, 11, 40), (long)@Cluster::warningTextCode, "warningTextCode");
  assertIntEq("display-policy-direction", 2, (long)@UiRender::renderDirection, "renderDirection");

  resetValidationHarnessIfNeeded();
}
