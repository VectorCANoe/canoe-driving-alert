/*@!Encoding:65001*/
includes
{
  #include "..\common\ValidationHarnessTestCommon.cin"
}

variables
{
}

export testcase TC_CANOE_IT_014_DISPLAY_POLICY()
{
  if (!resetValidationHarnessIfNeeded())
  {
    return;
  }

  if (!launchScenarioAndWait(215, 900, 1700))
  {
    return;
  }

  assertIntEq("display-policy-pass", 1, (long)@Test::scenarioResult, "scenarioResult");
  assertIntEq("display-policy-level", 6, (long)@Core::selectedAlertLevel, "selectedAlertLevel");
  assertIntEq("display-policy-type", 1, (long)@Core::selectedAlertType, "selectedAlertType");
  assertIntEq("display-policy-code", deriveExpectedEmergencyWarningCode(1, 2, 11, 40), (long)@Cluster::warningTextCode, "warningTextCode");
  assertIntEq("display-policy-direction", 2, (long)@UiRender::renderDirection, "renderDirection");

  resetValidationHarnessIfNeeded();
}
