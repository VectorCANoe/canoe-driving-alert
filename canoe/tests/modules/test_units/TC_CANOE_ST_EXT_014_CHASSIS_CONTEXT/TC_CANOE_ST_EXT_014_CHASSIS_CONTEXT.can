/*@!Encoding:65001*/
includes
{
  #include "..\\common\\ValidationHarnessTestCommon.cin"
}

variables
{
}

export testcase TC_CANOE_ST_EXT_014_CHASSIS_CONTEXT()
{
  if (!resetValidationHarnessIfNeeded()) { return; }
  if (!launchScenarioAndWait(218, 900, 1300)) { return; }
  assertIntEq("st-chassis-steer-pass", 1, (long)@Test::scenarioResult, "scenarioResult");
  assertIntEq("st-chassis-steer-input", 1, (long)@Core::steeringInputNorm, "steeringInputNorm");
  if (!resetValidationHarnessIfNeeded()) { return; }
  if (!launchScenarioAndWait(219, 900, 1300)) { return; }
  assertIntEq("st-chassis-brake-pass", 1, (long)@Test::scenarioResult, "scenarioResult");
  assertIntMin("st-chassis-brake-pedal", 30, (long)@Core::brakePedalNorm, "brakePedalNorm");
  if (!resetValidationHarnessIfNeeded()) { return; }
  if (!launchScenarioAndWait(237, 900, 1300)) { return; }
  assertIntEq("st-chassis-accel-pass", 1, (long)@Test::scenarioResult, "scenarioResult");
  assertIntEq("st-chassis-drive-mode", 2, (long)@CoreState::driveMode, "driveMode");
  resetValidationHarnessIfNeeded();
}
