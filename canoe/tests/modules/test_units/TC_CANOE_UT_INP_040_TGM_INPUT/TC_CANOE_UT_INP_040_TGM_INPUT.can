/*@!Encoding:65001*/
includes
{
  #include "..\common\ValidationHarnessTestCommon.cin"
}

variables
{
  int gTailgateAssistMode;
  int gTailgateOpenReq;
  int gTailgateActuatorCmd;
}

on message frmPowerTailgateCtrlStateMsg
{
  gTailgateAssistMode = this.TailgateAssistMode;
  gTailgateOpenReq = this.OpenRequestState;
  gTailgateActuatorCmd = this.TailgateActuatorCmd;
}

long waitForTgmInputState(dword timeoutMs)
{
  dword waitedMs;

  waitedMs = 0;
  while ((gTailgateAssistMode != 2 ||
          gTailgateOpenReq != 1 ||
          gTailgateActuatorCmd != 0) &&
         waitedMs < timeoutMs)
  {
    TestWaitForTimeout(50);
    waitedMs += 50;
  }

  if (gTailgateAssistMode != 2 ||
      gTailgateOpenReq != 1 ||
      gTailgateActuatorCmd != 0)
  {
    testStepFail("tgm-input-state", "TGM input timeout waited=%d mode=%d openReq=%d actuator=%d",
                 waitedMs,
                 gTailgateAssistMode,
                 gTailgateOpenReq,
                 gTailgateActuatorCmd);
    return 0;
  }

  return 1;
}

export testcase TC_CANOE_UT_INP_040_TGM_INPUT()
{
  if (!resetValidationHarnessIfNeeded())
  {
    return;
  }

  if (!launchScenarioAndWait(227, 800, 1300))
  {
    return;
  }

  if (!waitForTgmInputState(800))
  {
    resetValidationHarnessIfNeeded();
    return;
  }

  assertIntEq("s227_tailgateAssistMode", 2, gTailgateAssistMode, "tailgateAssistMode");
  assertIntEq("s227_tailgateOpenReq", 1, gTailgateOpenReq, "tailgateOpenReq");
  assertIntEq("s227_tailgateActuatorCmd", 0, gTailgateActuatorCmd, "tailgateActuatorCmd");

  resetValidationHarnessIfNeeded();
}
