/*@!Encoding:65001*/
includes
{
  #include "..\common\ValidationHarnessTestCommon.cin"
}

variables
{
  int gSunroofPosition;
  int gSunroofTiltState;
}

on message frmSunroofStateMsg
{
  gSunroofPosition = this.SunroofPosition;
  gSunroofTiltState = this.SunroofTiltState;
}

export testcase TC_CANOE_UT_INP_048_SRF_INPUT()
{
  if (!resetValidationHarnessIfNeeded())
  {
    return;
  }

  gSunroofPosition = -1;
  gSunroofTiltState = -1;
  if (!launchScenarioAndWait(229, 900, 1300))
  {
    return;
  }

  assertIntEq("s229_sunroofPosition", 0, gSunroofPosition, "sunroofPosition");
  assertIntEq("s229_sunroofTiltState", 0, gSunroofTiltState, "sunroofTiltState");

  resetValidationHarnessIfNeeded();
}
