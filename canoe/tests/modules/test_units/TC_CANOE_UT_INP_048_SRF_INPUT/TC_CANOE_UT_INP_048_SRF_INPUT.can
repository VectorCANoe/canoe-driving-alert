/*@!Encoding:65001*/
includes
{
  #include "..\common\ValidationHarnessTestCommon.cin"
}

variables
{
  int gSunroofPosition;
  int gSunroofTiltState;
}

on message frmSunroofStateMsg
{
  gSunroofPosition = this.SunroofPosition;
  gSunroofTiltState = this.SunroofTiltState;
}

export testcase TC_CANOE_UT_INP_048_SRF_INPUT()
{
  if (!resetValidationHarnessIfNeeded())
  {
    return;
  }

  if (!launchScenarioAndWait(230, 800, 1300))
  {
    return;
  }

  assertIntEq("s230_scenarioResult", 1, (long)@Test::scenarioResult, "scenarioResult");
  assertIntEq("s230_sunroofPosition", 0, gSunroofPosition, "sunroofPosition");
  assertIntEq("s230_sunroofTiltState", 0, gSunroofTiltState, "sunroofTiltState");

  resetValidationHarnessIfNeeded();
}
