/*@!Encoding:65001*/
includes
{
  #include "..\common\ValidationHarnessTestCommon.cin"
}

variables
{
  int gSeatDrvPos;
  int gSeatDrvHeatLvl;
}

on message frmSeatDrvStateMsg
{
  gSeatDrvPos = this.SeatDrvPos;
  gSeatDrvHeatLvl = this.SeatDrvHeatLvl;
}

export testcase TC_CANOE_UT_INP_046_SEAT_DRV_INPUT()
{
  if (!resetValidationHarnessIfNeeded())
  {
    return;
  }

  if (!launchScenarioAndWait(230, 800, 1300))
  {
    return;
  }

  assertIntEq("s230_scenarioResult", 1, (long)@Test::scenarioResult, "scenarioResult");
  assertIntEq("s230_seatDrvPos", 120, gSeatDrvPos, "seatDrvPos");
  assertIntEq("s230_seatDrvHeatLvl", 0, gSeatDrvHeatLvl, "seatDrvHeatLvl");

  resetValidationHarnessIfNeeded();
}
