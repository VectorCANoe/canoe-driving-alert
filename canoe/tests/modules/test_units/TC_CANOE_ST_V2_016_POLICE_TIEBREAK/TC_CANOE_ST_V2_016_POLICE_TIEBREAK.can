/*@!Encoding:65001*/
includes
{
  #include "..\\common\\ValidationHarnessTestCommon.cin"
}

variables
{
}

export testcase TC_CANOE_ST_V2_016_POLICE_TIEBREAK()
{
  if (!resetValidationHarnessIfNeeded())
  {
    return;
  }

  if (!launchScenarioAndWait(10, 700, 1200))
  {
    return;
  }

if (!waitForV2xIngressState(1, 1, 10, 5, 1500))
  {
    resetValidationHarnessIfNeeded();
    return;
  }

  assertIntEq("police-tiebreak-eta", 10, (long)@V2X::eta, "eta");
  assertIntEq("police-tiebreak-source", 5, (long)@V2X::sourceId, "sourceId");
  if (!waitForObservedSelectedAlertState(6, 1, 800))
  {
    resetValidationHarnessIfNeeded();
    return;
  }
  assertIntEq("police-tiebreak-level", 6, (long)@Test::obsSelectedAlertLevel, "ethSelectedAlertLevel");
  assertIntEq("police-tiebreak-alert-type", 1, (long)@Test::obsSelectedAlertType, "ethSelectedAlertType");

  resetValidationHarnessIfNeeded();
}
