/*@!Encoding:65001*/
includes
{
  #include "..\common\ValidationHarnessTestCommon.cin"
}

variables
{
  int gSurroundActive;
  int gProximityClass;
}

on message frmSurroundParkMasterStateMsg
{
  gSurroundActive = this.SurroundActive;
  gProximityClass = this.ProximityClass;
}

export testcase TC_CANOE_UT_INP_061_SRR_RR_INPUT()
{
  if (!resetValidationHarnessIfNeeded())
  {
    return;
  }

  if (!launchScenarioAndWait(234, 800, 1300))
  {
    return;
  }

  assertIntEq("s234_scenarioResult", 1, (long)@Test::scenarioResult, "scenarioResult");
  assertIntEq("s234_surroundActive", 1, gSurroundActive, "surroundActive");
  assertIntEq("s234_proximityClass", 3, gProximityClass, "proximityClass");

  resetValidationHarnessIfNeeded();
}
