/*@!Encoding:65001*/
includes
{
  #include "..\common\ValidationHarnessTestCommon.cin"
}

variables
{
  int gMergeConflict;
  int gTurnLampState;
}

on message frmSrrRrStateMsg
{
  gMergeConflict = this.MergeConflict;
  gTurnLampState = this.TurnLampState;
}

export testcase TC_CANOE_UT_INP_061_SRR_RR_INPUT()
{
  if (!resetValidationHarnessIfNeeded())
  {
    return;
  }

  gMergeConflict = -1;
  gTurnLampState = -1;
  if (!launchScenarioAndWait(22, 1000, 1200))
  {
    return;
  }

  assertIntEq("s22_srrRrMergeConflict", 1, gMergeConflict, "mergeConflict");
  assertIntEq("s22_obsMergeCutIn", 1, waitForObservedMergeCutIn(1500), "obsMergeCutIn");
  assertIntEq("s22_mergeCutIn", 1, (long)@Test::obsMergeCutInFlag, "mergeCutInFlag");

  resetValidationHarnessIfNeeded();
}
