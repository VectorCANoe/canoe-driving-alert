/*@!Encoding:65001*/
includes
{
  #include "..\\common\\ValidationHarnessTestCommon.cin"
}

variables
{
}

export testcase TC_CANOE_ST_EXT_033_HISTORY_QUERY()
{
  if (!resetValidationHarnessIfNeeded())
  {
    return;
  }

  if (!launchScenarioAndWait(222, 900, 1300))
  {
    return;
  }

  assertIntEq("history-query-pass", 1, (long)@Test::scenarioResult, "scenarioResult");
  assertIntEq("history-query-distance", 180, (long)@CoreState::emergencyDistanceM, "emergencyDistanceM");
  assertIntEq("history-query-warning-code", deriveExpectedEmergencyWarningCode(1, 2, 9, 72), (long)@Cluster::warningTextCode, "warningTextCode");
  assertIntMin("history-query-count", 1, (long)@CoreState::alertHistoryCount, "alertHistoryCount");

  @Test::historyQueryOffset = 0;
  TestWaitForTimeout(300);
  assertIntEq("history-query-latest-code", (long)@Cluster::warningTextCode, (long)@Test::historyQueryCode, "historyQueryCode");

  resetValidationHarnessIfNeeded();
}
