/*@!Encoding:65001*/
includes
{
  #include "..\\common\\ValidationHarnessTestCommon.cin"
}

variables
{
}

export testcase TC_CANOE_ST_EXT_033_HISTORY_QUERY()
{
  if (!resetValidationHarnessIfNeeded())
  {
    return;
  }

  if (!launchScenarioAndWait(222, 900, 1300))
  {
    return;
  }

  if (!waitForStableDistanceHistory(180, deriveExpectedEmergencyWarningCode(1, 2, 9, 72), 1, 1200))
  {
    resetValidationHarnessIfNeeded();
    return;
  }
  assertIntEq("history-query-distance", 180, (long)@CoreState::emergencyDistanceM, "emergencyDistanceM");
  assertIntEq("history-query-warning-code", deriveExpectedEmergencyWarningCode(1, 2, 9, 72), (long)@Cluster::warningTextCode, "warningTextCode");
  assertIntMin("history-query-count", 1, (long)@CoreState::alertHistoryCount, "alertHistoryCount");

  @Test::historyQueryOffset = 0;
  if (!waitForHistoryQueryCode(deriveExpectedEmergencyWarningCode(1, 2, 9, 72), 1200))
  {
    resetValidationHarnessIfNeeded();
    return;
  }
  assertIntEq("history-query-latest-code", deriveExpectedEmergencyWarningCode(1, 2, 9, 72), (long)@Test::historyQueryCode, "historyQueryCode");

  resetValidationHarnessIfNeeded();
}
