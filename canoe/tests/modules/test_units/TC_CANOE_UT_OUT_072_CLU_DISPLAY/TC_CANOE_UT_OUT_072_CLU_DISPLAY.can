/*@!Encoding:65001*/
includes
{
  #include "..\\common\\ValidationHarnessTestCommon.cin"
}

variables
{
}

export testcase TC_CANOE_UT_OUT_072_CLU_DISPLAY()
{
  if (!resetValidationHarnessIfNeeded())
  {
    return;
  }

  if (!launchScenarioAndWait(30, 700, 1200))
  {
    return;
  }

  assertIntEq("clu-police-pass", 1, (long)@Test::scenarioResult, "scenarioResult");
  assertIntEq("clu-police-code", deriveExpectedEmergencyWarningCode(1, 2, 12, 20), (long)@Cluster::warningTextCode, "warningTextCode");
  assertIntEq("clu-police-direction", 2, (long)@UiRender::renderDirection, "renderDirection");

  if (!resetValidationHarnessIfNeeded())
  {
    return;
  }

  if (!launchScenarioAndWait(33, 700, 1200))
  {
    return;
  }

  assertIntEq("clu-ambulance-pass", 1, (long)@Test::scenarioResult, "scenarioResult");
  assertIntEq("clu-ambulance-code", deriveExpectedEmergencyWarningCode(2, 1, 8, 20), (long)@Cluster::warningTextCode, "warningTextCode");
  assertIntEq("clu-ambulance-direction", 1, (long)@UiRender::renderDirection, "renderDirection");

  if (!resetValidationHarnessIfNeeded())
  {
    return;
  }

  if (!launchScenarioAndWait(220, 900, 1300))
  {
    return;
  }

  assertIntEq("clu-popup-pass", 1, (long)@Test::scenarioResult, "scenarioResult");
  assertIntEq("clu-theme", 2, (long)@CoreState::themeMode, "themeMode");
  assertIntEq("clu-popup-active", 1, (long)@CoreState::popupActive, "popupActive");
  assertIntEq("clu-cluster-sync", 1, (long)@CoreState::clusterSyncState, "clusterSyncState");

  resetValidationHarnessIfNeeded();
}
