/*@!Encoding:65001*/
includes
{
  #include "..\\common\\ValidationHarnessTestCommon.cin"
}

variables
{
}

export testcase TC_CANOE_ST_EXT_003_DRIVER_INTERVENTION_CLEAR()
{
  if (!resetValidationHarnessIfNeeded()) { return; }
  if (!launchScenarioAndWait(17, 900, 1300)) { return; }
  assertIntEq("st-driver-intervention-pass", 1, (long)@Test::scenarioResult, "scenarioResult");
  assertIntEq("st-driver-intervention-decel", 0, (long)@Core::decelAssistReq, "decelAssistReq");
  resetValidationHarnessIfNeeded();
}
