/*@!Encoding:65001*/
includes
{
  #include "..\\common\\ValidationHarnessTestCommon.cin"
}

variables
{
  long gParkMasterActive;
  long gAutoManeuverReady;
  long gParkPhase;
  long gPkmViewMode;
  long gMinDistanceCm;
  long gAssistStage;
  long gSurroundHealth;
  long gSurroundActive;
  long gAutoParkReady;
  long gSpmViewMode;
  long gProximityClass;
  long gSteeringAssistReq;
  long gBrakeHoldReq;
  long gDistanceBucket;
}

on message frmParkMasterStateMsg
{
  gParkMasterActive = this.ParkMasterActive;
  gAutoManeuverReady = this.AutoManeuverReady;
  gParkPhase = this.ParkPhase;
  gPkmViewMode = this.ViewMode;
  gMinDistanceCm = this.MinDistanceCm;
  gAssistStage = this.AssistStage;
  gSurroundHealth = this.SurroundHealth;
}

on message frmSurroundParkMasterStateMsg
{
  gSurroundActive = this.SurroundActive;
  gAutoParkReady = this.AutoParkReady;
  gSpmViewMode = this.ViewMode;
  gProximityClass = this.ProximityClass;
  gSteeringAssistReq = this.SteeringAssistReq;
  gBrakeHoldReq = this.BrakeHoldReq;
  gDistanceBucket = this.DistanceBucket;
}

export testcase TC_CANOE_UT_EXT_012_ADAS_PARKING_PERCEPTION()
{
  if (!resetValidationHarnessIfNeeded())
  {
    return;
  }

  @Test::scenarioCommand = 234;
  if (!waitForScenarioAck(234, 1500))
  {
    return;
  }
  TestWaitForTimeout(450);
  assertIntEq("adas-park-master-active", 1, gParkMasterActive, "ParkMasterActive");
  assertIntEq("adas-park-auto-ready", 1, gAutoManeuverReady, "AutoManeuverReady");
  assertIntEq("adas-park-phase", 3, gParkPhase, "ParkPhase");
  assertIntEq("adas-park-view", 3, gPkmViewMode, "ViewMode");
  assertIntEq("adas-park-distance", 28, gMinDistanceCm, "MinDistanceCm");
  assertIntEq("adas-park-assist-stage", 2, gAssistStage, "AssistStage");
  assertIntEq("adas-park-surround-health", 2, gSurroundHealth, "SurroundHealth");
  assertIntEq("adas-park-surround-active", 1, gSurroundActive, "SurroundActive");
  assertIntEq("adas-park-surround-ready", 1, gAutoParkReady, "AutoParkReady");
  assertIntEq("adas-park-spm-view", 3, gSpmViewMode, "ViewMode");
  assertIntEq("adas-park-proximity", 3, gProximityClass, "ProximityClass");
  assertIntEq("adas-park-steer-req", 1, gSteeringAssistReq, "SteeringAssistReq");
  assertIntEq("adas-park-brake-hold", 1, gBrakeHoldReq, "BrakeHoldReq");
  assertIntEq("adas-park-distance-bucket", 28, gDistanceBucket, "DistanceBucket");

  resetValidationHarnessIfNeeded();
}
