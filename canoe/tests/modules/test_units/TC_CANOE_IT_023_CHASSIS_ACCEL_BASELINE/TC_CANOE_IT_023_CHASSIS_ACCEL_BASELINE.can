/*@!Encoding:65001*/
includes
{
  #include "..\common\ValidationHarnessTestCommon.cin"
}

variables
{
}

export testcase TC_CANOE_IT_023_CHASSIS_ACCEL_BASELINE()
{
  if (!resetValidationHarnessIfNeeded())
  {
    return;
  }

  if (!launchScenarioAndWait(237, 1500, 2600))
  {
    return;
  }
  if (!waitForCoreDriveState(3, 100, -1, 1600))
  {
    resetValidationHarnessIfNeeded();
    return;
  }

  assertIntEq("chassis-accel-drive-state", 3, (long)@Core::driveStateNorm, "driveStateNorm");
  assertIntMin("chassis-accel-speed", 100, (long)@Core::vehicleSpeedNorm, "vehicleSpeedNorm");
  assertIntMin("chassis-accel-drive-mode", 1, (long)@CoreState::driveMode, "driveMode");
  assertIntMin("chassis-accel-sport-mode", 1, (long)@CoreState::sportMode, "sportMode");

  resetValidationHarnessIfNeeded();
}
