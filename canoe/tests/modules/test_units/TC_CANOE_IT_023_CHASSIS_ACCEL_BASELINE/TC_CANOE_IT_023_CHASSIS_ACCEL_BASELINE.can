/*@!Encoding:65001*/
includes
{
  #include "..\common\ValidationHarnessTestCommon.cin"
}

variables
{
}

export testcase TC_CANOE_IT_023_CHASSIS_ACCEL_BASELINE()
{
  if (!resetValidationHarnessIfNeeded())
  {
    return;
  }

  if (!launchScenarioAndWait(237, 900, 1300))
  {
    return;
  }
  if (!waitForCoreDriveState(3, 140, -1, 800))
  {
    resetValidationHarnessIfNeeded();
    return;
  }

  assertIntEq("chassis-accel-drive-state", 3, (long)@Core::driveStateNorm, "driveStateNorm");
  assertIntEq("chassis-accel-speed", 140, (long)@Core::vehicleSpeedNorm, "vehicleSpeedNorm");
  assertIntEq("chassis-accel-drive-mode", 2, (long)@CoreState::driveMode, "driveMode");
  assertIntEq("chassis-accel-sport-mode", 1, (long)@CoreState::sportMode, "sportMode");

  resetValidationHarnessIfNeeded();
}
