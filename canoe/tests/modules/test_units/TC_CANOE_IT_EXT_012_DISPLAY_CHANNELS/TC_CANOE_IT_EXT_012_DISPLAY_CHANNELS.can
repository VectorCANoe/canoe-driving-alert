/*@!Encoding:65001*/
includes
{
  #include "..\\common\\ValidationHarnessTestCommon.cin"
}

variables
{
}

export testcase TC_CANOE_IT_EXT_012_DISPLAY_CHANNELS()
{
  if (!resetValidationHarnessIfNeeded()) { return; }
  if (!launchScenarioAndWait(220, 900, 1300)) { return; }
  assertIntEq("it-display-channel-pass", 1, (long)@Test::scenarioResult, "scenarioResult");
  assertIntEq("it-display-channel-theme", 2, (long)@CoreState::themeMode, "themeMode");
  assertIntEq("it-display-channel-popup", 1, (long)@CoreState::popupActive, "popupActive");
  assertIntEq("it-display-channel-priority", 1, (long)@CoreState::popupPriority, "popupPriority");
  assertIntEq("it-display-channel-cluster-sync", 1, (long)@CoreState::clusterSyncState, "clusterSyncState");
  if (!resetValidationHarnessIfNeeded()) { return; }
  if (!launchScenarioAndWait(222, 900, 1300)) { return; }
  assertIntEq("it-distance-display-pass", 1, (long)@Test::scenarioResult, "scenarioResult");
  assertIntEq("it-distance-display-distance", 180, (long)@CoreState::emergencyDistanceM, "emergencyDistanceM");
  assertIntEq("it-distance-display-code", 102, (long)@Cluster::warningTextCode, "warningTextCode");
  assertIntEq("it-distance-display-failsafe", 0, (long)@Core::failSafeMode, "failSafeMode");
  resetValidationHarnessIfNeeded();
}
