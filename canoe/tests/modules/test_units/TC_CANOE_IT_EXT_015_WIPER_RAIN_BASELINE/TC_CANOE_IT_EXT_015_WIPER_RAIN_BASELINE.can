/*@!Encoding:65001*/
includes
{
  #include "..\\common\\ValidationHarnessTestCommon.cin"
}

variables
{
  long gFrontWiperState;
  long gRearWiperState;
  long gWiperInterval;
  long gRainSenseLevel;
  long gAutoLightState;
}

on message frmWiperStateMsg
{
  gFrontWiperState = this.FrontWiperState;
  gRearWiperState = this.RearWiperState;
  gWiperInterval = this.WiperInterval;
}

on message frmRainLightAutoMsg
{
  gRainSenseLevel = this.RainSenseLevel;
  gAutoLightState = this.AutoLightState;
}

export testcase TC_CANOE_IT_EXT_015_WIPER_RAIN_BASELINE()
{
  if (!resetValidationHarnessIfNeeded()) { return; }
  if (!launchScenarioAndWait(229, 1300, 1700)) { return; }

  assertIntEq("it-wiper-rain-pass", 1, (long)@Test::scenarioResult, "scenarioResult");
  assertIntEq("it-wiper-front", 0, gFrontWiperState, "FrontWiperState");
  assertIntEq("it-wiper-rear", 0, gRearWiperState, "RearWiperState");
  assertIntEq("it-wiper-interval", 0, gWiperInterval, "WiperInterval");
  assertIntEq("it-rain-level", 0, gRainSenseLevel, "RainSenseLevel");
  assertIntEq("it-auto-light", 0, gAutoLightState, "AutoLightState");

  resetValidationHarnessIfNeeded();
}
