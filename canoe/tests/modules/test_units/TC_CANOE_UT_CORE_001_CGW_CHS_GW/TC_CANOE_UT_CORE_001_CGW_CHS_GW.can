/*@!Encoding:65001*/
includes
{
  #include "..\\common\\ValidationHarnessTestCommon.cin"
}

variables
{
}

export testcase TC_CANOE_UT_CORE_001_CGW_CHS_GW()
{
  if (!resetValidationHarnessIfNeeded())
  {
    return;
  }

  if (!launchScenarioAndWait(216, 800, 1300))
  {
    return;
  }
  if (!waitForCoreDriveState(0, 0, 0, 800) ||
      !waitForCoreSelectedAlertState(0, 0, 800))
  {
    resetValidationHarnessIfNeeded();
    return;
  }
  assertIntEq("chs-gw-park-drive", 0, (long)@Core::driveStateNorm, "driveStateNorm");
  assertIntEq("chs-gw-park-speed", 0, (long)@Core::vehicleSpeedNorm, "vehicleSpeedNorm");
  assertIntEq("chs-gw-park-failsafe", 0, (long)@Core::failSafeMode, "failSafeMode");

  if (!resetValidationHarnessIfNeeded())
  {
    return;
  }
  if (!launchScenarioAndWait(217, 800, 1300))
  {
    return;
  }
  if (!waitForCoreDriveStateMinSpeed(3, 30, -1, 800))
  {
    resetValidationHarnessIfNeeded();
    return;
  }
  assertIntEq("chs-gw-drive-state", 3, (long)@Core::driveStateNorm, "driveStateNorm");
  assertIntMin("chs-gw-drive-speed", 30, (long)@Core::vehicleSpeedNorm, "vehicleSpeedNorm");

  if (!resetValidationHarnessIfNeeded())
  {
    return;
  }
  if (!launchScenarioAndWait(218, 800, 1300))
  {
    return;
  }
  if (!waitForCoreChassisState(68, 1, 0, -1, 800))
  {
    resetValidationHarnessIfNeeded();
    return;
  }
  assertIntEq("chs-gw-steer-input", 1, (long)@Core::steeringInputNorm, "steeringInputNorm");
  assertIntEq("chs-gw-steer-speed", 68, (long)@Core::vehicleSpeedNorm, "vehicleSpeedNorm");

  if (!resetValidationHarnessIfNeeded())
  {
    return;
  }
  if (!launchScenarioAndWait(219, 800, 1300))
  {
    return;
  }
  if (!waitForCoreChassisState(-1, -1, 30, -1, 800))
  {
    resetValidationHarnessIfNeeded();
    return;
  }
  assertIntMin("chs-gw-brake-input", 30, (long)@Core::brakePedalNorm, "brakePedalNorm");
  assertIntEq("chs-gw-brake-drive", 0, (long)@Core::driveStateNorm, "driveStateNorm");

  resetValidationHarnessIfNeeded();
}
