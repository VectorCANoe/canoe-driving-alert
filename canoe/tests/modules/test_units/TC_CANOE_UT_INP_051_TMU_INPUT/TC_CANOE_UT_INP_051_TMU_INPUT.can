/*@!Encoding:65001*/
includes
{
  #include "..\common\ValidationHarnessTestCommon.cin"
}

variables
{
  int gTmuLinkState;
  int gTmuServiceMode;
  int gRemoteClimateReq;
  int gSignalBars;
}

on message frmTmuServiceStateMsg
{
  gTmuLinkState = this.TmuLinkState;
  gTmuServiceMode = this.TmuServiceMode;
  gRemoteClimateReq = this.RemoteClimateReq;
  gSignalBars = this.SignalBars;
}

export testcase TC_CANOE_UT_INP_051_TMU_INPUT()
{
  if (!resetValidationHarnessIfNeeded())
  {
    return;
  }

  if (!launchScenarioAndWait(229, 900, 1300))
  {
    return;
  }

  assertIntEq("s229_scenarioResult", 1, (long)@Test::scenarioResult, "scenarioResult");
  assertIntEq("s229_tmuLinkState", 2, gTmuLinkState, "tmuLinkState");
  assertIntEq("s229_tmuServiceMode", 1, gTmuServiceMode, "tmuServiceMode");
  assertIntEq("s229_signalBars", 4, gSignalBars, "signalBars");

  resetValidationHarnessIfNeeded();
}
