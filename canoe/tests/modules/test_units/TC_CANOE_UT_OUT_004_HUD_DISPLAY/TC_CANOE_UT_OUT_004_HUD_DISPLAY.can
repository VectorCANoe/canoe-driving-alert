/*@!Encoding:65001*/
includes
{
  #include "..\\common\\ValidationHarnessTestCommon.cin"
}

variables
{
}

/*
  UT_073 uses shared front-display render seams.
  The project does not currently expose a dedicated HUD namespace, so this unit
  contract closes the reviewer row via warning / popup / route / theme seams
  consumed by HUD processing.
*/
export testcase TC_CANOE_UT_OUT_004_HUD_DISPLAY()
{
  if (!resetValidationHarnessIfNeeded())
  {
    return;
  }

  if (!launchScenarioAndWait(30, 700, 1200))
  {
    return;
  }

  assertIntEq("hud-direction-pass", 1, (long)@Test::scenarioResult, "scenarioResult");
  assertIntEq("hud-direction-code", 102, (long)@Cluster::warningTextCode, "warningTextCode");
  assertIntEq("hud-direction-render", 2, (long)@UiRender::renderDirection, "renderDirection");

  if (!resetValidationHarnessIfNeeded())
  {
    return;
  }

  if (!launchScenarioAndWait(220, 900, 1300))
  {
    return;
  }

  assertIntEq("hud-popup-pass", 1, (long)@Test::scenarioResult, "scenarioResult");
  assertIntEq("hud-theme", 2, (long)@CoreState::themeMode, "themeMode");
  assertIntEq("hud-popup-active", 1, (long)@CoreState::popupActive, "popupActive");
  assertIntEq("hud-popup-priority", 1, (long)@CoreState::popupPriority, "popupPriority");

  resetValidationHarnessIfNeeded();
}
