/*@!Encoding:65001*/
includes
{
  #include "..\\common\\ValidationHarnessTestCommon.cin"
}

variables
{
}

export testcase TC_CANOE_ST_CORE_014_AMBULANCE_DIRECTION_LEFT()
{
  if (!resetValidationHarnessIfNeeded())
  {
    return;
  }

  if (!launchScenarioAndWait(33, 700, 1200))
  {
    return;
  }

  assertIntEq("scenario-pass", 1, (long)@Test::scenarioResult, "scenarioResult");
  assertIntEq("selected-alert-level", 7, (long)@Core::selectedAlertLevel, "selectedAlertLevel");
  assertIntEq("selected-alert-type", 2, (long)@Core::selectedAlertType, "selectedAlertType");
  assertIntEq("warning-text-code", 201, (long)@Cluster::warningTextCode, "warningTextCode");
  assertIntEq("render-direction", 1, (long)@UiRender::renderDirection, "renderDirection");

  resetValidationHarnessIfNeeded();
}
