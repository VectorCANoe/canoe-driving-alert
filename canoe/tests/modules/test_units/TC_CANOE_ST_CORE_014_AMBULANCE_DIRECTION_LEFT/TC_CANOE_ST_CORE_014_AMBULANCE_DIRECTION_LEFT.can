/*@!Encoding:65001*/
includes
{
  #include "..\\common\\ValidationHarnessTestCommon.cin"
}

variables
{
}

export testcase TC_CANOE_ST_CORE_014_AMBULANCE_DIRECTION_LEFT()
{
  if (!resetValidationHarnessIfNeeded())
  {
    return;
  }

  if (!launchScenarioAndWait(33, 700, 1200))
  {
    return;
  }

  if (!waitForCoreSelectedAlertState(7, 2, 800) ||
      !waitForStableWarningRender(deriveExpectedEmergencyWarningCode(2, 1, 8, 20), 1, 800))
  {
    resetValidationHarnessIfNeeded();
    return;
  }

  assertIntEq("selected-alert-level", 7, getCanonicalSelectedAlertLevel(), "selectedAlertLevel");
  assertIntEq("selected-alert-type", 2, getCanonicalSelectedAlertType(), "selectedAlertType");
  assertIntEq("warning-text-code", deriveExpectedEmergencyWarningCode(2, 1, 8, 20), (long)@Cluster::warningTextCode, "warningTextCode");
  assertIntEq("render-direction", 1, (long)@UiRender::renderDirection, "renderDirection");

  resetValidationHarnessIfNeeded();
}
