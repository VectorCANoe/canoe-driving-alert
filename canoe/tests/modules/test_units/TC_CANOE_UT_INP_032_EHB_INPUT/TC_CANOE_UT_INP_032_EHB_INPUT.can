/*@!Encoding:65001*/
includes
{
  #include "..\common\ValidationHarnessTestCommon.cin"
}

variables
{
}

export testcase TC_CANOE_UT_INP_032_EHB_INPUT()
{
  if (!resetValidationHarnessIfNeeded())
  {
    return;
  }

  if (!launchScenarioAndWait(219, 800, 1300))
  {
    return;
  }
  if (!waitForCoreChassisState(0, 0, 30, 0, 800))
  {
    resetValidationHarnessIfNeeded();
    return;
  }

  assertIntEq("s219_driveStateNorm", 0, (long)@Core::driveStateNorm, "driveStateNorm");
  assertIntMin("s219_brakePedalNorm", 30, (long)@Core::brakePedalNorm, "brakePedalNorm");
  assertIntEq("s219_failSafeMode", 0, (long)@Core::failSafeMode, "failSafeMode");

  resetValidationHarnessIfNeeded();
}
