/*@!Encoding:65001*/
includes
{
  #include "..\common\ValidationHarnessTestCommon.cin"
}

variables
{
}

export testcase TC_CANOE_IT_020_POWERTRAIN_DRIVE_BASELINE()
{
  if (!resetValidationHarnessIfNeeded())
  {
    return;
  }

  if (!launchScenarioAndWait(217, 1500, 2200))
  {
    return;
  }
  if (!waitForCoreDriveStateMinSpeed(3, 20, -1, 1600) ||
      !waitForCoreSelectedAlertState(0, 0, 1200))
  {
    resetValidationHarnessIfNeeded();
    return;
  }

  assertIntEq("powertrain-drive-state", 3, (long)@Core::driveStateNorm, "driveStateNorm");
  assertIntMin("powertrain-drive-speed", 20, (long)@Core::vehicleSpeedNorm, "vehicleSpeedNorm");
  assertIntEq("powertrain-drive-level", 0, getCanonicalSelectedAlertLevel(), "selectedAlertLevel");

  resetValidationHarnessIfNeeded();
}
