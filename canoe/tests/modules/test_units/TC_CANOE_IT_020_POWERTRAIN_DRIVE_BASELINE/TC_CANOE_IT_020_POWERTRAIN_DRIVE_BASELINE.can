/*@!Encoding:65001*/
includes
{
  #include "..\common\ValidationHarnessTestCommon.cin"
}

variables
{
}

export testcase TC_CANOE_IT_020_POWERTRAIN_DRIVE_BASELINE()
{
  if (!resetValidationHarnessIfNeeded())
  {
    return;
  }

  if (!launchScenarioAndWait(217, 900, 1300))
  {
    return;
  }
  if (!waitForCoreDriveStateMinSpeed(3, 30, -1, 800) ||
      !waitForCoreSelectedAlertState(0, 0, 800))
  {
    resetValidationHarnessIfNeeded();
    return;
  }

  assertIntEq("powertrain-drive-state", 3, (long)@Core::driveStateNorm, "driveStateNorm");
  assertIntMin("powertrain-drive-speed", 30, (long)@Core::vehicleSpeedNorm, "vehicleSpeedNorm");
  assertIntEq("powertrain-drive-level", 0, (long)@Core::selectedAlertLevel, "selectedAlertLevel");

  resetValidationHarnessIfNeeded();
}
