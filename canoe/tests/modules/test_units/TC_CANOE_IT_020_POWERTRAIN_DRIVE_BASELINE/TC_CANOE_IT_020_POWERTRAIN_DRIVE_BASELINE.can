/*@!Encoding:65001*/
includes
{
  #include "..\common\ValidationHarnessTestCommon.cin"
}

variables
{
}

export testcase TC_CANOE_IT_020_POWERTRAIN_DRIVE_BASELINE()
{
  if (!resetValidationHarnessIfNeeded())
  {
    return;
  }

  if (!launchScenarioAndWait(217, 900, 1300))
  {
    return;
  }

  assertIntEq("powertrain-drive-pass", 1, (long)@Test::scenarioResult, "scenarioResult");
  assertIntEq("powertrain-drive-state", 3, (long)@Core::driveStateNorm, "driveStateNorm");
  assertIntEq("powertrain-drive-speed", 55, (long)@Core::vehicleSpeedNorm, "vehicleSpeedNorm");
  assertIntEq("powertrain-drive-level", 0, (long)@Core::selectedAlertLevel, "selectedAlertLevel");

  resetValidationHarnessIfNeeded();
}
