/*@!Encoding:65001*/
includes
{
  #include "..\\common\\ValidationHarnessTestCommon.cin"
}

export testcase TC_CANOE_UT_OUT_006_DECEL_ASSIST_REQ()
{
  if (!resetValidationHarnessIfNeeded())
  {
    return;
  }

  if (!launchScenarioAndWait(16, 800, 1300))
  {
    return;
  }

  assertIntEq("decel-assist-active-pass", 1, (long)@Test::scenarioResult, "scenarioResult");
  assertLongGe("decel-assist-risk", (long)@Test::obsDecelRisk, 70, "ethDecelRisk");
  assertIntEq("decel-assist-active", 1, (long)@Test::obsDecelAssistReq, "ethDecelAssistReq");
  assertIntEq("decel-assist-active-level", 7, (long)@Test::obsSelectedAlertLevel, "ethSelectedAlertLevel");

  if (!resetValidationHarnessIfNeeded())
  {
    return;
  }
  if (!launchScenarioAndWait(18, 1500, 1000))
  {
    return;
  }

  if (!waitForBaseResult(18, 2000))
  {
    return;
  }

  TestWaitForTimeout(200);
  assertIntEq("decel-assist-failsafe-pass", 1, (long)@Test::scenarioResult, "scenarioResult");
  assertIntEq("decel-assist-blocked", 0, (long)@Test::obsDecelAssistReq, "ethDecelAssistReq");
  assertIntMin("decel-assist-failsafe", 1, (long)@Test::obsFailSafeMode, "ethFailSafeMode");

  resetValidationHarnessIfNeeded();
}
