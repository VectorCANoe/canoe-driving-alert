/*@!Encoding:65001*/
includes
{
  #include "..\\common\\ValidationHarnessTestCommon.cin"
}

variables
{
}

export testcase TC_CANOE_UT_OUT_006_DECEL_ASSIST_REQ()
{
  if (!resetValidationHarnessIfNeeded())
  {
    return;
  }

  if (!launchScenarioAndWait(16, 800, 1300))
  {
    return;
  }

  assertIntEq("decel-assist-active-pass", 1, (long)@Test::scenarioResult, "scenarioResult");
  assertLongGe("decel-assist-risk", (long)@Core::proximityRiskLevel, 70, "proximityRiskLevel");
  assertIntEq("decel-assist-active", 1, (long)@Core::decelAssistReq, "decelAssistReq");
  assertIntEq("decel-assist-active-level", 7, (long)@Core::selectedAlertLevel, "selectedAlertLevel");

  if (!resetValidationHarnessIfNeeded())
  {
    return;
  }

  @Test::scenarioCommand = 18;
  if (!waitForScenarioAck(18, 1500))
  {
    return;
  }

  if (!waitForBaseResult(18, 2000))
  {
    return;
  }

  TestWaitForTimeout(200);
  assertIntEq("decel-assist-failsafe-pass", 1, (long)@Test::scenarioResult, "scenarioResult");
  assertIntEq("decel-assist-blocked", 0, (long)@Core::decelAssistReq, "decelAssistReq");
  assertIntMin("decel-assist-failsafe", 1, (long)@Core::failSafeMode, "failSafeMode");

  resetValidationHarnessIfNeeded();
}
