/*@!Encoding:65001*/
includes
{
  #include "..\\common\\ValidationHarnessTestCommon.cin"
}

variables
{
}

export testcase TC_CANOE_ST_EXT_026_FAILSAFE_RECOVERY()
{
  if (!resetValidationHarnessIfNeeded()) { return; }
  if (!launchScenarioAndWait(201, 1500, 2100)) { return; }
  if (!waitForObservedFailSafe(1200)) { resetValidationHarnessIfNeeded(); return; }
  assertIntEq("st-failsafe-recovery-observed-mode", 0, (long)@Test::obsFailSafeMode, "ethFailSafeMode");
  assertIntEq("st-failsafe-recovery-mode", 0, (long)@Core::failSafeMode, "failSafeMode");
  resetValidationHarnessIfNeeded();
}
