/*@!Encoding:65001*/
includes
{
  #include "..\\common\\ValidationHarnessTestCommon.cin"
}

variables
{
}

export testcase TC_CANOE_UT_EXT_002_CLU_CONTEXT_ADJUST()
{
  if (!resetValidationHarnessIfNeeded())
  {
    return;
  }

  if (!launchScenarioAndWait(214, 900, 1300))
  {
    return;
  }

  assertIntEq("clu-seatbelt-pass", 1, (long)@Test::scenarioResult, "scenarioResult");
  assertIntEq("clu-seatbelt-level", 5, (long)@Core::selectedAlertLevel, "selectedAlertLevel");
  assertIntEq("clu-seatbelt-type", 3, (long)@Core::selectedAlertType, "selectedAlertType");

  if (!resetValidationHarnessIfNeeded())
  {
    return;
  }

  if (!launchScenarioAndWait(215, 900, 1300))
  {
    return;
  }

  assertIntEq("clu-policy-pass", 1, (long)@Test::scenarioResult, "scenarioResult");
  assertIntEq("clu-policy-code", 142, (long)@Cluster::warningTextCode, "warningTextCode");
  assertIntEq("clu-policy-direction", 2, (long)@UiRender::renderDirection, "renderDirection");

  if (!resetValidationHarnessIfNeeded())
  {
    return;
  }

  if (!launchScenarioAndWait(222, 900, 1300))
  {
    return;
  }

  assertIntEq("clu-distance-pass", 1, (long)@Test::scenarioResult, "scenarioResult");
  assertIntEq("clu-distance-code", 102, (long)@Cluster::warningTextCode, "warningTextCode");
  assertIntEq("clu-distance-m", 180, (long)@CoreState::emergencyDistanceM, "emergencyDistanceM");

  resetValidationHarnessIfNeeded();
}
