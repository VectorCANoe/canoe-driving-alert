/*@!Encoding:65001*/
includes
{
  #include "..\common\ValidationHarnessTestCommon.cin"
}

variables
{
  int gAmpMute;
  int gAmpDuckingLvl;
  int gAmpVolumeLevel;
}

on message frmAmpStateMsg
{
  gAmpMute = this.AmpMute;
  gAmpDuckingLvl = this.AmpDuckingLvl;
  gAmpVolumeLevel = this.AmpVolumeLevel;
}

export testcase TC_CANOE_UT_INP_050_AMP_INPUT()
{
  if (!resetValidationHarnessIfNeeded())
  {
    return;
  }

  if (!launchScenarioAndWait(215, 900, 1300))
  {
    return;
  }

  assertIntEq("s215_scenarioResult", 1, (long)@Test::scenarioResult, "scenarioResult");
  assertIntEq("s215_ampMute", 0, gAmpMute, "ampMute");
  assertIntEq("s215_ampDuckingLvl", 4, gAmpDuckingLvl, "ampDuckingLvl");
  assertIntEq("s215_ampVolumeLevel", 80, gAmpVolumeLevel, "ampVolumeLevel");

  resetValidationHarnessIfNeeded();
}
