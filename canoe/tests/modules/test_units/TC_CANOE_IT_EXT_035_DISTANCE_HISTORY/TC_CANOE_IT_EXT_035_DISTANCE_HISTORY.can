/*@!Encoding:65001*/
includes
{
  #include "..\\common\\ValidationHarnessTestCommon.cin"
}

variables
{
}

export testcase TC_CANOE_IT_EXT_035_DISTANCE_HISTORY()
{
  if (!resetValidationHarnessIfNeeded())
  {
    return;
  }

  if (!launchScenarioAndWait(222, 900, 1300))
  {
    return;
  }

  assertIntEq("distance-history-pass", 1, (long)@Test::scenarioResult, "scenarioResult");
  assertIntEq("distance-history-distance", 180, (long)@CoreState::emergencyDistanceM, "emergencyDistanceM");
  assertIntEq("distance-history-code", deriveExpectedEmergencyWarningCode(1, 2, 9, 72), (long)@Cluster::warningTextCode, "warningTextCode");
  assertIntMin("distance-history-count", 1, (long)@CoreState::alertHistoryCount, "alertHistoryCount");

  @Test::historyQueryOffset = 0;
  TestWaitForTimeout(300);
  assertIntEq("distance-history-query-code", (long)@Cluster::warningTextCode, (long)@Test::historyQueryCode, "historyQueryCode");

  resetValidationHarnessIfNeeded();
}
