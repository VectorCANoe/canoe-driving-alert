/*@!Encoding:65001*/
includes
{
  #include "..\\common\\ValidationHarnessTestCommon.cin"
}

variables
{
}

export testcase TC_CANOE_IT_EXT_035_DISTANCE_HISTORY()
{
  if (!resetValidationHarnessIfNeeded())
  {
    return;
  }

  if (!launchScenarioAndWait(222, 900, 1300))
  {
    return;
  }

  if (!waitForStableDistanceHistory(180, deriveExpectedEmergencyWarningCode(1, 2, 9, 72), 1, 1200))
  {
    resetValidationHarnessIfNeeded();
    return;
  }
  assertIntEq("distance-history-distance", 180, (long)@CoreState::emergencyDistanceM, "emergencyDistanceM");
  assertIntEq("distance-history-code", deriveExpectedEmergencyWarningCode(1, 2, 9, 72), (long)@Cluster::warningTextCode, "warningTextCode");
  assertIntMin("distance-history-count", 1, (long)@CoreState::alertHistoryCount, "alertHistoryCount");

  @Test::historyQueryOffset = 0;
  if (!waitForHistoryQueryCode(deriveExpectedEmergencyWarningCode(1, 2, 9, 72), 1200))
  {
    resetValidationHarnessIfNeeded();
    return;
  }
  assertIntEq("distance-history-query-code", deriveExpectedEmergencyWarningCode(1, 2, 9, 72), (long)@Test::historyQueryCode, "historyQueryCode");

  resetValidationHarnessIfNeeded();
}
