/*@!Encoding:65001*/
includes
{
  #include "..\\common\\ValidationHarnessTestCommon.cin"
}

variables
{
}

export testcase TC_CANOE_ST_EXT_046_FAILSAFE_RECOVERY()
{
  if (!resetValidationHarnessIfNeeded())
  {
    return;
  }

  if (!launchScenarioAndWait(201, 1500, 2000))
  {
    return;
  }

  if (!waitForObservedFailSafe(1200))
  {
    resetValidationHarnessIfNeeded();
    return;
  }
  assertIntEq("fail-safe-observed-recovered", 0, (long)@Test::obsFailSafeMode, "ethFailSafeMode");
  assertIntEq("fail-safe-recovered", 0, (long)@Core::failSafeMode, "failSafeMode");

  resetValidationHarnessIfNeeded();
}
