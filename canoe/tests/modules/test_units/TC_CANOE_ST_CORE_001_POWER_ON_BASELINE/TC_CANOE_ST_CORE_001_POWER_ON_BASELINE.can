/*@!Encoding:65001*/
includes
{
  #include "..\\common\\ValidationHarnessTestCommon.cin"
}

variables
{
}

export testcase TC_CANOE_ST_CORE_001_POWER_ON_BASELINE()
{
  if (!resetValidationHarnessIfNeeded())
  {
    return;
  }

  if (!launchScenarioAndWait(1, 700, 1000))
  {
    return;
  }

  assertIntEq("st001-pass", 1, (long)@Test::scenarioResult, "scenarioResult");
  assertIntEq("st001-level", 0, (long)@Core::selectedAlertLevel, "selectedAlertLevel");
  assertIntEq("st001-type", 0, (long)@Core::selectedAlertType, "selectedAlertType");
  assertIntEq("st001-code", 0, (long)@Cluster::warningTextCode, "warningTextCode");
  assertIntEq("st001-failsafe", 0, (long)@Core::failSafeMode, "failSafeMode");

  resetValidationHarnessIfNeeded();
}
