/*@!Encoding:65001*/
includes
{
  #include "..\common\ValidationHarnessTestCommon.cin"
}

variables
{
}

export testcase TC_CANOE_ST_037_AUDIO_CHANNEL_STABILITY()
{
  if (!resetValidationHarnessIfNeeded())
  {
    return;
  }

  if (!launchScenarioAndWait(215, 900, 1300))
  {
    return;
  }

  assertIntMin("channel-contention-audio-focus", 1, (long)@CoreState::audioFocusOwner, "audioFocusOwner");
  assertIntMin("channel-contention-audio-ducking", 2, (long)@CoreState::audioDuckingLvl, "audioDuckingLvl");
  assertIntMin("channel-contention-audio-volume", 20, (long)@CoreState::volumeLevel, "volumeLevel");
  assertIntEq("channel-contention-audio-failsafe", 0, (long)@Core::failSafeMode, "failSafeMode");

  resetValidationHarnessIfNeeded();
}
