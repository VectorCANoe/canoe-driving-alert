/*@!Encoding:65001*/
includes
{
  #include "..\\common\\ValidationHarnessTestCommon.cin"
}

variables
{
}

export testcase TC_CANOE_IT_CORE_008_CLUSTER_DIRECTION_OUTPUT()
{
  if (!resetValidationHarnessIfNeeded())
  {
    return;
  }

  if (!launchScenarioAndWait(30, 700, 1200))
  {
    return;
  }

  if (!waitForCoreSelectedAlertState(6, 1, 800) ||
      !waitForStableWarningRender(deriveExpectedEmergencyWarningCode(1, 2, 12, 20), 2, 800))
  {
    resetValidationHarnessIfNeeded();
    return;
  }

  assertIntEq("selected-alert-level", 6, (long)@Core::selectedAlertLevel, "selectedAlertLevel");
  assertIntEq("selected-alert-type", 1, (long)@Core::selectedAlertType, "selectedAlertType");
  assertIntEq("warning-text-code", deriveExpectedEmergencyWarningCode(1, 2, 12, 20), (long)@Cluster::warningTextCode, "warningTextCode");
  assertIntEq("render-direction", 2, (long)@UiRender::renderDirection, "renderDirection");

  resetValidationHarnessIfNeeded();
}
