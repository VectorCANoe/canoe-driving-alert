/*@!Encoding:65001*/
includes
{
  #include "..\common\ValidationHarnessTestCommon.cin"
}

variables
{
  int gMinDistanceCm;
  int gProximityClass;
}

on message frmParkUltrasonicStateMsg
{
  gMinDistanceCm = this.MinDistanceCm;
}

on message frmSurroundParkMasterStateMsg
{
  gProximityClass = this.ProximityClass;
}

export testcase TC_CANOE_UT_INP_054_PUS_INPUT()
{
  if (!resetValidationHarnessIfNeeded())
  {
    return;
  }

  if (!launchScenarioAndWait(234, 800, 1300))
  {
    return;
  }

  assertIntEq("s234_scenarioResult", 1, (long)@Test::scenarioResult, "scenarioResult");
  assertIntEq("s234_minDistanceCm", 28, gMinDistanceCm, "minDistanceCm");
  assertIntEq("s234_proximityClass", 3, gProximityClass, "proximityClass");

  resetValidationHarnessIfNeeded();
}
