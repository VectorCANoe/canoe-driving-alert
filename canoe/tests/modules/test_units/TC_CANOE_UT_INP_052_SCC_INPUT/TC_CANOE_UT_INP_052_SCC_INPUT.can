/*@!Encoding:65001*/
includes
{
  #include "..\common\ValidationHarnessTestCommon.cin"
}

variables
{
  int gSccState;
  int gSccSetSpeed;
}

on message frmSccStateMsg
{
  gSccState = this.SccState;
  gSccSetSpeed = this.SccSetSpeed;
}

export testcase TC_CANOE_UT_INP_052_SCC_INPUT()
{
  /* Scenario 16: proximity decel scenario — SCC active with close following distance.
     ADAS_WARN_CTRL receives SCC state and raises decel assist request.
     Verifies: SCC state input received AND decel assist observer triggered. */
  if (!resetValidationHarnessIfNeeded())
  {
    return;
  }

  if (!launchScenarioAndWait(16, 1000, 1200))
  {
    return;
  }

  assertIntEq("s16_scenarioResult", 1, (long)@Test::scenarioResult, "scenarioResult");
  assertIntEq("s16_sccState", 1, gSccState, "sccState");
  assertIntEq("s16_obsDecelAssistReq", 1, waitForObservedDecelAssist(800), "obsDecelAssistReq");
  assertIntEq("s16_decelAssistReq", 1, (long)@Test::obsDecelAssistReq, "decelAssistReq");

  resetValidationHarnessIfNeeded();
}
