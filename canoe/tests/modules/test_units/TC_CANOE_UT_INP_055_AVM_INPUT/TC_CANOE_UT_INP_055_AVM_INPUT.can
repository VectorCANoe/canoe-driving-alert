/*@!Encoding:65001*/
includes
{
  #include "..\common\ValidationHarnessTestCommon.cin"
}

variables
{
  int gViewMode;
  int gSurroundActive;
}

on message frmSurroundParkMasterStateMsg
{
  gViewMode = this.ViewMode;
  gSurroundActive = this.SurroundActive;
}

long waitForAvmInputState(dword timeoutMs)
{
  dword waitedMs;

  waitedMs = 0;
  while ((gViewMode != 3 ||
          gSurroundActive != 1) &&
         waitedMs < timeoutMs)
  {
    TestWaitForTimeout(50);
    waitedMs += 50;
  }

  if (gViewMode != 3 ||
      gSurroundActive != 1)
  {
    testStepFail("avm-input-state", "AVM input timeout waited=%d view=%d active=%d",
                 waitedMs, gViewMode, gSurroundActive);
    return 0;
  }

  return 1;
}

export testcase TC_CANOE_UT_INP_055_AVM_INPUT()
{
  if (!resetValidationHarnessIfNeeded())
  {
    return;
  }

  if (!launchScenarioAndWait(234, 800, 1300))
  {
    return;
  }
  if (!waitForAvmInputState(800))
  {
    resetValidationHarnessIfNeeded();
    return;
  }

  assertIntEq("s234_viewMode", 3, gViewMode, "viewMode");
  assertIntEq("s234_surroundActive", 1, gSurroundActive, "surroundActive");

  resetValidationHarnessIfNeeded();
}
