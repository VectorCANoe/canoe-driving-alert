/*@!Encoding:65001*/
includes
{
  #include "..\\common\\ValidationHarnessTestCommon.cin"
}

variables
{
  long gAutoDoorState;
  long gAutoUnlockState;
  long gDoorApproachScore;
  long gTailgateAssistMode;
  long gTailgateOpenReq;
  long gTailgateActuatorCmd;
}

on message frmAutoDoorCtrlStateMsg
{
  gAutoDoorState = this.AutoDoorState;
  gAutoUnlockState = this.AutoUnlockState;
  gDoorApproachScore = this.DoorApproachScore;
}

on message frmPowerTailgateCtrlStateMsg
{
  gTailgateAssistMode = this.TailgateAssistMode;
  gTailgateOpenReq = this.OpenRequestState;
  gTailgateActuatorCmd = this.TailgateActuatorCmd;
}

long waitForBodyEntryDoorState(long expectedDoorState,
                               long expectedUnlockState,
                               long expectedMinApproachScore,
                               dword timeoutMs)
{
  dword waitedMs;

  waitedMs = 0;
  while ((gAutoDoorState != expectedDoorState ||
          gAutoUnlockState != expectedUnlockState ||
          gDoorApproachScore < expectedMinApproachScore) &&
         waitedMs < timeoutMs)
  {
    TestWaitForTimeout(50);
    waitedMs += 50;
  }

  if (gAutoDoorState != expectedDoorState ||
      gAutoUnlockState != expectedUnlockState ||
      gDoorApproachScore < expectedMinApproachScore)
  {
    testStepFail("body-entry-door-state", "Door state timeout waited=%d expectedDoor=%d expectedUnlock=%d expectedMinScore=%d actualDoor=%d actualUnlock=%d actualScore=%d",
                 waitedMs,
                 expectedDoorState,
                 expectedUnlockState,
                 expectedMinApproachScore,
                 gAutoDoorState,
                 gAutoUnlockState,
                 gDoorApproachScore);
    return 0;
  }

  return 1;
}

long waitForBodyTailgateState(long expectedAssistMode,
                              long expectedOpenReq,
                              long expectedActuatorCmd,
                              dword timeoutMs)
{
  dword waitedMs;

  waitedMs = 0;
  while ((gTailgateAssistMode != expectedAssistMode ||
          gTailgateOpenReq != expectedOpenReq ||
          gTailgateActuatorCmd != expectedActuatorCmd) &&
         waitedMs < timeoutMs)
  {
    TestWaitForTimeout(50);
    waitedMs += 50;
  }

  if (gTailgateAssistMode != expectedAssistMode ||
      gTailgateOpenReq != expectedOpenReq ||
      gTailgateActuatorCmd != expectedActuatorCmd)
  {
    testStepFail("body-entry-tailgate-state", "Tailgate state timeout waited=%d expectedMode=%d expectedOpen=%d expectedCmd=%d actualMode=%d actualOpen=%d actualCmd=%d",
                 waitedMs,
                 expectedAssistMode,
                 expectedOpenReq,
                 expectedActuatorCmd,
                 gTailgateAssistMode,
                 gTailgateOpenReq,
                 gTailgateActuatorCmd);
    return 0;
  }

  return 1;
}

export testcase TC_CANOE_UT_EXT_018_BODY_ENTRY_EXIT()
{
  if (!resetValidationHarnessIfNeeded())
  {
    return;
  }

  gAutoDoorState = -1;
  gAutoUnlockState = -1;
  gDoorApproachScore = -1;
  gTailgateAssistMode = -1;
  gTailgateOpenReq = -1;
  gTailgateActuatorCmd = -1;

  if (!launchScenarioAndWait(226, 1500, 350))
  {
    return;
  }
  if (!waitForBodyEntryDoorState(1, 1, 80, 800))
  {
    resetValidationHarnessIfNeeded();
    return;
  }
  assertIntEq("body-entry-door-state", 1, gAutoDoorState, "AutoDoorState");
  assertIntEq("body-entry-door-unlock", 1, gAutoUnlockState, "AutoUnlockState");
  assertIntMin("body-entry-door-score", 80, gDoorApproachScore, "DoorApproachScore");

  if (!resetValidationHarnessIfNeeded())
  {
    return;
  }

  gTailgateAssistMode = -1;
  gTailgateOpenReq = -1;
  gTailgateActuatorCmd = -1;
  if (!launchScenarioAndWait(227, 1500, 350))
  {
    return;
  }
  if (!waitForBodyTailgateState(2, 1, 0, 800))
  {
    resetValidationHarnessIfNeeded();
    return;
  }
  assertIntEq("body-entry-tailgate-mode", 2, gTailgateAssistMode, "TailgateAssistMode");
  assertIntEq("body-entry-tailgate-open", 1, gTailgateOpenReq, "OpenRequestState");
  assertIntEq("body-entry-tailgate-cmd", 0, gTailgateActuatorCmd, "TailgateActuatorCmd");

  resetValidationHarnessIfNeeded();
}
