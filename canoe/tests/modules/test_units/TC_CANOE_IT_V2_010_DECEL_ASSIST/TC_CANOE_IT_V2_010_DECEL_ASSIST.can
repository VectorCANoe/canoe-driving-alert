/*@!Encoding:65001*/
includes
{
  #include "..\\common\\ValidationHarnessTestCommon.cin"
}

variables
{
}

export testcase TC_CANOE_IT_V2_010_DECEL_ASSIST()
{
  if (!resetValidationHarnessIfNeeded())
  {
    return;
  }

  if (!launchScenarioAndWait(19, 800, 1300))
  {
    return;
  }

  assertIntEq("scenario-pass", 1, (long)@Test::scenarioResult, "scenarioResult");
  if (!waitForObservedDecelState(1, 1, 0, 800) ||
      !waitForObservedSelectedAlert(800) ||
      !waitForObservedFailSafe(800))
  {
    resetValidationHarnessIfNeeded();
    return;
  }
  assertIntEq("decel-decision-req", 1, (long)@Test::obsDecelDecisionReq, "ethDecelDecisionReq");
  assertIntEq("decel-assist-req", 1, (long)@Test::obsDecelAssistReq, "ethDecelAssistReq");
  assertIntEq("decel-gate-clear", 0, (long)@Test::obsDecelGateReason, "ethDecelGateReason");
  assertLongGe("proximity-risk-level", (long)@Test::obsDecelRisk, 70, "ethDecelRisk");
  assertIntEq("selected-alert-level", 7, (long)@Test::obsSelectedAlertLevel, "ethSelectedAlertLevel");
  assertIntEq("selected-alert-type", 2, (long)@Test::obsSelectedAlertType, "ethSelectedAlertType");
  assertIntEq("fail-safe-clear", 0, (long)@Test::obsFailSafeMode, "ethFailSafeMode");

  resetValidationHarnessIfNeeded();
}
