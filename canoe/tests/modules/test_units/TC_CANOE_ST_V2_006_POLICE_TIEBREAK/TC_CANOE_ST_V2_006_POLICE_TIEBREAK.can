/*@!Encoding:65001*/
includes
{
  #include "..\\common\\ValidationHarnessTestCommon.cin"
}

variables
{
}

export testcase TC_CANOE_ST_V2_006_POLICE_TIEBREAK()
{
  if (!resetValidationHarnessIfNeeded())
  {
    return;
  }

  if (!launchScenarioAndWait(10, 700, 1200))
  {
    return;
  }

  assertIntEq("police-tiebreak-pass", 1, (long)@Test::scenarioResult, "scenarioResult");
  assertIntEq("police-tiebreak-eta", 10, (long)@V2X::eta, "eta");
  assertIntEq("police-tiebreak-source", 5, (long)@V2X::sourceId, "sourceId");
  if (!waitForObservedSelectedAlert(800))
  {
    resetValidationHarnessIfNeeded();
    return;
  }
  assertIntEq("police-tiebreak-level", 6, (long)@Test::obsSelectedAlertLevel, "ethSelectedAlertLevel");
  assertIntEq("police-tiebreak-alert-type", 1, (long)@Test::obsSelectedAlertType, "ethSelectedAlertType");

  resetValidationHarnessIfNeeded();
}
