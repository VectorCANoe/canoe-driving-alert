/*@!Encoding:65001*/
includes
{
  #include "..\\common\\ValidationHarnessTestCommon.cin"
}

variables
{
}

export testcase TC_CANOE_ST_EXT_040_TRIP_SEQUENCE()
{
  if (!resetValidationHarnessIfNeeded())
  {
    return;
  }

  if (!launchScenarioAndWait(200, 3500, 4000))
  {
    return;
  }

  assertIntEq("scenario-pass", 1, (long)@Test::scenarioResult, "scenarioResult");
  assertIntEq("selected-alert-level", 0, (long)@Core::selectedAlertLevel, "selectedAlertLevel");
  assertIntEq("warning-text-code", 0, (long)@Cluster::warningTextCode, "warningTextCode");

  resetValidationHarnessIfNeeded();
}
