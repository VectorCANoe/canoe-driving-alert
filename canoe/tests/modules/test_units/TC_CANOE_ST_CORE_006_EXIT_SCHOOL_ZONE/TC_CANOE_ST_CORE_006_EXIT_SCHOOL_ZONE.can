/*@!Encoding:65001*/
includes
{
  #include "..\\common\\ValidationHarnessTestCommon.cin"
}

variables
{
}

export testcase TC_CANOE_ST_CORE_006_EXIT_SCHOOL_ZONE()
{
  if (!resetValidationHarnessIfNeeded())
  {
    return;
  }

  if (!launchScenarioAndWait(2, 700, 1200))
  {
    return;
  }

  if (!waitForNavContextState(1, 30, 800) ||
      !waitForCoreSelectedAlertState(3, 3, 800))
  {
    resetValidationHarnessIfNeeded();
    return;
  }

  assertIntEq("st006-school-level", 3, getCanonicalSelectedAlertLevel(), "selectedAlertLevel");

  if (!launchScenarioAndWait(1, 700, 1000))
  {
    return;
  }

  if (!waitForCoreSelectedAlertState(0, 0, 800) ||
      !waitForStableWarningRender(0, -1, 800))
  {
    resetValidationHarnessIfNeeded();
    return;
  }

  assertIntEq("st006-clear-level", 0, getCanonicalSelectedAlertLevel(), "selectedAlertLevel");
  assertIntEq("st006-clear-type", 0, getCanonicalSelectedAlertType(), "selectedAlertType");
  assertIntEq("st006-clear-code", 0, (long)@Cluster::warningTextCode, "warningTextCode");

  resetValidationHarnessIfNeeded();
}
