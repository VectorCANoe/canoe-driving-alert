/*@!Encoding:65001*/
includes
{
  #include "..\\common\\ValidationHarnessTestCommon.cin"
}

variables
{
}

export testcase TC_CANOE_ST_EXT_029_CUTIN_OBJECT_RISK()
{
  if (!resetValidationHarnessIfNeeded())
  {
    return;
  }

  if (!launchScenarioAndWait(22, 700, 1200))
  {
    return;
  }

  assertIntEq("cutin-object-pass", 1, (long)@Test::scenarioResult, "scenarioResult");
  if (!waitForObservedObjectRisk(800) ||
      !waitForObservedObjectScenario(800) ||
      !waitForObservedSelectedAlert(800) ||
      !waitForObservedFailSafe(800))
  {
    resetValidationHarnessIfNeeded();
    return;
  }
  assertIntEq("cutin-object-merge-flag", 1, (long)@Test::obsMergeCutInFlag, "ethMergeCutInFlag");
  assertIntMin("cutin-object-risk-class", 3, (long)@Test::obsObjectRiskClass, "ethObjectRiskClass");
  assertIntEq("cutin-object-alert-type", 6, (long)@Test::obsSelectedAlertType, "ethSelectedAlertType");
  assertIntEq("cutin-object-failsafe", 0, (long)@Test::obsFailSafeMode, "ethFailSafeMode");

  resetValidationHarnessIfNeeded();
}
