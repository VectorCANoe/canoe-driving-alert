/*@!Encoding:65001*/
includes
{
  #include "..\\common\\ValidationHarnessTestCommon.cin"
}

variables
{
}

export testcase TC_CANOE_ST_EXT_002_MERGE_DECEL()
{
  if (!resetValidationHarnessIfNeeded()) { return; }
  if (!launchScenarioAndWait(238, 900, 1300)) { return; }
  assertIntEq("st-merge-decel-pass", 1, (long)@Test::scenarioResult, "scenarioResult");
  assertIntEq("st-merge-decel-req", 1, (long)@Core::decelAssistReq, "decelAssistReq");
  resetValidationHarnessIfNeeded();
}
