/*@!Encoding:65001*/
includes
{
  #include "..\common\ValidationHarnessTestCommon.cin"
}

variables
{
  int gSrrFlState;
  int gSrrFlObjectRange;
}

on message frmSrrFlStateMsg
{
  gSrrFlState = this.SrrState;
  gSrrFlObjectRange = this.ObjectRange;
}

export testcase TC_CANOE_UT_INP_058_SRR_FL_INPUT()
{
  /* Scenario 21: lateral/intersection conflict scenario.
     Left front SRR detects crossing vehicle at intersection.
     ADAS_WARN_CTRL must raise intersection conflict flag via object risk path. */
  if (!resetValidationHarnessIfNeeded())
  {
    return;
  }

  if (!launchScenarioAndWait(21, 1000, 1200))
  {
    return;
  }

  assertIntEq("s21_scenarioResult", 1, (long)@Test::scenarioResult, "scenarioResult");
  assertIntEq("s21_srrFlState", 1, gSrrFlState, "srrFlState");
  assertIntEq("s21_obsObjectScenario", 1, waitForObservedObjectScenario(800), "obsObjectScenario");
  assertIntEq("s21_intersectionConflict", 1, (long)@Test::obsIntersectionConflictFlag, "intersectionConflictFlag");

  resetValidationHarnessIfNeeded();
}
