/*@!Encoding:65001*/
includes
{
  #include "..\\common\\ValidationHarnessTestCommon.cin"
}

variables
{
}

export testcase TC_CANOE_IT_CORE_007_AMBIENT_OUTPUT()
{
  if (!resetValidationHarnessIfNeeded())
  {
    return;
  }

  if (!launchScenarioAndWait(4, 700, 1200))
  {
    return;
  }

if (!waitForV2xIngressState(1, 1, 12, 11, 1500) ||
      !waitForCoreSelectedAlertState(6, 1, 800))
  {
    resetValidationHarnessIfNeeded();
    return;
  }

  assertIntEq("selected-alert-level", 6, (long)@Core::selectedAlertLevel, "selectedAlertLevel");
  assertIntEq("selected-alert-type", 1, (long)@Core::selectedAlertType, "selectedAlertType");
  assertIntEq("ambient-color", 6, (long)@Body::ambientColor, "ambientColor");
  assertIntEq("ambient-pattern", 6, (long)@Body::ambientPattern, "ambientPattern");

  resetValidationHarnessIfNeeded();
}
