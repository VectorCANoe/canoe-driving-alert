/*@!Encoding:65001*/
includes
{
  #include "..\common\ValidationHarnessTestCommon.cin"
}

variables
{
  int gDKeyState;
  int gVehicleAccessState;
  int gSecurityGrade;
  int gKeyPresence;
}

on message frmDigitalKeyStateMsg
{
  gDKeyState = this.DKeyState;
  gVehicleAccessState = this.VehicleAccessState;
  gSecurityGrade = this.SecurityGrade;
  gKeyPresence = this.KeyPresence;
}

long waitForIboxState(dword timeoutMs)
{
  dword waitedMs;

  waitedMs = 0;
  while ((gDKeyState != 2 ||
          gVehicleAccessState != 2 ||
          gSecurityGrade != 2 ||
          gKeyPresence != 1) &&
         waitedMs < timeoutMs)
  {
    TestWaitForTimeout(50);
    waitedMs += 50;
  }

  if (gDKeyState != 2 ||
      gVehicleAccessState != 2 ||
      gSecurityGrade != 2 ||
      gKeyPresence != 1)
  {
    testStepFail("ibox-state", "IBOX state timeout waited=%d dkey=%d access=%d grade=%d presence=%d",
                 waitedMs,
                 gDKeyState,
                 gVehicleAccessState,
                 gSecurityGrade,
                 gKeyPresence);
    return 0;
  }

  return 1;
}

export testcase TC_CANOE_UT_INP_062_IBOX_INPUT()
{
  if (!resetValidationHarnessIfNeeded())
  {
    return;
  }

  gDKeyState = -1;
  gVehicleAccessState = -1;
  gSecurityGrade = -1;
  gKeyPresence = -1;
  if (!launchScenarioAndWait(229, 900, 1300))
  {
    return;
  }

  if (!waitForIboxState(800))
  {
    resetValidationHarnessIfNeeded();
    return;
  }

  assertIntEq("s229_dKeyState", 2, gDKeyState, "dKeyState");
  assertIntEq("s229_vehicleAccessState", 2, gVehicleAccessState, "vehicleAccessState");
  assertIntEq("s229_securityGrade", 2, gSecurityGrade, "securityGrade");
  assertIntEq("s229_keyPresence", 1, gKeyPresence, "keyPresence");

  resetValidationHarnessIfNeeded();
}
