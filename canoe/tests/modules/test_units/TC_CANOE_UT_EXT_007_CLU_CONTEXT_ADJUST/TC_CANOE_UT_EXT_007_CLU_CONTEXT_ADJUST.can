/*@!Encoding:65001*/
includes
{
  #include "..\\common\\ValidationHarnessTestCommon.cin"
}

variables
{
}

export testcase TC_CANOE_UT_EXT_007_CLU_CONTEXT_ADJUST()
{
  if (!resetValidationHarnessIfNeeded())
  {
    return;
  }

  if (!launchScenarioAndWait(214, 900, 1300))
  {
    return;
  }

  assertIntEq("clu-seatbelt-pass", 1, (long)@Test::scenarioResult, "scenarioResult");
  assertIntEq("clu-seatbelt-level", 5, (long)@Core::selectedAlertLevel, "selectedAlertLevel");
  assertIntEq("clu-seatbelt-type", 3, (long)@Core::selectedAlertType, "selectedAlertType");

  if (!resetValidationHarnessIfNeeded())
  {
    return;
  }

  if (!launchScenarioAndWait(215, 900, 1300))
  {
    return;
  }

  if (!waitForStableWarningRender(deriveExpectedEmergencyWarningCode(1, 2, 11, 40), 2, 1200))
  {
    resetValidationHarnessIfNeeded();
    return;
  }
  assertIntEq("clu-policy-pass", 1, (long)@Test::scenarioResult, "scenarioResult");
  assertIntEq("clu-policy-code", deriveExpectedEmergencyWarningCode(1, 2, 11, 40), (long)@Cluster::warningTextCode, "warningTextCode");
  assertIntEq("clu-policy-direction", 2, (long)@UiRender::renderDirection, "renderDirection");

  if (!resetValidationHarnessIfNeeded())
  {
    return;
  }

  if (!launchScenarioAndWait(222, 900, 1300))
  {
    return;
  }

  if (!waitForStableDistanceHistory(180, deriveExpectedEmergencyWarningCode(1, 2, 9, 72), 1, 1200))
  {
    resetValidationHarnessIfNeeded();
    return;
  }
  assertIntEq("clu-distance-pass", 1, (long)@Test::scenarioResult, "scenarioResult");
  assertIntEq("clu-distance-code", deriveExpectedEmergencyWarningCode(1, 2, 9, 72), (long)@Cluster::warningTextCode, "warningTextCode");
  assertIntEq("clu-distance-m", 180, (long)@CoreState::emergencyDistanceM, "emergencyDistanceM");

  resetValidationHarnessIfNeeded();
}
