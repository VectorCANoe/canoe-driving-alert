/*@!Encoding:65001*/
includes
{
  #include "..\common\ValidationHarnessTestCommon.cin"
}

variables
{
}

export testcase TC_CANOE_ST_035_TIMEOUT_CLEAR_RESTORE()
{
  if (!resetValidationHarnessIfNeeded())
  {
    return;
  }

  if (!launchScenarioAndWait(35, 1800, 2300))
  {
    return;
  }

  if (!waitForObservedSelectedAlertState(3, 3, 800) ||
      !waitForObservedFailSafe(1200))
  {
    resetValidationHarnessIfNeeded();
    return;
  }
  assertIntEq("delay-stability-restore-level", 3, (long)@Test::obsSelectedAlertLevel, "ethSelectedAlertLevel");
  assertIntEq("delay-stability-restore-failsafe", 0, (long)@Test::obsFailSafeMode, "ethFailSafeMode");

  resetValidationHarnessIfNeeded();
}
