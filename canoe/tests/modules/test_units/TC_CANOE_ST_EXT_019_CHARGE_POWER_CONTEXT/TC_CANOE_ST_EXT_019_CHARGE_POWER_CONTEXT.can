/*@!Encoding:65001*/
includes
{
  #include "..\\common\\ValidationHarnessTestCommon.cin"
}

variables
{
  long gObcState;
  long gAcPlugState;
  long gChargePowerKw;
  long gDcdcMode;
  long gLvOutputVolt;
  long gLvOutputCurr;
  long gEopState;
  long gPumpRpm;
  long gOilPressure;
  long gMcuState;
  long gMotorTorqueCmd;
  long gMotorSpeedRpm;
  long gInverterState;
  long gInvTemp;
  long gDcLinkVolt;
}

on message frmObcStateMsg
{
  gObcState = this.ObcState;
  gAcPlugState = this.AcPlugState;
  gChargePowerKw = this.ChargePowerKw;
}

on message frmDcdcStateMsg
{
  gDcdcMode = this.DcdcMode;
  gLvOutputVolt = this.LvOutputVolt;
  gLvOutputCurr = this.LvOutputCurr;
}

on message frmEopStateMsg
{
  gEopState = this.EopState;
  gPumpRpm = this.PumpRpm;
  gOilPressure = this.OilPressure;
}

on message frmMcuStateMsg
{
  gMcuState = this.McuState;
  gMotorTorqueCmd = this.MotorTorqueCmd;
  gMotorSpeedRpm = this.MotorSpeedRpm;
}

on message frmInverterStateMsg
{
  gInverterState = this.InverterState;
  gInvTemp = this.InvTemp;
  gDcLinkVolt = this.DcLinkVolt;
}

export testcase TC_CANOE_ST_EXT_019_CHARGE_POWER_CONTEXT()
{
  if (!resetValidationHarnessIfNeeded()) { return; }
  if (!launchScenarioAndWait(231, 900, 1300)) { return; }
  assertIntEq("st-charge-pass", 1, (long)@Test::scenarioResult, "scenarioResult");
  assertIntEq("st-charge-obc-state", 2, gObcState, "ObcState");
  assertIntEq("st-charge-plug", 1, gAcPlugState, "AcPlugState");
  assertIntEq("st-charge-kw", 20, gChargePowerKw, "ChargePowerKw");
  assertIntEq("st-charge-dcdc-mode", 2, gDcdcMode, "DcdcMode");
  assertIntEq("st-charge-volt", 140, gLvOutputVolt, "LvOutputVolt");
  assertIntEq("st-charge-curr", 35, gLvOutputCurr, "LvOutputCurr");

  if (!resetValidationHarnessIfNeeded()) { return; }
  if (!launchScenarioAndWait(232, 900, 1300)) { return; }
  assertIntEq("st-propulsion-pass", 1, (long)@Test::scenarioResult, "scenarioResult");
  assertIntEq("st-propulsion-eop-state", 2, gEopState, "EopState");
  assertIntEq("st-propulsion-pump-rpm", 1600, gPumpRpm, "PumpRpm");
  assertIntEq("st-propulsion-oil-pressure", 120, gOilPressure, "OilPressure");
  assertIntEq("st-propulsion-mcu-state", 2, gMcuState, "McuState");
  assertIntEq("st-propulsion-torque", 124, gMotorTorqueCmd, "MotorTorqueCmd");
  assertIntEq("st-propulsion-speed", 4800, gMotorSpeedRpm, "MotorSpeedRpm");
  assertIntEq("st-propulsion-inverter-state", 2, gInverterState, "InverterState");
  assertIntEq("st-propulsion-inv-temp", 71, gInvTemp, "InvTemp");
  assertIntEq("st-propulsion-dc-link", 134, gDcLinkVolt, "DcLinkVolt");

  if (!resetValidationHarnessIfNeeded()) { return; }
  if (!launchScenarioAndWait(237, 900, 1300)) { return; }
  assertIntEq("st-drive-accel-pass", 1, (long)@Test::scenarioResult, "scenarioResult");
  assertIntEq("st-drive-accel-drive-mode", 2, (long)@CoreState::driveMode, "driveMode");
  resetValidationHarnessIfNeeded();
}
