/*@!Encoding:65001*/
includes
{
  #include "..\common\ValidationHarnessTestCommon.cin"
}

variables
{
  int gRideHeightMode;
  int gFrontHeight;
  int gRearHeight;
  int gCdcMode;
  int gValveCurrent;
}

on message frmAirSuspensionStateMsg
{
  gRideHeightMode = this.RideHeightMode;
  gFrontHeight = this.FrontSuspHeight;
  gRearHeight = this.RearSuspHeight;
}

on message frmCdcStateMsg
{
  gCdcMode = this.CdcMode;
  gValveCurrent = this.ValveCurrent;
}

export testcase TC_CANOE_UT_INP_035_CDC_INPUT()
{
  if (!resetValidationHarnessIfNeeded())
  {
    return;
  }

  if (!launchScenarioAndWait(225, 800, 1300))
  {
    return;
  }

  assertIntEq("s225_scenarioResult", 1, (long)@Test::scenarioResult, "scenarioResult");
  assertIntEq("s225_cdcMode", 2, gCdcMode, "cdcMode");
  assertIntEq("s225_valveCurrent", 160, gValveCurrent, "valveCurrent");

  resetValidationHarnessIfNeeded();
}
