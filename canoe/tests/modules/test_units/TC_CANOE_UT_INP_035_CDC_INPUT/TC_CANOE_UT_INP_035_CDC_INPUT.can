/*@!Encoding:65001*/
includes
{
  #include "..\common\ValidationHarnessTestCommon.cin"
}

variables
{
  int gCdcMode;
  int gCdcValveCurrent;
}

on message frmCdcStateMsg
{
  gCdcMode = this.CdcMode;
  gCdcValveCurrent = this.CdcValveCurrent;
}

long waitForCdcInputState(dword timeoutMs)
{
  dword waitedMs;

  waitedMs = 0;
  while ((gCdcMode < 1 ||
          gCdcValveCurrent < 40) &&
         waitedMs < timeoutMs)
  {
    TestWaitForTimeout(50);
    waitedMs += 50;
  }

  if (gCdcMode < 1 ||
      gCdcValveCurrent < 40)
  {
    testStepFail("cdc-input-state", "CDC input timeout waited=%d mode=%d current=%d minimumMode=%d minimumCurrent=%d",
                 waitedMs, gCdcMode, gCdcValveCurrent, 1, 40);
    return 0;
  }

  return 1;
}

export testcase TC_CANOE_UT_INP_035_CDC_INPUT()
{
  if (!resetValidationHarnessIfNeeded())
  {
    return;
  }

  if (!launchScenarioAndWait(225, 800, 1300))
  {
    return;
  }
  if (!waitForCdcInputState(800))
  {
    resetValidationHarnessIfNeeded();
    return;
  }

  assertIntMin("s225_cdcMode", 1, gCdcMode, "cdcMode");
  assertIntMin("s225_valveCurrent", 40, gCdcValveCurrent, "valveCurrent");

  resetValidationHarnessIfNeeded();
}
