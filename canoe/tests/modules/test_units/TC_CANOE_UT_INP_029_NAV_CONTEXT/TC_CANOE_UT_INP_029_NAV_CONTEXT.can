/*@!Encoding:65001*/
includes
{
  #include "..\common\ValidationHarnessTestCommon.cin"
}

variables
{
}

export testcase TC_CANOE_UT_INP_029_NAV_CONTEXT()
{
  if (!resetValidationHarnessIfNeeded())
  {
    return;
  }

  if (!launchScenarioAndWait(2, 800, 1300))
  {
    return;
  }

  assertIntMin("s2_selectedAlertLevel", 3, (long)@Core::selectedAlertLevel, "selectedAlertLevel");
  assertIntEq("s2_failSafeMode", 0, (long)@Core::failSafeMode, "failSafeMode");

  if (!resetValidationHarnessIfNeeded())
  {
    return;
  }

  if (!launchScenarioAndWait(7, 800, 1300))
  {
    return;
  }

  assertIntEq("s7_failSafeMode", 0, (long)@Core::failSafeMode, "failSafeMode");

  resetValidationHarnessIfNeeded();
}
