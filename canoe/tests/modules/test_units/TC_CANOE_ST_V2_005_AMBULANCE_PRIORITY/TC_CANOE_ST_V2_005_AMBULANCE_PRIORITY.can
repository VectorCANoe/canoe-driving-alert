/*@!Encoding:65001*/
includes
{
  #include "..\\common\\ValidationHarnessTestCommon.cin"
}

variables
{
}

export testcase TC_CANOE_ST_V2_005_AMBULANCE_PRIORITY()
{
  if (!resetValidationHarnessIfNeeded())
  {
    return;
  }

  if (!launchScenarioAndWait(212, 700, 1200))
  {
    return;
  }

  assertIntEq("ambulance-priority-pass", 1, (long)@Test::scenarioResult, "scenarioResult");
  assertIntEq("ambulance-priority-emergency-type", 2, (long)@V2X::emergencyType, "emergencyType");
  assertIntEq("ambulance-priority-level", 7, (long)@Core::selectedAlertLevel, "selectedAlertLevel");
  assertIntEq("ambulance-priority-alert-type", 2, (long)@Core::selectedAlertType, "selectedAlertType");
  assertIntEq("ambulance-priority-warning-code", 202, (long)@Cluster::warningTextCode, "warningTextCode");

  resetValidationHarnessIfNeeded();
}
