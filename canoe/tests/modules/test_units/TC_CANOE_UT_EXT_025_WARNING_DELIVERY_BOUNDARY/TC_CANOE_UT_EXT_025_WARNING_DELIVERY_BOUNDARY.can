/*@!Encoding:65001*/
includes
{
  #include "..\\common\\ValidationHarnessTestCommon.cin"
}

export testcase TC_CANOE_UT_EXT_025_WARNING_DELIVERY_BOUNDARY()
{
  if (!resetValidationHarnessIfNeeded())
  {
    return;
  }
  if (!launchScenarioAndWait(18, 1500, 1000))
  {
    return;
  }

  if (!waitForBaseResult(18, 2000))
  {
    return;
  }
  if (!waitForObservedFailSafeMin(1, 1500) ||
      !waitForObservedDecelState(-1, 0, -1, 800))
  {
    resetValidationHarnessIfNeeded();
    return;
  }
  assertIntMin("boundary-failsafe-mode", 1, (long)@Test::obsFailSafeMode, "ethFailSafeMode");
  assertIntEq("boundary-failsafe-decel-off", 0, (long)@Test::obsDecelAssistReq, "ethDecelAssistReq");

  if (!resetValidationHarnessIfNeeded())
  {
    return;
  }

  if (!launchScenarioAndWait(203, 1500, 2100))
  {
    return;
  }

  assertIntEq("boundary-security-state", 3, (long)@Diag::SecurityState, "SecurityState");
  assertIntEq("boundary-route-owner", 1, (long)@Diag::RouteOwner, "RouteOwner");

  if (!resetValidationHarnessIfNeeded())
  {
    return;
  }

  if (!launchScenarioAndWait(204, 1500, 2100))
  {
    return;
  }

  assertIntEq("boundary-response-kind", 4, (long)@Diag::ResponseKind, "ResponseKind");
  assertIntEq("boundary-reason-code", 2, (long)@Diag::ReasonCode, "ReasonCode");
  assertIntEq("boundary-response-ok", 0, (long)@Diag::LastResponseOk, "LastResponseOk");

  resetValidationHarnessIfNeeded();
}
