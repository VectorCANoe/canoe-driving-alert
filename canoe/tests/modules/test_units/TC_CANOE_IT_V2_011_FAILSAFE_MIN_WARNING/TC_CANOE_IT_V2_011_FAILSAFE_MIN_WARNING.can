/*@!Encoding:65001*/
includes
{
  #include "..\\common\\ValidationHarnessTestCommon.cin"
}

export testcase TC_CANOE_IT_V2_011_FAILSAFE_MIN_WARNING()
{
  if (!resetValidationHarnessIfNeeded())
  {
    return;
  }
  if (!launchScenarioAndWait(18, 1500, 1000))
  {
    return;
  }

  if (!waitForBaseResult(18, 2000))
  {
    return;
  }

  if (!waitForObservedDecelState(1, 0, 3, 800) ||
      !waitForObservedFailSafe(800) ||
      !waitForObservedSelectedAlert(800))
  {
    resetValidationHarnessIfNeeded();
    return;
  }

  assertIntEq("scenario-pass", 1, (long)@Test::scenarioResult, "scenarioResult");
  assertIntEq("base-scenario-id", 18, (long)@Test::baseScenarioId, "baseScenarioId");
  assertIntEq("base-result", 1, (long)@Test::baseScenarioResult, "baseScenarioResult");
  assertIntEq("decel-decision-held", 1, (long)@Test::obsDecelDecisionReq, "ethDecelDecisionReq");
  assertIntEq("decel-gate-reason", 3, (long)@Test::obsDecelGateReason, "ethDecelGateReason");
  assertIntMin("fail-safe-mode", 1, (long)@Test::obsFailSafeMode, "ethFailSafeMode");
  assertIntEq("decel-assist", 0, (long)@Test::obsDecelAssistReq, "ethDecelAssistReq");
  assertIntMin("alert-level", 6, (long)@Test::obsSelectedAlertLevel, "ethSelectedAlertLevel");
  assertIntEq("alert-type", 1, (long)@Test::obsSelectedAlertType, "ethSelectedAlertType");
  assertIntMin("cluster-code", 100, (long)@Cluster::warningTextCode, "warningTextCode");

  resetValidationHarnessIfNeeded();
}
