/*@!Encoding:65001*/
includes
{
  #include "..\\common\\ValidationHarnessTestCommon.cin"
}

variables
{
}

export testcase TC_CANOE_IT_EXT_007_OCCUPANT_COMFORT_CONTEXT()
{
  if (!resetValidationHarnessIfNeeded()) { return; }
  if (!launchScenarioAndWait(226, 900, 1300)) { return; }
  assertIntEq("it-door-entry-pass", 1, (long)@Test::scenarioResult, "scenarioResult");
  if (!resetValidationHarnessIfNeeded()) { return; }
  if (!launchScenarioAndWait(227, 900, 1300)) { return; }
  assertIntEq("it-tailgate-pass", 1, (long)@Test::scenarioResult, "scenarioResult");
  if (!resetValidationHarnessIfNeeded()) { return; }
  if (!launchScenarioAndWait(228, 900, 1300)) { return; }
  assertIntEq("it-occupant-protection-pass", 1, (long)@Test::scenarioResult, "scenarioResult");
  if (!resetValidationHarnessIfNeeded()) { return; }
  if (!launchScenarioAndWait(229, 1300, 1700)) { return; }
  assertIntEq("it-comfort-service-pass", 1, (long)@Test::scenarioResult, "scenarioResult");
  resetValidationHarnessIfNeeded();
}
