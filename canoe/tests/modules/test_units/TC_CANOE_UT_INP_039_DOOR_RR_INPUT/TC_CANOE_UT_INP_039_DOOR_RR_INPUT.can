/*@!Encoding:65001*/
includes
{
  #include "..\common\ValidationHarnessTestCommon.cin"
}

variables
{
  int gAutoDoorState;
  int gAutoUnlockState;
  int gDoorApproachScore;
}

on message frmAutoDoorCtrlStateMsg
{
  gAutoDoorState = this.AutoDoorState;
  gAutoUnlockState = this.AutoUnlockState;
  gDoorApproachScore = this.DoorApproachScore;
}

export testcase TC_CANOE_UT_INP_039_DOOR_RR_INPUT()
{
  if (!resetValidationHarnessIfNeeded())
  {
    return;
  }

  if (!launchScenarioAndWait(226, 800, 1300))
  {
    return;
  }

  assertIntEq("s226_scenarioResult", 1, (long)@Test::scenarioResult, "scenarioResult");
  assertIntEq("s226_autoDoorState", 1, gAutoDoorState, "autoDoorState");
  assertIntMin("s226_doorApproachScore", 50, gDoorApproachScore, "doorApproachScore");

  resetValidationHarnessIfNeeded();
}
