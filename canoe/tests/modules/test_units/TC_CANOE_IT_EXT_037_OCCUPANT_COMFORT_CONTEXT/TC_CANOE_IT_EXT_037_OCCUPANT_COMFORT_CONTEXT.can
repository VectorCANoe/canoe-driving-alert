/*@!Encoding:65001*/
includes
{
  #include "..\\common\\ValidationHarnessTestCommon.cin"
}

variables
{
  long gAutoDoorState;
  long gAutoUnlockState;
  long gDoorApproachScore;
  long gTailgateAssistMode;
  long gTailgateOpenReq;
  long gTailgateActuatorCmd;
  long gDeploymentArmed;
  long gPretensionReq;
  long gAirbagWarn;
  long gOccupantDetected;
  long gWeightClass;
  long gAirbagSuppress;
  long gChildSeatDetected;
  long gCabinSetTemp;
  long gBlowerLevel;
  long gAcOn;
  long gVentMode;
  long gDefogMode;
  long gFanRpmStep;
}

on message frmAutoDoorCtrlStateMsg
{
  gAutoDoorState = this.AutoDoorState;
  gAutoUnlockState = this.AutoUnlockState;
  gDoorApproachScore = this.DoorApproachScore;
}

on message frmPowerTailgateCtrlStateMsg
{
  gTailgateAssistMode = this.TailgateAssistMode;
  gTailgateOpenReq = this.OpenRequestState;
  gTailgateActuatorCmd = this.TailgateActuatorCmd;
}

on message frmAcuStateMsg
{
  gDeploymentArmed = this.DeploymentArmed;
  gPretensionReq = this.PretensionReq;
  gAirbagWarn = this.AirbagWarn;
}

on message frmOdsStateMsg
{
  gOccupantDetected = this.OccupantDetected;
  gWeightClass = this.WeightClass;
  gAirbagSuppress = this.AirbagSuppress;
  gChildSeatDetected = this.ChildSeatDetected;
}

on message frmHvacStateMsg
{
  gCabinSetTemp = this.CabinSetTemp;
  gBlowerLevel = this.BlowerLevel;
  gAcOn = this.AcCompressorOn;
}

on message frmHvacActuatorMsg
{
  gVentMode = this.VentMode;
  gDefogMode = this.DefogMode;
  gFanRpmStep = this.FanRpmStep;
}

export testcase TC_CANOE_IT_EXT_037_OCCUPANT_COMFORT_CONTEXT()
{
  if (!resetValidationHarnessIfNeeded()) { return; }
  if (!launchScenarioAndWait(226, 900, 1300)) { return; }
  assertIntEq("it-door-entry-pass", 1, (long)@Test::scenarioResult, "scenarioResult");
  assertIntEq("it-door-entry-state", 1, gAutoDoorState, "AutoDoorState");
  assertIntEq("it-door-entry-unlock", 1, gAutoUnlockState, "AutoUnlockState");
  assertIntEq("it-door-entry-score", 100, gDoorApproachScore, "DoorApproachScore");
  if (!resetValidationHarnessIfNeeded()) { return; }
  if (!launchScenarioAndWait(227, 900, 1300)) { return; }
  assertIntEq("it-tailgate-pass", 1, (long)@Test::scenarioResult, "scenarioResult");
  assertIntEq("it-tailgate-mode", 2, gTailgateAssistMode, "TailgateAssistMode");
  assertIntEq("it-tailgate-open", 1, gTailgateOpenReq, "OpenRequestState");
  assertIntEq("it-tailgate-cmd", 0, gTailgateActuatorCmd, "TailgateActuatorCmd");
  if (!resetValidationHarnessIfNeeded()) { return; }
  if (!launchScenarioAndWait(228, 900, 1300)) { return; }
  assertIntEq("it-occupant-protection-pass", 1, (long)@Test::scenarioResult, "scenarioResult");
  assertIntEq("it-occupant-armed", 0, gDeploymentArmed, "DeploymentArmed");
  assertIntEq("it-occupant-pretension", 1, gPretensionReq, "PretensionReq");
  assertIntEq("it-occupant-airbag-warn", 1, gAirbagWarn, "AirbagWarn");
  assertIntEq("it-occupant-detected", 1, gOccupantDetected, "OccupantDetected");
  assertIntEq("it-occupant-weight-class", 1, gWeightClass, "WeightClass");
  assertIntEq("it-occupant-airbag-suppress", 1, gAirbagSuppress, "AirbagSuppress");
  assertIntEq("it-occupant-child-seat", 1, gChildSeatDetected, "ChildSeatDetected");
  if (!resetValidationHarnessIfNeeded()) { return; }
  if (!launchScenarioAndWait(229, 1300, 1700)) { return; }
  assertIntEq("it-comfort-service-pass", 1, (long)@Test::scenarioResult, "scenarioResult");
  assertIntEq("it-comfort-hvac-set", 24, gCabinSetTemp, "CabinSetTemp");
  assertIntEq("it-comfort-hvac-blower", 5, gBlowerLevel, "BlowerLevel");
  assertIntEq("it-comfort-hvac-ac", 1, gAcOn, "AcCompressorOn");
  assertIntEq("it-comfort-hvac-vent", 2, gVentMode, "VentMode");
  assertIntEq("it-comfort-hvac-defog", 0, gDefogMode, "DefogMode");
  assertIntEq("it-comfort-hvac-fan", 80, gFanRpmStep, "FanRpmStep");
  resetValidationHarnessIfNeeded();
}
