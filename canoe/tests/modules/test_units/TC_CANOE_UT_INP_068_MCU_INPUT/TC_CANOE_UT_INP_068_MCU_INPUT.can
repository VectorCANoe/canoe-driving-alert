/*@!Encoding:65001*/
includes
{
  #include "..\common\ValidationHarnessTestCommon.cin"
}

variables
{
  int gMcuState;
  int gMotorTorqueCmd;
  int gMotorSpeedRpm;
}

on message frmMcuStateMsg
{
  gMcuState = this.McuState;
  gMotorTorqueCmd = this.MotorTorqueCmd;
  gMotorSpeedRpm = this.MotorSpeedRpm;
}

export testcase TC_CANOE_UT_INP_068_MCU_INPUT()
{
  if (!resetValidationHarnessIfNeeded())
  {
    return;
  }

  if (!launchScenarioAndWait(232, 800, 1300))
  {
    return;
  }

  assertIntEq("s232_scenarioResult", 1, (long)@Test::scenarioResult, "scenarioResult");
  assertIntEq("s232_mcuState", 2, gMcuState, "mcuState");
  assertIntEq("s232_motorTorqueCmd", 124, gMotorTorqueCmd, "motorTorqueCmd");
  assertIntEq("s232_motorSpeedRpm", 4800, gMotorSpeedRpm, "motorSpeedRpm");

  resetValidationHarnessIfNeeded();
}
