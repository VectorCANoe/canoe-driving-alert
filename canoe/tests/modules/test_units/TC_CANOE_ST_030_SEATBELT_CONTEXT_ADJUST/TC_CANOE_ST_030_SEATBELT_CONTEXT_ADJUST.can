/*@!Encoding:65001*/
includes
{
  #include "..\common\ValidationHarnessTestCommon.cin"
}

variables
{
}

export testcase TC_CANOE_ST_030_SEATBELT_CONTEXT_ADJUST()
{
  if (!resetValidationHarnessIfNeeded())
  {
    return;
  }

  if (!launchScenarioAndWait(214, 900, 1300))
  {
    return;
  }

  if (!waitForCoreSelectedAlertState(5, 3, 800) ||
      !waitForCoreDriveState(-1, -1, 0, 800))
  {
    resetValidationHarnessIfNeeded();
    return;
  }

  assertIntEq("context-adjust-alert-level", 5, (long)@Core::selectedAlertLevel, "selectedAlertLevel");
  assertIntEq("context-adjust-alert-type", 3, (long)@Core::selectedAlertType, "selectedAlertType");
  assertIntEq("context-adjust-failsafe", 0, (long)@Core::failSafeMode, "failSafeMode");

  resetValidationHarnessIfNeeded();
}
