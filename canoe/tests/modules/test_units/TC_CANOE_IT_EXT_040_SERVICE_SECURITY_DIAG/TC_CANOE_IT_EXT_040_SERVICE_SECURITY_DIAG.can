/*@!Encoding:65001*/
includes
{
  #include "..\\common\\ValidationHarnessTestCommon.cin"
}

variables
{
}

export testcase TC_CANOE_IT_EXT_040_SERVICE_SECURITY_DIAG()
{
  // Verify integrated service, security, and diagnostic-state verdict.
  if (!resetValidationHarnessIfNeeded())
  {
    return;
  }

  if (!launchScenarioAndWait(205, 1500, 2100))
  {
    return;
  }

  assertIntEq("scenario-pass", 1, (long)@Test::scenarioResult, "scenarioResult");
  assertIntEq("service-state", 1, (long)@Diag::ServiceState, "ServiceState");
  assertIntEq("security-state", 3, (long)@Diag::SecurityState, "SecurityState");
  assertIntEq("route-owner", 1, (long)@Diag::RouteOwner, "RouteOwner");
  assertIntEq("response-kind", 4, (long)@Diag::ResponseKind, "ResponseKind");
  assertIntEq("reason-code", 2, (long)@Diag::ReasonCode, "ReasonCode");

  resetValidationHarnessIfNeeded();
}
