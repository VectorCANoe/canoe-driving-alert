/*@!Encoding:65001*/
includes
{
  #include "..\common\ValidationHarnessTestCommon.cin"
}

variables
{
  int gCabinSetTemp;
  int gBlowerLevel;
  int gAcOn;
  int gVentMode;
}

on message frmHvacStateMsg
{
  gCabinSetTemp = this.CabinSetTemp;
  gBlowerLevel = this.BlowerLevel;
  gAcOn = this.AcCompressorOn;
}

on message frmHvacActuatorMsg
{
  gVentMode = this.VentMode;
}

long waitForDatcInputState(dword timeoutMs)
{
  dword waitedMs;

  waitedMs = 0;
  while ((gCabinSetTemp != 24 ||
          gBlowerLevel != 5 ||
          gAcOn != 1 ||
          gVentMode != 2) &&
         waitedMs < timeoutMs)
  {
    TestWaitForTimeout(50);
    waitedMs += 50;
  }

  if (gCabinSetTemp != 24 ||
      gBlowerLevel != 5 ||
      gAcOn != 1 ||
      gVentMode != 2)
  {
    testStepFail("datc-input-state", "DATC input timeout waited=%d temp=%d blower=%d ac=%d vent=%d",
                 waitedMs,
                 gCabinSetTemp,
                 gBlowerLevel,
                 gAcOn,
                 gVentMode);
    return 0;
  }

  return 1;
}

export testcase TC_CANOE_UT_INP_045_DATC_INPUT()
{
  if (!resetValidationHarnessIfNeeded())
  {
    return;
  }

  gCabinSetTemp = -1;
  gBlowerLevel = -1;
  gAcOn = -1;
  gVentMode = -1;
  if (!launchScenarioAndWait(229, 800, 1300))
  {
    return;
  }

  if (!waitForDatcInputState(800))
  {
    resetValidationHarnessIfNeeded();
    return;
  }

  assertIntEq("s229_cabinSetTemp", 24, gCabinSetTemp, "cabinSetTemp");
  assertIntEq("s229_blowerLevel", 5, gBlowerLevel, "blowerLevel");
  assertIntEq("s229_acOn", 1, gAcOn, "acOn");
  assertIntEq("s229_ventMode", 2, gVentMode, "ventMode");

  resetValidationHarnessIfNeeded();
}
