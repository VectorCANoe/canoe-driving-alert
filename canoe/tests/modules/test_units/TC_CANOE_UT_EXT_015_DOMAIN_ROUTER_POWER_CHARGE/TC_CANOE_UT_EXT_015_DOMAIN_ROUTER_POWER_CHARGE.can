/*@!Encoding:65001*/
includes
{
  #include "..\\common\\ValidationHarnessTestCommon.cin"
}

variables
{
  long gObcState;
  long gAcPlugState;
  long gChargePowerKw;
  long gDcdcMode;
  long gLvOutputVolt;
  long gLvOutputCurr;
}

on message frmObcStateMsg
{
  gObcState = this.ObcState;
  gAcPlugState = this.AcPlugState;
  gChargePowerKw = this.ChargePowerKw;
}

on message frmDcdcStateMsg
{
  gDcdcMode = this.DcdcMode;
  gLvOutputVolt = this.LvOutputVolt;
  gLvOutputCurr = this.LvOutputCurr;
}

export testcase TC_CANOE_UT_EXT_015_DOMAIN_ROUTER_POWER_CHARGE()
{
  if (!resetValidationHarnessIfNeeded())
  {
    return;
  }
  if (!launchScenarioAndWait(231, 1500, 450))
  {
    return;
  }
  assertIntEq("router-power-obc-state", 2, gObcState, "ObcState");
  assertIntEq("router-power-plug", 1, gAcPlugState, "AcPlugState");
  assertIntEq("router-power-charge-kw", 20, gChargePowerKw, "ChargePowerKw");
  assertIntEq("router-power-dcdc-mode", 2, gDcdcMode, "DcdcMode");
  assertIntEq("router-power-volt", 140, gLvOutputVolt, "LvOutputVolt");
  assertIntEq("router-power-curr", 35, gLvOutputCurr, "LvOutputCurr");

  resetValidationHarnessIfNeeded();
}
