/*@!Encoding:65001*/
includes
{
  #include "..\\common\\ValidationHarnessTestCommon.cin"
}

variables
{
  long gTmuLinkState;
  long gTmuServiceMode;
  long gRemoteClimateReq;
  long gSignalBars;
}

on message frmTmuServiceStateMsg
{
  gTmuLinkState = this.TmuLinkState;
  gTmuServiceMode = this.TmuServiceMode;
  gRemoteClimateReq = this.RemoteClimateReq;
  gSignalBars = this.SignalBars;
}

export testcase TC_CANOE_ST_EXT_016_DISPLAY_SERVICE_CONTEXT()
{
  if (!resetValidationHarnessIfNeeded()) { return; }
  if (!launchScenarioAndWait(229, 1300, 1700)) { return; }
  assertIntEq("st-display-service-pass", 1, (long)@Test::scenarioResult, "scenarioResult");
  assertIntEq("st-display-service-link", 2, gTmuLinkState, "TmuLinkState");
  assertIntEq("st-display-service-mode", 1, gTmuServiceMode, "TmuServiceMode");
  assertIntEq("st-display-service-remote", 1, gRemoteClimateReq, "RemoteClimateReq");
  assertIntEq("st-display-service-bars", 4, gSignalBars, "SignalBars");
  if (!resetValidationHarnessIfNeeded()) { return; }
  if (!launchScenarioAndWait(220, 900, 1300)) { return; }
  assertIntEq("st-display-policy-pass", 1, (long)@Test::scenarioResult, "scenarioResult");
  assertIntEq("st-display-policy-theme", 2, (long)@CoreState::themeMode, "themeMode");
  assertIntEq("st-display-policy-popup", 1, (long)@CoreState::popupActive, "popupActive");
  assertIntEq("st-display-policy-priority", 1, (long)@CoreState::popupPriority, "popupPriority");
  assertIntEq("st-display-policy-cluster-sync", 1, (long)@CoreState::clusterSyncState, "clusterSyncState");
  if (!resetValidationHarnessIfNeeded()) { return; }
  if (!launchScenarioAndWait(215, 900, 1300)) { return; }
  assertIntEq("st-audio-policy-pass", 1, (long)@Test::scenarioResult, "scenarioResult");
  assertIntEq("st-audio-policy-focus", 1, (long)@CoreState::audioFocusOwner, "audioFocusOwner");
  assertIntEq("st-audio-policy-ducking", 4, (long)@CoreState::audioDuckingLvl, "audioDuckingLvl");
  assertIntEq("st-audio-policy-volume", 80, (long)@CoreState::volumeLevel, "volumeLevel");
  assertIntEq("st-audio-policy-popup-clear", 0, (long)@CoreState::popupActive, "popupActive");
  resetValidationHarnessIfNeeded();
}
