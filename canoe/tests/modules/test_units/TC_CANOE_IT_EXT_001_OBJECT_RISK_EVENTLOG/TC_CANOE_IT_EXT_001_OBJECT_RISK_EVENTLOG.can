/*@!Encoding:65001*/
includes
{
  #include "..\\common\\ValidationHarnessTestCommon.cin"
}

variables
{
}

export testcase TC_CANOE_IT_EXT_001_OBJECT_RISK_EVENTLOG()
{
  if (!resetValidationHarnessIfNeeded())
  {
    return;
  }

  if (!launchScenarioAndWait(20, 700, 1200))
  {
    return;
  }

  assertIntEq("forward-conflict-pass", 1, (long)@Test::scenarioResult, "scenarioResult");
  assertIntMin("forward-conflict-risk-class", 3, (long)@Core::objectRiskClass, "objectRiskClass");
  assertIntMin("forward-conflict-proximity", 60, (long)@Core::proximityRiskLevel, "proximityRiskLevel");

  if (!resetValidationHarnessIfNeeded())
  {
    return;
  }

  if (!launchScenarioAndWait(21, 700, 1200))
  {
    return;
  }

  assertIntEq("intersection-conflict-pass", 1, (long)@Test::scenarioResult, "scenarioResult");
  assertIntEq("intersection-flag", 1, (long)@Core::intersectionConflictFlag, "intersectionConflictFlag");
  assertIntMin("intersection-risk-class", 3, (long)@Core::objectRiskClass, "objectRiskClass");
  assertIntEq("intersection-alert-type", 5, (long)@Core::selectedAlertType, "selectedAlertType");

  if (!resetValidationHarnessIfNeeded())
  {
    return;
  }

  if (!launchScenarioAndWait(22, 700, 1200))
  {
    return;
  }

  assertIntEq("merge-cutin-pass", 1, (long)@Test::scenarioResult, "scenarioResult");
  assertIntEq("merge-cutin-flag", 1, (long)@Core::mergeCutInFlag, "mergeCutInFlag");
  assertIntMin("merge-cutin-risk-class", 3, (long)@Core::objectRiskClass, "objectRiskClass");
  assertIntEq("merge-cutin-alert-type", 6, (long)@Core::selectedAlertType, "selectedAlertType");

  if (!resetValidationHarnessIfNeeded())
  {
    return;
  }

  if (!launchScenarioAndWait(24, 700, 1200))
  {
    return;
  }

  assertIntEq("confidence-degrade-pass", 1, (long)@Test::scenarioResult, "scenarioResult");
  assertIntEq("confidence-value", 20, (long)@Core::objectConfidence, "objectConfidence");
  assertIntMin("confidence-degrade-failsafe", 1, (long)@Core::failSafeMode, "failSafeMode");
  assertIntEq("confidence-degrade-decel-off", 0, (long)@Core::decelAssistReq, "decelAssistReq");

  if (!resetValidationHarnessIfNeeded())
  {
    return;
  }

  if (!launchScenarioAndWait(25, 1100, 1500))
  {
    return;
  }

  assertIntEq("tracking-loss-pass", 1, (long)@Test::scenarioResult, "scenarioResult");
  assertIntEq("tracking-loss-track-valid", 1, (long)@Core::objectTrackValid, "objectTrackValid");
  assertIntMin("tracking-loss-risk-class", 3, (long)@Core::objectRiskClass, "objectRiskClass");
  assertIntMin("tracking-loss-event-code", 1381, (long)@Core::objectEventCode, "objectEventCode");

  resetValidationHarnessIfNeeded();
}
