/*@!Encoding:65001*/
includes
{
  #include "..\\common\\ValidationHarnessTestCommon.cin"
}

variables
{
}

export testcase TC_CANOE_IT_EXT_001_OBJECT_RISK_EVENTLOG()
{
  if (!resetValidationHarnessIfNeeded())
  {
    return;
  }

  if (!launchScenarioAndWait(20, 700, 1200))
  {
    return;
  }

  assertIntEq("forward-conflict-pass", 1, (long)@Test::scenarioResult, "scenarioResult");
  if (!waitForObservedObjectRisk(800))
  {
    resetValidationHarnessIfNeeded();
    return;
  }
  assertIntMin("forward-conflict-risk-class", 3, (long)@Test::obsObjectRiskClass, "ethObjectRiskClass");
  assertIntMin("forward-conflict-proximity", 60, (long)@Test::obsObjectRiskLevel, "ethObjectRiskLevel");

  if (!resetValidationHarnessIfNeeded())
  {
    return;
  }

  if (!launchScenarioAndWait(21, 700, 1200))
  {
    return;
  }

  assertIntEq("intersection-conflict-pass", 1, (long)@Test::scenarioResult, "scenarioResult");
  if (!waitForObservedObjectRisk(800) ||
      !waitForObservedObjectScenario(800) ||
      !waitForObservedSelectedAlert(800))
  {
    resetValidationHarnessIfNeeded();
    return;
  }
  assertIntEq("intersection-flag", 1, (long)@Test::obsIntersectionConflictFlag, "ethIntersectionConflictFlag");
  assertIntMin("intersection-risk-class", 3, (long)@Test::obsObjectRiskClass, "ethObjectRiskClass");
  assertIntEq("intersection-alert-type", 5, (long)@Test::obsSelectedAlertType, "ethSelectedAlertType");

  if (!resetValidationHarnessIfNeeded())
  {
    return;
  }

  if (!launchScenarioAndWait(22, 700, 1200))
  {
    return;
  }

  assertIntEq("merge-cutin-pass", 1, (long)@Test::scenarioResult, "scenarioResult");
  if (!waitForObservedObjectRisk(800) ||
      !waitForObservedObjectScenario(800) ||
      !waitForObservedSelectedAlert(800))
  {
    resetValidationHarnessIfNeeded();
    return;
  }
  assertIntEq("merge-cutin-flag", 1, (long)@Test::obsMergeCutInFlag, "ethMergeCutInFlag");
  assertIntMin("merge-cutin-risk-class", 3, (long)@Test::obsObjectRiskClass, "ethObjectRiskClass");
  assertIntEq("merge-cutin-alert-type", 6, (long)@Test::obsSelectedAlertType, "ethSelectedAlertType");

  if (!resetValidationHarnessIfNeeded())
  {
    return;
  }

  if (!launchScenarioAndWait(24, 700, 1200))
  {
    return;
  }

  assertIntEq("confidence-degrade-pass", 1, (long)@Test::scenarioResult, "scenarioResult");
  if (!waitForObservedObjectRisk(800) ||
      !waitForObservedFailSafe(800) ||
      !waitForObservedDecelAssist(800))
  {
    resetValidationHarnessIfNeeded();
    return;
  }
  assertIntEq("confidence-value", 20, (long)@Test::obsObjectConfidence, "ethObjectConfidence");
  assertIntMin("confidence-degrade-failsafe", 1, (long)@Test::obsFailSafeMode, "ethFailSafeMode");
  assertIntEq("confidence-degrade-decel-off", 0, (long)@Test::obsDecelAssistReq, "ethDecelAssistReq");

  if (!resetValidationHarnessIfNeeded())
  {
    return;
  }

  if (!launchScenarioAndWait(25, 1100, 1500))
  {
    return;
  }

  assertIntEq("tracking-loss-pass", 1, (long)@Test::scenarioResult, "scenarioResult");
  if (!waitForObservedObjectRisk(800))
  {
    resetValidationHarnessIfNeeded();
    return;
  }
  assertIntEq("tracking-loss-track-valid", 1, (long)@Test::obsObjectTrackValid, "ethObjectTrackValid");
  assertIntMin("tracking-loss-risk-class", 3, (long)@Test::obsObjectRiskClass, "ethObjectRiskClass");
  assertIntMin("tracking-loss-event-code", 1381, (long)@Core::objectEventCode, "objectEventCode");

  resetValidationHarnessIfNeeded();
}
