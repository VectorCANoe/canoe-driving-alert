/*@!Encoding:65001*/
includes
{
  #include "..\\common\\ValidationHarnessTestCommon.cin"
}

variables
{
}

export testcase TC_CANOE_UT_CORE_007_BODY_GW_ROUTE()
{
  if (!resetValidationHarnessIfNeeded())
  {
    return;
  }

  if (!launchScenarioAndWait(208, 800, 1300))
  {
    return;
  }
  assertIntEq("body-gw-school-pass", 1, (long)@Test::scenarioResult, "scenarioResult");
  assertIntEq("body-gw-school-route", 1, (long)@CoreState::routingPolicy, "routingPolicy");
  assertIntEq("body-gw-school-path", 0, (long)@CoreState::warningPathStatus, "warningPathStatus");
  assertIntEq("body-gw-school-color", 3, (long)@Body::ambientColor, "ambientColor");
  assertIntEq("body-gw-school-pattern", 5, (long)@Body::ambientPattern, "ambientPattern");

  if (!resetValidationHarnessIfNeeded())
  {
    return;
  }
  if (!launchScenarioAndWait(4, 800, 1300))
  {
    return;
  }
  assertIntEq("body-gw-emergency-pass", 1, (long)@Test::scenarioResult, "scenarioResult");
  assertIntEq("body-gw-emergency-route", 2, (long)@CoreState::routingPolicy, "routingPolicy");
  assertIntEq("body-gw-emergency-path", 0, (long)@CoreState::warningPathStatus, "warningPathStatus");
  assertIntEq("body-gw-emergency-color", 6, (long)@Body::ambientColor, "ambientColor");
  assertIntEq("body-gw-emergency-pattern", 6, (long)@Body::ambientPattern, "ambientPattern");

  resetValidationHarnessIfNeeded();
}
