/*@!Encoding:65001*/
includes
{
  #include "..\common\ValidationHarnessTestCommon.cin"
}

variables
{
}

export testcase TC_CANOE_ST_018_POLICE_TX_PERIOD()
{
  if (!resetValidationHarnessIfNeeded())
  {
    return;
  }

  if (!launchScenarioAndWait(4, 700, 1200))
  {
    return;
  }

  assertIntEq("eth-police-active-pass", 1, (long)@Test::scenarioResult, "scenarioResult");
  assertIntEq("eth-police-alert-state", 1, (long)@V2X::alertState, "alertState");
  assertIntEq("eth-police-type", 1, (long)@V2X::emergencyType, "emergencyType");
  if (!waitForObservedSelectedAlert(800))
  {
    resetValidationHarnessIfNeeded();
    return;
  }
  assertIntEq("eth-police-level", 6, (long)@Test::obsSelectedAlertLevel, "ethSelectedAlertLevel");

  resetValidationHarnessIfNeeded();
}
