/*@!Encoding:65001*/
includes
{
  #include "..\common\ValidationHarnessTestCommon.cin"
}

variables
{
  int gSeatPassPos;
  int gSeatPassHeatLvl;
}

on message frmSeatPassStateMsg
{
  gSeatPassPos = this.SeatPassPos;
  gSeatPassHeatLvl = this.SeatPassHeatLvl;
}

export testcase TC_CANOE_UT_INP_047_SEAT_PASS_INPUT()
{
  if (!resetValidationHarnessIfNeeded())
  {
    return;
  }

  if (!launchScenarioAndWait(230, 800, 1300))
  {
    return;
  }

  assertIntEq("s230_scenarioResult", 1, (long)@Test::scenarioResult, "scenarioResult");
  assertIntEq("s230_seatPassPos", 0, gSeatPassPos, "seatPassPos");
  assertIntEq("s230_seatPassHeatLvl", 0, gSeatPassHeatLvl, "seatPassHeatLvl");

  resetValidationHarnessIfNeeded();
}
