/*@!Encoding:65001*/
includes
{
  #include "..\common\ValidationHarnessTestCommon.cin"
}

variables
{
  int gSeatPassPos;
  int gSeatPassHeatLvl;
}

on message frmSeatPassStateMsg
{
  gSeatPassPos = this.SeatPassPos;
  gSeatPassHeatLvl = this.SeatPassHeatLvl;
}

export testcase TC_CANOE_UT_INP_047_SEAT_PASS_INPUT()
{
  if (!resetValidationHarnessIfNeeded())
  {
    return;
  }

  gSeatPassPos = -1;
  gSeatPassHeatLvl = -1;
  if (!launchScenarioAndWait(229, 900, 1300))
  {
    return;
  }

  assertIntEq("s229_seatPassPos", 0, gSeatPassPos, "seatPassPos");
  assertIntEq("s229_seatPassHeatLvl", 0, gSeatPassHeatLvl, "seatPassHeatLvl");

  resetValidationHarnessIfNeeded();
}
