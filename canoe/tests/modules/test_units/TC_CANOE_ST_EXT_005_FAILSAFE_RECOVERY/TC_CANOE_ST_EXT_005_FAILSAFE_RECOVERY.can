/*@!Encoding:65001*/
includes
{
  #include "..\\common\\ValidationHarnessTestCommon.cin"
}

variables
{
}

export testcase TC_CANOE_ST_EXT_005_FAILSAFE_RECOVERY()
{
  if (!resetValidationHarnessIfNeeded()) { return; }
  if (!launchScenarioAndWait(201, 1500, 2100)) { return; }
  assertIntEq("st-failsafe-recovery-pass", 1, (long)@Test::scenarioResult, "scenarioResult");
  assertIntEq("st-failsafe-recovery-mode", 0, (long)@Core::failSafeMode, "failSafeMode");
  resetValidationHarnessIfNeeded();
}
