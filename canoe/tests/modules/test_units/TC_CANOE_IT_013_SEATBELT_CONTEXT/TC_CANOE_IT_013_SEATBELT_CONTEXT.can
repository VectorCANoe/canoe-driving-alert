/*@!Encoding:65001*/
includes
{
  #include "..\common\ValidationHarnessTestCommon.cin"
}

variables
{
}

export testcase TC_CANOE_IT_013_SEATBELT_CONTEXT()
{
  if (!resetValidationHarnessIfNeeded())
  {
    return;
  }

  if (!launchScenarioAndWait(214, 900, 1300))
  {
    return;
  }

  assertIntEq("seatbelt-context-pass", 1, (long)@Test::scenarioResult, "scenarioResult");
  assertIntEq("seatbelt-context-level", 5, (long)@Core::selectedAlertLevel, "selectedAlertLevel");
  assertIntEq("seatbelt-context-type", 3, (long)@Core::selectedAlertType, "selectedAlertType");

  resetValidationHarnessIfNeeded();
}
