/*@!Encoding:65001*/
includes
{
  #include "..\\common\\ValidationHarnessTestCommon.cin"
}

variables
{
}

export testcase TC_CANOE_IT_EXT_018_EMERGENCY_PLUS_TTC()
{
  if (!resetValidationHarnessIfNeeded())
  {
    return;
  }

  if (!launchScenarioAndWait(213, 800, 1300))
  {
    return;
  }

  assertIntEq("emergency-plus-ttc-pass", 1, (long)@Test::scenarioResult, "scenarioResult");
  assertIntEq("emergency-plus-ttc-emergency-type", 2, (long)@V2X::emergencyType, "emergencyType");
  if (!waitForObservedDecelAssist(800) ||
      !waitForObservedObjectScenario(800) ||
      !waitForObservedSelectedAlert(800))
  {
    resetValidationHarnessIfNeeded();
    return;
  }
  assertIntEq("emergency-plus-ttc-intersection", 1, (long)@Test::obsIntersectionConflictFlag, "ethIntersectionConflictFlag");
  assertIntEq("emergency-plus-ttc-decel", 1, (long)@Test::obsDecelAssistReq, "ethDecelAssistReq");
  assertIntEq("emergency-plus-ttc-level", 7, (long)@Test::obsSelectedAlertLevel, "ethSelectedAlertLevel");
  assertIntEq("emergency-plus-ttc-type", 2, (long)@Test::obsSelectedAlertType, "ethSelectedAlertType");

  resetValidationHarnessIfNeeded();
}
