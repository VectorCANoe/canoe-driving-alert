/*@!Encoding:65001*/
includes
{
  #include "..\common\ValidationHarnessTestCommon.cin"
}

variables
{
}

export testcase TC_CANOE_IT_033_DUPLICATE_POPUP_SUPPRESSION()
{
  if (!resetValidationHarnessIfNeeded())
  {
    return;
  }

  if (!launchScenarioAndWait(12, 900, 1400))
  {
    return;
  }

  if (!waitForCoreSelectedAlertState(3, 3, 800) ||
      !waitForDuplicatePopupGuard(1, 800))
  {
    resetValidationHarnessIfNeeded();
    return;
  }

  assertIntMin("duplicate-popup-guard", 1, (long)@CoreState::duplicatePopupGuard, "duplicatePopupGuard");

  resetValidationHarnessIfNeeded();
}
