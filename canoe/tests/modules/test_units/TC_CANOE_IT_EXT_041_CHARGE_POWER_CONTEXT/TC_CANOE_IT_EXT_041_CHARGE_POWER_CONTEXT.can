/*@!Encoding:65001*/
includes
{
  #include "..\\common\\ValidationHarnessTestCommon.cin"
}

variables
{
  long gObcState;
  long gAcPlugState;
  long gChargePowerKw;
  long gDcdcMode;
  long gLvOutputVolt;
  long gLvOutputCurr;
  long gEopState;
  long gPumpRpm;
  long gOilPressure;
  long gMcuState;
  long gMotorTorqueCmd;
  long gMotorSpeedRpm;
  long gInverterState;
  long gInvTemp;
  long gDcLinkVolt;
}

on message frmObcStateMsg
{
  gObcState = this.ObcState;
  gAcPlugState = this.AcPlugState;
  gChargePowerKw = this.ChargePowerKw;
}

on message frmDcdcStateMsg
{
  gDcdcMode = this.DcdcMode;
  gLvOutputVolt = this.LvOutputVolt;
  gLvOutputCurr = this.LvOutputCurr;
}

on message frmEopStateMsg
{
  gEopState = this.EopState;
  gPumpRpm = this.PumpRpm;
  gOilPressure = this.OilPressure;
}

on message frmMcuStateMsg
{
  gMcuState = this.McuState;
  gMotorTorqueCmd = this.MotorTorqueCmd;
  gMotorSpeedRpm = this.MotorSpeedRpm;
}

on message frmInverterStateMsg
{
  gInverterState = this.InverterState;
  gInvTemp = this.InvTemp;
  gDcLinkVolt = this.DcLinkVolt;
}

export testcase TC_CANOE_IT_EXT_041_CHARGE_POWER_CONTEXT()
{
  if (!resetValidationHarnessIfNeeded()) { return; }
  if (!launchScenarioAndWait(231, 900, 1300)) { return; }
  assertIntEq("it-charge-pass", 1, (long)@Test::scenarioResult, "scenarioResult");
  assertIntEq("it-charge-obc-state", 2, gObcState, "ObcState");
  assertIntEq("it-charge-plug", 1, gAcPlugState, "AcPlugState");
  assertIntEq("it-charge-kw", 20, gChargePowerKw, "ChargePowerKw");
  assertIntEq("it-charge-dcdc-mode", 2, gDcdcMode, "DcdcMode");
  assertIntEq("it-charge-volt", 140, gLvOutputVolt, "LvOutputVolt");
  assertIntEq("it-charge-curr", 35, gLvOutputCurr, "LvOutputCurr");
  if (!resetValidationHarnessIfNeeded()) { return; }
  if (!launchScenarioAndWait(232, 900, 1300)) { return; }
  assertIntEq("it-propulsion-pass", 1, (long)@Test::scenarioResult, "scenarioResult");
  assertIntEq("it-propulsion-eop-state", 2, gEopState, "EopState");
  assertIntEq("it-propulsion-pump-rpm", 1600, gPumpRpm, "PumpRpm");
  assertIntEq("it-propulsion-oil-pressure", 120, gOilPressure, "OilPressure");
  assertIntEq("it-propulsion-mcu-state", 2, gMcuState, "McuState");
  assertIntEq("it-propulsion-torque", 124, gMotorTorqueCmd, "MotorTorqueCmd");
  assertIntEq("it-propulsion-speed", 4800, gMotorSpeedRpm, "MotorSpeedRpm");
  assertIntEq("it-propulsion-inverter-state", 2, gInverterState, "InverterState");
  assertIntEq("it-propulsion-inv-temp", 71, gInvTemp, "InvTemp");
  assertIntEq("it-propulsion-dc-link", 134, gDcLinkVolt, "DcLinkVolt");
  if (!resetValidationHarnessIfNeeded()) { return; }
  if (!launchScenarioAndWait(237, 900, 1300)) { return; }
  assertIntEq("it-drive-accel-pass", 1, (long)@Test::scenarioResult, "scenarioResult");
  assertIntEq("it-drive-accel-drive-mode", 2, (long)@CoreState::driveMode, "driveMode");
  resetValidationHarnessIfNeeded();
}
