/*@!Encoding:65001*/
includes
{
  #include "..\\common\\ValidationHarnessTestCommon.cin"
}

variables
{
}

export testcase TC_CANOE_ST_CORE_002_NORMAL_DRIVE()
{
  if (!resetValidationHarnessIfNeeded())
  {
    return;
  }

  if (!launchScenarioAndWait(14, 700, 1000))
  {
    return;
  }
  if (!waitForCoreDriveState(3, -1, -1, 800) ||
      !waitForCoreSelectedAlertState(0, 0, 800))
  {
    resetValidationHarnessIfNeeded();
    return;
  }

  assertIntEq("st002-drive-state", 3, (long)@Core::driveStateNorm, "driveStateNorm");
  assertIntEq("st002-boundary", 1, (long)@CoreState::domainBoundaryStatus, "domainBoundaryStatus");
  assertIntEq("st002-routing", 1, (long)@CoreState::routingPolicy, "routingPolicy");
  assertIntEq("st002-level", 0, getCanonicalSelectedAlertLevel(), "selectedAlertLevel");

  resetValidationHarnessIfNeeded();
}
