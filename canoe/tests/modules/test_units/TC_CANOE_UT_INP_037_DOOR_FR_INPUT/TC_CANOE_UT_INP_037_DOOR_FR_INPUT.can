/*@!Encoding:65001*/
includes
{
  #include "..\common\ValidationHarnessTestCommon.cin"
}

variables
{
  int gAutoDoorState;
  int gAutoUnlockState;
  int gDoorApproachScore;
}

on message frmAutoDoorCtrlStateMsg
{
  gAutoDoorState = this.AutoDoorState;
  gAutoUnlockState = this.AutoUnlockState;
  gDoorApproachScore = this.DoorApproachScore;
}

long waitForDoorFrInputState(dword timeoutMs)
{
  dword waitedMs;

  waitedMs = 0;
  while ((gAutoUnlockState != 1 ||
          gDoorApproachScore < 80) &&
         waitedMs < timeoutMs)
  {
    TestWaitForTimeout(50);
    waitedMs += 50;
  }

  if (gAutoUnlockState != 1 ||
      gDoorApproachScore < 80)
  {
    testStepFail("door-fr-input-state", "Door FR input timeout waited=%d unlock=%d score=%d",
                 waitedMs,
                 gAutoUnlockState,
                 gDoorApproachScore);
    return 0;
  }

  return 1;
}

export testcase TC_CANOE_UT_INP_037_DOOR_FR_INPUT()
{
  if (!resetValidationHarnessIfNeeded())
  {
    return;
  }

  if (!launchScenarioAndWait(226, 800, 1300))
  {
    return;
  }

  if (!waitForDoorFrInputState(800))
  {
    resetValidationHarnessIfNeeded();
    return;
  }

  assertIntEq("s226_autoUnlockState", 1, gAutoUnlockState, "autoUnlockState");
  assertIntMin("s226_doorApproachScore", 80, gDoorApproachScore, "doorApproachScore");

  resetValidationHarnessIfNeeded();
}
