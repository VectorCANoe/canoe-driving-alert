/*@!Encoding:65001*/
includes
{
  #include "..\common\ValidationHarnessTestCommon.cin"
}

variables
{
  int gAutoDoorState;
  int gAutoUnlockState;
  int gDoorApproachScore;
}

on message frmAutoDoorCtrlStateMsg
{
  gAutoDoorState = this.AutoDoorState;
  gAutoUnlockState = this.AutoUnlockState;
  gDoorApproachScore = this.DoorApproachScore;
}

export testcase TC_CANOE_UT_INP_037_DOOR_FR_INPUT()
{
  if (!resetValidationHarnessIfNeeded())
  {
    return;
  }

  if (!launchScenarioAndWait(226, 800, 1300))
  {
    return;
  }

  assertIntEq("s226_scenarioResult", 1, (long)@Test::scenarioResult, "scenarioResult");
  assertIntEq("s226_autoUnlockState", 1, gAutoUnlockState, "autoUnlockState");
  assertIntEq("s226_doorApproachScore", 100, gDoorApproachScore, "doorApproachScore");

  resetValidationHarnessIfNeeded();
}
