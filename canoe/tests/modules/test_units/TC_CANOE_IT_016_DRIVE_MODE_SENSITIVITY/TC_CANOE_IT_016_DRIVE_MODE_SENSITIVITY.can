/*@!Encoding:65001*/
includes
{
  #include "..\common\ValidationHarnessTestCommon.cin"
}

variables
{
}

export testcase TC_CANOE_IT_016_DRIVE_MODE_SENSITIVITY()
{
  if (!resetValidationHarnessIfNeeded())
  {
    return;
  }

  if (!launchScenarioAndWait(236, 900, 1300))
  {
    return;
  }

  if (!waitForCoreSelectedAlertState(4, 3, 800) ||
      !waitForCoreSportMode(1, 800))
  {
    resetValidationHarnessIfNeeded();
    return;
  }

  assertIntEq("drive-mode-sport-level", 4, (long)@Core::selectedAlertLevel, "selectedAlertLevel");
  assertIntEq("drive-mode-sport-type", 3, (long)@Core::selectedAlertType, "selectedAlertType");
  assertIntEq("drive-mode-sport-flag", 1, (long)@CoreState::sportMode, "sportMode");

  resetValidationHarnessIfNeeded();
}
