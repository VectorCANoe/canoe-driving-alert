/*@!Encoding:65001*/
includes
{
  #include "..\\common\\ValidationHarnessTestCommon.cin"
}

variables
{
}

export testcase TC_CANOE_ST_CORE_004_BASIC_WARNING_CLEAR()
{
  if (!resetValidationHarnessIfNeeded())
  {
    return;
  }

  if (!launchScenarioAndWait(26, 700, 1000))
  {
    return;
  }

  assertIntEq("st004-active-pass", 1, (long)@Test::scenarioResult, "scenarioResult");
  assertIntEq("st004-active-level", 1, (long)@Core::selectedAlertLevel, "selectedAlertLevel");

  if (!launchScenarioAndWait(1, 700, 1000))
  {
    return;
  }

  assertIntEq("st004-clear-pass", 1, (long)@Test::scenarioResult, "scenarioResult");
  assertIntEq("st004-clear-level", 0, (long)@Core::selectedAlertLevel, "selectedAlertLevel");
  assertIntEq("st004-clear-type", 0, (long)@Core::selectedAlertType, "selectedAlertType");
  assertIntEq("st004-clear-code", 0, (long)@Cluster::warningTextCode, "warningTextCode");
  assertIntEq("st004-clear-failsafe", 0, (long)@Core::failSafeMode, "failSafeMode");

  resetValidationHarnessIfNeeded();
}
