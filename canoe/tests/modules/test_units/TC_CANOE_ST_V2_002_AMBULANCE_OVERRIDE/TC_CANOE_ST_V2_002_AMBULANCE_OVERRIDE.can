/*@!Encoding:65001*/
includes
{
  #include "..\\common\\ValidationHarnessTestCommon.cin"
}

variables
{
}

export testcase TC_CANOE_ST_V2_002_AMBULANCE_OVERRIDE()
{
  if (!resetValidationHarnessIfNeeded())
  {
    return;
  }

  if (!launchScenarioAndWait(223, 800, 1300))
  {
    return;
  }

  assertIntEq("ambulance-override-pass", 1, (long)@Test::scenarioResult, "scenarioResult");
  assertIntEq("ambulance-override-level", 7, (long)@Core::selectedAlertLevel, "selectedAlertLevel");
  assertIntEq("ambulance-override-type", 2, (long)@Core::selectedAlertType, "selectedAlertType");
  assertIntEq("ambulance-override-failsafe", 0, (long)@Core::failSafeMode, "failSafeMode");
  assertIntMin("ambulance-override-arbitration", 1, (long)@CoreState::arbitrationSnapshotId, "arbitrationSnapshotId");

  resetValidationHarnessIfNeeded();
}
