/*@!Encoding:65001*/
includes
{
  #include "..\\common\\ValidationHarnessTestCommon.cin"
}

variables
{
}

/*
  IT_031
  Integration-level external TX path for police emergency propagation.
  Periodicity closure remains Ethernet-trace gated.
*/
export testcase TC_CANOE_IT_ETH_001_POLICE_TX()
{
  if (!resetValidationHarnessIfNeeded())
  {
    return;
  }

  if (!launchScenarioAndWait(4, 700, 1200))
  {
    return;
  }

  assertIntEq("it-police-tx-pass", 1, (long)@Test::scenarioResult, "scenarioResult");
  assertIntEq("it-police-tx-context", 1, (long)@Core::emergencyContext, "emergencyContext");
  assertIntEq("it-police-tx-type", 1, (long)@V2X::emergencyType, "emergencyType");
  assertIntEq("it-police-tx-level", 6, (long)@Core::selectedAlertLevel, "selectedAlertLevel");
  assertIntEq("it-police-tx-code", 101, (long)@Cluster::warningTextCode, "warningTextCode");
  assertIntEq("it-police-tx-failsafe", 0, (long)@Core::failSafeMode, "failSafeMode");

  resetValidationHarnessIfNeeded();
}
