/*@!Encoding:65001*/
includes
{
  #include "..\\common\\ValidationHarnessTestCommon.cin"
}

variables
{
}

export testcase TC_CANOE_IT_BASE_004_BASIC_DISPLAY_UI()
{
  if (!resetValidationHarnessIfNeeded())
  {
    return;
  }

  if (!launchScenarioAndWait(220, 900, 1300))
  {
    return;
  }

  assertIntEq("display-ui-pass", 1, (long)@Test::scenarioResult, "scenarioResult");
  assertIntEq("display-ui-level", 3, (long)@Core::selectedAlertLevel, "selectedAlertLevel");
  assertIntEq("display-ui-type", 3, (long)@Core::selectedAlertType, "selectedAlertType");
  assertIntEq("display-ui-theme", 2, (long)@CoreState::themeMode, "themeMode");
  assertIntEq("display-ui-popup-active", 1, (long)@CoreState::popupActive, "popupActive");
  assertIntEq("display-ui-popup-prio", 1, (long)@CoreState::popupPriority, "popupPriority");
  assertIntEq("display-ui-sync", 1, (long)@CoreState::clusterSyncState, "clusterSyncState");

  resetValidationHarnessIfNeeded();
}