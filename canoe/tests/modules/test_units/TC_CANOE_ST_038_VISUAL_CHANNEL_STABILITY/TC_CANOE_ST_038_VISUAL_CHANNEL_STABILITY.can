/*@!Encoding:65001*/
includes
{
  #include "..\common\ValidationHarnessTestCommon.cin"
}

variables
{
}

export testcase TC_CANOE_ST_038_VISUAL_CHANNEL_STABILITY()
{
  if (!resetValidationHarnessIfNeeded())
  {
    return;
  }

  if (!launchScenarioAndWait(220, 900, 1300))
  {
    return;
  }

  assertIntEq("channel-contention-popup-active", 1, (long)@CoreState::popupActive, "popupActive");
  assertIntMin("channel-contention-popup-priority", 1, (long)@CoreState::popupPriority, "popupPriority");
  assertIntEq("channel-contention-cluster-sync", 1, (long)@CoreState::clusterSyncState, "clusterSyncState");
  assertIntEq("channel-contention-failsafe", 0, (long)@Core::failSafeMode, "failSafeMode");

  resetValidationHarnessIfNeeded();
}
