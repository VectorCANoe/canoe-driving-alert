/*@!Encoding:65001*/
includes
{
  #include "..\\common\\ValidationHarnessTestCommon.cin"
}

variables
{
}

export testcase TC_CANOE_ST_EXT_007_LATERAL_OBJECT_RISK()
{
  if (!resetValidationHarnessIfNeeded())
  {
    return;
  }

  if (!launchScenarioAndWait(21, 700, 1200))
  {
    return;
  }

  assertIntEq("lateral-object-pass", 1, (long)@Test::scenarioResult, "scenarioResult");
  assertIntEq("lateral-object-intersection-flag", 1, (long)@Core::intersectionConflictFlag, "intersectionConflictFlag");
  assertIntMin("lateral-object-risk-class", 3, (long)@Core::objectRiskClass, "objectRiskClass");
  assertIntEq("lateral-object-alert-type", 5, (long)@Core::selectedAlertType, "selectedAlertType");
  assertIntEq("lateral-object-failsafe", 0, (long)@Core::failSafeMode, "failSafeMode");

  resetValidationHarnessIfNeeded();
}
