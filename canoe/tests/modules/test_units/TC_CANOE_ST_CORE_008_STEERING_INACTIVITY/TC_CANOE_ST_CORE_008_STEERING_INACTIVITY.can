/*@!Encoding:65001*/
includes
{
  #include "..\\common\\ValidationHarnessTestCommon.cin"
}

variables
{
}

export testcase TC_CANOE_ST_CORE_008_STEERING_INACTIVITY()
{
  if (!resetValidationHarnessIfNeeded())
  {
    return;
  }

  if (!launchScenarioAndWait(244, 900, 1300))
  {
    return;
  }

  assertIntEq("st008-highway-baseline-pass", 1, (long)@Test::scenarioResult, "scenarioResult");
  assertIntEq("st008-highway-zone", 2, (long)@Core::baseZoneContext, "baseZoneContext");
  assertIntEq("st008-highway-level", 0, (long)@Core::selectedAlertLevel, "selectedAlertLevel");

  if (!launchScenarioAndWait(3, 11000, 11600))
  {
    return;
  }

  assertIntEq("st008-trigger-pass", 1, (long)@Test::scenarioResult, "scenarioResult");
  assertIntEq("st008-trigger-level", 2, (long)@Core::selectedAlertLevel, "selectedAlertLevel");
  assertIntEq("st008-trigger-type", 4, (long)@Core::selectedAlertType, "selectedAlertType");

  if (!launchScenarioAndWait(244, 900, 1300))
  {
    return;
  }

  assertIntEq("st008-clear-pass", 1, (long)@Test::scenarioResult, "scenarioResult");
  assertIntEq("st008-clear-level", 0, (long)@Core::selectedAlertLevel, "selectedAlertLevel");
  assertIntEq("st008-clear-type", 0, (long)@Core::selectedAlertType, "selectedAlertType");

  resetValidationHarnessIfNeeded();
}
