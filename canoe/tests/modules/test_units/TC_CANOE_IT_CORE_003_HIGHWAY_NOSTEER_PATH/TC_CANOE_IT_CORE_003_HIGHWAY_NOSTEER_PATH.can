/*@!Encoding:65001*/
includes
{
  #include "..\\common\\ValidationHarnessTestCommon.cin"
}

variables
{
}

export testcase TC_CANOE_IT_CORE_003_HIGHWAY_NOSTEER_PATH()
{
  if (!resetValidationHarnessIfNeeded())
  {
    return;
  }

  if (!launchScenarioAndWait(3, 11000, 11600))
  {
    return;
  }

  if (!waitForNavContextState(2, -1, 800) ||
      !waitForCoreSelectedAlertState(2, 4, 800))
  {
    resetValidationHarnessIfNeeded();
    return;
  }

  assertIntEq("selected-alert-level", 2, getCanonicalSelectedAlertLevel(), "selectedAlertLevel");
  assertIntEq("selected-alert-type", 4, getCanonicalSelectedAlertType(), "selectedAlertType");
  assertIntEq("ambient-color", 4, (long)@Body::ambientColor, "ambientColor");
  assertIntEq("ambient-pattern", 4, (long)@Body::ambientPattern, "ambientPattern");

  resetValidationHarnessIfNeeded();
}
