/*@!Encoding:65001*/
includes
{
  #include "..\\common\\ValidationHarnessTestCommon.cin"
}

variables
{
}

export testcase TC_CANOE_IT_CORE_003_HIGHWAY_NOSTEER_PATH()
{
  if (!resetValidationHarnessIfNeeded())
  {
    return;
  }

  if (!launchScenarioAndWait(3, 11000, 11600))
  {
    return;
  }

  assertIntEq("scenario-pass", 1, (long)@Test::scenarioResult, "scenarioResult");
  assertIntEq("selected-alert-level", 2, (long)@Core::selectedAlertLevel, "selectedAlertLevel");
  assertIntEq("selected-alert-type", 4, (long)@Core::selectedAlertType, "selectedAlertType");
  assertIntEq("ambient-color", 4, (long)@Body::ambientColor, "ambientColor");
  assertIntEq("ambient-pattern", 4, (long)@Body::ambientPattern, "ambientPattern");

  resetValidationHarnessIfNeeded();
}
