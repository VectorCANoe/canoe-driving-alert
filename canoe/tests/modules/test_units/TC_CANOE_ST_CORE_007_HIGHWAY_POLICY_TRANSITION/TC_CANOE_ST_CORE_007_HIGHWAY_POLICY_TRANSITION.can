/*@!Encoding:65001*/
includes
{
  #include "..\\common\\ValidationHarnessTestCommon.cin"
}

variables
{
}

export testcase TC_CANOE_ST_CORE_007_HIGHWAY_POLICY_TRANSITION()
{
  if (!resetValidationHarnessIfNeeded())
  {
    return;
  }

  if (!launchScenarioAndWait(14, 700, 1000))
  {
    return;
  }

  if (!waitForNavContextState(0, -1, 800) ||
      !waitForCoreSelectedAlertState(0, 0, 800))
  {
    resetValidationHarnessIfNeeded();
    return;
  }

  assertIntEq("st007-normal-zone", 0, (long)@Core::baseZoneContext, "baseZoneContext");

  if (!launchScenarioAndWait(244, 900, 1300))
  {
    return;
  }

  if (!waitForNavContextState(2, -1, 800) ||
      !waitForCoreSelectedAlertState(0, 0, 800) ||
      !waitForCoreDriveState(-1, -1, 0, 800))
  {
    resetValidationHarnessIfNeeded();
    return;
  }

  assertIntEq("st007-highway-zone", 2, (long)@Core::baseZoneContext, "baseZoneContext");
  assertIntEq("st007-level", 0, getCanonicalSelectedAlertLevel(), "selectedAlertLevel");
  assertIntEq("st007-type", 0, getCanonicalSelectedAlertType(), "selectedAlertType");
  assertIntEq("st007-failsafe", 0, (long)@Core::failSafeMode, "failSafeMode");

  resetValidationHarnessIfNeeded();
}
