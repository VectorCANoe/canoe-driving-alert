/*@!Encoding:65001*/
includes
{
  #include "..\\common\\ValidationHarnessTestCommon.cin"
}

variables
{
}

export testcase TC_CANOE_ST_V2_008_TIMEOUT_CLEAR()
{
  if (!resetValidationHarnessIfNeeded())
  {
    return;
  }

  if (!launchScenarioAndWait(35, 1800, 2300))
  {
    return;
  }

  assertIntEq("timeout-clear-pass", 1, (long)@Test::scenarioResult, "scenarioResult");
  if (!waitForObservedEmergencyContext(800) ||
      !waitForObservedSelectedAlert(800) ||
      !waitForObservedFailSafe(800))
  {
    resetValidationHarnessIfNeeded();
    return;
  }
  assertIntEq("timeout-clear-level", 3, (long)@Test::obsSelectedAlertLevel, "ethSelectedAlertLevel");
  assertIntEq("timeout-clear-type", 3, (long)@Test::obsSelectedAlertType, "ethSelectedAlertType");
  assertIntEq("timeout-clear-emergency-context", 0, (long)@Test::obsEmergencyContext, "ethEmergencyContext");
  assertIntEq("timeout-clear-failsafe", 0, (long)@Test::obsFailSafeMode, "ethFailSafeMode");

  resetValidationHarnessIfNeeded();
}
