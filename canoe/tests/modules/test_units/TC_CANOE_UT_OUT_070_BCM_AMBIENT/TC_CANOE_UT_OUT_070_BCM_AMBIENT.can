/*@!Encoding:65001*/
includes
{
  #include "..\\common\\ValidationHarnessTestCommon.cin"
}

variables
{
}

export testcase TC_CANOE_UT_OUT_070_BCM_AMBIENT()
{
  if (!resetValidationHarnessIfNeeded())
  {
    return;
  }

  if (!launchScenarioAndWait(208, 700, 1200))
  {
    return;
  }

  assertIntEq("ambient-schoolzone-pass", 1, (long)@Test::scenarioResult, "scenarioResult");
  assertIntEq("ambient-schoolzone-level", 3, (long)@Core::selectedAlertLevel, "selectedAlertLevel");
  assertIntEq("ambient-schoolzone-type", 3, (long)@Core::selectedAlertType, "selectedAlertType");
  assertIntEq("ambient-schoolzone-color", 3, (long)@Body::ambientColor, "ambientColor");
  assertIntEq("ambient-schoolzone-pattern", 5, (long)@Body::ambientPattern, "ambientPattern");

  if (!resetValidationHarnessIfNeeded())
  {
    return;
  }

  if (!launchScenarioAndWait(4, 700, 1200))
  {
    return;
  }

  assertIntEq("ambient-emergency-pass", 1, (long)@Test::scenarioResult, "scenarioResult");
  assertIntEq("ambient-emergency-level", 6, (long)@Core::selectedAlertLevel, "selectedAlertLevel");
  assertIntEq("ambient-emergency-type", 1, (long)@Core::selectedAlertType, "selectedAlertType");
  assertIntEq("ambient-emergency-color", 6, (long)@Body::ambientColor, "ambientColor");
  assertIntEq("ambient-emergency-pattern", 6, (long)@Body::ambientPattern, "ambientPattern");

  resetValidationHarnessIfNeeded();
}
