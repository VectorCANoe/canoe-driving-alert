/*@!Encoding:65001*/
includes
{
  #include "..\\common\\ValidationHarnessTestCommon.cin"
}

variables
{
  long gDoorFlLockState;
  long gDoorFrLockState;
  long gDoorFlOpenState;
  long gDoorFrOpenState;
}

on message frmDoorFlStateMsg
{
  gDoorFlLockState = this.DoorFlLockState;
  gDoorFlOpenState = this.DoorFlOpenState;
}

on message frmDoorFrStateMsg
{
  gDoorFrLockState = this.DoorFrLockState;
  gDoorFrOpenState = this.DoorFrOpenState;
}

export testcase TC_CANOE_IT_EXT_014_BODY_CONTROL_LOCK()
{
  if (!resetValidationHarnessIfNeeded()) { return; }
  if (!launchScenarioAndWait(226, 900, 1300)) { return; }

  assertIntEq("it-body-lock-pass", 1, (long)@Test::scenarioResult, "scenarioResult");
  assertIntEq("it-body-lock-fl", 0, gDoorFlLockState, "DoorFlLockState");
  assertIntEq("it-body-lock-fr", 1, gDoorFrLockState, "DoorFrLockState");
  assertIntEq("it-body-open-fl", 1, gDoorFlOpenState, "DoorFlOpenState");
  assertIntEq("it-body-open-fr", 0, gDoorFrOpenState, "DoorFrOpenState");

  resetValidationHarnessIfNeeded();
}
