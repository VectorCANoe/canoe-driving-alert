/*@!Encoding:65001*/
includes
{
  #include "..\\common\\ValidationHarnessTestCommon.cin"
}

variables
{
  long gRideHeightMode;
  long gFrontHeight;
  long gRearHeight;
  long gCdcMode;
  long gValveCurrent;
}

on message frmAirSuspensionStateMsg
{
  gRideHeightMode = this.RideHeightMode;
  gFrontHeight = this.FrontHeight;
  gRearHeight = this.RearHeight;
}

on message frmCdcStateMsg
{
  gCdcMode = this.CdcMode;
  gValveCurrent = this.CdcValveCurrent;
}

export testcase TC_CANOE_UT_EXT_005_CHS_DYNAMICS_EXT()
{
  if (!resetValidationHarnessIfNeeded())
  {
    return;
  }

  gRideHeightMode = -1;
  gFrontHeight = -1;
  gRearHeight = -1;
  gCdcMode = -1;
  gValveCurrent = -1;
  if (!launchScenarioAndWait(225, 1500, 350))
  {
    return;
  }
  assertIntEq("chs-dyn-ack", 225, (long)@Test::scenarioCommandAck, "scenarioCommandAck");
  assertIntEq("chs-dyn-ride-mode", 3, gRideHeightMode, "RideHeightMode");
  assertIntEq("chs-dyn-front-height", 122, gFrontHeight, "FrontHeight");
  assertIntEq("chs-dyn-rear-height", 122, gRearHeight, "RearHeight");
  assertIntEq("chs-dyn-cdc-mode", 2, gCdcMode, "CdcMode");
  assertIntEq("chs-dyn-cdc-current", 160, gValveCurrent, "CdcValveCurrent");

  resetValidationHarnessIfNeeded();
}
