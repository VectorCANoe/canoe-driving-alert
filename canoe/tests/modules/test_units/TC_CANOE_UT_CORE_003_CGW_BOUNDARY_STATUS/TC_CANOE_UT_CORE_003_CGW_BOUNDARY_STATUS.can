/*@!Encoding:65001*/
includes
{
  #include "..\\common\\ValidationHarnessTestCommon.cin"
}

variables
{
}

export testcase TC_CANOE_UT_CORE_003_CGW_BOUNDARY_STATUS()
{
  if (!resetValidationHarnessIfNeeded())
  {
    return;
  }

  if (!launchScenarioAndWait(206, 700, 1200))
  {
    return;
  }
  if (!waitForCoreBoundaryState(1, 1, -1, 0, 800))
  {
    resetValidationHarnessIfNeeded();
    return;
  }

  assertIntEq("boundary-status", 1, (long)@CoreState::domainBoundaryStatus, "domainBoundaryStatus");
  assertIntEq("routing-policy", 1, (long)@CoreState::routingPolicy, "routingPolicy");
  assertIntEq("selected-alert-level", 0, (long)@Core::selectedAlertLevel, "selectedAlertLevel");
  assertIntEq("fail-safe-clear", 0, (long)@Core::failSafeMode, "failSafeMode");

  resetValidationHarnessIfNeeded();
}
