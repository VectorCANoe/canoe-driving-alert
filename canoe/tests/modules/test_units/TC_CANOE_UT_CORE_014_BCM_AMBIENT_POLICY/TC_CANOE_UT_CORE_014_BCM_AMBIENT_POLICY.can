/*@!Encoding:65001*/
includes
{
  #include "..\\common\\ValidationHarnessTestCommon.cin"
}

variables
{
}

export testcase TC_CANOE_UT_CORE_014_BCM_AMBIENT_POLICY()
{
  if (!resetValidationHarnessIfNeeded())
  {
    return;
  }

  if (!launchScenarioAndWait(208, 700, 1200))
  {
    return;
  }

  if (!waitForNavContextState(1, 30, 800) ||
      !waitForAmbientStateMinLevel(3, 3, 3, 5, 800) ||
      !waitForCoreDriveState(-1, -1, 0, 800))
  {
    resetValidationHarnessIfNeeded();
    return;
  }

  assertIntMin("selected-alert-level", 3, getCanonicalSelectedAlertLevel(), "selectedAlertLevel");
  assertIntEq("selected-alert-type", 3, getCanonicalSelectedAlertType(), "selectedAlertType");
  assertIntEq("ambient-color", 3, (long)@Body::ambientColor, "ambientColor");
  assertIntEq("ambient-pattern", 5, (long)@Body::ambientPattern, "ambientPattern");
  assertIntEq("fail-safe-clear", 0, (long)@Core::failSafeMode, "failSafeMode");

  resetValidationHarnessIfNeeded();
}
