/*@@=================================================================
 * CANoe CAPL Node: ESP (Electronic Stability Program)
 *==================================================================@@*/

includes {}

variables
{
  float gWheelSpeed_FL = 0.0;
  float gWheelSpeed_FR = 0.0;
  float gWheelSpeed_RL = 0.0;
  float gWheelSpeed_RR = 0.0;

  float gYawRate = 0.0;
  float gLateralAccel = 0.0;
  float gBrakePressure = 0.0;
  int gESP_Active = 0;

  byte gAliveCounter_Sensors = 0;

  msTimer tVehicleDynamics;
  msTimer tSensors;
}

on start
{
  write("ESP (Electronic Stability Program) Started");
  setTimer(tVehicleDynamics, 10);  // 10ms
  setTimer(tSensors, 10);          // 10ms
}

on timer tVehicleDynamics
{
  message ESP_VehicleDynamics msg;

  msg.Wheel_Speed_FL = gWheelSpeed_FL;
  msg.Wheel_Speed_FR = gWheelSpeed_FR;
  msg.Wheel_Speed_RL = gWheelSpeed_RL;
  msg.Wheel_Speed_RR = gWheelSpeed_RR;

  output(msg);
  setTimer(tVehicleDynamics, 10);
}

on timer tSensors
{
  message ESP_Sensors msg;

  msg.Yaw_Rate = gYawRate;
  msg.Lateral_Accel = gLateralAccel;
  msg.Brake_Pressure = gBrakePressure;
  msg.ESP_Active = gESP_Active;
  msg.AliveCounter = gAliveCounter_Sensors;
  msg.Checksum = 0;

  gAliveCounter_Sensors = (gAliveCounter_Sensors + 1) & 0x0F;

  output(msg);
  setTimer(tSensors, 10);
}

on message EMS_EngineStatus
{
  // Sync wheel speeds with vehicle speed
  float speed = this.Vehicle_Speed;
  gWheelSpeed_FL = speed;
  gWheelSpeed_FR = speed;
  gWheelSpeed_RL = speed;
  gWheelSpeed_RR = speed;
}

on stopMeasurement
{
  cancelTimer(tVehicleDynamics);
  cancelTimer(tSensors);
}
