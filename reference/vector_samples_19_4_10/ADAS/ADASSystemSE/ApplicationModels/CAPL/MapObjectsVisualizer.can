/*@!Encoding:1252*/
includes
{  
  #include "ScenarioControl.cin"
}

variables
{ 
  enum EnumFigures
  {
    Square    = 1,
    Rectangle = 2,
    Ellipse   = 3,
    Cross     = 4,
    Triangle  = 5,
    Line      = 6,
    Bitmap    = 7,
    Text      = 8,
    Vehicle   = 9
  };

  struct Vehicle
  {
    long   handle;
    long   handleText;
    char   name[40];
    double x, y;
  };
  
  struct Vehicle mEgoVehicle;
  struct Vehicle mBrakingVehicle;
  struct Vehicle mEmergencyVehicle;
  
  struct Vehicle mVehicles[long];
}

on start
{
  // Set timer for scenario control
  setTimerCyclic(scenarioDurationTimer, 1000);
  
  init_vehicle(mEgoVehicle, "EgoVehicle");
  init_vehicle(mBrakingVehicle, "BrakingVehicle");
  init_vehicle(mEmergencyVehicle, "EmergencyVehicle");
   
  SetMapObjectFillColor(mEgoVehicle.handle, makeRGB(0, 255, 0));
  SetMapObjectFillColor(mBrakingVehicle.handle , makeRGB(255, 0, 0));
  SetMapObjectFillColor(mEmergencyVehicle.handle, makeRGB(0, 0, 255));
}

void init_vehicle(struct Vehicle vehicle, char text[])
{
  vehicle.handle = CreateMapObject(Vehicle);
  vehicle.handleText = CreateMapObject(Text);
  
  strncpy(vehicle.name, text, elCount(vehicle.name));
  
  memcpy(mVehicles[vehicle.handle], vehicle);
  
  SetMapObjectText(vehicle.handleText, text);
}

void draw_vehicle(struct Vehicle vehicle, double pos_y, double pos_x, double heading)
{
  SetMapObjectPosition(vehicle.handle, pos_y, pos_x);
  SetMapObjectPosition(vehicle.handleText, pos_y - 0.0001, pos_x);
  SetMapObjectHeading(vehicle.handle, heading);
  
  vehicle.x = pos_x;
  vehicle.y = pos_y;
  
  memcpy(mVehicles[vehicle.handle], vehicle);
  
  DrawMapObject(vehicle.handle);  
  DrawMapObject(vehicle.handleText);
}

on value_update EgoVehicle.geo_data
{
  draw_vehicle(mEgoVehicle, $EgoVehicle.geo_data.position.latitude, $EgoVehicle.geo_data.position.longitude ,$EgoVehicle.geo_data.heading);
}

on value_update BrakingVehicle.geo_data
{
  draw_vehicle(mBrakingVehicle, $BrakingVehicle.geo_data.position.latitude, $BrakingVehicle.geo_data.position.longitude ,$BrakingVehicle.geo_data.heading);
}

on value_update EmergencyVehicle.geo_data
{
  draw_vehicle(mEmergencyVehicle, $EmergencyVehicle.geo_data.position.latitude, $EmergencyVehicle.geo_data.position.longitude ,$EmergencyVehicle.geo_data.heading);
}