AUTOSAR XML (schema 4-3-0)
standard types defined: UInt32, UInt8, UInt16, UInt64, Float32, Float64
package /Cluster
  ethernet cluster ADASNetwork: baudrate=100000000, protocol-name=ETHERNET
    ethernet physical channel ADAS: comm-connectors=[ConsumerA/ADAS, ProviderA/ADAS]
      pdu triggering SD_MC_AEP_TRG: pdu=SD_PDU, from ProviderA ConsumerA, to ProviderA ConsumerA
      pdu triggering DetectedLaneBoundaries_Trg0: pdu=DetectedLaneBoundaries, from ProviderA, to ConsumerA
      pdu triggering DetectedLanes_Trg0: pdu=DetectedLanes, from ProviderA, to ConsumerA
      4 x network endpoint:
        ConsumerA_NEP: network-endpoint-addresses=ipv-4-configuration={ipv-4-address=192.168.0.150, ipv-4-address-source=FIXED, network-mask=255.255.255.0}
        ProviderA_NEP: network-endpoint-addresses=ipv-4-configuration={ipv-4-address=192.168.0.100, ipv-4-address-source=FIXED, network-mask=255.255.255.0}
        SD_MC_NEP: network-endpoint-addresses=ipv-4-configuration={ipv-4-address=239.0.0.1, ipv-4-address-source=FIXED, network-mask=255.255.255.0}
        SOMEIP_MC_NEP: network-endpoint-addresses=ipv-4-configuration={ipv-4-address=239.0.0.2, ipv-4-address-source=FIXED, network-mask=255.255.255.0}
      so-ad-config:
        socket connection bundle SD_MC_AEP_BNDL: bundled-connections=[ProviderA_SOMEIP_SD_AEP, ConsumerA_SOMEIP_SD_AEP], pdus=socket-connection-ipdu-identifier={header-id=4294934784, pdu-triggering=SD_MC_AEP_TRG}, server-port=SD_MC_AEP
        socket connection bundle LaneDetectionPSI1: socket-connection=ConsumerA_SOMEIP_AEP, server-port=ProviderA_SOMEIP_AEP
          pdus:
            header-id=655392769, pdu-triggering=DetectedLanes_Trg0, routing-group=ADASLaneDetectionPSI1AllEvg
            header-id=655392770, pdu-triggering=DetectedLaneBoundaries_Trg0, routing-group=ADASLaneDetectionPSI1AllEvg
        socket connection bundle LaneDetectionCSI1: socket-connection=ProviderA_SOMEIP_AEP, server-port=ConsumerA_SOMEIP_AEP
        6 x socket address:
          ConsumerA_SOMEIP_SD_AEP: connector=ConsumerA/ADAS
            application endpoint ConsumerA_SOMEIP_SD_AEP: network-endpoint=ConsumerA_NEP, tp-configuration=udp-tp=udp-tp-port=port-number=30490
          ConsumerA_SOMEIP_AEP: connector=ConsumerA/ADAS
            application endpoint ConsumerA_SOMEIP_AEP: network-endpoint=ConsumerA_NEP, tp-configuration=udp-tp=udp-tp-port=port-number=30500
              consumed service instance LaneDetectionCSI1: routing-group=ADAS_LaneDetectionPSI1, provided-service-instance=LaneDetectionPSI1, sd-client-config={client-service-major-version=1, client-service-minor-version=0, initial-find-behavior={initial-delay-max-value=0.1, initial-delay-min-value=0.005, initial-repetitions-base-delay=0, initial-repetitions-max=0}, ttl=300}
                consumed event group AllEvg: application-endpoint=SOMEIP_MC_AEP, event-group-identifier=1, routing-group=ADASLaneDetectionPSI1AllEvg
          ProviderA_SOMEIP_SD_AEP: connector=ProviderA/ADAS
            application endpoint ProviderA_SOMEIP_SD_AEP: network-endpoint=ProviderA_NEP, tp-configuration=udp-tp=udp-tp-port=port-number=30490
          ProviderA_SOMEIP_AEP: connector=ProviderA/ADAS
            application endpoint ProviderA_SOMEIP_AEP: network-endpoint=ProviderA_NEP, tp-configuration=udp-tp=udp-tp-port=port-number=30500
              provided service instance LaneDetectionPSI1: routing-group=ADAS_LaneDetectionPSI1, instance-identifier=1, sd-server-config={initial-offer-behavior={initial-delay-max-value=0.1, initial-delay-min-value=0.01, initial-repetitions-base-delay=0, initial-repetitions-max=0}, offer-cyclic-delay=0, request-response-delay={max-value=0.2, min-value=0.01}, server-service-major-version=1, server-service-minor-version=0, ttl=300}, service-identifier=10000
                event handler AllEvg: application-endpoint=ProviderA_SOMEIP_AEP, consumed-event-group=AllEvg, multicast-threshold=1
          SD_MC_AEP: multicast-connector=[ConsumerA/ADAS, ProviderA/ADAS]
            application endpoint SD_MC_AEP: network-endpoint=SD_MC_NEP, tp-configuration=udp-tp=udp-tp-port=port-number=30490
          SOMEIP_MC_AEP: multicast-connector=[ConsumerA/ADAS, ProviderA/ADAS]
            application endpoint SOMEIP_MC_AEP: network-endpoint=SOMEIP_MC_NEP, tp-configuration=udp-tp=udp-tp-port=port-number=30500
package /ECU
  ecu instance ProviderA
    ethernet communication controller ProviderA_ADASNetwork: mac-unicast-address=02:00:00:00:00:64
    ethernet communication connector ADAS: comm-controller=ProviderA_ADASNetwork, network-endpoint=[ProviderA_NEP, SD_MC_NEP, SOMEIP_MC_NEP]
  ecu instance ConsumerA
    ethernet communication controller ConsumerA_ADASNetwork: mac-unicast-address=02:00:00:00:00:96
    ethernet communication connector ADAS: comm-controller=ConsumerA_ADASNetwork, network-endpoint=[ConsumerA_NEP, SD_MC_NEP, SOMEIP_MC_NEP]
package /PDU
  general purpose pdu SD_PDU: category=SD, length=1472
  pdu DetectedLaneBoundaries: length=16, unused-bit-pattern=0
    signal DetectedLaneBoundaries: start 0, 128 bit, little-endian, data-transformations=SOMEIPData, data-type-policy=TRANSFORMING-I-SIGNAL, someip-transformation-i-signal-props{transformer=SOMEIP, interface-version=1, size-of-array-length-fields=4, size-of-struct-length-fields=4, size-of-union-length-fields=4}, transfer-property=TRIGGERED, to ConsumerA
  pdu DetectedLanes: length=16, unused-bit-pattern=0
    signal DetectedLanes: start 0, 128 bit, little-endian, data-transformations=SOMEIPData, data-type-policy=TRANSFORMING-I-SIGNAL, someip-transformation-i-signal-props{transformer=SOMEIP, interface-version=1, size-of-array-length-fields=4, size-of-struct-length-fields=4, size-of-union-length-fields=4}, transfer-property=TRIGGERED, to ConsumerA
package /SystemMapping
  system System
    system mapping SystemMapping
      data-mappings:
        event-handler=AllEvg, service-instance=LaneDetectionPSI1, data-element=DetectedLanes, system-signal=DetectedLanes
        event-handler=AllEvg, service-instance=LaneDetectionPSI1, data-element=DetectedLaneBoundaries, system-signal=DetectedLaneBoundaries
  sender receiver interface SenderReceiver
    data DetectedLaneBoundaries: type=DetectedLaneBoundariesEvt
    data DetectedLanes: type=DetectedLanesEvt
package /ServiceInterface
  collection LaneDetection: category=SET, element-role=SO_SERVICE_INTERFACE, element=[DetectedLanes, DetectedLaneBoundaries]
package /ADT
  application record data type DetectedLaneBoundariesEvt: category=STRUCTURE
    application record element Lane: category=ARRAY, type=DetectedLaneBoundaries_Lane_ARRAYDT
  application record data type DetectedLanesEvt: category=STRUCTURE
    application record element Lane: category=ARRAY, type=DetectedLanes_Lane_ARRAYDT
  4 x application array data type, all with category=ARRAY:
    DetectedLaneBoundaries_Lane_ARRAYDT
      element Lane1: category=STRUCTURE, type=Lane1, array-size-handling=ALL-INDICES-SAME-ARRAY-SIZE, array-size-semantics=VARIABLE-SIZE, max-number-of-elements=20
    Lane1_Segment_ARRAYDT
      element Segment1: category=STRUCTURE, type=Segment1, array-size-handling=ALL-INDICES-SAME-ARRAY-SIZE, array-size-semantics=VARIABLE-SIZE, max-number-of-elements=40
    DetectedLanes_Lane_ARRAYDT
      element Lane0: category=STRUCTURE, type=Lane0, array-size-handling=ALL-INDICES-SAME-ARRAY-SIZE, array-size-semantics=VARIABLE-SIZE, max-number-of-elements=20
    Lane0_Segment_ARRAYDT
      element Segment0: category=STRUCTURE, type=Segment0, array-size-handling=ALL-INDICES-SAME-ARRAY-SIZE, array-size-semantics=VARIABLE-SIZE, max-number-of-elements=40
  4 x application record data type, all with category=STRUCTURE:
    Lane1
      application record element ID: category=VALUE, type=UInt32
      application record element Segment: category=ARRAY, type=Lane1_Segment_ARRAYDT
    Segment1
      application record element X: category=VALUE, type=Distance
      application record element Y: category=VALUE, type=Distance
      application record element Z: category=VALUE, type=Distance
    Lane0
      application record element ID: category=VALUE, type=UInt32
      application record element Segment: category=ARRAY, type=Lane0_Segment_ARRAYDT
    Segment0
      application record element X: category=VALUE, type=Distance
      application record element Y: category=VALUE, type=Distance
      application record element Z: category=VALUE, type=Distance
  app type UInt32: category=VALUE, base-type=UInt32
  app type Distance: category=VALUE, base-type=Int32
package /IDT
  11 x impl type:
    DetectedLaneBoundariesEvt: category=STRUCTURE
      element Lane: implementation-data-type=DetectedLaneBoundaries_Lane_ARRAYDT
    DetectedLanesEvt: category=STRUCTURE
      element Lane: implementation-data-type=DetectedLanes_Lane_ARRAYDT
    Distance: category=VALUE, base-type=Int32, compu {phys=raw*0.01; unit m}
    Lane1: category=STRUCTURE
      element ID: implementation-data-type=UInt32
      element Segment: implementation-data-type=Lane1_Segment_ARRAYDT
    Segment1: category=STRUCTURE
      element X: implementation-data-type=Distance
      element Y: implementation-data-type=Distance
      element Z: implementation-data-type=Distance
    Lane0: category=STRUCTURE
      element ID: implementation-data-type=UInt32
      element Segment: implementation-data-type=Lane0_Segment_ARRAYDT
    Segment0: category=STRUCTURE
      element X: implementation-data-type=Distance
      element Y: implementation-data-type=Distance
      element Z: implementation-data-type=Distance
    DetectedLaneBoundaries_Lane_ARRAYDT: category=STRUCTURE, dynamic-array-size-profile=VSA_LINEAR
      element Size: category=TYPE_REFERENCE, base-type=UInt32
      element Payload: category=ARRAY
        element Lane1: array-size=20, array-size-semantics=VARIABLE-SIZE, implementation-data-type=Lane1
    Lane1_Segment_ARRAYDT: category=STRUCTURE, dynamic-array-size-profile=VSA_LINEAR
      element Size: category=TYPE_REFERENCE, base-type=UInt32
      element Payload: category=ARRAY
        element Segment1: array-size=40, array-size-semantics=VARIABLE-SIZE, implementation-data-type=Segment1
    DetectedLanes_Lane_ARRAYDT: category=STRUCTURE, dynamic-array-size-profile=VSA_LINEAR
      element Size: category=TYPE_REFERENCE, base-type=UInt32
      element Payload: category=ARRAY
        element Lane0: array-size=20, array-size-semantics=VARIABLE-SIZE, implementation-data-type=Lane0
    Lane0_Segment_ARRAYDT: category=STRUCTURE, dynamic-array-size-profile=VSA_LINEAR
      element Size: category=TYPE_REFERENCE, base-type=UInt32
      element Payload: category=ARRAY
        element Segment0: array-size=40, array-size-semantics=VARIABLE-SIZE, implementation-data-type=Segment0
package /DataTypeMapping
  data type mapping set DatatypeMappingSet
    data-type-maps:
      application-data-type=DetectedLanesEvt, implementation-data-type=DetectedLanesEvt
      application-data-type=DetectedLaneBoundariesEvt, implementation-data-type=DetectedLaneBoundariesEvt
      application-data-type=DetectedLaneBoundaries_Lane_ARRAYDT, implementation-data-type=DetectedLaneBoundaries_Lane_ARRAYDT
      application-data-type=Lane1, implementation-data-type=Lane1
      application-data-type=UInt32, implementation-data-type=UInt32
      application-data-type=Lane1_Segment_ARRAYDT, implementation-data-type=Lane1_Segment_ARRAYDT
      application-data-type=Segment1, implementation-data-type=Segment1
      application-data-type=Distance, implementation-data-type=Distance
      application-data-type=DetectedLanes_Lane_ARRAYDT, implementation-data-type=DetectedLanes_Lane_ARRAYDT
      application-data-type=Lane0, implementation-data-type=Lane0
      application-data-type=Lane0_Segment_ARRAYDT, implementation-data-type=Lane0_Segment_ARRAYDT
      application-data-type=Segment0, implementation-data-type=Segment0
package /Unit
  unit DistanceUnit: display-name=m
package /RoutingGroups
  so ad routing group ADAS_LaneDetectionPSI1
  so ad routing group ADASLaneDetectionPSI1AllEvg: event-group-control-type=ACTIVATION-UNICAST
package /BaseType
  8 x base type:
    Int8: category=FIXED_LENGTH, base-type-size=8, base-type-encoding=2C
    Int16: category=FIXED_LENGTH, base-type-size=16, base-type-encoding=2C
    Int32: category=FIXED_LENGTH, base-type-size=32, base-type-encoding=2C
    Int64: category=FIXED_LENGTH, base-type-size=64, base-type-encoding=2C
    Bool: category=FIXED_LENGTH, base-type-size=8, base-type-encoding=BOOLEAN
    ASCIIString: base-type-size=8, base-type-encoding=ISO-8859-1
    UTF8String: base-type-size=8, base-type-encoding=UTF-8
    UTF16String: base-type-size=16, base-type-encoding=UTF-16, byte-order=big-endian
package /Transformer
  data transformation set TransformationSet
    data transformation SOMEIPData: execute-despite-data-unavailability=false, transformer-chain=SOMEIP
    transformation technology SOMEIP: buffer-properties={header-length=64, in-place=false}, protocol=SOMEIP, someip-transformation-description{alignment=8, byte-order=little-endian, interface-version=1}, transformer-class=SERIALIZER, version=1
