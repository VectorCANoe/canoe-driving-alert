/*@!Encoding:65001*/
variables
{
  int trackingId;

  distObjRef ::_ADAS::DataModel::IDetectedMovingObject detObj;

  char detObjName [100];
  char detObjNameWithAdasPrefix [100];
}

on start
{
  $FrontRadar.sensor_info.sensor_view_configuration.range.impl = 60;
  $FrontRadar.sensor_info.sensor_view_configuration.field_of_view_horizontal.impl = 1;
}
  
on message RadarObjPos
{
  trackingId = $RadarObjPos::TrackingID;

  FrontRadar.BeginUpdate.Call();
  
  memcpy(detObjName, FrontRadar.GetOrCreateDetectedObject.Call_Phys(trackingId, _ADAS::DataModel::EDetectedObjectType::IDetectedMovingObject), elCount(FrontRadar.GetOrCreateDetectedObject.Call_Phys(trackingId, _ADAS::DataModel::EDetectedObjectType:: IDetectedMovingObject)));

  snprintf(detObjNameWithAdasPrefix, elcount(detObjNameWithAdasPrefix),"ADAS::%s", detObjName);
  detObj = (distObjRef _ADAS::DataModel::IDetectedMovingObject) lookupDistObj(detObjNameWithAdasPrefix);

  if(detObj.IsValid)
  {
    $detObj.moving_object.baseInfo.position.x.impl = $RadarObjPos::PosX;
    $detObj.moving_object.baseInfo.position.y.impl = $RadarObjPos::PosY;
  }
}

on message RadarObjDim
{
  if($RadarObjDim::TrackingID == trackingId)
  {
    memcpy(detObjName, FrontRadar.GetDetectedObjectByTrackingId.Call(trackingId), elCount(FrontRadar.GetDetectedObjectByTrackingId.Call(trackingId)));
  
    snprintf(detObjNameWithAdasPrefix, elcount(detObjNameWithAdasPrefix),"ADAS::%s", detObjName);
    detObj = (distObjRef _ADAS::DataModel::IDetectedMovingObject) lookupDistObj(detObjNameWithAdasPrefix);

    if (detObj.IsValid)
    {
      $detObj.moving_object.baseInfo.dimension.height.impl = $RadarObjDim::DimZ;
      $detObj.moving_object.baseInfo.dimension.width.impl  = $RadarObjDim::DimY;
      $detObj.moving_object.baseInfo.dimension.length.impl = $RadarObjDim::DimX;
    }
  }
}

on message RadarObjMovement
{
  if($RadarObjMovement::TrackingID == trackingId)
  {
    memcpy(detObjName, FrontRadar.GetDetectedObjectByTrackingId.Call(trackingId), elCount(FrontRadar.GetDetectedObjectByTrackingId.Call(trackingId)));
  
    snprintf(detObjNameWithAdasPrefix, elcount(detObjNameWithAdasPrefix),"ADAS::%s", detObjName);
    detObj = (distObjRef _ADAS::DataModel::IDetectedMovingObject) lookupDistObj(detObjNameWithAdasPrefix);

    if (detObj.IsValid)
    {
      $detObj.moving_object.baseInfo.velocity.x.impl = $RadarObjMovement::RelSpeed;
      $detObj.moving_object.baseInfo.orientation.yaw.phys = $RadarObjMovement::Orientation;
    }
    
    FrontRadar.SetDetectedObjectCompleted.Call($RadarObjDim::TrackingID, 1);
    FrontRadar.Update.Call();
  }
}