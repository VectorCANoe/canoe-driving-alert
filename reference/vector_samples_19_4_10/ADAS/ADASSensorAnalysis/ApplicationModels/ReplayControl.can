/*@!Encoding:1252*/
includes
{
  
}

variables
{
  msTimer replayControl;
}

on start
{
  FrontCamera.RemoveDetectedObjects.Call();
  FrontRadar.RemoveDetectedObjects.Call();
  
  replayStart("CameraReplayBlock");
  replayStart("RadarReplayBlock");
  setTimer(replayControl, 15000); 
}

on timer replayControl
{
  replayStop("CameraReplayBlock");
  replayStop("RadarReplayBlock");
  
  FrontCamera.RemoveDetectedObjects.Call();
  FrontRadar.RemoveDetectedObjects.Call();
  
  replayStart("CameraReplayBlock");
  replayStart("RadarReplayBlock");
  setTimer(replayControl, 15000); 
}