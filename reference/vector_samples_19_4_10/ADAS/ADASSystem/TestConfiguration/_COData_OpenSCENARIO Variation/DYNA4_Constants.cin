/*@!Encoding:1252*/
/*
 * DYNA4_Constants.cin
 *
 * This include provides variables, that can be used in multiple CAPL files.
 *
 * This file has been prepared for DYNA4 R8. Don't use with different versions!
 *
 * Copyright 2020-2023, Vector Informatik GmbH - All right reserved
 *
 */
variables
{
  char enabledSubsystemName[130] = "DYNA4";   // adapt the name of your enabled subsystem in the model here
  char animationSubsystemName[130] = "/Animation/Animation3/Send To DYNAanimation"; // adapt the path to animation block in the model here
  char animationDataFileName[64] = "animation_parameters.dat";
}
