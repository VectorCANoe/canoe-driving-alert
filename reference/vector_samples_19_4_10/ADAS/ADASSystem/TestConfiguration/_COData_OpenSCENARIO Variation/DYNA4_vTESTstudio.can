/*@!Encoding:1252*/
/*
 * DYNA4_vTESTstudio.can
 *
 * This capl file can be added to a vTESTstudio test unit (add copy of existing file...), since *.cin files can't be added directly. Please copy the referenced capl include (cin) manually to the vTESTstudio project.
 *
 * This file has been prepared for DYNA4 R8. Don't use with different versions!
 *
 * Copyright 2020-2023, Vector Informatik GmbH - All right reserved
 *
 */
 
includes
{
  #include "DYNA4_Functions.cin"
}

