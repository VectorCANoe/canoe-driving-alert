/*@!Encoding:1252*/
includes
{
  
}


variables
{
  enum VWaitThreshold
  {
    kUnderThreshold = 0,
    kOverThreshold = 1
  };
}

export void resetExampleAlgorithm()
{
  $OutputSimpleAlgorithm.resetAlgorithmState.impl = 1;
  testWaitForTimeout(10);
  $OutputSimpleAlgorithm.resetAlgorithmState.impl = 0;
  testStep("Info","Reset Algorithm under Test");
}

export testcase checkDistanceAndTimeToCollision()
{
  dword checkId1, checkId2;
  checkId1 = chkStart_ADASGroundTruthObjectsDistanceViolation(kUnderThreshold, 4.4); // distance under 4.4 m to any Moving Object on the ego vehicle lane will trigger the check
  checkId2 = chkStart_ADASGroundTruthObjectsTimeToCollisionViolation(kUnderThreshold, 0.3); // TCC under 0.3s to any Moving Object ego vehicle lane will trigger the check
  
  TestAddCondition(checkId1);
  TestAddCondition(checkId2);
  // Wait for 5s 
  TestWaitForTimeout(5000);
  TestRemoveCondition(checkId1);
  TestRemoveCondition(checkId2);
  testStepPass("No Distance and TTC Violations. Test ran for 5s.");
}

export testcase checkWarningIsActive()
{
  distObjRef ::_ADAS::DataModel::IDetectedMovingObject detObj;
  char buffer[100];
  double minAcceptableTTC = 1500.0;
  double maxAcceptableTTC = 2000.0;
  double timeToImpact = 0;
  int    isWarningActive = 0;
  long   checkId;

  if(TestWaitForADASDetectedObjectTimeToCollision(kUnderThreshold, 2, 101,30000))
  {

    timeToImpact = $OutputSimpleAlgorithm.timeToImpact.impl;
    isWarningActive = $OutputSimpleAlgorithm.isWarningActive.impl;
    
    if(timeToImpact > minAcceptableTTC && timeToImpact < maxAcceptableTTC)
    {
      testStepPass("", "Time To Collision (TTC) calculation is correct. TCC was %f ms",timeToImpact);
    }
    else
    {
      testStepFail("", "Time To Collision (TTC) calculation is wrong. TCC was %f ms",timeToImpact);
    }
    
    if(isWarningActive)
    {
      testStepPass("Success, a warning was provided when necessary.");
    }
    else
    {
      testStepFail("Fail, the TTC indicates that a warning is necessary, but no warning was provided.");
    }  
  }

  else
  {
    testStepInconclusive("No TTC under 2 seconds for a Detected Moving Object was recognised");
  }
  
}
