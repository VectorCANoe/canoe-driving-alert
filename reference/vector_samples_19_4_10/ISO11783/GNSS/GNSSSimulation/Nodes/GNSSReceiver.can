/*@!Encoding:65001*/
variables
{ 
  // OnMapClick
  enum mouseButton { leftMouseButton = 1, rightMouseButton = 2, middleMouseButton = 4 };
  enum buttonState { buttonDown = 0, buttonUp = 1 };
  enum modifierKey { noModKey = 0, ctrlKey = 1, altKey = 2, shiftKey = 4 };
  
  // supported GNSS specific PGNs
  const dword cPGN_GNSSPositionData = 129029;
  const dword cPGN_PositionDeltaHPRU = 129027;
  const dword cPGN_COGSOGRU = 129026;
  const dword cPGN_PositionRU = 129025;
  const dword cPGN_VehiclePosition = 65267;
  const dword cPGN_VehicleDirSpeed = 65256;
  
  const dword enable = 1;
  const dword disable = 0;
  
  const dword cVehicle = 0;
  const dword cReceiver = 1;
  
  const float altitude_vehicle = 250.0;
  
  msTimer getDataTimer;
  long timerPeriodMS = 100;
  
  long handleVehicleSymbol;
}

on preStart
{
  // Enable callback OnMapClick
  SetMapClickEnabled(enable);
  
  // Configure route preview in Map Window
  GNSSIL_EnableRoutePreview(cVehicle, enable);
  GNSSIL_ConfigRoutePreviewLines(cVehicle, @sysvar::RouteCfg::DrawingAccuracy, 1, 3, makeARGB(200, 255, 30, 30));
  GNSSIL_ConfigRoutePreviewPoints(cVehicle, 3, 2, makeARGB(200, 255, 30, 30), makeARGB(0, 255, 255, 255));
  GNSSIL_ConfigRoutePreviewLines(cReceiver, @sysvar::RouteCfg::DrawingAccuracy, 1, 2, makeARGB(255, 0, 0, 0));
  GNSSIL_ConfigRoutePreviewPoints(cReceiver, 1.5, 2, makeARGB(255, 0, 0, 0), makeARGB(0, 255, 255, 255));
}

on start
{ 
  // Fill PG 129029/0x1F805 with additional data
  GNSSIL_SetValGNSSPositionData(0, 0, 2, 1, 4, 0.21, 0.54, 7.63);
  GNSSIL_AddRefStation(0, 123, 0.123);
  GNSSIL_AddRefStation(0, 456, 0.456);
  
  // Vehicle symbol
  handleVehicleSymbol = CreateMapObject( 9 );
  SetMapObjectHeading(handleVehicleSymbol, 360);
  SetMapObjectFillColor(handleVehicleSymbol, makeARGB(100, 255, 30, 30));
  SetMapObjectLineColor(handleVehicleSymbol, makeARGB(200, 255, 30, 30));
  SetMapObjectPenWidth(handleVehicleSymbol, 3);
  
  // Panel controls
  EnablePanelControls();
}

// Callbacks

OnMapClick(double latitude, double longitude, long button, long buttonState, long modifierKeys)
{  
  if (button == leftMouseButton && buttonState == buttonDown)
  {     
    if (modifierKeys == ctrlKey || modifierKeys == ctrlKey + shiftKey)
    {
      if (@sysvar::RouteCfg::State_StartPointIsSet == 0) // add start point
      {
        long result; 
        @sysvar::RouteCfg::StartPoint_Lat = latitude;
        @sysvar::RouteCfg::StartPoint_Lon = longitude;
        GNSSIL_SetReceiverOffset(@sysvar::Vehicle::ReceiverOffsetX, @sysvar::Vehicle::ReceiverOffsetY, @sysvar::Vehicle::ReceiverOffsetZ);
        result = GNSSIL_SetStartPoint(latitude, longitude, altitude_vehicle);
        
        GNSSIL_StopAtEnd();
        
        if (result == 0)
        {          
          @sysvar::RouteCfg::Straight_Lat = latitude;
          @sysvar::RouteCfg::Straight_Lon = longitude;
          @sysvar::RouteCfg::Bezier_Lat = latitude;
          @sysvar::RouteCfg::Bezier_Lon = longitude;
          
          @sysvar::RouteCfg::State_StartPointIsSet = 1;
          
          EnablePanelControls();
        }
      }
      else if (modifierKeys == ctrlKey) // add Bezier curve
      {
        AddBezier(1, latitude, longitude);
      }
      else // add straight line
      {
        AddStraight(1, latitude, longitude);
      }
      
      RefreshVehicleSymbol();
    }
    else if (modifierKeys == ctrlKey + altKey) // delete one segment
    {
      float totalLength, courseEnd;
      dword segmentCount;
      long result = -1;
      
      result = GNSSIL_DeleteSegmentsAtEnd(1);
      if (result == 0)
      {        
        GNSSIL_GetSegmentsTotalCount(segmentCount);
        if (segmentCount > 0)
        {
          UpdateRouteAttributes();
        }
        else
        {
          @sysvar::RouteCfg::TotalRouteLength = 0.0;
          @sysvar::RouteCfg::Meander_CourseStart = 0.0;
          @sysvar::RouteCfg::Circle_CourseStart = 0.0;
          @sysvar::RouteCfg::State_RouteIsCreated = 0; 
        }
      }
    }
  }
}

GNSSIL_OnLastWpReached()
{
  float currentSpeed;
  GNSSIL_GetCurrentSpeed(0/*vehicle*/, currentSpeed);
  if (currentSpeed == 0.0)
  {
    @sysvar::Vehicle::SpeedSetValue = 0.0;
  }
  
  writeEx(-3, 1, "Reached end of predefined trajectory.");  
}

// Helper functions and panel functionality

AddBezier(long addType, float latOrXdiff, float lonOrYdiff)
{
  long result = -1;
  
  if (addType == 1) // to geographic point
  {
    result = GNSSIL_AddBezierToGeoPoint(latOrXdiff, lonOrYdiff);
  }
  else if (addType == 2) // to x-/y-Difference
  {
    result = GNSSIL_AddBezierToXYDiff(latOrXdiff, lonOrYdiff);
  }
  
  if (result == 0)
  {    
    UpdateRouteAttributes();
  }
}

AddStraight(long addType, float latOrXdiff, float lonOrYdiff)
{  
  long result = -1;
  
  if (addType == 1) // to geographic point
  {
    result = GNSSIL_AddStraightToGeoPoint(latOrXdiff, lonOrYdiff);
  }
  else if (addType == 2) // to x-/y-Difference
  {
    result = GNSSIL_AddStraightToXYDiff(latOrXdiff, lonOrYdiff);
  }
  
  if (result == 0)
  {
    UpdateRouteAttributes();
  }
}

UpdateRouteAttributes()
{
  float distEnd, courseEnd, totalLength;
  
  GNSSIL_GetDistanceEnd(distEnd);
  GNSSIL_GetCourseByDistance(cVehicle, distEnd, courseEnd);
  GNSSIL_GetTotalLength(totalLength);
  
  @sysvar::RouteCfg::State_RouteIsCreated = 1;
  @sysvar::RouteCfg::State_RouteIsLeft = 0;
  @sysvar::RouteCfg::TotalRouteLength = totalLength;
  @sysvar::RouteCfg::Meander_CourseStart = courseEnd;
  @sysvar::RouteCfg::Circle_CourseStart = courseEnd;
  
  EnablePanelControls();
}

EnablePanelControls()
{
  if (@sysvar::RouteCfg::State_StartPointIsSet == 0)
  {
    enableControl("GNSS IL Control", "Button_MoveMap1", disable);
    enableControl("GNSS IL Control", "Button_MoveMap2", disable);
    enableControl("GNSS IL Control", "Button_Reset1", disable);
    enableControl("GNSS IL Control", "Button_Reset2", disable);
    enableControl("GNSS IL Control", "GroupBox_AddMeander", disable);
    enableControl("GNSS IL Control", "GroupBox_AddStraight", disable);
    enableControl("GNSS IL Control", "GroupBox_AddBezier", disable);
    enableControl("GNSS IL Control", "GroupBox_AddCircle", disable);
  }
  else
  {
    enableControl("GNSS IL Control", "Button_MoveMap1", enable);
    enableControl("GNSS IL Control", "Button_MoveMap2", enable);
    enableControl("GNSS IL Control", "Button_Reset1", enable);
    enableControl("GNSS IL Control", "Button_Reset2", enable);
    enableControl("GNSS IL Control", "GroupBox_AddMeander", enable);
    enableControl("GNSS IL Control", "GroupBox_AddStraight", enable);
    enableControl("GNSS IL Control", "GroupBox_AddBezier", enable);
    enableControl("GNSS IL Control", "GroupBox_AddCircle", enable);
  }
  
  if (@sysvar::RouteCfg::State_RouteIsCreated == 0)
  {
    enableControl("GNSS IL Control", "IOBox_Curvature", disable);
    enableControl("GNSS IL Control", "TrackBar_Curvature", disable);
    enableControl("GNSS IL Control", "IOBox_Speed", disable);
    enableControl("GNSS IL Control", "TrackBar_Speed", disable);
  }
  else
  {
    enableControl("GNSS IL Control", "IOBox_Curvature", enable);
    enableControl("GNSS IL Control", "TrackBar_Curvature", enable);
    enableControl("GNSS IL Control", "IOBox_Speed", enable);
    enableControl("GNSS IL Control", "TrackBar_Speed", enable);
  }
  
  if (@sysvar::RouteCfg::State_RouteIsLeft == 0 && @sysvar::RouteCfg::State_RouteIsCreated == 1)
  {
    enableControl("GNSS IL Control", "GroupBox_AddMeander", enable);
    enableControl("GNSS IL Control", "GroupBox_AddStraight", enable);
    enableControl("GNSS IL Control", "GroupBox_AddBezier", enable);
    enableControl("GNSS IL Control", "GroupBox_AddCircle", enable);
  }
  if (@sysvar::RouteCfg::State_RouteIsLeft == 1)
  {
    enableControl("GNSS IL Control", "GroupBox_AddMeander", disable);
    enableControl("GNSS IL Control", "GroupBox_AddStraight", disable);
    enableControl("GNSS IL Control", "GroupBox_AddBezier", disable);
    enableControl("GNSS IL Control", "GroupBox_AddCircle", disable);
  }
}

RefreshVehicleSymbol()
{
  if (@sysvar::RouteCfg::State_RouteIsCreated == 1)
  {
    float latitude, longitude, course;
    dword segmentCount;
    
    GNSSIL_GetSegmentsTotalCount(segmentCount);
    
    if (segmentCount != 0)
    {
      GNSSIL_GetCurrentPositionGeo(cVehicle, latitude, longitude);
      GNSSIL_GetCurrentCourse(cVehicle, course);
      SetMapObjectVisible(handleVehicleSymbol, 1);
      SetMapObjectPosition(handleVehicleSymbol, latitude, longitude);
      SetMapObjectHeading(handleVehicleSymbol, course);
      DrawMapObject(handleVehicleSymbol);
    }    
  }
}

DisableAllGNSSMsgs()
{
  GNSSIL_EnableGNSSMsg(cPGN_GNSSPositionData, disable, @sysvar::GNSSMsgCfg::GNSSPosData_Prio, @sysvar::GNSSMsgCfg::GNSSPosData_CycleTime);
  GNSSIL_EnableGNSSMsg(cPGN_PositionDeltaHPRU, disable, @sysvar::GNSSMsgCfg::PosDeltaHPRU_Prio, @sysvar::GNSSMsgCfg::PosDeltaHPRU_CycleTime);
  GNSSIL_EnableGNSSMsg(cPGN_COGSOGRU, disable, @sysvar::GNSSMsgCfg::COGSOG_Prio, @sysvar::GNSSMsgCfg::COGSOG_CycleTime);
  GNSSIL_EnableGNSSMsg(cPGN_PositionRU, disable, @sysvar::GNSSMsgCfg::PosRU_Prio, @sysvar::GNSSMsgCfg::PosRU_CycleTime);
  GNSSIL_EnableGNSSMsg(cPGN_VehiclePosition, disable, @sysvar::GNSSMsgCfg::VP_Prio, @sysvar::GNSSMsgCfg::VP_CycleTime);
  GNSSIL_EnableGNSSMsg(cPGN_VehicleDirSpeed, disable, @sysvar::GNSSMsgCfg::VDS_Prio, @sysvar::GNSSMsgCfg::VDS_CycleTime);
}

on timer getDataTimer
{
  float currentCurvature, currentCourse, currentSpeed, currentCurvature_receiver, currentCourse_receiver, currentSpeed_receiver, currentDist_vehicle;
  dword segmentCount;
  
  GNSSIL_GetSegmentsTotalCount(segmentCount);
  if (segmentCount != 0)
  {
    GNSSIL_GetCurrentCurvature(cVehicle, currentCurvature); 
    GNSSIL_GetCurrentCourse(cVehicle, currentCourse);
    GNSSIL_GetCurrentSpeed(cVehicle, currentSpeed);
    GNSSIL_GetCurrentDistance(currentDist_vehicle);
    GNSSIL_GetCurrentCurvature(cReceiver, currentCurvature_receiver); 
    GNSSIL_GetCurrentCourse(cReceiver, currentCourse_receiver);
    GNSSIL_GetCurrentSpeed(cReceiver, currentSpeed_receiver);
    @sysvar::Vehicle::CurvatureActualValue_vehicle = currentCurvature;
    @sysvar::Vehicle::CourseActualValue_vehicle = currentCourse;
    @sysvar::Vehicle::SpeedActualValue_vehicle = currentSpeed;
    @sysvar::Vehicle::YawRateActualValue_vehicle = currentSpeed * currentCurvature;
    @sysvar::Vehicle::DistanceActualValue_vehicle = currentDist_vehicle;
    @sysvar::Vehicle::CurvatureActualValue_receiver = currentCurvature_receiver;
    @sysvar::Vehicle::CourseActualValue_receiver = currentCourse_receiver;
    @sysvar::Vehicle::SpeedActualValue_receiver = currentSpeed_receiver;
    @sysvar::Vehicle::YawRateActualValue_receiver = currentSpeed_receiver * currentCurvature_receiver;
  }
}

on sysvar_update Vehicle::SpeedSetValue
{
 if (@sysvar::RouteCfg::State_RouteIsCreated == 1)
 {
   if (@sysvar::RouteCfg::State_RouteIsStarted == 0)
   {
    @sysvar::GNSSMsgCfg::Button_SetMsgCfg = 0;
    @sysvar::GNSSMsgCfg::Button_SetMsgCfg = 1;
    @sysvar::RouteCfg::State_RouteIsStarted = 1;
   }
   
   GNSSIL_ChangeSpeed(@this, 0); 
 }
}

on sysvar_update Vehicle::CurvatureSetValue
{
 if (@sysvar::RouteCfg::State_RouteIsCreated == 1)
 {
   long result;
   result = GNSSIL_SetCurvature(@this);
   if (result == 0)
   {
     @sysvar::RouteCfg::State_RouteIsLeft = 1;
   }
 }
}

on sysvar_update Vehicle::CurvatureSetValue_slider
{
  @sysvar::Vehicle::CurvatureSetValue = - @this;
}

on sysvar GNSSMsgCfg::Button_SetMsgCfg
{
 if (@this == 1)
   {
     GNSSIL_EnableGNSSMsg(cPGN_GNSSPositionData, @sysvar::GNSSMsgCfg::GNSSPosData_enable, @sysvar::GNSSMsgCfg::GNSSPosData_Prio, @sysvar::GNSSMsgCfg::GNSSPosData_CycleTime);
     GNSSIL_EnableGNSSMsg(cPGN_PositionDeltaHPRU, @sysvar::GNSSMsgCfg::PosDeltaHPRU_enable, @sysvar::GNSSMsgCfg::PosDeltaHPRU_Prio, @sysvar::GNSSMsgCfg::PosDeltaHPRU_CycleTime);
     GNSSIL_EnableGNSSMsg(cPGN_COGSOGRU, @sysvar::GNSSMsgCfg::COGSOG_enable, @sysvar::GNSSMsgCfg::COGSOG_Prio, @sysvar::GNSSMsgCfg::COGSOG_CycleTime);
     GNSSIL_EnableGNSSMsg(cPGN_PositionRU, @sysvar::GNSSMsgCfg::PosRU_enable, @sysvar::GNSSMsgCfg::PosRU_Prio, @sysvar::GNSSMsgCfg::PosRU_CycleTime);
     GNSSIL_EnableGNSSMsg(cPGN_VehiclePosition, @sysvar::GNSSMsgCfg::VP_enable, @sysvar::GNSSMsgCfg::VP_Prio, @sysvar::GNSSMsgCfg::VP_CycleTime);
     GNSSIL_EnableGNSSMsg(cPGN_VehicleDirSpeed, @sysvar::GNSSMsgCfg::VDS_enable, @sysvar::GNSSMsgCfg::VDS_Prio, @sysvar::GNSSMsgCfg::VDS_CycleTime);
   }
}

on sysvar RouteCfg::State_RouteIsCreated
{
 if (@this == 1)
 {
   setTimerCyclic(getDataTimer, 0, timerPeriodMS);
 }
 if (@this == 0)
 {
  cancelTimer(getDataTimer); 
 }
}

on sysvar RouteCfg::Button_AddMeander
{
  if (@this == 1)
  {
    long result; 
    result = GNSSIL_AddMeander(@sysvar::RouteCfg::Meander_CourseStart, @sysvar::RouteCfg::Meander_WorkingWidth, @sysvar::RouteCfg::Meander_Height, @sysvar::RouteCfg::Meander_CurveDim, @sysvar::RouteCfg::Meander_Direction, @sysvar::RouteCfg::Meander_WaveCount);
    if (result == 0)
    {
      UpdateRouteAttributes();
    }
  }
}

on sysvar RouteCfg::Button_AddStraight
{
  if (@this == 1)
  {    
    if (@sysvar::RouteCfg::AddType_Straight == 1)
    {
      AddStraight(1, @sysvar::RouteCfg::Straight_Lat, @sysvar::RouteCfg::Straight_Lon);
    }
    
    else if (@sysvar::RouteCfg::AddType_Straight == 2)
    {
      AddStraight(2, @sysvar::RouteCfg::Straight_xDiff, @sysvar::RouteCfg::Straight_yDiff);   
    }
  }
}

on sysvar RouteCfg::Button_AddBezier
{
  if (@this == 1)
  {       
    if (@sysvar::RouteCfg::AddType_Bezier == 1)
    { 
      AddBezier(1, @sysvar::RouteCfg::Bezier_Lat, @sysvar::RouteCfg::Bezier_Lon);
    }
    else if (@sysvar::RouteCfg::AddType_Bezier == 2)
    {      
      AddBezier(2, @sysvar::RouteCfg::Bezier_xDiff, @sysvar::RouteCfg::Bezier_yDiff);
    }
  }
}

on sysvar RouteCfg::Button_AddCircle
{
  if (@this == 1)
  {  
    long result;
    result = GNSSIL_AddCircleArcCourseStartEnd(@sysvar::RouteCfg::Circle_Radius, @sysvar::RouteCfg::Circle_CourseStart, @sysvar::RouteCfg::Circle_CourseEnd);
    if (result == 0)
    {
      UpdateRouteAttributes(); 
    }
  }
}

on sysvar RouteCfg::Button_ResetRoute
{
 if (@this == 1)
 {
   GNSSIL_ResetTrajectory();
   
   @sysvar::RouteCfg::TotalRouteLength = 0.0;
   @sysvar::RouteCfg::Meander_CourseStart = 0.0;   
   @sysvar::RouteCfg::Circle_CourseStart = 0.0;
   @sysvar::RouteCfg::State_RouteIsCreated = 0;
   @sysvar::RouteCfg::State_RouteIsStarted = 0;
   @sysvar::RouteCfg::State_RouteIsLeft = 0;
   @sysvar::RouteCfg::State_StartPointIsSet = 0;
   
   SetMapObjectVisible(handleVehicleSymbol, 0);
   DrawMapObject(handleVehicleSymbol);
   EnablePanelControls();
   DisableAllGNSSMsgs();
 }
}

on sysvar RouteCfg::Button_SetMapPos
{
 if (@this == 1 && @sysvar::RouteCfg::State_StartPointIsSet == 1)
 {
   SetMapPosition(@sysvar::RouteCfg::StartPoint_Lat, @sysvar::RouteCfg::StartPoint_Lon);
 }
}

on sysvar Vehicle::ReceiverOffsetX
{
  GNSSIL_SetReceiverOffset(@sysvar::Vehicle::ReceiverOffsetX, @sysvar::Vehicle::ReceiverOffsetY, @sysvar::Vehicle::ReceiverOffsetZ);
}

on sysvar Vehicle::ReceiverOffsetY
{
  GNSSIL_SetReceiverOffset(@sysvar::Vehicle::ReceiverOffsetX, @sysvar::Vehicle::ReceiverOffsetY, @sysvar::Vehicle::ReceiverOffsetZ);
}

on sysvar Vehicle::ReceiverOffsetZ
{
  GNSSIL_SetReceiverOffset(@sysvar::Vehicle::ReceiverOffsetX, @sysvar::Vehicle::ReceiverOffsetY, @sysvar::Vehicle::ReceiverOffsetZ);
}

on sysvar RouteCfg::DrawingAccuracy
{
  GNSSIL_ConfigRoutePreviewLines(cVehicle, @sysvar::RouteCfg::DrawingAccuracy, 1, 3, makeARGB(200, 255, 30, 30));
  GNSSIL_ConfigRoutePreviewLines(cReceiver, @sysvar::RouteCfg::DrawingAccuracy, 1, 2, makeARGB(255, 0, 0, 0));
}

on sysvar RouteCfg::Enable_ReceiverPreview
{
  GNSSIL_EnableRoutePreview(cReceiver, @this); 
}

on sysvar GPS::GPS1.Latitude
{
  RefreshVehicleSymbol();
}

on sysvar GPS::GPS1.Longitude
{
  RefreshVehicleSymbol();
}

on sysvar GPS::GPS1.Direction
{
  RefreshVehicleSymbol();
}