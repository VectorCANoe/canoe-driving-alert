VERSION ""

NS_ :

BS_:

BU_: VT TC Sprayer TECU
VAL_TABLE_ FMI 0 "Above normal (most severe)" 1 "Below normal (most severe)" 2 "Data erratic" 3 "Voltage above normal" 4 "Voltage below normal" 5 "Current below normal" 6 "Current above normal" 7 "Mechanical system not responding" 8 "Abnormal frequency" 9 "Abnormal update rate" 10 "Abnormal rate of change" 11 "Root cause not known" 12 "Bad intelligent device" 13 "Out of calibration" 14 "Special intstructions" 15 "Above normal (least severe)" 16 "Above normal (moderately severe)" 17 "Below normal (least severe)" 18 "Below normal (moderately severe)" 19 "Received network data in error" 31 "Not available" 20 "Data Drifted High" 21 "Data Drifted Low" ;

BO_ 3221225472 VECTOR__INDEPENDENT_SIG_MSG: 0 Vector__XXX
 SG_ NumOfReportedFuncCharacteristics : 0|8@1+ (1,0) [0|255] "" Vector__XXX
 SG_ FirstListedFuncCharacteristic : 0|8@1+ (1,0) [0|255] "" Vector__XXX
 SG_ FirstListedFuncGen : 0|8@1+ (1,0) [0|255] "" Vector__XXX
 SG_ NumOfFirstListedFuncOptionBytes : 0|8@1+ (1,0) [0|2] "" Vector__XXX
 SG_ VTFuncOptions : 0|8@1+ (1,0) [0|250] "" Vector__XXX
 SG_ AuxType1_SupportFunc0 : 0|1@1+ (1,0) [0|1] "" Vector__XXX
 SG_ AuxType1_SupportFunc1 : 0|1@1+ (1,0) [0|1] "" Vector__XXX
 SG_ AuxType1_SupportFunc2 : 0|1@1+ (1,0) [0|1] "" Vector__XXX
 SG_ AuxType2_SupportFunc00 : 0|1@1+ (1,0) [0|1] "" Vector__XXX
 SG_ AuxType2_SupportFunc01 : 0|1@1+ (1,0) [0|1] "" Vector__XXX
 SG_ AuxType2_SupportFunc02 : 0|1@1+ (1,0) [0|1] "" Vector__XXX
 SG_ AuxType2_SupportFunc03 : 0|1@1+ (1,0) [0|1] "" Vector__XXX
 SG_ AuxType2_SupportFunc04 : 0|1@1+ (1,0) [0|1] "" Vector__XXX
 SG_ AuxType2_SupportFunc05 : 0|1@1+ (1,0) [0|1] "" Vector__XXX
 SG_ AuxType2_SupportFunc06 : 0|1@1+ (1,0) [0|1] "" Vector__XXX
 SG_ AuxType2_SupportFunc07 : 0|1@1+ (1,0) [0|1] "" Vector__XXX
 SG_ AuxType2_SupportFunc08 : 0|1@1+ (1,0) [0|1] "" Vector__XXX
 SG_ AuxType2_SupportFunc09 : 0|1@1+ (1,0) [0|1] "" Vector__XXX
 SG_ AuxType2_SupportFunc10 : 0|1@1+ (1,0) [0|1] "" Vector__XXX
 SG_ AuxType2_SupportFunc11 : 0|1@1+ (1,0) [0|1] "" Vector__XXX
 SG_ AuxType2_SupportFunc12 : 0|1@1+ (1,0) [0|1] "" Vector__XXX
 SG_ AuxType2_SupportFunc13 : 0|1@1+ (1,0) [0|1] "" Vector__XXX
 SG_ AuxType2_SupportFunc14 : 0|1@1+ (1,0) [0|1] "" Vector__XXX
 SG_ TCBasicFuncOptions : 0|8@1+ (1,0) [0|255] "" Vector__XXX
 SG_ TCGeoSupportedChannels : 0|8@1+ (1,0) [0|250] "" Vector__XXX
 SG_ TCGeoFuncOptions : 0|8@1+ (1,0) [0|0] "" Vector__XXX
 SG_ TCSectionNumberOfBooms : 0|8@1+ (1,0) [1|250] "" Vector__XXX
 SG_ TCSectionNumberOfSections : 0|8@1+ (1,0) [1|250] "" Vector__XXX
 SG_ BasicTECU_Class1NoOptions : 0|1@1+ (1,0) [0|1] "" Vector__XXX
 SG_ BasicTECU_Class2NoOptions : 0|1@1+ (1,0) [0|1] "" Vector__XXX
 SG_ BasicTECU_ClassRequiredLighting : 0|1@1+ (1,0) [0|1] "" Vector__XXX
 SG_ BasicTECU_NavigationOption : 0|1@1+ (1,0) [0|1] "" Vector__XXX
 SG_ BasicTECU_FrontHitchOption : 0|1@1+ (1,0) [0|1] "" Vector__XXX
 SG_ BasicTECU_GuidanceOption : 0|1@1+ (1,0) [0|1] "" Vector__XXX
 SG_ AdvanceTECU_Class3NoOptions : 0|1@1+ (1,0) [0|1] "" Vector__XXX
 SG_ AdvanceTECU_FullLightingMsgSet : 0|1@1+ (1,0) [0|1] "" Vector__XXX
 SG_ AdvanceTECU_NavigationOption : 0|1@1+ (1,0) [0|1] "" Vector__XXX
 SG_ AdvanceTECU_FrontHitchOption : 0|1@1+ (1,0) [0|1] "" Vector__XXX
 SG_ AdvanceTECU_GuidanceOption : 0|1@1+ (1,0) [0|1] "" Vector__XXX
 SG_ AdvanceTECU_PowertrainOption : 0|1@1+ (1,0) [0|1] "" Vector__XXX
 SG_ AdvanceTECU_MotionInitiationOpti : 0|1@1+ (1,0) [0|1] "" Vector__XXX
 SG_ SequenceControlFuncOptions : 0|8@1+ (1,0) [0|255] "" Vector__XXX
 SG_ StopAllImplementOperationsOption : 0|8@1+ (1,0) [0|0] "" Vector__XXX
 SG_ DiagnosticOptions : 0|8@1+ (1,0) [0|255] "" Vector__XXX
 SG_ MachineSelSpeedExitReason : 0|6@1+ (1,0) [0|63] "" Vector__XXX
 SG_ NumberOfOptionsBytes : 0|8@1+ (1,0) [0|250] "" Vector__XXX
 SG_ AuxControlType1FuncOptions : 0|8@1- (1,0) [0|255] "" Vector__XXX
 SG_ ImmediateOperandValue : 0|32@1+ (1,0) [0|0] "" Vector__XXX
 SG_ CertTypeAuxControlFunc : 0|1@1+ (1,0) [0|1] "" Vector__XXX
 SG_ CertTypeAuxControlInUnit : 0|1@1+ (1,0) [0|1] "" Vector__XXX
 SG_ CertTypeDataLogger : 0|1@1+ (1,0) [0|1] "" Vector__XXX
 SG_ CertTypeDataLoggerWSMaster : 0|1@1+ (1,0) [0|1] "" Vector__XXX
 SG_ CertTypeDataLoggerWSMember : 0|1@1+ (1,0) [0|1] "" Vector__XXX
 SG_ CertTypeFileClient : 0|1@1+ (1,0) [0|1] "" Vector__XXX
 SG_ CertTypeSecControlClient : 0|1@1+ (1,0) [0|1] "" Vector__XXX
 SG_ CertTypeSeqControlMaster : 0|1@1+ (1,0) [0|1] "" Vector__XXX
 SG_ CertTypeTCSectionControl : 0|1@1+ (1,0) [0|1] "" Vector__XXX
 SG_ CertTypeTCSectionControlWSMember : 0|1@1+ (1,0) [0|1] "" Vector__XXX

BO_ 2362179319 PD_TC: 14 TC
 SG_ ApplicationTotalMass m352 : 32|32@1- (1,0) [0|2147483647] "g" Vector__XXX
 SG_ ApplicationTotalVolume m351 : 32|32@1- (1,0) [0|2147483647] "ml" Vector__XXX
 SG_ FunctionType m350 : 32|32@1- (1,0) [0|2147483647] "" Vector__XXX
 SG_ NozzleDriftReduction m349 : 32|32@1- (1,0) [0|100] "ppm" Vector__XXX
 SG_ MaximumSwathingWidth m348 : 32|32@1- (1,0) [0|2147483647] "mm" Vector__XXX
 SG_ MinimumSwathingWidth m347 : 32|32@1- (1,0) [0|2147483647] "mm" Vector__XXX
 SG_ ActualSwathingWidth m346 : 32|32@1- (1,0) [0|2147483647] "mm" Vector__XXX
 SG_ SetpointSwathingWidth m345 : 32|32@1- (1,0) [0|2147483647] "mm" Vector__XXX
 SG_ MaximumGrainKernelCrackerGap m344 : 32|32@1- (0.001,0) [0|2147483.647] "mm" Vector__XXX
 SG_ MinimumGrainKernelCrackerGap m343 : 32|32@1- (0.001,0) [0|2147483.647] "mm" Vector__XXX
 SG_ ActualGrainKernelCrackerGap m342 : 32|32@1- (0.001,0) [-0|2147483.647] "mm" Vector__XXX
 SG_ SetpointGrainKernelCrackerGap m341 : 32|32@1- (0.001,0) [-0|2147483.647] "mm" Vector__XXX
 SG_ EffectiveUnloadingTime m340 : 32|32@1- (1,0) [-0|2147483647] "s" Vector__XXX
 SG_ EffectiveLoadingTime m339 : 32|32@1- (1,0) [0|2147483647] "s" Vector__XXX
 SG_ LiftimeRearPTOHours m338 : 32|32@1- (0.1,0) [0|214748364.7] "h" Vector__XXX
 SG_ LifetimeFrontPTOHours m337 : 32|32@1- (0.1,0) [0|214748364.7] "h" Vector__XXX
 SG_ RearPTOHours m336 : 32|32@1- (1,0) [0|2147480000] "s" Vector__XXX
 SG_ FrontPTOHours m335 : 32|32@1- (1,0) [0|2147483647] "s" Vector__XXX
 SG_ OperatingHoursSinceLastSharpenin m334 : 32|32@1- (1,0) [0|2147483647] "s" Vector__XXX
 SG_ MaximumCuttingDrumSpeed m333 : 32|32@1- (0.001,0) [0|2147483.647] "1/s" Vector__XXX
 SG_ ActualCuttingDrumSpeed m331 : 32|32@1- (0.001,0) [0|2147483.647] "1/s" Vector__XXX
 SG_ SetpointCuttingDrumSpeed m330 : 32|32@1- (0.001,0) [0|2147483.647] "1/s" Vector__XXX
 SG_ MaximumHeaderSpeed m329 : 32|32@1- (0.001,0) [0|2147483.647] "1/s" Vector__XXX
 SG_ MinimumHeaderSpeed m328 : 32|32@1- (0.001,0) [0|2147483.647] "1/s" Vector__XXX
 SG_ ActualHeaderSpeed m327 : 32|32@1- (0.001,0) [0|2147483.647] "1/s" Vector__XXX
 SG_ SetpointHeaderSpeed m326 : 32|32@1- (0.001,0) [0|2147483.647] "1/s" Vector__XXX
 SG_ LifetimeApplicationTotalVolume m325 : 32|32@1+ (1,0) [0|2147483647] "L" Vector__XXX
 SG_ ChopperEngagementTotalTime m324 : 32|32@1+ (1,0) [0|2147483647] "s" Vector__XXX
 SG_ UnloadIdentificationNumber m323 : 32|32@1+ (1,0) [0|2147483647] "" Vector__XXX
 SG_ LoadIdentificationNumber m322 : 32|32@1+ (1,0) [0|4294967296] "" Vector__XXX
 SG_ ArbitraryAddressCapable m0 : 111|1@1+ (1,0) [0|1] "" Vector__XXX
 SG_ IndustryGroup m0 : 108|3@1+ (1,0) [0|7] "" Vector__XXX
 SG_ VehicleSystemInstance m0 : 104|4@1+ (1,0) [0|15] "" Vector__XXX
 SG_ VehicleSystem2 m0 : 97|7@1+ (1,0) [0|127] "" Vector__XXX
 SG_ Function m0 : 88|8@1+ (1,0) [0|255] "" Vector__XXX
 SG_ FunctionInstance m0 : 83|5@1+ (1,0) [0|31] "" Vector__XXX
 SG_ ECUInstance m0 : 80|3@1+ (1,0) [0|7] "" Vector__XXX
 SG_ ManufacturerCode m0 : 69|11@1+ (1,0) [0|2047] "" Vector__XXX
 SG_ TemperatureUnits m2 : 54|2@1+ (1,0) [0|3] "" Vector__XXX
 SG_ PressureUnits m2 : 52|2@1+ (1,0) [0|3] "" Vector__XXX
 SG_ ErrorCodeObjPool4 m9 : 51|1@1+ (1,0) [0|0] "" Vector__XXX
 SG_ ErrorCodeObjPool3 m9 : 50|1@1+ (1,0) [0|0] "" Vector__XXX
 SG_ ForceUnits m2 : 50|2@1+ (1,0) [0|3] "" Vector__XXX
 SG_ ErrorCodeObjPool2 m9 : 49|1@1+ (1,0) [0|0] "" Vector__XXX
 SG_ IdentityNumber m0 : 48|21@1+ (1,0) [0|2097152] "" Vector__XXX
 SG_ NumberOfSection m1 : 48|8@1+ (1,0) [0|255] "" Vector__XXX
 SG_ ExecutedCommand m14 : 48|8@1+ (1,0) [0|65535] "" Vector__XXX
 SG_ UnitsSystem m2 : 48|2@1+ (1,0) [0|3] "" Vector__XXX
 SG_ ErrorCodeObjPool1 m9 : 48|1@1+ (1,0) [0|0] "" Vector__XXX
 SG_ DistanceUnitCmd m2 : 46|2@1+ (1,0) [0|3] "" Vector__XXX
 SG_ AreaUnitCmd m2 : 44|2@1+ (1,0) [0|3] "" Vector__XXX
 SG_ VolumeUnitCmd m2 : 42|2@1+ (1,0) [0|3] "" Vector__XXX
 SG_ SourceAddressWSM m14 : 40|8@1+ (1,0) [0|65535] "" Vector__XXX
 SG_ MassUnitCmd m2 : 40|2@1+ (1,0) [0|3] "" Vector__XXX
 SG_ NumberOfBooms m1 : 40|8@1+ (1,0) [0|255] "" Vector__XXX
 SG_ ErrorCodeProcessData8 m13 : 39|1@1+ (1,0) [0|1] "" Vector__XXX
 SG_ ErrorCodeProcessData7 m13 : 38|1@1+ (1,0) [0|1] "" Vector__XXX
 SG_ ErrorCodeProcessData6 m13 : 37|1@1+ (1,0) [0|1] "" Vector__XXX
 SG_ DestinationElementNumber m3 : 36|12@1+ (1,0) [0|4095] "" Vector__XXX
 SG_ ErrorCodeProcessData5 m13 : 36|1@1+ (1,0) [0|1] "" Vector__XXX
 SG_ ErrorCodeProcessData4 m13 : 35|1@1+ (1,0) [0|1] "" Vector__XXX
 SG_ StatusBusyExecuting m14 : 35|1@1+ (1,0) [0|1] "" Vector__XXX
 SG_ ErrorCodeProcessData3 m13 : 34|1@1+ (1,0) [0|1] "" Vector__XXX
 SG_ StatusBusyReading m14 : 34|1@1+ (1,0) [0|1] "" Vector__XXX
 SG_ ErrorCodeProcessData2 m13 : 33|1@1+ (1,0) [0|1] "" Vector__XXX
 SG_ StatusBusySaving m14 : 33|1@1+ (1,0) [0|1] "" Vector__XXX
 SG_ DataLogTimeInterval m4 : 32|32@1- (1,0) [0|60000] "ms" Vector__XXX
 SG_ DataLogDistanceInterval m5 : 32|32@1- (1,0) [0|1000000] "mm" Vector__XXX
 SG_ AppRateVolumePerArea_Set m1 : 32|32@1- (0.01,0) [0|21474836.47] "mm³/m²" Vector__XXX
 SG_ AppRateVolumePerArea_Act m2 : 32|32@1- (0.01,0) [0|21474836.47] "mm³/m²" Vector__XXX
 SG_ AppRateVolumePerArea_Def m3 : 32|32@1- (0.01,0) [0|21474836.47] "mm³/m²" Vector__XXX
 SG_ AppRateVolumePerArea_Min m4 : 32|32@1- (0.01,0) [0|21474836.47] "mm³/m²" Vector__XXX
 SG_ AppRateVolumePerArea_Max m5 : 32|32@1- (0.01,0) [0|21474836.47] "mm³/m²" Vector__XXX
 SG_ AppRateMassPerArea_Set m6 : 32|32@1- (1,0) [0|2147483647] "mg/m²" Vector__XXX
 SG_ AppRateMassPerArea_Act m7 : 32|32@1- (1,0) [0|2147483647] "mg/m²" Vector__XXX
 SG_ AppRateMassPerArea_Def m8 : 32|32@1- (1,0) [0|2147483647] "mg/m²" Vector__XXX
 SG_ AppRateMassPerArea_Min m9 : 32|32@1- (1,0) [0|2147483647] "mg/m²" Vector__XXX
 SG_ AppRateMassPerArea_Max m10 : 32|32@1- (1,0) [0|2147483647] "mg/m²" Vector__XXX
 SG_ AppRateCountPerArea_Set m11 : 32|32@1- (0.001,0) [0|2147483.647] "1/m²" Vector__XXX
 SG_ AppRateCountPerArea_Act m12 : 32|32@1- (0.001,0) [0|2147483.647] "1/m²" Vector__XXX
 SG_ AppRateCountPerArea_Def m13 : 32|32@1- (0.001,0) [0|2147483.647] "1/m²" Vector__XXX
 SG_ AppRateCountPerArea_Min m14 : 32|32@1- (0.001,0) [0|2147483.647] "1/m²" Vector__XXX
 SG_ AppRateCountPerArea_Max m15 : 32|32@1- (0.001,0) [0|2147483.647] "1/m²" Vector__XXX
 SG_ SetAppRateDistance_Set m16 : 32|32@1- (1,0) [0|2147483647] "mm" Vector__XXX
 SG_ AppRateDistance_Act m17 : 32|32@1- (1,0) [0|2147483647] "mm" Vector__XXX
 SG_ AppRateDistance_Def m18 : 32|32@1- (1,0) [0|2147483647] "mm" Vector__XXX
 SG_ AppRateDistance_Min m19 : 32|32@1- (1,0) [0|2147483647] "mm" Vector__XXX
 SG_ AppRateDistance_Max m20 : 32|32@1- (1,0) [0|2147483647] "mm" Vector__XXX
 SG_ AppRateVolumePerVolume_Set m21 : 32|32@1- (1,0) [0|2147483647] "mm³/m³" Vector__XXX
 SG_ AppRateVolumePerVolume_Act m22 : 32|32@1- (1,0) [0|2147483647] "mm³/m³" Vector__XXX
 SG_ AppRateVolumePerVolume_Def m23 : 32|32@1- (1,0) [0|2147483647] "mm³/m³" Vector__XXX
 SG_ AppRateVolumePerVolume_Min m24 : 32|32@1- (1,0) [0|2147483647] "mm³/m³" Vector__XXX
 SG_ AppRateVolumePerVolume_Max m25 : 32|32@1- (1,0) [0|2147483647] "mm³/m³" Vector__XXX
 SG_ AppRateMassPerMass_Set m26 : 32|32@1- (1,0) [0|2147483647] "mg/kg" Vector__XXX
 SG_ AppRateMassPerMass_Act m27 : 32|32@1- (1,0) [0|2147483647] "mg/kg" Vector__XXX
 SG_ AppRateMassPerMass_Def m28 : 32|32@1- (1,0) [0|2147483647] "mg/kg" Vector__XXX
 SG_ AppRateMassPerMass_Min m29 : 32|32@1- (1,0) [0|2147483647] "mg/kg" Vector__XXX
 SG_ AppRateMassPerMass_Max m30 : 32|32@1- (1,0) [0|2147483647] "mg/kg" Vector__XXX
 SG_ AppRateVolumePerMass_Set m31 : 32|32@1- (1,0) [0|2147483647] "mm³/kg" Vector__XXX
 SG_ AppRateVolumePerMass_Act m32 : 32|32@1- (1,0) [0|2147483647] "mm³/kg" Vector__XXX
 SG_ AppRateVolumePerMass_Def m33 : 32|32@1- (1,0) [0|2147483647] "mm³/kg" Vector__XXX
 SG_ AppRateVolumePerMass_Min m34 : 32|32@1- (1,0) [0|2147483647] "mm³/kg" Vector__XXX
 SG_ AppRateVolumePerMass_Max m35 : 32|32@1- (1,0) [0|2147483647] "mm³/kg" Vector__XXX
 SG_ AppRateVolumePerTime_Set m36 : 32|32@1- (1,0) [0|2147483647] "mm³/s" Vector__XXX
 SG_ AppRateVolumePerTime_Act m37 : 32|32@1- (1,0) [0|2147483647] "mm³/s" Vector__XXX
 SG_ AppRateVolumePerTime_Def m38 : 32|32@1- (1,0) [0|2147483647] "mm³/s" Vector__XXX
 SG_ AppRateVolumePerTime_Min m39 : 32|32@1- (1,0) [0|2147483647] "mm³/s" Vector__XXX
 SG_ AppRateVolumePerTime_Max m40 : 32|32@1- (1,0) [0|2147483647] "mm³/s" Vector__XXX
 SG_ AppRateMassPerTime_Set m41 : 32|32@1- (1,0) [0|2147483647] "mg/s" Vector__XXX
 SG_ AppRateMassPerTime_Act m42 : 32|32@1- (1,0) [0|2147483647] "mg/s" Vector__XXX
 SG_ AppRateMassPerTime_Def m43 : 32|32@1- (1,0) [0|2147483647] "mg/s" Vector__XXX
 SG_ AppRateMassPerTime_Min m44 : 32|32@1- (1,0) [0|2147483647] "mg/s" Vector__XXX
 SG_ AppRateMassPerTime_Max m45 : 32|32@1- (1,0) [0|2147483647] "mg/s" Vector__XXX
 SG_ AppRateCountPerTime_Set m46 : 32|32@1- (0.001,0) [0|2147483.647] "1/s" Vector__XXX
 SG_ AppRateCountPerTime_Act m47 : 32|32@1- (0.001,0) [0|2147483.647] "1/s" Vector__XXX
 SG_ AppRateCountPerTime_Def m48 : 32|32@1- (0.001,0) [0|2147483.647] "1/s" Vector__XXX
 SG_ AppRateCountPerTime_Min m49 : 32|32@1- (0.001,0) [0|2147483.647] "1/s" Vector__XXX
 SG_ AppRateCountPerTime_Max m50 : 32|32@1- (0.001,0) [0|2147483.647] "1/s" Vector__XXX
 SG_ SetTillageDepth_Set m51 : 32|32@1- (1,0) [0|2147483647] "mm" Vector__XXX
 SG_ TillageDepth_Act m52 : 32|32@1- (1,0) [0|2147483647] "mm" Vector__XXX
 SG_ TillageDepth_Def m53 : 32|32@1- (1,0) [0|2147483647] "mm" Vector__XXX
 SG_ TillageDepth_Min m54 : 32|32@1- (1,0) [0|2147483647] "mm" Vector__XXX
 SG_ TillageDepth_Max m55 : 32|32@1- (1,0) [0|2147483647] "mm" Vector__XXX
 SG_ SeedingDeph_Set m56 : 32|32@1- (1,0) [0|2147483647] "mm" Vector__XXX
 SG_ SeedingDeph_Act m57 : 32|32@1- (1,0) [0|2147483647] "mm" Vector__XXX
 SG_ SeedingDeph_Def m58 : 32|32@1- (1,0) [0|2147483647] "mm" Vector__XXX
 SG_ SeedingDeph_Min m59 : 32|32@1- (1,0) [0|2147483647] "mm" Vector__XXX
 SG_ SeedingDeph_Max m60 : 32|32@1- (1,0) [0|2147483647] "mm" Vector__XXX
 SG_ WorkingHeight_Set m61 : 32|32@1- (1,0) [0|2147483647] "mm" Vector__XXX
 SG_ WorkingHeight_Act m62 : 32|32@1- (1,0) [0|2147483647] "mm" Vector__XXX
 SG_ WorkingHeight_Def m63 : 32|32@1- (1,0) [0|2147483647] "mm" Vector__XXX
 SG_ WorkingHeight_Min m64 : 32|32@1- (1,0) [0|2147483647] "mm" Vector__XXX
 SG_ WorkingHeight_Max m65 : 32|32@1- (1,0) [0|2147483647] "mm" Vector__XXX
 SG_ WorkingWidth_Set m66 : 32|32@1- (1,0) [0|2147483647] "mm" Vector__XXX
 SG_ WorkingWidth_Act m67 : 32|32@1- (1,0) [0|2147483647] "mm" Vector__XXX
 SG_ WorkingWidth_Def m68 : 32|32@1- (1,0) [0|2147483647] "mm" Vector__XXX
 SG_ WorkingWidth_Min m69 : 32|32@1- (1,0) [0|2147483647] "mm" Vector__XXX
 SG_ WorkingWidth_Max m70 : 32|32@1- (1,0) [0|2147483647] "mm" Vector__XXX
 SG_ ContentAsVolume_Set m71 : 32|32@1- (1,0) [0|2147483647] "ml" Vector__XXX
 SG_ ContentAsVolume_Act m72 : 32|32@1- (1,0) [0|2147483647] "ml" Vector__XXX
 SG_ ContentAsVolume_Max m73 : 32|32@1- (1,0) [0|2147483647] "ml" Vector__XXX
 SG_ ContentAsMass_Set m74 : 32|32@1- (1,0) [0|2147483647] "g" Vector__XXX
 SG_ ContentAsMass_Act m75 : 32|32@1- (1,0) [0|2147483647] "g" Vector__XXX
 SG_ ContentAsMass_Max m76 : 32|32@1- (1,0) [0|2147483647] "g" Vector__XXX
 SG_ ContentAsCount_Set m77 : 32|32@1- (1,0) [0|2147483647] "" Vector__XXX
 SG_ ContentAsCount_Act m78 : 32|32@1- (1,0) [0|2147483647] "" Vector__XXX
 SG_ ContentAsCount_Max m79 : 32|32@1- (1,0) [0|2147483647] "" Vector__XXX
 SG_ AccumulatedAppAsVolume m80 : 32|32@1- (1,0) [0|2147483647] "l" Vector__XXX
 SG_ AccumulatedAppAsMass m81 : 32|32@1- (1,0) [0|2147483647] "kg" Vector__XXX
 SG_ AccumulatedAppAsCount m82 : 32|32@1- (1,0) [0|2147483647] "" Vector__XXX
 SG_ YieldVolumePerArea m83 : 32|32@1- (1,0) [0|2147483647] "ml/m²" Vector__XXX
 SG_ YieldMassPerArea m84 : 32|32@1- (1,0) [0|2147483647] "mg/m²" Vector__XXX
 SG_ YieldCountPerArea m85 : 32|32@1- (0.001,0) [0|2147483.647] "1/m²" Vector__XXX
 SG_ YieldVolumePerTime m86 : 32|32@1- (1,0) [0|2147483647] "ml/s" Vector__XXX
 SG_ YieldMassPerTime m87 : 32|32@1- (1,0) [0|2147483647] "mg/s" Vector__XXX
 SG_ YieldCountPerTime m88 : 32|32@1- (0.001,0) [0|2147483.647] "1/s" Vector__XXX
 SG_ AccumulatedYieldAsVolume m89 : 32|32@1- (1,0) [0|2147483647] "ml" Vector__XXX
 SG_ AccumulatedYieldAsMass m90 : 32|32@1- (1,0) [0|2147483647] "g" Vector__XXX
 SG_ AccumulatedYieldAsCount m91 : 32|32@1- (1,0) [0|2147483647] "" Vector__XXX
 SG_ CropYieldLossVolumePerArea m92 : 32|32@1- (1,0) [0|2147483647] "ml/m²" Vector__XXX
 SG_ CropYieldLossMassPerArea m93 : 32|32@1- (1,0) [0|2147483647] "mg/m²" Vector__XXX
 SG_ CropYieldLossCountPerArea m94 : 32|32@1- (0.001,0) [0|2147483.647] "1/m²" Vector__XXX
 SG_ CropYieldLossVolumePerTime m95 : 32|32@1- (1,0) [0|2147483647] "ml/s" Vector__XXX
 SG_ CropYieldLossMassPerTime m96 : 32|32@1- (1,0) [0|2147483647] "mg/s" Vector__XXX
 SG_ CropYieldLossCountPerTime m97 : 32|32@1- (0.001,0) [0|2147483.647] "1/s" Vector__XXX
 SG_ CropYieldLoss m98 : 32|32@1- (1,0) [0|2147483647] "ppm" Vector__XXX
 SG_ MoistureInCropYield m99 : 32|32@1- (1,0) [0|2147483647] "ppm" Vector__XXX
 SG_ DirtMaterialInCropYield m100 : 32|32@1- (1,0) [0|2147483647] "ppm" Vector__XXX
 SG_ BaleWidth_Set m101 : 32|32@1- (1,0) [0|2147483647] "mm" Vector__XXX
 SG_ BaleWidth_Act m102 : 32|32@1- (1,0) [0|2147483647] "mm" Vector__XXX
 SG_ BaleWidth_Def m103 : 32|32@1- (1,0) [0|2147483647] "mm" Vector__XXX
 SG_ BaleWidth_Min m104 : 32|32@1- (1,0) [0|2147483647] "mm" Vector__XXX
 SG_ BaleWidth_Max m105 : 32|32@1- (1,0) [0|2147483647] "mm" Vector__XXX
 SG_ BaleHeight_Set m106 : 32|32@1- (1,0) [0|2147483647] "mm" Vector__XXX
 SG_ BaleHeight_Act m107 : 32|32@1- (1,0) [0|2147483647] "mm" Vector__XXX
 SG_ BaleHeight_Def m108 : 32|32@1- (1,0) [0|2147483647] "mm" Vector__XXX
 SG_ BaleHeight_Min m109 : 32|32@1- (1,0) [0|2147483647] "mm" Vector__XXX
 SG_ BaleHeight_Max m110 : 32|32@1- (1,0) [0|2147483647] "mm" Vector__XXX
 SG_ BaleSize_Set m111 : 32|32@1- (1,0) [0|2147483647] "mm" Vector__XXX
 SG_ BaleSize_Act m112 : 32|32@1- (1,0) [0|2147483647] "mm" Vector__XXX
 SG_ BaleSize_Def m113 : 32|32@1- (1,0) [0|2147483647] "mm" Vector__XXX
 SG_ BaleSize_Min m114 : 32|32@1- (1,0) [0|2147483647] "mm" Vector__XXX
 SG_ BaleSize_Max m115 : 32|32@1- (1,0) [0|2147483647] "mm" Vector__XXX
 SG_ AccumulatedArea m116 : 32|32@1- (1,0) [0|2147483647] "m²" Vector__XXX
 SG_ AccumulatedDistanceInWork m117 : 32|32@1- (1,0) [0|2147483647] "mm" Vector__XXX
 SG_ AccumulatedDistanceOutWork m118 : 32|32@1- (1,0) [0|2147483647] "mm" Vector__XXX
 SG_ AccumulatedTimeInWork m119 : 32|32@1- (1,0) [0|2147483647] "s" Vector__XXX
 SG_ AccumulatedTimeOutWork m120 : 32|32@1- (1,0) [0|2147483647] "s" Vector__XXX
 SG_ PrdoucDensityMassPerArea m121 : 32|32@1- (1,0) [0|2147483647] "g/l" Vector__XXX
 SG_ PrdoucDensityMassPerCount m122 : 32|32@1- (1,0) [0|2147483647] "mg/1000" Vector__XXX
 SG_ PrdoucDensityVolumePerCount m123 : 32|32@1- (1,0) [0|2147483647] "ml/1000" Vector__XXX
 SG_ AuxiliaryValveScalingExtend m124 : 32|32@1- (0.1,0) [-214748367.9|214748367.9] "%" Vector__XXX
 SG_ AuxiliaryValveScalingRetract m125 : 32|32@1- (0.1,0) [-214748367.9|214748367.9] "%" Vector__XXX
 SG_ AuxiliaryRampExtendUp m126 : 32|32@1- (1,0) [-2147483647|2147483647] "ms" Vector__XXX
 SG_ AuxiliaryValveRampExtendDown m127 : 32|32@1- (1,0) [-2147483647|2147483647] "ms" Vector__XXX
 SG_ AuxiliaryValveRampRetractUp m128 : 32|32@1- (1,0) [-2147483647|2147483647] "ms" Vector__XXX
 SG_ AuxiliaryValveRampRetractDown m129 : 32|32@1- (1,0) [-2147483647|2147483647] "ms" Vector__XXX
 SG_ AuxiliaryValveFloatThreshold m130 : 32|32@1- (0.1,0) [-214748367.9|214748367.9] "%" Vector__XXX
 SG_ AuxiliaryValveProgressivExtend m131 : 32|32@1- (1,0) [-2147483647|2147483647] "" Vector__XXX
 SG_ AuxiliaryValveProgressivRetract m132 : 32|32@1- (1,0) [-2147480000|2147480000] "" Vector__XXX
 SG_ AuxiliaryValveInvertPorts m133 : 32|32@1- (1,0) [-2147480000|2147480000] "" Vector__XXX
 SG_ DeviceElementOffsetX m134 : 32|32@1- (1,0) [-2147483647|2147483647] "mm" Vector__XXX
 SG_ DeviceElementOffsetY m135 : 32|32@1- (1,0) [-2147483647|2147483647] "mm" Vector__XXX
 SG_ DeviceElementOffsetZ m136 : 32|32@1- (1,0) [-2147483647|2147483647] "mm" Vector__XXX
 SG_ DeviceVolumeCapacity m137 : 32|32@1- (1,0) [0|2147483647] "ml" Vector__XXX
 SG_ DeviceMassCapacity m138 : 32|32@1- (1,0) [0|2147483647] "g" Vector__XXX
 SG_ DeviceCountCapacity m139 : 32|32@1- (1,0) [0|2147483647] "" Vector__XXX
 SG_ PercentageAppRateSetpoint m140 : 32|32@1- (1,0) [0|2147483647] "ppm" Vector__XXX
 SG_ WorkState m141 : 32|32@1- (1,0) [0|3] "" Vector__XXX
 SG_ SetpointTimeLatency m142 : 32|32@1- (1,0) [-2147483647|2147483647] "ms" Vector__XXX
 SG_ ActualValueTimeLatency m143 : 32|32@1- (1,0) [-2147483647|2147483647] "ms" Vector__XXX
 SG_ YawAngle m144 : 32|32@1- (0.001,0) [-180|180] "°" Vector__XXX
 SG_ RollAngle m145 : 32|32@1- (0.001,0) [-180|180] "°" Vector__XXX
 SG_ PitchAngle m146 : 32|32@1- (0.001,0) [-180|180] "°" Vector__XXX
 SG_ LogCount m147 : 32|32@1- (1,0) [0|2147483647] "" Vector__XXX
 SG_ TotalFuelConsumption m148 : 32|32@1- (1,0) [0|2147483647] "ml" Vector__XXX
 SG_ FuelConsumptionPerTime m149 : 32|32@1- (1,0) [0|2147483647] "mm³/s" Vector__XXX
 SG_ FuelConsumptionPerArea m150 : 32|32@1- (1,0) [0|2147483647] "mm³/ m²" Vector__XXX
 SG_ AreaPerTimeCapacity m151 : 32|32@1- (1,0) [0|2147483647] "mm²/s" Vector__XXX
 SG_ MinMassPerAreaAppRate m152 : 32|32@1- (0.01,0) [0|2147480000] "mm³/m³" Vector__XXX
 SG_ NDVI m153 : 32|32@1- (1,0) [-1|1] "" Vector__XXX
 SG_ PhysicalObjectLength m154 : 32|32@1- (1,0) [0|2147483647] "mm" Vector__XXX
 SG_ PhysicalObjectWidth m155 : 32|32@1- (1,0) [0|2147483647] "mm" Vector__XXX
 SG_ PhysicalObjectHeight m156 : 32|32@1- (1,0) [0|2147483647] "mm" Vector__XXX
 SG_ ConnectorType m157 : 32|32@1- (1,0) [0|7] "" Vector__XXX
 SG_ PrescriptionControlState m158 : 32|32@1- (1,0) [0|3] "" Vector__XXX
 SG_ NumberOfSubUnitsPerSection m159 : 32|32@1- (1,0) [0|2147483647] "Amount/Count" Vector__XXX
 SG_ SectionControlState m160 : 32|32@1- (1,0) [0|3] "" Vector__XXX
 SG_ CondensedWorkState1to16 m161 : 32|32@1- (1,0) [-2147483648|2147483647] "" Vector__XXX
 SG_ CondensedWorkState17to32 m162 : 32|32@1- (1,0) [-2147483648|2147483647] "" Vector__XXX
 SG_ CondensedWorkState33to48 m163 : 32|32@1- (1,0) [-2147483648|2147483647] "" Vector__XXX
 SG_ CondensedWorkState49to64 m164 : 32|32@1- (1,0) [-2147483648|2147483647] "" Vector__XXX
 SG_ CondensedWorkState65to80 m165 : 32|32@1- (1,0) [-2147483648|2147483647] "" Vector__XXX
 SG_ CondensedWorkState81to96 m166 : 32|32@1- (1,0) [-2147483648|2147483647] "" Vector__XXX
 SG_ CondensedWorkState97to112 m167 : 32|32@1- (1,0) [-2147483648|2147483647] "" Vector__XXX
 SG_ CondensedWorkState113to128 m168 : 32|32@1- (1,0) [-2147483648|2147483647] "" Vector__XXX
 SG_ CondensedWorkState129to144 m169 : 32|32@1- (1,0) [-2147483648|2147483647] "" Vector__XXX
 SG_ CondensedWorkState145to160 m170 : 32|32@1- (1,0) [-2147483648|2147483647] "" Vector__XXX
 SG_ CondensedWorkState161to176 m171 : 32|32@1- (1,0) [-2147483648|2147483647] "" Vector__XXX
 SG_ CondensedWorkState177to192 m172 : 32|32@1- (1,0) [-2147483648|2147483647] "" Vector__XXX
 SG_ CondensedWorkState193to208 m173 : 32|32@1- (1,0) [-2147483648|2147483647] "" Vector__XXX
 SG_ CondensedWorkState209to224 m174 : 32|32@1- (1,0) [-2147483648|2147483647] "" Vector__XXX
 SG_ CondensedWorkState225to240 m175 : 32|32@1- (1,0) [-2147483648|2147483647] "" Vector__XXX
 SG_ CondensedWorkState241to256 m176 : 32|32@1- (1,0) [-2147483648|2147483647] "" Vector__XXX
 SG_ ActualLengthOfCut m177 : 32|32@1- (0.001,0) [0|2147483647] "mm" Vector__XXX
 SG_ ElementTypeInstance m178 : 32|32@1- (1,0) [0|65533] "" Vector__XXX
 SG_ ActualCulturalPractice m179 : 32|32@1- (1,0) [0|2147483647] "" Vector__XXX
 SG_ DRP2GroundDistance m180 : 32|32@1- (1,0) [-2147483648|2147483647] "mm" Vector__XXX
 SG_ DryMassPerAreaYield m181 : 32|32@1- (1,0) [0|2147483647] "mg/m²" Vector__XXX
 SG_ DryMassPerTimeYield m182 : 32|32@1- (1,0) [0|2147483647] "mg/s" Vector__XXX
 SG_ YieldTotalDryMass m183 : 32|32@1- (1,0) [0|2147483647] "kg" Vector__XXX
 SG_ RefMoistureForDryMass m184 : 32|32@1- (1,0) [0|2147483647] "ppm" Vector__XXX
 SG_ SeedCottonMassPerAreaYield m185 : 32|32@1- (1,0) [0|2147483647] "mg/m²" Vector__XXX
 SG_ LintCottonMassPerAreaYield m186 : 32|32@1- (1,0) [0|2147483647] "mg/m²" Vector__XXX
 SG_ SeedCottonMassPerTimeYield m187 : 32|32@1- (1,0) [0|2147483647] "mg/s" Vector__XXX
 SG_ LintCottonMassPerTimeYield m188 : 32|32@1- (1,0) [0|2147483647] "mg/s" Vector__XXX
 SG_ YieldTotalSeedCottonMass m189 : 32|32@1- (1,0) [0|2147483647] "" Vector__XXX
 SG_ YieldTotalLintCottonMass m190 : 32|32@1- (1,0) [0|2147483647] "kg" Vector__XXX
 SG_ LintTurnoutPercentage m191 : 32|32@1- (1,0) [0|2147483647] "ppm" Vector__XXX
 SG_ AmbientTemperature m192 : 32|32@1- (1,0) [0|1000000] "mK" Vector__XXX
 SG_ SetpointProductPressure m193 : 32|32@1- (0.1,0) [-2147483648|2147483647] "Pa" Vector__XXX
 SG_ ActualProductPressure m194 : 32|32@1- (0.1,0) [-2147483648|2147483647] "Pa" Vector__XXX
 SG_ MinimumProductPressure m195 : 32|32@1- (0.1,0) [-2147483648|2147483647] "Pa" Vector__XXX
 SG_ MaximumProductPressure m196 : 32|32@1- (0.1,0) [-2147483648|2147483647] "Pa" Vector__XXX
 SG_ SetpointPumpOutputPressure m197 : 32|32@1- (0.1,0) [-2147483648|2147483647] "Pa" Vector__XXX
 SG_ ActualPumpOutputPressure m198 : 32|32@1- (0.1,0) [-2147483648|2147483647] "Pa" Vector__XXX
 SG_ MinimumPumpOutputPressure m199 : 32|32@1- (0.1,0) [-2147483648|2147483647] "Pa" Vector__XXX
 SG_ MaximumPumpOutputPressure m200 : 32|32@1- (0.1,0) [-2147483648|2147483647] "Pa" Vector__XXX
 SG_ SetpointTankAgitationPressure m201 : 32|32@1- (0.1,0) [-2147483648|2147483647] "Pa" Vector__XXX
 SG_ ActualTankAgitationPressure m202 : 32|32@1- (0.1,0) [-2147483648|2147483647] "Pa" Vector__XXX
 SG_ MinimumTankAgitationPressure m203 : 32|32@1- (0.1,0) [-2147483648|2147483647] "Pa" Vector__XXX
 SG_ MaximumTankAgitationPressure m204 : 32|32@1- (0.1,0) [-2147483648|2147483647] "Pa" Vector__XXX
 SG_ SCTurnOnTime_ m205 : 32|32@1- (1,0) [-2147483648|2147483647] "ms" Vector__XXX
 SG_ SCTurnOffTime m206 : 32|32@1- (1,0) [-2147483648|2147483647] "ms" Vector__XXX
 SG_ WindSpeed m207 : 32|32@1- (1,0) [0|100000000] "mm/s" Vector__XXX
 SG_ WindDirection m208 : 32|32@1- (1,0) [0|359] "°" Vector__XXX
 SG_ AirHumidity m209 : 32|32@1- (1,0) [0|100] "%" Vector__XXX
 SG_ SkyConditions m210 : 32|32@1- (1,0) [-2147483648|2147483647] "" Vector__XXX
 SG_ LastBaleFlakesPerBale m211 : 32|32@1- (1,0) [0|1000] "Amount/Count" Vector__XXX
 SG_ LastBaleAverageMoisture m212 : 32|32@1- (1,0) [0|100000000] "ppm" Vector__XXX
 SG_ LastBaleAverageStrokesPerFlake m213 : 32|32@1- (1,0) [0|1000] "Amount/Count" Vector__XXX
 SG_ LifetimeBaleCount m214 : 32|32@1- (1,0) [0|2147483647] "Amount/Count" Vector__XXX
 SG_ LifetimeWorkingHours m215 : 32|32@1- (0.05,0) [0|2147483647] "h" Vector__XXX
 SG_ ActualBaleHydraulicPressure m216 : 32|32@1- (1,0) [0|2147483647] "Pa" Vector__XXX
 SG_ LastBaleAverageHydraulicPressure m217 : 32|32@1- (1,0) [0|2147483647] "Pa" Vector__XXX
 SG_ SetpointBaleCompressionPlungerLo m218 : 32|32@1- (1,0) [0|2000] "" Vector__XXX
 SG_ ActualBaleCompressionPlungerLoad m219 : 32|32@1- (1,0) [0|2000] "" Vector__XXX
 SG_ LastBaleAverageBaleCompressionPl m220 : 32|32@1- (1,0) [0|2000] "" Vector__XXX
 SG_ LastBaleAppliedPreservative m221 : 32|32@1- (1,0) [0|2147483647] "ml" Vector__XXX
 SG_ LastBaleTagNumber m222 : 32|32@1- (1,0) [0|2147483647] "" Vector__XXX
 SG_ LastBaleMass m223 : 32|32@1- (1,0) [0|2147483647] "g" Vector__XXX
 SG_ DeltaT m224 : 32|32@1- (1,0) [0|1000000] "mK" Vector__XXX
 SG_ SetpointWorkingLength m225 : 32|32@1- (1,0) [-2147483648|2147483647] "mm" Vector__XXX
 SG_ ActualWorkingLength m226 : 32|32@1- (1,0) [-2147483648|2147483647] "mm" Vector__XXX
 SG_ MinimumWorkingLength m227 : 32|32@1- (1,0) [-2147483648|2147483647] "mm" Vector__XXX
 SG_ MaximumWorkingLength m228 : 32|32@1- (1,0) [-2147483648|2147483647] "mm" Vector__XXX
 SG_ ActualNetWeight m229 : 32|32@1- (1,0) [-2147483648|2147483647] "g" Vector__XXX
 SG_ NetWeightState m230 : 32|32@1- (1,0) [0|3] "" Vector__XXX
 SG_ SetpointNetWeight m231 : 32|32@1- (1,0) [-2147483648|2147483647] "g" Vector__XXX
 SG_ ActualGrossWeight m232 : 32|32@1- (1,0) [-2147483648|2147483647] "g" Vector__XXX
 SG_ GrossWeightState m233 : 32|32@1- (1,0) [0|3] "" Vector__XXX
 SG_ MinimumGrossWeight m234 : 32|32@1- (1,0) [-2147483648|2147483647] "g" Vector__XXX
 SG_ MaximumGrossWeight m235 : 32|32@1- (1,0) [-2147483648|2147483647] "g" Vector__XXX
 SG_ ThreshingEngagementTotalTime m236 : 32|32@1- (1,0) [0|2147483647] "s" Vector__XXX
 SG_ ActualHeaderWorkingHeightStatus m237 : 32|32@1- (1,0) [0|3] "" Vector__XXX
 SG_ ActualHeaderRotationalSpeedStatu m238 : 32|32@1- (1,0) [0|3] "" Vector__XXX
 SG_ YieldHoldStatus m239 : 32|32@1- (1,0) [0|3] "" Vector__XXX
 SG_ ActualUnLoadingSystemStatus m240 : 32|32@1- (1,0) [0|771] "" Vector__XXX
 SG_ CropTemperature m241 : 32|32@1- (1,0) [0|1000000] "mK" Vector__XXX
 SG_ SetpointSieveClearance m242 : 32|32@1- (1,0) [0|2147483647] "mm" Vector__XXX
 SG_ ActualSieveClearance m243 : 32|32@1- (1,0) [0|2147483647] "mm" Vector__XXX
 SG_ MinimumSieveClearance m244 : 32|32@1- (1,0) [0|2147483647] "mm" Vector__XXX
 SG_ MaximumSieveClearance m245 : 32|32@1- (1,0) [0|2147483647] "mm" Vector__XXX
 SG_ SetpointChafferClearance m246 : 32|32@1- (1,0) [0|2147483647] "mm" Vector__XXX
 SG_ ActualChafferClearance m247 : 32|32@1- (1,0) [0|2147483647] "mm" Vector__XXX
 SG_ MinimumChafferClearance m248 : 32|32@1- (1,0) [0|2147483647] "mm" Vector__XXX
 SG_ MaximumChafferClearance m249 : 32|32@1- (1,0) [0|2147483647] "mm" Vector__XXX
 SG_ SetpointConcaveClearance m250 : 32|32@1- (1,0) [0|2147483647] "mm" Vector__XXX
 SG_ ActualConcaveClearance m251 : 32|32@1- (1,0) [0|2147483647] "mm" Vector__XXX
 SG_ MinimumConcaveClearance m252 : 32|32@1- (1,0) [0|2147483647] "mm" Vector__XXX
 SG_ MaximumConcaveClearance m253 : 32|32@1- (1,0) [0|2147483647] "mm" Vector__XXX
 SG_ SetpointSeparationFanRotationalS m254 : 32|32@1- (0.001,0) [0|2147483647] "1/s" Vector__XXX
 SG_ ActualSeparationFanRotationalSpe m255 : 32|32@1- (0.001,0) [0|2147483647] "1/s" Vector__XXX
 SG_ MinimumSeparationFanRotationalSp m256 : 32|32@1- (0.001,0) [0|2147483647] "1/s" Vector__XXX
 SG_ MaximumSeparationFanRotationalSp m257 : 32|32@1- (0.001,0) [0|2147483647] "1/s" Vector__XXX
 SG_ HydraulicOilTemperature m258 : 32|32@1- (1,0) [0|2000000] "mK" Vector__XXX
 SG_ YieldLagIgnoreTime m259 : 32|32@1- (1,0) [0|2147483647] "ms" Vector__XXX
 SG_ YieldLeadIgnoreTime m260 : 32|32@1- (1,0) [0|2147483647] "ms" Vector__XXX
 SG_ AverageYieldMassPerTime m261 : 32|32@1- (1,0) [0|2147483647] "mg/s" Vector__XXX
 SG_ AverageCropMoisture m262 : 32|32@1- (1,0) [0|2147483647] "ppm" Vector__XXX
 SG_ AverageYieldMassPerArea m263 : 32|32@1- (1,0) [0|2147483647] "mg/m²" Vector__XXX
 SG_ ConnectorPivotXOffset m264 : 32|32@1- (1,0) [-2147483648|2147483647] "mm" Vector__XXX
 SG_ RemainingArea m265 : 32|32@1- (1,0) [0|2147483647] "m²" Vector__XXX
 SG_ LifetimeApplicationTotalMass m266 : 32|32@1- (1,0) [0|2147483647] "kg" Vector__XXX
 SG_ LifetimeApplicationTotalCount m267 : 32|32@1- (1,0) [0|2147483647] "" Vector__XXX
 SG_ LifetimeYieldTotalVolume m268 : 32|32@1- (1,0) [0|2147483647] "L" Vector__XXX
 SG_ LifetimeYieldTotalMass m269 : 32|32@1- (1,0) [0|2147483647] "kg" Vector__XXX
 SG_ LifetimeYieldTotalCount m270 : 32|32@1- (1,0) [0|2147483647] "" Vector__XXX
 SG_ LifetimeTotalArea m271 : 32|32@1- (1,0) [0|2147483647] "m²" Vector__XXX
 SG_ LifetimeTotalDistance m272 : 32|32@1- (1,0) [0|2147483647] "m" Vector__XXX
 SG_ LifetimeIneffectiveTotalDistance m273 : 32|32@1- (1,0) [0|2147483647] "m" Vector__XXX
 SG_ LifetimeEffectiveTotalTime m274 : 32|32@1- (1,0) [0|2147483647] "s" Vector__XXX
 SG_ LifetimeIneffectiveTotalTime m275 : 32|32@1- (1,0) [0|2147483647] "s" Vector__XXX
 SG_ LifetimeFuelConsumption m276 : 32|32@1- (0.5,0) [0|2147483647] "L" Vector__XXX
 SG_ LifetimeAverageFuelConsumptionPe m277 : 32|32@1- (1,0) [0|2147483647] "mm³/s" Vector__XXX
 SG_ LifetimeAverageFuelConsumpt_0000 m278 : 32|32@1- (1,0) [0|2147483647] "mm³/m²" Vector__XXX
 SG_ LifetimeYieldTotalDryMass m279 : 32|32@1- (1,0) [0|2147483647] "kg" Vector__XXX
 SG_ LifetimeYieldTotalSeedCottonMass m280 : 32|32@1- (1,0) [0|2147483647] "" Vector__XXX
 SG_ LifetimeYieldTotalLintCottonMass m281 : 32|32@1- (1,0) [0|2147483647] "kg" Vector__XXX
 SG_ LifetimeThreshingEngagementTotal m282 : 32|32@1- (1,0) [0|2147483647] "s" Vector__XXX
 SG_ PrecutTotalCount m283 : 32|32@1- (1,0) [0|2147483647] "" Vector__XXX
 SG_ UncutTotalCount m284 : 32|32@1- (1,0) [0|2147483647] "" Vector__XXX
 SG_ LifetimePrecutTotalCount m285 : 32|32@1- (1,0) [0|2147483647] "" Vector__XXX
 SG_ LifetimeUncutTotalCount m286 : 32|32@1- (1,0) [0|2147483647] "" Vector__XXX
 SG_ SetpointWorkState m289 : 32|32@1- (1,0) [0|3] "" Vector__XXX
 SG_ SetpointCondensedWorkState1to16 m290 : 32|32@1+ (1,0) [0|4294967295] "" Vector__XXX
 SG_ SetpointCondensedWorkState17to32 m291 : 32|32@1+ (1,0) [0|4294967295] "" Vector__XXX
 SG_ SetpointCondensedWorkState33to48 m292 : 32|32@1+ (1,0) [0|4294967295] "" Vector__XXX
 SG_ SetpointCondensedWorkState49to64 m293 : 32|32@1+ (1,0) [0|4294967295] "" Vector__XXX
 SG_ SetpointCondensedWorkState65to80 m294 : 32|32@1+ (1,0) [0|4294967295] "" Vector__XXX
 SG_ SetpointCondensedWorkState81to96 m295 : 32|32@1+ (1,0) [0|4294967295] "" Vector__XXX
 SG_ SetpointCondensedWorkState97to11 m296 : 32|32@1+ (1,0) [0|4294967295] "" Vector__XXX
 SG_ SetpointCondensedWorkState113to1 m297 : 32|32@1+ (1,0) [0|4294967295] "" Vector__XXX
 SG_ SetpointCondensedWorkState129to1 m298 : 32|32@1+ (1,0) [0|4294967295] "" Vector__XXX
 SG_ SetpointCondensedWorkState145to1 m299 : 32|32@1+ (1,0) [0|4294967295] "" Vector__XXX
 SG_ SetpointCondensedWorkState161to1 m300 : 32|32@1+ (1,0) [0|4294967295] "" Vector__XXX
 SG_ SetpointCondensedWorkState177to1 m301 : 32|32@1+ (1,0) [0|4294967295] "" Vector__XXX
 SG_ SetpointCondensedWorkState193to2 m302 : 32|32@1+ (1,0) [0|4294967295] "" Vector__XXX
 SG_ SetpointCondensedWorkState209to2 m303 : 32|32@1+ (1,0) [0|4294967295] "" Vector__XXX
 SG_ SetpointCondensedWorkState225to2 m304 : 32|32@1+ (1,0) [0|4294967295] "" Vector__XXX
 SG_ SetpointCondensedWorkState241to2 m305 : 32|32@1+ (1,0) [0|4294967295] "" Vector__XXX
 SG_ TrueRotationPointXOffset m306 : 32|32@1- (1,0) [-2147483648|2147483647] "mm" Vector__XXX
 SG_ TrueRotationPointYOffset m307 : 32|32@1- (1,0) [-2147483648|2147483647] "mm" Vector__XXX
 SG_ ActualPercentageApplicationRate m308 : 32|32@1- (1,0) [0|2147483647] "ppm" Vector__XXX
 SG_ MinimumPercentageApplicationRate m309 : 32|32@1- (1,0) [0|2147483647] "ppm" Vector__XXX
 SG_ MaximumPercentageApplicationRate m310 : 32|32@1- (1,0) [0|2147483647] "ppm" Vector__XXX
 SG_ RelativeYieldPotential m311 : 32|32@1- (1,0) [0|2147483647] "ppm" Vector__XXX
 SG_ MinimumRelativeYieldPotential m312 : 32|32@1- (1,0) [0|2147483647] "ppm" Vector__XXX
 SG_ MaximumRelativeYieldPotential m313 : 32|32@1- (1,0) [0|2147483647] "ppm" Vector__XXX
 SG_ ActualPercentageCropDryMatter m314 : 32|32@1- (1,0) [0|2147483647] "ppm" Vector__XXX
 SG_ AveragePercentageCropDryMatter m315 : 32|32@1- (1,0) [0|2147483647] "ppm" Vector__XXX
 SG_ EffectiveTotalFuelConsumption m316 : 32|32@1- (1,0) [0|2147483647] "ml" Vector__XXX
 SG_ IneffectiveTotalFuelConsumption m317 : 32|32@1- (1,0) [0|2147483647] "ml" Vector__XXX
 SG_ EffectiveTotalDieselExhaustFluid m318 : 32|32@1- (1,0) [0|2147483647] "ml" Vector__XXX
 SG_ IneffectiveTotalDieselExhaustFlu m319 : 32|32@1- (1,0) [0|2147483647] "ml" Vector__XXX
 SG_ LastLoadedWeight m320 : 32|32@1- (1,0) [0|2147483647] "g" Vector__XXX
 SG_ LastUnloadedWeight m321 : 32|32@1- (1,0) [0|2147483647] "g" Vector__XXX
 SG_ PGNBasedData m57342 : 32|32@1- (1,0) [-2147483648|2147483647] "" Vector__XXX
 SG_ RequestDefaultProcessData m57343 : 32|32@1- (1,0) [0|0] "" Vector__XXX
 SG_ ObjectIdOfFaultyObject m9 : 32|16@1+ (1,0) [0|65535] "" Vector__XXX
 SG_ ErrorCodeProcessData1 m13 : 32|1@1+ (1,0) [0|1] "" Vector__XXX
 SG_ StatusTotalsActive m14 : 32|1@1+ (1,0) [0|1] "" Vector__XXX
 SG_ Status_TotalsActive m15 : 32|1@1+ (1,0) [0|1] "" Vector__XXX
 SG_ DateFormatCmd m2 : 32|8@1+ (1,0) [0|255] "" Vector__XXX
 SG_ DataDictionaryVersion m0 : 32|32@1- (1,0) [0|21474800] "" Vector__XXX
 SG_ PeerControlCommand m9M : 32|4@1+ (1,0) [0|5] "" Vector__XXX
 SG_ DecimalSymbolCmd m2 : 30|2@1+ (1,0) [0|3] "" Vector__XXX
 SG_ TimeFormatCmd m2 : 28|2@1+ (1,0) [0|3] "" Vector__XXX
 SG_ ImplementSectionControl m1 : 28|1@1+ (1,0) [0|1] "" Vector__XXX
 SG_ PeerControlAssignment m1 : 27|1@1+ (1,0) [0|1] "" Vector__XXX
 SG_ TC_GEO_DefinitionPositionBasedCo m1 : 26|1@1+ (1,0) [0|1] "" Vector__XXX
 SG_ TimeAndPositionForDataLogging m1 : 25|1@1+ (1,0) [0|1] "" Vector__XXX
 SG_ Documentation m1 : 24|1@1+ (1,0) [0|1] "" Vector__XXX
 SG_ ErrorCodeChangeDesignator m13 : 24|8@1+ (1,0) [0|0] "" Vector__XXX
 SG_ DesignatorLength m12 : 24|8@1+ (1,0) [0|255] "bytes" Vector__XXX
 SG_ DDI_TI m4 : 16|16@1+ (1,0) [0|65535] "" Vector__XXX
 SG_ DDI_DI m5 : 16|16@1+ (1,0) [0|65535] "" Vector__XXX
 SG_ ErrorDDI m13 : 16|16@1+ (1,0) [0|65535] "" Vector__XXX
 SG_ ParentObjectIdOfFaultyObject m9 : 16|16@1+ (1,0) [0|65535] "" Vector__XXX
 SG_ ReceivedDataSize m7 : 16|32@1+ (1,0) [0|4294967295] "bytes" Vector__XXX
 SG_ DDI m2M : 16|16@1+ (1,0) [0|65535] "" Vector__XXX
 SG_ BootTimeTC m1 : 16|8@1+ (1,0) [0|255] "s" Vector__XXX
 SG_ PeerControlDDI m9 : 16|16@1+ (1,0) [0|65535] "" Vector__XXX
 SG_ LanguageCodeCmd m2 : 15|16@0+ (1,0) [0|16383] "" Vector__XXX
 SG_ ErrorCodeObjPoolActiveResp3 m9 : 10|1@1+ (1,0) [0|0] "" Vector__XXX
 SG_ ErrorCodeObjPoolActiveResp2 m9 : 9|1@1+ (1,0) [0|0] "" Vector__XXX
 SG_ StructureLabel m0 : 8|56@1+ (1,0) [0|0] "" Vector__XXX
 SG_ VersionNumberISO11783Part10 m1 : 8|8@1- (1,0) [0|255] "" Vector__XXX
 SG_ RequestTransferDataSize m4 : 8|32@1+ (1,0) [0|4294967295] "bytes" Vector__XXX
 SG_ Status m5 : 8|8@1+ (1,0) [0|1] "" Vector__XXX
 SG_ ErrorCodeObjPoolTransfer m7 : 8|8@1+ (1,0) [0|3] "" Vector__XXX
 SG_ ActivateDeactivateCommand m8 : 8|8@1+ (1,0) [0|255] "" Vector__XXX
 SG_ ErrorCodeObjectPoolDelete m11 : 8|8@1+ (1,0) [0|0] "" Vector__XXX
 SG_ ObjectIdToChange m12 : 8|16@1+ (1,0) [0|65535] "" Vector__XXX
 SG_ ObjectIdChanged m13 : 8|16@1+ (1,0) [0|65535] "" Vector__XXX
 SG_ ErrorCodeObjPoolActiveResp1 m9 : 8|1@1+ (1,0) [0|0] "" Vector__XXX
 SG_ TechnicalDataMsgType m0M : 4|4@1+ (1,0) [0|15] "" Vector__XXX
 SG_ DeviceDescriptionMsgType m1M : 4|4@1+ (1,0) [0|15] "" Vector__XXX
 SG_ ElementNumber m2 : 4|12@1+ (1,0) [0|4095] "" Vector__XXX
 SG_ ErrorElementNumber m13 : 4|12@1+ (1,0) [0|4095] "" Vector__XXX
 SG_ Command M : 0|4@1+ (1,0) [0|15] "" Vector__XXX
 SG_ NumberOfControlChannels m1 : 56|8@1+ (1,0) [0|255] "" Vector__XXX

BO_ 2565406455 ACKM_TC: 8 TC
 SG_ ParameterGroupNumber : 40|24@1+ (1,0) [0|16777215] "" Vector__XXX
 SG_ AddressBusy m3 : 32|8@1+ (1,0) [0|255] "" Vector__XXX
 SG_ AddressAccessDenied m2 : 32|8@1+ (1,0) [0|255] "" Vector__XXX
 SG_ AddressNegativeAcknowledgement m1 : 32|8@1+ (1,0) [0|255] "" Vector__XXX
 SG_ AddressAcknowledged m0 : 32|8@1+ (1,0) [0|255] "" Vector__XXX
 SG_ GroupFunctionValue : 8|8@1+ (1,0) [0|255] "" Vector__XXX
 SG_ ControlByte M : 0|8@1+ (1,0) [0|255] "" Vector__XXX

BO_ 2565799671 ACL_TC: 8 TC
 SG_ ArbitraryAddressCapable : 63|1@1+ (1,0) [0|1] "" Vector__XXX
 SG_ IndustryGroup M : 60|3@1+ (1,0) [0|7] "" Vector__XXX
 SG_ VehicleSystemInstance : 56|4@1+ (1,0) [0|15] "" Vector__XXX
 SG_ VehicleSystem m0 : 49|7@1+ (1,0) [0|127] "" Vector__XXX
 SG_ VehicleSystem5 m5 : 49|7@1+ (1,0) [0|127] "" Vector__XXX
 SG_ VehicleSystem4 m4 : 49|7@1+ (1,0) [0|127] "" Vector__XXX
 SG_ VehicleSystem3 m3 : 49|7@1+ (1,0) [0|127] "" Vector__XXX
 SG_ VehicleSystem2 m2 : 49|7@1+ (1,0) [0|127] "" Vector__XXX
 SG_ VehicleSystem1 m1 : 49|7@1+ (1,0) [0|127] "" Vector__XXX
 SG_ Function : 40|8@1+ (1,0) [0|255] "" Vector__XXX
 SG_ FunctionInstance : 35|5@1+ (1,0) [0|31] "" Vector__XXX
 SG_ ECUInstance : 32|3@1+ (1,0) [0|7] "" Vector__XXX
 SG_ ManufacturerCode : 21|11@1+ (1,0) [0|2047] "" Vector__XXX
 SG_ IdentityNumber : 0|21@1+ (1,0) [0|2097152] "" Vector__XXX

CM_ BO_ 3221225472 "This is a message for not used signals, created by Vector CANdb++ DBC OLE DB Provider.";
CM_ SG_ 3221225472 NumOfReportedFuncCharacteristics "Number of functionality characteristics reported in this message";
CM_ SG_ 3221225472 FirstListedFuncCharacteristic "This parameter reports which functionalities characteristics are supported by a control function connected to 
the ISO 11783 network.";
CM_ SG_ 3221225472 FirstListedFuncGen "This parameter reports the generation of the first listed functionality.";
CM_ SG_ 3221225472 VTFuncOptions "This parameter reports which VT functionality options are supported by an implement working set master or a 
VT that is connected to the ISO 11783 network. ";
CM_ SG_ 3221225472 TCBasicFuncOptions "This  parameter  reports  which  basic  task  controller  functionality  options  are  supported  by  an  implement 
working set master or a task controller that is connected to the ISO 11783 network.";
CM_ SG_ 3221225472 TCGeoSupportedChannels "This  parameter  reports  the  number  of  control  channels  are  required  by  a  TC-GEO  implement  working  set 
master or supported by a TC-GEO service type task controller that is connected to the ISO 11783 network. ";
CM_ SG_ 3221225472 TCGeoFuncOptions "This parameter reports which task controller geo functionality options are supported by an implement working 
set master or a task controller that is connected to the ISO 11783 network. ";
CM_ SG_ 3221225472 TCSectionNumberOfBooms "This parameter reports how many booms are required by an implement working set master or supported by a 
task controller geo that is connected to the ISO 11783 network. ";
CM_ SG_ 3221225472 TCSectionNumberOfSections "This parameter reports how many sections are required by an implement working set master or supported by 
a task controller geo that is connected to the ISO 11783 network. ";
CM_ SG_ 3221225472 SequenceControlFuncOptions "This parameter reports which sequence control (SQC) functionality options are supported by an implement 
working set master or a sequence control master that is connected to the ISO 11783 network. ";
CM_ SG_ 3221225472 StopAllImplementOperationsOption "This  parameter  reports  which  stop  all  implement  operations  functionality  options  are  supported  by  an 
implement working set master or a stop all implement operations input unit that is connected to the ISO 11783 
network. ";
CM_ SG_ 3221225472 DiagnosticOptions "This  parameter  reports  which  diagnostics  functionality  options  are  supported  by  a  controller  or  external 
diagnostic tool that is connected to the ISO 11783 network. ";
CM_ SG_ 3221225472 MachineSelSpeedExitReason "Parameter used to indicate why the vehicle speed control unit cannot currently accept remote commands or 
has most recently stopped accepting remote commands. ";
CM_ SG_ 3221225472 NumberOfOptionsBytes "This parameter reports the number of bytes that follow to report which options are supported by a functionality 
provided by a control function connected to the ISO 11783 network. ";
CM_ SG_ 3221225472 AuxControlType1FuncOptions "This  parameter  reports  which  Auxiliary  control  type  1  functionality  type  functions  are  supported  by  an 
implement working set auxiliary function or an auxiliary function input unit that is connected to the ISO 11783 
network. ";
CM_ SG_ 3221225472 CertTypeAuxControlFunc "Parameter used to indicate the type of compliance test performed. ";
CM_ SG_ 3221225472 CertTypeAuxControlInUnit "Parameter used to indicate the type of compliance test performed.";
CM_ SG_ 3221225472 CertTypeDataLogger "Parameter used to indicate the type of compliance test performed. ";
CM_ SG_ 3221225472 CertTypeDataLoggerWSMaster "Parameter used to indicate the type of compliance test performed. ";
CM_ SG_ 3221225472 CertTypeDataLoggerWSMember "Parameter used to indicate the type of compliance test performed. ";
CM_ SG_ 3221225472 CertTypeFileClient "Parameter used to indicate the type of compliance test performed. ";
CM_ SG_ 3221225472 CertTypeSecControlClient "Parameter used to indicate the type of compliance test performed. ";
CM_ SG_ 3221225472 CertTypeSeqControlMaster "Parameter used to indicate the type of compliance test performed. ";
CM_ SG_ 3221225472 CertTypeTCSectionControl "Parameter used to indicate the type of compliance test performed. ";
CM_ SG_ 3221225472 CertTypeTCSectionControlWSMember "Parameter used to indicate the type of compliance test performed. ";
CM_ BO_ 2362179319 "The Process Data message is used for the transmission of device description data, 
measured data and or set point commands to one or more controllers.";
CM_ SG_ 2362179319 ApplicationTotalMass "Accumulated Application specified as mass in gram [g]
.
Comment: is a counter of a device elemen.";
CM_ SG_ 2362179319 ApplicationTotalVolume "Accumulated Application specified as volume in milliliter [ml]
.
Comment: is a counter of a device element.";
CM_ SG_ 2362179319 FunctionType "The Function Type DDE can be used to define the operation or functionality performed 
by the device element of type Function defined within the DDOP. 
The values to be used are defined in the attached document.";
CM_ SG_ 2362179319 NozzleDriftReduction "The Nozzle Drift Reduction classification value of the spraying equipment as percentage.";
CM_ SG_ 2362179319 MaximumSwathingWidth "This is the maximum with of the swath the raker can create.";
CM_ SG_ 2362179319 MinimumSwathingWidth "This is the minimum swath width the raker can create.";
CM_ SG_ 2362179319 ActualSwathingWidth "This is the width of the swath currently created by a raker.";
CM_ SG_ 2362179319 SetpointSwathingWidth "This is the setpoint swathing width of the swath created by a raker.";
CM_ SG_ 2362179319 MaximumGrainKernelCrackerGap "The maximum gap (distance) of the grain kernel cracker drums in a chopper.";
CM_ SG_ 2362179319 MinimumGrainKernelCrackerGap "The minimum gap (distance) of the grain kernel cracker drums in a chopper.";
CM_ SG_ 2362179319 ActualGrainKernelCrackerGap "The actual gap (distance) of the grain kernel cracker drums in a chopper";
CM_ SG_ 2362179319 SetpointGrainKernelCrackerGap "The setpoint gap (distance) of the grain kernel cracker drums in a chopper.";
CM_ SG_ 2362179319 EffectiveUnloadingTime "The total time needed in the current task to unload a product crop.";
CM_ SG_ 2362179319 EffectiveLoadingTime "The total time needed in the current task to load a product such as crop.";
CM_ SG_ 2362179319 LiftimeRearPTOHours "The hours the Rear PTO of the machine was running for the lifetime of the machine";
CM_ SG_ 2362179319 LifetimeFrontPTOHours "The hours the Front PTO of the machine was running for the lifetime of the machine.";
CM_ SG_ 2362179319 RearPTOHours "The hours the Rear PTO of the machine was running for the current Task";
CM_ SG_ 2362179319 FrontPTOHours "The hours the Front PTO of the machine was running for the current Task";
CM_ SG_ 2362179319 OperatingHoursSinceLastSharpenin "This value describes the working hours since the last sharpening of the cutting device.";
CM_ SG_ 2362179319 MaximumCuttingDrumSpeed "The maximum speed of the cutting drum of a chopper.

Comment: This is a value recommented by the manufacturer of the machine as the maximum speed the machine is able to offer.";
CM_ SG_ 2362179319 ActualCuttingDrumSpeed "The actual speed of the cutting drum of a chopper";
CM_ SG_ 2362179319 SetpointCuttingDrumSpeed "The setpoint speed of the cutting drum of a chopper.";
CM_ SG_ 2362179319 MaximumHeaderSpeed "The maximum rotational speed of the header attachment of a chopper, mower or combine.

Comment: 
This is a value recommented by the manufacturer of the machine as the maximum speed the machine is able to offer";
CM_ SG_ 2362179319 MinimumHeaderSpeed "The minimum rotational speed of the header attachment of a chopper, mower or combine";
CM_ SG_ 2362179319 ActualHeaderSpeed "The actual rotational speed of the header attachment of a chopper, mower or combine";
CM_ SG_ 2362179319 SetpointHeaderSpeed "The setpoint rotational speed of the header attachment of a chopper, mower or combine";
CM_ SG_ 2362179319 NumberOfSection "Number of sections across all booms for section control";
CM_ SG_ 2362179319 NumberOfBooms "Number of booms for section control";
CM_ SG_ 2362179319 DestinationElementNumber "Device Element Number";
CM_ SG_ 2362179319 DataLogTimeInterval "Time interval for data log in ms, 0 stops measurement, 100 ms is minimum time interval.";
CM_ SG_ 2362179319 DataLogDistanceInterval "Distance interval for data log in mm, 0 stops measurement.";
CM_ SG_ 2362179319 AppRateVolumePerArea_Set "Setpoint Application Rate specified as volume per area";
CM_ SG_ 2362179319 AppRateVolumePerArea_Act "Actual Application Rate specified as volume per area";
CM_ SG_ 2362179319 AppRateVolumePerArea_Def "Default Application Rate specified as volume per area";
CM_ SG_ 2362179319 AppRateVolumePerArea_Min "Minimum Application Rate specified as volume per area";
CM_ SG_ 2362179319 AppRateVolumePerArea_Max "Maximum Application Rate specified as volume per area";
CM_ SG_ 2362179319 AppRateMassPerArea_Set "Setpoint Application Rate specified as mass per area";
CM_ SG_ 2362179319 AppRateMassPerArea_Act "Actual Application Rate specified as mass per area";
CM_ SG_ 2362179319 AppRateMassPerArea_Def "Default Application Rate specified as mass per area";
CM_ SG_ 2362179319 AppRateMassPerArea_Min "Minimum Application Rate specified as mass per area";
CM_ SG_ 2362179319 AppRateMassPerArea_Max "Maximum Application Rate specified as mass per area";
CM_ SG_ 2362179319 AppRateCountPerArea_Set "Setpoint Application Rate specified as count per area";
CM_ SG_ 2362179319 AppRateCountPerArea_Act "Actual Application Rate specified as count per area";
CM_ SG_ 2362179319 AppRateCountPerArea_Def "Default Application Rate specified as count per area";
CM_ SG_ 2362179319 AppRateCountPerArea_Min "Minimum Application Rate specified as count per area";
CM_ SG_ 2362179319 AppRateCountPerArea_Max "Maximum Application Rate specified as count per area";
CM_ SG_ 2362179319 SetAppRateDistance_Set "Setpoint Application Rate specified as distance";
CM_ SG_ 2362179319 AppRateDistance_Act "Actual Application Rate specified as distance";
CM_ SG_ 2362179319 AppRateDistance_Def "Default Application Rate specified as distance";
CM_ SG_ 2362179319 AppRateDistance_Min "Minimum Application Rate specified as distance";
CM_ SG_ 2362179319 AppRateDistance_Max "Maximum Application Rate specified as distance";
CM_ SG_ 2362179319 AppRateVolumePerVolume_Set "Setpoint Application Rate specified as volume per volume";
CM_ SG_ 2362179319 AppRateVolumePerVolume_Act "Actual Application Rate specified as volume per volume";
CM_ SG_ 2362179319 AppRateVolumePerVolume_Def "Default Application Rate specified as volume per volume";
CM_ SG_ 2362179319 AppRateVolumePerVolume_Min "Minimum Application Rate specified as volume per volume";
CM_ SG_ 2362179319 AppRateVolumePerVolume_Max "Maximum Application Rate specified as volume per volume";
CM_ SG_ 2362179319 AppRateMassPerMass_Set "Setpoint Application Rate specified as mass per mass";
CM_ SG_ 2362179319 AppRateMassPerMass_Act "Actual Application Rate specified as mass per mass";
CM_ SG_ 2362179319 AppRateMassPerMass_Def "Default Application Rate specified as mass per mass";
CM_ SG_ 2362179319 AppRateMassPerMass_Min "Minimum Application Rate specified as mass per mass";
CM_ SG_ 2362179319 AppRateMassPerMass_Max "Maximum Application Rate specified as mass per mass";
CM_ SG_ 2362179319 AppRateVolumePerMass_Set "Setpoint Application Rate specified as volume per mass";
CM_ SG_ 2362179319 AppRateVolumePerMass_Act "Actual Application Rate specified as volume per mass";
CM_ SG_ 2362179319 AppRateVolumePerMass_Def "Default Application Rate specified as volume per mass";
CM_ SG_ 2362179319 AppRateVolumePerMass_Min "Minimum Application Rate specified as volume per mass";
CM_ SG_ 2362179319 AppRateVolumePerMass_Max "Maximum Application Rate specified as volume per mass";
CM_ SG_ 2362179319 AppRateVolumePerTime_Set "Setpoint Application Rate specified as volume per time";
CM_ SG_ 2362179319 AppRateVolumePerTime_Act "Actual Application Rate specified as volume per time";
CM_ SG_ 2362179319 AppRateVolumePerTime_Def "Default Application Rate specified as volume per time";
CM_ SG_ 2362179319 AppRateVolumePerTime_Min "Minimum Application Rate specified as volume per time";
CM_ SG_ 2362179319 AppRateVolumePerTime_Max "Maximum Application Rate specified as volume per time";
CM_ SG_ 2362179319 AppRateMassPerTime_Set "Setpoint Application Rate specified as mass per time";
CM_ SG_ 2362179319 AppRateMassPerTime_Act "Actual Application Rate specified as mass per time";
CM_ SG_ 2362179319 AppRateMassPerTime_Def "Defaut Application Rate specified as mass per time";
CM_ SG_ 2362179319 AppRateMassPerTime_Min "Minimum Application Rate specified as mass per time";
CM_ SG_ 2362179319 AppRateMassPerTime_Max "Maximum Application Rate specified as mass per time";
CM_ SG_ 2362179319 AppRateCountPerTime_Set "Setpoint Application Rate specified as count per time";
CM_ SG_ 2362179319 AppRateCountPerTime_Act "Actual Application Rate specified as count per time";
CM_ SG_ 2362179319 AppRateCountPerTime_Def "Default Application Rate specified as count per time";
CM_ SG_ 2362179319 AppRateCountPerTime_Min "Minimum Application Rate specified as count per time";
CM_ SG_ 2362179319 AppRateCountPerTime_Max "Maximum Application Rate specified as count per time";
CM_ SG_ 2362179319 SetTillageDepth_Set "Setpoint Tillage Depth of Machine Element below soil surface, value increases with depth";
CM_ SG_ 2362179319 TillageDepth_Act "Actual Tillage Depth of Machine Element below soil surface, value increases with depth";
CM_ SG_ 2362179319 TillageDepth_Def "Default Tillage Depth of Machine Element below soil surface, value increases with depth";
CM_ SG_ 2362179319 TillageDepth_Min "Minimum Tillage Depth of Machine Element below soil surface, value increases with depth";
CM_ SG_ 2362179319 TillageDepth_Max "Maximum Tillage Depth of Machine Element below soil surface, value increases with depth";
CM_ SG_ 2362179319 SeedingDeph_Set "Setpoint Seeding Depth of Machine Element below soil surface, value increases with depth";
CM_ SG_ 2362179319 SeedingDeph_Act "Setpoint Seeding Depth of Machine Element below soil surface, value increases with depth";
CM_ SG_ 2362179319 SeedingDeph_Def "Setpoint Seeding Depth of Machine Element below soil surface, value increases with depth";
CM_ SG_ 2362179319 SeedingDeph_Min "Setpoint Seeding Depth of Machine Element below soil surface, value increases with depth";
CM_ SG_ 2362179319 SeedingDeph_Max "Setpoint Seeding Depth of Machine Element below soil surface, value increases with depth";
CM_ SG_ 2362179319 WorkingHeight_Set "Setpoint Working Height of Machine Element above crop or soil";
CM_ SG_ 2362179319 WorkingHeight_Act "Actual Working Height of Machine Element above crop or soil";
CM_ SG_ 2362179319 WorkingHeight_Def "Default Working Height of Machine Element above crop or soil";
CM_ SG_ 2362179319 WorkingHeight_Min "Minimum Working Height of Machine Element above crop or soil";
CM_ SG_ 2362179319 WorkingHeight_Max "Maximum Working Height of Machine Element above crop or soil";
CM_ SG_ 2362179319 WorkingWidth_Set "Setpoint Working Width of Machine Element";
CM_ SG_ 2362179319 WorkingWidth_Act "Actual Working Width of Machine Element";
CM_ SG_ 2362179319 WorkingWidth_Def "Default Working Width of Machine Element";
CM_ SG_ 2362179319 WorkingWidth_Min "Minimum Working Width of Machine Element";
CM_ SG_ 2362179319 WorkingWidth_Max "Maximum Working Width of Machine Element";
CM_ SG_ 2362179319 ContentAsVolume_Set "Setpoint Machine Element Content specified as volume";
CM_ SG_ 2362179319 ContentAsVolume_Act "Actual Machine Element Content specified as volume";
CM_ SG_ 2362179319 ContentAsVolume_Max "Maximum Machine Element Content specified as volume";
CM_ SG_ 2362179319 ContentAsMass_Set "Setpoint Machine Element Content specified as mass";
CM_ SG_ 2362179319 ContentAsMass_Act "Actual Machine Element Content specified as mass";
CM_ SG_ 2362179319 ContentAsMass_Max "Maximum Machine Element Content specified as mass";
CM_ SG_ 2362179319 ContentAsCount_Set "Setpoint Machine Element Content specified as count";
CM_ SG_ 2362179319 ContentAsCount_Act "Actual Machine Element Content specified as count";
CM_ SG_ 2362179319 ContentAsCount_Max "Maximum Machine Element Content specified as count";
CM_ SG_ 2362179319 AccumulatedAppAsVolume "Accumulated Application specified as volume";
CM_ SG_ 2362179319 AccumulatedAppAsMass "Accumulated Application specified as mass";
CM_ SG_ 2362179319 AccumulatedAppAsCount "Accumulated Application specified as count";
CM_ SG_ 2362179319 YieldVolumePerArea "Yield as volume per area";
CM_ SG_ 2362179319 YieldMassPerArea "Yield as mass per area";
CM_ SG_ 2362179319 YieldCountPerArea "Yield as count per area";
CM_ SG_ 2362179319 YieldVolumePerTime "Yield as volume per area";
CM_ SG_ 2362179319 YieldMassPerTime "Yield as mass per area";
CM_ SG_ 2362179319 YieldCountPerTime "Yield as count per area";
CM_ SG_ 2362179319 AccumulatedYieldAsVolume "Accumulated Yield specified as volume";
CM_ SG_ 2362179319 AccumulatedYieldAsMass "Accumulated Yield specified as mass";
CM_ SG_ 2362179319 AccumulatedYieldAsCount "Accumulated Yield specified as count";
CM_ SG_ 2362179319 CropYieldLossVolumePerArea "Crop yield loss as volume per area";
CM_ SG_ 2362179319 CropYieldLossMassPerArea "Crop yield loss as mass per area";
CM_ SG_ 2362179319 CropYieldLossCountPerArea "Crop yield loss as count per area";
CM_ SG_ 2362179319 CropYieldLossVolumePerTime "Crop yield loss as volume per time";
CM_ SG_ 2362179319 CropYieldLossMassPerTime "Crop yield loss as mass per time";
CM_ SG_ 2362179319 CropYieldLossCountPerTime "Crop yield loss as count per time";
CM_ SG_ 2362179319 CropYieldLoss "Crop yield loss";
CM_ SG_ 2362179319 MoistureInCropYield "Moisture in crop yield";
CM_ SG_ 2362179319 DirtMaterialInCropYield "Dirt or foreign material in crop yield";
CM_ SG_ 2362179319 BaleWidth_Set "Setpoint Bale Width for square baler or round baler";
CM_ SG_ 2362179319 BaleWidth_Act "Actual Bale Width for square baler or round baler";
CM_ SG_ 2362179319 BaleWidth_Def "Default Bale Width for square baler or round baler";
CM_ SG_ 2362179319 BaleWidth_Min "Minimum Bale Width for square baler or round baler";
CM_ SG_ 2362179319 BaleWidth_Max "Maximum Bale Width for square baler or round baler";
CM_ SG_ 2362179319 BaleHeight_Set "Setpoint Bale Height is only applicable to square baler";
CM_ SG_ 2362179319 BaleHeight_Act "Actual Bale Height is only applicable to square baler";
CM_ SG_ 2362179319 BaleHeight_Def "Default Bale Height is only applicable to square baler";
CM_ SG_ 2362179319 BaleHeight_Min "Minimum Bale Height is only applicable to square baler";
CM_ SG_ 2362179319 BaleHeight_Max "Maximum Bale Height is only applicable to square baler";
CM_ SG_ 2362179319 BaleSize_Set "Setpoint Bale Size as length for a square baler or diameter for a round baler";
CM_ SG_ 2362179319 BaleSize_Act "Actual Bale Size as length for a square baler or diameter for a round baler";
CM_ SG_ 2362179319 BaleSize_Def "Default Bale Size as length for a square baler or diameter for a round baler";
CM_ SG_ 2362179319 BaleSize_Min "Minimum Bale Size as length for a square baler or diameter for a round baler";
CM_ SG_ 2362179319 BaleSize_Max "Maximum Bale Size as length for a square baler or diameter for a round baler";
CM_ SG_ 2362179319 AccumulatedArea "Accumulated Area";
CM_ SG_ 2362179319 AccumulatedDistanceInWork "Accumulated Distance in working position";
CM_ SG_ 2362179319 AccumulatedDistanceOutWork "Accumulated Distance out of working position";
CM_ SG_ 2362179319 AccumulatedTimeInWork "Accumulated Time in working position";
CM_ SG_ 2362179319 AccumulatedTimeOutWork "Accumulated Time out of working position";
CM_ SG_ 2362179319 PrdoucDensityMassPerArea "Product Density as mass per volume";
CM_ SG_ 2362179319 PrdoucDensityMassPerCount "Product Density as mass per count";
CM_ SG_ 2362179319 PrdoucDensityVolumePerCount "Product Density as volume per count";
CM_ SG_ 2362179319 AuxiliaryValveScalingExtend "Factor to apply to AuxValveCommand PortFlowCommand.";
CM_ SG_ 2362179319 AuxiliaryValveScalingRetract "Factor to apply to AuxValveCommand PortFlowCommand.";
CM_ SG_ 2362179319 AuxiliaryRampExtendUp "The valve will apply a ramp to the Auxiliary ValveCommand
PortFlowCommand, to limit the acceleration or deceleration of flow.";
CM_ SG_ 2362179319 AuxiliaryValveRampExtendDown "The valve will apply a ramp to the Auxiliary ValveCommand
PortFlowCommand, to limit the acceleration or deceleration of flow.";
CM_ SG_ 2362179319 AuxiliaryValveRampRetractUp "The valve will apply a ramp to theAuxiliary ValveCommand
PortFlowCommand, to limit the acceleration or deceleration of flow.";
CM_ SG_ 2362179319 AuxiliaryValveRampRetractDown "The valve will apply a ramp to the Auxiliary ValveCommand
PortFlowCommand, to limit the acceleration or deceleration of flow.";
CM_ SG_ 2362179319 AuxiliaryValveFloatThreshold "Safety function. Current output of valve must be above threshold before
float command is allowed.";
CM_ SG_ 2362179319 AuxiliaryValveProgressivExtend "Define non-linear releationship between command and flow by 2nd
degree polynomium.";
CM_ SG_ 2362179319 AuxiliaryValveProgressivRetract "Define non-linear releationship between command and flow by 2nd
degree polynomium.";
CM_ SG_ 2362179319 AuxiliaryValveInvertPorts "Command valve to swap extend and retract ports, easier than redoing
plumbing on valve.";
CM_ SG_ 2362179319 DeviceElementOffsetX "X direction offset of a DeviceElement relative to a Device.";
CM_ SG_ 2362179319 DeviceElementOffsetY "Y direction offset of a DeviceElement relative to  Device.";
CM_ SG_ 2362179319 DeviceElementOffsetZ "Z direction offset of a DeviceElement relative to  Device.";
CM_ SG_ 2362179319 DeviceVolumeCapacity "DeviceElement Volume Capacity, dimension of a DeviceElement.";
CM_ SG_ 2362179319 DeviceMassCapacity "DeviceElement Mass Capacity, dimension of a DeviceElement.";
CM_ SG_ 2362179319 DeviceCountCapacity "DeviceElement Count Capacity, dimension of a DeviceElement";
CM_ SG_ 2362179319 PercentageAppRateSetpoint "Application Rate expressed as percentage";
CM_ SG_ 2362179319 SetpointTimeLatency "Temporal Latency valid for the setpoint values of a Device Element";
CM_ SG_ 2362179319 ActualValueTimeLatency "Temporal Latency valid for the actual value of a Device Element";
CM_ SG_ 2362179319 YawAngle "Pivot / Yaw Angle of a DeviceElement";
CM_ SG_ 2362179319 RollAngle "Roll Angle of a DeviceElement";
CM_ SG_ 2362179319 PitchAngle "Pitch Angle of a DeviceElement";
CM_ SG_ 2362179319 LogCount "Log Counter, may be used to control data log record generation on a
Task Controller";
CM_ SG_ 2362179319 TotalFuelConsumption "Accumulated Fuel Consumption as Counter";
CM_ SG_ 2362179319 FuelConsumptionPerTime "Fuel consumption per time";
CM_ SG_ 2362179319 FuelConsumptionPerArea "Fuel consumption per area";
CM_ SG_ 2362179319 AreaPerTimeCapacity "Area per time capacity";
CM_ SG_ 2362179319 MinMassPerAreaAppRate "Minimum Application Rate specified as mass per area";
CM_ SG_ 2362179319 NDVI "Actual Normalized Difference Vegetative Index (NDVI)";
CM_ SG_ 2362179319 PhysicalObjectLength "Length of device element (dimension along the X-axis)";
CM_ SG_ 2362179319 PhysicalObjectWidth "Width of device element (dimension along the Y-axis)";
CM_ SG_ 2362179319 PhysicalObjectHeight "Height of device element (dimension along the Z-axis)";
CM_ SG_ 2362179319 ConnectorType "Specification of the type of coupler.";
CM_ SG_ 2362179319 PrescriptionControlState "Defines and synchronise the actual state of the prescription system";
CM_ SG_ 2362179319 NumberOfSubUnitsPerSection "Specifies the number of sub-units for a section 
(e.g. number of nozzles per sprayer section 
or number of planter row units per metering device)";
CM_ SG_ 2362179319 SectionControlState "Specifies the actual state of section control";
CM_ SG_ 2362179319 CondensedWorkState1to16 "Combination of the work states of individual sections or units (e.g. nozzles) 
number 1 to 16 into a single work state of their parent device element";
CM_ SG_ 2362179319 CondensedWorkState17to32 "Combination of the work states of individual sections or units (e.g. nozzles) 
number 17 to 32 into a single work state of their parent device element";
CM_ SG_ 2362179319 CondensedWorkState33to48 "Combination of the work states of individual sections or units (e.g. nozzles) 
number 33 to 48 into a single work state of their parent device element";
CM_ SG_ 2362179319 CondensedWorkState49to64 "Combination of the work states of individual sections or units (e.g. nozzles) 
number 49 to 64 into a single work state of their parent device element";
CM_ SG_ 2362179319 CondensedWorkState65to80 "Combination of the work states of individual sections or units (e.g. nozzles) 
number 65 to 80 into a single work state of their parent device element";
CM_ SG_ 2362179319 CondensedWorkState81to96 "Combination of the work states of individual sections or units (e.g. nozzles) 
number 81 to 96 into a single work state of their parent device element";
CM_ SG_ 2362179319 CondensedWorkState97to112 "Combination of the work states of individual sections or units (e.g. nozzles) 
number 97 to 112 into a single work state of their parent device element";
CM_ SG_ 2362179319 CondensedWorkState113to128 "Combination of the work states of individual sections or units (e.g. nozzles) 
number 113 to 128 into a single work state of their parent device element";
CM_ SG_ 2362179319 CondensedWorkState129to144 "Combination of the work states of individual sections or units (e.g. nozzles) 
number 129 to 144 into a single work state of their parent device element";
CM_ SG_ 2362179319 CondensedWorkState145to160 "Combination of the work states of individual sections or units (e.g. nozzles) 
number 145 to 160 into a single work state of their parent device element";
CM_ SG_ 2362179319 CondensedWorkState161to176 "Combination of the work states of individual sections or units (e.g. nozzles) 
number 161 to 176 into a single work state of their parent device element";
CM_ SG_ 2362179319 CondensedWorkState177to192 "Combination of the work states of individual sections or units (e.g. nozzles) 
number 177 to 192 into a single work state of their parent device element";
CM_ SG_ 2362179319 CondensedWorkState193to208 "Combination of the work states of individual sections or units (e.g. nozzles) 
number 193 to 208 into a single work state of their parent device element";
CM_ SG_ 2362179319 CondensedWorkState209to224 "Combination of the work states of individual sections or units (e.g. nozzles) 
number 209 to 224 into a single work state of their parent device element";
CM_ SG_ 2362179319 CondensedWorkState225to240 "Combination of the work states of individual sections or units (e.g. nozzles) 
number 225 to 240 into a single work state of their parent device element";
CM_ SG_ 2362179319 CondensedWorkState241to256 "Combination of the work states of individual sections or units (e.g. nozzles) 
number 241 to 256 into a single work state of their parent device element";
CM_ SG_ 2362179319 ActualLengthOfCut "Actual length of cut for harvested material, e.g. Forage Harvester or Tree Harvester";
CM_ SG_ 2362179319 ElementTypeInstance "This DDI is used to enumerate and identify multiple device elements (DET) 
of the same type within one Device Description object pool";
CM_ SG_ 2362179319 ActualCulturalPractice "This DDI is used to define the current cultural practice which is performed 
by an individual device operation. For instance a planter/seeder 
could provide a sowing and a fertilizing operation at the same time.";
CM_ SG_ 2362179319 DRP2GroundDistance "This DDI is used to specify the distance from the Device Reference Point (DRP) 
down to the ground surface. The DRP to Ground DDI shall be attached 
only to the Device Element (DET) with element number zero.";
CM_ SG_ 2362179319 DryMassPerAreaYield "Yield as dry mass per area. The definition of dry mass 
is the mass with a reference moisture specified by DDI 184.";
CM_ SG_ 2362179319 DryMassPerTimeYield "Yield as dry mass per time. The definition of dry mass 
is the mass with a reference moisture specified by DDI 184.";
CM_ SG_ 2362179319 YieldTotalDryMass "Accumulated Yield specified as dry mass. 
The definition of dry mass is the mass 
with a reference moisture specified by DDI 184.";
CM_ SG_ 2362179319 RefMoistureForDryMass "Moisture percentage used for the dry mass DDIs 181, 182 and 183.";
CM_ SG_ 2362179319 SeedCottonMassPerAreaYield "Seed cotton yield as mass per area, not corrected for a possibly included lint percantage.";
CM_ SG_ 2362179319 LintCottonMassPerAreaYield "Lint cotton yield as mass per area.";
CM_ SG_ 2362179319 SeedCottonMassPerTimeYield "Seed cotton yield as mass per time, not corrected for a possibly included lint percantage.";
CM_ SG_ 2362179319 LintCottonMassPerTimeYield "Lint cotton yield as mass per time.";
CM_ SG_ 2362179319 YieldTotalSeedCottonMass "Accumulated yield specified as seed cotton mass, not corrected for a possibly included lint percantage.";
CM_ SG_ 2362179319 YieldTotalLintCottonMass "Accumulated yield specified as lint cotton mass.";
CM_ SG_ 2362179319 LintTurnoutPercentage "Percent of lint in the seed cotton.";
CM_ SG_ 2362179319 AmbientTemperature "Ambient temperature measured by a machine. Unit is milli-Kelvin (mK).";
CM_ SG_ 2362179319 SetpointProductPressure "Setpoint Product Pressure to adjust the pressure of the product flow system at the point of dispensing.";
CM_ SG_ 2362179319 ActualProductPressure "Actual Product Pressure is the measured pressure in the product flow system at the point of dispensing.";
CM_ SG_ 2362179319 MinimumProductPressure "Minimun Product Pressure in the product flow system at the point of dispensing. ";
CM_ SG_ 2362179319 MaximumProductPressure "Maximum Product Pressure in the product flow system at the point of dispensing.";
CM_ SG_ 2362179319 SetpointPumpOutputPressure "Setpoint Pump Output Pressure to adjust the  pressure at the output of the solution pump.";
CM_ SG_ 2362179319 ActualPumpOutputPressure "Actual Pump Output Pressure measured at the output of the solution pump.";
CM_ SG_ 2362179319 MinimumPumpOutputPressure "Minimum Pump Output Pressure for the output pressure of the solution pump.";
CM_ SG_ 2362179319 MaximumPumpOutputPressure "Maximum Pump Output Pressure for the output pressure of the solution pump.";
CM_ SG_ 2362179319 SetpointTankAgitationPressure "Setpoint Tank Agitation Pressure to adjust the pressure for a stir system in a tank.";
CM_ SG_ 2362179319 ActualTankAgitationPressure "Actual Tank Agitation Pressure measured by the tank stir system.";
CM_ SG_ 2362179319 MinimumTankAgitationPressure "Minimun Tank Agitation Pressure for a stir system in a tank.";
CM_ SG_ 2362179319 MaximumTankAgitationPressure "Maximun Tank Agitation Pressure for a stir system in a tank.";
CM_ SG_ 2362179319 SCTurnOnTime_ "The Section Control Turn On Time defines the overall time lapse 
between the moment the TC sends a turn on section command 
to the working set and the moment this section 
is physically turned on and the product is applied.";
CM_ SG_ 2362179319 SCTurnOffTime "The Section Control Turn Off Time defines the overall time lapse 
between the moment the TC sends a turn off section command 
to the working set and the moment this section is physically turned off.";
CM_ SG_ 2362179319 WindSpeed "Wind speed measured in the treated field 
at the beginning of operations 
or on the application implement during operations.";
CM_ SG_ 2362179319 WindDirection "Wind direction measured in the treated field 
at the beginning of operations 
or on the application implement during operations.";
CM_ SG_ 2362179319 AirHumidity "Ambient humidty measured by a weather station 
in a treated field or on the application implement.";
CM_ SG_ 2362179319 SkyConditions "This DDE is used to define the current sky conditions during operation.";
CM_ SG_ 2362179319 LastBaleFlakesPerBale "The number of flakes in the most recently produced bale.";
CM_ SG_ 2362179319 LastBaleAverageMoisture "The average moisture in the most recently produced bale.";
CM_ SG_ 2362179319 LastBaleAverageStrokesPerFlake "The number of baler plunger compression strokes per flake 
that has entered the bale compression chamber. 
This value is the average valid for the most recently produced bale.";
CM_ SG_ 2362179319 LifetimeBaleCount "The number of bales produced by a machine over its entire lifetime.";
CM_ SG_ 2362179319 LifetimeWorkingHours "The number of working hours of a device element over its entire lifetime.";
CM_ SG_ 2362179319 ActualBaleHydraulicPressure "The actual value of the hydraulic pressure applied 
to the sides of the bale in the bale compression chamber.";
CM_ SG_ 2362179319 LastBaleAverageHydraulicPressure "The average actual value of the hydraulic pressure applied 
to the sides of the bale in the bale compression chamber.";
CM_ SG_ 2362179319 SetpointBaleCompressionPlungerLo "The setpoint bale compression plunger load as a unitless number.";
CM_ SG_ 2362179319 ActualBaleCompressionPlungerLoad "The actual bale compression plunger load as a unitless number.";
CM_ SG_ 2362179319 LastBaleAverageBaleCompressionPl "The average bale compression plunger load for the most recently produced bale.";
CM_ SG_ 2362179319 LastBaleAppliedPreservative "The total preservative applied to the most recently produced bale.";
CM_ SG_ 2362179319 LastBaleTagNumber "The Last Bale Tag Number as a decimal number in the range of 0 to 4294967295.";
CM_ SG_ 2362179319 LastBaleMass "The mass of the bale that has most recently been produced.";
CM_ SG_ 2362179319 DeltaT "The difference between dry bulb temperature and wet bulb temperature measured 
by a weather station in a treated field or on the application equipment.";
CM_ SG_ 2362179319 SetpointWorkingLength "This is the desired working length of the device element during operation.";
CM_ SG_ 2362179319 ActualWorkingLength "Actual Working Length of a Device Element.";
CM_ SG_ 2362179319 MinimumWorkingLength "This is the minimum working length of the device element during operation.";
CM_ SG_ 2362179319 MaximumWorkingLength "This is the maximum working length of the device element during operation.";
CM_ SG_ 2362179319 ActualNetWeight "The Actual Net Weight is the current measured mass by a weighing system.";
CM_ SG_ 2362179319 NetWeightState "The Net Weight State indicates whether the current 
Actual Net Weight value is a reliable value or not.";
CM_ SG_ 2362179319 SetpointNetWeight "The Setpoint Net Weight value is used to prompt 
the weighing system to perform a tare procedure.";
CM_ SG_ 2362179319 ActualGrossWeight "The Actual Gross Weight is the overall 
measured mass by a weighing system.";
CM_ SG_ 2362179319 GrossWeightState "The Gross Weight State indicates whether the current 
Actual Gross Weight value is a reliable value or not.";
CM_ SG_ 2362179319 MinimumGrossWeight "The Minimum Gross Weight may represent the minimum value 
of the effective range of the weighing system.";
CM_ SG_ 2362179319 MaximumGrossWeight "Maximum Gross Weight may represent the maximum value 
of the effective range of the weighing system.";
CM_ SG_ 2362179319 ThreshingEngagementTotalTime "Accumulated time while the threshing mechanism is engaged";
CM_ SG_ 2362179319 ActualHeaderWorkingHeightStatus "Actual status of the header being above or below 
the threshold height for the in-work state.";
CM_ SG_ 2362179319 ActualHeaderRotationalSpeedStatu "Actual status of the header rotational speed 
being above or below the threshold for in-work state.";
CM_ SG_ 2362179319 YieldHoldStatus "Status indicator for the yield measurement system. ";
CM_ SG_ 2362179319 ActualUnLoadingSystemStatus "Actual status of the Unloading and/or Loading system.";
CM_ SG_ 2362179319 CropTemperature "Temperature of harvested crop";
CM_ SG_ 2362179319 SetpointSieveClearance "Setpoint separation distance between Sieve elements";
CM_ SG_ 2362179319 ActualSieveClearance "Actual separation distance between Sieve elements";
CM_ SG_ 2362179319 MinimumSieveClearance "Minimal separation distance between Sieve elements";
CM_ SG_ 2362179319 MaximumSieveClearance "Maximum separation distance between Sieve elements.";
CM_ SG_ 2362179319 SetpointChafferClearance "Setpoint separation distance between Chaffer elements.";
CM_ SG_ 2362179319 ActualChafferClearance "Actual separation distance between Chaffer elements.";
CM_ SG_ 2362179319 MinimumChafferClearance "Minimum separation distance between Chaffer elements.";
CM_ SG_ 2362179319 MaximumChafferClearance "Maximum separation distance between Chaffer elements.";
CM_ SG_ 2362179319 SetpointConcaveClearance "Setpoint separation distance between Concave elements.";
CM_ SG_ 2362179319 ActualConcaveClearance "Actual separation distance between Concave elements.";
CM_ SG_ 2362179319 MinimumConcaveClearance "Minimum separation distance between Concave elements.";
CM_ SG_ 2362179319 MaximumConcaveClearance "Maximum separation distance between Concave elements.";
CM_ SG_ 2362179319 SetpointSeparationFanRotationalS "Setpoint rotational speed of the fan used 
for separating product material from non product material.";
CM_ SG_ 2362179319 ActualSeparationFanRotationalSpe "Actual rotational speed of the fan used 
for separating product material from non product material.";
CM_ SG_ 2362179319 MinimumSeparationFanRotationalSp "Minimum rotational speed of the fan used 
for separating product material from non product material.";
CM_ SG_ 2362179319 MaximumSeparationFanRotationalSp "Maximum rotational speed of the fan used 
for separating product material from non product material.";
CM_ SG_ 2362179319 HydraulicOilTemperature "Temperature of fluid in the hydraulic system.";
CM_ SG_ 2362179319 YieldLagIgnoreTime "Amount of time to ignore yield data, 
starting at the transition from the in-work to the out-of-work state. 
During this time, the yield sensor provides 
inconsistent or unreliable crop flow data.";
CM_ SG_ 2362179319 YieldLeadIgnoreTime "Amount of time to ignore yield data, 
starting at the transition from the out-of-work to the in-work state. 
During this time, the yield sensor provides 
inconsistent or unreliable crop flow data.";
CM_ SG_ 2362179319 AverageYieldMassPerTime "Average Yield expressed as mass per unit time, 
not corrected for the reference moisture percentage DDI 184. 
This value is the average for a Task and may be reported as a total.";
CM_ SG_ 2362179319 AverageCropMoisture "Average Moisture of the harvested crop. 
This value is the average for a Task and may be reported as a total.";
CM_ SG_ 2362179319 AverageYieldMassPerArea "This Average Yield Mass Per Area is the mass that includes the average crop moisture (DDI 262) i";
CM_ SG_ 2362179319 ConnectorPivotXOffset "X direction offset of a connector pivot point relative to DRP";
CM_ SG_ 2362179319 RemainingArea "Remaining Area of a field";
CM_ SG_ 2362179319 LifetimeApplicationTotalMass "Entire Application Total Count of the device lifetime";
CM_ SG_ 2362179319 LifetimeApplicationTotalCount "Entire Application Total Count of the device lifetime";
CM_ SG_ 2362179319 LifetimeYieldTotalVolume "Entire Yield Total Volume of the device lifetime";
CM_ SG_ 2362179319 LifetimeYieldTotalMass "Entire Yield Total Mass of the device lifetime";
CM_ SG_ 2362179319 LifetimeYieldTotalCount "Entire Yield Total Count of the device lifetime";
CM_ SG_ 2362179319 LifetimeTotalArea "Entire Total Area of the device lifetime";
CM_ SG_ 2362179319 LifetimeTotalDistance "Entire Total Area of the device lifetime";
CM_ SG_ 2362179319 LifetimeIneffectiveTotalDistance "Entire Ineffective Total Distance of the device lifetime";
CM_ SG_ 2362179319 LifetimeEffectiveTotalTime "Entire Ineffective Total Distance of the device lifetime";
CM_ SG_ 2362179319 LifetimeIneffectiveTotalTime "Entire Ineffective Total Time of the device lifetime";
CM_ SG_ 2362179319 LifetimeFuelConsumption "Entire Fuel Consumption of the device lifetime";
CM_ SG_ 2362179319 LifetimeAverageFuelConsumptionPe "Entire Average Fuel Consumption per Time of the device lifetime";
CM_ SG_ 2362179319 LifetimeAverageFuelConsumpt_0000 "Entire Average Fuel Consumption per Area of the device lifetime";
CM_ SG_ 2362179319 LifetimeYieldTotalDryMass "Entire Yield Total Dry Mass of the device lifetime";
CM_ SG_ 2362179319 LifetimeYieldTotalSeedCottonMass "Entire Yield Total Seed Cotton Mass of the device lifetime";
CM_ SG_ 2362179319 LifetimeYieldTotalLintCottonMass "Entire Yield Total Lint Cotton Mass of the device lifetime";
CM_ SG_ 2362179319 LifetimeThreshingEngagementTotal "Entire Threshing Engagement Total Time of the device lifetime";
CM_ SG_ 2362179319 PrecutTotalCount "The total number of pre-cutted product units produced by a device during an operation";
CM_ SG_ 2362179319 UncutTotalCount "The total number of un-cutted product units produced by a device during an operation";
CM_ SG_ 2362179319 LifetimePrecutTotalCount "Entire Precut Total Count of the device lifetime";
CM_ SG_ 2362179319 LifetimeUncutTotalCount "Entire Uncut Total Count of the device lifetime";
CM_ SG_ 2362179319 SetpointWorkState "The Setpoint Work State DDI is the control command counterparts to the Work State DDI (141)";
CM_ SG_ 2362179319 SetpointCondensedWorkState1to16 "The Setpoint Condensed Work State DDIs are the control command counterparts to the Condensed Work States DDIs (161 – 176)";
CM_ SG_ 2362179319 SetpointCondensedWorkState17to32 "The Setpoint Condensed Work State DDIs are the control command counterparts to the Condensed Work States DDIs (161 – 176)";
CM_ SG_ 2362179319 SetpointCondensedWorkState33to48 "The Setpoint Condensed Work State DDIs are the control command counterparts to the Condensed Work States DDIs (161 – 176)";
CM_ SG_ 2362179319 SetpointCondensedWorkState49to64 "The Setpoint Condensed Work State DDIs are the control command counterparts to the Condensed Work States DDIs (161 – 176)";
CM_ SG_ 2362179319 SetpointCondensedWorkState65to80 "The Setpoint Condensed Work State DDIs are the control command counterparts to the Condensed Work States DDIs (161 – 176)";
CM_ SG_ 2362179319 SetpointCondensedWorkState81to96 "The Setpoint Condensed Work State DDIs are the control command counterparts to the Condensed Work States DDIs (161 – 176)";
CM_ SG_ 2362179319 SetpointCondensedWorkState97to11 "The Setpoint Condensed Work State DDIs are the control command counterparts to the Condensed Work States DDIs (161 – 176)";
CM_ SG_ 2362179319 SetpointCondensedWorkState113to1 "The Setpoint Condensed Work State DDIs are the control command counterparts to the Condensed Work States DDIs (161 – 176)";
CM_ SG_ 2362179319 SetpointCondensedWorkState129to1 "The Setpoint Condensed Work State DDIs are the control command counterparts to the Condensed Work States DDIs (161 – 176)";
CM_ SG_ 2362179319 SetpointCondensedWorkState145to1 "The Setpoint Condensed Work State DDIs are the control command counterparts to the Condensed Work States DDIs (161 – 176)";
CM_ SG_ 2362179319 SetpointCondensedWorkState161to1 "The Setpoint Condensed Work State DDIs are the control command counterparts to the Condensed Work States DDIs (161 – 176)";
CM_ SG_ 2362179319 SetpointCondensedWorkState177to1 "The Setpoint Condensed Work State DDIs are the control command counterparts to the Condensed Work States DDIs (161 – 176)";
CM_ SG_ 2362179319 SetpointCondensedWorkState193to2 "The Setpoint Condensed Work State DDIs are the control command counterparts to the Condensed Work States DDIs (161 – 176)";
CM_ SG_ 2362179319 SetpointCondensedWorkState209to2 "The Setpoint Condensed Work State DDIs are the control command counterparts to the Condensed Work States DDIs (161 – 176)";
CM_ SG_ 2362179319 SetpointCondensedWorkState225to2 "The Setpoint Condensed Work State DDIs are the control command counterparts to the Condensed Work States DDIs (161 – 176)";
CM_ SG_ 2362179319 SetpointCondensedWorkState241to2 "The Setpoint Condensed Work State DDIs are the control command counterparts to the Condensed Work States DDIs (161 – 176)";
CM_ SG_ 2362179319 TrueRotationPointXOffset "X direction offset of the device rotation point relative to the DRP";
CM_ SG_ 2362179319 TrueRotationPointYOffset "Y direction offset of the device rotation point relative to the DRP";
CM_ SG_ 2362179319 ActualPercentageApplicationRate "Actual Application Rate expressed as percentage";
CM_ SG_ 2362179319 MinimumPercentageApplicationRate "Actual Application Rate expressed as percentage";
CM_ SG_ 2362179319 MaximumPercentageApplicationRate "Maximum Application Rate expressed as percentage";
CM_ SG_ 2362179319 RelativeYieldPotential "Relative yield potential provided by a FMIS or a sensor or entered by the operator for a certain task expressed as percentage";
CM_ SG_ 2362179319 MinimumRelativeYieldPotential "Minimum potential yield expressed as percentage";
CM_ SG_ 2362179319 MaximumRelativeYieldPotential "Maximum potential yield expressed as percentage";
CM_ SG_ 2362179319 ActualPercentageCropDryMatter "Actual Percentage Crop Dry Matter expressed as parts per million";
CM_ SG_ 2362179319 AveragePercentageCropDryMatter "Average Percentage Crop Dry Matter expressed as parts per million";
CM_ SG_ 2362179319 EffectiveTotalFuelConsumption "Accumulated total fuel consumption in working position";
CM_ SG_ 2362179319 IneffectiveTotalFuelConsumption "Accumulated total fuel consumption in non working position";
CM_ SG_ 2362179319 EffectiveTotalDieselExhaustFluid "Accumulated total Diesel Exhaust Fluid consumption in working position";
CM_ SG_ 2362179319 IneffectiveTotalDieselExhaustFlu "Accumulated total Diesel Exhaust Fluid consumption in non working position";
CM_ SG_ 2362179319 LastLoadedWeight "Last loaded Weight value specified as mass";
CM_ SG_ 2362179319 LastUnloadedWeight "Last unloaded Weight value specified as mass";
CM_ SG_ 2362179319 PGNBasedData "This DDI is used in the XML files to identify PGN based data";
CM_ SG_ 2362179319 RequestDefaultProcessData "Request Default Process Data.";
CM_ SG_ 2362179319 DataDictionaryVersion "This DDE is used to specify which version of the Data Dictionary is being used.";
CM_ SG_ 2362179319 DDI_TI "Data Dictionary Identifier";
CM_ SG_ 2362179319 DDI_DI "Data Dictionary Identifier";
CM_ SG_ 2362179319 ErrorDDI "Data Dictionary Identifier";
CM_ SG_ 2362179319 DDI "Data Dictionary Identifier";
CM_ SG_ 2362179319 BootTimeTC "Maximum number of seconds from a power cycle to transmission of first Task Controller Status message";
CM_ SG_ 2362179319 PeerControlDDI "Data Dictionary Identifier";
CM_ SG_ 2362179319 ElementNumber "Device Element Number";
CM_ SG_ 2362179319 ErrorElementNumber "Device Element Number";
CM_ SG_ 2362179319 Command "Process Data Command";
CM_ SG_ 2362179319 NumberOfControlChannels "Number of control channels for position based control";
CM_ BO_ 2565406455 "Acknowledgment Message";
CM_ SG_ 2565406455 ParameterGroupNumber "PGN which is requested by the Request message";
CM_ BO_ 2565799671 "Address Claimed";
BA_DEF_  "ISO11783_11_SpecVersion" STRING ;
BA_DEF_  "ISO11783_7_SpecVersion" STRING ;
BA_DEF_  "ISO11783_6_SpecVersion" STRING ;
BA_DEF_ SG_  "DDI" INT 0 65535;
BA_DEF_ BO_  "SingleFrame" INT 0 1;
BA_DEF_ BU_  "NodeLayerModules" STRING ;
BA_DEF_  "ProtocolType" STRING ;
BA_DEF_  "BusType" STRING ;
BA_DEF_ BU_  "NmStationAddress" INT 0 255;
BA_DEF_ BU_  "NmJ1939AAC" INT 0 1;
BA_DEF_ BU_  "NmJ1939IndustryGroup" INT 0 7;
BA_DEF_ BU_  "NmJ1939System" INT 0 127;
BA_DEF_ BU_  "NmJ1939Function" INT 0 255;
BA_DEF_ BU_  "NmJ1939ManufacturerCode" INT 0 2047;
BA_DEF_ BU_  "NmJ1939IdentityNumber" INT 0 2097151;
BA_DEF_ BO_  "VFrameFormat" ENUM  "StandardCAN","ExtendedCAN","reserved","J1939PG","vector_leerstring";
BA_DEF_ BO_  "GenMsgSendType" ENUM  "cyclic","NotUsed","IfActive","NotUsed","NotUsed","NotUsed","NotUsed","NotUsed","noMsgSendType","vector_leerstring";
BA_DEF_ BO_  "GenMsgCycleTime" INT 0 3600000;
BA_DEF_ BO_  "GenMsgRequestable" INT 0 1;
BA_DEF_ BO_  "GenMsgCycleTimeFast" INT 0 3600000;
BA_DEF_ SG_  "SPN" INT 0 524287;
BA_DEF_  "DatabaseVersion" STRING ;
BA_DEF_ SG_  "GenSigSendType" ENUM  "Cyclic","OnWrite","OnWriteWithRepetition","OnChange","OnChangeWithRepetition","IfActive","IfActiveWithRepetition","NoSigSendType";
BA_DEF_ SG_  "SigType" ENUM  "Default","Range","RangeSigned","ASCII","Discrete","Control","ReferencePGN","DTC","StringDelimiter","StringLength","StringLengthControl","MessageCounter","MessageChecksum";
BA_DEF_  "ISO11783_12_SpecVersion" STRING ;
BA_DEF_  "ISO11783_13_SpecVersion" STRING ;
BA_DEF_ SG_  "GenSigStartValue" INT -2147483648 2147483647;
BA_DEF_ BU_  "ISO11783IOPFilename" STRING ;
BA_DEF_ BU_  "ISO11783IOPVersion" ENUM  "0","1","2","3","4";
BA_DEF_ BU_  "ISO11783PDDFilename" STRING ;
BA_DEF_ BU_  "ISO11783PDDVersion" ENUM  "0","1","2","3";
BA_DEF_ SG_  "SystemSignalLongSymbol" STRING ;
BA_DEF_DEF_  "ISO11783_11_SpecVersion" "";
BA_DEF_DEF_  "ISO11783_7_SpecVersion" "";
BA_DEF_DEF_  "ISO11783_6_SpecVersion" "";
BA_DEF_DEF_  "DDI" 0;
BA_DEF_DEF_  "SingleFrame" 1;
BA_DEF_DEF_  "NodeLayerModules" "";
BA_DEF_DEF_  "ProtocolType" "";
BA_DEF_DEF_  "BusType" "";
BA_DEF_DEF_  "NmStationAddress" 254;
BA_DEF_DEF_  "NmJ1939AAC" 0;
BA_DEF_DEF_  "NmJ1939IndustryGroup" 0;
BA_DEF_DEF_  "NmJ1939System" 0;
BA_DEF_DEF_  "NmJ1939Function" 0;
BA_DEF_DEF_  "NmJ1939ManufacturerCode" 0;
BA_DEF_DEF_  "NmJ1939IdentityNumber" 0;
BA_DEF_DEF_  "VFrameFormat" "J1939PG";
BA_DEF_DEF_  "GenMsgSendType" "noMsgSendType";
BA_DEF_DEF_  "GenMsgCycleTime" 0;
BA_DEF_DEF_  "GenMsgRequestable" 1;
BA_DEF_DEF_  "GenMsgCycleTimeFast" 0;
BA_DEF_DEF_  "SPN" 0;
BA_DEF_DEF_  "DatabaseVersion" "";
BA_DEF_DEF_  "GenSigSendType" "NoSigSendType";
BA_DEF_DEF_  "SigType" "Default";
BA_DEF_DEF_  "ISO11783_12_SpecVersion" "";
BA_DEF_DEF_  "ISO11783_13_SpecVersion" "";
BA_DEF_DEF_  "GenSigStartValue" 0;
BA_DEF_DEF_  "ISO11783IOPFilename" "";
BA_DEF_DEF_  "ISO11783IOPVersion" "3";
BA_DEF_DEF_  "ISO11783PDDFilename" "";
BA_DEF_DEF_  "ISO11783PDDVersion" "3";
BA_DEF_DEF_  "SystemSignalLongSymbol" "";
BA_ "ISO11783_12_SpecVersion" "2013-01-29 IS (ISO/TC 23/SC 19)";
BA_ "DatabaseVersion" "7.5 SP2";
BA_ "ProtocolType" "ISO11783";
BA_ "ISO11783_6_SpecVersion" "2010-05-11 FDIS";
BA_ "ISO11783_7_SpecVersion" "2009-01-29 FDIS";
BA_ "ISO11783_11_SpecVersion" "2007-04-01 IS";
BA_ "BusType" "CAN";
BA_ "ISO11783_13_SpecVersion" "2010-01-29 2007 With Amendments ";
BA_ "NmStationAddress" BU_ VT 38;
BA_ "NmJ1939AAC" BU_ VT 1;
BA_ "NmJ1939IndustryGroup" BU_ VT 2;
BA_ "NmJ1939Function" BU_ VT 29;
BA_ "NmJ1939ManufacturerCode" BU_ VT 1861;
BA_ "NmJ1939IdentityNumber" BU_ VT 1;
BA_ "NodeLayerModules" BU_ VT "Iso11783_VT_IL.vmodule";
BA_ "NmStationAddress" BU_ TC 247;
BA_ "NmJ1939IndustryGroup" BU_ TC 2;
BA_ "NmJ1939Function" BU_ TC 130;
BA_ "NodeLayerModules" BU_ TC "Iso11783_TC_IL.vmodule";
BA_ "ISO11783PDDFilename" BU_ Sprayer "DeviceDescriptions\Sprayer.xml";
BA_ "ISO11783IOPFilename" BU_ Sprayer "ObjectPools\Sprayer.iop";
BA_ "NodeLayerModules" BU_ Sprayer "Iso11783_IL.vmodule";
BA_ "NmStationAddress" BU_ Sprayer 128;
BA_ "NmJ1939AAC" BU_ Sprayer 1;
BA_ "NmJ1939IndustryGroup" BU_ Sprayer 2;
BA_ "NmJ1939System" BU_ Sprayer 6;
BA_ "NmJ1939Function" BU_ Sprayer 132;
BA_ "NmJ1939ManufacturerCode" BU_ Sprayer 1861;
BA_ "NmJ1939IdentityNumber" BU_ Sprayer 702222;
BA_ "NmStationAddress" BU_ TECU 1;
BA_ "NodeLayerModules" BU_ TECU "J1939_IL.vmodule";
BA_ "GenSigStartValue" SG_ 3221225472 TCSectionNumberOfBooms 1;
BA_ "GenSigStartValue" SG_ 3221225472 TCSectionNumberOfSections 1;
BA_ "SystemSignalLongSymbol" SG_ 3221225472 AdvanceTECU_MotionInitiationOpti "AdvanceTECU_MotionInitiationOption";
BA_ "SystemSignalLongSymbol" SG_ 3221225472 StopAllImplementOperationsOption "StopAllImplementOperationsOptions";
BA_ "SPN" SG_ 3221225472 MachineSelSpeedExitReason 5818;
BA_ "DDI" SG_ 2362179319 ApplicationTotalMass 352;
BA_ "DDI" SG_ 2362179319 ApplicationTotalVolume 351;
BA_ "DDI" SG_ 2362179319 FunctionType 350;
BA_ "DDI" SG_ 2362179319 NozzleDriftReduction 349;
BA_ "DDI" SG_ 2362179319 MaximumSwathingWidth 348;
BA_ "DDI" SG_ 2362179319 MinimumSwathingWidth 347;
BA_ "DDI" SG_ 2362179319 ActualSwathingWidth 346;
BA_ "DDI" SG_ 2362179319 SetpointSwathingWidth 345;
BA_ "DDI" SG_ 2362179319 MaximumGrainKernelCrackerGap 344;
BA_ "DDI" SG_ 2362179319 MinimumGrainKernelCrackerGap 343;
BA_ "DDI" SG_ 2362179319 ActualGrainKernelCrackerGap 342;
BA_ "DDI" SG_ 2362179319 SetpointGrainKernelCrackerGap 341;
BA_ "DDI" SG_ 2362179319 EffectiveUnloadingTime 340;
BA_ "DDI" SG_ 2362179319 EffectiveLoadingTime 339;
BA_ "DDI" SG_ 2362179319 LiftimeRearPTOHours 338;
BA_ "DDI" SG_ 2362179319 LifetimeFrontPTOHours 337;
BA_ "DDI" SG_ 2362179319 RearPTOHours 336;
BA_ "DDI" SG_ 2362179319 FrontPTOHours 335;
BA_ "DDI" SG_ 2362179319 OperatingHoursSinceLastSharpenin 334;
BA_ "SystemSignalLongSymbol" SG_ 2362179319 OperatingHoursSinceLastSharpenin "OperatingHoursSinceLastSharpening";
BA_ "DDI" SG_ 2362179319 MaximumCuttingDrumSpeed 333;
BA_ "DDI" SG_ 2362179319 ActualCuttingDrumSpeed 331;
BA_ "DDI" SG_ 2362179319 SetpointCuttingDrumSpeed 330;
BA_ "DDI" SG_ 2362179319 MaximumHeaderSpeed 329;
BA_ "DDI" SG_ 2362179319 MinimumHeaderSpeed 328;
BA_ "DDI" SG_ 2362179319 ActualHeaderSpeed 327;
BA_ "DDI" SG_ 2362179319 SetpointHeaderSpeed 326;
BA_ "DDI" SG_ 2362179319 LifetimeApplicationTotalVolume 325;
BA_ "DDI" SG_ 2362179319 ChopperEngagementTotalTime 324;
BA_ "DDI" SG_ 2362179319 UnloadIdentificationNumber 323;
BA_ "DDI" SG_ 2362179319 LoadIdentificationNumber 322;
BA_ "SPN" SG_ 2362179319 ArbitraryAddressCapable 2844;
BA_ "SPN" SG_ 2362179319 IndustryGroup 2846;
BA_ "SPN" SG_ 2362179319 VehicleSystemInstance 2843;
BA_ "SPN" SG_ 2362179319 Function 2841;
BA_ "SPN" SG_ 2362179319 FunctionInstance 2839;
BA_ "SPN" SG_ 2362179319 ECUInstance 2840;
BA_ "SigType" SG_ 2362179319 ManufacturerCode 1;
BA_ "SPN" SG_ 2362179319 ManufacturerCode 2838;
BA_ "SigType" SG_ 2362179319 TemperatureUnits 4;
BA_ "SigType" SG_ 2362179319 PressureUnits 4;
BA_ "SigType" SG_ 2362179319 ForceUnits 4;
BA_ "SPN" SG_ 2362179319 IdentityNumber 2837;
BA_ "SigType" SG_ 2362179319 UnitsSystem 4;
BA_ "SPN" SG_ 2362179319 DistanceUnitCmd 2414;
BA_ "SigType" SG_ 2362179319 DistanceUnitCmd 4;
BA_ "SPN" SG_ 2362179319 AreaUnitCmd 2415;
BA_ "SigType" SG_ 2362179319 AreaUnitCmd 4;
BA_ "SPN" SG_ 2362179319 VolumeUnitCmd 2416;
BA_ "SigType" SG_ 2362179319 VolumeUnitCmd 4;
BA_ "SPN" SG_ 2362179319 MassUnitCmd 2417;
BA_ "SigType" SG_ 2362179319 MassUnitCmd 4;
BA_ "GenSigStartValue" SG_ 2362179319 NumberOfBooms 255;
BA_ "DDI" SG_ 2362179319 AppRateVolumePerArea_Set 1;
BA_ "DDI" SG_ 2362179319 AppRateVolumePerArea_Act 2;
BA_ "DDI" SG_ 2362179319 AppRateVolumePerArea_Def 3;
BA_ "DDI" SG_ 2362179319 AppRateVolumePerArea_Min 4;
BA_ "DDI" SG_ 2362179319 AppRateVolumePerArea_Max 5;
BA_ "DDI" SG_ 2362179319 AppRateMassPerArea_Set 6;
BA_ "DDI" SG_ 2362179319 AppRateMassPerArea_Act 7;
BA_ "DDI" SG_ 2362179319 AppRateMassPerArea_Def 8;
BA_ "DDI" SG_ 2362179319 AppRateMassPerArea_Min 9;
BA_ "DDI" SG_ 2362179319 AppRateMassPerArea_Max 10;
BA_ "DDI" SG_ 2362179319 AppRateCountPerArea_Set 11;
BA_ "DDI" SG_ 2362179319 AppRateCountPerArea_Act 12;
BA_ "DDI" SG_ 2362179319 AppRateCountPerArea_Def 13;
BA_ "DDI" SG_ 2362179319 AppRateCountPerArea_Min 14;
BA_ "DDI" SG_ 2362179319 AppRateCountPerArea_Max 15;
BA_ "DDI" SG_ 2362179319 SetAppRateDistance_Set 16;
BA_ "DDI" SG_ 2362179319 AppRateDistance_Act 17;
BA_ "DDI" SG_ 2362179319 AppRateDistance_Def 18;
BA_ "DDI" SG_ 2362179319 AppRateDistance_Min 19;
BA_ "DDI" SG_ 2362179319 AppRateDistance_Max 20;
BA_ "DDI" SG_ 2362179319 AppRateVolumePerVolume_Set 21;
BA_ "DDI" SG_ 2362179319 AppRateVolumePerVolume_Act 22;
BA_ "DDI" SG_ 2362179319 AppRateVolumePerVolume_Def 23;
BA_ "DDI" SG_ 2362179319 AppRateVolumePerVolume_Min 24;
BA_ "DDI" SG_ 2362179319 AppRateVolumePerVolume_Max 25;
BA_ "DDI" SG_ 2362179319 AppRateMassPerMass_Set 26;
BA_ "DDI" SG_ 2362179319 AppRateMassPerMass_Act 27;
BA_ "DDI" SG_ 2362179319 AppRateMassPerMass_Def 28;
BA_ "DDI" SG_ 2362179319 AppRateMassPerMass_Min 29;
BA_ "DDI" SG_ 2362179319 AppRateMassPerMass_Max 30;
BA_ "DDI" SG_ 2362179319 AppRateVolumePerMass_Set 31;
BA_ "DDI" SG_ 2362179319 AppRateVolumePerMass_Act 32;
BA_ "DDI" SG_ 2362179319 AppRateVolumePerMass_Def 33;
BA_ "DDI" SG_ 2362179319 AppRateVolumePerMass_Min 34;
BA_ "DDI" SG_ 2362179319 AppRateVolumePerMass_Max 35;
BA_ "DDI" SG_ 2362179319 AppRateVolumePerTime_Set 36;
BA_ "DDI" SG_ 2362179319 AppRateVolumePerTime_Act 37;
BA_ "DDI" SG_ 2362179319 AppRateVolumePerTime_Def 38;
BA_ "DDI" SG_ 2362179319 AppRateVolumePerTime_Min 39;
BA_ "DDI" SG_ 2362179319 AppRateVolumePerTime_Max 40;
BA_ "DDI" SG_ 2362179319 AppRateMassPerTime_Set 41;
BA_ "DDI" SG_ 2362179319 AppRateMassPerTime_Act 42;
BA_ "DDI" SG_ 2362179319 AppRateMassPerTime_Def 43;
BA_ "DDI" SG_ 2362179319 AppRateMassPerTime_Min 44;
BA_ "DDI" SG_ 2362179319 AppRateMassPerTime_Max 45;
BA_ "DDI" SG_ 2362179319 AppRateCountPerTime_Set 46;
BA_ "DDI" SG_ 2362179319 AppRateCountPerTime_Act 47;
BA_ "DDI" SG_ 2362179319 AppRateCountPerTime_Def 48;
BA_ "DDI" SG_ 2362179319 AppRateCountPerTime_Min 49;
BA_ "DDI" SG_ 2362179319 AppRateCountPerTime_Max 50;
BA_ "DDI" SG_ 2362179319 SetTillageDepth_Set 51;
BA_ "DDI" SG_ 2362179319 TillageDepth_Act 52;
BA_ "DDI" SG_ 2362179319 TillageDepth_Def 53;
BA_ "DDI" SG_ 2362179319 TillageDepth_Min 54;
BA_ "DDI" SG_ 2362179319 TillageDepth_Max 55;
BA_ "DDI" SG_ 2362179319 SeedingDeph_Set 56;
BA_ "DDI" SG_ 2362179319 SeedingDeph_Act 57;
BA_ "DDI" SG_ 2362179319 SeedingDeph_Def 58;
BA_ "DDI" SG_ 2362179319 SeedingDeph_Min 59;
BA_ "DDI" SG_ 2362179319 SeedingDeph_Max 60;
BA_ "DDI" SG_ 2362179319 WorkingHeight_Set 61;
BA_ "DDI" SG_ 2362179319 WorkingHeight_Act 62;
BA_ "DDI" SG_ 2362179319 WorkingHeight_Def 63;
BA_ "DDI" SG_ 2362179319 WorkingHeight_Min 64;
BA_ "DDI" SG_ 2362179319 WorkingHeight_Max 65;
BA_ "DDI" SG_ 2362179319 WorkingWidth_Set 66;
BA_ "DDI" SG_ 2362179319 WorkingWidth_Act 67;
BA_ "DDI" SG_ 2362179319 WorkingWidth_Def 68;
BA_ "DDI" SG_ 2362179319 WorkingWidth_Min 69;
BA_ "DDI" SG_ 2362179319 WorkingWidth_Max 70;
BA_ "DDI" SG_ 2362179319 ContentAsVolume_Set 71;
BA_ "DDI" SG_ 2362179319 ContentAsVolume_Act 72;
BA_ "DDI" SG_ 2362179319 ContentAsVolume_Max 73;
BA_ "DDI" SG_ 2362179319 ContentAsMass_Set 74;
BA_ "DDI" SG_ 2362179319 ContentAsMass_Act 75;
BA_ "DDI" SG_ 2362179319 ContentAsMass_Max 76;
BA_ "DDI" SG_ 2362179319 ContentAsCount_Set 77;
BA_ "DDI" SG_ 2362179319 ContentAsCount_Act 78;
BA_ "DDI" SG_ 2362179319 ContentAsCount_Max 79;
BA_ "DDI" SG_ 2362179319 AccumulatedAppAsVolume 80;
BA_ "DDI" SG_ 2362179319 AccumulatedAppAsMass 81;
BA_ "DDI" SG_ 2362179319 AccumulatedAppAsCount 82;
BA_ "DDI" SG_ 2362179319 YieldVolumePerArea 83;
BA_ "DDI" SG_ 2362179319 YieldMassPerArea 84;
BA_ "DDI" SG_ 2362179319 YieldCountPerArea 85;
BA_ "DDI" SG_ 2362179319 YieldVolumePerTime 86;
BA_ "DDI" SG_ 2362179319 YieldMassPerTime 87;
BA_ "DDI" SG_ 2362179319 YieldCountPerTime 88;
BA_ "DDI" SG_ 2362179319 AccumulatedYieldAsVolume 89;
BA_ "DDI" SG_ 2362179319 AccumulatedYieldAsMass 90;
BA_ "DDI" SG_ 2362179319 AccumulatedYieldAsCount 91;
BA_ "DDI" SG_ 2362179319 CropYieldLossVolumePerArea 92;
BA_ "DDI" SG_ 2362179319 CropYieldLossMassPerArea 93;
BA_ "DDI" SG_ 2362179319 CropYieldLossCountPerArea 94;
BA_ "DDI" SG_ 2362179319 CropYieldLossVolumePerTime 95;
BA_ "DDI" SG_ 2362179319 CropYieldLossMassPerTime 96;
BA_ "DDI" SG_ 2362179319 CropYieldLossCountPerTime 97;
BA_ "DDI" SG_ 2362179319 CropYieldLoss 98;
BA_ "DDI" SG_ 2362179319 MoistureInCropYield 99;
BA_ "DDI" SG_ 2362179319 DirtMaterialInCropYield 100;
BA_ "DDI" SG_ 2362179319 BaleWidth_Set 101;
BA_ "DDI" SG_ 2362179319 BaleWidth_Act 102;
BA_ "DDI" SG_ 2362179319 BaleWidth_Def 103;
BA_ "DDI" SG_ 2362179319 BaleWidth_Min 104;
BA_ "DDI" SG_ 2362179319 BaleWidth_Max 105;
BA_ "DDI" SG_ 2362179319 BaleHeight_Set 106;
BA_ "DDI" SG_ 2362179319 BaleHeight_Act 107;
BA_ "DDI" SG_ 2362179319 BaleHeight_Def 108;
BA_ "DDI" SG_ 2362179319 BaleHeight_Min 109;
BA_ "DDI" SG_ 2362179319 BaleHeight_Max 110;
BA_ "DDI" SG_ 2362179319 BaleSize_Set 111;
BA_ "DDI" SG_ 2362179319 BaleSize_Act 112;
BA_ "DDI" SG_ 2362179319 BaleSize_Def 113;
BA_ "DDI" SG_ 2362179319 BaleSize_Min 114;
BA_ "DDI" SG_ 2362179319 BaleSize_Max 115;
BA_ "DDI" SG_ 2362179319 AccumulatedArea 116;
BA_ "DDI" SG_ 2362179319 AccumulatedDistanceInWork 117;
BA_ "DDI" SG_ 2362179319 AccumulatedDistanceOutWork 118;
BA_ "DDI" SG_ 2362179319 AccumulatedTimeInWork 119;
BA_ "DDI" SG_ 2362179319 AccumulatedTimeOutWork 120;
BA_ "DDI" SG_ 2362179319 PrdoucDensityMassPerArea 121;
BA_ "DDI" SG_ 2362179319 PrdoucDensityMassPerCount 122;
BA_ "DDI" SG_ 2362179319 PrdoucDensityVolumePerCount 123;
BA_ "DDI" SG_ 2362179319 AuxiliaryValveScalingExtend 124;
BA_ "DDI" SG_ 2362179319 AuxiliaryValveScalingRetract 125;
BA_ "DDI" SG_ 2362179319 AuxiliaryRampExtendUp 126;
BA_ "DDI" SG_ 2362179319 AuxiliaryValveRampExtendDown 127;
BA_ "DDI" SG_ 2362179319 AuxiliaryValveRampRetractUp 128;
BA_ "DDI" SG_ 2362179319 AuxiliaryValveRampRetractDown 129;
BA_ "DDI" SG_ 2362179319 AuxiliaryValveFloatThreshold 130;
BA_ "DDI" SG_ 2362179319 AuxiliaryValveProgressivExtend 131;
BA_ "DDI" SG_ 2362179319 AuxiliaryValveProgressivRetract 132;
BA_ "DDI" SG_ 2362179319 AuxiliaryValveInvertPorts 133;
BA_ "DDI" SG_ 2362179319 DeviceElementOffsetX 134;
BA_ "DDI" SG_ 2362179319 DeviceElementOffsetY 135;
BA_ "DDI" SG_ 2362179319 DeviceElementOffsetZ 136;
BA_ "DDI" SG_ 2362179319 DeviceVolumeCapacity 137;
BA_ "DDI" SG_ 2362179319 DeviceMassCapacity 138;
BA_ "DDI" SG_ 2362179319 DeviceCountCapacity 139;
BA_ "DDI" SG_ 2362179319 PercentageAppRateSetpoint 140;
BA_ "DDI" SG_ 2362179319 WorkState 141;
BA_ "DDI" SG_ 2362179319 SetpointTimeLatency 142;
BA_ "DDI" SG_ 2362179319 ActualValueTimeLatency 143;
BA_ "DDI" SG_ 2362179319 YawAngle 144;
BA_ "DDI" SG_ 2362179319 RollAngle 145;
BA_ "DDI" SG_ 2362179319 PitchAngle 146;
BA_ "DDI" SG_ 2362179319 LogCount 147;
BA_ "DDI" SG_ 2362179319 TotalFuelConsumption 148;
BA_ "DDI" SG_ 2362179319 FuelConsumptionPerTime 149;
BA_ "DDI" SG_ 2362179319 FuelConsumptionPerArea 150;
BA_ "DDI" SG_ 2362179319 AreaPerTimeCapacity 151;
BA_ "DDI" SG_ 2362179319 MinMassPerAreaAppRate 152;
BA_ "DDI" SG_ 2362179319 NDVI 153;
BA_ "DDI" SG_ 2362179319 PhysicalObjectLength 154;
BA_ "DDI" SG_ 2362179319 PhysicalObjectWidth 155;
BA_ "DDI" SG_ 2362179319 PhysicalObjectHeight 156;
BA_ "DDI" SG_ 2362179319 ConnectorType 157;
BA_ "DDI" SG_ 2362179319 PrescriptionControlState 158;
BA_ "DDI" SG_ 2362179319 NumberOfSubUnitsPerSection 159;
BA_ "DDI" SG_ 2362179319 SectionControlState 160;
BA_ "DDI" SG_ 2362179319 CondensedWorkState1to16 161;
BA_ "DDI" SG_ 2362179319 CondensedWorkState17to32 162;
BA_ "DDI" SG_ 2362179319 CondensedWorkState33to48 163;
BA_ "DDI" SG_ 2362179319 CondensedWorkState49to64 164;
BA_ "DDI" SG_ 2362179319 CondensedWorkState65to80 165;
BA_ "DDI" SG_ 2362179319 CondensedWorkState81to96 166;
BA_ "DDI" SG_ 2362179319 CondensedWorkState97to112 167;
BA_ "DDI" SG_ 2362179319 CondensedWorkState113to128 168;
BA_ "DDI" SG_ 2362179319 CondensedWorkState129to144 169;
BA_ "DDI" SG_ 2362179319 CondensedWorkState145to160 170;
BA_ "DDI" SG_ 2362179319 CondensedWorkState161to176 171;
BA_ "DDI" SG_ 2362179319 CondensedWorkState177to192 172;
BA_ "DDI" SG_ 2362179319 CondensedWorkState193to208 173;
BA_ "DDI" SG_ 2362179319 CondensedWorkState209to224 174;
BA_ "DDI" SG_ 2362179319 CondensedWorkState225to240 175;
BA_ "DDI" SG_ 2362179319 CondensedWorkState241to256 176;
BA_ "DDI" SG_ 2362179319 ActualLengthOfCut 177;
BA_ "DDI" SG_ 2362179319 ElementTypeInstance 178;
BA_ "DDI" SG_ 2362179319 ActualCulturalPractice 179;
BA_ "DDI" SG_ 2362179319 DRP2GroundDistance 180;
BA_ "DDI" SG_ 2362179319 DryMassPerAreaYield 181;
BA_ "DDI" SG_ 2362179319 DryMassPerTimeYield 182;
BA_ "DDI" SG_ 2362179319 YieldTotalDryMass 183;
BA_ "DDI" SG_ 2362179319 RefMoistureForDryMass 184;
BA_ "DDI" SG_ 2362179319 SeedCottonMassPerAreaYield 185;
BA_ "DDI" SG_ 2362179319 LintCottonMassPerAreaYield 186;
BA_ "DDI" SG_ 2362179319 SeedCottonMassPerTimeYield 187;
BA_ "DDI" SG_ 2362179319 LintCottonMassPerTimeYield 188;
BA_ "DDI" SG_ 2362179319 YieldTotalSeedCottonMass 189;
BA_ "DDI" SG_ 2362179319 YieldTotalLintCottonMass 190;
BA_ "DDI" SG_ 2362179319 LintTurnoutPercentage 191;
BA_ "DDI" SG_ 2362179319 AmbientTemperature 192;
BA_ "DDI" SG_ 2362179319 SetpointProductPressure 193;
BA_ "DDI" SG_ 2362179319 ActualProductPressure 194;
BA_ "DDI" SG_ 2362179319 MinimumProductPressure 195;
BA_ "DDI" SG_ 2362179319 MaximumProductPressure 196;
BA_ "DDI" SG_ 2362179319 SetpointPumpOutputPressure 197;
BA_ "DDI" SG_ 2362179319 ActualPumpOutputPressure 198;
BA_ "DDI" SG_ 2362179319 MinimumPumpOutputPressure 199;
BA_ "DDI" SG_ 2362179319 MaximumPumpOutputPressure 200;
BA_ "DDI" SG_ 2362179319 SetpointTankAgitationPressure 201;
BA_ "DDI" SG_ 2362179319 ActualTankAgitationPressure 202;
BA_ "DDI" SG_ 2362179319 MinimumTankAgitationPressure 203;
BA_ "DDI" SG_ 2362179319 MaximumTankAgitationPressure 204;
BA_ "DDI" SG_ 2362179319 SCTurnOnTime_ 205;
BA_ "DDI" SG_ 2362179319 SCTurnOffTime 206;
BA_ "DDI" SG_ 2362179319 WindSpeed 207;
BA_ "DDI" SG_ 2362179319 WindDirection 208;
BA_ "DDI" SG_ 2362179319 AirHumidity 209;
BA_ "DDI" SG_ 2362179319 SkyConditions 210;
BA_ "DDI" SG_ 2362179319 LastBaleFlakesPerBale 211;
BA_ "DDI" SG_ 2362179319 LastBaleAverageMoisture 212;
BA_ "DDI" SG_ 2362179319 LastBaleAverageStrokesPerFlake 213;
BA_ "DDI" SG_ 2362179319 LifetimeBaleCount 214;
BA_ "DDI" SG_ 2362179319 LifetimeWorkingHours 215;
BA_ "DDI" SG_ 2362179319 ActualBaleHydraulicPressure 216;
BA_ "DDI" SG_ 2362179319 LastBaleAverageHydraulicPressure 217;
BA_ "DDI" SG_ 2362179319 SetpointBaleCompressionPlungerLo 218;
BA_ "SystemSignalLongSymbol" SG_ 2362179319 SetpointBaleCompressionPlungerLo "SetpointBaleCompressionPlungerLoad";
BA_ "DDI" SG_ 2362179319 ActualBaleCompressionPlungerLoad 219;
BA_ "DDI" SG_ 2362179319 LastBaleAverageBaleCompressionPl 220;
BA_ "SystemSignalLongSymbol" SG_ 2362179319 LastBaleAverageBaleCompressionPl "LastBaleAverageBaleCompressionPlungerLoad";
BA_ "DDI" SG_ 2362179319 LastBaleAppliedPreservative 221;
BA_ "DDI" SG_ 2362179319 LastBaleTagNumber 222;
BA_ "DDI" SG_ 2362179319 LastBaleMass 223;
BA_ "DDI" SG_ 2362179319 DeltaT 224;
BA_ "DDI" SG_ 2362179319 SetpointWorkingLength 225;
BA_ "DDI" SG_ 2362179319 ActualWorkingLength 226;
BA_ "DDI" SG_ 2362179319 MinimumWorkingLength 227;
BA_ "DDI" SG_ 2362179319 MaximumWorkingLength 228;
BA_ "DDI" SG_ 2362179319 ActualNetWeight 229;
BA_ "DDI" SG_ 2362179319 NetWeightState 230;
BA_ "DDI" SG_ 2362179319 SetpointNetWeight 231;
BA_ "DDI" SG_ 2362179319 ActualGrossWeight 232;
BA_ "DDI" SG_ 2362179319 GrossWeightState 233;
BA_ "DDI" SG_ 2362179319 MinimumGrossWeight 234;
BA_ "DDI" SG_ 2362179319 MaximumGrossWeight 235;
BA_ "DDI" SG_ 2362179319 ThreshingEngagementTotalTime 236;
BA_ "DDI" SG_ 2362179319 ActualHeaderWorkingHeightStatus 237;
BA_ "DDI" SG_ 2362179319 ActualHeaderRotationalSpeedStatu 238;
BA_ "SystemSignalLongSymbol" SG_ 2362179319 ActualHeaderRotationalSpeedStatu "ActualHeaderRotationalSpeedStatus";
BA_ "DDI" SG_ 2362179319 YieldHoldStatus 239;
BA_ "DDI" SG_ 2362179319 ActualUnLoadingSystemStatus 240;
BA_ "DDI" SG_ 2362179319 CropTemperature 241;
BA_ "DDI" SG_ 2362179319 SetpointSieveClearance 242;
BA_ "DDI" SG_ 2362179319 ActualSieveClearance 243;
BA_ "DDI" SG_ 2362179319 MinimumSieveClearance 244;
BA_ "DDI" SG_ 2362179319 MaximumSieveClearance 245;
BA_ "DDI" SG_ 2362179319 SetpointChafferClearance 246;
BA_ "DDI" SG_ 2362179319 ActualChafferClearance 247;
BA_ "DDI" SG_ 2362179319 MinimumChafferClearance 248;
BA_ "DDI" SG_ 2362179319 MaximumChafferClearance 249;
BA_ "DDI" SG_ 2362179319 SetpointConcaveClearance 250;
BA_ "DDI" SG_ 2362179319 ActualConcaveClearance 251;
BA_ "DDI" SG_ 2362179319 MinimumConcaveClearance 252;
BA_ "DDI" SG_ 2362179319 MaximumConcaveClearance 253;
BA_ "DDI" SG_ 2362179319 SetpointSeparationFanRotationalS 254;
BA_ "SystemSignalLongSymbol" SG_ 2362179319 SetpointSeparationFanRotationalS "SetpointSeparationFanRotationalSpeed";
BA_ "DDI" SG_ 2362179319 ActualSeparationFanRotationalSpe 255;
BA_ "SystemSignalLongSymbol" SG_ 2362179319 ActualSeparationFanRotationalSpe "ActualSeparationFanRotationalSpeed";
BA_ "DDI" SG_ 2362179319 MinimumSeparationFanRotationalSp 256;
BA_ "SystemSignalLongSymbol" SG_ 2362179319 MinimumSeparationFanRotationalSp "MinimumSeparationFanRotationalSpeed";
BA_ "DDI" SG_ 2362179319 MaximumSeparationFanRotationalSp 257;
BA_ "SystemSignalLongSymbol" SG_ 2362179319 MaximumSeparationFanRotationalSp "MaximumSeparationFanRotationalSpeed";
BA_ "DDI" SG_ 2362179319 HydraulicOilTemperature 258;
BA_ "DDI" SG_ 2362179319 YieldLagIgnoreTime 259;
BA_ "DDI" SG_ 2362179319 YieldLeadIgnoreTime 260;
BA_ "DDI" SG_ 2362179319 AverageYieldMassPerTime 261;
BA_ "DDI" SG_ 2362179319 AverageCropMoisture 262;
BA_ "DDI" SG_ 2362179319 AverageYieldMassPerArea 263;
BA_ "DDI" SG_ 2362179319 ConnectorPivotXOffset 264;
BA_ "DDI" SG_ 2362179319 RemainingArea 265;
BA_ "DDI" SG_ 2362179319 LifetimeApplicationTotalMass 266;
BA_ "DDI" SG_ 2362179319 LifetimeApplicationTotalCount 267;
BA_ "DDI" SG_ 2362179319 LifetimeYieldTotalVolume 268;
BA_ "DDI" SG_ 2362179319 LifetimeYieldTotalMass 269;
BA_ "DDI" SG_ 2362179319 LifetimeYieldTotalCount 270;
BA_ "DDI" SG_ 2362179319 LifetimeTotalArea 271;
BA_ "DDI" SG_ 2362179319 LifetimeTotalDistance 272;
BA_ "DDI" SG_ 2362179319 LifetimeIneffectiveTotalDistance 273;
BA_ "DDI" SG_ 2362179319 LifetimeEffectiveTotalTime 274;
BA_ "DDI" SG_ 2362179319 LifetimeIneffectiveTotalTime 275;
BA_ "DDI" SG_ 2362179319 LifetimeFuelConsumption 276;
BA_ "DDI" SG_ 2362179319 LifetimeAverageFuelConsumptionPe 277;
BA_ "SystemSignalLongSymbol" SG_ 2362179319 LifetimeAverageFuelConsumptionPe "LifetimeAverageFuelConsumptionPerTime";
BA_ "DDI" SG_ 2362179319 LifetimeAverageFuelConsumpt_0000 278;
BA_ "SystemSignalLongSymbol" SG_ 2362179319 LifetimeAverageFuelConsumpt_0000 "LifetimeAverageFuelConsumptionPerArea";
BA_ "DDI" SG_ 2362179319 LifetimeYieldTotalDryMass 279;
BA_ "DDI" SG_ 2362179319 LifetimeYieldTotalSeedCottonMass 280;
BA_ "DDI" SG_ 2362179319 LifetimeYieldTotalLintCottonMass 281;
BA_ "DDI" SG_ 2362179319 LifetimeThreshingEngagementTotal 282;
BA_ "SystemSignalLongSymbol" SG_ 2362179319 LifetimeThreshingEngagementTotal "LifetimeThreshingEngagementTotalTime";
BA_ "DDI" SG_ 2362179319 PrecutTotalCount 283;
BA_ "DDI" SG_ 2362179319 UncutTotalCount 284;
BA_ "DDI" SG_ 2362179319 LifetimePrecutTotalCount 285;
BA_ "DDI" SG_ 2362179319 LifetimeUncutTotalCount 286;
BA_ "DDI" SG_ 2362179319 SetpointWorkState 289;
BA_ "DDI" SG_ 2362179319 SetpointCondensedWorkState1to16 290;
BA_ "DDI" SG_ 2362179319 SetpointCondensedWorkState17to32 291;
BA_ "DDI" SG_ 2362179319 SetpointCondensedWorkState33to48 292;
BA_ "DDI" SG_ 2362179319 SetpointCondensedWorkState49to64 293;
BA_ "DDI" SG_ 2362179319 SetpointCondensedWorkState65to80 294;
BA_ "DDI" SG_ 2362179319 SetpointCondensedWorkState81to96 295;
BA_ "DDI" SG_ 2362179319 SetpointCondensedWorkState97to11 296;
BA_ "SystemSignalLongSymbol" SG_ 2362179319 SetpointCondensedWorkState97to11 "SetpointCondensedWorkState97to112";
BA_ "DDI" SG_ 2362179319 SetpointCondensedWorkState113to1 297;
BA_ "SystemSignalLongSymbol" SG_ 2362179319 SetpointCondensedWorkState113to1 "SetpointCondensedWorkState113to128";
BA_ "DDI" SG_ 2362179319 SetpointCondensedWorkState129to1 298;
BA_ "SystemSignalLongSymbol" SG_ 2362179319 SetpointCondensedWorkState129to1 "SetpointCondensedWorkState129to144";
BA_ "DDI" SG_ 2362179319 SetpointCondensedWorkState145to1 299;
BA_ "SystemSignalLongSymbol" SG_ 2362179319 SetpointCondensedWorkState145to1 "SetpointCondensedWorkState145to160";
BA_ "DDI" SG_ 2362179319 SetpointCondensedWorkState161to1 300;
BA_ "SystemSignalLongSymbol" SG_ 2362179319 SetpointCondensedWorkState161to1 "SetpointCondensedWorkState161to176";
BA_ "DDI" SG_ 2362179319 SetpointCondensedWorkState177to1 301;
BA_ "SystemSignalLongSymbol" SG_ 2362179319 SetpointCondensedWorkState177to1 "SetpointCondensedWorkState177to192";
BA_ "DDI" SG_ 2362179319 SetpointCondensedWorkState193to2 302;
BA_ "SystemSignalLongSymbol" SG_ 2362179319 SetpointCondensedWorkState193to2 "SetpointCondensedWorkState193to208";
BA_ "DDI" SG_ 2362179319 SetpointCondensedWorkState209to2 303;
BA_ "SystemSignalLongSymbol" SG_ 2362179319 SetpointCondensedWorkState209to2 "SetpointCondensedWorkState209to224";
BA_ "DDI" SG_ 2362179319 SetpointCondensedWorkState225to2 304;
BA_ "SystemSignalLongSymbol" SG_ 2362179319 SetpointCondensedWorkState225to2 "SetpointCondensedWorkState225to240";
BA_ "DDI" SG_ 2362179319 SetpointCondensedWorkState241to2 305;
BA_ "SystemSignalLongSymbol" SG_ 2362179319 SetpointCondensedWorkState241to2 "SetpointCondensedWorkState241to256";
BA_ "DDI" SG_ 2362179319 TrueRotationPointXOffset 306;
BA_ "DDI" SG_ 2362179319 TrueRotationPointYOffset 307;
BA_ "DDI" SG_ 2362179319 ActualPercentageApplicationRate 308;
BA_ "DDI" SG_ 2362179319 MinimumPercentageApplicationRate 309;
BA_ "DDI" SG_ 2362179319 MaximumPercentageApplicationRate 310;
BA_ "DDI" SG_ 2362179319 RelativeYieldPotential 311;
BA_ "DDI" SG_ 2362179319 MinimumRelativeYieldPotential 312;
BA_ "DDI" SG_ 2362179319 MaximumRelativeYieldPotential 313;
BA_ "DDI" SG_ 2362179319 ActualPercentageCropDryMatter 314;
BA_ "DDI" SG_ 2362179319 AveragePercentageCropDryMatter 315;
BA_ "DDI" SG_ 2362179319 EffectiveTotalFuelConsumption 316;
BA_ "DDI" SG_ 2362179319 IneffectiveTotalFuelConsumption 317;
BA_ "DDI" SG_ 2362179319 EffectiveTotalDieselExhaustFluid 318;
BA_ "SystemSignalLongSymbol" SG_ 2362179319 EffectiveTotalDieselExhaustFluid "EffectiveTotalDieselExhaustFluidConsumption";
BA_ "DDI" SG_ 2362179319 IneffectiveTotalDieselExhaustFlu 319;
BA_ "SystemSignalLongSymbol" SG_ 2362179319 IneffectiveTotalDieselExhaustFlu "IneffectiveTotalDieselExhaustFluidConsumption";
BA_ "DDI" SG_ 2362179319 LastLoadedWeight 320;
BA_ "DDI" SG_ 2362179319 LastUnloadedWeight 321;
BA_ "DDI" SG_ 2362179319 PGNBasedData 57342;
BA_ "DDI" SG_ 2362179319 RequestDefaultProcessData 57343;
BA_ "SPN" SG_ 2362179319 DateFormatCmd 2412;
BA_ "SigType" SG_ 2362179319 DateFormatCmd 1;
BA_ "SPN" SG_ 2362179319 DecimalSymbolCmd 2411;
BA_ "SigType" SG_ 2362179319 DecimalSymbolCmd 4;
BA_ "SPN" SG_ 2362179319 TimeFormatCmd 2413;
BA_ "SigType" SG_ 2362179319 TimeFormatCmd 4;
BA_ "GenSigStartValue" SG_ 2362179319 ImplementSectionControl 1;
BA_ "GenSigStartValue" SG_ 2362179319 PeerControlAssignment 1;
BA_ "GenSigStartValue" SG_ 2362179319 TC_GEO_DefinitionPositionBasedCo 1;
BA_ "SystemSignalLongSymbol" SG_ 2362179319 TC_GEO_DefinitionPositionBasedCo "TC_GEO_DefinitionPositionBasedControl";
BA_ "GenSigStartValue" SG_ 2362179319 TimeAndPositionForDataLogging 1;
BA_ "GenSigStartValue" SG_ 2362179319 Documentation 1;
BA_ "GenSigStartValue" SG_ 2362179319 BootTimeTC 255;
BA_ "SPN" SG_ 2362179319 LanguageCodeCmd 2410;
BA_ "SigType" SG_ 2362179319 LanguageCodeCmd 3;
BA_ "GenSigStartValue" SG_ 2362179319 NumberOfControlChannels 255;
BA_ "SigType" SG_ 2565406455 ParameterGroupNumber 6;
BA_ "SPN" SG_ 2565406455 ParameterGroupNumber 2574;
BA_ "SPN" SG_ 2565406455 GroupFunctionValue 2542;
BA_ "SigType" SG_ 2565406455 GroupFunctionValue 1;
BA_ "SPN" SG_ 2565406455 ControlByte 2541;
BA_ "SPN" SG_ 2565799671 ArbitraryAddressCapable 2844;
BA_ "SPN" SG_ 2565799671 IndustryGroup 2846;
BA_ "SPN" SG_ 2565799671 VehicleSystemInstance 2843;
BA_ "SPN" SG_ 2565799671 Function 2841;
BA_ "SPN" SG_ 2565799671 FunctionInstance 2839;
BA_ "SPN" SG_ 2565799671 ECUInstance 2840;
BA_ "SigType" SG_ 2565799671 ManufacturerCode 1;
BA_ "SPN" SG_ 2565799671 ManufacturerCode 2838;
BA_ "SPN" SG_ 2565799671 IdentityNumber 2837;
VAL_ 3221225472 FirstListedFuncCharacteristic 0 "No functionalities reported " 1 "Virtual terminal " 2 "Virtual terminal working set " 3 "Auxiliary control Type 1 inputs " 4 "Auxiliary control Type 1 functions " 5 "Auxiliary control Type 2 inputs " 6 "Auxiliary control Type 2 functions" 7 "Task controller basic" 8 "Task controller basic working set " 9 "Task controller geo  " 10 "Task controller geo working set " 11 "Task controller section control " 12 "Task controller section control working set " 13 "Basic Tractor ECU  " 14 "Basic Tractor ECU implement set " 15 "Advance Tractor ECU  " 16 "Advance Tractor ECU implement set " 17 "File server " 18 "File server client " 19 "Sequence control server" 20 "Sequence control client " 21 "Stop all implement operations input" 22 "Stop all implement operations implement set " 23 "Diagnostic tool " 24 "Diagnostic ECU " 253 "Error indication" 254 "Not available" ;
VAL_ 3221225472 MachineSelSpeedExitReason 0 "No reason/all clear " 1 "Operator presence not detected" 2 "Implement released control of function " 3 "Operator override of function" 4 "Operator control not in valid position" 5 "Remote command timeout" 6 "Remote command out of range/invalid " 7 "Function not calibrated " 8 "Operator control fault " 9 "Function fault " 22 "Vehicle transmission gear does not allow remote commands" 62 "Error" 63 "Not available (parameter not supported)" ;
VAL_ 3221225472 CertTypeAuxControlFunc 0 "Not certified" 1 "Certification test performed" ;
VAL_ 3221225472 CertTypeAuxControlInUnit 0 "Not certified" 1 "Certification test performed" ;
VAL_ 3221225472 CertTypeDataLogger 0 "Not certified" 1 "Certification test performed" ;
VAL_ 3221225472 CertTypeDataLoggerWSMaster 0 "Not certified" 1 "Certification test performed" ;
VAL_ 3221225472 CertTypeDataLoggerWSMember 0 "Not certified" 1 "Certification test performed" ;
VAL_ 3221225472 CertTypeFileClient 0 "Not certified" 1 "Certification test performed" ;
VAL_ 3221225472 CertTypeSecControlClient 0 "Not certified" 1 "Certification test performed" ;
VAL_ 3221225472 CertTypeSeqControlMaster 0 "Not certified" 1 "Certification test performed" ;
VAL_ 3221225472 CertTypeTCSectionControl 0 "Not certified" 1 "Certification test performed" ;
VAL_ 3221225472 CertTypeTCSectionControlWSMember 0 "Not certified" 1 "Certification test performed" ;
VAL_ 2362179319 IndustryGroup 7 "NotAvailable" 5 "Reserved" 4 "Marine" 3 "Construction" 2 "AgriculturalAndForestry" 1 "OnHighway" 0 "Global" ;
VAL_ 2362179319 VehicleSystem2 0 "Non-specific System" 127 "Not Available" 1 "Tractor" 2 "Tillage" 3 "Secondary Tillage" 4 "Planters/Seeders" 5 "Fertilizers" 6 "Sprayers" 7 "Harvesters" 8 "Root Harvesters" 9 "Forage" 10 "Irrigation" 11 "Transport/Trailer" 12 "Farm Yard Operations" 13 "Powered Auxiliary Device" 14 "Special Crops" 15 "Earth Work" 16 "Skidder" 17 "Sensor Systems" 19 "Timber Harvesters" 20 "Forwarders" 21 "Timber loaders" 22 "Timber Processing Machines" 23 "Mulchers" 24 "Utility Vehicles" 25 "Slurry Applicators" ;
VAL_ 2362179319 Function 43 "Transmission Display" 44 "Exhaust Emission Control" 45 "Vehicle Dynamic Stability Control" 46 "Oil Sensor Unit" 47 "Information System Controller" 48 "Ramp Control" 49 "Clutch/Converter Control" 50 "Auxiliary Heater" 51 "Forward-Looking Collision Warning System" 52 "Chassis Controller" 53 "Alternator/Charging System" 54 "Communications Unit, Cellular" 55 "Communications Unit, Satellite" 56 "Communications Unit, Radio" 57 "Steering Column Unit" 58 "Fan Drive Control" 59 "Starter" 60 "Cab Display" 61 "File Server/Printer" 62 "On-Board Diagnostic Unit" 63 "Engine Valve Controller" 64 "Endurance Braking" 65 "Gas Flow Measurement" 66 "I/O Controller" 67 "Electrical System Controller" 68 "Aftertreatment system gas measurement" 69 "Engine Emission Aftertreatement System" 70 "Auxiliary Regeneration Device" 71 "Transfer Case Control" 72 "Coolant Valve Controller" 73 "Rollover Detection Control" 74 "Lubrication System" 75 "Supplemental Fan" 76 "Temperature Sensor" 77 "Fuel Properties Sensor" 78 "Fire Suppression System" 79 "Reserved" 80 "Reserved" 81 "Reserved" 82 "Reserved" 83 "Reserved" 84 "Reserved" 85 "Reserved" 86 "Reserved" 87 "Reserved" 88 "Reserved" 89 "Reserved" 90 "Reserved" 91 "Reserved" 92 "Reserved" 93 "Reserved" 94 "Reserved" 95 "Reserved" 96 "Reserved" 97 "Reserved" 98 "Reserved" 99 "Reserved" 100 "Reserved" 0 "Engine" 1 "Auxiliary Power Unit (APU)" 2 "Electric Propulsion Control" 3 "Transmission" 4 "Battery Pack Monitor" 5 "Shift Control/Console" 6 "Power TakeOff - (Main or Rear)" 7 "Axle - Steering" 8 "Axle - Drive" 9 "Brakes - System Controller" 10 "Brakes - Steer Axle" 11 "Brakes - Drive Axle" 12 "Retarder - Engine" 13 "Retarder - Driveline" 14 "Cruise Control" 15 "Fuel System" 16 "Steering Controller" 17 "Suspension - Steer Axle" 18 "Suspension - Drive Axle" 19 "Instrument Cluster" 20 "Trip Recorder" 21 "Cab Climate Control" 22 "Aerodynamic Control" 23 "Vehicle Navigation" 24 "Vehicle Security" 25 "Network Interconnect ECU" 26 "Body Controller" 27 "Power TakeOff (Secondary or Front)" 28 "Off Vehicle Gateway" 29 "Virtual Terminal (in cab)" 30 "Management Computer" 31 "Propulsion Battery Charger" 32 "Headway Controller" 33 "System Monitor" 34 "Hydraulic Pump Controller" 35 "Suspension - System Controller" 36 "Pneumatic - System Controller" 37 "Cab Controller" 38 "Tire Pressure Control" 39 "Ignition Control Module" 40 "Seat Control" 41 "Lighting - Operator Controls" 42 "Water Pump Control" 101 "Reserved" 102 "Reserved" 103 "Reserved" 104 "Reserved" 105 "Reserved" 106 "Reserved" 107 "Reserved" 108 "Reserved" 109 "Reserved" 110 "Reserved" 111 "Reserved" 112 "Reserved" 113 "Reserved" 114 "Reserved" 115 "Reserved" 116 "Reserved" 117 "Reserved" 118 "Reserved" 119 "Reserved" 120 "Reserved" 121 "Reserved" 122 "Reserved" 123 "Reserved" 124 "Reserved" 125 "Reserved" 126 "Reserved" 127 "Reserved" ;
VAL_ 2362179319 ManufacturerCode 234 "Mondial electronic GmbH" 235 "SailorMade Marine Telemetry - Tetra Technology Ltd." 236 "Norac Systems International Inc" 237 "Agtron Enterprises Inc" 238 "ZF Friedrichshafen AG" 239 "May & Scofield Ltd" 240 "Vanair Mfg" 241 "Schneider Automation SAS " 242 "Kokusandenki Co. Ltd" 243 "eRide, Inc." 244 "Techno-Matic" 245 "Capstan Ag Systems, Inc." 246 "Class 1, Inc" 247 "ePULSE" 248 "Cooper Standard Automotive Active Systems Group" 264 "Autolync" 265 "MTS Sensor Technologie GmbH" 266 "International Thermal Research Ltd" 267 "Red Lion Controls, Inc" 268 "Accurate Technologies" 269 "Saft America Inc.,  Space & Defense Division" 270 "Tennant" 271 "Cole Hersee" 312 "Lectronix, Inc." 313 "Ilmor Engineering, Inc" 314 "CSM GmbH" 315 "Icom Incorporated" 316 "ITT Flow Control" 317 "Navtronics Bvba" 318 "SAT Plan" 319 "Cadec Global" 320 "Miedema Landbouwwerktuigenfabriek B.V." 321 "Ultra Electronics, Electrics" 322 "MICHENKA s.r.o." 323 "Mobileye Vision Technologies Ltd." 324 "Snap-on Diagnostics" 325 "ASM Automation Sensorik Messtechnik GmbH" 326 "Akron Brass Company" 327 "Sonceboz SA" 272 "Gross Mechanical Laboratories, Inc" 273 "Active Research Limited" 274 "LTW Technology Co., LTD" 275 "Navico Egersund AS" 276 "Aqua-Hot Heating Systems" 277 "LHP Telematics" 278 "Takata Electronics" 279 "Geometris LP" 280 "Leica Geosystems Pty Ltd" 299 "Rauch Landmaschinen GmbH" 300 "Systron Donner Automotive" 301 "Parker Hannifin (UK) Ltd FDE group" 302 "Nissin Kogyo Co., LTD" 303 "CTS Corporation" 304 "EmpirBus AB" 305 "NovAtel Inc" 306 "Sleipner Motor AB" 307 "MBW Technologies" 308 "Cyntrx" 309 "Krauss-Maffei Wegmann GmbH & Co. KG" 310 "TECNORD srl" 311 "Patrick Power Products" 281 "Precision Governors LLC" 282 "Medallion Instrumentation Systems" 283 "CWF Hamilton & Co Ltd" 284 "Mobile Tech Chile" 285 "Sea Recovery Corp" 286 "Coelmo srl" 287 "NTech Industries, Inc" 288 "Mitsubishi FUSO Truck & Bus Corp." 289 "Watlow" 290 "Kuebler GmbH" 291 "Groeneveld Transport Efficiency BV" 292 "IKUSI - Angel Iglesias S.A." 293 "Spyder Controls Corp." 294 "Grayhill Inc." 295 "BEP Marine" 296 "micro dynamics GmbH" 297 "Zonar Systems Inc" 298 "Holley Performance" 253 "Mobile Control Systems" 254 "GE Sensing" 255 "MEAS France" 256 "Tyco Electronics AMP" 257 "Honda Motor Co., Ltd" 258 "ARAG" 259 "Jetter AG" 260 "Reichhardt GmbH" 261 "Red Dot Corporation" 262 "HydraForce, Inc" 263 "IMMI" 223 "Vaueo Retarder Co., Ltd." 224 "EMMI Network, S.L." 225 "SKF" 226 "Monaco Coach Corporation" 227 "Lykketronic A/S" 228 "ZF Marine Electronics" 229 "Garmin International Inc." 230 "Saucon Technologies" 231 "Topcon Positioning Systems, Inc." 0 "Reserved" 1 "Allied Signal Inc." 2 "Allison Transmission, GMC" 3 "Ametek, US Gauge Division" 4 "Ametek-Dixson" 5 "AMP Inc." 6 "Berifors Electronics AB" 7 "Case Corp." 8 "Caterpillar Inc." 9 "Chrysler Corp." 10 "Cummins Engine Co." 11 "Dearborn Group Inc." 12 "Deere & Company, Precision Farming" 13 "Delco Electronics" 14 "Detroit Diesel Corporation" 15 "Dickey-John Corp." 16 "Eaton Corp." 17 "Eaton Corp. Res & Dev" 18 "Eaton Corp, Transmission Division" 19 "Eaton Corp. Trucking Info Services" 20 "Eaton Ltd" 21 "Echilin Inc., Midland Brake Inc." 22 "Ford Motor Co., Electronic Concepts $ Systems" 23 "Ford Motor Co., Heavy Truck" 24 "Ford Motor Co., Vehicle Controls" 25 "Daimler Trucks North America LLC" 26 "General Motors Corp., Service Technology Group" 27 "GMC" 28 "Grote Ind. Inc." 29 "Hino Motors Ltd." 30 "Isuzu Motors Ltd." 31 "J Pollak Corp." 32 "Jacobs Vehicle Systems" 33 "John Deere" 34 "Kelsey Hayes Co." 35 "Kenworth Truck Co." 36 "Lucas Ltd." 37 "Mack Trucks Inc." 38 "Micro Processor Systems Inc." 39 "Microfirm Inc." 40 "Motorola AIEG Inc." 41 "Motorola Inc." 42 "International Truck and Engine Corp. Engine Electronics" 43 "International Truck and Engine Corp. Vehicle Electronics" 44 "Nippondenso Co. Ltd." 45 "PACCAR" 46 "Noregon Systems, Inc" 47 "Phillips Semiconductor" 48 "Pollak Alphabet" 49 "RE America Inc." 50 "Robert Bosch Corp" 51 "Robert Bosch GmbH" 52 "Meritor Automotive, Inc." 53 "Continental Automotive Systems US, Inc." 54 "Meritor Wabco" 55 "Ryder System Inc." 56 "SAIC" 57 "Sauer-Danfoss Co." 58 "SPX Corporation, OTC Division" 59 "VES Inc." 60 "Volvo Trucks North America Inc." 61 "Volvo Truck Corp." 62 "Wabco" 63 "ZF Industries Inc." 64 "unused" 65 "MAN Nutzfahrzeuge AG" 66 "John Deere Construction Equipment Division" 67 "Funk Manufacturing Company" 68 "Scania" 69 "Trimble Navigation" 70 "Flex-Coil Limited" 71 "Vansco Electronics Ltd." 72 "Sisu Corporation" 73 "LeTourneau, Inc." 74 "Eaton Axle-Brake Division" 75 "Deere & Co. Agricultural Division" 76 "unused" 77 "Deere Power Systems Group" 78 "Frank W. Murphy Manufacturing, Inc." 79 "Daimler Benz AG - Engine Division (PBM)" 80 "Twin Disc, Inc." 81 "Fire Research Corp" 82 "Bobcat/Ingersoll-Rand" 83 "Bendix VORAD Technologies" 84 "New Holland UK Limited" 85 "Kohler Co." 86 "C.E. Niehoff & Company" 87 "J.C. Bamford Excavators Ltd (JCB)" 88 "Satloc Precision GPS" 89 "Kverneland Group, Electronics Division" 90 "Knorr-Bremse SfN GmbH" 91 "BSG Bodensee Steuergeraete GmbH" 92 "Ag-Chem Equipment Co., Inc." 93 "Perkins Engines Company Ltd." 94 "CNH Global N.V." 95 "Pacific Insight Electronics Corp." 96 "Mech@tronic IT GmbH" 97 "Ag Leader Technology, Inc." 98 "Mueller-Elektronik GmbH & Co." 99 "International Transmissions Ltd (ITL)" 100 "VDO Technik AG" 101 "Sensoria" 102 "AGCO GmbH & Co." 103 "CLAAS Agrosystems GmbH & Co. KG" 104 "Claas Selbstfahrende Erntemaschinen GmbH" 105 "Kiepe Elektrik GmbH & Co. KG" 106 "BAE Systems Controls, Inc." 107 "Grimme Landmaschinen GmbH & Co. KG" 108 "WTK-Elecktronik GmbH" 109 "TeeJet Technologies Denmark" 110 "EPIQ Sensor-Nite" 111 "Maschinenfabrik Bernard Krone GmbH" 112 "MECALAC" 113 "Stress-Tek, Inc." 114 "EControls, Inc." 115 "NACCO Materials Handling Group, Inc." 116 "BEELINE Technologies" 117 "HUSCO International" 118 "Intron GmbH" 119 "IntegriNautics" 120 "RDS Technology Ltd." 121 "HED (Hydro Electronic Devices, Inc.)" 122 "FG Wilson (Engineering) Limited" 123 "Basler Electric" 124 "Hydac Electronic" 125 "Nevada Automotive Test Center" 126 "Driver Tech" 127 "Holland USA" 128 "Gerhard Duecker GmbH & Co. KG" 129 "OMNEX Control Systems, Inc." 130 "Nido - Universal Machines B.V." 131 "ITT Industries" 132 "Mulag-Fahrzeugwerk" 133 "Bucher Schoerling GmbH" 134 "Iris Technology Ltd." 135 "Airmar Technology Corporation" 136 "Komatsu Ltd." 137 "Maretron" 138 "Georg Fritzmeier GmbH & Co. KG" 139 "Caterpillar Trimble Control Technologies (CTCT), LLC" 140 "Lowrance Electronics, Inc." 141 "Thales Navigation Ltd." 142 "TRW Automotive (Commercial Steering Systems)" 143 "W. Gmeiner GmbH & Co." 144 "Mercury Marine" 145 "MurCal Controls" 146 "Maxima Technologies" 147 "Nautibus Electronic GmbH" 148 "Blue Water Data, Inc." 149 "Holset" 150 "Fleetguard" 151 "Raven Industries Inc. - Flow Controls Division" 152 "elobau GmbH & Co. KG" 153 "Woodward, Industrial Controls Division" 154 "Westerbeke Corporation" 155 "Vetronix Corporation" 156 "ITT Industries - Cannon" 157 "ISSPRO Inc." 158 "Firestone Industrial Products Company" 159 "NTech Industries Inc." 160 "Nido" 161 "Offshore Systems (UK) Limited" 162 "Axiomatic Technologies" 163 "BRP Inc." 164 "DaimlerChrysler Off-Highway" 165 "CPAC Systems AB" 166 "Phoenix International" 167 "JLG Industries Inc." 168 "Xantrex" 169 "Marlin Technologies Inc." 170 "Computronics Corporation Ltd." 171 "Wachendorff Elektronik GmbH & Co. KG" 172 "Yanmar Marine USA" 173 "Ryeso, Inc." 174 "AB Volvo Penta" 175 "Veris Technologies, Inc." 176 "Moritz Aerospace" 177 "Diagnostic System Associates" 178 "Siemens VDO Automotive AG" 179 "TeeJet Technologies Denmark" 180 "Smart Power Systems" 181 "Coretronics, Inc." 182 "Vehicle Systems Engineering B.V." 183 "KDS Controls, Inc." 184 "EIA Electronics" 185 "Beede Electrical Instrument Company" 186 "Altronic, Inc." 187 "Air-Weigh" 188 "EMP Corp." 189 "QUALCOMM" 190 "Hella KGaA Hueck & Co." 191 "XRS Corporation" 192 "Floscan" 193 "Nobletec" 194 "TriMark Corporation" 195 "General Engine Products" 196 "LEMKEN GmbH & Co. KG" 197 "Mechron Power Systems" 198 "Mystic Valley Communications" 199 "Actia Corp." 200 "MGM Brakes" 201 "Disenos y Tecnologia S.A." 202 "Curtis Instruments, Inc." 203 "MILtronik GmbH" 204 "The Morey Corporation" 205 "SmarTire Systems Inc" 206 "port GmbH" 207 "Otto Engineering" 208 "Drew Technologies, Inc." 209 "Bell Equip. Co. SA (PTY) LTD" 210 "Iteris, Inc." 211 "DNA Group" 212 "Sure Power Industries, Inc." 213 "CNH Belgium N.V." 214 "MC elettronica Srl" 215 "Aetna Engineering/Fireboy-Xintex" 216 "Paneltronics Inc." 217 "RM Michaelides Software & Elektronik GmbH" 218 "Gits Manufacturing Company" 219 "Cat OEM Solutions" 220 "Beede Electrical Instrument Company, Inc." 221 "SiE" 222 "Generac Power Systems, Inc." 1850 "Teleflex" 1851 "Raymarine" 1852 "Navionics" 1853 "Japan Radio Co." 1854 "Northstar Technologies" 1855 "Furuno USA" 1856 "Trimble" 1857 "Simrad" 1858 "Litton" 1859 "Kvasar AB" 1860 "MMP" 1861 "Vector CANtech" 1862 "Sanshin" 1863 "Thomas G. Faria Co." 232 "TSD Integrated Controls" 233 "Yacht Monitoring Solutions Inc." 249 "Schaltbau GmbH" 250 "Kuhn Group" 251 "German Agricultural Society" 252 "Sensor-Technik Wiedemann GmbH" 328 "Qwerty Electronik AB" 329 "Deif A/S" 330 "Kidde Aerospace and Defense" 331 "Horton, Inc." 332 "HWH Corporation" 333 "Hadley Products Corporation" 334 "Takata-Petri AG" 335 "Evo Electric Ltd" 336 "APE s.r.o." 337 "Carraro S.p.A." 338 "GRAF-SYTECO" 339 "Competence Center ISOBUS e.V." 340 "Continental AG" 341 "Boning GmbH & Co" 342 "THOMAS MAGNETE GmbH" 343 "Baumer Group" 344 "Parvus Corporation" 345 "Korean Maritime University" 346 "Control Solutions" 347 "Honeywell" 348 "Amazonen Werke H. Dreyer" 349 "Suonentiet" 350 "Noris Marine Systems GmbH & Co KG" 351 "Thrane & Thrane" 352 "SAME DEUTZ-FAHR" 353 "Hegemon Electronics, Inc." 354 "Junkkari OY" 355 "Mastervolt International B.V." 356 "Fischer Panda Generators, Inc" 357 "Hardi International A/S" 358 "Victron Energy BV" 359 "Ludwig Bergmann GmbH" 360 "HJS Emission Technology GmbH & Co KG" 361 "InMach" 362 "Alois Poettinger Maschinenfabrik GmbH" 363 "BEI Duncan" 364 "OEM Controls Inc." 365 "Digi-Star, LLC" 366 "Viewnyx Corp." 367 "Fliegl Agrartechnik" 368 "HANSENHOF_electronic" 369 "Power Torque Engineering Ltd" 370 "Rolls-Royce Marine AS" 371 "Heinzmann GmbH & Co. KG" 373 "Electronic Design Inc." 374 "Northern Lights, Inc." 381 "B&G" 372 "Delphi" 375 "Williams Controls Inc." 376 "Quake Global" 377 "ifm electronic gmbh" 378 "Glendinning Marine Products" 379 "Yamabiko Corporation" 380 "Suntech International Ltd." 382 "National Agricultural and Food Research Organization" 383 "MCL Industries" 384 "Camano Light" 385 "Johnson Outdoor Marine Electronics" 386 "JLG Automation BVBA" 387 "Orscheln Products, LLC" 388 "Innomatix, LLC" 389 "Benchmark Electronics, Minnesota Division" 390 "Partech Inc." 391 "Electronic Design for Industry, Inc" 392 "Tianyuan Technology Co Ltd." 393 "Harvest Tec, Inc" 394 "Capi 2 Nederland BV" 395 "GENTEC S.R.L." 396 "Beyond Measure" 397 "Sanyo-kiki Co Ltd." 398 "Hilite International" 399 "ISEKI & Co., Ltd." 400 "Livorsi Marine" 401 "Torqeedo GmbH" 402 "Simma Software, Inc." 403 "Trackwell ADS, Inc." 404 "Com Nav Marine Ltd" 405 "Wema System AS" 406 "Vecima Networks Inc." 407 "Comtech Mobile Datacom" 408 "Corvus Energy Ltd." 409 "Transfluid S.r.L." 410 "COBO S.p.A. Divisione 3B6" 411 "Hy-Drive Technologies Ltd." 412 "WebTech Wireless Inc." 413 "Datapross Nijbroek bv" 414 "Cattron Group International" 415 "Valid Manufacturing Ltd." 416 "Kubota Corporation" 417 "KZValve" 418 "Intellistick Inc" 419 "Fusion Electronics Ltd" 420 "Vermeer Corporation, ACS Group" 421 "Vertex Standard Co., Ltd" 422 "True Heading AB" 423 "BSM Wireless, Inc." 424 "Odyne LLC" 425 "Methode Electronics Inc, MDI" 426 "Egersund Marine Electronics AS" 427 "em-trak Marine Electronics Ltd" 428 "Mfg_428" 429 "Rota Engineering Ltd." 455 "ADZ NAGANO GmbH" 456 "General Kinetics" 457 "RUSELPROM-ElectricDrive Ltd" 458 "Control Solutions, Inc." 459 "Alltek Marine Electronics Corp" 460 "San Giorgio S.E.I.N." 461 "HAWE Hydraulik SE" 462 "IHI Shibaura Machinery Corporation" 463 "PROBOTIQ" 464 "Leach International Corporation" 465 "Ashcroft Inc" 466 "Veethree Electronics and Marine LLC" 467 "Lely Industries N.V." 468 "Tyco Fire Protection Products" 469 "RA Consulting GmbH" 470 "SI-TEX Marine Electronics" 471 "Sea Cross Marine AB" 472 "Tenneco Inc." 473 "Boss Industries, Inc." 474 "Persen Technologies Inc." 475 "GME" 476 "Hummingbird Marine Electronics" 477 "OilQuick AB" 478 "OceanSat BV" 479 "Vapor Bus International" 430 "Auteq Telematica S.A." 431 "Tohatsu Corporation" 432 "S&A Systems, Inc." 433 "Rowe Electronics" 434 "Stored Energy Systems" 435 "Zunhammer GmbH" 436 "Kinze Manufacturing" 437 "Digital Yacht Limited" 438 "Comar Systems Ltd" 439 "Hyundai Heavy Industries" 440 "Cummins Power Generation" 441 "PTG Reifendruckregelsysteme GmbH" 442 "Horsch Maschinen GmbH" 443 "SignalQuest, Inc." 444 "ITT Power Solutions" 445 "KAT MECHATRONIC, Electronic Product Division" 446 "CertTech, L.L.C." 447 "Great Plains Mfg." 448 "Stanadyne Corporation, Electronics Systems" 449 "Polaris Industries Inc" 450 "Dycor Technologies Ltd." 451 "Parker Hannifin Corp" 452 "WIKA Alexander Wiegand SE & Co. KG" 453 "Cooper Bussmann" 454 "NGK Spark Plug Co. Ltd" 480 "EnerDel, Inc." 481 "Chetco Digital Instruments" 482 "Tricon Electronics" 483 "Valeo" 484 "Headsight Inc." 485 "MATT automotive" 486 "Westport Innovations Inc." 487 "DSE Test Solutions A/S" 488 "The Charles Machine Works, Inc." 489 "Appareo Systems" 490 "QuikQ" 491 "Penny and Giles Ltd" 492 "Inergy Automotive Systems" 493 "Watcheye" 494 "Synerject" 495 "HOLMER Maschinenbau GmbH" 496 "W. Gessmann GmbH" 497 "SENTRON Sistemas Embarcados" 498 "Innovative Design Solutions, Inc." 499 "LCJ Capteurs" 500 "Oxbo International Corporation" 501 "Agrotronix S.A." 502 "Attwood Corporation" 503 "Naviop S.R.L." 504 "Vesper Marine" 505 "Yetter Farm Equipment" 506 "IHI STAR Machinery Corporation" 507 "Test Center ISOBUS" 508 "Transtech Innovations" 509 "MOTORTECH GmbH" 510 "Marinesoft Co. Ltd" 511 "Sulky" 512 "Inpower LLC" 513 "FarmscanAg" 514 "DISTek Integration, Inc." 515 "GINAF Trucks Nederland B.V." 516 "AVAT Automation GmbH" 517 "Noland Engineering" 518 "Transas USA Inc." 519 "Peeters Landbouwmachines b.v." 520 "Trapeze" ;
VAL_ 2362179319 TemperatureUnits 3 "NoAction" 2 "Reserved" 1 "Imperial" 0 "Metric" ;
VAL_ 2362179319 PressureUnits 3 "NoAction" 2 "Reserved" 1 "Imperial" 0 "Metric" ;
VAL_ 2362179319 ErrorCodeObjPool4 0 "NoError" 1 "ObjectPoolWasDeleted" ;
VAL_ 2362179319 ErrorCodeObjPool3 0 "NoError" 1 "GeneralError" ;
VAL_ 2362179319 ForceUnits 3 "NoAction" 2 "Reserved" 1 "Imperial" 0 "Metric" ;
VAL_ 2362179319 ErrorCodeObjPool2 0 "NoError" 1 "UnknownObjectReference" ;
VAL_ 2362179319 UnitsSystem 3 "NoAction" 2 "US" 1 "Imperial" 0 "Metric" ;
VAL_ 2362179319 ErrorCodeObjPool1 0 "NoError" 1 "MethodOrAttributeNotSupported" ;
VAL_ 2362179319 DistanceUnitCmd 3 "NoAction" 1 "Imperial" 0 "Metric" ;
VAL_ 2362179319 AreaUnitCmd 3 "NoAction" 1 "Imperial" 0 "Metric" ;
VAL_ 2362179319 VolumeUnitCmd 3 "NoAction" 2 "US" 1 "Imperial" 0 "Metric" ;
VAL_ 2362179319 MassUnitCmd 3 "NoAction" 2 "TonsPounds" 1 "Imperial" 0 "Metric" ;
VAL_ 2362179319 ErrorCodeProcessData8 1 "ProcessDataValueIsOutsideOperationalRange " 0 "NoError" ;
VAL_ 2362179319 ErrorCodeProcessData7 1 "ProcessDataValueNotConformToDDI " 0 "NoError" ;
VAL_ 2362179319 ErrorCodeProcessData6 1 "InvalidIntervalOrThreshold" 0 "NoError" ;
VAL_ 2362179319 ErrorCodeProcessData5 1 "ProcessDataNotSetable" 0 "NoError" ;
VAL_ 2362179319 ErrorCodeProcessData4 1 "TriggerMethodNotSupported" 0 "NoError" ;
VAL_ 2362179319 ErrorCodeProcessData3 1 "DDINotSupportedByElement" 0 "NoError" ;
VAL_ 2362179319 ErrorCodeProcessData2 1 "InvalidElementNumber" 0 "NoError" ;
VAL_ 2362179319 DataLogTimeInterval 0 "Stop measurement" ;
VAL_ 2362179319 DataLogDistanceInterval 0 "Stop measurement" ;
VAL_ 2362179319 ErrorCodeProcessData1 1 "CommandNotSupported" 0 "NoError" ;
VAL_ 2362179319 DateFormatCmd 5 "yyyyddmm" 4 "yyyymmdd" 3 "mmddyyyy" 2 "mmyyyydd" 1 "ddyyyymm" 0 "ddmmyyyy" ;
VAL_ 2362179319 PeerControlCommand 0 "Assign Receiver" 1 "UnassignReceiver" 2 "Receiver Ackowledge" 3 "Assign Transmitter" 4 "UnassignTransmitter" 5 "Transmitter Acknowledge" ;
VAL_ 2362179319 DecimalSymbolCmd 3 "NoAction" 1 "PointIsUsed" 0 "CommaIsUsed" ;
VAL_ 2362179319 TimeFormatCmd 3 "NoAction" 1 "Hour12" 0 "Hour24" ;
VAL_ 2362179319 ImplementSectionControl 0 "NotSupported" 1 "Supported" ;
VAL_ 2362179319 PeerControlAssignment 0 "NotSupported" 1 "Supported" ;
VAL_ 2362179319 TC_GEO_DefinitionPositionBasedCo 0 "NotSupported" 1 "Supported" ;
VAL_ 2362179319 TimeAndPositionForDataLogging 0 "NotSupported" 1 "Supported" ;
VAL_ 2362179319 Documentation 0 "NotSupported" 1 "Supported" ;
VAL_ 2362179319 ErrorCodeChangeDesignator 0 "Success" 1 "Error" ;
VAL_ 2362179319 ErrorCodeObjPoolActiveResp3 0 "NoError" 1 "GeneralError" ;
VAL_ 2362179319 ErrorCodeObjPoolActiveResp2 0 "NoError" 1 "TaskControllerRanOutOfMemory" ;
VAL_ 2362179319 Status 0 "EnoughMemoryAvailable" 1 "NotEnoughMemoryAvailable" ;
VAL_ 2362179319 ErrorCodeObjPoolTransfer 0 "NoError" 1 "TaskControllerRanOutOfMemory" 2 "GeneralError" ;
VAL_ 2362179319 ActivateDeactivateCommand 0 "ObjectPoolDeactivation" 255 "ObjectPoolActivation" ;
VAL_ 2362179319 ErrorCodeObjectPoolDelete 0 "Success" 1 "Error" ;
VAL_ 2362179319 ErrorCodeObjPoolActiveResp1 0 "NoError" 1 "ErrorsInTheObjectPool" ;
VAL_ 2362179319 TechnicalDataMsgType 0 "ParameterRequestVersion" 1 "ParameterVersion" ;
VAL_ 2362179319 DeviceDescriptionMsgType 0 "RequestStructureLabel" 1 "StructureLabel" 2 "RequestLocalizationLabel" 3 "LocalizationLabel" 4 "RequestObjectPoolTransfer" 5 "RequestObjectPoolTransferResp" 6 "ObjectPoolTransfer" 7 "ObjectPoolTransferResponse" 8 "ObjectPoolActivate" 9 "ObjectPoolActivateResponse" 10 "ObjectPoolDelete" 11 "ObjectPoolDeleteResponse" 12 "ChangeDesignator" 13 "ChangeDesignatorResponse" ;
VAL_ 2362179319 Command 15 "WorkingSetTask" 14 "TaskControllerStatus" 13 "PDACK" 8 "ChangeThreshold" 7 "MaxWithinThreshold" 6 "MinWithinThreshold" 5 "DistanceInterval" 4 "TimeInterval" 3 "ValueCommand" 2 "RequestValue" 1 "DeviceDescription" 0 "TechnicalData" 9 "PeerControlAssignment" 10 "SetValueAndAcknowledge" ;
VAL_ 2565406455 ControlByte 0 "ACK" 1 "NACK" 2 "AccessDenied" 3 "CannotRespond" ;
VAL_ 2565799671 IndustryGroup 7 "Reserved for SAE" 5 "IndustrialProcessCtrlStationary" 4 "Marine" 3 "Construction" 2 "Agricultural and Forestry" 1 "On-Highway" 0 "Global" ;
VAL_ 2565799671 VehicleSystem 127 "Not Available" 0 "Non-specific System" ;
VAL_ 2565799671 VehicleSystem5 0 "Ind. Process Control Stationary" 127 "Not Available" ;
VAL_ 2565799671 VehicleSystem4 0 "Non-specific System" 127 "Not Available" 10 "System Tools" 20 "Safety Systems" 25 "Inter/Intranetwork Device" 30 "Electrical Distribution" 40 "Steering and Control Surfaces" 50 "Propulsion" 60 "Navigation" 70 "Communications" 80 "Instrumentation/General Systems (deprecate)" 90 "Internal Environment" 100 "Deck, Cargo and Fishing Equipment" 35 "Electrical Generation" 75 "Sensor Communication Interface" 85 "External Environment" 120 "Display" 125 "Entertainment" ;
VAL_ 2565799671 VehicleSystem3 0 "Non-specific System" 127 "Not Available" 1 "Skid Steer Loader" 2 "Articulated Dump Truck" 3 "Backhoe" 4 "Crawler" 5 "Excavator" 6 "Forklift" 7 "Four Wheel Drive Loader" 8 "Grader" ;
VAL_ 2565799671 VehicleSystem2 0 "Non-specific System" 127 "Not Available" 1 "Tractor" 2 "Tillage" 3 "Secondary Tillage" 4 "Planters/Seeders" 5 "Fertilizers" 6 "Sprayers" 7 "Harvesters" 8 "Root Harvesters" 9 "Forage" 10 "Irrigation" 11 "Transport/Trailer" 12 "Farm Yard Operations" 13 "Powered Auxiliary Device" 14 "Special Crops" 15 "Earth Work" 16 "Skidder" 17 "Sensor Systems" 19 "Timber Harvesters" 20 "Forwarders" 21 "Timber loaders" 22 "Timber Processing Machines" 23 "Mulchers" 24 "Utility Vehicles" 25 "Slurry Applicators" ;
VAL_ 2565799671 VehicleSystem1 0 "Non-specific System" 127 "Not Available" 1 "Tractor" 2 "Trailer" ;
VAL_ 2565799671 Function 43 "Transmission Display" 44 "Exhaust Emission Control" 45 "Vehicle Dynamic Stability Control" 46 "Oil Sensor Unit" 47 "Information System Controller" 48 "Ramp Control" 49 "Clutch/Converter Control" 50 "Auxiliary Heater" 51 "Forward-Looking Collision Warning System" 52 "Chassis Controller" 53 "Alternator/Charging System" 54 "Communications Unit, Cellular" 55 "Communications Unit, Satellite" 56 "Communications Unit, Radio" 57 "Steering Column Unit" 58 "Fan Drive Control" 59 "Starter" 60 "Cab Display" 61 "File Server/Printer" 62 "On-Board Diagnostic Unit" 63 "Engine Valve Controller" 64 "Endurance Braking" 65 "Gas Flow Measurement" 66 "I/O Controller" 67 "Electrical System Controller" 68 "Aftertreatment system gas measurement" 69 "Engine Emission Aftertreatement System" 70 "Auxiliary Regeneration Device" 71 "Transfer Case Control" 72 "Coolant Valve Controller" 73 "Rollover Detection Control" 74 "Lubrication System" 75 "Supplemental Fan" 76 "Temperature Sensor" 77 "Fuel Properties Sensor" 78 "Fire Suppression System" 79 "Reserved" 80 "Reserved" 81 "Reserved" 82 "Reserved" 83 "Reserved" 84 "Reserved" 85 "Reserved" 86 "Reserved" 87 "Reserved" 88 "Reserved" 89 "Reserved" 90 "Reserved" 91 "Reserved" 92 "Reserved" 93 "Reserved" 94 "Reserved" 95 "Reserved" 96 "Reserved" 97 "Reserved" 98 "Reserved" 99 "Reserved" 100 "Reserved" 0 "Engine" 1 "Auxiliary Power Unit (APU)" 2 "Electric Propulsion Control" 3 "Transmission" 4 "Battery Pack Monitor" 5 "Shift Control/Console" 6 "Power TakeOff - (Main or Rear)" 7 "Axle - Steering" 8 "Axle - Drive" 9 "Brakes - System Controller" 10 "Brakes - Steer Axle" 11 "Brakes - Drive Axle" 12 "Retarder - Engine" 13 "Retarder - Driveline" 14 "Cruise Control" 15 "Fuel System" 16 "Steering Controller" 17 "Suspension - Steer Axle" 18 "Suspension - Drive Axle" 19 "Instrument Cluster" 20 "Trip Recorder" 21 "Cab Climate Control" 22 "Aerodynamic Control" 23 "Vehicle Navigation" 24 "Vehicle Security" 25 "Network Interconnect ECU" 26 "Body Controller" 27 "Power TakeOff (Secondary or Front)" 28 "Off Vehicle Gateway" 29 "Virtual Terminal (in cab)" 30 "Management Computer" 31 "Propulsion Battery Charger" 32 "Headway Controller" 33 "System Monitor" 34 "Hydraulic Pump Controller" 35 "Suspension - System Controller" 36 "Pneumatic - System Controller" 37 "Cab Controller" 38 "Tire Pressure Control" 39 "Ignition Control Module" 40 "Seat Control" 41 "Lighting - Operator Controls" 42 "Water Pump Control" 101 "Reserved" 102 "Reserved" 103 "Reserved" 104 "Reserved" 105 "Reserved" 106 "Reserved" 107 "Reserved" 108 "Reserved" 109 "Reserved" 110 "Reserved" 111 "Reserved" 112 "Reserved" 113 "Reserved" 114 "Reserved" 115 "Reserved" 116 "Reserved" 117 "Reserved" 118 "Reserved" 119 "Reserved" 120 "Reserved" 121 "Reserved" 122 "Reserved" 123 "Reserved" 124 "Reserved" 125 "Reserved" 126 "Reserved" 127 "Reserved" ;
VAL_ 2565799671 ManufacturerCode 234 "Mondial electronic GmbH" 235 "SailorMade Marine Telemetry - Tetra Technology Ltd." 236 "Norac Systems International Inc" 237 "Agtron Enterprises Inc" 238 "ZF Friedrichshafen AG" 239 "May & Scofield Ltd" 240 "Vanair Mfg" 241 "Schneider Automation SAS " 242 "Kokusandenki Co. Ltd" 243 "eRide, Inc." 244 "Techno-Matic" 245 "Capstan Ag Systems, Inc." 246 "Class 1, Inc" 247 "ePULSE" 248 "Cooper Standard Automotive Active Systems Group" 264 "Autolync" 265 "MTS Sensor Technologie GmbH" 266 "International Thermal Research Ltd" 267 "Red Lion Controls, Inc" 268 "Accurate Technologies" 269 "Saft America Inc.,  Space & Defense Division" 270 "Tennant" 271 "Cole Hersee" 312 "Lectronix, Inc." 313 "Ilmor Engineering, Inc" 314 "CSM GmbH" 315 "Icom Incorporated" 316 "ITT Flow Control" 317 "Navtronics Bvba" 318 "SAT Plan" 319 "Cadec Global" 320 "Miedema Landbouwwerktuigenfabriek B.V." 321 "Ultra Electronics, Electrics" 322 "MICHENKA s.r.o." 323 "Mobileye Vision Technologies Ltd." 324 "Snap-on Diagnostics" 325 "ASM Automation Sensorik Messtechnik GmbH" 326 "Akron Brass Company" 327 "Sonceboz SA" 272 "Gross Mechanical Laboratories, Inc" 273 "Active Research Limited" 274 "LTW Technology Co., LTD" 275 "Navico Egersund AS" 276 "Aqua-Hot Heating Systems" 277 "LHP Telematics" 278 "Takata Electronics" 279 "Geometris LP" 280 "Leica Geosystems Pty Ltd" 299 "Rauch Landmaschinen GmbH" 300 "Systron Donner Automotive" 301 "Parker Hannifin (UK) Ltd FDE group" 302 "Nissin Kogyo Co., LTD" 303 "CTS Corporation" 304 "EmpirBus AB" 305 "NovAtel Inc" 306 "Sleipner Motor AB" 307 "MBW Technologies" 308 "Cyntrx" 309 "Krauss-Maffei Wegmann GmbH & Co. KG" 310 "TECNORD srl" 311 "Patrick Power Products" 281 "Precision Governors LLC" 282 "Medallion Instrumentation Systems" 283 "CWF Hamilton & Co Ltd" 284 "Mobile Tech Chile" 285 "Sea Recovery Corp" 286 "Coelmo srl" 287 "NTech Industries, Inc" 288 "Mitsubishi FUSO Truck & Bus Corp." 289 "Watlow" 290 "Kuebler GmbH" 291 "Groeneveld Transport Efficiency BV" 292 "IKUSI - Angel Iglesias S.A." 293 "Spyder Controls Corp." 294 "Grayhill Inc." 295 "BEP Marine" 296 "micro dynamics GmbH" 297 "Zonar Systems Inc" 298 "Holley Performance" 253 "Mobile Control Systems" 254 "GE Sensing" 255 "MEAS France" 256 "Tyco Electronics AMP" 257 "Honda Motor Co., Ltd" 258 "ARAG" 259 "Jetter AG" 260 "Reichhardt GmbH" 261 "Red Dot Corporation" 262 "HydraForce, Inc" 263 "IMMI" 223 "Vaueo Retarder Co., Ltd." 224 "EMMI Network, S.L." 225 "SKF" 226 "Monaco Coach Corporation" 227 "Lykketronic A/S" 228 "ZF Marine Electronics" 229 "Garmin International Inc." 230 "Saucon Technologies" 231 "Topcon Positioning Systems, Inc." 0 "Reserved" 1 "Allied Signal Inc." 2 "Allison Transmission, GMC" 3 "Ametek, US Gauge Division" 4 "Ametek-Dixson" 5 "AMP Inc." 6 "Berifors Electronics AB" 7 "Case Corp." 8 "Caterpillar Inc." 9 "Chrysler Corp." 10 "Cummins Engine Co." 11 "Dearborn Group Inc." 12 "Deere & Company, Precision Farming" 13 "Delco Electronics" 14 "Detroit Diesel Corporation" 15 "Dickey-John Corp." 16 "Eaton Corp." 17 "Eaton Corp. Res & Dev" 18 "Eaton Corp, Transmission Division" 19 "Eaton Corp. Trucking Info Services" 20 "Eaton Ltd" 21 "Echilin Inc., Midland Brake Inc." 22 "Ford Motor Co., Electronic Concepts $ Systems" 23 "Ford Motor Co., Heavy Truck" 24 "Ford Motor Co., Vehicle Controls" 25 "Daimler Trucks North America LLC" 26 "General Motors Corp., Service Technology Group" 27 "GMC" 28 "Grote Ind. Inc." 29 "Hino Motors Ltd." 30 "Isuzu Motors Ltd." 31 "J Pollak Corp." 32 "Jacobs Vehicle Systems" 33 "John Deere" 34 "Kelsey Hayes Co." 35 "Kenworth Truck Co." 36 "Lucas Ltd." 37 "Mack Trucks Inc." 38 "Micro Processor Systems Inc." 39 "Microfirm Inc." 40 "Motorola AIEG Inc." 41 "Motorola Inc." 42 "International Truck and Engine Corp. Engine Electronics" 43 "International Truck and Engine Corp. Vehicle Electronics" 44 "Nippondenso Co. Ltd." 45 "PACCAR" 46 "Noregon Systems, Inc" 47 "Phillips Semiconductor" 48 "Pollak Alphabet" 49 "RE America Inc." 50 "Robert Bosch Corp" 51 "Robert Bosch GmbH" 52 "Meritor Automotive, Inc." 53 "Continental Automotive Systems US, Inc." 54 "Meritor Wabco" 55 "Ryder System Inc." 56 "SAIC" 57 "Sauer-Danfoss Co." 58 "SPX Corporation, OTC Division" 59 "VES Inc." 60 "Volvo Trucks North America Inc." 61 "Volvo Truck Corp." 62 "Wabco" 63 "ZF Industries Inc." 64 "unused" 65 "MAN Nutzfahrzeuge AG" 66 "John Deere Construction Equipment Division" 67 "Funk Manufacturing Company" 68 "Scania" 69 "Trimble Navigation" 70 "Flex-Coil Limited" 71 "Vansco Electronics Ltd." 72 "Sisu Corporation" 73 "LeTourneau, Inc." 74 "Eaton Axle-Brake Division" 75 "Deere & Co. Agricultural Division" 76 "unused" 77 "Deere Power Systems Group" 78 "Frank W. Murphy Manufacturing, Inc." 79 "Daimler Benz AG - Engine Division (PBM)" 80 "Twin Disc, Inc." 81 "Fire Research Corp" 82 "Bobcat/Ingersoll-Rand" 83 "Bendix VORAD Technologies" 84 "New Holland UK Limited" 85 "Kohler Co." 86 "C.E. Niehoff & Company" 87 "J.C. Bamford Excavators Ltd (JCB)" 88 "Satloc Precision GPS" 89 "Kverneland Group, Electronics Division" 90 "Knorr-Bremse SfN GmbH" 91 "BSG Bodensee Steuergeraete GmbH" 92 "Ag-Chem Equipment Co., Inc." 93 "Perkins Engines Company Ltd." 94 "CNH Global N.V." 95 "Pacific Insight Electronics Corp." 96 "Mech@tronic IT GmbH" 97 "Ag Leader Technology, Inc." 98 "Mueller-Elektronik GmbH & Co." 99 "International Transmissions Ltd (ITL)" 100 "VDO Technik AG" 101 "Sensoria" 102 "AGCO GmbH & Co." 103 "CLAAS Agrosystems GmbH & Co. KG" 104 "Claas Selbstfahrende Erntemaschinen GmbH" 105 "Kiepe Elektrik GmbH & Co. KG" 106 "BAE Systems Controls, Inc." 107 "Grimme Landmaschinen GmbH & Co. KG" 108 "WTK-Elecktronik GmbH" 109 "TeeJet Technologies Denmark" 110 "EPIQ Sensor-Nite" 111 "Maschinenfabrik Bernard Krone GmbH" 112 "MECALAC" 113 "Stress-Tek, Inc." 114 "EControls, Inc." 115 "NACCO Materials Handling Group, Inc." 116 "BEELINE Technologies" 117 "HUSCO International" 118 "Intron GmbH" 119 "IntegriNautics" 120 "RDS Technology Ltd." 121 "HED (Hydro Electronic Devices, Inc.)" 122 "FG Wilson (Engineering) Limited" 123 "Basler Electric" 124 "Hydac Electronic" 125 "Nevada Automotive Test Center" 126 "Driver Tech" 127 "Holland USA" 128 "Gerhard Duecker GmbH & Co. KG" 129 "OMNEX Control Systems, Inc." 130 "Nido - Universal Machines B.V." 131 "ITT Industries" 132 "Mulag-Fahrzeugwerk" 133 "Bucher Schoerling GmbH" 134 "Iris Technology Ltd." 135 "Airmar Technology Corporation" 136 "Komatsu Ltd." 137 "Maretron" 138 "Georg Fritzmeier GmbH & Co. KG" 139 "Caterpillar Trimble Control Technologies (CTCT), LLC" 140 "Lowrance Electronics, Inc." 141 "Thales Navigation Ltd." 142 "TRW Automotive (Commercial Steering Systems)" 143 "W. Gmeiner GmbH & Co." 144 "Mercury Marine" 145 "MurCal Controls" 146 "Maxima Technologies" 147 "Nautibus Electronic GmbH" 148 "Blue Water Data, Inc." 149 "Holset" 150 "Fleetguard" 151 "Raven Industries Inc. - Flow Controls Division" 152 "elobau GmbH & Co. KG" 153 "Woodward, Industrial Controls Division" 154 "Westerbeke Corporation" 155 "Vetronix Corporation" 156 "ITT Industries - Cannon" 157 "ISSPRO Inc." 158 "Firestone Industrial Products Company" 159 "NTech Industries Inc." 160 "Nido" 161 "Offshore Systems (UK) Limited" 162 "Axiomatic Technologies" 163 "BRP Inc." 164 "DaimlerChrysler Off-Highway" 165 "CPAC Systems AB" 166 "Phoenix International" 167 "JLG Industries Inc." 168 "Xantrex" 169 "Marlin Technologies Inc." 170 "Computronics Corporation Ltd." 171 "Wachendorff Elektronik GmbH & Co. KG" 172 "Yanmar Marine USA" 173 "Ryeso, Inc." 174 "AB Volvo Penta" 175 "Veris Technologies, Inc." 176 "Moritz Aerospace" 177 "Diagnostic System Associates" 178 "Siemens VDO Automotive AG" 179 "TeeJet Technologies Denmark" 180 "Smart Power Systems" 181 "Coretronics, Inc." 182 "Vehicle Systems Engineering B.V." 183 "KDS Controls, Inc." 184 "EIA Electronics" 185 "Beede Electrical Instrument Company" 186 "Altronic, Inc." 187 "Air-Weigh" 188 "EMP Corp." 189 "QUALCOMM" 190 "Hella KGaA Hueck & Co." 191 "XRS Corporation" 192 "Floscan" 193 "Nobletec" 194 "TriMark Corporation" 195 "General Engine Products" 196 "LEMKEN GmbH & Co. KG" 197 "Mechron Power Systems" 198 "Mystic Valley Communications" 199 "Actia Corp." 200 "MGM Brakes" 201 "Disenos y Tecnologia S.A." 202 "Curtis Instruments, Inc." 203 "MILtronik GmbH" 204 "The Morey Corporation" 205 "SmarTire Systems Inc" 206 "port GmbH" 207 "Otto Engineering" 208 "Drew Technologies, Inc." 209 "Bell Equip. Co. SA (PTY) LTD" 210 "Iteris, Inc." 211 "DNA Group" 212 "Sure Power Industries, Inc." 213 "CNH Belgium N.V." 214 "MC elettronica Srl" 215 "Aetna Engineering/Fireboy-Xintex" 216 "Paneltronics Inc." 217 "RM Michaelides Software & Elektronik GmbH" 218 "Gits Manufacturing Company" 219 "Cat OEM Solutions" 220 "Beede Electrical Instrument Company, Inc." 221 "SiE" 222 "Generac Power Systems, Inc." 1850 "Teleflex" 1851 "Raymarine" 1852 "Navionics" 1853 "Japan Radio Co." 1854 "Northstar Technologies" 1855 "Furuno USA" 1856 "Trimble" 1857 "Simrad" 1858 "Litton" 1859 "Kvasar AB" 1860 "MMP" 1861 "Vector CANtech" 1862 "Sanshin" 1863 "Thomas G. Faria Co." 232 "TSD Integrated Controls" 233 "Yacht Monitoring Solutions Inc." 249 "Schaltbau GmbH" 250 "Kuhn Group" 251 "German Agricultural Society" 252 "Sensor-Technik Wiedemann GmbH" 328 "Qwerty Electronik AB" 329 "Deif A/S" 330 "Kidde Aerospace and Defense" 331 "Horton, Inc." 332 "HWH Corporation" 333 "Hadley Products Corporation" 334 "Takata-Petri AG" 335 "Evo Electric Ltd" 336 "APE s.r.o." 337 "Carraro S.p.A." 338 "GRAF-SYTECO" 339 "Competence Center ISOBUS e.V." 340 "Continental AG" 341 "Boning GmbH & Co" 342 "THOMAS MAGNETE GmbH" 343 "Baumer Group" 344 "Parvus Corporation" 345 "Korean Maritime University" 346 "Control Solutions" 347 "Honeywell" 348 "Amazonen Werke H. Dreyer" 349 "Suonentiet" 350 "Noris Marine Systems GmbH & Co KG" 351 "Thrane & Thrane" 352 "SAME DEUTZ-FAHR" 353 "Hegemon Electronics, Inc." 354 "Junkkari OY" 355 "Mastervolt International B.V." 356 "Fischer Panda Generators, Inc" 357 "Hardi International A/S" 358 "Victron Energy BV" 359 "Ludwig Bergmann GmbH" 360 "HJS Emission Technology GmbH & Co KG" 361 "InMach" 362 "Alois Poettinger Maschinenfabrik GmbH" 363 "BEI Duncan" 364 "OEM Controls Inc." 365 "Digi-Star, LLC" 366 "Viewnyx Corp." 367 "Fliegl Agrartechnik" 368 "HANSENHOF_electronic" 369 "Power Torque Engineering Ltd" 370 "Rolls-Royce Marine AS" 371 "Heinzmann GmbH & Co. KG" 373 "Electronic Design Inc." 374 "Northern Lights, Inc." 381 "B&G" 372 "Delphi" 375 "Williams Controls Inc." 376 "Quake Global" 377 "ifm electronic gmbh" 378 "Glendinning Marine Products" 379 "Yamabiko Corporation" 380 "Suntech International Ltd." 382 "National Agricultural and Food Research Organization" 383 "MCL Industries" 384 "Camano Light" 385 "Johnson Outdoor Marine Electronics" 386 "JLG Automation BVBA" 387 "Orscheln Products, LLC" 388 "Innomatix, LLC" 389 "Benchmark Electronics, Minnesota Division" 390 "Partech Inc." 391 "Electronic Design for Industry, Inc" 392 "Tianyuan Technology Co Ltd." 393 "Harvest Tec, Inc" 394 "Capi 2 Nederland BV" 395 "GENTEC S.R.L." 396 "Beyond Measure" 397 "Sanyo-kiki Co Ltd." 398 "Hilite International" 399 "ISEKI & Co., Ltd." 400 "Livorsi Marine" 401 "Torqeedo GmbH" 402 "Simma Software, Inc." 403 "Trackwell ADS, Inc." 404 "Com Nav Marine Ltd" 405 "Wema System AS" 406 "Vecima Networks Inc." 407 "Comtech Mobile Datacom" 408 "Corvus Energy Ltd." 409 "Transfluid S.r.L." 410 "COBO S.p.A. Divisione 3B6" 411 "Hy-Drive Technologies Ltd." 412 "WebTech Wireless Inc." 413 "Datapross Nijbroek bv" 414 "Cattron Group International" 415 "Valid Manufacturing Ltd." 416 "Kubota Corporation" 417 "KZValve" 418 "Intellistick Inc" 419 "Fusion Electronics Ltd" 420 "Vermeer Corporation, ACS Group" 421 "Vertex Standard Co., Ltd" 422 "True Heading AB" 423 "BSM Wireless, Inc." 424 "Odyne LLC" 425 "Methode Electronics Inc, MDI" 426 "Egersund Marine Electronics AS" 427 "em-trak Marine Electronics Ltd" 428 "Mfg_428" 429 "Rota Engineering Ltd." 455 "ADZ NAGANO GmbH" 456 "General Kinetics" 457 "RUSELPROM-ElectricDrive Ltd" 458 "Control Solutions, Inc." 459 "Alltek Marine Electronics Corp" 460 "San Giorgio S.E.I.N." 461 "HAWE Hydraulik SE" 462 "IHI Shibaura Machinery Corporation" 463 "PROBOTIQ" 464 "Leach International Corporation" 465 "Ashcroft Inc" 466 "Veethree Electronics and Marine LLC" 467 "Lely Industries N.V." 468 "Tyco Fire Protection Products" 469 "RA Consulting GmbH" 470 "SI-TEX Marine Electronics" 471 "Sea Cross Marine AB" 472 "Tenneco Inc." 473 "Boss Industries, Inc." 474 "Persen Technologies Inc." 475 "GME" 476 "Hummingbird Marine Electronics" 477 "OilQuick AB" 478 "OceanSat BV" 479 "Vapor Bus International" 430 "Auteq Telematica S.A." 431 "Tohatsu Corporation" 432 "S&A Systems, Inc." 433 "Rowe Electronics" 434 "Stored Energy Systems" 435 "Zunhammer GmbH" 436 "Kinze Manufacturing" 437 "Digital Yacht Limited" 438 "Comar Systems Ltd" 439 "Hyundai Heavy Industries" 440 "Cummins Power Generation" 441 "PTG Reifendruckregelsysteme GmbH" 442 "Horsch Maschinen GmbH" 443 "SignalQuest, Inc." 444 "ITT Power Solutions" 445 "KAT MECHATRONIC, Electronic Product Division" 446 "CertTech, L.L.C." 447 "Great Plains Mfg." 448 "Stanadyne Corporation, Electronics Systems" 449 "Polaris Industries Inc" 450 "Dycor Technologies Ltd." 451 "Parker Hannifin Corp" 452 "WIKA Alexander Wiegand SE & Co. KG" 453 "Cooper Bussmann" 454 "NGK Spark Plug Co. Ltd" 480 "EnerDel, Inc." 481 "Chetco Digital Instruments" 482 "Tricon Electronics" 483 "Valeo" 484 "Headsight Inc." 485 "MATT automotive" 486 "Westport Innovations Inc." 487 "DSE Test Solutions A/S" 488 "The Charles Machine Works, Inc." 489 "Appareo Systems" 490 "QuikQ" 491 "Penny and Giles Ltd" 492 "Inergy Automotive Systems" 493 "Watcheye" 494 "Synerject" 495 "HOLMER Maschinenbau GmbH" 496 "W. Gessmann GmbH" 497 "SENTRON Sistemas Embarcados" 498 "Innovative Design Solutions, Inc." 499 "LCJ Capteurs" 500 "Oxbo International Corporation" 501 "Agrotronix S.A." 502 "Attwood Corporation" 503 "Naviop S.R.L." 504 "Vesper Marine" 505 "Yetter Farm Equipment" 506 "IHI STAR Machinery Corporation" 507 "Test Center ISOBUS" 508 "Transtech Innovations" 509 "MOTORTECH GmbH" 510 "Marinesoft Co. Ltd" 511 "Sulky" 512 "Inpower LLC" 513 "FarmscanAg" 514 "DISTek Integration, Inc." 515 "GINAF Trucks Nederland B.V." 516 "AVAT Automation GmbH" 517 "Noland Engineering" 518 "Transas USA Inc." 519 "Peeters Landbouwmachines b.v." 520 "Trapeze" ;

SG_MUL_VAL_ 2362179319 ApplicationTotalMass DDI 352-352;
SG_MUL_VAL_ 2362179319 ApplicationTotalVolume DDI 351-351;
SG_MUL_VAL_ 2362179319 FunctionType DDI 350-350;
SG_MUL_VAL_ 2362179319 NozzleDriftReduction DDI 349-349;
SG_MUL_VAL_ 2362179319 MaximumSwathingWidth DDI 348-348;
SG_MUL_VAL_ 2362179319 MinimumSwathingWidth DDI 347-347;
SG_MUL_VAL_ 2362179319 ActualSwathingWidth DDI 346-346;
SG_MUL_VAL_ 2362179319 SetpointSwathingWidth DDI 345-345;
SG_MUL_VAL_ 2362179319 MaximumGrainKernelCrackerGap DDI 344-344;
SG_MUL_VAL_ 2362179319 MinimumGrainKernelCrackerGap DDI 343-343;
SG_MUL_VAL_ 2362179319 ActualGrainKernelCrackerGap DDI 342-342;
SG_MUL_VAL_ 2362179319 SetpointGrainKernelCrackerGap DDI 341-341;
SG_MUL_VAL_ 2362179319 EffectiveUnloadingTime DDI 340-340;
SG_MUL_VAL_ 2362179319 EffectiveLoadingTime DDI 339-339;
SG_MUL_VAL_ 2362179319 LiftimeRearPTOHours DDI 338-338;
SG_MUL_VAL_ 2362179319 LifetimeFrontPTOHours DDI 337-337;
SG_MUL_VAL_ 2362179319 RearPTOHours DDI 336-336;
SG_MUL_VAL_ 2362179319 FrontPTOHours DDI 335-335;
SG_MUL_VAL_ 2362179319 OperatingHoursSinceLastSharpenin DDI 334-334;
SG_MUL_VAL_ 2362179319 MaximumCuttingDrumSpeed DDI 333-333;
SG_MUL_VAL_ 2362179319 ActualCuttingDrumSpeed DDI 331-331;
SG_MUL_VAL_ 2362179319 SetpointCuttingDrumSpeed DDI 330-330;
SG_MUL_VAL_ 2362179319 MaximumHeaderSpeed DDI 329-329;
SG_MUL_VAL_ 2362179319 MinimumHeaderSpeed DDI 328-328;
SG_MUL_VAL_ 2362179319 ActualHeaderSpeed DDI 327-327;
SG_MUL_VAL_ 2362179319 SetpointHeaderSpeed DDI 326-326;
SG_MUL_VAL_ 2362179319 LifetimeApplicationTotalVolume DDI 325-325;
SG_MUL_VAL_ 2362179319 ChopperEngagementTotalTime DDI 324-324;
SG_MUL_VAL_ 2362179319 UnloadIdentificationNumber DDI 323-323;
SG_MUL_VAL_ 2362179319 LoadIdentificationNumber DDI 322-322;
SG_MUL_VAL_ 2362179319 ArbitraryAddressCapable PeerControlCommand 0-0, 1-1, 3-3, 4-4, 6-21;
SG_MUL_VAL_ 2362179319 IndustryGroup PeerControlCommand 0-0, 1-1, 3-3, 4-4, 6-21;
SG_MUL_VAL_ 2362179319 VehicleSystemInstance PeerControlCommand 0-0, 1-1, 3-3, 4-4, 6-21;
SG_MUL_VAL_ 2362179319 VehicleSystem2 PeerControlCommand 0-0, 1-1, 3-3, 4-4, 6-21;
SG_MUL_VAL_ 2362179319 Function PeerControlCommand 0-0, 1-1, 3-3, 4-4, 6-21;
SG_MUL_VAL_ 2362179319 FunctionInstance PeerControlCommand 0-0, 1-1, 3-3, 4-4, 6-21;
SG_MUL_VAL_ 2362179319 ECUInstance PeerControlCommand 0-0, 1-1, 3-3, 4-4, 6-21;
SG_MUL_VAL_ 2362179319 ManufacturerCode PeerControlCommand 0-0, 1-1, 3-3, 4-4, 6-21;
SG_MUL_VAL_ 2362179319 TemperatureUnits DeviceDescriptionMsgType 2-2, 3-3;
SG_MUL_VAL_ 2362179319 PressureUnits DeviceDescriptionMsgType 2-2, 3-3;
SG_MUL_VAL_ 2362179319 ErrorCodeObjPool4 DeviceDescriptionMsgType 9-9;
SG_MUL_VAL_ 2362179319 ErrorCodeObjPool3 DeviceDescriptionMsgType 9-9;
SG_MUL_VAL_ 2362179319 ForceUnits DeviceDescriptionMsgType 2-2, 3-3;
SG_MUL_VAL_ 2362179319 ErrorCodeObjPool2 DeviceDescriptionMsgType 9-9;
SG_MUL_VAL_ 2362179319 IdentityNumber PeerControlCommand 0-0, 1-1, 3-3, 4-4, 6-21;
SG_MUL_VAL_ 2362179319 NumberOfSection TechnicalDataMsgType 1-1;
SG_MUL_VAL_ 2362179319 ExecutedCommand Command 14-14;
SG_MUL_VAL_ 2362179319 UnitsSystem DeviceDescriptionMsgType 2-2, 3-3;
SG_MUL_VAL_ 2362179319 ErrorCodeObjPool1 DeviceDescriptionMsgType 9-9;
SG_MUL_VAL_ 2362179319 DistanceUnitCmd DeviceDescriptionMsgType 2-2, 3-3;
SG_MUL_VAL_ 2362179319 AreaUnitCmd DeviceDescriptionMsgType 2-2, 3-3;
SG_MUL_VAL_ 2362179319 VolumeUnitCmd DeviceDescriptionMsgType 2-2, 3-3;
SG_MUL_VAL_ 2362179319 SourceAddressWSM Command 14-14;
SG_MUL_VAL_ 2362179319 MassUnitCmd DeviceDescriptionMsgType 2-2, 3-3;
SG_MUL_VAL_ 2362179319 NumberOfBooms TechnicalDataMsgType 1-1;
SG_MUL_VAL_ 2362179319 ErrorCodeProcessData8 Command 13-13;
SG_MUL_VAL_ 2362179319 ErrorCodeProcessData7 Command 13-13;
SG_MUL_VAL_ 2362179319 ErrorCodeProcessData6 Command 13-13;
SG_MUL_VAL_ 2362179319 DestinationElementNumber PeerControlCommand 3-3, 4-4;
SG_MUL_VAL_ 2362179319 ErrorCodeProcessData5 Command 13-13;
SG_MUL_VAL_ 2362179319 ErrorCodeProcessData4 Command 13-13;
SG_MUL_VAL_ 2362179319 StatusBusyExecuting Command 14-14;
SG_MUL_VAL_ 2362179319 ErrorCodeProcessData3 Command 13-13;
SG_MUL_VAL_ 2362179319 StatusBusyReading Command 14-14;
SG_MUL_VAL_ 2362179319 ErrorCodeProcessData2 Command 13-13;
SG_MUL_VAL_ 2362179319 StatusBusySaving Command 14-14;
SG_MUL_VAL_ 2362179319 DataLogTimeInterval Command 4-4;
SG_MUL_VAL_ 2362179319 DataLogDistanceInterval Command 5-5;
SG_MUL_VAL_ 2362179319 AppRateVolumePerArea_Set DDI 1-1;
SG_MUL_VAL_ 2362179319 AppRateVolumePerArea_Act DDI 2-2;
SG_MUL_VAL_ 2362179319 AppRateVolumePerArea_Def DDI 3-3;
SG_MUL_VAL_ 2362179319 AppRateVolumePerArea_Min DDI 4-4;
SG_MUL_VAL_ 2362179319 AppRateVolumePerArea_Max DDI 5-5;
SG_MUL_VAL_ 2362179319 AppRateMassPerArea_Set DDI 6-6;
SG_MUL_VAL_ 2362179319 AppRateMassPerArea_Act DDI 7-7;
SG_MUL_VAL_ 2362179319 AppRateMassPerArea_Def DDI 8-8;
SG_MUL_VAL_ 2362179319 AppRateMassPerArea_Min DDI 9-9;
SG_MUL_VAL_ 2362179319 AppRateMassPerArea_Max DDI 10-10;
SG_MUL_VAL_ 2362179319 AppRateCountPerArea_Set DDI 11-11;
SG_MUL_VAL_ 2362179319 AppRateCountPerArea_Act DDI 12-12;
SG_MUL_VAL_ 2362179319 AppRateCountPerArea_Def DDI 13-13;
SG_MUL_VAL_ 2362179319 AppRateCountPerArea_Min DDI 14-14;
SG_MUL_VAL_ 2362179319 AppRateCountPerArea_Max DDI 15-15;
SG_MUL_VAL_ 2362179319 SetAppRateDistance_Set DDI 16-16;
SG_MUL_VAL_ 2362179319 AppRateDistance_Act DDI 17-17;
SG_MUL_VAL_ 2362179319 AppRateDistance_Def DDI 18-18;
SG_MUL_VAL_ 2362179319 AppRateDistance_Min DDI 19-19;
SG_MUL_VAL_ 2362179319 AppRateDistance_Max DDI 20-20;
SG_MUL_VAL_ 2362179319 AppRateVolumePerVolume_Set DDI 21-21;
SG_MUL_VAL_ 2362179319 AppRateVolumePerVolume_Act DDI 22-22;
SG_MUL_VAL_ 2362179319 AppRateVolumePerVolume_Def DDI 23-23;
SG_MUL_VAL_ 2362179319 AppRateVolumePerVolume_Min DDI 24-24;
SG_MUL_VAL_ 2362179319 AppRateVolumePerVolume_Max DDI 25-25;
SG_MUL_VAL_ 2362179319 AppRateMassPerMass_Set DDI 26-26;
SG_MUL_VAL_ 2362179319 AppRateMassPerMass_Act DDI 27-27;
SG_MUL_VAL_ 2362179319 AppRateMassPerMass_Def DDI 28-28;
SG_MUL_VAL_ 2362179319 AppRateMassPerMass_Min DDI 29-29;
SG_MUL_VAL_ 2362179319 AppRateMassPerMass_Max DDI 30-30;
SG_MUL_VAL_ 2362179319 AppRateVolumePerMass_Set DDI 31-31;
SG_MUL_VAL_ 2362179319 AppRateVolumePerMass_Act DDI 32-32;
SG_MUL_VAL_ 2362179319 AppRateVolumePerMass_Def DDI 33-33;
SG_MUL_VAL_ 2362179319 AppRateVolumePerMass_Min DDI 34-34;
SG_MUL_VAL_ 2362179319 AppRateVolumePerMass_Max DDI 35-35;
SG_MUL_VAL_ 2362179319 AppRateVolumePerTime_Set DDI 36-36;
SG_MUL_VAL_ 2362179319 AppRateVolumePerTime_Act DDI 37-37;
SG_MUL_VAL_ 2362179319 AppRateVolumePerTime_Def DDI 38-38;
SG_MUL_VAL_ 2362179319 AppRateVolumePerTime_Min DDI 39-39;
SG_MUL_VAL_ 2362179319 AppRateVolumePerTime_Max DDI 40-40;
SG_MUL_VAL_ 2362179319 AppRateMassPerTime_Set DDI 41-41;
SG_MUL_VAL_ 2362179319 AppRateMassPerTime_Act DDI 42-42;
SG_MUL_VAL_ 2362179319 AppRateMassPerTime_Def DDI 43-43;
SG_MUL_VAL_ 2362179319 AppRateMassPerTime_Min DDI 44-44;
SG_MUL_VAL_ 2362179319 AppRateMassPerTime_Max DDI 45-45;
SG_MUL_VAL_ 2362179319 AppRateCountPerTime_Set DDI 46-46;
SG_MUL_VAL_ 2362179319 AppRateCountPerTime_Act DDI 47-47;
SG_MUL_VAL_ 2362179319 AppRateCountPerTime_Def DDI 48-48;
SG_MUL_VAL_ 2362179319 AppRateCountPerTime_Min DDI 49-49;
SG_MUL_VAL_ 2362179319 AppRateCountPerTime_Max DDI 50-50;
SG_MUL_VAL_ 2362179319 SetTillageDepth_Set DDI 51-51;
SG_MUL_VAL_ 2362179319 TillageDepth_Act DDI 52-52;
SG_MUL_VAL_ 2362179319 TillageDepth_Def DDI 53-53;
SG_MUL_VAL_ 2362179319 TillageDepth_Min DDI 54-54;
SG_MUL_VAL_ 2362179319 TillageDepth_Max DDI 55-55;
SG_MUL_VAL_ 2362179319 SeedingDeph_Set DDI 56-56;
SG_MUL_VAL_ 2362179319 SeedingDeph_Act DDI 57-57;
SG_MUL_VAL_ 2362179319 SeedingDeph_Def DDI 58-58;
SG_MUL_VAL_ 2362179319 SeedingDeph_Min DDI 59-59;
SG_MUL_VAL_ 2362179319 SeedingDeph_Max DDI 60-60;
SG_MUL_VAL_ 2362179319 WorkingHeight_Set DDI 61-61;
SG_MUL_VAL_ 2362179319 WorkingHeight_Act DDI 62-62;
SG_MUL_VAL_ 2362179319 WorkingHeight_Def DDI 63-63;
SG_MUL_VAL_ 2362179319 WorkingHeight_Min DDI 64-64;
SG_MUL_VAL_ 2362179319 WorkingHeight_Max DDI 65-65;
SG_MUL_VAL_ 2362179319 WorkingWidth_Set DDI 66-66;
SG_MUL_VAL_ 2362179319 WorkingWidth_Act DDI 67-67;
SG_MUL_VAL_ 2362179319 WorkingWidth_Def DDI 68-68;
SG_MUL_VAL_ 2362179319 WorkingWidth_Min DDI 69-69;
SG_MUL_VAL_ 2362179319 WorkingWidth_Max DDI 70-70;
SG_MUL_VAL_ 2362179319 ContentAsVolume_Set DDI 71-71;
SG_MUL_VAL_ 2362179319 ContentAsVolume_Act DDI 72-72;
SG_MUL_VAL_ 2362179319 ContentAsVolume_Max DDI 73-73;
SG_MUL_VAL_ 2362179319 ContentAsMass_Set DDI 74-74;
SG_MUL_VAL_ 2362179319 ContentAsMass_Act DDI 75-75;
SG_MUL_VAL_ 2362179319 ContentAsMass_Max DDI 76-76;
SG_MUL_VAL_ 2362179319 ContentAsCount_Set DDI 77-77;
SG_MUL_VAL_ 2362179319 ContentAsCount_Act DDI 78-78;
SG_MUL_VAL_ 2362179319 ContentAsCount_Max DDI 79-79;
SG_MUL_VAL_ 2362179319 AccumulatedAppAsVolume DDI 80-80;
SG_MUL_VAL_ 2362179319 AccumulatedAppAsMass DDI 81-81;
SG_MUL_VAL_ 2362179319 AccumulatedAppAsCount DDI 82-82;
SG_MUL_VAL_ 2362179319 YieldVolumePerArea DDI 83-83;
SG_MUL_VAL_ 2362179319 YieldMassPerArea DDI 84-84;
SG_MUL_VAL_ 2362179319 YieldCountPerArea DDI 85-85;
SG_MUL_VAL_ 2362179319 YieldVolumePerTime DDI 86-86;
SG_MUL_VAL_ 2362179319 YieldMassPerTime DDI 87-87;
SG_MUL_VAL_ 2362179319 YieldCountPerTime DDI 88-88;
SG_MUL_VAL_ 2362179319 AccumulatedYieldAsVolume DDI 89-89;
SG_MUL_VAL_ 2362179319 AccumulatedYieldAsMass DDI 90-90;
SG_MUL_VAL_ 2362179319 AccumulatedYieldAsCount DDI 91-91;
SG_MUL_VAL_ 2362179319 CropYieldLossVolumePerArea DDI 92-92;
SG_MUL_VAL_ 2362179319 CropYieldLossMassPerArea DDI 93-93;
SG_MUL_VAL_ 2362179319 CropYieldLossCountPerArea DDI 94-94;
SG_MUL_VAL_ 2362179319 CropYieldLossVolumePerTime DDI 95-95;
SG_MUL_VAL_ 2362179319 CropYieldLossMassPerTime DDI 96-96;
SG_MUL_VAL_ 2362179319 CropYieldLossCountPerTime DDI 97-97;
SG_MUL_VAL_ 2362179319 CropYieldLoss DDI 98-98;
SG_MUL_VAL_ 2362179319 MoistureInCropYield DDI 99-99;
SG_MUL_VAL_ 2362179319 DirtMaterialInCropYield DDI 100-100;
SG_MUL_VAL_ 2362179319 BaleWidth_Set DDI 101-101;
SG_MUL_VAL_ 2362179319 BaleWidth_Act DDI 102-102;
SG_MUL_VAL_ 2362179319 BaleWidth_Def DDI 103-103;
SG_MUL_VAL_ 2362179319 BaleWidth_Min DDI 104-104;
SG_MUL_VAL_ 2362179319 BaleWidth_Max DDI 105-105;
SG_MUL_VAL_ 2362179319 BaleHeight_Set DDI 106-106;
SG_MUL_VAL_ 2362179319 BaleHeight_Act DDI 107-107;
SG_MUL_VAL_ 2362179319 BaleHeight_Def DDI 108-108;
SG_MUL_VAL_ 2362179319 BaleHeight_Min DDI 109-109;
SG_MUL_VAL_ 2362179319 BaleHeight_Max DDI 110-110;
SG_MUL_VAL_ 2362179319 BaleSize_Set DDI 111-111;
SG_MUL_VAL_ 2362179319 BaleSize_Act DDI 112-112;
SG_MUL_VAL_ 2362179319 BaleSize_Def DDI 113-113;
SG_MUL_VAL_ 2362179319 BaleSize_Min DDI 114-114;
SG_MUL_VAL_ 2362179319 BaleSize_Max DDI 115-115;
SG_MUL_VAL_ 2362179319 AccumulatedArea DDI 116-116;
SG_MUL_VAL_ 2362179319 AccumulatedDistanceInWork DDI 117-117;
SG_MUL_VAL_ 2362179319 AccumulatedDistanceOutWork DDI 118-118;
SG_MUL_VAL_ 2362179319 AccumulatedTimeInWork DDI 119-119;
SG_MUL_VAL_ 2362179319 AccumulatedTimeOutWork DDI 120-120;
SG_MUL_VAL_ 2362179319 PrdoucDensityMassPerArea DDI 121-121;
SG_MUL_VAL_ 2362179319 PrdoucDensityMassPerCount DDI 122-122;
SG_MUL_VAL_ 2362179319 PrdoucDensityVolumePerCount DDI 123-123;
SG_MUL_VAL_ 2362179319 AuxiliaryValveScalingExtend DDI 124-124;
SG_MUL_VAL_ 2362179319 AuxiliaryValveScalingRetract DDI 125-125;
SG_MUL_VAL_ 2362179319 AuxiliaryRampExtendUp DDI 126-126;
SG_MUL_VAL_ 2362179319 AuxiliaryValveRampExtendDown DDI 127-127;
SG_MUL_VAL_ 2362179319 AuxiliaryValveRampRetractUp DDI 128-128;
SG_MUL_VAL_ 2362179319 AuxiliaryValveRampRetractDown DDI 129-129;
SG_MUL_VAL_ 2362179319 AuxiliaryValveFloatThreshold DDI 130-130;
SG_MUL_VAL_ 2362179319 AuxiliaryValveProgressivExtend DDI 131-131;
SG_MUL_VAL_ 2362179319 AuxiliaryValveProgressivRetract DDI 132-132;
SG_MUL_VAL_ 2362179319 AuxiliaryValveInvertPorts DDI 133-133;
SG_MUL_VAL_ 2362179319 DeviceElementOffsetX DDI 134-134;
SG_MUL_VAL_ 2362179319 DeviceElementOffsetY DDI 135-135;
SG_MUL_VAL_ 2362179319 DeviceElementOffsetZ DDI 136-136;
SG_MUL_VAL_ 2362179319 DeviceVolumeCapacity DDI 137-137;
SG_MUL_VAL_ 2362179319 DeviceMassCapacity DDI 138-138;
SG_MUL_VAL_ 2362179319 DeviceCountCapacity DDI 139-139;
SG_MUL_VAL_ 2362179319 PercentageAppRateSetpoint DDI 140-140;
SG_MUL_VAL_ 2362179319 WorkState DDI 141-141;
SG_MUL_VAL_ 2362179319 SetpointTimeLatency DDI 142-142;
SG_MUL_VAL_ 2362179319 ActualValueTimeLatency DDI 143-143;
SG_MUL_VAL_ 2362179319 YawAngle DDI 144-144;
SG_MUL_VAL_ 2362179319 RollAngle DDI 145-145;
SG_MUL_VAL_ 2362179319 PitchAngle DDI 146-146;
SG_MUL_VAL_ 2362179319 LogCount DDI 147-147;
SG_MUL_VAL_ 2362179319 TotalFuelConsumption DDI 148-148;
SG_MUL_VAL_ 2362179319 FuelConsumptionPerTime DDI 149-149;
SG_MUL_VAL_ 2362179319 FuelConsumptionPerArea DDI 150-150;
SG_MUL_VAL_ 2362179319 AreaPerTimeCapacity DDI 151-151;
SG_MUL_VAL_ 2362179319 MinMassPerAreaAppRate DDI 152-152;
SG_MUL_VAL_ 2362179319 NDVI DDI 153-153;
SG_MUL_VAL_ 2362179319 PhysicalObjectLength DDI 154-154;
SG_MUL_VAL_ 2362179319 PhysicalObjectWidth DDI 155-155;
SG_MUL_VAL_ 2362179319 PhysicalObjectHeight DDI 156-156;
SG_MUL_VAL_ 2362179319 ConnectorType DDI 157-157;
SG_MUL_VAL_ 2362179319 PrescriptionControlState DDI 158-158;
SG_MUL_VAL_ 2362179319 NumberOfSubUnitsPerSection DDI 159-159;
SG_MUL_VAL_ 2362179319 SectionControlState DDI 160-160;
SG_MUL_VAL_ 2362179319 CondensedWorkState1to16 DDI 161-161;
SG_MUL_VAL_ 2362179319 CondensedWorkState17to32 DDI 162-162;
SG_MUL_VAL_ 2362179319 CondensedWorkState33to48 DDI 163-163;
SG_MUL_VAL_ 2362179319 CondensedWorkState49to64 DDI 164-164;
SG_MUL_VAL_ 2362179319 CondensedWorkState65to80 DDI 165-165;
SG_MUL_VAL_ 2362179319 CondensedWorkState81to96 DDI 166-166;
SG_MUL_VAL_ 2362179319 CondensedWorkState97to112 DDI 167-167;
SG_MUL_VAL_ 2362179319 CondensedWorkState113to128 DDI 168-168;
SG_MUL_VAL_ 2362179319 CondensedWorkState129to144 DDI 169-169;
SG_MUL_VAL_ 2362179319 CondensedWorkState145to160 DDI 170-170;
SG_MUL_VAL_ 2362179319 CondensedWorkState161to176 DDI 171-171;
SG_MUL_VAL_ 2362179319 CondensedWorkState177to192 DDI 172-172;
SG_MUL_VAL_ 2362179319 CondensedWorkState193to208 DDI 173-173;
SG_MUL_VAL_ 2362179319 CondensedWorkState209to224 DDI 174-174;
SG_MUL_VAL_ 2362179319 CondensedWorkState225to240 DDI 175-175;
SG_MUL_VAL_ 2362179319 CondensedWorkState241to256 DDI 176-176;
SG_MUL_VAL_ 2362179319 ActualLengthOfCut DDI 177-177;
SG_MUL_VAL_ 2362179319 ElementTypeInstance DDI 178-178;
SG_MUL_VAL_ 2362179319 ActualCulturalPractice DDI 179-179;
SG_MUL_VAL_ 2362179319 DRP2GroundDistance DDI 180-180;
SG_MUL_VAL_ 2362179319 DryMassPerAreaYield DDI 181-181;
SG_MUL_VAL_ 2362179319 DryMassPerTimeYield DDI 182-182;
SG_MUL_VAL_ 2362179319 YieldTotalDryMass DDI 183-183;
SG_MUL_VAL_ 2362179319 RefMoistureForDryMass DDI 184-184;
SG_MUL_VAL_ 2362179319 SeedCottonMassPerAreaYield DDI 185-185;
SG_MUL_VAL_ 2362179319 LintCottonMassPerAreaYield DDI 186-186;
SG_MUL_VAL_ 2362179319 SeedCottonMassPerTimeYield DDI 187-187;
SG_MUL_VAL_ 2362179319 LintCottonMassPerTimeYield DDI 188-188;
SG_MUL_VAL_ 2362179319 YieldTotalSeedCottonMass DDI 189-189;
SG_MUL_VAL_ 2362179319 YieldTotalLintCottonMass DDI 190-190;
SG_MUL_VAL_ 2362179319 LintTurnoutPercentage DDI 191-191;
SG_MUL_VAL_ 2362179319 AmbientTemperature DDI 192-192;
SG_MUL_VAL_ 2362179319 SetpointProductPressure DDI 193-193;
SG_MUL_VAL_ 2362179319 ActualProductPressure DDI 194-194;
SG_MUL_VAL_ 2362179319 MinimumProductPressure DDI 195-195;
SG_MUL_VAL_ 2362179319 MaximumProductPressure DDI 196-196;
SG_MUL_VAL_ 2362179319 SetpointPumpOutputPressure DDI 197-197;
SG_MUL_VAL_ 2362179319 ActualPumpOutputPressure DDI 198-198;
SG_MUL_VAL_ 2362179319 MinimumPumpOutputPressure DDI 199-199;
SG_MUL_VAL_ 2362179319 MaximumPumpOutputPressure DDI 200-200;
SG_MUL_VAL_ 2362179319 SetpointTankAgitationPressure DDI 201-201;
SG_MUL_VAL_ 2362179319 ActualTankAgitationPressure DDI 202-202;
SG_MUL_VAL_ 2362179319 MinimumTankAgitationPressure DDI 203-203;
SG_MUL_VAL_ 2362179319 MaximumTankAgitationPressure DDI 204-204;
SG_MUL_VAL_ 2362179319 SCTurnOnTime_ DDI 205-205;
SG_MUL_VAL_ 2362179319 SCTurnOffTime DDI 206-206;
SG_MUL_VAL_ 2362179319 WindSpeed DDI 207-207;
SG_MUL_VAL_ 2362179319 WindDirection DDI 208-208;
SG_MUL_VAL_ 2362179319 AirHumidity DDI 209-209;
SG_MUL_VAL_ 2362179319 SkyConditions DDI 210-210;
SG_MUL_VAL_ 2362179319 LastBaleFlakesPerBale DDI 211-211;
SG_MUL_VAL_ 2362179319 LastBaleAverageMoisture DDI 212-212;
SG_MUL_VAL_ 2362179319 LastBaleAverageStrokesPerFlake DDI 213-213;
SG_MUL_VAL_ 2362179319 LifetimeBaleCount DDI 214-214;
SG_MUL_VAL_ 2362179319 LifetimeWorkingHours DDI 215-215;
SG_MUL_VAL_ 2362179319 ActualBaleHydraulicPressure DDI 216-216;
SG_MUL_VAL_ 2362179319 LastBaleAverageHydraulicPressure DDI 217-217;
SG_MUL_VAL_ 2362179319 SetpointBaleCompressionPlungerLo DDI 218-218;
SG_MUL_VAL_ 2362179319 ActualBaleCompressionPlungerLoad DDI 219-219;
SG_MUL_VAL_ 2362179319 LastBaleAverageBaleCompressionPl DDI 220-220;
SG_MUL_VAL_ 2362179319 LastBaleAppliedPreservative DDI 221-221;
SG_MUL_VAL_ 2362179319 LastBaleTagNumber DDI 222-222;
SG_MUL_VAL_ 2362179319 LastBaleMass DDI 223-223;
SG_MUL_VAL_ 2362179319 DeltaT DDI 224-224;
SG_MUL_VAL_ 2362179319 SetpointWorkingLength DDI 225-225;
SG_MUL_VAL_ 2362179319 ActualWorkingLength DDI 226-226;
SG_MUL_VAL_ 2362179319 MinimumWorkingLength DDI 227-227;
SG_MUL_VAL_ 2362179319 MaximumWorkingLength DDI 228-228;
SG_MUL_VAL_ 2362179319 ActualNetWeight DDI 229-229;
SG_MUL_VAL_ 2362179319 NetWeightState DDI 230-230;
SG_MUL_VAL_ 2362179319 SetpointNetWeight DDI 231-231;
SG_MUL_VAL_ 2362179319 ActualGrossWeight DDI 232-232;
SG_MUL_VAL_ 2362179319 GrossWeightState DDI 233-233;
SG_MUL_VAL_ 2362179319 MinimumGrossWeight DDI 234-234;
SG_MUL_VAL_ 2362179319 MaximumGrossWeight DDI 235-235;
SG_MUL_VAL_ 2362179319 ThreshingEngagementTotalTime DDI 236-236;
SG_MUL_VAL_ 2362179319 ActualHeaderWorkingHeightStatus DDI 237-237;
SG_MUL_VAL_ 2362179319 ActualHeaderRotationalSpeedStatu DDI 238-238;
SG_MUL_VAL_ 2362179319 YieldHoldStatus DDI 239-239;
SG_MUL_VAL_ 2362179319 ActualUnLoadingSystemStatus DDI 240-240;
SG_MUL_VAL_ 2362179319 CropTemperature DDI 241-241;
SG_MUL_VAL_ 2362179319 SetpointSieveClearance DDI 242-242;
SG_MUL_VAL_ 2362179319 ActualSieveClearance DDI 243-243;
SG_MUL_VAL_ 2362179319 MinimumSieveClearance DDI 244-244;
SG_MUL_VAL_ 2362179319 MaximumSieveClearance DDI 245-245;
SG_MUL_VAL_ 2362179319 SetpointChafferClearance DDI 246-246;
SG_MUL_VAL_ 2362179319 ActualChafferClearance DDI 247-247;
SG_MUL_VAL_ 2362179319 MinimumChafferClearance DDI 248-248;
SG_MUL_VAL_ 2362179319 MaximumChafferClearance DDI 249-249;
SG_MUL_VAL_ 2362179319 SetpointConcaveClearance DDI 250-250;
SG_MUL_VAL_ 2362179319 ActualConcaveClearance DDI 251-251;
SG_MUL_VAL_ 2362179319 MinimumConcaveClearance DDI 252-252;
SG_MUL_VAL_ 2362179319 MaximumConcaveClearance DDI 253-253;
SG_MUL_VAL_ 2362179319 SetpointSeparationFanRotationalS DDI 254-254;
SG_MUL_VAL_ 2362179319 ActualSeparationFanRotationalSpe DDI 255-255;
SG_MUL_VAL_ 2362179319 MinimumSeparationFanRotationalSp DDI 256-256;
SG_MUL_VAL_ 2362179319 MaximumSeparationFanRotationalSp DDI 257-257;
SG_MUL_VAL_ 2362179319 HydraulicOilTemperature DDI 258-258;
SG_MUL_VAL_ 2362179319 YieldLagIgnoreTime DDI 259-259;
SG_MUL_VAL_ 2362179319 YieldLeadIgnoreTime DDI 260-260;
SG_MUL_VAL_ 2362179319 AverageYieldMassPerTime DDI 261-261;
SG_MUL_VAL_ 2362179319 AverageCropMoisture DDI 262-262;
SG_MUL_VAL_ 2362179319 AverageYieldMassPerArea DDI 263-263;
SG_MUL_VAL_ 2362179319 ConnectorPivotXOffset DDI 264-264;
SG_MUL_VAL_ 2362179319 RemainingArea DDI 265-265;
SG_MUL_VAL_ 2362179319 LifetimeApplicationTotalMass DDI 266-266;
SG_MUL_VAL_ 2362179319 LifetimeApplicationTotalCount DDI 267-267;
SG_MUL_VAL_ 2362179319 LifetimeYieldTotalVolume DDI 268-268;
SG_MUL_VAL_ 2362179319 LifetimeYieldTotalMass DDI 269-269;
SG_MUL_VAL_ 2362179319 LifetimeYieldTotalCount DDI 270-270;
SG_MUL_VAL_ 2362179319 LifetimeTotalArea DDI 271-271;
SG_MUL_VAL_ 2362179319 LifetimeTotalDistance DDI 272-272;
SG_MUL_VAL_ 2362179319 LifetimeIneffectiveTotalDistance DDI 273-273;
SG_MUL_VAL_ 2362179319 LifetimeEffectiveTotalTime DDI 274-274;
SG_MUL_VAL_ 2362179319 LifetimeIneffectiveTotalTime DDI 275-275;
SG_MUL_VAL_ 2362179319 LifetimeFuelConsumption DDI 276-276;
SG_MUL_VAL_ 2362179319 LifetimeAverageFuelConsumptionPe DDI 277-277;
SG_MUL_VAL_ 2362179319 LifetimeAverageFuelConsumpt_0000 DDI 278-278;
SG_MUL_VAL_ 2362179319 LifetimeYieldTotalDryMass DDI 279-279;
SG_MUL_VAL_ 2362179319 LifetimeYieldTotalSeedCottonMass DDI 280-280;
SG_MUL_VAL_ 2362179319 LifetimeYieldTotalLintCottonMass DDI 281-281;
SG_MUL_VAL_ 2362179319 LifetimeThreshingEngagementTotal DDI 282-282;
SG_MUL_VAL_ 2362179319 PrecutTotalCount DDI 283-283;
SG_MUL_VAL_ 2362179319 UncutTotalCount DDI 284-284;
SG_MUL_VAL_ 2362179319 LifetimePrecutTotalCount DDI 285-285;
SG_MUL_VAL_ 2362179319 LifetimeUncutTotalCount DDI 286-286;
SG_MUL_VAL_ 2362179319 SetpointWorkState DDI 289-289;
SG_MUL_VAL_ 2362179319 SetpointCondensedWorkState1to16 DDI 290-290;
SG_MUL_VAL_ 2362179319 SetpointCondensedWorkState17to32 DDI 291-291;
SG_MUL_VAL_ 2362179319 SetpointCondensedWorkState33to48 DDI 292-292;
SG_MUL_VAL_ 2362179319 SetpointCondensedWorkState49to64 DDI 293-293;
SG_MUL_VAL_ 2362179319 SetpointCondensedWorkState65to80 DDI 294-294;
SG_MUL_VAL_ 2362179319 SetpointCondensedWorkState81to96 DDI 295-295;
SG_MUL_VAL_ 2362179319 SetpointCondensedWorkState97to11 DDI 296-296;
SG_MUL_VAL_ 2362179319 SetpointCondensedWorkState113to1 DDI 297-297;
SG_MUL_VAL_ 2362179319 SetpointCondensedWorkState129to1 DDI 298-298;
SG_MUL_VAL_ 2362179319 SetpointCondensedWorkState145to1 DDI 299-299;
SG_MUL_VAL_ 2362179319 SetpointCondensedWorkState161to1 DDI 300-300;
SG_MUL_VAL_ 2362179319 SetpointCondensedWorkState177to1 DDI 301-301;
SG_MUL_VAL_ 2362179319 SetpointCondensedWorkState193to2 DDI 302-302;
SG_MUL_VAL_ 2362179319 SetpointCondensedWorkState209to2 DDI 303-303;
SG_MUL_VAL_ 2362179319 SetpointCondensedWorkState225to2 DDI 304-304;
SG_MUL_VAL_ 2362179319 SetpointCondensedWorkState241to2 DDI 305-305;
SG_MUL_VAL_ 2362179319 TrueRotationPointXOffset DDI 306-306;
SG_MUL_VAL_ 2362179319 TrueRotationPointYOffset DDI 307-307;
SG_MUL_VAL_ 2362179319 ActualPercentageApplicationRate DDI 308-308;
SG_MUL_VAL_ 2362179319 MinimumPercentageApplicationRate DDI 309-309;
SG_MUL_VAL_ 2362179319 MaximumPercentageApplicationRate DDI 310-310;
SG_MUL_VAL_ 2362179319 RelativeYieldPotential DDI 311-311;
SG_MUL_VAL_ 2362179319 MinimumRelativeYieldPotential DDI 312-312;
SG_MUL_VAL_ 2362179319 MaximumRelativeYieldPotential DDI 313-313;
SG_MUL_VAL_ 2362179319 ActualPercentageCropDryMatter DDI 314-314;
SG_MUL_VAL_ 2362179319 AveragePercentageCropDryMatter DDI 315-315;
SG_MUL_VAL_ 2362179319 EffectiveTotalFuelConsumption DDI 316-316;
SG_MUL_VAL_ 2362179319 IneffectiveTotalFuelConsumption DDI 317-317;
SG_MUL_VAL_ 2362179319 EffectiveTotalDieselExhaustFluid DDI 318-318;
SG_MUL_VAL_ 2362179319 IneffectiveTotalDieselExhaustFlu DDI 319-319;
SG_MUL_VAL_ 2362179319 LastLoadedWeight DDI 320-320;
SG_MUL_VAL_ 2362179319 LastUnloadedWeight DDI 321-321;
SG_MUL_VAL_ 2362179319 PGNBasedData DDI 57342-57342;
SG_MUL_VAL_ 2362179319 RequestDefaultProcessData DDI 57343-57343;
SG_MUL_VAL_ 2362179319 ObjectIdOfFaultyObject DeviceDescriptionMsgType 9-9;
SG_MUL_VAL_ 2362179319 ErrorCodeProcessData1 Command 13-13;
SG_MUL_VAL_ 2362179319 StatusTotalsActive Command 14-14;
SG_MUL_VAL_ 2362179319 Status_TotalsActive Command 15-15;
SG_MUL_VAL_ 2362179319 DateFormatCmd DeviceDescriptionMsgType 2-2, 3-3;
SG_MUL_VAL_ 2362179319 DataDictionaryVersion DDI 0-0;
SG_MUL_VAL_ 2362179319 PeerControlCommand Command 9-9;
SG_MUL_VAL_ 2362179319 DecimalSymbolCmd DeviceDescriptionMsgType 2-2, 3-3;
SG_MUL_VAL_ 2362179319 TimeFormatCmd DeviceDescriptionMsgType 2-2, 3-3;
SG_MUL_VAL_ 2362179319 ImplementSectionControl TechnicalDataMsgType 1-1;
SG_MUL_VAL_ 2362179319 PeerControlAssignment TechnicalDataMsgType 1-1;
SG_MUL_VAL_ 2362179319 TC_GEO_DefinitionPositionBasedCo TechnicalDataMsgType 1-1;
SG_MUL_VAL_ 2362179319 TimeAndPositionForDataLogging TechnicalDataMsgType 1-1;
SG_MUL_VAL_ 2362179319 Documentation TechnicalDataMsgType 1-1;
SG_MUL_VAL_ 2362179319 ErrorCodeChangeDesignator DeviceDescriptionMsgType 13-13;
SG_MUL_VAL_ 2362179319 DesignatorLength DeviceDescriptionMsgType 12-12;
SG_MUL_VAL_ 2362179319 DDI_TI Command 4-4;
SG_MUL_VAL_ 2362179319 DDI_DI Command 5-5;
SG_MUL_VAL_ 2362179319 ErrorDDI Command 13-13;
SG_MUL_VAL_ 2362179319 ParentObjectIdOfFaultyObject DeviceDescriptionMsgType 9-9;
SG_MUL_VAL_ 2362179319 ReceivedDataSize DeviceDescriptionMsgType 7-7;
SG_MUL_VAL_ 2362179319 DDI Command 2-2, 3-3, 6-8, 10-10;
SG_MUL_VAL_ 2362179319 BootTimeTC TechnicalDataMsgType 1-1;
SG_MUL_VAL_ 2362179319 PeerControlDDI Command 9-9;
SG_MUL_VAL_ 2362179319 LanguageCodeCmd DeviceDescriptionMsgType 2-2, 3-3;
SG_MUL_VAL_ 2362179319 ErrorCodeObjPoolActiveResp3 DeviceDescriptionMsgType 9-9;
SG_MUL_VAL_ 2362179319 ErrorCodeObjPoolActiveResp2 DeviceDescriptionMsgType 9-9;
SG_MUL_VAL_ 2362179319 StructureLabel DeviceDescriptionMsgType 0-0, 1-1;
SG_MUL_VAL_ 2362179319 VersionNumberISO11783Part10 TechnicalDataMsgType 1-1;
SG_MUL_VAL_ 2362179319 RequestTransferDataSize DeviceDescriptionMsgType 4-4;
SG_MUL_VAL_ 2362179319 Status DeviceDescriptionMsgType 5-5;
SG_MUL_VAL_ 2362179319 ErrorCodeObjPoolTransfer DeviceDescriptionMsgType 7-7;
SG_MUL_VAL_ 2362179319 ActivateDeactivateCommand DeviceDescriptionMsgType 8-8;
SG_MUL_VAL_ 2362179319 ErrorCodeObjectPoolDelete DeviceDescriptionMsgType 11-11;
SG_MUL_VAL_ 2362179319 ObjectIdToChange DeviceDescriptionMsgType 12-12;
SG_MUL_VAL_ 2362179319 ObjectIdChanged DeviceDescriptionMsgType 13-13;
SG_MUL_VAL_ 2362179319 ErrorCodeObjPoolActiveResp1 DeviceDescriptionMsgType 9-9;
SG_MUL_VAL_ 2362179319 TechnicalDataMsgType Command 0-0;
SG_MUL_VAL_ 2362179319 DeviceDescriptionMsgType Command 1-1;
SG_MUL_VAL_ 2362179319 ElementNumber Command 2-10;
SG_MUL_VAL_ 2362179319 ErrorElementNumber Command 13-13;
SG_MUL_VAL_ 2362179319 NumberOfControlChannels TechnicalDataMsgType 1-1;
