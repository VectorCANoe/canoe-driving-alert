VERSION ""

NS_ :

BS_:

BU_: TIMServer TIMClient3 TIMClient2 TIMClient1 DiagnosticNode

BO_ 2621308419 TIM21_CS_TIMClient3: 16 TIMClient3
 SG_ SecurityByte_VS m17 : 56|8@1+ (1,0) [0|255] "" Vector__XXX
 SG_ SecurityByte_RTL m17 : 56|8@1+ (1,0) [0|255] "" Vector__XXX
 SG_ SecurityByte_RPTO m17 : 56|8@1+ (1,0) [0|255] "" Vector__XXX
 SG_ SecurityByte_RH m17 : 56|8@1+ (1,0) [0|255] "" Vector__XXX
 SG_ SecurityByte_FTL m17 : 56|8@1+ (1,0) [0|255] "" Vector__XXX
 SG_ SecurityByte_FPTO m17 : 56|8@1+ (1,0) [0|255] "" Vector__XXX
 SG_ SecurityByte_FH m17 : 56|8@1+ (1,0) [0|255] "" Vector__XXX
 SG_ SecurityByte_EG m17 : 56|8@1+ (1,0) [0|255] "" Vector__XXX
 SG_ SecurityByte_AV32 m17 : 56|8@1+ (1,0) [0|255] "" Vector__XXX
 SG_ SecurityByte_AV31 m17 : 56|8@1+ (1,0) [0|255] "" Vector__XXX
 SG_ SecurityByte_AV30 m17 : 56|8@1+ (1,0) [0|255] "" Vector__XXX
 SG_ SecurityByte_AV29 m17 : 56|8@1+ (1,0) [0|255] "" Vector__XXX
 SG_ SecurityByte_AV28 m17 : 56|8@1+ (1,0) [0|255] "" Vector__XXX
 SG_ SecurityByte_AV27 m17 : 56|8@1+ (1,0) [0|255] "" Vector__XXX
 SG_ SecurityByte_AV26 m17 : 56|8@1+ (1,0) [0|255] "" Vector__XXX
 SG_ SecurityByte_AV25 m17 : 56|8@1+ (1,0) [0|255] "" Vector__XXX
 SG_ SecurityByte_AV24 m17 : 56|8@1+ (1,0) [0|255] "" Vector__XXX
 SG_ SecurityByte_AV23 m17 : 56|8@1+ (1,0) [0|255] "" Vector__XXX
 SG_ SecurityByte_AV22 m17 : 56|8@1+ (1,0) [0|255] "" Vector__XXX
 SG_ SecurityByte_AV21 m17 : 56|8@1+ (1,0) [0|255] "" Vector__XXX
 SG_ SecurityByte_AV20 m17 : 56|8@1+ (1,0) [0|255] "" Vector__XXX
 SG_ SecurityByte_AV19 m17 : 56|8@1+ (1,0) [0|255] "" Vector__XXX
 SG_ SecurityByte_AV18 m17 : 56|8@1+ (1,0) [0|255] "" Vector__XXX
 SG_ SecurityByte_AV17 m17 : 56|8@1+ (1,0) [0|255] "" Vector__XXX
 SG_ SecurityByte_AV16 m17 : 56|8@1+ (1,0) [0|255] "" Vector__XXX
 SG_ SecurityByte_AV15 m17 : 56|8@1+ (1,0) [0|255] "" Vector__XXX
 SG_ SecurityByte_AV14 m17 : 56|8@1+ (1,0) [0|255] "" Vector__XXX
 SG_ SecurityByte_AV13 m17 : 56|8@1+ (1,0) [0|255] "" Vector__XXX
 SG_ SecurityByte_AV12 m17 : 56|8@1+ (1,0) [0|255] "" Vector__XXX
 SG_ SecurityByte_AV11 m17 : 56|8@1+ (1,0) [0|255] "" Vector__XXX
 SG_ SecurityByte_AV10 m17 : 56|8@1+ (1,0) [0|255] "" Vector__XXX
 SG_ SecurityByte_AV09 m17 : 56|8@1+ (1,0) [0|255] "" Vector__XXX
 SG_ SecurityByte_AV08 m17 : 56|8@1+ (1,0) [0|255] "" Vector__XXX
 SG_ SecurityByte_AV07 m17 : 56|8@1+ (1,0) [0|255] "" Vector__XXX
 SG_ SecurityByte_AV06 m17 : 56|8@1+ (1,0) [0|255] "" Vector__XXX
 SG_ SecurityByte_AV05 m17 : 56|8@1+ (1,0) [0|255] "" Vector__XXX
 SG_ SecurityByte_AV04 m17 : 56|8@1+ (1,0) [0|255] "" Vector__XXX
 SG_ SecurityByte_AV03 m17 : 56|8@1+ (1,0) [0|255] "" Vector__XXX
 SG_ SecurityByte_AV02 m17 : 56|8@1+ (1,0) [0|255] "" Vector__XXX
 SG_ SecurityByte_AV01 m17 : 56|8@1+ (1,0) [0|255] "" Vector__XXX
 SG_ PositionRequest_RTL m17 : 32|16@1+ (0.01,0) [0|100] "%" Vector__XXX
 SG_ PositionRequest_FTL m17 : 32|16@1+ (0.01,0) [0|100] "%" Vector__XXX
 SG_ ControlMode1_VS m0 : 24|4@1+ (1,0) [0|15] "" Vector__XXX
 SG_ ControlMode1_RTL m0 : 24|4@1+ (1,0) [0|15] "" Vector__XXX
 SG_ ControlMode1_FTL m0 : 24|4@1+ (1,0) [0|15] "" Vector__XXX
 SG_ NumOfControlModes_VS m0 : 16|4@1+ (1,0) [0|15] "" Vector__XXX
 SG_ NumOfControlModes_RTL m0 : 16|4@1+ (1,0) [0|15] "" Vector__XXX
 SG_ NumOfControlModes_FTL m0 : 16|4@1+ (1,0) [0|15] "" Vector__XXX
 SG_ NumOfBytes_CM1_VS m0 : 32|8@1+ (1,0) [0|255] "" Vector__XXX
 SG_ NumOfBytes_CM1_RTL m0 : 32|8@1+ (1,0) [0|255] "" Vector__XXX
 SG_ NumOfBytes_CM1_FTL m0 : 32|8@1+ (1,0) [0|255] "" Vector__XXX
 SG_ MsgType_RTL m72M : 8|8@1+ (1,0) [0|255] "" Vector__XXX
 SG_ MsgType_FTL m71M : 8|8@1+ (1,0) [0|255] "" Vector__XXX
 SG_ MsgType_EG m70M : 8|8@1+ (1,0) [0|255] "" Vector__XXX
 SG_ MsgType_VS m68M : 8|8@1+ (1,0) [0|255] "" Vector__XXX
 SG_ MsgType_RH m67M : 8|8@1+ (1,0) [0|255] "" Vector__XXX
 SG_ MsgType_FH m66M : 8|8@1+ (1,0) [0|255] "" Vector__XXX
 SG_ MsgType_RPTO m65M : 8|8@1+ (1,0) [0|255] "" Vector__XXX
 SG_ MsgType_FPTO m64M : 8|8@1+ (1,0) [0|255] "" Vector__XXX
 SG_ MsgType_AV32 m32M : 8|8@1+ (1,0) [0|255] "" Vector__XXX
 SG_ MsgType_AV31 m31M : 8|8@1+ (1,0) [0|255] "" Vector__XXX
 SG_ MsgType_AV30 m30M : 8|8@1+ (1,0) [0|255] "" Vector__XXX
 SG_ MsgType_AV29 m29M : 8|8@1+ (1,0) [0|255] "" Vector__XXX
 SG_ MsgType_AV28 m28M : 8|8@1+ (1,0) [0|255] "" Vector__XXX
 SG_ MsgType_AV27 m27M : 8|8@1+ (1,0) [0|255] "" Vector__XXX
 SG_ MsgType_AV26 m26M : 8|8@1+ (1,0) [0|255] "" Vector__XXX
 SG_ MsgType_AV25 m25M : 8|8@1+ (1,0) [0|255] "" Vector__XXX
 SG_ MsgType_AV24 m24M : 8|8@1+ (1,0) [0|255] "" Vector__XXX
 SG_ MsgType_AV23 m23M : 8|8@1+ (1,0) [0|255] "" Vector__XXX
 SG_ MsgType_AV22 m22M : 8|8@1+ (1,0) [0|255] "" Vector__XXX
 SG_ MsgType_AV21 m21M : 8|8@1+ (1,0) [0|255] "" Vector__XXX
 SG_ MsgType_AV20 m20M : 8|8@1+ (1,0) [0|255] "" Vector__XXX
 SG_ MsgType_AV19 m19M : 8|8@1+ (1,0) [0|255] "" Vector__XXX
 SG_ MsgType_AV18 m18M : 8|8@1+ (1,0) [0|255] "" Vector__XXX
 SG_ MsgType_AV17 m17M : 8|8@1+ (1,0) [0|255] "" Vector__XXX
 SG_ MsgType_AV16 m16M : 8|8@1+ (1,0) [0|255] "" Vector__XXX
 SG_ MsgType_AV15 m15M : 8|8@1+ (1,0) [0|255] "" Vector__XXX
 SG_ MsgType_AV14 m14M : 8|8@1+ (1,0) [0|255] "" Vector__XXX
 SG_ MsgType_AV13 m13M : 8|8@1+ (1,0) [0|255] "" Vector__XXX
 SG_ MsgType_AV12 m12M : 8|8@1+ (1,0) [0|255] "" Vector__XXX
 SG_ MsgType_AV11 m11M : 8|8@1+ (1,0) [0|255] "" Vector__XXX
 SG_ MsgType_AV10 m10M : 8|8@1+ (1,0) [0|255] "" Vector__XXX
 SG_ MsgType_AV09 m9M : 8|8@1+ (1,0) [0|255] "" Vector__XXX
 SG_ MsgType_AV08 m8M : 8|8@1+ (1,0) [0|255] "" Vector__XXX
 SG_ MsgType_AV07 m7M : 8|8@1+ (1,0) [0|255] "" Vector__XXX
 SG_ MsgType_AV06 m6M : 8|8@1+ (1,0) [0|255] "" Vector__XXX
 SG_ MsgType_AV05 m5M : 8|8@1+ (1,0) [0|255] "" Vector__XXX
 SG_ MsgType_AV04 m4M : 8|8@1+ (1,0) [0|255] "" Vector__XXX
 SG_ MsgType_AV03 m3M : 8|8@1+ (1,0) [0|255] "" Vector__XXX
 SG_ MsgType_AV02 m2M : 8|8@1+ (1,0) [0|255] "" Vector__XXX
 SG_ MsgType_AV01 m1M : 8|8@1+ (1,0) [0|255] "" Vector__XXX
 SG_ TIMFunctionID M : 0|8@1+ (1,0) [0|255] "" Vector__XXX
 SG_ FlowRequest_AV32 m17 : 32|16@1+ (0.004,-128.512) [0|0] "%" Vector__XXX
 SG_ FlowRequest_AV31 m17 : 32|16@1+ (0.004,-128.512) [0|0] "%" Vector__XXX
 SG_ FlowRequest_AV30 m17 : 32|16@1+ (0.004,-128.512) [0|0] "%" Vector__XXX
 SG_ FlowRequest_AV29 m17 : 32|16@1+ (0.004,-128.512) [0|0] "%" Vector__XXX
 SG_ FlowRequest_AV28 m17 : 32|16@1+ (0.004,-128.512) [0|0] "%" Vector__XXX
 SG_ FlowRequest_AV27 m17 : 32|16@1+ (0.004,-128.512) [0|0] "%" Vector__XXX
 SG_ FlowRequest_AV26 m17 : 32|16@1+ (0.004,-128.512) [0|0] "%" Vector__XXX
 SG_ FlowRequest_AV25 m17 : 32|16@1+ (0.004,-128.512) [0|0] "%" Vector__XXX
 SG_ FlowRequest_AV24 m17 : 32|16@1+ (0.004,-128.512) [0|0] "%" Vector__XXX
 SG_ FlowRequest_AV23 m17 : 32|16@1+ (0.004,-128.512) [0|0] "%" Vector__XXX
 SG_ FlowRequest_AV22 m17 : 32|16@1+ (0.004,-128.512) [0|0] "%" Vector__XXX
 SG_ FlowRequest_AV21 m17 : 32|16@1+ (0.004,-128.512) [0|0] "%" Vector__XXX
 SG_ FlowRequest_AV20 m17 : 32|16@1+ (0.004,-128.512) [0|0] "%" Vector__XXX
 SG_ FlowRequest_AV19 m17 : 32|16@1+ (0.004,-128.512) [0|0] "%" Vector__XXX
 SG_ FlowRequest_AV18 m17 : 32|16@1+ (0.004,-128.512) [0|0] "%" Vector__XXX
 SG_ FlowRequest_AV17 m17 : 32|16@1+ (0.004,-128.512) [0|0] "%" Vector__XXX
 SG_ FlowRequest_AV16 m17 : 32|16@1+ (0.004,-128.512) [0|0] "%" Vector__XXX
 SG_ FlowRequest_AV15 m17 : 32|16@1+ (0.004,-128.512) [0|0] "%" Vector__XXX
 SG_ FlowRequest_AV14 m17 : 32|16@1+ (0.004,-128.512) [0|0] "%" Vector__XXX
 SG_ FlowRequest_AV13 m17 : 32|16@1+ (0.004,-128.512) [0|0] "%" Vector__XXX
 SG_ FlowRequest_AV12 m17 : 32|16@1+ (0.004,-128.512) [0|0] "%" Vector__XXX
 SG_ FlowRequest_AV11 m17 : 32|16@1+ (0.004,-128.512) [0|0] "%" Vector__XXX
 SG_ FlowRequest_AV10 m17 : 32|16@1+ (0.004,-128.512) [0|0] "%" Vector__XXX
 SG_ FlowRequest_AV09 m17 : 32|16@1+ (0.004,-128.512) [0|0] "%" Vector__XXX
 SG_ FlowRequest_AV08 m17 : 32|16@1+ (0.004,-128.512) [0|0] "%" Vector__XXX
 SG_ FlowRequest_AV07 m17 : 32|16@1+ (0.004,-128.512) [0|0] "%" Vector__XXX
 SG_ FlowRequest_AV06 m17 : 32|16@1+ (0.004,-128.512) [0|0] "%" Vector__XXX
 SG_ FlowRequest_AV05 m17 : 32|16@1+ (0.004,-128.512) [0|0] "%" Vector__XXX
 SG_ FlowRequest_AV04 m17 : 32|16@1+ (0.004,-128.512) [0|0] "%" Vector__XXX
 SG_ FlowRequest_AV03 m17 : 32|16@1+ (0.004,-128.512) [0|0] "%" Vector__XXX
 SG_ FlowRequest_AV02 m17 : 32|16@1+ (0.004,-128.512) [0|0] "%" Vector__XXX
 SG_ PositionRequest_RH m17 : 32|16@1+ (0.01,0) [0|100] "%" Vector__XXX
 SG_ OutputShaftSpeedRequest_RPTO m17 : 32|16@1+ (0.125,-4016) [0|0] "1/min" Vector__XXX
 SG_ CurvatureRequest_EG m17 : 32|16@1+ (0.25,-8032) [-8032|8031.75] "1/km" Vector__XXX
 SG_ VehicleSpeedRequest_VS m17 : 32|16@1+ (0.001,-32.128) [-32.127|32.127] "m/s" Vector__XXX
 SG_ PositionRequest_FH m17 : 32|16@1+ (0.01,0) [0|100] "%" Vector__XXX
 SG_ OutputShaftSpeedRequest_FPTO m17 : 32|16@1+ (0.125,-4016) [0|0] "1/min" Vector__XXX
 SG_ FlowRequest_AV01 m17 : 32|16@1+ (0.004,-128.512) [0|0] "%" Vector__XXX

BO_ 2621308418 TIM21_CS_TIMClient2: 16 TIMClient2
 SG_ SecurityByte_VS m17 : 56|8@1+ (1,0) [0|255] "" Vector__XXX
 SG_ SecurityByte_RTL m17 : 56|8@1+ (1,0) [0|255] "" Vector__XXX
 SG_ SecurityByte_RPTO m17 : 56|8@1+ (1,0) [0|255] "" Vector__XXX
 SG_ SecurityByte_RH m17 : 56|8@1+ (1,0) [0|255] "" Vector__XXX
 SG_ SecurityByte_FTL m17 : 56|8@1+ (1,0) [0|255] "" Vector__XXX
 SG_ SecurityByte_FPTO m17 : 56|8@1+ (1,0) [0|255] "" Vector__XXX
 SG_ SecurityByte_FH m17 : 56|8@1+ (1,0) [0|255] "" Vector__XXX
 SG_ SecurityByte_EG m17 : 56|8@1+ (1,0) [0|255] "" Vector__XXX
 SG_ SecurityByte_AV32 m17 : 56|8@1+ (1,0) [0|255] "" Vector__XXX
 SG_ SecurityByte_AV31 m17 : 56|8@1+ (1,0) [0|255] "" Vector__XXX
 SG_ SecurityByte_AV30 m17 : 56|8@1+ (1,0) [0|255] "" Vector__XXX
 SG_ SecurityByte_AV29 m17 : 56|8@1+ (1,0) [0|255] "" Vector__XXX
 SG_ SecurityByte_AV28 m17 : 56|8@1+ (1,0) [0|255] "" Vector__XXX
 SG_ SecurityByte_AV27 m17 : 56|8@1+ (1,0) [0|255] "" Vector__XXX
 SG_ SecurityByte_AV26 m17 : 56|8@1+ (1,0) [0|255] "" Vector__XXX
 SG_ SecurityByte_AV25 m17 : 56|8@1+ (1,0) [0|255] "" Vector__XXX
 SG_ SecurityByte_AV24 m17 : 56|8@1+ (1,0) [0|255] "" Vector__XXX
 SG_ SecurityByte_AV23 m17 : 56|8@1+ (1,0) [0|255] "" Vector__XXX
 SG_ SecurityByte_AV22 m17 : 56|8@1+ (1,0) [0|255] "" Vector__XXX
 SG_ SecurityByte_AV21 m17 : 56|8@1+ (1,0) [0|255] "" Vector__XXX
 SG_ SecurityByte_AV20 m17 : 56|8@1+ (1,0) [0|255] "" Vector__XXX
 SG_ SecurityByte_AV19 m17 : 56|8@1+ (1,0) [0|255] "" Vector__XXX
 SG_ SecurityByte_AV18 m17 : 56|8@1+ (1,0) [0|255] "" Vector__XXX
 SG_ SecurityByte_AV17 m17 : 56|8@1+ (1,0) [0|255] "" Vector__XXX
 SG_ SecurityByte_AV16 m17 : 56|8@1+ (1,0) [0|255] "" Vector__XXX
 SG_ SecurityByte_AV15 m17 : 56|8@1+ (1,0) [0|255] "" Vector__XXX
 SG_ SecurityByte_AV14 m17 : 56|8@1+ (1,0) [0|255] "" Vector__XXX
 SG_ SecurityByte_AV13 m17 : 56|8@1+ (1,0) [0|255] "" Vector__XXX
 SG_ SecurityByte_AV12 m17 : 56|8@1+ (1,0) [0|255] "" Vector__XXX
 SG_ SecurityByte_AV11 m17 : 56|8@1+ (1,0) [0|255] "" Vector__XXX
 SG_ SecurityByte_AV10 m17 : 56|8@1+ (1,0) [0|255] "" Vector__XXX
 SG_ SecurityByte_AV09 m17 : 56|8@1+ (1,0) [0|255] "" Vector__XXX
 SG_ SecurityByte_AV08 m17 : 56|8@1+ (1,0) [0|255] "" Vector__XXX
 SG_ SecurityByte_AV07 m17 : 56|8@1+ (1,0) [0|255] "" Vector__XXX
 SG_ SecurityByte_AV06 m17 : 56|8@1+ (1,0) [0|255] "" Vector__XXX
 SG_ SecurityByte_AV05 m17 : 56|8@1+ (1,0) [0|255] "" Vector__XXX
 SG_ SecurityByte_AV04 m17 : 56|8@1+ (1,0) [0|255] "" Vector__XXX
 SG_ SecurityByte_AV03 m17 : 56|8@1+ (1,0) [0|255] "" Vector__XXX
 SG_ SecurityByte_AV02 m17 : 56|8@1+ (1,0) [0|255] "" Vector__XXX
 SG_ SecurityByte_AV01 m17 : 56|8@1+ (1,0) [0|255] "" Vector__XXX
 SG_ PositionRequest_RTL m17 : 32|16@1+ (0.01,0) [0|100] "%" Vector__XXX
 SG_ PositionRequest_FTL m17 : 32|16@1+ (0.01,0) [0|100] "%" Vector__XXX
 SG_ ControlMode1_VS m0 : 24|4@1+ (1,0) [0|15] "" Vector__XXX
 SG_ ControlMode1_RTL m0 : 24|4@1+ (1,0) [0|15] "" Vector__XXX
 SG_ ControlMode1_FTL m0 : 24|4@1+ (1,0) [0|15] "" Vector__XXX
 SG_ NumOfControlModes_VS m0 : 16|4@1+ (1,0) [0|15] "" Vector__XXX
 SG_ NumOfControlModes_RTL m0 : 16|4@1+ (1,0) [0|15] "" Vector__XXX
 SG_ NumOfControlModes_FTL m0 : 16|4@1+ (1,0) [0|15] "" Vector__XXX
 SG_ NumOfBytes_CM1_VS m0 : 32|8@1+ (1,0) [0|255] "" Vector__XXX
 SG_ NumOfBytes_CM1_RTL m0 : 32|8@1+ (1,0) [0|255] "" Vector__XXX
 SG_ NumOfBytes_CM1_FTL m0 : 32|8@1+ (1,0) [0|255] "" Vector__XXX
 SG_ MsgType_RTL m72M : 8|8@1+ (1,0) [0|255] "" Vector__XXX
 SG_ MsgType_FTL m71M : 8|8@1+ (1,0) [0|255] "" Vector__XXX
 SG_ MsgType_EG m70M : 8|8@1+ (1,0) [0|255] "" Vector__XXX
 SG_ MsgType_VS m68M : 8|8@1+ (1,0) [0|255] "" Vector__XXX
 SG_ MsgType_RH m67M : 8|8@1+ (1,0) [0|255] "" Vector__XXX
 SG_ MsgType_FH m66M : 8|8@1+ (1,0) [0|255] "" Vector__XXX
 SG_ MsgType_RPTO m65M : 8|8@1+ (1,0) [0|255] "" Vector__XXX
 SG_ MsgType_FPTO m64M : 8|8@1+ (1,0) [0|255] "" Vector__XXX
 SG_ MsgType_AV32 m32M : 8|8@1+ (1,0) [0|255] "" Vector__XXX
 SG_ MsgType_AV31 m31M : 8|8@1+ (1,0) [0|255] "" Vector__XXX
 SG_ MsgType_AV30 m30M : 8|8@1+ (1,0) [0|255] "" Vector__XXX
 SG_ MsgType_AV29 m29M : 8|8@1+ (1,0) [0|255] "" Vector__XXX
 SG_ MsgType_AV28 m28M : 8|8@1+ (1,0) [0|255] "" Vector__XXX
 SG_ MsgType_AV27 m27M : 8|8@1+ (1,0) [0|255] "" Vector__XXX
 SG_ MsgType_AV26 m26M : 8|8@1+ (1,0) [0|255] "" Vector__XXX
 SG_ MsgType_AV25 m25M : 8|8@1+ (1,0) [0|255] "" Vector__XXX
 SG_ MsgType_AV24 m24M : 8|8@1+ (1,0) [0|255] "" Vector__XXX
 SG_ MsgType_AV23 m23M : 8|8@1+ (1,0) [0|255] "" Vector__XXX
 SG_ MsgType_AV22 m22M : 8|8@1+ (1,0) [0|255] "" Vector__XXX
 SG_ MsgType_AV21 m21M : 8|8@1+ (1,0) [0|255] "" Vector__XXX
 SG_ MsgType_AV20 m20M : 8|8@1+ (1,0) [0|255] "" Vector__XXX
 SG_ MsgType_AV19 m19M : 8|8@1+ (1,0) [0|255] "" Vector__XXX
 SG_ MsgType_AV18 m18M : 8|8@1+ (1,0) [0|255] "" Vector__XXX
 SG_ MsgType_AV17 m17M : 8|8@1+ (1,0) [0|255] "" Vector__XXX
 SG_ MsgType_AV16 m16M : 8|8@1+ (1,0) [0|255] "" Vector__XXX
 SG_ MsgType_AV15 m15M : 8|8@1+ (1,0) [0|255] "" Vector__XXX
 SG_ MsgType_AV14 m14M : 8|8@1+ (1,0) [0|255] "" Vector__XXX
 SG_ MsgType_AV13 m13M : 8|8@1+ (1,0) [0|255] "" Vector__XXX
 SG_ MsgType_AV12 m12M : 8|8@1+ (1,0) [0|255] "" Vector__XXX
 SG_ MsgType_AV11 m11M : 8|8@1+ (1,0) [0|255] "" Vector__XXX
 SG_ MsgType_AV10 m10M : 8|8@1+ (1,0) [0|255] "" Vector__XXX
 SG_ MsgType_AV09 m9M : 8|8@1+ (1,0) [0|255] "" Vector__XXX
 SG_ MsgType_AV08 m8M : 8|8@1+ (1,0) [0|255] "" Vector__XXX
 SG_ MsgType_AV07 m7M : 8|8@1+ (1,0) [0|255] "" Vector__XXX
 SG_ MsgType_AV06 m6M : 8|8@1+ (1,0) [0|255] "" Vector__XXX
 SG_ MsgType_AV05 m5M : 8|8@1+ (1,0) [0|255] "" Vector__XXX
 SG_ MsgType_AV04 m4M : 8|8@1+ (1,0) [0|255] "" Vector__XXX
 SG_ MsgType_AV03 m3M : 8|8@1+ (1,0) [0|255] "" Vector__XXX
 SG_ MsgType_AV02 m2M : 8|8@1+ (1,0) [0|255] "" Vector__XXX
 SG_ MsgType_AV01 m1M : 8|8@1+ (1,0) [0|255] "" Vector__XXX
 SG_ TIMFunctionID M : 0|8@1+ (1,0) [0|255] "" Vector__XXX
 SG_ FlowRequest_AV32 m17 : 32|16@1+ (0.004,-128.512) [0|0] "%" Vector__XXX
 SG_ FlowRequest_AV31 m17 : 32|16@1+ (0.004,-128.512) [0|0] "%" Vector__XXX
 SG_ FlowRequest_AV30 m17 : 32|16@1+ (0.004,-128.512) [0|0] "%" Vector__XXX
 SG_ FlowRequest_AV29 m17 : 32|16@1+ (0.004,-128.512) [0|0] "%" Vector__XXX
 SG_ FlowRequest_AV28 m17 : 32|16@1+ (0.004,-128.512) [0|0] "%" Vector__XXX
 SG_ FlowRequest_AV27 m17 : 32|16@1+ (0.004,-128.512) [0|0] "%" Vector__XXX
 SG_ FlowRequest_AV26 m17 : 32|16@1+ (0.004,-128.512) [0|0] "%" Vector__XXX
 SG_ FlowRequest_AV25 m17 : 32|16@1+ (0.004,-128.512) [0|0] "%" Vector__XXX
 SG_ FlowRequest_AV24 m17 : 32|16@1+ (0.004,-128.512) [0|0] "%" Vector__XXX
 SG_ FlowRequest_AV23 m17 : 32|16@1+ (0.004,-128.512) [0|0] "%" Vector__XXX
 SG_ FlowRequest_AV22 m17 : 32|16@1+ (0.004,-128.512) [0|0] "%" Vector__XXX
 SG_ FlowRequest_AV21 m17 : 32|16@1+ (0.004,-128.512) [0|0] "%" Vector__XXX
 SG_ FlowRequest_AV20 m17 : 32|16@1+ (0.004,-128.512) [0|0] "%" Vector__XXX
 SG_ FlowRequest_AV19 m17 : 32|16@1+ (0.004,-128.512) [0|0] "%" Vector__XXX
 SG_ FlowRequest_AV18 m17 : 32|16@1+ (0.004,-128.512) [0|0] "%" Vector__XXX
 SG_ FlowRequest_AV17 m17 : 32|16@1+ (0.004,-128.512) [0|0] "%" Vector__XXX
 SG_ FlowRequest_AV16 m17 : 32|16@1+ (0.004,-128.512) [0|0] "%" Vector__XXX
 SG_ FlowRequest_AV15 m17 : 32|16@1+ (0.004,-128.512) [0|0] "%" Vector__XXX
 SG_ FlowRequest_AV14 m17 : 32|16@1+ (0.004,-128.512) [0|0] "%" Vector__XXX
 SG_ FlowRequest_AV13 m17 : 32|16@1+ (0.004,-128.512) [0|0] "%" Vector__XXX
 SG_ FlowRequest_AV12 m17 : 32|16@1+ (0.004,-128.512) [0|0] "%" Vector__XXX
 SG_ FlowRequest_AV11 m17 : 32|16@1+ (0.004,-128.512) [0|0] "%" Vector__XXX
 SG_ FlowRequest_AV10 m17 : 32|16@1+ (0.004,-128.512) [0|0] "%" Vector__XXX
 SG_ FlowRequest_AV09 m17 : 32|16@1+ (0.004,-128.512) [0|0] "%" Vector__XXX
 SG_ FlowRequest_AV08 m17 : 32|16@1+ (0.004,-128.512) [0|0] "%" Vector__XXX
 SG_ FlowRequest_AV07 m17 : 32|16@1+ (0.004,-128.512) [0|0] "%" Vector__XXX
 SG_ FlowRequest_AV06 m17 : 32|16@1+ (0.004,-128.512) [0|0] "%" Vector__XXX
 SG_ FlowRequest_AV05 m17 : 32|16@1+ (0.004,-128.512) [0|0] "%" Vector__XXX
 SG_ FlowRequest_AV04 m17 : 32|16@1+ (0.004,-128.512) [0|0] "%" Vector__XXX
 SG_ FlowRequest_AV03 m17 : 32|16@1+ (0.004,-128.512) [0|0] "%" Vector__XXX
 SG_ FlowRequest_AV02 m17 : 32|16@1+ (0.004,-128.512) [0|0] "%" Vector__XXX
 SG_ PositionRequest_RH m17 : 32|16@1+ (0.01,0) [0|100] "%" Vector__XXX
 SG_ OutputShaftSpeedRequest_RPTO m17 : 32|16@1+ (0.125,-4016) [0|0] "1/min" Vector__XXX
 SG_ CurvatureRequest_EG m17 : 32|16@1+ (0.25,-8032) [-8032|8031.75] "1/km" Vector__XXX
 SG_ VehicleSpeedRequest_VS m17 : 32|16@1+ (0.001,-32.128) [-32.127|32.127] "m/s" Vector__XXX
 SG_ PositionRequest_FH m17 : 32|16@1+ (0.01,0) [0|100] "%" Vector__XXX
 SG_ OutputShaftSpeedRequest_FPTO m17 : 32|16@1+ (0.125,-4016) [0|0] "1/min" Vector__XXX
 SG_ FlowRequest_AV01 m17 : 32|16@1+ (0.004,-128.512) [0|0] "%" Vector__XXX

BO_ 2621308417 TIM21_CS_TIMClient1: 16 TIMClient1
 SG_ SecurityByte_VS m17 : 56|8@1+ (1,0) [0|255] "" Vector__XXX
 SG_ SecurityByte_RTL m17 : 56|8@1+ (1,0) [0|255] "" Vector__XXX
 SG_ SecurityByte_RPTO m17 : 56|8@1+ (1,0) [0|255] "" Vector__XXX
 SG_ SecurityByte_RH m17 : 56|8@1+ (1,0) [0|255] "" Vector__XXX
 SG_ SecurityByte_FTL m17 : 56|8@1+ (1,0) [0|255] "" Vector__XXX
 SG_ SecurityByte_FPTO m17 : 56|8@1+ (1,0) [0|255] "" Vector__XXX
 SG_ SecurityByte_FH m17 : 56|8@1+ (1,0) [0|255] "" Vector__XXX
 SG_ SecurityByte_EG m17 : 56|8@1+ (1,0) [0|255] "" Vector__XXX
 SG_ SecurityByte_AV32 m17 : 56|8@1+ (1,0) [0|255] "" Vector__XXX
 SG_ SecurityByte_AV31 m17 : 56|8@1+ (1,0) [0|255] "" Vector__XXX
 SG_ SecurityByte_AV30 m17 : 56|8@1+ (1,0) [0|255] "" Vector__XXX
 SG_ SecurityByte_AV29 m17 : 56|8@1+ (1,0) [0|255] "" Vector__XXX
 SG_ SecurityByte_AV28 m17 : 56|8@1+ (1,0) [0|255] "" Vector__XXX
 SG_ SecurityByte_AV27 m17 : 56|8@1+ (1,0) [0|255] "" Vector__XXX
 SG_ SecurityByte_AV26 m17 : 56|8@1+ (1,0) [0|255] "" Vector__XXX
 SG_ SecurityByte_AV25 m17 : 56|8@1+ (1,0) [0|255] "" Vector__XXX
 SG_ SecurityByte_AV24 m17 : 56|8@1+ (1,0) [0|255] "" Vector__XXX
 SG_ SecurityByte_AV23 m17 : 56|8@1+ (1,0) [0|255] "" Vector__XXX
 SG_ SecurityByte_AV22 m17 : 56|8@1+ (1,0) [0|255] "" Vector__XXX
 SG_ SecurityByte_AV21 m17 : 56|8@1+ (1,0) [0|255] "" Vector__XXX
 SG_ SecurityByte_AV20 m17 : 56|8@1+ (1,0) [0|255] "" Vector__XXX
 SG_ SecurityByte_AV19 m17 : 56|8@1+ (1,0) [0|255] "" Vector__XXX
 SG_ SecurityByte_AV18 m17 : 56|8@1+ (1,0) [0|255] "" Vector__XXX
 SG_ SecurityByte_AV17 m17 : 56|8@1+ (1,0) [0|255] "" Vector__XXX
 SG_ SecurityByte_AV16 m17 : 56|8@1+ (1,0) [0|255] "" Vector__XXX
 SG_ SecurityByte_AV15 m17 : 56|8@1+ (1,0) [0|255] "" Vector__XXX
 SG_ SecurityByte_AV14 m17 : 56|8@1+ (1,0) [0|255] "" Vector__XXX
 SG_ SecurityByte_AV13 m17 : 56|8@1+ (1,0) [0|255] "" Vector__XXX
 SG_ SecurityByte_AV12 m17 : 56|8@1+ (1,0) [0|255] "" Vector__XXX
 SG_ SecurityByte_AV11 m17 : 56|8@1+ (1,0) [0|255] "" Vector__XXX
 SG_ SecurityByte_AV10 m17 : 56|8@1+ (1,0) [0|255] "" Vector__XXX
 SG_ SecurityByte_AV09 m17 : 56|8@1+ (1,0) [0|255] "" Vector__XXX
 SG_ SecurityByte_AV08 m17 : 56|8@1+ (1,0) [0|255] "" Vector__XXX
 SG_ SecurityByte_AV07 m17 : 56|8@1+ (1,0) [0|255] "" Vector__XXX
 SG_ SecurityByte_AV06 m17 : 56|8@1+ (1,0) [0|255] "" Vector__XXX
 SG_ SecurityByte_AV05 m17 : 56|8@1+ (1,0) [0|255] "" Vector__XXX
 SG_ SecurityByte_AV04 m17 : 56|8@1+ (1,0) [0|255] "" Vector__XXX
 SG_ SecurityByte_AV03 m17 : 56|8@1+ (1,0) [0|255] "" Vector__XXX
 SG_ SecurityByte_AV02 m17 : 56|8@1+ (1,0) [0|255] "" Vector__XXX
 SG_ SecurityByte_AV01 m17 : 56|8@1+ (1,0) [0|255] "" Vector__XXX
 SG_ PositionRequest_RTL m17 : 32|16@1+ (0.01,0) [0|100] "%" Vector__XXX
 SG_ PositionRequest_FTL m17 : 32|16@1+ (0.01,0) [0|100] "%" Vector__XXX
 SG_ ControlMode1_VS m0 : 24|4@1+ (1,0) [0|15] "" Vector__XXX
 SG_ ControlMode1_RTL m0 : 24|4@1+ (1,0) [0|15] "" Vector__XXX
 SG_ ControlMode1_FTL m0 : 24|4@1+ (1,0) [0|15] "" Vector__XXX
 SG_ NumOfControlModes_VS m0 : 16|4@1+ (1,0) [0|15] "" Vector__XXX
 SG_ NumOfControlModes_RTL m0 : 16|4@1+ (1,0) [0|15] "" Vector__XXX
 SG_ NumOfControlModes_FTL m0 : 16|4@1+ (1,0) [0|15] "" Vector__XXX
 SG_ NumOfBytes_CM1_VS m0 : 32|8@1+ (1,0) [0|255] "" Vector__XXX
 SG_ NumOfBytes_CM1_RTL m0 : 32|8@1+ (1,0) [0|255] "" Vector__XXX
 SG_ NumOfBytes_CM1_FTL m0 : 32|8@1+ (1,0) [0|255] "" Vector__XXX
 SG_ MsgType_RTL m72M : 8|8@1+ (1,0) [0|255] "" Vector__XXX
 SG_ MsgType_FTL m71M : 8|8@1+ (1,0) [0|255] "" Vector__XXX
 SG_ MsgType_EG m70M : 8|8@1+ (1,0) [0|255] "" Vector__XXX
 SG_ MsgType_VS m68M : 8|8@1+ (1,0) [0|255] "" Vector__XXX
 SG_ MsgType_RH m67M : 8|8@1+ (1,0) [0|255] "" Vector__XXX
 SG_ MsgType_FH m66M : 8|8@1+ (1,0) [0|255] "" Vector__XXX
 SG_ MsgType_RPTO m65M : 8|8@1+ (1,0) [0|255] "" Vector__XXX
 SG_ MsgType_FPTO m64M : 8|8@1+ (1,0) [0|255] "" Vector__XXX
 SG_ MsgType_AV32 m32M : 8|8@1+ (1,0) [0|255] "" Vector__XXX
 SG_ MsgType_AV31 m31M : 8|8@1+ (1,0) [0|255] "" Vector__XXX
 SG_ MsgType_AV30 m30M : 8|8@1+ (1,0) [0|255] "" Vector__XXX
 SG_ MsgType_AV29 m29M : 8|8@1+ (1,0) [0|255] "" Vector__XXX
 SG_ MsgType_AV28 m28M : 8|8@1+ (1,0) [0|255] "" Vector__XXX
 SG_ MsgType_AV27 m27M : 8|8@1+ (1,0) [0|255] "" Vector__XXX
 SG_ MsgType_AV26 m26M : 8|8@1+ (1,0) [0|255] "" Vector__XXX
 SG_ MsgType_AV25 m25M : 8|8@1+ (1,0) [0|255] "" Vector__XXX
 SG_ MsgType_AV24 m24M : 8|8@1+ (1,0) [0|255] "" Vector__XXX
 SG_ MsgType_AV23 m23M : 8|8@1+ (1,0) [0|255] "" Vector__XXX
 SG_ MsgType_AV22 m22M : 8|8@1+ (1,0) [0|255] "" Vector__XXX
 SG_ MsgType_AV21 m21M : 8|8@1+ (1,0) [0|255] "" Vector__XXX
 SG_ MsgType_AV20 m20M : 8|8@1+ (1,0) [0|255] "" Vector__XXX
 SG_ MsgType_AV19 m19M : 8|8@1+ (1,0) [0|255] "" Vector__XXX
 SG_ MsgType_AV18 m18M : 8|8@1+ (1,0) [0|255] "" Vector__XXX
 SG_ MsgType_AV17 m17M : 8|8@1+ (1,0) [0|255] "" Vector__XXX
 SG_ MsgType_AV16 m16M : 8|8@1+ (1,0) [0|255] "" Vector__XXX
 SG_ MsgType_AV15 m15M : 8|8@1+ (1,0) [0|255] "" Vector__XXX
 SG_ MsgType_AV14 m14M : 8|8@1+ (1,0) [0|255] "" Vector__XXX
 SG_ MsgType_AV13 m13M : 8|8@1+ (1,0) [0|255] "" Vector__XXX
 SG_ MsgType_AV12 m12M : 8|8@1+ (1,0) [0|255] "" Vector__XXX
 SG_ MsgType_AV11 m11M : 8|8@1+ (1,0) [0|255] "" Vector__XXX
 SG_ MsgType_AV10 m10M : 8|8@1+ (1,0) [0|255] "" Vector__XXX
 SG_ MsgType_AV09 m9M : 8|8@1+ (1,0) [0|255] "" Vector__XXX
 SG_ MsgType_AV08 m8M : 8|8@1+ (1,0) [0|255] "" Vector__XXX
 SG_ MsgType_AV07 m7M : 8|8@1+ (1,0) [0|255] "" Vector__XXX
 SG_ MsgType_AV06 m6M : 8|8@1+ (1,0) [0|255] "" Vector__XXX
 SG_ MsgType_AV05 m5M : 8|8@1+ (1,0) [0|255] "" Vector__XXX
 SG_ MsgType_AV04 m4M : 8|8@1+ (1,0) [0|255] "" Vector__XXX
 SG_ MsgType_AV03 m3M : 8|8@1+ (1,0) [0|255] "" Vector__XXX
 SG_ MsgType_AV02 m2M : 8|8@1+ (1,0) [0|255] "" Vector__XXX
 SG_ MsgType_AV01 m1M : 8|8@1+ (1,0) [0|255] "" Vector__XXX
 SG_ TIMFunctionID M : 0|8@1+ (1,0) [0|255] "" Vector__XXX
 SG_ FlowRequest_AV32 m17 : 32|16@1+ (0.004,-128.512) [0|0] "%" Vector__XXX
 SG_ FlowRequest_AV31 m17 : 32|16@1+ (0.004,-128.512) [0|0] "%" Vector__XXX
 SG_ FlowRequest_AV30 m17 : 32|16@1+ (0.004,-128.512) [0|0] "%" Vector__XXX
 SG_ FlowRequest_AV29 m17 : 32|16@1+ (0.004,-128.512) [0|0] "%" Vector__XXX
 SG_ FlowRequest_AV28 m17 : 32|16@1+ (0.004,-128.512) [0|0] "%" Vector__XXX
 SG_ FlowRequest_AV27 m17 : 32|16@1+ (0.004,-128.512) [0|0] "%" Vector__XXX
 SG_ FlowRequest_AV26 m17 : 32|16@1+ (0.004,-128.512) [0|0] "%" Vector__XXX
 SG_ FlowRequest_AV25 m17 : 32|16@1+ (0.004,-128.512) [0|0] "%" Vector__XXX
 SG_ FlowRequest_AV24 m17 : 32|16@1+ (0.004,-128.512) [0|0] "%" Vector__XXX
 SG_ FlowRequest_AV23 m17 : 32|16@1+ (0.004,-128.512) [0|0] "%" Vector__XXX
 SG_ FlowRequest_AV22 m17 : 32|16@1+ (0.004,-128.512) [0|0] "%" Vector__XXX
 SG_ FlowRequest_AV21 m17 : 32|16@1+ (0.004,-128.512) [0|0] "%" Vector__XXX
 SG_ FlowRequest_AV20 m17 : 32|16@1+ (0.004,-128.512) [0|0] "%" Vector__XXX
 SG_ FlowRequest_AV19 m17 : 32|16@1+ (0.004,-128.512) [0|0] "%" Vector__XXX
 SG_ FlowRequest_AV18 m17 : 32|16@1+ (0.004,-128.512) [0|0] "%" Vector__XXX
 SG_ FlowRequest_AV17 m17 : 32|16@1+ (0.004,-128.512) [0|0] "%" Vector__XXX
 SG_ FlowRequest_AV16 m17 : 32|16@1+ (0.004,-128.512) [0|0] "%" Vector__XXX
 SG_ FlowRequest_AV15 m17 : 32|16@1+ (0.004,-128.512) [0|0] "%" Vector__XXX
 SG_ FlowRequest_AV14 m17 : 32|16@1+ (0.004,-128.512) [0|0] "%" Vector__XXX
 SG_ FlowRequest_AV13 m17 : 32|16@1+ (0.004,-128.512) [0|0] "%" Vector__XXX
 SG_ FlowRequest_AV12 m17 : 32|16@1+ (0.004,-128.512) [0|0] "%" Vector__XXX
 SG_ FlowRequest_AV11 m17 : 32|16@1+ (0.004,-128.512) [0|0] "%" Vector__XXX
 SG_ FlowRequest_AV10 m17 : 32|16@1+ (0.004,-128.512) [0|0] "%" Vector__XXX
 SG_ FlowRequest_AV09 m17 : 32|16@1+ (0.004,-128.512) [0|0] "%" Vector__XXX
 SG_ FlowRequest_AV08 m17 : 32|16@1+ (0.004,-128.512) [0|0] "%" Vector__XXX
 SG_ FlowRequest_AV07 m17 : 32|16@1+ (0.004,-128.512) [0|0] "%" Vector__XXX
 SG_ FlowRequest_AV06 m17 : 32|16@1+ (0.004,-128.512) [0|0] "%" Vector__XXX
 SG_ FlowRequest_AV05 m17 : 32|16@1+ (0.004,-128.512) [0|0] "%" Vector__XXX
 SG_ FlowRequest_AV04 m17 : 32|16@1+ (0.004,-128.512) [0|0] "%" Vector__XXX
 SG_ FlowRequest_AV03 m17 : 32|16@1+ (0.004,-128.512) [0|0] "%" Vector__XXX
 SG_ FlowRequest_AV02 m17 : 32|16@1+ (0.004,-128.512) [0|0] "%" Vector__XXX
 SG_ PositionRequest_RH m17 : 32|16@1+ (0.01,0) [0|100] "%" Vector__XXX
 SG_ OutputShaftSpeedRequest_RPTO m17 : 32|16@1+ (0.125,-4016) [0|0] "1/min" Vector__XXX
 SG_ CurvatureRequest_EG m17 : 32|16@1+ (0.25,-8032) [-8032|8031.75] "1/km" Vector__XXX
 SG_ VehicleSpeedRequest_VS m17 : 32|16@1+ (0.001,-32.128) [-32.127|32.127] "m/s" Vector__XXX
 SG_ PositionRequest_FH m17 : 32|16@1+ (0.01,0) [0|100] "%" Vector__XXX
 SG_ OutputShaftSpeedRequest_FPTO m17 : 32|16@1+ (0.125,-4016) [0|0] "1/min" Vector__XXX
 SG_ FlowRequest_AV01 m17 : 32|16@1+ (0.004,-128.512) [0|0] "%" Vector__XXX

BO_ 2619670019 TIM21_TIMClient3: 16 TIMClient3
 SG_ RequestCounterAuxValve32 m32 : 8|4@1+ (1,0) [0|0] "" Vector__XXX
 SG_ RequestCounterAuxValve31 m31 : 8|4@1+ (1,0) [0|0] "" Vector__XXX
 SG_ RequestCounterAuxValve30 m30 : 8|4@1+ (1,0) [0|0] "" Vector__XXX
 SG_ RequestCounterAuxValve29 m29 : 8|4@1+ (1,0) [0|0] "" Vector__XXX
 SG_ RequestCounterAuxValve28 m28 : 8|4@1+ (1,0) [0|0] "" Vector__XXX
 SG_ RequestCounterAuxValve27 m27 : 8|4@1+ (1,0) [0|0] "" Vector__XXX
 SG_ RequestCounterAuxValve26 m26 : 8|4@1+ (1,0) [0|0] "" Vector__XXX
 SG_ RequestCounterAuxValve25 m25 : 8|4@1+ (1,0) [0|0] "" Vector__XXX
 SG_ RequestCounterAuxValve24 m24 : 8|4@1+ (1,0) [0|0] "" Vector__XXX
 SG_ RequestCounterAuxValve23 m23 : 8|4@1+ (1,0) [0|0] "" Vector__XXX
 SG_ RequestCounterAuxValve22 m22 : 8|4@1+ (1,0) [0|0] "" Vector__XXX
 SG_ RequestCounterAuxValve21 m21 : 8|4@1+ (1,0) [0|0] "" Vector__XXX
 SG_ RequestCounterAuxValve20 m20 : 8|4@1+ (1,0) [0|0] "" Vector__XXX
 SG_ RequestCounterAuxValve19 m19 : 8|4@1+ (1,0) [0|0] "" Vector__XXX
 SG_ RequestCounterAuxValve18 m18 : 8|4@1+ (1,0) [0|0] "" Vector__XXX
 SG_ RequestCounterAuxValve17 m17 : 8|4@1+ (1,0) [0|0] "" Vector__XXX
 SG_ RequestCounterAuxValve16 m16 : 8|4@1+ (1,0) [0|0] "" Vector__XXX
 SG_ RequestCounterAuxValve15 m15 : 8|4@1+ (1,0) [0|0] "" Vector__XXX
 SG_ RequestCounterAuxValve14 m14 : 8|4@1+ (1,0) [0|0] "" Vector__XXX
 SG_ RequestCounterAuxValve13 m13 : 8|4@1+ (1,0) [0|0] "" Vector__XXX
 SG_ RequestCounterAuxValve12 m12 : 8|4@1+ (1,0) [0|0] "" Vector__XXX
 SG_ RequestCounterAuxValve11 m11 : 8|4@1+ (1,0) [0|0] "" Vector__XXX
 SG_ RequestCounterAuxValve10 m10 : 8|4@1+ (1,0) [0|0] "" Vector__XXX
 SG_ RequestCounterAuxValve09 m9 : 8|4@1+ (1,0) [0|0] "" Vector__XXX
 SG_ RequestCounterAuxValve08 m8 : 8|4@1+ (1,0) [0|0] "" Vector__XXX
 SG_ RequestCounterAuxValve07 m7 : 8|4@1+ (1,0) [0|0] "" Vector__XXX
 SG_ RequestCounterAuxValve06 m6 : 8|4@1+ (1,0) [0|0] "" Vector__XXX
 SG_ RequestCounterAuxValve05 m5 : 8|4@1+ (1,0) [0|0] "" Vector__XXX
 SG_ RequestCounterAuxValve04 m4 : 8|4@1+ (1,0) [0|0] "" Vector__XXX
 SG_ RequestCounterAuxValve03 m3 : 8|4@1+ (1,0) [0|0] "" Vector__XXX
 SG_ RequestCounterAuxValve02 m2 : 8|4@1+ (1,0) [0|0] "" Vector__XXX
 SG_ RequestCounterAuxValve01 m1 : 8|4@1+ (1,0) [0|0] "" Vector__XXX
 SG_ RequestCounterVehicleSpeed m68 : 8|4@1+ (1,0) [0|0] "" Vector__XXX
 SG_ RequestCounterRearHitch m67 : 8|4@1+ (1,0) [0|0] "" Vector__XXX
 SG_ RequestCounterFrontHitch m66 : 8|4@1+ (1,0) [0|0] "" Vector__XXX
 SG_ RequestCounterRearPTO m65 : 8|4@1+ (1,0) [0|0] "" Vector__XXX
 SG_ RequestCounterFrontPTO m64 : 8|4@1+ (1,0) [0|0] "" Vector__XXX
 SG_ RequestCounterExternalGuidance m70 : 8|4@1+ (1,0) [0|0] "" Vector__XXX
 SG_ FlowRequest_AV32 m32 : 32|16@1+ (0.004,-128.512) [0|0] "%" Vector__XXX
 SG_ FlowRequest_AV31 m31 : 32|16@1+ (0.004,-128.512) [0|0] "%" Vector__XXX
 SG_ FlowRequest_AV30 m30 : 32|16@1+ (0.004,-128.512) [0|0] "%" Vector__XXX
 SG_ FlowRequest_AV29 m29 : 32|16@1+ (0.004,-128.512) [0|0] "%" Vector__XXX
 SG_ FlowRequest_AV28 m28 : 32|16@1+ (0.004,-128.512) [0|0] "%" Vector__XXX
 SG_ FlowRequest_AV27 m27 : 32|16@1+ (0.004,-128.512) [0|0] "%" Vector__XXX
 SG_ FlowRequest_AV26 m26 : 32|16@1+ (0.004,-128.512) [0|0] "%" Vector__XXX
 SG_ FlowRequest_AV25 m25 : 32|16@1+ (0.004,-128.512) [0|0] "%" Vector__XXX
 SG_ FlowRequest_AV24 m24 : 32|16@1+ (0.004,-128.512) [0|0] "%" Vector__XXX
 SG_ FlowRequest_AV23 m23 : 32|16@1+ (0.004,-128.512) [0|0] "%" Vector__XXX
 SG_ FlowRequest_AV22 m22 : 32|16@1+ (0.004,-128.512) [0|0] "%" Vector__XXX
 SG_ FlowRequest_AV21 m21 : 32|16@1+ (0.004,-128.512) [0|0] "%" Vector__XXX
 SG_ FlowRequest_AV20 m20 : 32|16@1+ (0.004,-128.512) [0|0] "%" Vector__XXX
 SG_ FlowRequest_AV19 m19 : 32|16@1+ (0.004,-128.512) [0|0] "%" Vector__XXX
 SG_ FlowRequest_AV18 m18 : 32|16@1+ (0.004,-128.512) [0|0] "%" Vector__XXX
 SG_ FlowRequest_AV17 m17 : 32|16@1+ (0.004,-128.512) [0|0] "%" Vector__XXX
 SG_ FlowRequest_AV16 m16 : 32|16@1+ (0.004,-128.512) [0|0] "%" Vector__XXX
 SG_ FlowRequest_AV15 m15 : 32|16@1+ (0.004,-128.512) [0|0] "%" Vector__XXX
 SG_ FlowRequest_AV14 m14 : 32|16@1+ (0.004,-128.512) [0|0] "%" Vector__XXX
 SG_ FlowRequest_AV13 m13 : 32|16@1+ (0.004,-128.512) [0|0] "%" Vector__XXX
 SG_ FlowRequest_AV12 m12 : 32|16@1+ (0.004,-128.512) [0|0] "%" Vector__XXX
 SG_ FlowRequest_AV11 m11 : 32|16@1+ (0.004,-128.512) [0|0] "%" Vector__XXX
 SG_ FlowRequest_AV10 m10 : 32|16@1+ (0.004,-128.512) [0|0] "%" Vector__XXX
 SG_ FlowRequest_AV09 m9 : 32|16@1+ (0.004,-128.512) [0|0] "%" Vector__XXX
 SG_ FlowRequest_AV08 m8 : 32|16@1+ (0.004,-128.512) [0|0] "%" Vector__XXX
 SG_ FlowRequest_AV07 m7 : 32|16@1+ (0.004,-128.512) [0|0] "%" Vector__XXX
 SG_ FlowRequest_AV06 m6 : 32|16@1+ (0.004,-128.512) [0|0] "%" Vector__XXX
 SG_ FlowRequest_AV05 m5 : 32|16@1+ (0.004,-128.512) [0|0] "%" Vector__XXX
 SG_ FlowRequest_AV04 m4 : 32|16@1+ (0.004,-128.512) [0|0] "%" Vector__XXX
 SG_ FlowRequest_AV03 m3 : 32|16@1+ (0.004,-128.512) [0|0] "%" Vector__XXX
 SG_ FlowRequest_AV02 m2 : 32|16@1+ (0.004,-128.512) [0|0] "%" Vector__XXX
 SG_ RearHitchPosRequest m67 : 32|16@1+ (0.01,0) [0|100] "%" Vector__XXX
 SG_ RearPTOSpeedRequest m65 : 32|16@1+ (0.125,-4016) [0|0] "1/min" Vector__XXX
 SG_ MinimumTIMVersion_Resp m247 : 24|8@1+ (1,0) [0|0] "" Vector__XXX
 SG_ ImplementedTIMVersion_Resp m247 : 16|8@1+ (1,0) [0|0] "" Vector__XXX
 SG_ CurvatureRequest m70 : 32|16@1+ (0.25,-8032) [-8032|8031.75] "1/km" Vector__XXX
 SG_ VehicleSpeedRequest m68 : 32|16@1+ (0.001,-32.128) [-32.127|32.127] "m/s" Vector__XXX
 SG_ FrontHitchPosRequest m66 : 32|16@1+ (0.01,0) [0|100] "%" Vector__XXX
 SG_ FrontPTOSpeedRequest m64 : 32|16@1+ (0.125,-4016) [0|0] "1/min" Vector__XXX
 SG_ FlowRequest_AV01 m1 : 32|16@1+ (0.004,-128.512) [0|0] "%" Vector__XXX
 SG_ TIMClientState m249 : 20|4@1+ (1,0) [0|0] "" Vector__XXX
 SG_ ClientHeartbeatCounter m249 : 8|8@1+ (1,0) [0|0] "" Vector__XXX
 SG_ TIMFunctionId_4 m245 : 64|8@1+ (1,0) [0|0] "" Vector__XXX
 SG_ TIMFunctionId_3 m245 : 48|8@1+ (1,0) [0|0] "" Vector__XXX
 SG_ TIMFunctionId_2 m245 : 32|8@1+ (1,0) [0|0] "" Vector__XXX
 SG_ TIMFunctionId_1 m245 : 16|8@1+ (1,0) [0|0] "" Vector__XXX
 SG_ NumOfTIMFunctions m245 : 8|8@1+ (1,0) [1|250] "" Vector__XXX
 SG_ RequestType_4 m245 : 77|3@1+ (1,0) [0|0] "" Vector__XXX
 SG_ RequestType_3 m245 : 61|3@1+ (1,0) [0|0] "" Vector__XXX
 SG_ RequestType_2 m245 : 45|3@1+ (1,0) [0|0] "" Vector__XXX
 SG_ RequestType_1 m245 : 29|3@1+ (1,0) [0|0] "" Vector__XXX
 SG_ MinimumTIMVersion_Req m246 : 24|8@1+ (1,0) [0|0] "" Vector__XXX
 SG_ ImplementedTIMVersion_Req m246 : 16|8@1+ (1,0) [0|0] "" Vector__XXX
 SG_ TIMMessageType m1 : 12|4@1+ (1,0) [0|0] "" Vector__XXX
 SG_ GroupFunctionValue M : 0|8@1+ (1,0) [0|0] "" Vector__XXX

BO_ 2619670018 TIM21_TIMClient2: 16 TIMClient2
 SG_ RequestCounterAuxValve32 m32 : 8|4@1+ (1,0) [0|0] "" Vector__XXX
 SG_ RequestCounterAuxValve31 m31 : 8|4@1+ (1,0) [0|0] "" Vector__XXX
 SG_ RequestCounterAuxValve30 m30 : 8|4@1+ (1,0) [0|0] "" Vector__XXX
 SG_ RequestCounterAuxValve29 m29 : 8|4@1+ (1,0) [0|0] "" Vector__XXX
 SG_ RequestCounterAuxValve28 m28 : 8|4@1+ (1,0) [0|0] "" Vector__XXX
 SG_ RequestCounterAuxValve27 m27 : 8|4@1+ (1,0) [0|0] "" Vector__XXX
 SG_ RequestCounterAuxValve26 m26 : 8|4@1+ (1,0) [0|0] "" Vector__XXX
 SG_ RequestCounterAuxValve25 m25 : 8|4@1+ (1,0) [0|0] "" Vector__XXX
 SG_ RequestCounterAuxValve24 m24 : 8|4@1+ (1,0) [0|0] "" Vector__XXX
 SG_ RequestCounterAuxValve23 m23 : 8|4@1+ (1,0) [0|0] "" Vector__XXX
 SG_ RequestCounterAuxValve22 m22 : 8|4@1+ (1,0) [0|0] "" Vector__XXX
 SG_ RequestCounterAuxValve21 m21 : 8|4@1+ (1,0) [0|0] "" Vector__XXX
 SG_ RequestCounterAuxValve20 m20 : 8|4@1+ (1,0) [0|0] "" Vector__XXX
 SG_ RequestCounterAuxValve19 m19 : 8|4@1+ (1,0) [0|0] "" Vector__XXX
 SG_ RequestCounterAuxValve18 m18 : 8|4@1+ (1,0) [0|0] "" Vector__XXX
 SG_ RequestCounterAuxValve17 m17 : 8|4@1+ (1,0) [0|0] "" Vector__XXX
 SG_ RequestCounterAuxValve16 m16 : 8|4@1+ (1,0) [0|0] "" Vector__XXX
 SG_ RequestCounterAuxValve15 m15 : 8|4@1+ (1,0) [0|0] "" Vector__XXX
 SG_ RequestCounterAuxValve14 m14 : 8|4@1+ (1,0) [0|0] "" Vector__XXX
 SG_ RequestCounterAuxValve13 m13 : 8|4@1+ (1,0) [0|0] "" Vector__XXX
 SG_ RequestCounterAuxValve12 m12 : 8|4@1+ (1,0) [0|0] "" Vector__XXX
 SG_ RequestCounterAuxValve11 m11 : 8|4@1+ (1,0) [0|0] "" Vector__XXX
 SG_ RequestCounterAuxValve10 m10 : 8|4@1+ (1,0) [0|0] "" Vector__XXX
 SG_ RequestCounterAuxValve09 m9 : 8|4@1+ (1,0) [0|0] "" Vector__XXX
 SG_ RequestCounterAuxValve08 m8 : 8|4@1+ (1,0) [0|0] "" Vector__XXX
 SG_ RequestCounterAuxValve07 m7 : 8|4@1+ (1,0) [0|0] "" Vector__XXX
 SG_ RequestCounterAuxValve06 m6 : 8|4@1+ (1,0) [0|0] "" Vector__XXX
 SG_ RequestCounterAuxValve05 m5 : 8|4@1+ (1,0) [0|0] "" Vector__XXX
 SG_ RequestCounterAuxValve04 m4 : 8|4@1+ (1,0) [0|0] "" Vector__XXX
 SG_ RequestCounterAuxValve03 m3 : 8|4@1+ (1,0) [0|0] "" Vector__XXX
 SG_ RequestCounterAuxValve02 m2 : 8|4@1+ (1,0) [0|0] "" Vector__XXX
 SG_ RequestCounterAuxValve01 m1 : 8|4@1+ (1,0) [0|0] "" Vector__XXX
 SG_ RequestCounterVehicleSpeed m68 : 8|4@1+ (1,0) [0|0] "" Vector__XXX
 SG_ RequestCounterRearHitch m67 : 8|4@1+ (1,0) [0|0] "" Vector__XXX
 SG_ RequestCounterFrontHitch m66 : 8|4@1+ (1,0) [0|0] "" Vector__XXX
 SG_ RequestCounterRearPTO m65 : 8|4@1+ (1,0) [0|0] "" Vector__XXX
 SG_ RequestCounterFrontPTO m64 : 8|4@1+ (1,0) [0|0] "" Vector__XXX
 SG_ RequestCounterExternalGuidance m70 : 8|4@1+ (1,0) [0|0] "" Vector__XXX
 SG_ FlowRequest_AV32 m32 : 32|16@1+ (0.004,-128.512) [0|0] "%" Vector__XXX
 SG_ FlowRequest_AV31 m31 : 32|16@1+ (0.004,-128.512) [0|0] "%" Vector__XXX
 SG_ FlowRequest_AV30 m30 : 32|16@1+ (0.004,-128.512) [0|0] "%" Vector__XXX
 SG_ FlowRequest_AV29 m29 : 32|16@1+ (0.004,-128.512) [0|0] "%" Vector__XXX
 SG_ FlowRequest_AV28 m28 : 32|16@1+ (0.004,-128.512) [0|0] "%" Vector__XXX
 SG_ FlowRequest_AV27 m27 : 32|16@1+ (0.004,-128.512) [0|0] "%" Vector__XXX
 SG_ FlowRequest_AV26 m26 : 32|16@1+ (0.004,-128.512) [0|0] "%" Vector__XXX
 SG_ FlowRequest_AV25 m25 : 32|16@1+ (0.004,-128.512) [0|0] "%" Vector__XXX
 SG_ FlowRequest_AV24 m24 : 32|16@1+ (0.004,-128.512) [0|0] "%" Vector__XXX
 SG_ FlowRequest_AV23 m23 : 32|16@1+ (0.004,-128.512) [0|0] "%" Vector__XXX
 SG_ FlowRequest_AV22 m22 : 32|16@1+ (0.004,-128.512) [0|0] "%" Vector__XXX
 SG_ FlowRequest_AV21 m21 : 32|16@1+ (0.004,-128.512) [0|0] "%" Vector__XXX
 SG_ FlowRequest_AV20 m20 : 32|16@1+ (0.004,-128.512) [0|0] "%" Vector__XXX
 SG_ FlowRequest_AV19 m19 : 32|16@1+ (0.004,-128.512) [0|0] "%" Vector__XXX
 SG_ FlowRequest_AV18 m18 : 32|16@1+ (0.004,-128.512) [0|0] "%" Vector__XXX
 SG_ FlowRequest_AV17 m17 : 32|16@1+ (0.004,-128.512) [0|0] "%" Vector__XXX
 SG_ FlowRequest_AV16 m16 : 32|16@1+ (0.004,-128.512) [0|0] "%" Vector__XXX
 SG_ FlowRequest_AV15 m15 : 32|16@1+ (0.004,-128.512) [0|0] "%" Vector__XXX
 SG_ FlowRequest_AV14 m14 : 32|16@1+ (0.004,-128.512) [0|0] "%" Vector__XXX
 SG_ FlowRequest_AV13 m13 : 32|16@1+ (0.004,-128.512) [0|0] "%" Vector__XXX
 SG_ FlowRequest_AV12 m12 : 32|16@1+ (0.004,-128.512) [0|0] "%" Vector__XXX
 SG_ FlowRequest_AV11 m11 : 32|16@1+ (0.004,-128.512) [0|0] "%" Vector__XXX
 SG_ FlowRequest_AV10 m10 : 32|16@1+ (0.004,-128.512) [0|0] "%" Vector__XXX
 SG_ FlowRequest_AV09 m9 : 32|16@1+ (0.004,-128.512) [0|0] "%" Vector__XXX
 SG_ FlowRequest_AV08 m8 : 32|16@1+ (0.004,-128.512) [0|0] "%" Vector__XXX
 SG_ FlowRequest_AV07 m7 : 32|16@1+ (0.004,-128.512) [0|0] "%" Vector__XXX
 SG_ FlowRequest_AV06 m6 : 32|16@1+ (0.004,-128.512) [0|0] "%" Vector__XXX
 SG_ FlowRequest_AV05 m5 : 32|16@1+ (0.004,-128.512) [0|0] "%" Vector__XXX
 SG_ FlowRequest_AV04 m4 : 32|16@1+ (0.004,-128.512) [0|0] "%" Vector__XXX
 SG_ FlowRequest_AV03 m3 : 32|16@1+ (0.004,-128.512) [0|0] "%" Vector__XXX
 SG_ FlowRequest_AV02 m2 : 32|16@1+ (0.004,-128.512) [0|0] "%" Vector__XXX
 SG_ RearHitchPosRequest m67 : 32|16@1+ (0.01,0) [0|100] "%" Vector__XXX
 SG_ RearPTOSpeedRequest m65 : 32|16@1+ (0.125,-4016) [0|0] "1/min" Vector__XXX
 SG_ MinimumTIMVersion_Resp m247 : 24|8@1+ (1,0) [0|0] "" Vector__XXX
 SG_ ImplementedTIMVersion_Resp m247 : 16|8@1+ (1,0) [0|0] "" Vector__XXX
 SG_ CurvatureRequest m70 : 32|16@1+ (0.25,-8032) [-8032|8031.75] "1/km" Vector__XXX
 SG_ VehicleSpeedRequest m68 : 32|16@1+ (0.001,-32.128) [-32.127|32.127] "m/s" Vector__XXX
 SG_ FrontHitchPosRequest m66 : 32|16@1+ (0.01,0) [0|100] "%" Vector__XXX
 SG_ FrontPTOSpeedRequest m64 : 32|16@1+ (0.125,-4016) [0|0] "1/min" Vector__XXX
 SG_ FlowRequest_AV01 m1 : 32|16@1+ (0.004,-128.512) [0|0] "%" Vector__XXX
 SG_ TIMClientState m249 : 20|4@1+ (1,0) [0|0] "" Vector__XXX
 SG_ ClientHeartbeatCounter m249 : 8|8@1+ (1,0) [0|0] "" Vector__XXX
 SG_ TIMFunctionId_4 m245 : 64|8@1+ (1,0) [0|0] "" Vector__XXX
 SG_ TIMFunctionId_3 m245 : 48|8@1+ (1,0) [0|0] "" Vector__XXX
 SG_ TIMFunctionId_2 m245 : 32|8@1+ (1,0) [0|0] "" Vector__XXX
 SG_ TIMFunctionId_1 m245 : 16|8@1+ (1,0) [0|0] "" Vector__XXX
 SG_ NumOfTIMFunctions m245 : 8|8@1+ (1,0) [1|250] "" Vector__XXX
 SG_ RequestType_4 m245 : 77|3@1+ (1,0) [0|0] "" Vector__XXX
 SG_ RequestType_3 m245 : 61|3@1+ (1,0) [0|0] "" Vector__XXX
 SG_ RequestType_2 m245 : 45|3@1+ (1,0) [0|0] "" Vector__XXX
 SG_ RequestType_1 m245 : 29|3@1+ (1,0) [0|0] "" Vector__XXX
 SG_ MinimumTIMVersion_Req m246 : 24|8@1+ (1,0) [0|0] "" Vector__XXX
 SG_ ImplementedTIMVersion_Req m246 : 16|8@1+ (1,0) [0|0] "" Vector__XXX
 SG_ TIMMessageType m1 : 12|4@1+ (1,0) [0|0] "" Vector__XXX
 SG_ GroupFunctionValue M : 0|8@1+ (1,0) [0|0] "" Vector__XXX

CM_ BO_ 2621308419 "TIM client to TIM server (control status, v.2 and higher)";
CM_ BO_ 2621308418 "TIM client to TIM server (control status, v.2 and higher)";
CM_ BO_ 2621308417 "TIM client to TIM server (control status, v.2 and higher)";
CM_ BO_ 2619670019 "TIM message: TIM client to TIM server";
CM_ BO_ 2619670018 "TIM message: TIM client to TIM server";
BA_DEF_ SG_  "DDI" INT 0 65535;
BA_DEF_ BO_  "SingleFrame" INT 0 1;
BA_DEF_ BO_  "VFrameFormat" ENUM  "StandardCAN","ExtendedCAN","reserved","J1939PG","vector_leerstring";
BA_DEF_ BO_  "GenMsgSendType" ENUM  "cyclic","NotUsed","IfActive","NotUsed","NotUsed","NotUsed","NotUsed","NotUsed","noMsgSendType","vector_leerstring";
BA_DEF_ BO_  "GenMsgCycleTime" INT 0 3600000;
BA_DEF_ BO_  "GenMsgRequestable" INT 0 1;
BA_DEF_ BO_  "GenMsgNrOfRepetition" INT 0 1000000;
BA_DEF_ BO_  "GenMsgCycleTimeFast" INT 0 3600000;
BA_DEF_ SG_  "GenSigInactiveValue" INT 0 0;
BA_DEF_ BO_  "GenMsgFastOnStart" INT 0 100000;
BA_DEF_ BO_  "GenMsgStartDelayTime" INT 0 100000;
BA_DEF_ BO_  "GenMsgILSupport" ENUM  "No","Yes";
BA_DEF_ BO_  "GenMsgDelayTime" INT 0 1000;
BA_DEF_ SG_  "SPN" INT 0 524287;
BA_DEF_ SG_  "GenSigSendType" ENUM  "Cyclic","OnWrite","OnWriteWithRepetition","OnChange","OnChangeWithRepetition","IfActive","IfActiveWithRepetition","NoSigSendType";
BA_DEF_ SG_  "SigType" ENUM  "Default","Range","RangeSigned","ASCII","Discrete","Control","ReferencePGN","DTC","StringDelimiter","StringLength","StringLengthControl","MessageCounter","MessageChecksum";
BA_DEF_ SG_  "GenSigStartValue" INT -2147483648 2147483647;
BA_DEF_ SG_  "GenSigILSupport" ENUM  "No","Yes";
BA_DEF_DEF_  "DDI" 0;
BA_DEF_DEF_  "SingleFrame" 1;
BA_DEF_DEF_  "VFrameFormat" "J1939PG";
BA_DEF_DEF_  "GenMsgSendType" "noMsgSendType";
BA_DEF_DEF_  "GenMsgCycleTime" 0;
BA_DEF_DEF_  "GenMsgRequestable" 1;
BA_DEF_DEF_  "GenMsgNrOfRepetition" 0;
BA_DEF_DEF_  "GenMsgCycleTimeFast" 0;
BA_DEF_DEF_  "GenSigInactiveValue" 0;
BA_DEF_DEF_  "GenMsgFastOnStart" 0;
BA_DEF_DEF_  "GenMsgStartDelayTime" 0;
BA_DEF_DEF_  "GenMsgILSupport" "Yes";
BA_DEF_DEF_  "GenMsgDelayTime" 0;
BA_DEF_DEF_  "SPN" 0;
BA_DEF_DEF_  "GenSigSendType" "NoSigSendType";
BA_DEF_DEF_  "SigType" "Default";
BA_DEF_DEF_  "GenSigStartValue" 0;
BA_DEF_DEF_  "GenSigILSupport" "Yes";
BA_ "SPN" SG_ 2621308419 PositionRequest_RTL 23590;
BA_ "SPN" SG_ 2621308419 PositionRequest_FTL 23589;
BA_ "SPN" SG_ 2621308419 ControlMode1_VS 23581;
BA_ "SPN" SG_ 2621308419 ControlMode1_RTL 23581;
BA_ "SPN" SG_ 2621308419 ControlMode1_FTL 23581;
BA_ "SPN" SG_ 2621308419 NumOfControlModes_VS 23875;
BA_ "SPN" SG_ 2621308419 NumOfControlModes_RTL 23875;
BA_ "SPN" SG_ 2621308419 NumOfControlModes_FTL 23875;
BA_ "SPN" SG_ 2621308419 NumOfBytes_CM1_VS 23876;
BA_ "SPN" SG_ 2621308419 NumOfBytes_CM1_RTL 23876;
BA_ "SPN" SG_ 2621308419 NumOfBytes_CM1_FTL 23876;
BA_ "SPN" SG_ 2621308419 FlowRequest_AV32 8810;
BA_ "SigType" SG_ 2621308419 FlowRequest_AV32 1;
BA_ "GenSigStartValue" SG_ 2621308419 FlowRequest_AV32 32128;
BA_ "SigType" SG_ 2621308419 FlowRequest_AV31 1;
BA_ "GenSigStartValue" SG_ 2621308419 FlowRequest_AV31 32128;
BA_ "SPN" SG_ 2621308419 FlowRequest_AV31 8809;
BA_ "SigType" SG_ 2621308419 FlowRequest_AV30 1;
BA_ "GenSigStartValue" SG_ 2621308419 FlowRequest_AV30 32128;
BA_ "SPN" SG_ 2621308419 FlowRequest_AV30 8808;
BA_ "SigType" SG_ 2621308419 FlowRequest_AV29 1;
BA_ "GenSigStartValue" SG_ 2621308419 FlowRequest_AV29 32128;
BA_ "SPN" SG_ 2621308419 FlowRequest_AV29 8807;
BA_ "SigType" SG_ 2621308419 FlowRequest_AV28 1;
BA_ "GenSigStartValue" SG_ 2621308419 FlowRequest_AV28 32128;
BA_ "SPN" SG_ 2621308419 FlowRequest_AV28 8806;
BA_ "SigType" SG_ 2621308419 FlowRequest_AV27 1;
BA_ "GenSigStartValue" SG_ 2621308419 FlowRequest_AV27 32128;
BA_ "SPN" SG_ 2621308419 FlowRequest_AV27 8805;
BA_ "SigType" SG_ 2621308419 FlowRequest_AV26 1;
BA_ "GenSigStartValue" SG_ 2621308419 FlowRequest_AV26 32128;
BA_ "SPN" SG_ 2621308419 FlowRequest_AV26 8804;
BA_ "SigType" SG_ 2621308419 FlowRequest_AV25 1;
BA_ "GenSigStartValue" SG_ 2621308419 FlowRequest_AV25 32128;
BA_ "SPN" SG_ 2621308419 FlowRequest_AV25 8803;
BA_ "SigType" SG_ 2621308419 FlowRequest_AV24 1;
BA_ "GenSigStartValue" SG_ 2621308419 FlowRequest_AV24 32128;
BA_ "SPN" SG_ 2621308419 FlowRequest_AV24 8802;
BA_ "SigType" SG_ 2621308419 FlowRequest_AV23 1;
BA_ "GenSigStartValue" SG_ 2621308419 FlowRequest_AV23 32128;
BA_ "SPN" SG_ 2621308419 FlowRequest_AV23 8801;
BA_ "SigType" SG_ 2621308419 FlowRequest_AV22 1;
BA_ "GenSigStartValue" SG_ 2621308419 FlowRequest_AV22 32128;
BA_ "SPN" SG_ 2621308419 FlowRequest_AV22 8800;
BA_ "SigType" SG_ 2621308419 FlowRequest_AV21 1;
BA_ "GenSigStartValue" SG_ 2621308419 FlowRequest_AV21 32128;
BA_ "SPN" SG_ 2621308419 FlowRequest_AV21 8799;
BA_ "SigType" SG_ 2621308419 FlowRequest_AV20 1;
BA_ "GenSigStartValue" SG_ 2621308419 FlowRequest_AV20 32128;
BA_ "SPN" SG_ 2621308419 FlowRequest_AV20 8798;
BA_ "SigType" SG_ 2621308419 FlowRequest_AV19 1;
BA_ "GenSigStartValue" SG_ 2621308419 FlowRequest_AV19 32128;
BA_ "SPN" SG_ 2621308419 FlowRequest_AV19 8797;
BA_ "SigType" SG_ 2621308419 FlowRequest_AV18 1;
BA_ "GenSigStartValue" SG_ 2621308419 FlowRequest_AV18 32128;
BA_ "SPN" SG_ 2621308419 FlowRequest_AV18 8796;
BA_ "SigType" SG_ 2621308419 FlowRequest_AV17 1;
BA_ "GenSigStartValue" SG_ 2621308419 FlowRequest_AV17 32128;
BA_ "SPN" SG_ 2621308419 FlowRequest_AV17 8795;
BA_ "SigType" SG_ 2621308419 FlowRequest_AV16 1;
BA_ "GenSigStartValue" SG_ 2621308419 FlowRequest_AV16 32128;
BA_ "SPN" SG_ 2621308419 FlowRequest_AV16 8794;
BA_ "SigType" SG_ 2621308419 FlowRequest_AV15 1;
BA_ "GenSigStartValue" SG_ 2621308419 FlowRequest_AV15 32128;
BA_ "SPN" SG_ 2621308419 FlowRequest_AV15 8793;
BA_ "SigType" SG_ 2621308419 FlowRequest_AV14 1;
BA_ "GenSigStartValue" SG_ 2621308419 FlowRequest_AV14 32128;
BA_ "SPN" SG_ 2621308419 FlowRequest_AV14 8792;
BA_ "SigType" SG_ 2621308419 FlowRequest_AV13 1;
BA_ "GenSigStartValue" SG_ 2621308419 FlowRequest_AV13 32128;
BA_ "SPN" SG_ 2621308419 FlowRequest_AV13 8791;
BA_ "SigType" SG_ 2621308419 FlowRequest_AV12 1;
BA_ "GenSigStartValue" SG_ 2621308419 FlowRequest_AV12 32128;
BA_ "SPN" SG_ 2621308419 FlowRequest_AV12 8790;
BA_ "SigType" SG_ 2621308419 FlowRequest_AV11 1;
BA_ "GenSigStartValue" SG_ 2621308419 FlowRequest_AV11 32128;
BA_ "SPN" SG_ 2621308419 FlowRequest_AV11 8789;
BA_ "SigType" SG_ 2621308419 FlowRequest_AV10 1;
BA_ "GenSigStartValue" SG_ 2621308419 FlowRequest_AV10 32128;
BA_ "SPN" SG_ 2621308419 FlowRequest_AV10 8788;
BA_ "SigType" SG_ 2621308419 FlowRequest_AV09 1;
BA_ "GenSigStartValue" SG_ 2621308419 FlowRequest_AV09 32128;
BA_ "SPN" SG_ 2621308419 FlowRequest_AV09 8787;
BA_ "SigType" SG_ 2621308419 FlowRequest_AV08 1;
BA_ "GenSigStartValue" SG_ 2621308419 FlowRequest_AV08 32128;
BA_ "SPN" SG_ 2621308419 FlowRequest_AV08 8786;
BA_ "SigType" SG_ 2621308419 FlowRequest_AV07 1;
BA_ "GenSigStartValue" SG_ 2621308419 FlowRequest_AV07 32128;
BA_ "SPN" SG_ 2621308419 FlowRequest_AV07 8785;
BA_ "SigType" SG_ 2621308419 FlowRequest_AV06 1;
BA_ "GenSigStartValue" SG_ 2621308419 FlowRequest_AV06 32128;
BA_ "SPN" SG_ 2621308419 FlowRequest_AV06 8784;
BA_ "SigType" SG_ 2621308419 FlowRequest_AV05 1;
BA_ "GenSigStartValue" SG_ 2621308419 FlowRequest_AV05 32128;
BA_ "SPN" SG_ 2621308419 FlowRequest_AV05 8783;
BA_ "SigType" SG_ 2621308419 FlowRequest_AV04 1;
BA_ "GenSigStartValue" SG_ 2621308419 FlowRequest_AV04 32128;
BA_ "SPN" SG_ 2621308419 FlowRequest_AV04 8782;
BA_ "SigType" SG_ 2621308419 FlowRequest_AV03 1;
BA_ "GenSigStartValue" SG_ 2621308419 FlowRequest_AV03 32128;
BA_ "SPN" SG_ 2621308419 FlowRequest_AV03 8781;
BA_ "SigType" SG_ 2621308419 FlowRequest_AV02 1;
BA_ "GenSigStartValue" SG_ 2621308419 FlowRequest_AV02 32128;
BA_ "SPN" SG_ 2621308419 FlowRequest_AV02 8780;
BA_ "SigType" SG_ 2621308419 PositionRequest_RH 1;
BA_ "SPN" SG_ 2621308419 PositionRequest_RH 8814;
BA_ "SigType" SG_ 2621308419 OutputShaftSpeedRequest_RPTO 1;
BA_ "GenSigStartValue" SG_ 2621308419 OutputShaftSpeedRequest_RPTO 32128;
BA_ "SPN" SG_ 2621308419 OutputShaftSpeedRequest_RPTO 8812;
BA_ "SigType" SG_ 2621308419 CurvatureRequest_EG 1;
BA_ "GenSigStartValue" SG_ 2621308419 CurvatureRequest_EG 32128;
BA_ "SPN" SG_ 2621308419 CurvatureRequest_EG 8816;
BA_ "SigType" SG_ 2621308419 VehicleSpeedRequest_VS 1;
BA_ "GenSigStartValue" SG_ 2621308419 VehicleSpeedRequest_VS 32128;
BA_ "SPN" SG_ 2621308419 VehicleSpeedRequest_VS 8815;
BA_ "SigType" SG_ 2621308419 PositionRequest_FH 1;
BA_ "SPN" SG_ 2621308419 PositionRequest_FH 8813;
BA_ "SigType" SG_ 2621308419 OutputShaftSpeedRequest_FPTO 1;
BA_ "GenSigStartValue" SG_ 2621308419 OutputShaftSpeedRequest_FPTO 32128;
BA_ "SPN" SG_ 2621308419 OutputShaftSpeedRequest_FPTO 8811;
BA_ "SigType" SG_ 2621308419 FlowRequest_AV01 1;
BA_ "GenSigStartValue" SG_ 2621308419 FlowRequest_AV01 32128;
BA_ "SPN" SG_ 2621308419 FlowRequest_AV01 8779;
BA_ "SPN" SG_ 2621308418 PositionRequest_RTL 23590;
BA_ "SPN" SG_ 2621308418 PositionRequest_FTL 23589;
BA_ "SPN" SG_ 2621308418 ControlMode1_VS 23581;
BA_ "SPN" SG_ 2621308418 ControlMode1_RTL 23581;
BA_ "SPN" SG_ 2621308418 ControlMode1_FTL 23581;
BA_ "SPN" SG_ 2621308418 NumOfControlModes_VS 23875;
BA_ "SPN" SG_ 2621308418 NumOfControlModes_RTL 23875;
BA_ "SPN" SG_ 2621308418 NumOfControlModes_FTL 23875;
BA_ "SPN" SG_ 2621308418 NumOfBytes_CM1_VS 23876;
BA_ "SPN" SG_ 2621308418 NumOfBytes_CM1_RTL 23876;
BA_ "SPN" SG_ 2621308418 NumOfBytes_CM1_FTL 23876;
BA_ "SPN" SG_ 2621308418 FlowRequest_AV32 8810;
BA_ "SigType" SG_ 2621308418 FlowRequest_AV32 1;
BA_ "GenSigStartValue" SG_ 2621308418 FlowRequest_AV32 32128;
BA_ "SigType" SG_ 2621308418 FlowRequest_AV31 1;
BA_ "GenSigStartValue" SG_ 2621308418 FlowRequest_AV31 32128;
BA_ "SPN" SG_ 2621308418 FlowRequest_AV31 8809;
BA_ "SigType" SG_ 2621308418 FlowRequest_AV30 1;
BA_ "GenSigStartValue" SG_ 2621308418 FlowRequest_AV30 32128;
BA_ "SPN" SG_ 2621308418 FlowRequest_AV30 8808;
BA_ "SigType" SG_ 2621308418 FlowRequest_AV29 1;
BA_ "GenSigStartValue" SG_ 2621308418 FlowRequest_AV29 32128;
BA_ "SPN" SG_ 2621308418 FlowRequest_AV29 8807;
BA_ "SigType" SG_ 2621308418 FlowRequest_AV28 1;
BA_ "GenSigStartValue" SG_ 2621308418 FlowRequest_AV28 32128;
BA_ "SPN" SG_ 2621308418 FlowRequest_AV28 8806;
BA_ "SigType" SG_ 2621308418 FlowRequest_AV27 1;
BA_ "GenSigStartValue" SG_ 2621308418 FlowRequest_AV27 32128;
BA_ "SPN" SG_ 2621308418 FlowRequest_AV27 8805;
BA_ "SigType" SG_ 2621308418 FlowRequest_AV26 1;
BA_ "GenSigStartValue" SG_ 2621308418 FlowRequest_AV26 32128;
BA_ "SPN" SG_ 2621308418 FlowRequest_AV26 8804;
BA_ "SigType" SG_ 2621308418 FlowRequest_AV25 1;
BA_ "GenSigStartValue" SG_ 2621308418 FlowRequest_AV25 32128;
BA_ "SPN" SG_ 2621308418 FlowRequest_AV25 8803;
BA_ "SigType" SG_ 2621308418 FlowRequest_AV24 1;
BA_ "GenSigStartValue" SG_ 2621308418 FlowRequest_AV24 32128;
BA_ "SPN" SG_ 2621308418 FlowRequest_AV24 8802;
BA_ "SigType" SG_ 2621308418 FlowRequest_AV23 1;
BA_ "GenSigStartValue" SG_ 2621308418 FlowRequest_AV23 32128;
BA_ "SPN" SG_ 2621308418 FlowRequest_AV23 8801;
BA_ "SigType" SG_ 2621308418 FlowRequest_AV22 1;
BA_ "GenSigStartValue" SG_ 2621308418 FlowRequest_AV22 32128;
BA_ "SPN" SG_ 2621308418 FlowRequest_AV22 8800;
BA_ "SigType" SG_ 2621308418 FlowRequest_AV21 1;
BA_ "GenSigStartValue" SG_ 2621308418 FlowRequest_AV21 32128;
BA_ "SPN" SG_ 2621308418 FlowRequest_AV21 8799;
BA_ "SigType" SG_ 2621308418 FlowRequest_AV20 1;
BA_ "GenSigStartValue" SG_ 2621308418 FlowRequest_AV20 32128;
BA_ "SPN" SG_ 2621308418 FlowRequest_AV20 8798;
BA_ "SigType" SG_ 2621308418 FlowRequest_AV19 1;
BA_ "GenSigStartValue" SG_ 2621308418 FlowRequest_AV19 32128;
BA_ "SPN" SG_ 2621308418 FlowRequest_AV19 8797;
BA_ "SigType" SG_ 2621308418 FlowRequest_AV18 1;
BA_ "GenSigStartValue" SG_ 2621308418 FlowRequest_AV18 32128;
BA_ "SPN" SG_ 2621308418 FlowRequest_AV18 8796;
BA_ "SigType" SG_ 2621308418 FlowRequest_AV17 1;
BA_ "GenSigStartValue" SG_ 2621308418 FlowRequest_AV17 32128;
BA_ "SPN" SG_ 2621308418 FlowRequest_AV17 8795;
BA_ "SigType" SG_ 2621308418 FlowRequest_AV16 1;
BA_ "GenSigStartValue" SG_ 2621308418 FlowRequest_AV16 32128;
BA_ "SPN" SG_ 2621308418 FlowRequest_AV16 8794;
BA_ "SigType" SG_ 2621308418 FlowRequest_AV15 1;
BA_ "GenSigStartValue" SG_ 2621308418 FlowRequest_AV15 32128;
BA_ "SPN" SG_ 2621308418 FlowRequest_AV15 8793;
BA_ "SigType" SG_ 2621308418 FlowRequest_AV14 1;
BA_ "GenSigStartValue" SG_ 2621308418 FlowRequest_AV14 32128;
BA_ "SPN" SG_ 2621308418 FlowRequest_AV14 8792;
BA_ "SigType" SG_ 2621308418 FlowRequest_AV13 1;
BA_ "GenSigStartValue" SG_ 2621308418 FlowRequest_AV13 32128;
BA_ "SPN" SG_ 2621308418 FlowRequest_AV13 8791;
BA_ "SigType" SG_ 2621308418 FlowRequest_AV12 1;
BA_ "GenSigStartValue" SG_ 2621308418 FlowRequest_AV12 32128;
BA_ "SPN" SG_ 2621308418 FlowRequest_AV12 8790;
BA_ "SigType" SG_ 2621308418 FlowRequest_AV11 1;
BA_ "GenSigStartValue" SG_ 2621308418 FlowRequest_AV11 32128;
BA_ "SPN" SG_ 2621308418 FlowRequest_AV11 8789;
BA_ "SigType" SG_ 2621308418 FlowRequest_AV10 1;
BA_ "GenSigStartValue" SG_ 2621308418 FlowRequest_AV10 32128;
BA_ "SPN" SG_ 2621308418 FlowRequest_AV10 8788;
BA_ "SigType" SG_ 2621308418 FlowRequest_AV09 1;
BA_ "GenSigStartValue" SG_ 2621308418 FlowRequest_AV09 32128;
BA_ "SPN" SG_ 2621308418 FlowRequest_AV09 8787;
BA_ "SigType" SG_ 2621308418 FlowRequest_AV08 1;
BA_ "GenSigStartValue" SG_ 2621308418 FlowRequest_AV08 32128;
BA_ "SPN" SG_ 2621308418 FlowRequest_AV08 8786;
BA_ "SigType" SG_ 2621308418 FlowRequest_AV07 1;
BA_ "GenSigStartValue" SG_ 2621308418 FlowRequest_AV07 32128;
BA_ "SPN" SG_ 2621308418 FlowRequest_AV07 8785;
BA_ "SigType" SG_ 2621308418 FlowRequest_AV06 1;
BA_ "GenSigStartValue" SG_ 2621308418 FlowRequest_AV06 32128;
BA_ "SPN" SG_ 2621308418 FlowRequest_AV06 8784;
BA_ "SigType" SG_ 2621308418 FlowRequest_AV05 1;
BA_ "GenSigStartValue" SG_ 2621308418 FlowRequest_AV05 32128;
BA_ "SPN" SG_ 2621308418 FlowRequest_AV05 8783;
BA_ "SigType" SG_ 2621308418 FlowRequest_AV04 1;
BA_ "GenSigStartValue" SG_ 2621308418 FlowRequest_AV04 32128;
BA_ "SPN" SG_ 2621308418 FlowRequest_AV04 8782;
BA_ "SigType" SG_ 2621308418 FlowRequest_AV03 1;
BA_ "GenSigStartValue" SG_ 2621308418 FlowRequest_AV03 32128;
BA_ "SPN" SG_ 2621308418 FlowRequest_AV03 8781;
BA_ "SigType" SG_ 2621308418 FlowRequest_AV02 1;
BA_ "GenSigStartValue" SG_ 2621308418 FlowRequest_AV02 32128;
BA_ "SPN" SG_ 2621308418 FlowRequest_AV02 8780;
BA_ "SigType" SG_ 2621308418 PositionRequest_RH 1;
BA_ "SPN" SG_ 2621308418 PositionRequest_RH 8814;
BA_ "SigType" SG_ 2621308418 OutputShaftSpeedRequest_RPTO 1;
BA_ "GenSigStartValue" SG_ 2621308418 OutputShaftSpeedRequest_RPTO 32128;
BA_ "SPN" SG_ 2621308418 OutputShaftSpeedRequest_RPTO 8812;
BA_ "SigType" SG_ 2621308418 CurvatureRequest_EG 1;
BA_ "GenSigStartValue" SG_ 2621308418 CurvatureRequest_EG 32128;
BA_ "SPN" SG_ 2621308418 CurvatureRequest_EG 8816;
BA_ "SigType" SG_ 2621308418 VehicleSpeedRequest_VS 1;
BA_ "GenSigStartValue" SG_ 2621308418 VehicleSpeedRequest_VS 32128;
BA_ "SPN" SG_ 2621308418 VehicleSpeedRequest_VS 8815;
BA_ "SigType" SG_ 2621308418 PositionRequest_FH 1;
BA_ "SPN" SG_ 2621308418 PositionRequest_FH 8813;
BA_ "SigType" SG_ 2621308418 OutputShaftSpeedRequest_FPTO 1;
BA_ "GenSigStartValue" SG_ 2621308418 OutputShaftSpeedRequest_FPTO 32128;
BA_ "SPN" SG_ 2621308418 OutputShaftSpeedRequest_FPTO 8811;
BA_ "SigType" SG_ 2621308418 FlowRequest_AV01 1;
BA_ "GenSigStartValue" SG_ 2621308418 FlowRequest_AV01 32128;
BA_ "SPN" SG_ 2621308418 FlowRequest_AV01 8779;
BA_ "SPN" SG_ 2621308417 PositionRequest_RTL 23590;
BA_ "SPN" SG_ 2621308417 PositionRequest_FTL 23589;
BA_ "SPN" SG_ 2621308417 ControlMode1_VS 23581;
BA_ "SPN" SG_ 2621308417 ControlMode1_RTL 23581;
BA_ "SPN" SG_ 2621308417 ControlMode1_FTL 23581;
BA_ "SPN" SG_ 2621308417 NumOfControlModes_VS 23875;
BA_ "SPN" SG_ 2621308417 NumOfControlModes_RTL 23875;
BA_ "SPN" SG_ 2621308417 NumOfControlModes_FTL 23875;
BA_ "SPN" SG_ 2621308417 NumOfBytes_CM1_VS 23876;
BA_ "SPN" SG_ 2621308417 NumOfBytes_CM1_RTL 23876;
BA_ "SPN" SG_ 2621308417 NumOfBytes_CM1_FTL 23876;
BA_ "SPN" SG_ 2621308417 FlowRequest_AV32 8810;
BA_ "SigType" SG_ 2621308417 FlowRequest_AV32 1;
BA_ "GenSigStartValue" SG_ 2621308417 FlowRequest_AV32 32128;
BA_ "SigType" SG_ 2621308417 FlowRequest_AV31 1;
BA_ "GenSigStartValue" SG_ 2621308417 FlowRequest_AV31 32128;
BA_ "SPN" SG_ 2621308417 FlowRequest_AV31 8809;
BA_ "SigType" SG_ 2621308417 FlowRequest_AV30 1;
BA_ "GenSigStartValue" SG_ 2621308417 FlowRequest_AV30 32128;
BA_ "SPN" SG_ 2621308417 FlowRequest_AV30 8808;
BA_ "SigType" SG_ 2621308417 FlowRequest_AV29 1;
BA_ "GenSigStartValue" SG_ 2621308417 FlowRequest_AV29 32128;
BA_ "SPN" SG_ 2621308417 FlowRequest_AV29 8807;
BA_ "SigType" SG_ 2621308417 FlowRequest_AV28 1;
BA_ "GenSigStartValue" SG_ 2621308417 FlowRequest_AV28 32128;
BA_ "SPN" SG_ 2621308417 FlowRequest_AV28 8806;
BA_ "SigType" SG_ 2621308417 FlowRequest_AV27 1;
BA_ "GenSigStartValue" SG_ 2621308417 FlowRequest_AV27 32128;
BA_ "SPN" SG_ 2621308417 FlowRequest_AV27 8805;
BA_ "SigType" SG_ 2621308417 FlowRequest_AV26 1;
BA_ "GenSigStartValue" SG_ 2621308417 FlowRequest_AV26 32128;
BA_ "SPN" SG_ 2621308417 FlowRequest_AV26 8804;
BA_ "SigType" SG_ 2621308417 FlowRequest_AV25 1;
BA_ "GenSigStartValue" SG_ 2621308417 FlowRequest_AV25 32128;
BA_ "SPN" SG_ 2621308417 FlowRequest_AV25 8803;
BA_ "SigType" SG_ 2621308417 FlowRequest_AV24 1;
BA_ "GenSigStartValue" SG_ 2621308417 FlowRequest_AV24 32128;
BA_ "SPN" SG_ 2621308417 FlowRequest_AV24 8802;
BA_ "SigType" SG_ 2621308417 FlowRequest_AV23 1;
BA_ "GenSigStartValue" SG_ 2621308417 FlowRequest_AV23 32128;
BA_ "SPN" SG_ 2621308417 FlowRequest_AV23 8801;
BA_ "SigType" SG_ 2621308417 FlowRequest_AV22 1;
BA_ "GenSigStartValue" SG_ 2621308417 FlowRequest_AV22 32128;
BA_ "SPN" SG_ 2621308417 FlowRequest_AV22 8800;
BA_ "SigType" SG_ 2621308417 FlowRequest_AV21 1;
BA_ "GenSigStartValue" SG_ 2621308417 FlowRequest_AV21 32128;
BA_ "SPN" SG_ 2621308417 FlowRequest_AV21 8799;
BA_ "SigType" SG_ 2621308417 FlowRequest_AV20 1;
BA_ "GenSigStartValue" SG_ 2621308417 FlowRequest_AV20 32128;
BA_ "SPN" SG_ 2621308417 FlowRequest_AV20 8798;
BA_ "SigType" SG_ 2621308417 FlowRequest_AV19 1;
BA_ "GenSigStartValue" SG_ 2621308417 FlowRequest_AV19 32128;
BA_ "SPN" SG_ 2621308417 FlowRequest_AV19 8797;
BA_ "SigType" SG_ 2621308417 FlowRequest_AV18 1;
BA_ "GenSigStartValue" SG_ 2621308417 FlowRequest_AV18 32128;
BA_ "SPN" SG_ 2621308417 FlowRequest_AV18 8796;
BA_ "SigType" SG_ 2621308417 FlowRequest_AV17 1;
BA_ "GenSigStartValue" SG_ 2621308417 FlowRequest_AV17 32128;
BA_ "SPN" SG_ 2621308417 FlowRequest_AV17 8795;
BA_ "SigType" SG_ 2621308417 FlowRequest_AV16 1;
BA_ "GenSigStartValue" SG_ 2621308417 FlowRequest_AV16 32128;
BA_ "SPN" SG_ 2621308417 FlowRequest_AV16 8794;
BA_ "SigType" SG_ 2621308417 FlowRequest_AV15 1;
BA_ "GenSigStartValue" SG_ 2621308417 FlowRequest_AV15 32128;
BA_ "SPN" SG_ 2621308417 FlowRequest_AV15 8793;
BA_ "SigType" SG_ 2621308417 FlowRequest_AV14 1;
BA_ "GenSigStartValue" SG_ 2621308417 FlowRequest_AV14 32128;
BA_ "SPN" SG_ 2621308417 FlowRequest_AV14 8792;
BA_ "SigType" SG_ 2621308417 FlowRequest_AV13 1;
BA_ "GenSigStartValue" SG_ 2621308417 FlowRequest_AV13 32128;
BA_ "SPN" SG_ 2621308417 FlowRequest_AV13 8791;
BA_ "SigType" SG_ 2621308417 FlowRequest_AV12 1;
BA_ "GenSigStartValue" SG_ 2621308417 FlowRequest_AV12 32128;
BA_ "SPN" SG_ 2621308417 FlowRequest_AV12 8790;
BA_ "SigType" SG_ 2621308417 FlowRequest_AV11 1;
BA_ "GenSigStartValue" SG_ 2621308417 FlowRequest_AV11 32128;
BA_ "SPN" SG_ 2621308417 FlowRequest_AV11 8789;
BA_ "SigType" SG_ 2621308417 FlowRequest_AV10 1;
BA_ "GenSigStartValue" SG_ 2621308417 FlowRequest_AV10 32128;
BA_ "SPN" SG_ 2621308417 FlowRequest_AV10 8788;
BA_ "SigType" SG_ 2621308417 FlowRequest_AV09 1;
BA_ "GenSigStartValue" SG_ 2621308417 FlowRequest_AV09 32128;
BA_ "SPN" SG_ 2621308417 FlowRequest_AV09 8787;
BA_ "SigType" SG_ 2621308417 FlowRequest_AV08 1;
BA_ "GenSigStartValue" SG_ 2621308417 FlowRequest_AV08 32128;
BA_ "SPN" SG_ 2621308417 FlowRequest_AV08 8786;
BA_ "SigType" SG_ 2621308417 FlowRequest_AV07 1;
BA_ "GenSigStartValue" SG_ 2621308417 FlowRequest_AV07 32128;
BA_ "SPN" SG_ 2621308417 FlowRequest_AV07 8785;
BA_ "SigType" SG_ 2621308417 FlowRequest_AV06 1;
BA_ "GenSigStartValue" SG_ 2621308417 FlowRequest_AV06 32128;
BA_ "SPN" SG_ 2621308417 FlowRequest_AV06 8784;
BA_ "SigType" SG_ 2621308417 FlowRequest_AV05 1;
BA_ "GenSigStartValue" SG_ 2621308417 FlowRequest_AV05 32128;
BA_ "SPN" SG_ 2621308417 FlowRequest_AV05 8783;
BA_ "SigType" SG_ 2621308417 FlowRequest_AV04 1;
BA_ "GenSigStartValue" SG_ 2621308417 FlowRequest_AV04 32128;
BA_ "SPN" SG_ 2621308417 FlowRequest_AV04 8782;
BA_ "SigType" SG_ 2621308417 FlowRequest_AV03 1;
BA_ "GenSigStartValue" SG_ 2621308417 FlowRequest_AV03 32128;
BA_ "SPN" SG_ 2621308417 FlowRequest_AV03 8781;
BA_ "SigType" SG_ 2621308417 FlowRequest_AV02 1;
BA_ "GenSigStartValue" SG_ 2621308417 FlowRequest_AV02 32128;
BA_ "SPN" SG_ 2621308417 FlowRequest_AV02 8780;
BA_ "SigType" SG_ 2621308417 PositionRequest_RH 1;
BA_ "SPN" SG_ 2621308417 PositionRequest_RH 8814;
BA_ "SigType" SG_ 2621308417 OutputShaftSpeedRequest_RPTO 1;
BA_ "GenSigStartValue" SG_ 2621308417 OutputShaftSpeedRequest_RPTO 32128;
BA_ "SPN" SG_ 2621308417 OutputShaftSpeedRequest_RPTO 8812;
BA_ "SigType" SG_ 2621308417 CurvatureRequest_EG 1;
BA_ "GenSigStartValue" SG_ 2621308417 CurvatureRequest_EG 32128;
BA_ "SPN" SG_ 2621308417 CurvatureRequest_EG 8816;
BA_ "SigType" SG_ 2621308417 VehicleSpeedRequest_VS 1;
BA_ "GenSigStartValue" SG_ 2621308417 VehicleSpeedRequest_VS 32128;
BA_ "SPN" SG_ 2621308417 VehicleSpeedRequest_VS 8815;
BA_ "SigType" SG_ 2621308417 PositionRequest_FH 1;
BA_ "SPN" SG_ 2621308417 PositionRequest_FH 8813;
BA_ "SigType" SG_ 2621308417 OutputShaftSpeedRequest_FPTO 1;
BA_ "GenSigStartValue" SG_ 2621308417 OutputShaftSpeedRequest_FPTO 32128;
BA_ "SPN" SG_ 2621308417 OutputShaftSpeedRequest_FPTO 8811;
BA_ "SigType" SG_ 2621308417 FlowRequest_AV01 1;
BA_ "GenSigStartValue" SG_ 2621308417 FlowRequest_AV01 32128;
BA_ "SPN" SG_ 2621308417 FlowRequest_AV01 8779;
BA_ "SPN" SG_ 2619670019 RequestCounterAuxValve32 13360;
BA_ "SPN" SG_ 2619670019 RequestCounterAuxValve31 13359;
BA_ "SPN" SG_ 2619670019 RequestCounterAuxValve30 13358;
BA_ "SPN" SG_ 2619670019 RequestCounterAuxValve29 13357;
BA_ "SPN" SG_ 2619670019 RequestCounterAuxValve28 13356;
BA_ "SPN" SG_ 2619670019 RequestCounterAuxValve27 13355;
BA_ "SPN" SG_ 2619670019 RequestCounterAuxValve26 13354;
BA_ "SPN" SG_ 2619670019 RequestCounterAuxValve25 13353;
BA_ "SPN" SG_ 2619670019 RequestCounterAuxValve24 13352;
BA_ "SPN" SG_ 2619670019 RequestCounterAuxValve23 13351;
BA_ "SPN" SG_ 2619670019 RequestCounterAuxValve22 13350;
BA_ "SPN" SG_ 2619670019 RequestCounterAuxValve21 13349;
BA_ "SPN" SG_ 2619670019 RequestCounterAuxValve20 13348;
BA_ "SPN" SG_ 2619670019 RequestCounterAuxValve19 13347;
BA_ "SPN" SG_ 2619670019 RequestCounterAuxValve18 13346;
BA_ "SPN" SG_ 2619670019 RequestCounterAuxValve17 13345;
BA_ "SPN" SG_ 2619670019 RequestCounterAuxValve16 13344;
BA_ "SPN" SG_ 2619670019 RequestCounterAuxValve15 13343;
BA_ "SPN" SG_ 2619670019 RequestCounterAuxValve14 13342;
BA_ "SPN" SG_ 2619670019 RequestCounterAuxValve13 13341;
BA_ "SPN" SG_ 2619670019 RequestCounterAuxValve12 13340;
BA_ "SPN" SG_ 2619670019 RequestCounterAuxValve11 13339;
BA_ "SPN" SG_ 2619670019 RequestCounterAuxValve10 13338;
BA_ "SPN" SG_ 2619670019 RequestCounterAuxValve09 13337;
BA_ "SPN" SG_ 2619670019 RequestCounterAuxValve08 13336;
BA_ "SPN" SG_ 2619670019 RequestCounterAuxValve07 13335;
BA_ "SPN" SG_ 2619670019 RequestCounterAuxValve06 13334;
BA_ "SPN" SG_ 2619670019 RequestCounterAuxValve05 13333;
BA_ "SPN" SG_ 2619670019 RequestCounterAuxValve04 13332;
BA_ "SPN" SG_ 2619670019 RequestCounterAuxValve03 13331;
BA_ "SPN" SG_ 2619670019 RequestCounterAuxValve02 13330;
BA_ "SPN" SG_ 2619670019 RequestCounterAuxValve01 13329;
BA_ "SPN" SG_ 2619670019 RequestCounterVehicleSpeed 13328;
BA_ "SPN" SG_ 2619670019 RequestCounterRearHitch 13327;
BA_ "SPN" SG_ 2619670019 RequestCounterFrontHitch 13326;
BA_ "SPN" SG_ 2619670019 RequestCounterRearPTO 13325;
BA_ "SPN" SG_ 2619670019 RequestCounterFrontPTO 13324;
BA_ "SPN" SG_ 2619670019 RequestCounterExternalGuidance 13323;
BA_ "SPN" SG_ 2619670019 FlowRequest_AV32 8810;
BA_ "SigType" SG_ 2619670019 FlowRequest_AV32 1;
BA_ "GenSigStartValue" SG_ 2619670019 FlowRequest_AV32 32128;
BA_ "SigType" SG_ 2619670019 FlowRequest_AV31 1;
BA_ "GenSigStartValue" SG_ 2619670019 FlowRequest_AV31 32128;
BA_ "SPN" SG_ 2619670019 FlowRequest_AV31 8809;
BA_ "SigType" SG_ 2619670019 FlowRequest_AV30 1;
BA_ "GenSigStartValue" SG_ 2619670019 FlowRequest_AV30 32128;
BA_ "SPN" SG_ 2619670019 FlowRequest_AV30 8808;
BA_ "SigType" SG_ 2619670019 FlowRequest_AV29 1;
BA_ "GenSigStartValue" SG_ 2619670019 FlowRequest_AV29 32128;
BA_ "SPN" SG_ 2619670019 FlowRequest_AV29 8807;
BA_ "SigType" SG_ 2619670019 FlowRequest_AV28 1;
BA_ "GenSigStartValue" SG_ 2619670019 FlowRequest_AV28 32128;
BA_ "SPN" SG_ 2619670019 FlowRequest_AV28 8806;
BA_ "SigType" SG_ 2619670019 FlowRequest_AV27 1;
BA_ "GenSigStartValue" SG_ 2619670019 FlowRequest_AV27 32128;
BA_ "SPN" SG_ 2619670019 FlowRequest_AV27 8805;
BA_ "SigType" SG_ 2619670019 FlowRequest_AV26 1;
BA_ "GenSigStartValue" SG_ 2619670019 FlowRequest_AV26 32128;
BA_ "SPN" SG_ 2619670019 FlowRequest_AV26 8804;
BA_ "SigType" SG_ 2619670019 FlowRequest_AV25 1;
BA_ "GenSigStartValue" SG_ 2619670019 FlowRequest_AV25 32128;
BA_ "SPN" SG_ 2619670019 FlowRequest_AV25 8803;
BA_ "SigType" SG_ 2619670019 FlowRequest_AV24 1;
BA_ "GenSigStartValue" SG_ 2619670019 FlowRequest_AV24 32128;
BA_ "SPN" SG_ 2619670019 FlowRequest_AV24 8802;
BA_ "SigType" SG_ 2619670019 FlowRequest_AV23 1;
BA_ "GenSigStartValue" SG_ 2619670019 FlowRequest_AV23 32128;
BA_ "SPN" SG_ 2619670019 FlowRequest_AV23 8801;
BA_ "SigType" SG_ 2619670019 FlowRequest_AV22 1;
BA_ "GenSigStartValue" SG_ 2619670019 FlowRequest_AV22 32128;
BA_ "SPN" SG_ 2619670019 FlowRequest_AV22 8800;
BA_ "SigType" SG_ 2619670019 FlowRequest_AV21 1;
BA_ "GenSigStartValue" SG_ 2619670019 FlowRequest_AV21 32128;
BA_ "SPN" SG_ 2619670019 FlowRequest_AV21 8799;
BA_ "SigType" SG_ 2619670019 FlowRequest_AV20 1;
BA_ "GenSigStartValue" SG_ 2619670019 FlowRequest_AV20 32128;
BA_ "SPN" SG_ 2619670019 FlowRequest_AV20 8798;
BA_ "SigType" SG_ 2619670019 FlowRequest_AV19 1;
BA_ "GenSigStartValue" SG_ 2619670019 FlowRequest_AV19 32128;
BA_ "SPN" SG_ 2619670019 FlowRequest_AV19 8797;
BA_ "SigType" SG_ 2619670019 FlowRequest_AV18 1;
BA_ "GenSigStartValue" SG_ 2619670019 FlowRequest_AV18 32128;
BA_ "SPN" SG_ 2619670019 FlowRequest_AV18 8796;
BA_ "SigType" SG_ 2619670019 FlowRequest_AV17 1;
BA_ "GenSigStartValue" SG_ 2619670019 FlowRequest_AV17 32128;
BA_ "SPN" SG_ 2619670019 FlowRequest_AV17 8795;
BA_ "SigType" SG_ 2619670019 FlowRequest_AV16 1;
BA_ "GenSigStartValue" SG_ 2619670019 FlowRequest_AV16 32128;
BA_ "SPN" SG_ 2619670019 FlowRequest_AV16 8794;
BA_ "SigType" SG_ 2619670019 FlowRequest_AV15 1;
BA_ "GenSigStartValue" SG_ 2619670019 FlowRequest_AV15 32128;
BA_ "SPN" SG_ 2619670019 FlowRequest_AV15 8793;
BA_ "SigType" SG_ 2619670019 FlowRequest_AV14 1;
BA_ "GenSigStartValue" SG_ 2619670019 FlowRequest_AV14 32128;
BA_ "SPN" SG_ 2619670019 FlowRequest_AV14 8792;
BA_ "SigType" SG_ 2619670019 FlowRequest_AV13 1;
BA_ "GenSigStartValue" SG_ 2619670019 FlowRequest_AV13 32128;
BA_ "SPN" SG_ 2619670019 FlowRequest_AV13 8791;
BA_ "SigType" SG_ 2619670019 FlowRequest_AV12 1;
BA_ "GenSigStartValue" SG_ 2619670019 FlowRequest_AV12 32128;
BA_ "SPN" SG_ 2619670019 FlowRequest_AV12 8790;
BA_ "SigType" SG_ 2619670019 FlowRequest_AV11 1;
BA_ "GenSigStartValue" SG_ 2619670019 FlowRequest_AV11 32128;
BA_ "SPN" SG_ 2619670019 FlowRequest_AV11 8789;
BA_ "SigType" SG_ 2619670019 FlowRequest_AV10 1;
BA_ "GenSigStartValue" SG_ 2619670019 FlowRequest_AV10 32128;
BA_ "SPN" SG_ 2619670019 FlowRequest_AV10 8788;
BA_ "SigType" SG_ 2619670019 FlowRequest_AV09 1;
BA_ "GenSigStartValue" SG_ 2619670019 FlowRequest_AV09 32128;
BA_ "SPN" SG_ 2619670019 FlowRequest_AV09 8787;
BA_ "SigType" SG_ 2619670019 FlowRequest_AV08 1;
BA_ "GenSigStartValue" SG_ 2619670019 FlowRequest_AV08 32128;
BA_ "SPN" SG_ 2619670019 FlowRequest_AV08 8786;
BA_ "SigType" SG_ 2619670019 FlowRequest_AV07 1;
BA_ "GenSigStartValue" SG_ 2619670019 FlowRequest_AV07 32128;
BA_ "SPN" SG_ 2619670019 FlowRequest_AV07 8785;
BA_ "SigType" SG_ 2619670019 FlowRequest_AV06 1;
BA_ "GenSigStartValue" SG_ 2619670019 FlowRequest_AV06 32128;
BA_ "SPN" SG_ 2619670019 FlowRequest_AV06 8784;
BA_ "SigType" SG_ 2619670019 FlowRequest_AV05 1;
BA_ "GenSigStartValue" SG_ 2619670019 FlowRequest_AV05 32128;
BA_ "SPN" SG_ 2619670019 FlowRequest_AV05 8783;
BA_ "SigType" SG_ 2619670019 FlowRequest_AV04 1;
BA_ "GenSigStartValue" SG_ 2619670019 FlowRequest_AV04 32128;
BA_ "SPN" SG_ 2619670019 FlowRequest_AV04 8782;
BA_ "SigType" SG_ 2619670019 FlowRequest_AV03 1;
BA_ "GenSigStartValue" SG_ 2619670019 FlowRequest_AV03 32128;
BA_ "SPN" SG_ 2619670019 FlowRequest_AV03 8781;
BA_ "SigType" SG_ 2619670019 FlowRequest_AV02 1;
BA_ "GenSigStartValue" SG_ 2619670019 FlowRequest_AV02 32128;
BA_ "SPN" SG_ 2619670019 FlowRequest_AV02 8780;
BA_ "SigType" SG_ 2619670019 RearHitchPosRequest 1;
BA_ "SPN" SG_ 2619670019 RearHitchPosRequest 8814;
BA_ "SigType" SG_ 2619670019 RearPTOSpeedRequest 1;
BA_ "GenSigStartValue" SG_ 2619670019 RearPTOSpeedRequest 32128;
BA_ "SPN" SG_ 2619670019 RearPTOSpeedRequest 8812;
BA_ "SPN" SG_ 2619670019 MinimumTIMVersion_Resp 13288;
BA_ "SPN" SG_ 2619670019 ImplementedTIMVersion_Resp 13287;
BA_ "SigType" SG_ 2619670019 CurvatureRequest 1;
BA_ "GenSigStartValue" SG_ 2619670019 CurvatureRequest 32128;
BA_ "SPN" SG_ 2619670019 CurvatureRequest 8816;
BA_ "SigType" SG_ 2619670019 VehicleSpeedRequest 1;
BA_ "GenSigStartValue" SG_ 2619670019 VehicleSpeedRequest 32128;
BA_ "SPN" SG_ 2619670019 VehicleSpeedRequest 8815;
BA_ "SigType" SG_ 2619670019 FrontHitchPosRequest 1;
BA_ "SPN" SG_ 2619670019 FrontHitchPosRequest 8813;
BA_ "SigType" SG_ 2619670019 FrontPTOSpeedRequest 1;
BA_ "GenSigStartValue" SG_ 2619670019 FrontPTOSpeedRequest 32128;
BA_ "SPN" SG_ 2619670019 FrontPTOSpeedRequest 8811;
BA_ "SigType" SG_ 2619670019 FlowRequest_AV01 1;
BA_ "GenSigStartValue" SG_ 2619670019 FlowRequest_AV01 32128;
BA_ "SPN" SG_ 2619670019 FlowRequest_AV01 8779;
BA_ "SPN" SG_ 2619670019 TIMClientState 13286;
BA_ "SPN" SG_ 2619670019 ClientHeartbeatCounter 13285;
BA_ "SPN" SG_ 2619670019 NumOfTIMFunctions 23881;
BA_ "GenSigStartValue" SG_ 2619670019 NumOfTIMFunctions 1;
BA_ "SPN" SG_ 2619670019 RequestType_1 23882;
BA_ "SPN" SG_ 2619670019 MinimumTIMVersion_Req 13290;
BA_ "SPN" SG_ 2619670019 ImplementedTIMVersion_Req 13289;
BA_ "SPN" SG_ 2619670019 TIMMessageType 23576;
BA_ "SPN" SG_ 2619670019 GroupFunctionValue 23575;
BA_ "SPN" SG_ 2619670018 RequestCounterAuxValve32 13360;
BA_ "SPN" SG_ 2619670018 RequestCounterAuxValve31 13359;
BA_ "SPN" SG_ 2619670018 RequestCounterAuxValve30 13358;
BA_ "SPN" SG_ 2619670018 RequestCounterAuxValve29 13357;
BA_ "SPN" SG_ 2619670018 RequestCounterAuxValve28 13356;
BA_ "SPN" SG_ 2619670018 RequestCounterAuxValve27 13355;
BA_ "SPN" SG_ 2619670018 RequestCounterAuxValve26 13354;
BA_ "SPN" SG_ 2619670018 RequestCounterAuxValve25 13353;
BA_ "SPN" SG_ 2619670018 RequestCounterAuxValve24 13352;
BA_ "SPN" SG_ 2619670018 RequestCounterAuxValve23 13351;
BA_ "SPN" SG_ 2619670018 RequestCounterAuxValve22 13350;
BA_ "SPN" SG_ 2619670018 RequestCounterAuxValve21 13349;
BA_ "SPN" SG_ 2619670018 RequestCounterAuxValve20 13348;
BA_ "SPN" SG_ 2619670018 RequestCounterAuxValve19 13347;
BA_ "SPN" SG_ 2619670018 RequestCounterAuxValve18 13346;
BA_ "SPN" SG_ 2619670018 RequestCounterAuxValve17 13345;
BA_ "SPN" SG_ 2619670018 RequestCounterAuxValve16 13344;
BA_ "SPN" SG_ 2619670018 RequestCounterAuxValve15 13343;
BA_ "SPN" SG_ 2619670018 RequestCounterAuxValve14 13342;
BA_ "SPN" SG_ 2619670018 RequestCounterAuxValve13 13341;
BA_ "SPN" SG_ 2619670018 RequestCounterAuxValve12 13340;
BA_ "SPN" SG_ 2619670018 RequestCounterAuxValve11 13339;
BA_ "SPN" SG_ 2619670018 RequestCounterAuxValve10 13338;
BA_ "SPN" SG_ 2619670018 RequestCounterAuxValve09 13337;
BA_ "SPN" SG_ 2619670018 RequestCounterAuxValve08 13336;
BA_ "SPN" SG_ 2619670018 RequestCounterAuxValve07 13335;
BA_ "SPN" SG_ 2619670018 RequestCounterAuxValve06 13334;
BA_ "SPN" SG_ 2619670018 RequestCounterAuxValve05 13333;
BA_ "SPN" SG_ 2619670018 RequestCounterAuxValve04 13332;
BA_ "SPN" SG_ 2619670018 RequestCounterAuxValve03 13331;
BA_ "SPN" SG_ 2619670018 RequestCounterAuxValve02 13330;
BA_ "SPN" SG_ 2619670018 RequestCounterAuxValve01 13329;
BA_ "SPN" SG_ 2619670018 RequestCounterVehicleSpeed 13328;
BA_ "SPN" SG_ 2619670018 RequestCounterRearHitch 13327;
BA_ "SPN" SG_ 2619670018 RequestCounterFrontHitch 13326;
BA_ "SPN" SG_ 2619670018 RequestCounterRearPTO 13325;
BA_ "SPN" SG_ 2619670018 RequestCounterFrontPTO 13324;
BA_ "SPN" SG_ 2619670018 RequestCounterExternalGuidance 13323;
BA_ "SPN" SG_ 2619670018 FlowRequest_AV32 8810;
BA_ "SigType" SG_ 2619670018 FlowRequest_AV32 1;
BA_ "GenSigStartValue" SG_ 2619670018 FlowRequest_AV32 32128;
BA_ "SigType" SG_ 2619670018 FlowRequest_AV31 1;
BA_ "GenSigStartValue" SG_ 2619670018 FlowRequest_AV31 32128;
BA_ "SPN" SG_ 2619670018 FlowRequest_AV31 8809;
BA_ "SigType" SG_ 2619670018 FlowRequest_AV30 1;
BA_ "GenSigStartValue" SG_ 2619670018 FlowRequest_AV30 32128;
BA_ "SPN" SG_ 2619670018 FlowRequest_AV30 8808;
BA_ "SigType" SG_ 2619670018 FlowRequest_AV29 1;
BA_ "GenSigStartValue" SG_ 2619670018 FlowRequest_AV29 32128;
BA_ "SPN" SG_ 2619670018 FlowRequest_AV29 8807;
BA_ "SigType" SG_ 2619670018 FlowRequest_AV28 1;
BA_ "GenSigStartValue" SG_ 2619670018 FlowRequest_AV28 32128;
BA_ "SPN" SG_ 2619670018 FlowRequest_AV28 8806;
BA_ "SigType" SG_ 2619670018 FlowRequest_AV27 1;
BA_ "GenSigStartValue" SG_ 2619670018 FlowRequest_AV27 32128;
BA_ "SPN" SG_ 2619670018 FlowRequest_AV27 8805;
BA_ "SigType" SG_ 2619670018 FlowRequest_AV26 1;
BA_ "GenSigStartValue" SG_ 2619670018 FlowRequest_AV26 32128;
BA_ "SPN" SG_ 2619670018 FlowRequest_AV26 8804;
BA_ "SigType" SG_ 2619670018 FlowRequest_AV25 1;
BA_ "GenSigStartValue" SG_ 2619670018 FlowRequest_AV25 32128;
BA_ "SPN" SG_ 2619670018 FlowRequest_AV25 8803;
BA_ "SigType" SG_ 2619670018 FlowRequest_AV24 1;
BA_ "GenSigStartValue" SG_ 2619670018 FlowRequest_AV24 32128;
BA_ "SPN" SG_ 2619670018 FlowRequest_AV24 8802;
BA_ "SigType" SG_ 2619670018 FlowRequest_AV23 1;
BA_ "GenSigStartValue" SG_ 2619670018 FlowRequest_AV23 32128;
BA_ "SPN" SG_ 2619670018 FlowRequest_AV23 8801;
BA_ "SigType" SG_ 2619670018 FlowRequest_AV22 1;
BA_ "GenSigStartValue" SG_ 2619670018 FlowRequest_AV22 32128;
BA_ "SPN" SG_ 2619670018 FlowRequest_AV22 8800;
BA_ "SigType" SG_ 2619670018 FlowRequest_AV21 1;
BA_ "GenSigStartValue" SG_ 2619670018 FlowRequest_AV21 32128;
BA_ "SPN" SG_ 2619670018 FlowRequest_AV21 8799;
BA_ "SigType" SG_ 2619670018 FlowRequest_AV20 1;
BA_ "GenSigStartValue" SG_ 2619670018 FlowRequest_AV20 32128;
BA_ "SPN" SG_ 2619670018 FlowRequest_AV20 8798;
BA_ "SigType" SG_ 2619670018 FlowRequest_AV19 1;
BA_ "GenSigStartValue" SG_ 2619670018 FlowRequest_AV19 32128;
BA_ "SPN" SG_ 2619670018 FlowRequest_AV19 8797;
BA_ "SigType" SG_ 2619670018 FlowRequest_AV18 1;
BA_ "GenSigStartValue" SG_ 2619670018 FlowRequest_AV18 32128;
BA_ "SPN" SG_ 2619670018 FlowRequest_AV18 8796;
BA_ "SigType" SG_ 2619670018 FlowRequest_AV17 1;
BA_ "GenSigStartValue" SG_ 2619670018 FlowRequest_AV17 32128;
BA_ "SPN" SG_ 2619670018 FlowRequest_AV17 8795;
BA_ "SigType" SG_ 2619670018 FlowRequest_AV16 1;
BA_ "GenSigStartValue" SG_ 2619670018 FlowRequest_AV16 32128;
BA_ "SPN" SG_ 2619670018 FlowRequest_AV16 8794;
BA_ "SigType" SG_ 2619670018 FlowRequest_AV15 1;
BA_ "GenSigStartValue" SG_ 2619670018 FlowRequest_AV15 32128;
BA_ "SPN" SG_ 2619670018 FlowRequest_AV15 8793;
BA_ "SigType" SG_ 2619670018 FlowRequest_AV14 1;
BA_ "GenSigStartValue" SG_ 2619670018 FlowRequest_AV14 32128;
BA_ "SPN" SG_ 2619670018 FlowRequest_AV14 8792;
BA_ "SigType" SG_ 2619670018 FlowRequest_AV13 1;
BA_ "GenSigStartValue" SG_ 2619670018 FlowRequest_AV13 32128;
BA_ "SPN" SG_ 2619670018 FlowRequest_AV13 8791;
BA_ "SigType" SG_ 2619670018 FlowRequest_AV12 1;
BA_ "GenSigStartValue" SG_ 2619670018 FlowRequest_AV12 32128;
BA_ "SPN" SG_ 2619670018 FlowRequest_AV12 8790;
BA_ "SigType" SG_ 2619670018 FlowRequest_AV11 1;
BA_ "GenSigStartValue" SG_ 2619670018 FlowRequest_AV11 32128;
BA_ "SPN" SG_ 2619670018 FlowRequest_AV11 8789;
BA_ "SigType" SG_ 2619670018 FlowRequest_AV10 1;
BA_ "GenSigStartValue" SG_ 2619670018 FlowRequest_AV10 32128;
BA_ "SPN" SG_ 2619670018 FlowRequest_AV10 8788;
BA_ "SigType" SG_ 2619670018 FlowRequest_AV09 1;
BA_ "GenSigStartValue" SG_ 2619670018 FlowRequest_AV09 32128;
BA_ "SPN" SG_ 2619670018 FlowRequest_AV09 8787;
BA_ "SigType" SG_ 2619670018 FlowRequest_AV08 1;
BA_ "GenSigStartValue" SG_ 2619670018 FlowRequest_AV08 32128;
BA_ "SPN" SG_ 2619670018 FlowRequest_AV08 8786;
BA_ "SigType" SG_ 2619670018 FlowRequest_AV07 1;
BA_ "GenSigStartValue" SG_ 2619670018 FlowRequest_AV07 32128;
BA_ "SPN" SG_ 2619670018 FlowRequest_AV07 8785;
BA_ "SigType" SG_ 2619670018 FlowRequest_AV06 1;
BA_ "GenSigStartValue" SG_ 2619670018 FlowRequest_AV06 32128;
BA_ "SPN" SG_ 2619670018 FlowRequest_AV06 8784;
BA_ "SigType" SG_ 2619670018 FlowRequest_AV05 1;
BA_ "GenSigStartValue" SG_ 2619670018 FlowRequest_AV05 32128;
BA_ "SPN" SG_ 2619670018 FlowRequest_AV05 8783;
BA_ "SigType" SG_ 2619670018 FlowRequest_AV04 1;
BA_ "GenSigStartValue" SG_ 2619670018 FlowRequest_AV04 32128;
BA_ "SPN" SG_ 2619670018 FlowRequest_AV04 8782;
BA_ "SigType" SG_ 2619670018 FlowRequest_AV03 1;
BA_ "GenSigStartValue" SG_ 2619670018 FlowRequest_AV03 32128;
BA_ "SPN" SG_ 2619670018 FlowRequest_AV03 8781;
BA_ "SigType" SG_ 2619670018 FlowRequest_AV02 1;
BA_ "GenSigStartValue" SG_ 2619670018 FlowRequest_AV02 32128;
BA_ "SPN" SG_ 2619670018 FlowRequest_AV02 8780;
BA_ "SigType" SG_ 2619670018 RearHitchPosRequest 1;
BA_ "SPN" SG_ 2619670018 RearHitchPosRequest 8814;
BA_ "SigType" SG_ 2619670018 RearPTOSpeedRequest 1;
BA_ "GenSigStartValue" SG_ 2619670018 RearPTOSpeedRequest 32128;
BA_ "SPN" SG_ 2619670018 RearPTOSpeedRequest 8812;
BA_ "SPN" SG_ 2619670018 MinimumTIMVersion_Resp 13288;
BA_ "SPN" SG_ 2619670018 ImplementedTIMVersion_Resp 13287;
BA_ "SigType" SG_ 2619670018 CurvatureRequest 1;
BA_ "GenSigStartValue" SG_ 2619670018 CurvatureRequest 32128;
BA_ "SPN" SG_ 2619670018 CurvatureRequest 8816;
BA_ "SigType" SG_ 2619670018 VehicleSpeedRequest 1;
BA_ "GenSigStartValue" SG_ 2619670018 VehicleSpeedRequest 32128;
BA_ "SPN" SG_ 2619670018 VehicleSpeedRequest 8815;
BA_ "SigType" SG_ 2619670018 FrontHitchPosRequest 1;
BA_ "SPN" SG_ 2619670018 FrontHitchPosRequest 8813;
BA_ "SigType" SG_ 2619670018 FrontPTOSpeedRequest 1;
BA_ "GenSigStartValue" SG_ 2619670018 FrontPTOSpeedRequest 32128;
BA_ "SPN" SG_ 2619670018 FrontPTOSpeedRequest 8811;
BA_ "SigType" SG_ 2619670018 FlowRequest_AV01 1;
BA_ "GenSigStartValue" SG_ 2619670018 FlowRequest_AV01 32128;
BA_ "SPN" SG_ 2619670018 FlowRequest_AV01 8779;
BA_ "SPN" SG_ 2619670018 TIMClientState 13286;
BA_ "SPN" SG_ 2619670018 ClientHeartbeatCounter 13285;
BA_ "SPN" SG_ 2619670018 NumOfTIMFunctions 23881;
BA_ "GenSigStartValue" SG_ 2619670018 NumOfTIMFunctions 1;
BA_ "SPN" SG_ 2619670018 RequestType_1 23882;
BA_ "SPN" SG_ 2619670018 MinimumTIMVersion_Req 13290;
BA_ "SPN" SG_ 2619670018 ImplementedTIMVersion_Req 13289;
BA_ "SPN" SG_ 2619670018 TIMMessageType 23576;
BA_ "SPN" SG_ 2619670018 GroupFunctionValue 23575;
VAL_ 2621308419 SecurityByte_VS 17 "LinearMotion_Request" 0 "Parametrization_Request" ;
VAL_ 2621308419 SecurityByte_RTL 17 "PercentagePosition_Request" 0 "Parametrization_Request" ;
VAL_ 2621308419 SecurityByte_RPTO 17 "RotationalSpeed_Request" ;
VAL_ 2621308419 SecurityByte_RH 17 "PercentagePosition_Request" ;
VAL_ 2621308419 SecurityByte_FTL 17 "PercentagePosition_Request" 0 "Parametrization_Request" ;
VAL_ 2621308419 SecurityByte_FPTO 17 "RotationalSpeed_Request" ;
VAL_ 2621308419 SecurityByte_FH 17 "PercentagePosition_Request" ;
VAL_ 2621308419 SecurityByte_EG 17 "Curvature_Request" ;
VAL_ 2621308419 SecurityByte_AV32 17 "PercentageFlow_Request" ;
VAL_ 2621308419 SecurityByte_AV31 17 "PercentageFlow_Request" ;
VAL_ 2621308419 SecurityByte_AV30 17 "PercentageFlow_Request" ;
VAL_ 2621308419 SecurityByte_AV29 17 "PercentageFlow_Request" ;
VAL_ 2621308419 SecurityByte_AV28 17 "PercentageFlow_Request" ;
VAL_ 2621308419 SecurityByte_AV27 17 "PercentageFlow_Request" ;
VAL_ 2621308419 SecurityByte_AV26 17 "PercentageFlow_Request" ;
VAL_ 2621308419 SecurityByte_AV25 17 "PercentageFlow_Request" ;
VAL_ 2621308419 SecurityByte_AV24 17 "PercentageFlow_Request" ;
VAL_ 2621308419 SecurityByte_AV23 17 "PercentageFlow_Request" ;
VAL_ 2621308419 SecurityByte_AV22 17 "PercentageFlow_Request" ;
VAL_ 2621308419 SecurityByte_AV21 17 "PercentageFlow_Request" ;
VAL_ 2621308419 SecurityByte_AV20 17 "PercentageFlow_Request" ;
VAL_ 2621308419 SecurityByte_AV19 17 "PercentageFlow_Request" ;
VAL_ 2621308419 SecurityByte_AV18 17 "PercentageFlow_Request" ;
VAL_ 2621308419 SecurityByte_AV17 17 "PercentageFlow_Request" ;
VAL_ 2621308419 SecurityByte_AV16 17 "PercentageFlow_Request" ;
VAL_ 2621308419 SecurityByte_AV15 17 "PercentageFlow_Request" ;
VAL_ 2621308419 SecurityByte_AV14 17 "PercentageFlow_Request" ;
VAL_ 2621308419 SecurityByte_AV13 17 "PercentageFlow_Request" ;
VAL_ 2621308419 SecurityByte_AV12 17 "PercentageFlow_Request" ;
VAL_ 2621308419 SecurityByte_AV11 17 "PercentageFlow_Request" ;
VAL_ 2621308419 SecurityByte_AV10 17 "PercentageFlow_Request" ;
VAL_ 2621308419 SecurityByte_AV09 17 "PercentageFlow_Request" ;
VAL_ 2621308419 SecurityByte_AV08 17 "PercentageFlow_Request" ;
VAL_ 2621308419 SecurityByte_AV07 17 "PercentageFlow_Request" ;
VAL_ 2621308419 SecurityByte_AV06 17 "PercentageFlow_Request" ;
VAL_ 2621308419 SecurityByte_AV05 17 "PercentageFlow_Request" ;
VAL_ 2621308419 SecurityByte_AV04 17 "PercentageFlow_Request" ;
VAL_ 2621308419 SecurityByte_AV03 17 "PercentageFlow_Request" ;
VAL_ 2621308419 SecurityByte_AV02 17 "PercentageFlow_Request" ;
VAL_ 2621308419 SecurityByte_AV01 17 "PercentageFlow_Request" ;
VAL_ 2621308419 PositionRequest_RTL 64511 "ReadyToControl" 64509 "ReleaseControlReqOperatorAction" 64259 "ExtendUntilStopRequest" 64258 "RetractUntilStopRequest" 64257 "Stop" 64256 "Float" ;
VAL_ 2621308419 PositionRequest_FTL 64511 "ReadyToControl" 64509 "ReleaseControlReqOperatorAction" 64259 "ExtendUntilStopRequest" 64258 "RetractUntilStopRequest" 64257 "Stop" 64256 "Float" ;
VAL_ 2621308419 ControlMode1_VS 0 "GeneralParametrizationRequest" ;
VAL_ 2621308419 ControlMode1_RTL 0 "GeneralParametrizationRequest" ;
VAL_ 2621308419 ControlMode1_FTL 0 "GeneralParametrizationRequest" ;
VAL_ 2621308419 MsgType_RTL 17 "PercentagePosition_Request" 0 "Parametrization_Request" ;
VAL_ 2621308419 MsgType_FTL 17 "PercentagePosition_Request" 0 "Parametrization_Request" ;
VAL_ 2621308419 MsgType_EG 17 "Curvature_Request" ;
VAL_ 2621308419 MsgType_VS 17 "LinearMotion_Request" 0 "Parametrization_Request" ;
VAL_ 2621308419 MsgType_RH 17 "PercentagePosition_Request" ;
VAL_ 2621308419 MsgType_FH 17 "PercentagePosition_Request" ;
VAL_ 2621308419 MsgType_RPTO 17 "RotationalSpeed_Request" ;
VAL_ 2621308419 MsgType_FPTO 17 "RotationalSpeed_Request" ;
VAL_ 2621308419 MsgType_AV32 17 "PercentageFlow_Request" ;
VAL_ 2621308419 MsgType_AV31 17 "PercentageFlow_Request" ;
VAL_ 2621308419 MsgType_AV30 17 "PercentageFlow_Request" ;
VAL_ 2621308419 MsgType_AV29 17 "PercentageFlow_Request" ;
VAL_ 2621308419 MsgType_AV28 17 "PercentageFlow_Request" ;
VAL_ 2621308419 MsgType_AV27 17 "PercentageFlow_Request" ;
VAL_ 2621308419 MsgType_AV26 17 "PercentageFlow_Request" ;
VAL_ 2621308419 MsgType_AV25 17 "PercentageFlow_Request" ;
VAL_ 2621308419 MsgType_AV24 17 "PercentageFlow_Request" ;
VAL_ 2621308419 MsgType_AV23 17 "PercentageFlow_Request" ;
VAL_ 2621308419 MsgType_AV22 17 "PercentageFlow_Request" ;
VAL_ 2621308419 MsgType_AV21 17 "PercentageFlow_Request" ;
VAL_ 2621308419 MsgType_AV20 17 "PercentageFlow_Request" ;
VAL_ 2621308419 MsgType_AV19 17 "PercentageFlow_Request" ;
VAL_ 2621308419 MsgType_AV18 17 "PercentageFlow_Request" ;
VAL_ 2621308419 MsgType_AV17 17 "PercentageFlow_Request" ;
VAL_ 2621308419 MsgType_AV16 17 "PercentageFlow_Request" ;
VAL_ 2621308419 MsgType_AV15 17 "PercentageFlow_Request" ;
VAL_ 2621308419 MsgType_AV14 17 "PercentageFlow_Request" ;
VAL_ 2621308419 MsgType_AV13 17 "PercentageFlow_Request" ;
VAL_ 2621308419 MsgType_AV12 17 "PercentageFlow_Request" ;
VAL_ 2621308419 MsgType_AV11 17 "PercentageFlow_Request" ;
VAL_ 2621308419 MsgType_AV10 17 "PercentageFlow_Request" ;
VAL_ 2621308419 MsgType_AV09 17 "PercentageFlow_Request" ;
VAL_ 2621308419 MsgType_AV08 17 "PercentageFlow_Request" ;
VAL_ 2621308419 MsgType_AV07 17 "PercentageFlow_Request" ;
VAL_ 2621308419 MsgType_AV06 17 "PercentageFlow_Request" ;
VAL_ 2621308419 MsgType_AV05 17 "PercentageFlow_Request" ;
VAL_ 2621308419 MsgType_AV04 17 "PercentageFlow_Request" ;
VAL_ 2621308419 MsgType_AV03 17 "PercentageFlow_Request" ;
VAL_ 2621308419 MsgType_AV02 17 "PercentageFlow_Request" ;
VAL_ 2621308419 MsgType_AV01 17 "PercentageFlow_Request" ;
VAL_ 2621308419 TIMFunctionID 72 "RearTopLinkage" 71 "FrontTopLinkage" 32 "TIM_AuxValve32" 70 "ExternalGuidance" 68 "VehicleSpeed" 67 "RearHitch" 66 "FrontHitch" 65 "RearPTO" 64 "FrontPTO" 31 "TIM_AuxValve31" 30 "TIM_AuxValve30" 29 "TIM_AuxValve29" 28 "TIM_AuxValve28" 27 "TIM_AuxValve27" 26 "TIM_AuxValve26" 25 "TIM_AuxValve25" 24 "TIM_AuxValve24" 23 "TIM_AuxValve23" 22 "TIM_AuxValve22" 21 "TIM_AuxValve21" 20 "TIM_AuxValve20" 19 "TIM_AuxValve19" 18 "TIM_AuxValve18" 17 "TIM_AuxValve17" 16 "TIM_AuxValve16" 15 "TIM_AuxValve15" 14 "TIM_AuxValve14" 13 "TIM_AuxValve13" 12 "TIM_AuxValve12" 11 "TIM_AuxValve11" 10 "TIM_AuxValve10" 9 "TIM_AuxValve9" 8 "TIM_AuxValve8" 7 "TIM_AuxValve7" 6 "TIM_AuxValve6" 5 "TIM_AuxValve5" 4 "TIM_AuxValve4" 3 "TIM_AuxValve3" 2 "TIM_AuxValve2" 1 "TIM_AuxValve1" ;
VAL_ 2621308419 FlowRequest_AV32 64511 "ReadyToControl" 64509 "ReleasedControlRequestingOperatorActionBeforeFunctionValueIncreases" 64257 "Float" 64256 "ValveFullyOpened_Retract" 32128 "Block" 0 "ValveFullyOpened_Extend" ;
VAL_ 2621308419 FlowRequest_AV31 64511 "ReadyToControl" 64509 "ReleasedControlRequestingOperatorActionBeforeFunctionValueIncreases" 64257 "Float" 64256 "ValveFullyOpened_Retract" 32128 "Block" 0 "ValveFullyOpened_Extend" ;
VAL_ 2621308419 FlowRequest_AV30 64511 "ReadyToControl" 64509 "ReleasedControlRequestingOperatorActionBeforeFunctionValueIncreases" 64257 "Float" 64256 "ValveFullyOpened_Retract" 32128 "Block" 0 "ValveFullyOpened_Extend" ;
VAL_ 2621308419 FlowRequest_AV29 64511 "ReadyToControl" 64509 "ReleasedControlRequestingOperatorActionBeforeFunctionValueIncreases" 64257 "Float" 64256 "ValveFullyOpened_Retract" 32128 "Block" 0 "ValveFullyOpened_Extend" ;
VAL_ 2621308419 FlowRequest_AV28 64511 "ReadyToControl" 64509 "ReleasedControlRequestingOperatorActionBeforeFunctionValueIncreases" 64257 "Float" 64256 "ValveFullyOpened_Retract" 32128 "Block" 0 "ValveFullyOpened_Extend" ;
VAL_ 2621308419 FlowRequest_AV27 64511 "ReadyToControl" 64509 "ReleasedControlRequestingOperatorActionBeforeFunctionValueIncreases" 64257 "Float" 64256 "ValveFullyOpened_Retract" 32128 "Block" 0 "ValveFullyOpened_Extend" ;
VAL_ 2621308419 FlowRequest_AV26 64511 "ReadyToControl" 64509 "ReleasedControlRequestingOperatorActionBeforeFunctionValueIncreases" 64257 "Float" 64256 "ValveFullyOpened_Retract" 32128 "Block" 0 "ValveFullyOpened_Extend" ;
VAL_ 2621308419 FlowRequest_AV25 64511 "ReadyToControl" 64509 "ReleasedControlRequestingOperatorActionBeforeFunctionValueIncreases" 64257 "Float" 64256 "ValveFullyOpened_Retract" 32128 "Block" 0 "ValveFullyOpened_Extend" ;
VAL_ 2621308419 FlowRequest_AV24 64511 "ReadyToControl" 64509 "ReleasedControlRequestingOperatorActionBeforeFunctionValueIncreases" 64257 "Float" 64256 "ValveFullyOpened_Retract" 32128 "Block" 0 "ValveFullyOpened_Extend" ;
VAL_ 2621308419 FlowRequest_AV23 64511 "ReadyToControl" 64509 "ReleasedControlRequestingOperatorActionBeforeFunctionValueIncreases" 64257 "Float" 64256 "ValveFullyOpened_Retract" 32128 "Block" 0 "ValveFullyOpened_Extend" ;
VAL_ 2621308419 FlowRequest_AV22 64511 "ReadyToControl" 64509 "ReleasedControlRequestingOperatorActionBeforeFunctionValueIncreases" 64257 "Float" 64256 "ValveFullyOpened_Retract" 32128 "Block" 0 "ValveFullyOpened_Extend" ;
VAL_ 2621308419 FlowRequest_AV21 64511 "ReadyToControl" 64509 "ReleasedControlRequestingOperatorActionBeforeFunctionValueIncreases" 64257 "Float" 64256 "ValveFullyOpened_Retract" 32128 "Block" 0 "ValveFullyOpened_Extend" ;
VAL_ 2621308419 FlowRequest_AV20 64511 "ReadyToControl" 64509 "ReleasedControlRequestingOperatorActionBeforeFunctionValueIncreases" 64257 "Float" 64256 "ValveFullyOpened_Retract" 32128 "Block" 0 "ValveFullyOpened_Extend" ;
VAL_ 2621308419 FlowRequest_AV19 64511 "ReadyToControl" 64509 "ReleasedControlRequestingOperatorActionBeforeFunctionValueIncreases" 64257 "Float" 64256 "ValveFullyOpened_Retract" 32128 "Block" 0 "ValveFullyOpened_Extend" ;
VAL_ 2621308419 FlowRequest_AV18 64511 "ReadyToControl" 64509 "ReleasedControlRequestingOperatorActionBeforeFunctionValueIncreases" 64257 "Float" 64256 "ValveFullyOpened_Retract" 32128 "Block" 0 "ValveFullyOpened_Extend" ;
VAL_ 2621308419 FlowRequest_AV17 64511 "ReadyToControl" 64509 "ReleasedControlRequestingOperatorActionBeforeFunctionValueIncreases" 64257 "Float" 64256 "ValveFullyOpened_Retract" 32128 "Block" 0 "ValveFullyOpened_Extend" ;
VAL_ 2621308419 FlowRequest_AV16 64511 "ReadyToControl" 64509 "ReleasedControlRequestingOperatorActionBeforeFunctionValueIncreases" 64257 "Float" 64256 "ValveFullyOpened_Retract" 32128 "Block" 0 "ValveFullyOpened_Extend" ;
VAL_ 2621308419 FlowRequest_AV15 64511 "ReadyToControl" 64509 "ReleasedControlRequestingOperatorActionBeforeFunctionValueIncreases" 64257 "Float" 64256 "ValveFullyOpened_Retract" 32128 "Block" 0 "ValveFullyOpened_Extend" ;
VAL_ 2621308419 FlowRequest_AV14 64511 "ReadyToControl" 64509 "ReleasedControlRequestingOperatorActionBeforeFunctionValueIncreases" 64257 "Float" 64256 "ValveFullyOpened_Retract" 32128 "Block" 0 "ValveFullyOpened_Extend" ;
VAL_ 2621308419 FlowRequest_AV13 64511 "ReadyToControl" 64509 "ReleasedControlRequestingOperatorActionBeforeFunctionValueIncreases" 64257 "Float" 64256 "ValveFullyOpened_Retract" 32128 "Block" 0 "ValveFullyOpened_Extend" ;
VAL_ 2621308419 FlowRequest_AV12 64511 "ReadyToControl" 64509 "ReleasedControlRequestingOperatorActionBeforeFunctionValueIncreases" 64257 "Float" 64256 "ValveFullyOpened_Retract" 32128 "Block" 0 "ValveFullyOpened_Extend" ;
VAL_ 2621308419 FlowRequest_AV11 64511 "ReadyToControl" 64509 "ReleasedControlRequestingOperatorActionBeforeFunctionValueIncreases" 64257 "Float" 64256 "ValveFullyOpened_Retract" 32128 "Block" 0 "ValveFullyOpened_Extend" ;
VAL_ 2621308419 FlowRequest_AV10 64511 "ReadyToControl" 64509 "ReleasedControlRequestingOperatorActionBeforeFunctionValueIncreases" 64257 "Float" 64256 "ValveFullyOpened_Retract" 32128 "Block" 0 "ValveFullyOpened_Extend" ;
VAL_ 2621308419 FlowRequest_AV09 64511 "ReadyToControl" 64509 "ReleasedControlRequestingOperatorActionBeforeFunctionValueIncreases" 64257 "Float" 64256 "ValveFullyOpened_Retract" 32128 "Block" 0 "ValveFullyOpened_Extend" ;
VAL_ 2621308419 FlowRequest_AV08 64511 "ReadyToControl" 64509 "ReleasedControlRequestingOperatorActionBeforeFunctionValueIncreases" 64257 "Float" 64256 "ValveFullyOpened_Retract" 32128 "Block" 0 "ValveFullyOpened_Extend" ;
VAL_ 2621308419 FlowRequest_AV07 64511 "ReadyToControl" 64509 "ReleasedControlRequestingOperatorActionBeforeFunctionValueIncreases" 64257 "Float" 64256 "ValveFullyOpened_Retract" 32128 "Block" 0 "ValveFullyOpened_Extend" ;
VAL_ 2621308419 FlowRequest_AV06 64511 "ReadyToControl" 64509 "ReleasedControlRequestingOperatorActionBeforeFunctionValueIncreases" 64257 "Float" 64256 "ValveFullyOpened_Retract" 32128 "Block" 0 "ValveFullyOpened_Extend" ;
VAL_ 2621308419 FlowRequest_AV05 64511 "ReadyToControl" 64509 "ReleasedControlRequestingOperatorActionBeforeFunctionValueIncreases" 64257 "Float" 64256 "ValveFullyOpened_Retract" 32128 "Block" 0 "ValveFullyOpened_Extend" ;
VAL_ 2621308419 FlowRequest_AV04 64511 "ReadyToControl" 64509 "ReleasedControlRequestingOperatorActionBeforeFunctionValueIncreases" 64257 "Float" 64256 "ValveFullyOpened_Retract" 32128 "Block" 0 "ValveFullyOpened_Extend" ;
VAL_ 2621308419 FlowRequest_AV03 64511 "ReadyToControl" 64509 "ReleasedControlRequestingOperatorActionBeforeFunctionValueIncreases" 64257 "Float" 64256 "ValveFullyOpened_Retract" 32128 "Block" 0 "ValveFullyOpened_Extend" ;
VAL_ 2621308419 FlowRequest_AV02 64511 "ReadyToControl" 64509 "ReleasedControlRequestingOperatorActionBeforeFunctionValueIncreases" 64257 "Float" 64256 "ValveFullyOpened_Retract" 32128 "Block" 0 "ValveFullyOpened_Extend" ;
VAL_ 2621308419 PositionRequest_RH 10000 "FullRaise" 64259 "RaiseUntilStopRequest" 64258 "LowerUntilStopRequest" 0 "FullLower" 64511 "ReadyToControl" 64509 "ReleaseControlRequestingOperatorAction" 64257 "Stop" 64256 "Float" ;
VAL_ 2621308419 OutputShaftSpeedRequest_RPTO 64511 "ReadyToControl" 64509 "RequestingOperatorAction" 64256 "On_SpeedClockwiseSetByTimServer" 32128 "Off" 0 "On_SpeedCounterClockwiseSetByTimServer" ;
VAL_ 2621308419 CurvatureRequest_EG 64511 "ReadyToControl" 64509 "RequestingOperatorAwareness" 32128 "Straight" ;
VAL_ 2621308419 VehicleSpeedRequest_VS 64511 "ReadyToControl" 64510 "AcceptFunctionWithoutOperatorAwareness" 64509 "RequestingOperatorAwareness" 64256 "ForwardSpeedSetByTimServer" 32128 "Stop" 0 "ReverseSpeedSetByTimServer" ;
VAL_ 2621308419 PositionRequest_FH 10000 "FullRaise" 64259 "RaiseUntilStopRequest" 64258 "LowerUntilStopRequest" 0 "FullLower" 64511 "ReadyToControl" 64509 "ReleaseControlRequestingOperatorAction" 64257 "Stop" 64256 "Float" ;
VAL_ 2621308419 OutputShaftSpeedRequest_FPTO 64511 "ReadyToControl" 64509 "RequestingOperatorAction" 64256 "On_SpeedClockwiseSetByTimServer" 32128 "Off" 0 "On_SpeedCounterClockwiseSetByTimServer" ;
VAL_ 2621308419 FlowRequest_AV01 64511 "ReadyToControl" 64509 "ReleasedControlRequestingOperatorActionBeforeFunctionValueIncreases" 64257 "Float" 64256 "ValveFullyOpened_Retract" 32128 "Block" 0 "ValveFullyOpened_Extend" ;
VAL_ 2621308418 SecurityByte_VS 17 "LinearMotion_Request" 0 "Parametrization_Request" ;
VAL_ 2621308418 SecurityByte_RTL 17 "PercentagePosition_Request" 0 "Parametrization_Request" ;
VAL_ 2621308418 SecurityByte_RPTO 17 "RotationalSpeed_Request" ;
VAL_ 2621308418 SecurityByte_RH 17 "PercentagePosition_Request" ;
VAL_ 2621308418 SecurityByte_FTL 17 "PercentagePosition_Request" 0 "Parametrization_Request" ;
VAL_ 2621308418 SecurityByte_FPTO 17 "RotationalSpeed_Request" ;
VAL_ 2621308418 SecurityByte_FH 17 "PercentagePosition_Request" ;
VAL_ 2621308418 SecurityByte_EG 17 "Curvature_Request" ;
VAL_ 2621308418 SecurityByte_AV32 17 "PercentageFlow_Request" ;
VAL_ 2621308418 SecurityByte_AV31 17 "PercentageFlow_Request" ;
VAL_ 2621308418 SecurityByte_AV30 17 "PercentageFlow_Request" ;
VAL_ 2621308418 SecurityByte_AV29 17 "PercentageFlow_Request" ;
VAL_ 2621308418 SecurityByte_AV28 17 "PercentageFlow_Request" ;
VAL_ 2621308418 SecurityByte_AV27 17 "PercentageFlow_Request" ;
VAL_ 2621308418 SecurityByte_AV26 17 "PercentageFlow_Request" ;
VAL_ 2621308418 SecurityByte_AV25 17 "PercentageFlow_Request" ;
VAL_ 2621308418 SecurityByte_AV24 17 "PercentageFlow_Request" ;
VAL_ 2621308418 SecurityByte_AV23 17 "PercentageFlow_Request" ;
VAL_ 2621308418 SecurityByte_AV22 17 "PercentageFlow_Request" ;
VAL_ 2621308418 SecurityByte_AV21 17 "PercentageFlow_Request" ;
VAL_ 2621308418 SecurityByte_AV20 17 "PercentageFlow_Request" ;
VAL_ 2621308418 SecurityByte_AV19 17 "PercentageFlow_Request" ;
VAL_ 2621308418 SecurityByte_AV18 17 "PercentageFlow_Request" ;
VAL_ 2621308418 SecurityByte_AV17 17 "PercentageFlow_Request" ;
VAL_ 2621308418 SecurityByte_AV16 17 "PercentageFlow_Request" ;
VAL_ 2621308418 SecurityByte_AV15 17 "PercentageFlow_Request" ;
VAL_ 2621308418 SecurityByte_AV14 17 "PercentageFlow_Request" ;
VAL_ 2621308418 SecurityByte_AV13 17 "PercentageFlow_Request" ;
VAL_ 2621308418 SecurityByte_AV12 17 "PercentageFlow_Request" ;
VAL_ 2621308418 SecurityByte_AV11 17 "PercentageFlow_Request" ;
VAL_ 2621308418 SecurityByte_AV10 17 "PercentageFlow_Request" ;
VAL_ 2621308418 SecurityByte_AV09 17 "PercentageFlow_Request" ;
VAL_ 2621308418 SecurityByte_AV08 17 "PercentageFlow_Request" ;
VAL_ 2621308418 SecurityByte_AV07 17 "PercentageFlow_Request" ;
VAL_ 2621308418 SecurityByte_AV06 17 "PercentageFlow_Request" ;
VAL_ 2621308418 SecurityByte_AV05 17 "PercentageFlow_Request" ;
VAL_ 2621308418 SecurityByte_AV04 17 "PercentageFlow_Request" ;
VAL_ 2621308418 SecurityByte_AV03 17 "PercentageFlow_Request" ;
VAL_ 2621308418 SecurityByte_AV02 17 "PercentageFlow_Request" ;
VAL_ 2621308418 SecurityByte_AV01 17 "PercentageFlow_Request" ;
VAL_ 2621308418 PositionRequest_RTL 64511 "ReadyToControl" 64509 "ReleaseControlReqOperatorAction" 64259 "ExtendUntilStopRequest" 64258 "RetractUntilStopRequest" 64257 "Stop" 64256 "Float" ;
VAL_ 2621308418 PositionRequest_FTL 64511 "ReadyToControl" 64509 "ReleaseControlReqOperatorAction" 64259 "ExtendUntilStopRequest" 64258 "RetractUntilStopRequest" 64257 "Stop" 64256 "Float" ;
VAL_ 2621308418 ControlMode1_VS 0 "GeneralParametrizationRequest" ;
VAL_ 2621308418 ControlMode1_RTL 0 "GeneralParametrizationRequest" ;
VAL_ 2621308418 ControlMode1_FTL 0 "GeneralParametrizationRequest" ;
VAL_ 2621308418 MsgType_RTL 17 "PercentagePosition_Request" 0 "Parametrization_Request" ;
VAL_ 2621308418 MsgType_FTL 17 "PercentagePosition_Request" 0 "Parametrization_Request" ;
VAL_ 2621308418 MsgType_EG 17 "Curvature_Request" ;
VAL_ 2621308418 MsgType_VS 17 "LinearMotion_Request" 0 "Parametrization_Request" ;
VAL_ 2621308418 MsgType_RH 17 "PercentagePosition_Request" ;
VAL_ 2621308418 MsgType_FH 17 "PercentagePosition_Request" ;
VAL_ 2621308418 MsgType_RPTO 17 "RotationalSpeed_Request" ;
VAL_ 2621308418 MsgType_FPTO 17 "RotationalSpeed_Request" ;
VAL_ 2621308418 MsgType_AV32 17 "PercentageFlow_Request" ;
VAL_ 2621308418 MsgType_AV31 17 "PercentageFlow_Request" ;
VAL_ 2621308418 MsgType_AV30 17 "PercentageFlow_Request" ;
VAL_ 2621308418 MsgType_AV29 17 "PercentageFlow_Request" ;
VAL_ 2621308418 MsgType_AV28 17 "PercentageFlow_Request" ;
VAL_ 2621308418 MsgType_AV27 17 "PercentageFlow_Request" ;
VAL_ 2621308418 MsgType_AV26 17 "PercentageFlow_Request" ;
VAL_ 2621308418 MsgType_AV25 17 "PercentageFlow_Request" ;
VAL_ 2621308418 MsgType_AV24 17 "PercentageFlow_Request" ;
VAL_ 2621308418 MsgType_AV23 17 "PercentageFlow_Request" ;
VAL_ 2621308418 MsgType_AV22 17 "PercentageFlow_Request" ;
VAL_ 2621308418 MsgType_AV21 17 "PercentageFlow_Request" ;
VAL_ 2621308418 MsgType_AV20 17 "PercentageFlow_Request" ;
VAL_ 2621308418 MsgType_AV19 17 "PercentageFlow_Request" ;
VAL_ 2621308418 MsgType_AV18 17 "PercentageFlow_Request" ;
VAL_ 2621308418 MsgType_AV17 17 "PercentageFlow_Request" ;
VAL_ 2621308418 MsgType_AV16 17 "PercentageFlow_Request" ;
VAL_ 2621308418 MsgType_AV15 17 "PercentageFlow_Request" ;
VAL_ 2621308418 MsgType_AV14 17 "PercentageFlow_Request" ;
VAL_ 2621308418 MsgType_AV13 17 "PercentageFlow_Request" ;
VAL_ 2621308418 MsgType_AV12 17 "PercentageFlow_Request" ;
VAL_ 2621308418 MsgType_AV11 17 "PercentageFlow_Request" ;
VAL_ 2621308418 MsgType_AV10 17 "PercentageFlow_Request" ;
VAL_ 2621308418 MsgType_AV09 17 "PercentageFlow_Request" ;
VAL_ 2621308418 MsgType_AV08 17 "PercentageFlow_Request" ;
VAL_ 2621308418 MsgType_AV07 17 "PercentageFlow_Request" ;
VAL_ 2621308418 MsgType_AV06 17 "PercentageFlow_Request" ;
VAL_ 2621308418 MsgType_AV05 17 "PercentageFlow_Request" ;
VAL_ 2621308418 MsgType_AV04 17 "PercentageFlow_Request" ;
VAL_ 2621308418 MsgType_AV03 17 "PercentageFlow_Request" ;
VAL_ 2621308418 MsgType_AV02 17 "PercentageFlow_Request" ;
VAL_ 2621308418 MsgType_AV01 17 "PercentageFlow_Request" ;
VAL_ 2621308418 TIMFunctionID 72 "RearTopLinkage" 71 "FrontTopLinkage" 32 "TIM_AuxValve32" 70 "ExternalGuidance" 68 "VehicleSpeed" 67 "RearHitch" 66 "FrontHitch" 65 "RearPTO" 64 "FrontPTO" 31 "TIM_AuxValve31" 30 "TIM_AuxValve30" 29 "TIM_AuxValve29" 28 "TIM_AuxValve28" 27 "TIM_AuxValve27" 26 "TIM_AuxValve26" 25 "TIM_AuxValve25" 24 "TIM_AuxValve24" 23 "TIM_AuxValve23" 22 "TIM_AuxValve22" 21 "TIM_AuxValve21" 20 "TIM_AuxValve20" 19 "TIM_AuxValve19" 18 "TIM_AuxValve18" 17 "TIM_AuxValve17" 16 "TIM_AuxValve16" 15 "TIM_AuxValve15" 14 "TIM_AuxValve14" 13 "TIM_AuxValve13" 12 "TIM_AuxValve12" 11 "TIM_AuxValve11" 10 "TIM_AuxValve10" 9 "TIM_AuxValve9" 8 "TIM_AuxValve8" 7 "TIM_AuxValve7" 6 "TIM_AuxValve6" 5 "TIM_AuxValve5" 4 "TIM_AuxValve4" 3 "TIM_AuxValve3" 2 "TIM_AuxValve2" 1 "TIM_AuxValve1" ;
VAL_ 2621308418 FlowRequest_AV32 64511 "ReadyToControl" 64509 "ReleasedControlRequestingOperatorActionBeforeFunctionValueIncreases" 64257 "Float" 64256 "ValveFullyOpened_Retract" 32128 "Block" 0 "ValveFullyOpened_Extend" ;
VAL_ 2621308418 FlowRequest_AV31 64511 "ReadyToControl" 64509 "ReleasedControlRequestingOperatorActionBeforeFunctionValueIncreases" 64257 "Float" 64256 "ValveFullyOpened_Retract" 32128 "Block" 0 "ValveFullyOpened_Extend" ;
VAL_ 2621308418 FlowRequest_AV30 64511 "ReadyToControl" 64509 "ReleasedControlRequestingOperatorActionBeforeFunctionValueIncreases" 64257 "Float" 64256 "ValveFullyOpened_Retract" 32128 "Block" 0 "ValveFullyOpened_Extend" ;
VAL_ 2621308418 FlowRequest_AV29 64511 "ReadyToControl" 64509 "ReleasedControlRequestingOperatorActionBeforeFunctionValueIncreases" 64257 "Float" 64256 "ValveFullyOpened_Retract" 32128 "Block" 0 "ValveFullyOpened_Extend" ;
VAL_ 2621308418 FlowRequest_AV28 64511 "ReadyToControl" 64509 "ReleasedControlRequestingOperatorActionBeforeFunctionValueIncreases" 64257 "Float" 64256 "ValveFullyOpened_Retract" 32128 "Block" 0 "ValveFullyOpened_Extend" ;
VAL_ 2621308418 FlowRequest_AV27 64511 "ReadyToControl" 64509 "ReleasedControlRequestingOperatorActionBeforeFunctionValueIncreases" 64257 "Float" 64256 "ValveFullyOpened_Retract" 32128 "Block" 0 "ValveFullyOpened_Extend" ;
VAL_ 2621308418 FlowRequest_AV26 64511 "ReadyToControl" 64509 "ReleasedControlRequestingOperatorActionBeforeFunctionValueIncreases" 64257 "Float" 64256 "ValveFullyOpened_Retract" 32128 "Block" 0 "ValveFullyOpened_Extend" ;
VAL_ 2621308418 FlowRequest_AV25 64511 "ReadyToControl" 64509 "ReleasedControlRequestingOperatorActionBeforeFunctionValueIncreases" 64257 "Float" 64256 "ValveFullyOpened_Retract" 32128 "Block" 0 "ValveFullyOpened_Extend" ;
VAL_ 2621308418 FlowRequest_AV24 64511 "ReadyToControl" 64509 "ReleasedControlRequestingOperatorActionBeforeFunctionValueIncreases" 64257 "Float" 64256 "ValveFullyOpened_Retract" 32128 "Block" 0 "ValveFullyOpened_Extend" ;
VAL_ 2621308418 FlowRequest_AV23 64511 "ReadyToControl" 64509 "ReleasedControlRequestingOperatorActionBeforeFunctionValueIncreases" 64257 "Float" 64256 "ValveFullyOpened_Retract" 32128 "Block" 0 "ValveFullyOpened_Extend" ;
VAL_ 2621308418 FlowRequest_AV22 64511 "ReadyToControl" 64509 "ReleasedControlRequestingOperatorActionBeforeFunctionValueIncreases" 64257 "Float" 64256 "ValveFullyOpened_Retract" 32128 "Block" 0 "ValveFullyOpened_Extend" ;
VAL_ 2621308418 FlowRequest_AV21 64511 "ReadyToControl" 64509 "ReleasedControlRequestingOperatorActionBeforeFunctionValueIncreases" 64257 "Float" 64256 "ValveFullyOpened_Retract" 32128 "Block" 0 "ValveFullyOpened_Extend" ;
VAL_ 2621308418 FlowRequest_AV20 64511 "ReadyToControl" 64509 "ReleasedControlRequestingOperatorActionBeforeFunctionValueIncreases" 64257 "Float" 64256 "ValveFullyOpened_Retract" 32128 "Block" 0 "ValveFullyOpened_Extend" ;
VAL_ 2621308418 FlowRequest_AV19 64511 "ReadyToControl" 64509 "ReleasedControlRequestingOperatorActionBeforeFunctionValueIncreases" 64257 "Float" 64256 "ValveFullyOpened_Retract" 32128 "Block" 0 "ValveFullyOpened_Extend" ;
VAL_ 2621308418 FlowRequest_AV18 64511 "ReadyToControl" 64509 "ReleasedControlRequestingOperatorActionBeforeFunctionValueIncreases" 64257 "Float" 64256 "ValveFullyOpened_Retract" 32128 "Block" 0 "ValveFullyOpened_Extend" ;
VAL_ 2621308418 FlowRequest_AV17 64511 "ReadyToControl" 64509 "ReleasedControlRequestingOperatorActionBeforeFunctionValueIncreases" 64257 "Float" 64256 "ValveFullyOpened_Retract" 32128 "Block" 0 "ValveFullyOpened_Extend" ;
VAL_ 2621308418 FlowRequest_AV16 64511 "ReadyToControl" 64509 "ReleasedControlRequestingOperatorActionBeforeFunctionValueIncreases" 64257 "Float" 64256 "ValveFullyOpened_Retract" 32128 "Block" 0 "ValveFullyOpened_Extend" ;
VAL_ 2621308418 FlowRequest_AV15 64511 "ReadyToControl" 64509 "ReleasedControlRequestingOperatorActionBeforeFunctionValueIncreases" 64257 "Float" 64256 "ValveFullyOpened_Retract" 32128 "Block" 0 "ValveFullyOpened_Extend" ;
VAL_ 2621308418 FlowRequest_AV14 64511 "ReadyToControl" 64509 "ReleasedControlRequestingOperatorActionBeforeFunctionValueIncreases" 64257 "Float" 64256 "ValveFullyOpened_Retract" 32128 "Block" 0 "ValveFullyOpened_Extend" ;
VAL_ 2621308418 FlowRequest_AV13 64511 "ReadyToControl" 64509 "ReleasedControlRequestingOperatorActionBeforeFunctionValueIncreases" 64257 "Float" 64256 "ValveFullyOpened_Retract" 32128 "Block" 0 "ValveFullyOpened_Extend" ;
VAL_ 2621308418 FlowRequest_AV12 64511 "ReadyToControl" 64509 "ReleasedControlRequestingOperatorActionBeforeFunctionValueIncreases" 64257 "Float" 64256 "ValveFullyOpened_Retract" 32128 "Block" 0 "ValveFullyOpened_Extend" ;
VAL_ 2621308418 FlowRequest_AV11 64511 "ReadyToControl" 64509 "ReleasedControlRequestingOperatorActionBeforeFunctionValueIncreases" 64257 "Float" 64256 "ValveFullyOpened_Retract" 32128 "Block" 0 "ValveFullyOpened_Extend" ;
VAL_ 2621308418 FlowRequest_AV10 64511 "ReadyToControl" 64509 "ReleasedControlRequestingOperatorActionBeforeFunctionValueIncreases" 64257 "Float" 64256 "ValveFullyOpened_Retract" 32128 "Block" 0 "ValveFullyOpened_Extend" ;
VAL_ 2621308418 FlowRequest_AV09 64511 "ReadyToControl" 64509 "ReleasedControlRequestingOperatorActionBeforeFunctionValueIncreases" 64257 "Float" 64256 "ValveFullyOpened_Retract" 32128 "Block" 0 "ValveFullyOpened_Extend" ;
VAL_ 2621308418 FlowRequest_AV08 64511 "ReadyToControl" 64509 "ReleasedControlRequestingOperatorActionBeforeFunctionValueIncreases" 64257 "Float" 64256 "ValveFullyOpened_Retract" 32128 "Block" 0 "ValveFullyOpened_Extend" ;
VAL_ 2621308418 FlowRequest_AV07 64511 "ReadyToControl" 64509 "ReleasedControlRequestingOperatorActionBeforeFunctionValueIncreases" 64257 "Float" 64256 "ValveFullyOpened_Retract" 32128 "Block" 0 "ValveFullyOpened_Extend" ;
VAL_ 2621308418 FlowRequest_AV06 64511 "ReadyToControl" 64509 "ReleasedControlRequestingOperatorActionBeforeFunctionValueIncreases" 64257 "Float" 64256 "ValveFullyOpened_Retract" 32128 "Block" 0 "ValveFullyOpened_Extend" ;
VAL_ 2621308418 FlowRequest_AV05 64511 "ReadyToControl" 64509 "ReleasedControlRequestingOperatorActionBeforeFunctionValueIncreases" 64257 "Float" 64256 "ValveFullyOpened_Retract" 32128 "Block" 0 "ValveFullyOpened_Extend" ;
VAL_ 2621308418 FlowRequest_AV04 64511 "ReadyToControl" 64509 "ReleasedControlRequestingOperatorActionBeforeFunctionValueIncreases" 64257 "Float" 64256 "ValveFullyOpened_Retract" 32128 "Block" 0 "ValveFullyOpened_Extend" ;
VAL_ 2621308418 FlowRequest_AV03 64511 "ReadyToControl" 64509 "ReleasedControlRequestingOperatorActionBeforeFunctionValueIncreases" 64257 "Float" 64256 "ValveFullyOpened_Retract" 32128 "Block" 0 "ValveFullyOpened_Extend" ;
VAL_ 2621308418 FlowRequest_AV02 64511 "ReadyToControl" 64509 "ReleasedControlRequestingOperatorActionBeforeFunctionValueIncreases" 64257 "Float" 64256 "ValveFullyOpened_Retract" 32128 "Block" 0 "ValveFullyOpened_Extend" ;
VAL_ 2621308418 PositionRequest_RH 10000 "FullRaise" 64259 "RaiseUntilStopRequest" 64258 "LowerUntilStopRequest" 0 "FullLower" 64511 "ReadyToControl" 64509 "ReleaseControlRequestingOperatorAction" 64257 "Stop" 64256 "Float" ;
VAL_ 2621308418 OutputShaftSpeedRequest_RPTO 64511 "ReadyToControl" 64509 "RequestingOperatorAction" 64256 "On_SpeedClockwiseSetByTimServer" 32128 "Off" 0 "On_SpeedCounterClockwiseSetByTimServer" ;
VAL_ 2621308418 CurvatureRequest_EG 64511 "ReadyToControl" 64509 "RequestingOperatorAwareness" 32128 "Straight" ;
VAL_ 2621308418 VehicleSpeedRequest_VS 64511 "ReadyToControl" 64510 "AcceptFunctionWithoutOperatorAwareness" 64509 "RequestingOperatorAwareness" 64256 "ForwardSpeedSetByTimServer" 32128 "Stop" 0 "ReverseSpeedSetByTimServer" ;
VAL_ 2621308418 PositionRequest_FH 10000 "FullRaise" 64259 "RaiseUntilStopRequest" 64258 "LowerUntilStopRequest" 0 "FullLower" 64511 "ReadyToControl" 64509 "ReleaseControlRequestingOperatorAction" 64257 "Stop" 64256 "Float" ;
VAL_ 2621308418 OutputShaftSpeedRequest_FPTO 64511 "ReadyToControl" 64509 "RequestingOperatorAction" 64256 "On_SpeedClockwiseSetByTimServer" 32128 "Off" 0 "On_SpeedCounterClockwiseSetByTimServer" ;
VAL_ 2621308418 FlowRequest_AV01 64511 "ReadyToControl" 64509 "ReleasedControlRequestingOperatorActionBeforeFunctionValueIncreases" 64257 "Float" 64256 "ValveFullyOpened_Retract" 32128 "Block" 0 "ValveFullyOpened_Extend" ;
VAL_ 2621308417 SecurityByte_VS 17 "LinearMotion_Request" 0 "Parametrization_Request" ;
VAL_ 2621308417 SecurityByte_RTL 17 "PercentagePosition_Request" 0 "Parametrization_Request" ;
VAL_ 2621308417 SecurityByte_RPTO 17 "RotationalSpeed_Request" ;
VAL_ 2621308417 SecurityByte_RH 17 "PercentagePosition_Request" ;
VAL_ 2621308417 SecurityByte_FTL 17 "PercentagePosition_Request" 0 "Parametrization_Request" ;
VAL_ 2621308417 SecurityByte_FPTO 17 "RotationalSpeed_Request" ;
VAL_ 2621308417 SecurityByte_FH 17 "PercentagePosition_Request" ;
VAL_ 2621308417 SecurityByte_EG 17 "Curvature_Request" ;
VAL_ 2621308417 SecurityByte_AV32 17 "PercentageFlow_Request" ;
VAL_ 2621308417 SecurityByte_AV31 17 "PercentageFlow_Request" ;
VAL_ 2621308417 SecurityByte_AV30 17 "PercentageFlow_Request" ;
VAL_ 2621308417 SecurityByte_AV29 17 "PercentageFlow_Request" ;
VAL_ 2621308417 SecurityByte_AV28 17 "PercentageFlow_Request" ;
VAL_ 2621308417 SecurityByte_AV27 17 "PercentageFlow_Request" ;
VAL_ 2621308417 SecurityByte_AV26 17 "PercentageFlow_Request" ;
VAL_ 2621308417 SecurityByte_AV25 17 "PercentageFlow_Request" ;
VAL_ 2621308417 SecurityByte_AV24 17 "PercentageFlow_Request" ;
VAL_ 2621308417 SecurityByte_AV23 17 "PercentageFlow_Request" ;
VAL_ 2621308417 SecurityByte_AV22 17 "PercentageFlow_Request" ;
VAL_ 2621308417 SecurityByte_AV21 17 "PercentageFlow_Request" ;
VAL_ 2621308417 SecurityByte_AV20 17 "PercentageFlow_Request" ;
VAL_ 2621308417 SecurityByte_AV19 17 "PercentageFlow_Request" ;
VAL_ 2621308417 SecurityByte_AV18 17 "PercentageFlow_Request" ;
VAL_ 2621308417 SecurityByte_AV17 17 "PercentageFlow_Request" ;
VAL_ 2621308417 SecurityByte_AV16 17 "PercentageFlow_Request" ;
VAL_ 2621308417 SecurityByte_AV15 17 "PercentageFlow_Request" ;
VAL_ 2621308417 SecurityByte_AV14 17 "PercentageFlow_Request" ;
VAL_ 2621308417 SecurityByte_AV13 17 "PercentageFlow_Request" ;
VAL_ 2621308417 SecurityByte_AV12 17 "PercentageFlow_Request" ;
VAL_ 2621308417 SecurityByte_AV11 17 "PercentageFlow_Request" ;
VAL_ 2621308417 SecurityByte_AV10 17 "PercentageFlow_Request" ;
VAL_ 2621308417 SecurityByte_AV09 17 "PercentageFlow_Request" ;
VAL_ 2621308417 SecurityByte_AV08 17 "PercentageFlow_Request" ;
VAL_ 2621308417 SecurityByte_AV07 17 "PercentageFlow_Request" ;
VAL_ 2621308417 SecurityByte_AV06 17 "PercentageFlow_Request" ;
VAL_ 2621308417 SecurityByte_AV05 17 "PercentageFlow_Request" ;
VAL_ 2621308417 SecurityByte_AV04 17 "PercentageFlow_Request" ;
VAL_ 2621308417 SecurityByte_AV03 17 "PercentageFlow_Request" ;
VAL_ 2621308417 SecurityByte_AV02 17 "PercentageFlow_Request" ;
VAL_ 2621308417 SecurityByte_AV01 17 "PercentageFlow_Request" ;
VAL_ 2621308417 PositionRequest_RTL 64511 "ReadyToControl" 64509 "ReleaseControlReqOperatorAction" 64259 "ExtendUntilStopRequest" 64258 "RetractUntilStopRequest" 64257 "Stop" 64256 "Float" ;
VAL_ 2621308417 PositionRequest_FTL 64511 "ReadyToControl" 64509 "ReleaseControlReqOperatorAction" 64259 "ExtendUntilStopRequest" 64258 "RetractUntilStopRequest" 64257 "Stop" 64256 "Float" ;
VAL_ 2621308417 ControlMode1_VS 0 "GeneralParametrizationRequest" ;
VAL_ 2621308417 ControlMode1_RTL 0 "GeneralParametrizationRequest" ;
VAL_ 2621308417 ControlMode1_FTL 0 "GeneralParametrizationRequest" ;
VAL_ 2621308417 MsgType_RTL 17 "PercentagePosition_Request" 0 "Parametrization_Request" ;
VAL_ 2621308417 MsgType_FTL 17 "PercentagePosition_Request" 0 "Parametrization_Request" ;
VAL_ 2621308417 MsgType_EG 17 "Curvature_Request" ;
VAL_ 2621308417 MsgType_VS 17 "LinearMotion_Request" 0 "Parametrization_Request" ;
VAL_ 2621308417 MsgType_RH 17 "PercentagePosition_Request" ;
VAL_ 2621308417 MsgType_FH 17 "PercentagePosition_Request" ;
VAL_ 2621308417 MsgType_RPTO 17 "RotationalSpeed_Request" ;
VAL_ 2621308417 MsgType_FPTO 17 "RotationalSpeed_Request" ;
VAL_ 2621308417 MsgType_AV32 17 "PercentageFlow_Request" ;
VAL_ 2621308417 MsgType_AV31 17 "PercentageFlow_Request" ;
VAL_ 2621308417 MsgType_AV30 17 "PercentageFlow_Request" ;
VAL_ 2621308417 MsgType_AV29 17 "PercentageFlow_Request" ;
VAL_ 2621308417 MsgType_AV28 17 "PercentageFlow_Request" ;
VAL_ 2621308417 MsgType_AV27 17 "PercentageFlow_Request" ;
VAL_ 2621308417 MsgType_AV26 17 "PercentageFlow_Request" ;
VAL_ 2621308417 MsgType_AV25 17 "PercentageFlow_Request" ;
VAL_ 2621308417 MsgType_AV24 17 "PercentageFlow_Request" ;
VAL_ 2621308417 MsgType_AV23 17 "PercentageFlow_Request" ;
VAL_ 2621308417 MsgType_AV22 17 "PercentageFlow_Request" ;
VAL_ 2621308417 MsgType_AV21 17 "PercentageFlow_Request" ;
VAL_ 2621308417 MsgType_AV20 17 "PercentageFlow_Request" ;
VAL_ 2621308417 MsgType_AV19 17 "PercentageFlow_Request" ;
VAL_ 2621308417 MsgType_AV18 17 "PercentageFlow_Request" ;
VAL_ 2621308417 MsgType_AV17 17 "PercentageFlow_Request" ;
VAL_ 2621308417 MsgType_AV16 17 "PercentageFlow_Request" ;
VAL_ 2621308417 MsgType_AV15 17 "PercentageFlow_Request" ;
VAL_ 2621308417 MsgType_AV14 17 "PercentageFlow_Request" ;
VAL_ 2621308417 MsgType_AV13 17 "PercentageFlow_Request" ;
VAL_ 2621308417 MsgType_AV12 17 "PercentageFlow_Request" ;
VAL_ 2621308417 MsgType_AV11 17 "PercentageFlow_Request" ;
VAL_ 2621308417 MsgType_AV10 17 "PercentageFlow_Request" ;
VAL_ 2621308417 MsgType_AV09 17 "PercentageFlow_Request" ;
VAL_ 2621308417 MsgType_AV08 17 "PercentageFlow_Request" ;
VAL_ 2621308417 MsgType_AV07 17 "PercentageFlow_Request" ;
VAL_ 2621308417 MsgType_AV06 17 "PercentageFlow_Request" ;
VAL_ 2621308417 MsgType_AV05 17 "PercentageFlow_Request" ;
VAL_ 2621308417 MsgType_AV04 17 "PercentageFlow_Request" ;
VAL_ 2621308417 MsgType_AV03 17 "PercentageFlow_Request" ;
VAL_ 2621308417 MsgType_AV02 17 "PercentageFlow_Request" ;
VAL_ 2621308417 MsgType_AV01 17 "PercentageFlow_Request" ;
VAL_ 2621308417 TIMFunctionID 72 "RearTopLinkage" 71 "FrontTopLinkage" 32 "TIM_AuxValve32" 70 "ExternalGuidance" 68 "VehicleSpeed" 67 "RearHitch" 66 "FrontHitch" 65 "RearPTO" 64 "FrontPTO" 31 "TIM_AuxValve31" 30 "TIM_AuxValve30" 29 "TIM_AuxValve29" 28 "TIM_AuxValve28" 27 "TIM_AuxValve27" 26 "TIM_AuxValve26" 25 "TIM_AuxValve25" 24 "TIM_AuxValve24" 23 "TIM_AuxValve23" 22 "TIM_AuxValve22" 21 "TIM_AuxValve21" 20 "TIM_AuxValve20" 19 "TIM_AuxValve19" 18 "TIM_AuxValve18" 17 "TIM_AuxValve17" 16 "TIM_AuxValve16" 15 "TIM_AuxValve15" 14 "TIM_AuxValve14" 13 "TIM_AuxValve13" 12 "TIM_AuxValve12" 11 "TIM_AuxValve11" 10 "TIM_AuxValve10" 9 "TIM_AuxValve9" 8 "TIM_AuxValve8" 7 "TIM_AuxValve7" 6 "TIM_AuxValve6" 5 "TIM_AuxValve5" 4 "TIM_AuxValve4" 3 "TIM_AuxValve3" 2 "TIM_AuxValve2" 1 "TIM_AuxValve1" ;
VAL_ 2621308417 FlowRequest_AV32 64511 "ReadyToControl" 64509 "ReleasedControlRequestingOperatorActionBeforeFunctionValueIncreases" 64257 "Float" 64256 "ValveFullyOpened_Retract" 32128 "Block" 0 "ValveFullyOpened_Extend" ;
VAL_ 2621308417 FlowRequest_AV31 64511 "ReadyToControl" 64509 "ReleasedControlRequestingOperatorActionBeforeFunctionValueIncreases" 64257 "Float" 64256 "ValveFullyOpened_Retract" 32128 "Block" 0 "ValveFullyOpened_Extend" ;
VAL_ 2621308417 FlowRequest_AV30 64511 "ReadyToControl" 64509 "ReleasedControlRequestingOperatorActionBeforeFunctionValueIncreases" 64257 "Float" 64256 "ValveFullyOpened_Retract" 32128 "Block" 0 "ValveFullyOpened_Extend" ;
VAL_ 2621308417 FlowRequest_AV29 64511 "ReadyToControl" 64509 "ReleasedControlRequestingOperatorActionBeforeFunctionValueIncreases" 64257 "Float" 64256 "ValveFullyOpened_Retract" 32128 "Block" 0 "ValveFullyOpened_Extend" ;
VAL_ 2621308417 FlowRequest_AV28 64511 "ReadyToControl" 64509 "ReleasedControlRequestingOperatorActionBeforeFunctionValueIncreases" 64257 "Float" 64256 "ValveFullyOpened_Retract" 32128 "Block" 0 "ValveFullyOpened_Extend" ;
VAL_ 2621308417 FlowRequest_AV27 64511 "ReadyToControl" 64509 "ReleasedControlRequestingOperatorActionBeforeFunctionValueIncreases" 64257 "Float" 64256 "ValveFullyOpened_Retract" 32128 "Block" 0 "ValveFullyOpened_Extend" ;
VAL_ 2621308417 FlowRequest_AV26 64511 "ReadyToControl" 64509 "ReleasedControlRequestingOperatorActionBeforeFunctionValueIncreases" 64257 "Float" 64256 "ValveFullyOpened_Retract" 32128 "Block" 0 "ValveFullyOpened_Extend" ;
VAL_ 2621308417 FlowRequest_AV25 64511 "ReadyToControl" 64509 "ReleasedControlRequestingOperatorActionBeforeFunctionValueIncreases" 64257 "Float" 64256 "ValveFullyOpened_Retract" 32128 "Block" 0 "ValveFullyOpened_Extend" ;
VAL_ 2621308417 FlowRequest_AV24 64511 "ReadyToControl" 64509 "ReleasedControlRequestingOperatorActionBeforeFunctionValueIncreases" 64257 "Float" 64256 "ValveFullyOpened_Retract" 32128 "Block" 0 "ValveFullyOpened_Extend" ;
VAL_ 2621308417 FlowRequest_AV23 64511 "ReadyToControl" 64509 "ReleasedControlRequestingOperatorActionBeforeFunctionValueIncreases" 64257 "Float" 64256 "ValveFullyOpened_Retract" 32128 "Block" 0 "ValveFullyOpened_Extend" ;
VAL_ 2621308417 FlowRequest_AV22 64511 "ReadyToControl" 64509 "ReleasedControlRequestingOperatorActionBeforeFunctionValueIncreases" 64257 "Float" 64256 "ValveFullyOpened_Retract" 32128 "Block" 0 "ValveFullyOpened_Extend" ;
VAL_ 2621308417 FlowRequest_AV21 64511 "ReadyToControl" 64509 "ReleasedControlRequestingOperatorActionBeforeFunctionValueIncreases" 64257 "Float" 64256 "ValveFullyOpened_Retract" 32128 "Block" 0 "ValveFullyOpened_Extend" ;
VAL_ 2621308417 FlowRequest_AV20 64511 "ReadyToControl" 64509 "ReleasedControlRequestingOperatorActionBeforeFunctionValueIncreases" 64257 "Float" 64256 "ValveFullyOpened_Retract" 32128 "Block" 0 "ValveFullyOpened_Extend" ;
VAL_ 2621308417 FlowRequest_AV19 64511 "ReadyToControl" 64509 "ReleasedControlRequestingOperatorActionBeforeFunctionValueIncreases" 64257 "Float" 64256 "ValveFullyOpened_Retract" 32128 "Block" 0 "ValveFullyOpened_Extend" ;
VAL_ 2621308417 FlowRequest_AV18 64511 "ReadyToControl" 64509 "ReleasedControlRequestingOperatorActionBeforeFunctionValueIncreases" 64257 "Float" 64256 "ValveFullyOpened_Retract" 32128 "Block" 0 "ValveFullyOpened_Extend" ;
VAL_ 2621308417 FlowRequest_AV17 64511 "ReadyToControl" 64509 "ReleasedControlRequestingOperatorActionBeforeFunctionValueIncreases" 64257 "Float" 64256 "ValveFullyOpened_Retract" 32128 "Block" 0 "ValveFullyOpened_Extend" ;
VAL_ 2621308417 FlowRequest_AV16 64511 "ReadyToControl" 64509 "ReleasedControlRequestingOperatorActionBeforeFunctionValueIncreases" 64257 "Float" 64256 "ValveFullyOpened_Retract" 32128 "Block" 0 "ValveFullyOpened_Extend" ;
VAL_ 2621308417 FlowRequest_AV15 64511 "ReadyToControl" 64509 "ReleasedControlRequestingOperatorActionBeforeFunctionValueIncreases" 64257 "Float" 64256 "ValveFullyOpened_Retract" 32128 "Block" 0 "ValveFullyOpened_Extend" ;
VAL_ 2621308417 FlowRequest_AV14 64511 "ReadyToControl" 64509 "ReleasedControlRequestingOperatorActionBeforeFunctionValueIncreases" 64257 "Float" 64256 "ValveFullyOpened_Retract" 32128 "Block" 0 "ValveFullyOpened_Extend" ;
VAL_ 2621308417 FlowRequest_AV13 64511 "ReadyToControl" 64509 "ReleasedControlRequestingOperatorActionBeforeFunctionValueIncreases" 64257 "Float" 64256 "ValveFullyOpened_Retract" 32128 "Block" 0 "ValveFullyOpened_Extend" ;
VAL_ 2621308417 FlowRequest_AV12 64511 "ReadyToControl" 64509 "ReleasedControlRequestingOperatorActionBeforeFunctionValueIncreases" 64257 "Float" 64256 "ValveFullyOpened_Retract" 32128 "Block" 0 "ValveFullyOpened_Extend" ;
VAL_ 2621308417 FlowRequest_AV11 64511 "ReadyToControl" 64509 "ReleasedControlRequestingOperatorActionBeforeFunctionValueIncreases" 64257 "Float" 64256 "ValveFullyOpened_Retract" 32128 "Block" 0 "ValveFullyOpened_Extend" ;
VAL_ 2621308417 FlowRequest_AV10 64511 "ReadyToControl" 64509 "ReleasedControlRequestingOperatorActionBeforeFunctionValueIncreases" 64257 "Float" 64256 "ValveFullyOpened_Retract" 32128 "Block" 0 "ValveFullyOpened_Extend" ;
VAL_ 2621308417 FlowRequest_AV09 64511 "ReadyToControl" 64509 "ReleasedControlRequestingOperatorActionBeforeFunctionValueIncreases" 64257 "Float" 64256 "ValveFullyOpened_Retract" 32128 "Block" 0 "ValveFullyOpened_Extend" ;
VAL_ 2621308417 FlowRequest_AV08 64511 "ReadyToControl" 64509 "ReleasedControlRequestingOperatorActionBeforeFunctionValueIncreases" 64257 "Float" 64256 "ValveFullyOpened_Retract" 32128 "Block" 0 "ValveFullyOpened_Extend" ;
VAL_ 2621308417 FlowRequest_AV07 64511 "ReadyToControl" 64509 "ReleasedControlRequestingOperatorActionBeforeFunctionValueIncreases" 64257 "Float" 64256 "ValveFullyOpened_Retract" 32128 "Block" 0 "ValveFullyOpened_Extend" ;
VAL_ 2621308417 FlowRequest_AV06 64511 "ReadyToControl" 64509 "ReleasedControlRequestingOperatorActionBeforeFunctionValueIncreases" 64257 "Float" 64256 "ValveFullyOpened_Retract" 32128 "Block" 0 "ValveFullyOpened_Extend" ;
VAL_ 2621308417 FlowRequest_AV05 64511 "ReadyToControl" 64509 "ReleasedControlRequestingOperatorActionBeforeFunctionValueIncreases" 64257 "Float" 64256 "ValveFullyOpened_Retract" 32128 "Block" 0 "ValveFullyOpened_Extend" ;
VAL_ 2621308417 FlowRequest_AV04 64511 "ReadyToControl" 64509 "ReleasedControlRequestingOperatorActionBeforeFunctionValueIncreases" 64257 "Float" 64256 "ValveFullyOpened_Retract" 32128 "Block" 0 "ValveFullyOpened_Extend" ;
VAL_ 2621308417 FlowRequest_AV03 64511 "ReadyToControl" 64509 "ReleasedControlRequestingOperatorActionBeforeFunctionValueIncreases" 64257 "Float" 64256 "ValveFullyOpened_Retract" 32128 "Block" 0 "ValveFullyOpened_Extend" ;
VAL_ 2621308417 FlowRequest_AV02 64511 "ReadyToControl" 64509 "ReleasedControlRequestingOperatorActionBeforeFunctionValueIncreases" 64257 "Float" 64256 "ValveFullyOpened_Retract" 32128 "Block" 0 "ValveFullyOpened_Extend" ;
VAL_ 2621308417 PositionRequest_RH 10000 "FullRaise" 64259 "RaiseUntilStopRequest" 64258 "LowerUntilStopRequest" 0 "FullLower" 64511 "ReadyToControl" 64509 "ReleaseControlRequestingOperatorAction" 64257 "Stop" 64256 "Float" ;
VAL_ 2621308417 OutputShaftSpeedRequest_RPTO 64511 "ReadyToControl" 64509 "RequestingOperatorAction" 64256 "On_SpeedClockwiseSetByTimServer" 32128 "Off" 0 "On_SpeedCounterClockwiseSetByTimServer" ;
VAL_ 2621308417 CurvatureRequest_EG 64511 "ReadyToControl" 64509 "RequestingOperatorAwareness" 32128 "Straight" ;
VAL_ 2621308417 VehicleSpeedRequest_VS 64511 "ReadyToControl" 64510 "AcceptFunctionWithoutOperatorAwareness" 64509 "RequestingOperatorAwareness" 64256 "ForwardSpeedSetByTimServer" 32128 "Stop" 0 "ReverseSpeedSetByTimServer" ;
VAL_ 2621308417 PositionRequest_FH 10000 "FullRaise" 64259 "RaiseUntilStopRequest" 64258 "LowerUntilStopRequest" 0 "FullLower" 64511 "ReadyToControl" 64509 "ReleaseControlRequestingOperatorAction" 64257 "Stop" 64256 "Float" ;
VAL_ 2621308417 OutputShaftSpeedRequest_FPTO 64511 "ReadyToControl" 64509 "RequestingOperatorAction" 64256 "On_SpeedClockwiseSetByTimServer" 32128 "Off" 0 "On_SpeedCounterClockwiseSetByTimServer" ;
VAL_ 2621308417 FlowRequest_AV01 64511 "ReadyToControl" 64509 "ReleasedControlRequestingOperatorActionBeforeFunctionValueIncreases" 64257 "Float" 64256 "ValveFullyOpened_Retract" 32128 "Block" 0 "ValveFullyOpened_Extend" ;
VAL_ 2619670019 RequestCounterAuxValve32 15 "NotAvailable_DontCare " 14 "Reserved" ;
VAL_ 2619670019 RequestCounterAuxValve31 15 "NotAvailable_DontCare " 14 "Reserved" ;
VAL_ 2619670019 RequestCounterAuxValve30 15 "NotAvailable_DontCare " 14 "Reserved" ;
VAL_ 2619670019 RequestCounterAuxValve29 15 "NotAvailable_DontCare " 14 "Reserved" ;
VAL_ 2619670019 RequestCounterAuxValve28 15 "NotAvailable_DontCare " 14 "Reserved" ;
VAL_ 2619670019 RequestCounterAuxValve27 15 "NotAvailable_DontCare " 14 "Reserved" ;
VAL_ 2619670019 RequestCounterAuxValve26 15 "NotAvailable_DontCare " 14 "Reserved" ;
VAL_ 2619670019 RequestCounterAuxValve25 15 "NotAvailable_DontCare " 14 "Reserved" ;
VAL_ 2619670019 RequestCounterAuxValve24 15 "NotAvailable_DontCare " 14 "Reserved" ;
VAL_ 2619670019 RequestCounterAuxValve23 15 "NotAvailable_DontCare " 14 "Reserved" ;
VAL_ 2619670019 RequestCounterAuxValve22 15 "NotAvailable_DontCare " 14 "Reserved" ;
VAL_ 2619670019 RequestCounterAuxValve21 15 "NotAvailable_DontCare " 14 "Reserved" ;
VAL_ 2619670019 RequestCounterAuxValve20 15 "NotAvailable_DontCare " 14 "Reserved" ;
VAL_ 2619670019 RequestCounterAuxValve19 15 "NotAvailable_DontCare " 14 "Reserved" ;
VAL_ 2619670019 RequestCounterAuxValve18 15 "NotAvailable_DontCare " 14 "Reserved" ;
VAL_ 2619670019 RequestCounterAuxValve17 15 "NotAvailable_DontCare " 14 "Reserved" ;
VAL_ 2619670019 RequestCounterAuxValve16 15 "NotAvailable_DontCare " 14 "Reserved" ;
VAL_ 2619670019 RequestCounterAuxValve15 15 "NotAvailable_DontCare " 14 "Reserved" ;
VAL_ 2619670019 RequestCounterAuxValve14 15 "NotAvailable_DontCare " 14 "Reserved" ;
VAL_ 2619670019 RequestCounterAuxValve13 15 "NotAvailable_DontCare " 14 "Reserved" ;
VAL_ 2619670019 RequestCounterAuxValve12 15 "NotAvailable_DontCare " 14 "Reserved" ;
VAL_ 2619670019 RequestCounterAuxValve11 15 "NotAvailable_DontCare " 14 "Reserved" ;
VAL_ 2619670019 RequestCounterAuxValve10 15 "NotAvailable_DontCare " 14 "Reserved" ;
VAL_ 2619670019 RequestCounterAuxValve09 15 "NotAvailable_DontCare " 14 "Reserved" ;
VAL_ 2619670019 RequestCounterAuxValve08 15 "NotAvailable_DontCare " 14 "Reserved" ;
VAL_ 2619670019 RequestCounterAuxValve07 15 "NotAvailable_DontCare " 14 "Reserved" ;
VAL_ 2619670019 RequestCounterAuxValve06 15 "NotAvailable_DontCare " 14 "Reserved" ;
VAL_ 2619670019 RequestCounterAuxValve05 15 "NotAvailable_DontCare " 14 "Reserved" ;
VAL_ 2619670019 RequestCounterAuxValve04 15 "NotAvailable_DontCare " 14 "Reserved" ;
VAL_ 2619670019 RequestCounterAuxValve03 15 "NotAvailable_DontCare " 14 "Reserved" ;
VAL_ 2619670019 RequestCounterAuxValve02 15 "NotAvailable_DontCare " 14 "Reserved" ;
VAL_ 2619670019 RequestCounterAuxValve01 15 "NotAvailable_DontCare " 14 "Reserved" ;
VAL_ 2619670019 RequestCounterVehicleSpeed 15 "NotAvailable_DontCare " 14 "Reserved" ;
VAL_ 2619670019 RequestCounterRearHitch 15 "NotAvailable_DontCare " 14 "Reserved" ;
VAL_ 2619670019 RequestCounterFrontHitch 15 "NotAvailable_DontCare " 14 "Reserved" ;
VAL_ 2619670019 RequestCounterRearPTO 15 "NotAvailable_DontCare " 14 "Reserved" ;
VAL_ 2619670019 RequestCounterFrontPTO 15 "NotAvailable_DontCare " 14 "Reserved" ;
VAL_ 2619670019 RequestCounterExternalGuidance 15 "NotAvailable_DontCare " 14 "Reserved" ;
VAL_ 2619670019 FlowRequest_AV32 64511 "ReadyToControl" 64509 "ReleasedControlRequestingOperatorActionBeforeFunctionValueIncreases" 64257 "Float" 64256 "ValveFullyOpened_Retract" 32128 "Block" 0 "ValveFullyOpened_Extend" ;
VAL_ 2619670019 FlowRequest_AV31 64511 "ReadyToControl" 64509 "ReleasedControlRequestingOperatorActionBeforeFunctionValueIncreases" 64257 "Float" 64256 "ValveFullyOpened_Retract" 32128 "Block" 0 "ValveFullyOpened_Extend" ;
VAL_ 2619670019 FlowRequest_AV30 64511 "ReadyToControl" 64509 "ReleasedControlRequestingOperatorActionBeforeFunctionValueIncreases" 64257 "Float" 64256 "ValveFullyOpened_Retract" 32128 "Block" 0 "ValveFullyOpened_Extend" ;
VAL_ 2619670019 FlowRequest_AV29 64511 "ReadyToControl" 64509 "ReleasedControlRequestingOperatorActionBeforeFunctionValueIncreases" 64257 "Float" 64256 "ValveFullyOpened_Retract" 32128 "Block" 0 "ValveFullyOpened_Extend" ;
VAL_ 2619670019 FlowRequest_AV28 64511 "ReadyToControl" 64509 "ReleasedControlRequestingOperatorActionBeforeFunctionValueIncreases" 64257 "Float" 64256 "ValveFullyOpened_Retract" 32128 "Block" 0 "ValveFullyOpened_Extend" ;
VAL_ 2619670019 FlowRequest_AV27 64511 "ReadyToControl" 64509 "ReleasedControlRequestingOperatorActionBeforeFunctionValueIncreases" 64257 "Float" 64256 "ValveFullyOpened_Retract" 32128 "Block" 0 "ValveFullyOpened_Extend" ;
VAL_ 2619670019 FlowRequest_AV26 64511 "ReadyToControl" 64509 "ReleasedControlRequestingOperatorActionBeforeFunctionValueIncreases" 64257 "Float" 64256 "ValveFullyOpened_Retract" 32128 "Block" 0 "ValveFullyOpened_Extend" ;
VAL_ 2619670019 FlowRequest_AV25 64511 "ReadyToControl" 64509 "ReleasedControlRequestingOperatorActionBeforeFunctionValueIncreases" 64257 "Float" 64256 "ValveFullyOpened_Retract" 32128 "Block" 0 "ValveFullyOpened_Extend" ;
VAL_ 2619670019 FlowRequest_AV24 64511 "ReadyToControl" 64509 "ReleasedControlRequestingOperatorActionBeforeFunctionValueIncreases" 64257 "Float" 64256 "ValveFullyOpened_Retract" 32128 "Block" 0 "ValveFullyOpened_Extend" ;
VAL_ 2619670019 FlowRequest_AV23 64511 "ReadyToControl" 64509 "ReleasedControlRequestingOperatorActionBeforeFunctionValueIncreases" 64257 "Float" 64256 "ValveFullyOpened_Retract" 32128 "Block" 0 "ValveFullyOpened_Extend" ;
VAL_ 2619670019 FlowRequest_AV22 64511 "ReadyToControl" 64509 "ReleasedControlRequestingOperatorActionBeforeFunctionValueIncreases" 64257 "Float" 64256 "ValveFullyOpened_Retract" 32128 "Block" 0 "ValveFullyOpened_Extend" ;
VAL_ 2619670019 FlowRequest_AV21 64511 "ReadyToControl" 64509 "ReleasedControlRequestingOperatorActionBeforeFunctionValueIncreases" 64257 "Float" 64256 "ValveFullyOpened_Retract" 32128 "Block" 0 "ValveFullyOpened_Extend" ;
VAL_ 2619670019 FlowRequest_AV20 64511 "ReadyToControl" 64509 "ReleasedControlRequestingOperatorActionBeforeFunctionValueIncreases" 64257 "Float" 64256 "ValveFullyOpened_Retract" 32128 "Block" 0 "ValveFullyOpened_Extend" ;
VAL_ 2619670019 FlowRequest_AV19 64511 "ReadyToControl" 64509 "ReleasedControlRequestingOperatorActionBeforeFunctionValueIncreases" 64257 "Float" 64256 "ValveFullyOpened_Retract" 32128 "Block" 0 "ValveFullyOpened_Extend" ;
VAL_ 2619670019 FlowRequest_AV18 64511 "ReadyToControl" 64509 "ReleasedControlRequestingOperatorActionBeforeFunctionValueIncreases" 64257 "Float" 64256 "ValveFullyOpened_Retract" 32128 "Block" 0 "ValveFullyOpened_Extend" ;
VAL_ 2619670019 FlowRequest_AV17 64511 "ReadyToControl" 64509 "ReleasedControlRequestingOperatorActionBeforeFunctionValueIncreases" 64257 "Float" 64256 "ValveFullyOpened_Retract" 32128 "Block" 0 "ValveFullyOpened_Extend" ;
VAL_ 2619670019 FlowRequest_AV16 64511 "ReadyToControl" 64509 "ReleasedControlRequestingOperatorActionBeforeFunctionValueIncreases" 64257 "Float" 64256 "ValveFullyOpened_Retract" 32128 "Block" 0 "ValveFullyOpened_Extend" ;
VAL_ 2619670019 FlowRequest_AV15 64511 "ReadyToControl" 64509 "ReleasedControlRequestingOperatorActionBeforeFunctionValueIncreases" 64257 "Float" 64256 "ValveFullyOpened_Retract" 32128 "Block" 0 "ValveFullyOpened_Extend" ;
VAL_ 2619670019 FlowRequest_AV14 64511 "ReadyToControl" 64509 "ReleasedControlRequestingOperatorActionBeforeFunctionValueIncreases" 64257 "Float" 64256 "ValveFullyOpened_Retract" 32128 "Block" 0 "ValveFullyOpened_Extend" ;
VAL_ 2619670019 FlowRequest_AV13 64511 "ReadyToControl" 64509 "ReleasedControlRequestingOperatorActionBeforeFunctionValueIncreases" 64257 "Float" 64256 "ValveFullyOpened_Retract" 32128 "Block" 0 "ValveFullyOpened_Extend" ;
VAL_ 2619670019 FlowRequest_AV12 64511 "ReadyToControl" 64509 "ReleasedControlRequestingOperatorActionBeforeFunctionValueIncreases" 64257 "Float" 64256 "ValveFullyOpened_Retract" 32128 "Block" 0 "ValveFullyOpened_Extend" ;
VAL_ 2619670019 FlowRequest_AV11 64511 "ReadyToControl" 64509 "ReleasedControlRequestingOperatorActionBeforeFunctionValueIncreases" 64257 "Float" 64256 "ValveFullyOpened_Retract" 32128 "Block" 0 "ValveFullyOpened_Extend" ;
VAL_ 2619670019 FlowRequest_AV10 64511 "ReadyToControl" 64509 "ReleasedControlRequestingOperatorActionBeforeFunctionValueIncreases" 64257 "Float" 64256 "ValveFullyOpened_Retract" 32128 "Block" 0 "ValveFullyOpened_Extend" ;
VAL_ 2619670019 FlowRequest_AV09 64511 "ReadyToControl" 64509 "ReleasedControlRequestingOperatorActionBeforeFunctionValueIncreases" 64257 "Float" 64256 "ValveFullyOpened_Retract" 32128 "Block" 0 "ValveFullyOpened_Extend" ;
VAL_ 2619670019 FlowRequest_AV08 64511 "ReadyToControl" 64509 "ReleasedControlRequestingOperatorActionBeforeFunctionValueIncreases" 64257 "Float" 64256 "ValveFullyOpened_Retract" 32128 "Block" 0 "ValveFullyOpened_Extend" ;
VAL_ 2619670019 FlowRequest_AV07 64511 "ReadyToControl" 64509 "ReleasedControlRequestingOperatorActionBeforeFunctionValueIncreases" 64257 "Float" 64256 "ValveFullyOpened_Retract" 32128 "Block" 0 "ValveFullyOpened_Extend" ;
VAL_ 2619670019 FlowRequest_AV06 64511 "ReadyToControl" 64509 "ReleasedControlRequestingOperatorActionBeforeFunctionValueIncreases" 64257 "Float" 64256 "ValveFullyOpened_Retract" 32128 "Block" 0 "ValveFullyOpened_Extend" ;
VAL_ 2619670019 FlowRequest_AV05 64511 "ReadyToControl" 64509 "ReleasedControlRequestingOperatorActionBeforeFunctionValueIncreases" 64257 "Float" 64256 "ValveFullyOpened_Retract" 32128 "Block" 0 "ValveFullyOpened_Extend" ;
VAL_ 2619670019 FlowRequest_AV04 64511 "ReadyToControl" 64509 "ReleasedControlRequestingOperatorActionBeforeFunctionValueIncreases" 64257 "Float" 64256 "ValveFullyOpened_Retract" 32128 "Block" 0 "ValveFullyOpened_Extend" ;
VAL_ 2619670019 FlowRequest_AV03 64511 "ReadyToControl" 64509 "ReleasedControlRequestingOperatorActionBeforeFunctionValueIncreases" 64257 "Float" 64256 "ValveFullyOpened_Retract" 32128 "Block" 0 "ValveFullyOpened_Extend" ;
VAL_ 2619670019 FlowRequest_AV02 64511 "ReadyToControl" 64509 "ReleasedControlRequestingOperatorActionBeforeFunctionValueIncreases" 64257 "Float" 64256 "ValveFullyOpened_Retract" 32128 "Block" 0 "ValveFullyOpened_Extend" ;
VAL_ 2619670019 RearHitchPosRequest 10000 "FullRaise" 64259 "RaiseUntilStopRequest" 64258 "LowerUntilStopRequest" 0 "FullLower" 64511 "ReadyToControl" 64509 "ReleaseControlRequestingOperatorAction" 64257 "Stop" 64256 "Float" ;
VAL_ 2619670019 RearPTOSpeedRequest 64511 "ReadyToControl" 64509 "RequestingOperatorAction" 64256 "On_SpeedClockwiseSetByTimServer" 32128 "Off" 0 "On_SpeedCounterClockwiseSetByTimServer" ;
VAL_ 2619670019 CurvatureRequest 64511 "ReadyToControl" 64509 "RequestingOperatorAwareness" 32128 "Straight" ;
VAL_ 2619670019 VehicleSpeedRequest 64511 "ReadyToControl" 64510 "AcceptFunctionWithoutOperatorAwareness" 64509 "RequestingOperatorAwareness" 64256 "ForwardSpeedSetByTimServer" 32128 "Stop" 0 "ReverseSpeedSetByTimServer" ;
VAL_ 2619670019 FrontHitchPosRequest 10000 "FullRaise" 64259 "RaiseUntilStopRequest" 64258 "LowerUntilStopRequest" 0 "FullLower" 64511 "ReadyToControl" 64509 "ReleaseControlRequestingOperatorAction" 64257 "Stop" 64256 "Float" ;
VAL_ 2619670019 FrontPTOSpeedRequest 64511 "ReadyToControl" 64509 "RequestingOperatorAction" 64256 "On_SpeedClockwiseSetByTimServer" 32128 "Off" 0 "On_SpeedCounterClockwiseSetByTimServer" ;
VAL_ 2619670019 FlowRequest_AV01 65535 "NotAvailable" 65534 "Error" 64511 "ReadyToControl" 64509 "ReleasedControlRequestingOperatorActionBeforeFunctionValueIncreases" 64257 "Float" 64256 "ValveFullyOpened_Retract" 32128 "Block" 0 "ValveFullyOpened_Extend" ;
VAL_ 2619670019 TIMClientState 13 "AutomationFault" 5 "AutomationActive" 15 "NotAvailable" 14 "Error" 3 "AutomationEnabled" 2 "AutomationReadyToEnable" 1 "AutomationNotReady" 0 "AutomationUnavailable" ;
VAL_ 2619670019 ClientHeartbeatCounter 255 "GracefulShutdown" 254 "ErrorConditionOnSender" 251 "ResetOfHeartbeatCounter" ;
VAL_ 2619670019 TIMFunctionId_4 72 "RearTopLinkage" 71 "FrontTopLinkage" 32 "AuxValve32" 70 "ExternalGuidance" 68 "VehicleSpeed" 67 "RearHitch" 66 "FrontHitch" 65 "RearPTO" 64 "FrontPTO" 31 "AuxValve31" 30 "AuxValve30" 29 "AuxValve29" 28 "AuxValve28" 27 "AuxValve27" 26 "AuxValve26" 25 "AuxValve25" 24 "AuxValve24" 23 "AuxValve23" 22 "AuxValve22" 21 "AuxValve21" 20 "AuxValve20" 19 "AuxValve19" 18 "AuxValve18" 17 "AuxValve17" 16 "AuxValve16" 15 "AuxValve15" 14 "AuxValve14" 13 "AuxValve13" 12 "AuxValve12" 11 "AuxValve11" 10 "AuxValve10" 9 "AuxValve9" 8 "AuxValve8" 7 "AuxValve7" 6 "AuxValve6" 5 "AuxValve5" 4 "AuxValve4" 3 "AuxValve3" 2 "AuxValve2" 1 "AuxValve1" ;
VAL_ 2619670019 TIMFunctionId_3 72 "RearTopLinkage" 71 "FrontTopLinkage" 32 "AuxValve32" 70 "ExternalGuidance" 68 "VehicleSpeed" 67 "RearHitch" 66 "FrontHitch" 65 "RearPTO" 64 "FrontPTO" 31 "AuxValve31" 30 "AuxValve30" 29 "AuxValve29" 28 "AuxValve28" 27 "AuxValve27" 26 "AuxValve26" 25 "AuxValve25" 24 "AuxValve24" 23 "AuxValve23" 22 "AuxValve22" 21 "AuxValve21" 20 "AuxValve20" 19 "AuxValve19" 18 "AuxValve18" 17 "AuxValve17" 16 "AuxValve16" 15 "AuxValve15" 14 "AuxValve14" 13 "AuxValve13" 12 "AuxValve12" 11 "AuxValve11" 10 "AuxValve10" 9 "AuxValve9" 8 "AuxValve8" 7 "AuxValve7" 6 "AuxValve6" 5 "AuxValve5" 4 "AuxValve4" 3 "AuxValve3" 2 "AuxValve2" 1 "AuxValve1" ;
VAL_ 2619670019 TIMFunctionId_2 72 "RearTopLinkage" 71 "FrontTopLinkage" 32 "AuxValve32" 70 "ExternalGuidance" 68 "VehicleSpeed" 67 "RearHitch" 66 "FrontHitch" 65 "RearPTO" 64 "FrontPTO" 31 "AuxValve31" 30 "AuxValve30" 29 "AuxValve29" 28 "AuxValve28" 27 "AuxValve27" 26 "AuxValve26" 25 "AuxValve25" 24 "AuxValve24" 23 "AuxValve23" 22 "AuxValve22" 21 "AuxValve21" 20 "AuxValve20" 19 "AuxValve19" 18 "AuxValve18" 17 "AuxValve17" 16 "AuxValve16" 15 "AuxValve15" 14 "AuxValve14" 13 "AuxValve13" 12 "AuxValve12" 11 "AuxValve11" 10 "AuxValve10" 9 "AuxValve9" 8 "AuxValve8" 7 "AuxValve7" 6 "AuxValve6" 5 "AuxValve5" 4 "AuxValve4" 3 "AuxValve3" 2 "AuxValve2" 1 "AuxValve1" ;
VAL_ 2619670019 TIMFunctionId_1 72 "RearTopLinkage" 71 "FrontTopLinkage" 32 "AuxValve32" 70 "ExternalGuidance" 68 "VehicleSpeed" 67 "RearHitch" 66 "FrontHitch" 65 "RearPTO" 64 "FrontPTO" 31 "AuxValve31" 30 "AuxValve30" 29 "AuxValve29" 28 "AuxValve28" 27 "AuxValve27" 26 "AuxValve26" 25 "AuxValve25" 24 "AuxValve24" 23 "AuxValve23" 22 "AuxValve22" 21 "AuxValve21" 20 "AuxValve20" 19 "AuxValve19" 18 "AuxValve18" 17 "AuxValve17" 16 "AuxValve16" 15 "AuxValve15" 14 "AuxValve14" 13 "AuxValve13" 12 "AuxValve12" 11 "AuxValve11" 10 "AuxValve10" 9 "AuxValve9" 8 "AuxValve8" 7 "AuxValve7" 6 "AuxValve6" 5 "AuxValve5" 4 "AuxValve4" 3 "AuxValve3" 2 "AuxValve2" 1 "AuxValve1" ;
VAL_ 2619670019 RequestType_4 7 "DontCare" 6 "Error" 1 "AssignToRequestingClient" 0 "ReleaseAssignmentOfRequestingClient" ;
VAL_ 2619670019 RequestType_3 7 "DontCare" 6 "Error" 1 "AssignToRequestingClient" 0 "ReleaseAssignmentOfRequestingClient" ;
VAL_ 2619670019 RequestType_2 7 "DontCare" 6 "Error" 1 "AssignToRequestingClient" 0 "ReleaseAssignmentOfRequestingClient" ;
VAL_ 2619670019 RequestType_1 7 "DontCare" 6 "Error" 1 "AssignToRequestingClient" 0 "ReleaseAssignmentOfRequestingClient" ;
VAL_ 2619670019 TIMMessageType 1 "TIMFunctionStatus" 0 "TIMFunctionRequest" ;
VAL_ 2619670019 GroupFunctionValue 32 "TIM_AuxValve32Request" 249 "ClientStatus" 248 "ServerVersionRequest" 247 "ClientVersionResponse" 246 "ConnectionVersionRequest" 245 "FunctionsAssignmentRequest" 244 "FunctionsSupportRequest" 243 "FunctionsAssignmentStatusRequest" 70 "ExternalGuidanceRequest" 68 "VehicleSpeedRequest" 67 "RearHitchRequest" 66 "FrontHitchRequest" 65 "RearPTORequest" 64 "FrontPTORequest" 31 "TIM_AuxValve31Request" 30 "TIM_AuxValve30Request" 29 "TIM_AuxValve29Request" 28 "TIM_AuxValve28Request" 27 "TIM_AuxValve27Request" 26 "TIM_AuxValve26Request" 25 "TIM_AuxValve25Request" 24 "TIM_AuxValve24Request" 23 "TIM_AuxValve23Request" 22 "TIM_AuxValve22Request" 21 "TIM_AuxValve21Request" 20 "TIM_AuxValve20Request" 19 "TIM_AuxValve19Request" 18 "TIM_AuxValve18Request" 17 "TIM_AuxValve17Request" 16 "TIM_AuxValve16Request" 15 "TIM_AuxValve15Request" 14 "TIM_AuxValve14Request" 13 "TIM_AuxValve13Request" 12 "TIM_AuxValve12Request" 11 "TIM_AuxValve11Request" 10 "TIM_AuxValve10Request" 9 "TIM_AuxValve9Request" 8 "TIM_AuxValve8Request" 7 "TIM_AuxValve7Request" 6 "TIM_AuxValve6Request" 5 "TIM_AuxValve5Request" 4 "TIM_AuxValve4Request" 3 "TIM_AuxValve3Request" 2 "TIM_AuxValve2Request" 1 "TIM_AuxValve1Request" ;
VAL_ 2619670018 RequestCounterAuxValve32 15 "NotAvailable_DontCare " 14 "Reserved" ;
VAL_ 2619670018 RequestCounterAuxValve31 15 "NotAvailable_DontCare " 14 "Reserved" ;
VAL_ 2619670018 RequestCounterAuxValve30 15 "NotAvailable_DontCare " 14 "Reserved" ;
VAL_ 2619670018 RequestCounterAuxValve29 15 "NotAvailable_DontCare " 14 "Reserved" ;
VAL_ 2619670018 RequestCounterAuxValve28 15 "NotAvailable_DontCare " 14 "Reserved" ;
VAL_ 2619670018 RequestCounterAuxValve27 15 "NotAvailable_DontCare " 14 "Reserved" ;
VAL_ 2619670018 RequestCounterAuxValve26 15 "NotAvailable_DontCare " 14 "Reserved" ;
VAL_ 2619670018 RequestCounterAuxValve25 15 "NotAvailable_DontCare " 14 "Reserved" ;
VAL_ 2619670018 RequestCounterAuxValve24 15 "NotAvailable_DontCare " 14 "Reserved" ;
VAL_ 2619670018 RequestCounterAuxValve23 15 "NotAvailable_DontCare " 14 "Reserved" ;
VAL_ 2619670018 RequestCounterAuxValve22 15 "NotAvailable_DontCare " 14 "Reserved" ;
VAL_ 2619670018 RequestCounterAuxValve21 15 "NotAvailable_DontCare " 14 "Reserved" ;
VAL_ 2619670018 RequestCounterAuxValve20 15 "NotAvailable_DontCare " 14 "Reserved" ;
VAL_ 2619670018 RequestCounterAuxValve19 15 "NotAvailable_DontCare " 14 "Reserved" ;
VAL_ 2619670018 RequestCounterAuxValve18 15 "NotAvailable_DontCare " 14 "Reserved" ;
VAL_ 2619670018 RequestCounterAuxValve17 15 "NotAvailable_DontCare " 14 "Reserved" ;
VAL_ 2619670018 RequestCounterAuxValve16 15 "NotAvailable_DontCare " 14 "Reserved" ;
VAL_ 2619670018 RequestCounterAuxValve15 15 "NotAvailable_DontCare " 14 "Reserved" ;
VAL_ 2619670018 RequestCounterAuxValve14 15 "NotAvailable_DontCare " 14 "Reserved" ;
VAL_ 2619670018 RequestCounterAuxValve13 15 "NotAvailable_DontCare " 14 "Reserved" ;
VAL_ 2619670018 RequestCounterAuxValve12 15 "NotAvailable_DontCare " 14 "Reserved" ;
VAL_ 2619670018 RequestCounterAuxValve11 15 "NotAvailable_DontCare " 14 "Reserved" ;
VAL_ 2619670018 RequestCounterAuxValve10 15 "NotAvailable_DontCare " 14 "Reserved" ;
VAL_ 2619670018 RequestCounterAuxValve09 15 "NotAvailable_DontCare " 14 "Reserved" ;
VAL_ 2619670018 RequestCounterAuxValve08 15 "NotAvailable_DontCare " 14 "Reserved" ;
VAL_ 2619670018 RequestCounterAuxValve07 15 "NotAvailable_DontCare " 14 "Reserved" ;
VAL_ 2619670018 RequestCounterAuxValve06 15 "NotAvailable_DontCare " 14 "Reserved" ;
VAL_ 2619670018 RequestCounterAuxValve05 15 "NotAvailable_DontCare " 14 "Reserved" ;
VAL_ 2619670018 RequestCounterAuxValve04 15 "NotAvailable_DontCare " 14 "Reserved" ;
VAL_ 2619670018 RequestCounterAuxValve03 15 "NotAvailable_DontCare " 14 "Reserved" ;
VAL_ 2619670018 RequestCounterAuxValve02 15 "NotAvailable_DontCare " 14 "Reserved" ;
VAL_ 2619670018 RequestCounterAuxValve01 15 "NotAvailable_DontCare " 14 "Reserved" ;
VAL_ 2619670018 RequestCounterVehicleSpeed 15 "NotAvailable_DontCare " 14 "Reserved" ;
VAL_ 2619670018 RequestCounterRearHitch 15 "NotAvailable_DontCare " 14 "Reserved" ;
VAL_ 2619670018 RequestCounterFrontHitch 15 "NotAvailable_DontCare " 14 "Reserved" ;
VAL_ 2619670018 RequestCounterRearPTO 15 "NotAvailable_DontCare " 14 "Reserved" ;
VAL_ 2619670018 RequestCounterFrontPTO 15 "NotAvailable_DontCare " 14 "Reserved" ;
VAL_ 2619670018 RequestCounterExternalGuidance 15 "NotAvailable_DontCare " 14 "Reserved" ;
VAL_ 2619670018 FlowRequest_AV32 64511 "ReadyToControl" 64509 "ReleasedControlRequestingOperatorActionBeforeFunctionValueIncreases" 64257 "Float" 64256 "ValveFullyOpened_Retract" 32128 "Block" 0 "ValveFullyOpened_Extend" ;
VAL_ 2619670018 FlowRequest_AV31 64511 "ReadyToControl" 64509 "ReleasedControlRequestingOperatorActionBeforeFunctionValueIncreases" 64257 "Float" 64256 "ValveFullyOpened_Retract" 32128 "Block" 0 "ValveFullyOpened_Extend" ;
VAL_ 2619670018 FlowRequest_AV30 64511 "ReadyToControl" 64509 "ReleasedControlRequestingOperatorActionBeforeFunctionValueIncreases" 64257 "Float" 64256 "ValveFullyOpened_Retract" 32128 "Block" 0 "ValveFullyOpened_Extend" ;
VAL_ 2619670018 FlowRequest_AV29 64511 "ReadyToControl" 64509 "ReleasedControlRequestingOperatorActionBeforeFunctionValueIncreases" 64257 "Float" 64256 "ValveFullyOpened_Retract" 32128 "Block" 0 "ValveFullyOpened_Extend" ;
VAL_ 2619670018 FlowRequest_AV28 64511 "ReadyToControl" 64509 "ReleasedControlRequestingOperatorActionBeforeFunctionValueIncreases" 64257 "Float" 64256 "ValveFullyOpened_Retract" 32128 "Block" 0 "ValveFullyOpened_Extend" ;
VAL_ 2619670018 FlowRequest_AV27 64511 "ReadyToControl" 64509 "ReleasedControlRequestingOperatorActionBeforeFunctionValueIncreases" 64257 "Float" 64256 "ValveFullyOpened_Retract" 32128 "Block" 0 "ValveFullyOpened_Extend" ;
VAL_ 2619670018 FlowRequest_AV26 64511 "ReadyToControl" 64509 "ReleasedControlRequestingOperatorActionBeforeFunctionValueIncreases" 64257 "Float" 64256 "ValveFullyOpened_Retract" 32128 "Block" 0 "ValveFullyOpened_Extend" ;
VAL_ 2619670018 FlowRequest_AV25 64511 "ReadyToControl" 64509 "ReleasedControlRequestingOperatorActionBeforeFunctionValueIncreases" 64257 "Float" 64256 "ValveFullyOpened_Retract" 32128 "Block" 0 "ValveFullyOpened_Extend" ;
VAL_ 2619670018 FlowRequest_AV24 64511 "ReadyToControl" 64509 "ReleasedControlRequestingOperatorActionBeforeFunctionValueIncreases" 64257 "Float" 64256 "ValveFullyOpened_Retract" 32128 "Block" 0 "ValveFullyOpened_Extend" ;
VAL_ 2619670018 FlowRequest_AV23 64511 "ReadyToControl" 64509 "ReleasedControlRequestingOperatorActionBeforeFunctionValueIncreases" 64257 "Float" 64256 "ValveFullyOpened_Retract" 32128 "Block" 0 "ValveFullyOpened_Extend" ;
VAL_ 2619670018 FlowRequest_AV22 64511 "ReadyToControl" 64509 "ReleasedControlRequestingOperatorActionBeforeFunctionValueIncreases" 64257 "Float" 64256 "ValveFullyOpened_Retract" 32128 "Block" 0 "ValveFullyOpened_Extend" ;
VAL_ 2619670018 FlowRequest_AV21 64511 "ReadyToControl" 64509 "ReleasedControlRequestingOperatorActionBeforeFunctionValueIncreases" 64257 "Float" 64256 "ValveFullyOpened_Retract" 32128 "Block" 0 "ValveFullyOpened_Extend" ;
VAL_ 2619670018 FlowRequest_AV20 64511 "ReadyToControl" 64509 "ReleasedControlRequestingOperatorActionBeforeFunctionValueIncreases" 64257 "Float" 64256 "ValveFullyOpened_Retract" 32128 "Block" 0 "ValveFullyOpened_Extend" ;
VAL_ 2619670018 FlowRequest_AV19 64511 "ReadyToControl" 64509 "ReleasedControlRequestingOperatorActionBeforeFunctionValueIncreases" 64257 "Float" 64256 "ValveFullyOpened_Retract" 32128 "Block" 0 "ValveFullyOpened_Extend" ;
VAL_ 2619670018 FlowRequest_AV18 64511 "ReadyToControl" 64509 "ReleasedControlRequestingOperatorActionBeforeFunctionValueIncreases" 64257 "Float" 64256 "ValveFullyOpened_Retract" 32128 "Block" 0 "ValveFullyOpened_Extend" ;
VAL_ 2619670018 FlowRequest_AV17 64511 "ReadyToControl" 64509 "ReleasedControlRequestingOperatorActionBeforeFunctionValueIncreases" 64257 "Float" 64256 "ValveFullyOpened_Retract" 32128 "Block" 0 "ValveFullyOpened_Extend" ;
VAL_ 2619670018 FlowRequest_AV16 64511 "ReadyToControl" 64509 "ReleasedControlRequestingOperatorActionBeforeFunctionValueIncreases" 64257 "Float" 64256 "ValveFullyOpened_Retract" 32128 "Block" 0 "ValveFullyOpened_Extend" ;
VAL_ 2619670018 FlowRequest_AV15 64511 "ReadyToControl" 64509 "ReleasedControlRequestingOperatorActionBeforeFunctionValueIncreases" 64257 "Float" 64256 "ValveFullyOpened_Retract" 32128 "Block" 0 "ValveFullyOpened_Extend" ;
VAL_ 2619670018 FlowRequest_AV14 64511 "ReadyToControl" 64509 "ReleasedControlRequestingOperatorActionBeforeFunctionValueIncreases" 64257 "Float" 64256 "ValveFullyOpened_Retract" 32128 "Block" 0 "ValveFullyOpened_Extend" ;
VAL_ 2619670018 FlowRequest_AV13 64511 "ReadyToControl" 64509 "ReleasedControlRequestingOperatorActionBeforeFunctionValueIncreases" 64257 "Float" 64256 "ValveFullyOpened_Retract" 32128 "Block" 0 "ValveFullyOpened_Extend" ;
VAL_ 2619670018 FlowRequest_AV12 64511 "ReadyToControl" 64509 "ReleasedControlRequestingOperatorActionBeforeFunctionValueIncreases" 64257 "Float" 64256 "ValveFullyOpened_Retract" 32128 "Block" 0 "ValveFullyOpened_Extend" ;
VAL_ 2619670018 FlowRequest_AV11 64511 "ReadyToControl" 64509 "ReleasedControlRequestingOperatorActionBeforeFunctionValueIncreases" 64257 "Float" 64256 "ValveFullyOpened_Retract" 32128 "Block" 0 "ValveFullyOpened_Extend" ;
VAL_ 2619670018 FlowRequest_AV10 64511 "ReadyToControl" 64509 "ReleasedControlRequestingOperatorActionBeforeFunctionValueIncreases" 64257 "Float" 64256 "ValveFullyOpened_Retract" 32128 "Block" 0 "ValveFullyOpened_Extend" ;
VAL_ 2619670018 FlowRequest_AV09 64511 "ReadyToControl" 64509 "ReleasedControlRequestingOperatorActionBeforeFunctionValueIncreases" 64257 "Float" 64256 "ValveFullyOpened_Retract" 32128 "Block" 0 "ValveFullyOpened_Extend" ;
VAL_ 2619670018 FlowRequest_AV08 64511 "ReadyToControl" 64509 "ReleasedControlRequestingOperatorActionBeforeFunctionValueIncreases" 64257 "Float" 64256 "ValveFullyOpened_Retract" 32128 "Block" 0 "ValveFullyOpened_Extend" ;
VAL_ 2619670018 FlowRequest_AV07 64511 "ReadyToControl" 64509 "ReleasedControlRequestingOperatorActionBeforeFunctionValueIncreases" 64257 "Float" 64256 "ValveFullyOpened_Retract" 32128 "Block" 0 "ValveFullyOpened_Extend" ;
VAL_ 2619670018 FlowRequest_AV06 64511 "ReadyToControl" 64509 "ReleasedControlRequestingOperatorActionBeforeFunctionValueIncreases" 64257 "Float" 64256 "ValveFullyOpened_Retract" 32128 "Block" 0 "ValveFullyOpened_Extend" ;
VAL_ 2619670018 FlowRequest_AV05 64511 "ReadyToControl" 64509 "ReleasedControlRequestingOperatorActionBeforeFunctionValueIncreases" 64257 "Float" 64256 "ValveFullyOpened_Retract" 32128 "Block" 0 "ValveFullyOpened_Extend" ;
VAL_ 2619670018 FlowRequest_AV04 64511 "ReadyToControl" 64509 "ReleasedControlRequestingOperatorActionBeforeFunctionValueIncreases" 64257 "Float" 64256 "ValveFullyOpened_Retract" 32128 "Block" 0 "ValveFullyOpened_Extend" ;
VAL_ 2619670018 FlowRequest_AV03 64511 "ReadyToControl" 64509 "ReleasedControlRequestingOperatorActionBeforeFunctionValueIncreases" 64257 "Float" 64256 "ValveFullyOpened_Retract" 32128 "Block" 0 "ValveFullyOpened_Extend" ;
VAL_ 2619670018 FlowRequest_AV02 64511 "ReadyToControl" 64509 "ReleasedControlRequestingOperatorActionBeforeFunctionValueIncreases" 64257 "Float" 64256 "ValveFullyOpened_Retract" 32128 "Block" 0 "ValveFullyOpened_Extend" ;
VAL_ 2619670018 RearHitchPosRequest 10000 "FullRaise" 64259 "RaiseUntilStopRequest" 64258 "LowerUntilStopRequest" 0 "FullLower" 64511 "ReadyToControl" 64509 "ReleaseControlRequestingOperatorAction" 64257 "Stop" 64256 "Float" ;
VAL_ 2619670018 RearPTOSpeedRequest 64511 "ReadyToControl" 64509 "RequestingOperatorAction" 64256 "On_SpeedClockwiseSetByTimServer" 32128 "Off" 0 "On_SpeedCounterClockwiseSetByTimServer" ;
VAL_ 2619670018 CurvatureRequest 64511 "ReadyToControl" 64509 "RequestingOperatorAwareness" 32128 "Straight" ;
VAL_ 2619670018 VehicleSpeedRequest 64511 "ReadyToControl" 64510 "AcceptFunctionWithoutOperatorAwareness" 64509 "RequestingOperatorAwareness" 64256 "ForwardSpeedSetByTimServer" 32128 "Stop" 0 "ReverseSpeedSetByTimServer" ;
VAL_ 2619670018 FrontHitchPosRequest 10000 "FullRaise" 64259 "RaiseUntilStopRequest" 64258 "LowerUntilStopRequest" 0 "FullLower" 64511 "ReadyToControl" 64509 "ReleaseControlRequestingOperatorAction" 64257 "Stop" 64256 "Float" ;
VAL_ 2619670018 FrontPTOSpeedRequest 64511 "ReadyToControl" 64509 "RequestingOperatorAction" 64256 "On_SpeedClockwiseSetByTimServer" 32128 "Off" 0 "On_SpeedCounterClockwiseSetByTimServer" ;
VAL_ 2619670018 FlowRequest_AV01 65535 "NotAvailable" 65534 "Error" 64511 "ReadyToControl" 64509 "ReleasedControlRequestingOperatorActionBeforeFunctionValueIncreases" 64257 "Float" 64256 "ValveFullyOpened_Retract" 32128 "Block" 0 "ValveFullyOpened_Extend" ;
VAL_ 2619670018 TIMClientState 13 "AutomationFault" 5 "AutomationActive" 15 "NotAvailable" 14 "Error" 3 "AutomationEnabled" 2 "AutomationReadyToEnable" 1 "AutomationNotReady" 0 "AutomationUnavailable" ;
VAL_ 2619670018 ClientHeartbeatCounter 255 "GracefulShutdown" 254 "ErrorConditionOnSender" 251 "ResetOfHeartbeatCounter" ;
VAL_ 2619670018 TIMFunctionId_4 72 "RearTopLinkage" 71 "FrontTopLinkage" 32 "AuxValve32" 70 "ExternalGuidance" 68 "VehicleSpeed" 67 "RearHitch" 66 "FrontHitch" 65 "RearPTO" 64 "FrontPTO" 31 "AuxValve31" 30 "AuxValve30" 29 "AuxValve29" 28 "AuxValve28" 27 "AuxValve27" 26 "AuxValve26" 25 "AuxValve25" 24 "AuxValve24" 23 "AuxValve23" 22 "AuxValve22" 21 "AuxValve21" 20 "AuxValve20" 19 "AuxValve19" 18 "AuxValve18" 17 "AuxValve17" 16 "AuxValve16" 15 "AuxValve15" 14 "AuxValve14" 13 "AuxValve13" 12 "AuxValve12" 11 "AuxValve11" 10 "AuxValve10" 9 "AuxValve9" 8 "AuxValve8" 7 "AuxValve7" 6 "AuxValve6" 5 "AuxValve5" 4 "AuxValve4" 3 "AuxValve3" 2 "AuxValve2" 1 "AuxValve1" ;
VAL_ 2619670018 TIMFunctionId_3 72 "RearTopLinkage" 71 "FrontTopLinkage" 32 "AuxValve32" 70 "ExternalGuidance" 68 "VehicleSpeed" 67 "RearHitch" 66 "FrontHitch" 65 "RearPTO" 64 "FrontPTO" 31 "AuxValve31" 30 "AuxValve30" 29 "AuxValve29" 28 "AuxValve28" 27 "AuxValve27" 26 "AuxValve26" 25 "AuxValve25" 24 "AuxValve24" 23 "AuxValve23" 22 "AuxValve22" 21 "AuxValve21" 20 "AuxValve20" 19 "AuxValve19" 18 "AuxValve18" 17 "AuxValve17" 16 "AuxValve16" 15 "AuxValve15" 14 "AuxValve14" 13 "AuxValve13" 12 "AuxValve12" 11 "AuxValve11" 10 "AuxValve10" 9 "AuxValve9" 8 "AuxValve8" 7 "AuxValve7" 6 "AuxValve6" 5 "AuxValve5" 4 "AuxValve4" 3 "AuxValve3" 2 "AuxValve2" 1 "AuxValve1" ;
VAL_ 2619670018 TIMFunctionId_2 72 "RearTopLinkage" 71 "FrontTopLinkage" 32 "AuxValve32" 70 "ExternalGuidance" 68 "VehicleSpeed" 67 "RearHitch" 66 "FrontHitch" 65 "RearPTO" 64 "FrontPTO" 31 "AuxValve31" 30 "AuxValve30" 29 "AuxValve29" 28 "AuxValve28" 27 "AuxValve27" 26 "AuxValve26" 25 "AuxValve25" 24 "AuxValve24" 23 "AuxValve23" 22 "AuxValve22" 21 "AuxValve21" 20 "AuxValve20" 19 "AuxValve19" 18 "AuxValve18" 17 "AuxValve17" 16 "AuxValve16" 15 "AuxValve15" 14 "AuxValve14" 13 "AuxValve13" 12 "AuxValve12" 11 "AuxValve11" 10 "AuxValve10" 9 "AuxValve9" 8 "AuxValve8" 7 "AuxValve7" 6 "AuxValve6" 5 "AuxValve5" 4 "AuxValve4" 3 "AuxValve3" 2 "AuxValve2" 1 "AuxValve1" ;
VAL_ 2619670018 TIMFunctionId_1 72 "RearTopLinkage" 71 "FrontTopLinkage" 32 "AuxValve32" 70 "ExternalGuidance" 68 "VehicleSpeed" 67 "RearHitch" 66 "FrontHitch" 65 "RearPTO" 64 "FrontPTO" 31 "AuxValve31" 30 "AuxValve30" 29 "AuxValve29" 28 "AuxValve28" 27 "AuxValve27" 26 "AuxValve26" 25 "AuxValve25" 24 "AuxValve24" 23 "AuxValve23" 22 "AuxValve22" 21 "AuxValve21" 20 "AuxValve20" 19 "AuxValve19" 18 "AuxValve18" 17 "AuxValve17" 16 "AuxValve16" 15 "AuxValve15" 14 "AuxValve14" 13 "AuxValve13" 12 "AuxValve12" 11 "AuxValve11" 10 "AuxValve10" 9 "AuxValve9" 8 "AuxValve8" 7 "AuxValve7" 6 "AuxValve6" 5 "AuxValve5" 4 "AuxValve4" 3 "AuxValve3" 2 "AuxValve2" 1 "AuxValve1" ;
VAL_ 2619670018 RequestType_4 7 "DontCare" 6 "Error" 1 "AssignToRequestingClient" 0 "ReleaseAssignmentOfRequestingClient" ;
VAL_ 2619670018 RequestType_3 7 "DontCare" 6 "Error" 1 "AssignToRequestingClient" 0 "ReleaseAssignmentOfRequestingClient" ;
VAL_ 2619670018 RequestType_2 7 "DontCare" 6 "Error" 1 "AssignToRequestingClient" 0 "ReleaseAssignmentOfRequestingClient" ;
VAL_ 2619670018 RequestType_1 7 "DontCare" 6 "Error" 1 "AssignToRequestingClient" 0 "ReleaseAssignmentOfRequestingClient" ;
VAL_ 2619670018 TIMMessageType 1 "TIMFunctionStatus" 0 "TIMFunctionRequest" ;
VAL_ 2619670018 GroupFunctionValue 32 "TIM_AuxValve32Request" 249 "ClientStatus" 248 "ServerVersionRequest" 247 "ClientVersionResponse" 246 "ConnectionVersionRequest" 245 "FunctionsAssignmentRequest" 244 "FunctionsSupportRequest" 243 "FunctionsAssignmentStatusRequest" 70 "ExternalGuidanceRequest" 68 "VehicleSpeedRequest" 67 "RearHitchRequest" 66 "FrontHitchRequest" 65 "RearPTORequest" 64 "FrontPTORequest" 31 "TIM_AuxValve31Request" 30 "TIM_AuxValve30Request" 29 "TIM_AuxValve29Request" 28 "TIM_AuxValve28Request" 27 "TIM_AuxValve27Request" 26 "TIM_AuxValve26Request" 25 "TIM_AuxValve25Request" 24 "TIM_AuxValve24Request" 23 "TIM_AuxValve23Request" 22 "TIM_AuxValve22Request" 21 "TIM_AuxValve21Request" 20 "TIM_AuxValve20Request" 19 "TIM_AuxValve19Request" 18 "TIM_AuxValve18Request" 17 "TIM_AuxValve17Request" 16 "TIM_AuxValve16Request" 15 "TIM_AuxValve15Request" 14 "TIM_AuxValve14Request" 13 "TIM_AuxValve13Request" 12 "TIM_AuxValve12Request" 11 "TIM_AuxValve11Request" 10 "TIM_AuxValve10Request" 9 "TIM_AuxValve9Request" 8 "TIM_AuxValve8Request" 7 "TIM_AuxValve7Request" 6 "TIM_AuxValve6Request" 5 "TIM_AuxValve5Request" 4 "TIM_AuxValve4Request" 3 "TIM_AuxValve3Request" 2 "TIM_AuxValve2Request" 1 "TIM_AuxValve1Request" ;
SG_MUL_VAL_ 2621308419 SecurityByte_VS MsgType_VS 17-17;
SG_MUL_VAL_ 2621308419 SecurityByte_RTL MsgType_RTL 17-17;
SG_MUL_VAL_ 2621308419 SecurityByte_RPTO MsgType_RPTO 17-17;
SG_MUL_VAL_ 2621308419 SecurityByte_RH MsgType_RH 17-17;
SG_MUL_VAL_ 2621308419 SecurityByte_FTL MsgType_FTL 17-17;
SG_MUL_VAL_ 2621308419 SecurityByte_FPTO MsgType_FPTO 17-17;
SG_MUL_VAL_ 2621308419 SecurityByte_FH MsgType_FH 17-17;
SG_MUL_VAL_ 2621308419 SecurityByte_EG MsgType_EG 17-17;
SG_MUL_VAL_ 2621308419 SecurityByte_AV32 MsgType_AV32 17-17;
SG_MUL_VAL_ 2621308419 SecurityByte_AV31 MsgType_AV31 17-17;
SG_MUL_VAL_ 2621308419 SecurityByte_AV30 MsgType_AV30 17-17;
SG_MUL_VAL_ 2621308419 SecurityByte_AV29 MsgType_AV29 17-17;
SG_MUL_VAL_ 2621308419 SecurityByte_AV28 MsgType_AV28 17-17;
SG_MUL_VAL_ 2621308419 SecurityByte_AV27 MsgType_AV27 17-17;
SG_MUL_VAL_ 2621308419 SecurityByte_AV26 MsgType_AV26 17-17;
SG_MUL_VAL_ 2621308419 SecurityByte_AV25 MsgType_AV25 17-17;
SG_MUL_VAL_ 2621308419 SecurityByte_AV24 MsgType_AV24 17-17;
SG_MUL_VAL_ 2621308419 SecurityByte_AV23 MsgType_AV23 17-17;
SG_MUL_VAL_ 2621308419 SecurityByte_AV22 MsgType_AV22 17-17;
SG_MUL_VAL_ 2621308419 SecurityByte_AV21 MsgType_AV21 17-17;
SG_MUL_VAL_ 2621308419 SecurityByte_AV20 MsgType_AV20 17-17;
SG_MUL_VAL_ 2621308419 SecurityByte_AV19 MsgType_AV19 17-17;
SG_MUL_VAL_ 2621308419 SecurityByte_AV18 MsgType_AV18 17-17;
SG_MUL_VAL_ 2621308419 SecurityByte_AV17 MsgType_AV17 17-17;
SG_MUL_VAL_ 2621308419 SecurityByte_AV16 MsgType_AV16 17-17;
SG_MUL_VAL_ 2621308419 SecurityByte_AV15 MsgType_AV15 17-17;
SG_MUL_VAL_ 2621308419 SecurityByte_AV14 MsgType_AV14 17-17;
SG_MUL_VAL_ 2621308419 SecurityByte_AV13 MsgType_AV13 17-17;
SG_MUL_VAL_ 2621308419 SecurityByte_AV12 MsgType_AV12 17-17;
SG_MUL_VAL_ 2621308419 SecurityByte_AV11 MsgType_AV11 17-17;
SG_MUL_VAL_ 2621308419 SecurityByte_AV10 MsgType_AV10 17-17;
SG_MUL_VAL_ 2621308419 SecurityByte_AV09 MsgType_AV09 17-17;
SG_MUL_VAL_ 2621308419 SecurityByte_AV08 MsgType_AV08 17-17;
SG_MUL_VAL_ 2621308419 SecurityByte_AV07 MsgType_AV07 17-17;
SG_MUL_VAL_ 2621308419 SecurityByte_AV06 MsgType_AV06 17-17;
SG_MUL_VAL_ 2621308419 SecurityByte_AV05 MsgType_AV05 17-17;
SG_MUL_VAL_ 2621308419 SecurityByte_AV04 MsgType_AV04 17-17;
SG_MUL_VAL_ 2621308419 SecurityByte_AV03 MsgType_AV03 17-17;
SG_MUL_VAL_ 2621308419 SecurityByte_AV02 MsgType_AV02 17-17;
SG_MUL_VAL_ 2621308419 SecurityByte_AV01 MsgType_AV01 17-17;
SG_MUL_VAL_ 2621308419 PositionRequest_RTL MsgType_RTL 17-17;
SG_MUL_VAL_ 2621308419 PositionRequest_FTL MsgType_FTL 17-17;
SG_MUL_VAL_ 2621308419 ControlMode1_VS MsgType_VS 0-0;
SG_MUL_VAL_ 2621308419 ControlMode1_RTL MsgType_RTL 0-0;
SG_MUL_VAL_ 2621308419 ControlMode1_FTL MsgType_FTL 0-0;
SG_MUL_VAL_ 2621308419 NumOfControlModes_VS MsgType_VS 0-0;
SG_MUL_VAL_ 2621308419 NumOfControlModes_RTL MsgType_RTL 0-0;
SG_MUL_VAL_ 2621308419 NumOfControlModes_FTL MsgType_FTL 0-0;
SG_MUL_VAL_ 2621308419 NumOfBytes_CM1_VS MsgType_VS 0-0;
SG_MUL_VAL_ 2621308419 NumOfBytes_CM1_RTL MsgType_RTL 0-0;
SG_MUL_VAL_ 2621308419 NumOfBytes_CM1_FTL MsgType_FTL 0-0;
SG_MUL_VAL_ 2621308419 MsgType_RTL TIMFunctionID 72-72;
SG_MUL_VAL_ 2621308419 MsgType_FTL TIMFunctionID 71-71;
SG_MUL_VAL_ 2621308419 MsgType_EG TIMFunctionID 70-70;
SG_MUL_VAL_ 2621308419 MsgType_VS TIMFunctionID 68-68;
SG_MUL_VAL_ 2621308419 MsgType_RH TIMFunctionID 67-67;
SG_MUL_VAL_ 2621308419 MsgType_FH TIMFunctionID 66-66;
SG_MUL_VAL_ 2621308419 MsgType_RPTO TIMFunctionID 65-65;
SG_MUL_VAL_ 2621308419 MsgType_FPTO TIMFunctionID 64-64;
SG_MUL_VAL_ 2621308419 MsgType_AV32 TIMFunctionID 32-32;
SG_MUL_VAL_ 2621308419 MsgType_AV31 TIMFunctionID 31-31;
SG_MUL_VAL_ 2621308419 MsgType_AV30 TIMFunctionID 30-30;
SG_MUL_VAL_ 2621308419 MsgType_AV29 TIMFunctionID 29-29;
SG_MUL_VAL_ 2621308419 MsgType_AV28 TIMFunctionID 28-28;
SG_MUL_VAL_ 2621308419 MsgType_AV27 TIMFunctionID 27-27;
SG_MUL_VAL_ 2621308419 MsgType_AV26 TIMFunctionID 26-26;
SG_MUL_VAL_ 2621308419 MsgType_AV25 TIMFunctionID 25-25;
SG_MUL_VAL_ 2621308419 MsgType_AV24 TIMFunctionID 24-24;
SG_MUL_VAL_ 2621308419 MsgType_AV23 TIMFunctionID 23-23;
SG_MUL_VAL_ 2621308419 MsgType_AV22 TIMFunctionID 22-22;
SG_MUL_VAL_ 2621308419 MsgType_AV21 TIMFunctionID 21-21;
SG_MUL_VAL_ 2621308419 MsgType_AV20 TIMFunctionID 20-20;
SG_MUL_VAL_ 2621308419 MsgType_AV19 TIMFunctionID 19-19;
SG_MUL_VAL_ 2621308419 MsgType_AV18 TIMFunctionID 18-18;
SG_MUL_VAL_ 2621308419 MsgType_AV17 TIMFunctionID 17-17;
SG_MUL_VAL_ 2621308419 MsgType_AV16 TIMFunctionID 16-16;
SG_MUL_VAL_ 2621308419 MsgType_AV15 TIMFunctionID 15-15;
SG_MUL_VAL_ 2621308419 MsgType_AV14 TIMFunctionID 14-14;
SG_MUL_VAL_ 2621308419 MsgType_AV13 TIMFunctionID 13-13;
SG_MUL_VAL_ 2621308419 MsgType_AV12 TIMFunctionID 12-12;
SG_MUL_VAL_ 2621308419 MsgType_AV11 TIMFunctionID 11-11;
SG_MUL_VAL_ 2621308419 MsgType_AV10 TIMFunctionID 10-10;
SG_MUL_VAL_ 2621308419 MsgType_AV09 TIMFunctionID 9-9;
SG_MUL_VAL_ 2621308419 MsgType_AV08 TIMFunctionID 8-8;
SG_MUL_VAL_ 2621308419 MsgType_AV07 TIMFunctionID 7-7;
SG_MUL_VAL_ 2621308419 MsgType_AV06 TIMFunctionID 6-6;
SG_MUL_VAL_ 2621308419 MsgType_AV05 TIMFunctionID 5-5;
SG_MUL_VAL_ 2621308419 MsgType_AV04 TIMFunctionID 4-4;
SG_MUL_VAL_ 2621308419 MsgType_AV03 TIMFunctionID 3-3;
SG_MUL_VAL_ 2621308419 MsgType_AV02 TIMFunctionID 2-2;
SG_MUL_VAL_ 2621308419 MsgType_AV01 TIMFunctionID 1-1;
SG_MUL_VAL_ 2621308419 FlowRequest_AV32 MsgType_AV32 17-17;
SG_MUL_VAL_ 2621308419 FlowRequest_AV31 MsgType_AV31 17-17;
SG_MUL_VAL_ 2621308419 FlowRequest_AV30 MsgType_AV30 17-17;
SG_MUL_VAL_ 2621308419 FlowRequest_AV29 MsgType_AV29 17-17;
SG_MUL_VAL_ 2621308419 FlowRequest_AV28 MsgType_AV28 17-17;
SG_MUL_VAL_ 2621308419 FlowRequest_AV27 MsgType_AV27 17-17;
SG_MUL_VAL_ 2621308419 FlowRequest_AV26 MsgType_AV26 17-17;
SG_MUL_VAL_ 2621308419 FlowRequest_AV25 MsgType_AV25 17-17;
SG_MUL_VAL_ 2621308419 FlowRequest_AV24 MsgType_AV24 17-17;
SG_MUL_VAL_ 2621308419 FlowRequest_AV23 MsgType_AV23 17-17;
SG_MUL_VAL_ 2621308419 FlowRequest_AV22 MsgType_AV22 17-17;
SG_MUL_VAL_ 2621308419 FlowRequest_AV21 MsgType_AV21 17-17;
SG_MUL_VAL_ 2621308419 FlowRequest_AV20 MsgType_AV20 17-17;
SG_MUL_VAL_ 2621308419 FlowRequest_AV19 MsgType_AV19 17-17;
SG_MUL_VAL_ 2621308419 FlowRequest_AV18 MsgType_AV18 17-17;
SG_MUL_VAL_ 2621308419 FlowRequest_AV17 MsgType_AV17 17-17;
SG_MUL_VAL_ 2621308419 FlowRequest_AV16 MsgType_AV16 17-17;
SG_MUL_VAL_ 2621308419 FlowRequest_AV15 MsgType_AV15 17-17;
SG_MUL_VAL_ 2621308419 FlowRequest_AV14 MsgType_AV14 17-17;
SG_MUL_VAL_ 2621308419 FlowRequest_AV13 MsgType_AV13 17-17;
SG_MUL_VAL_ 2621308419 FlowRequest_AV12 MsgType_AV12 17-17;
SG_MUL_VAL_ 2621308419 FlowRequest_AV11 MsgType_AV11 17-17;
SG_MUL_VAL_ 2621308419 FlowRequest_AV10 MsgType_AV10 17-17;
SG_MUL_VAL_ 2621308419 FlowRequest_AV09 MsgType_AV09 17-17;
SG_MUL_VAL_ 2621308419 FlowRequest_AV08 MsgType_AV08 17-17;
SG_MUL_VAL_ 2621308419 FlowRequest_AV07 MsgType_AV07 17-17;
SG_MUL_VAL_ 2621308419 FlowRequest_AV06 MsgType_AV06 17-17;
SG_MUL_VAL_ 2621308419 FlowRequest_AV05 MsgType_AV05 17-17;
SG_MUL_VAL_ 2621308419 FlowRequest_AV04 MsgType_AV04 17-17;
SG_MUL_VAL_ 2621308419 FlowRequest_AV03 MsgType_AV03 17-17;
SG_MUL_VAL_ 2621308419 FlowRequest_AV02 MsgType_AV02 17-17;
SG_MUL_VAL_ 2621308419 PositionRequest_RH MsgType_RH 17-17;
SG_MUL_VAL_ 2621308419 OutputShaftSpeedRequest_RPTO MsgType_RPTO 17-17;
SG_MUL_VAL_ 2621308419 CurvatureRequest_EG MsgType_EG 17-17;
SG_MUL_VAL_ 2621308419 VehicleSpeedRequest_VS MsgType_VS 17-17;
SG_MUL_VAL_ 2621308419 PositionRequest_FH MsgType_FH 17-17;
SG_MUL_VAL_ 2621308419 OutputShaftSpeedRequest_FPTO MsgType_FPTO 17-17;
SG_MUL_VAL_ 2621308419 FlowRequest_AV01 MsgType_AV01 17-17;
SG_MUL_VAL_ 2621308418 SecurityByte_VS MsgType_VS 17-17;
SG_MUL_VAL_ 2621308418 SecurityByte_RTL MsgType_RTL 17-17;
SG_MUL_VAL_ 2621308418 SecurityByte_RPTO MsgType_RPTO 17-17;
SG_MUL_VAL_ 2621308418 SecurityByte_RH MsgType_RH 17-17;
SG_MUL_VAL_ 2621308418 SecurityByte_FTL MsgType_FTL 17-17;
SG_MUL_VAL_ 2621308418 SecurityByte_FPTO MsgType_FPTO 17-17;
SG_MUL_VAL_ 2621308418 SecurityByte_FH MsgType_FH 17-17;
SG_MUL_VAL_ 2621308418 SecurityByte_EG MsgType_EG 17-17;
SG_MUL_VAL_ 2621308418 SecurityByte_AV32 MsgType_AV32 17-17;
SG_MUL_VAL_ 2621308418 SecurityByte_AV31 MsgType_AV31 17-17;
SG_MUL_VAL_ 2621308418 SecurityByte_AV30 MsgType_AV30 17-17;
SG_MUL_VAL_ 2621308418 SecurityByte_AV29 MsgType_AV29 17-17;
SG_MUL_VAL_ 2621308418 SecurityByte_AV28 MsgType_AV28 17-17;
SG_MUL_VAL_ 2621308418 SecurityByte_AV27 MsgType_AV27 17-17;
SG_MUL_VAL_ 2621308418 SecurityByte_AV26 MsgType_AV26 17-17;
SG_MUL_VAL_ 2621308418 SecurityByte_AV25 MsgType_AV25 17-17;
SG_MUL_VAL_ 2621308418 SecurityByte_AV24 MsgType_AV24 17-17;
SG_MUL_VAL_ 2621308418 SecurityByte_AV23 MsgType_AV23 17-17;
SG_MUL_VAL_ 2621308418 SecurityByte_AV22 MsgType_AV22 17-17;
SG_MUL_VAL_ 2621308418 SecurityByte_AV21 MsgType_AV21 17-17;
SG_MUL_VAL_ 2621308418 SecurityByte_AV20 MsgType_AV20 17-17;
SG_MUL_VAL_ 2621308418 SecurityByte_AV19 MsgType_AV19 17-17;
SG_MUL_VAL_ 2621308418 SecurityByte_AV18 MsgType_AV18 17-17;
SG_MUL_VAL_ 2621308418 SecurityByte_AV17 MsgType_AV17 17-17;
SG_MUL_VAL_ 2621308418 SecurityByte_AV16 MsgType_AV16 17-17;
SG_MUL_VAL_ 2621308418 SecurityByte_AV15 MsgType_AV15 17-17;
SG_MUL_VAL_ 2621308418 SecurityByte_AV14 MsgType_AV14 17-17;
SG_MUL_VAL_ 2621308418 SecurityByte_AV13 MsgType_AV13 17-17;
SG_MUL_VAL_ 2621308418 SecurityByte_AV12 MsgType_AV12 17-17;
SG_MUL_VAL_ 2621308418 SecurityByte_AV11 MsgType_AV11 17-17;
SG_MUL_VAL_ 2621308418 SecurityByte_AV10 MsgType_AV10 17-17;
SG_MUL_VAL_ 2621308418 SecurityByte_AV09 MsgType_AV09 17-17;
SG_MUL_VAL_ 2621308418 SecurityByte_AV08 MsgType_AV08 17-17;
SG_MUL_VAL_ 2621308418 SecurityByte_AV07 MsgType_AV07 17-17;
SG_MUL_VAL_ 2621308418 SecurityByte_AV06 MsgType_AV06 17-17;
SG_MUL_VAL_ 2621308418 SecurityByte_AV05 MsgType_AV05 17-17;
SG_MUL_VAL_ 2621308418 SecurityByte_AV04 MsgType_AV04 17-17;
SG_MUL_VAL_ 2621308418 SecurityByte_AV03 MsgType_AV03 17-17;
SG_MUL_VAL_ 2621308418 SecurityByte_AV02 MsgType_AV02 17-17;
SG_MUL_VAL_ 2621308418 SecurityByte_AV01 MsgType_AV01 17-17;
SG_MUL_VAL_ 2621308418 PositionRequest_RTL MsgType_RTL 17-17;
SG_MUL_VAL_ 2621308418 PositionRequest_FTL MsgType_FTL 17-17;
SG_MUL_VAL_ 2621308418 ControlMode1_VS MsgType_VS 0-0;
SG_MUL_VAL_ 2621308418 ControlMode1_RTL MsgType_RTL 0-0;
SG_MUL_VAL_ 2621308418 ControlMode1_FTL MsgType_FTL 0-0;
SG_MUL_VAL_ 2621308418 NumOfControlModes_VS MsgType_VS 0-0;
SG_MUL_VAL_ 2621308418 NumOfControlModes_RTL MsgType_RTL 0-0;
SG_MUL_VAL_ 2621308418 NumOfControlModes_FTL MsgType_FTL 0-0;
SG_MUL_VAL_ 2621308418 NumOfBytes_CM1_VS MsgType_VS 0-0;
SG_MUL_VAL_ 2621308418 NumOfBytes_CM1_RTL MsgType_RTL 0-0;
SG_MUL_VAL_ 2621308418 NumOfBytes_CM1_FTL MsgType_FTL 0-0;
SG_MUL_VAL_ 2621308418 MsgType_RTL TIMFunctionID 72-72;
SG_MUL_VAL_ 2621308418 MsgType_FTL TIMFunctionID 71-71;
SG_MUL_VAL_ 2621308418 MsgType_EG TIMFunctionID 70-70;
SG_MUL_VAL_ 2621308418 MsgType_VS TIMFunctionID 68-68;
SG_MUL_VAL_ 2621308418 MsgType_RH TIMFunctionID 67-67;
SG_MUL_VAL_ 2621308418 MsgType_FH TIMFunctionID 66-66;
SG_MUL_VAL_ 2621308418 MsgType_RPTO TIMFunctionID 65-65;
SG_MUL_VAL_ 2621308418 MsgType_FPTO TIMFunctionID 64-64;
SG_MUL_VAL_ 2621308418 MsgType_AV32 TIMFunctionID 32-32;
SG_MUL_VAL_ 2621308418 MsgType_AV31 TIMFunctionID 31-31;
SG_MUL_VAL_ 2621308418 MsgType_AV30 TIMFunctionID 30-30;
SG_MUL_VAL_ 2621308418 MsgType_AV29 TIMFunctionID 29-29;
SG_MUL_VAL_ 2621308418 MsgType_AV28 TIMFunctionID 28-28;
SG_MUL_VAL_ 2621308418 MsgType_AV27 TIMFunctionID 27-27;
SG_MUL_VAL_ 2621308418 MsgType_AV26 TIMFunctionID 26-26;
SG_MUL_VAL_ 2621308418 MsgType_AV25 TIMFunctionID 25-25;
SG_MUL_VAL_ 2621308418 MsgType_AV24 TIMFunctionID 24-24;
SG_MUL_VAL_ 2621308418 MsgType_AV23 TIMFunctionID 23-23;
SG_MUL_VAL_ 2621308418 MsgType_AV22 TIMFunctionID 22-22;
SG_MUL_VAL_ 2621308418 MsgType_AV21 TIMFunctionID 21-21;
SG_MUL_VAL_ 2621308418 MsgType_AV20 TIMFunctionID 20-20;
SG_MUL_VAL_ 2621308418 MsgType_AV19 TIMFunctionID 19-19;
SG_MUL_VAL_ 2621308418 MsgType_AV18 TIMFunctionID 18-18;
SG_MUL_VAL_ 2621308418 MsgType_AV17 TIMFunctionID 17-17;
SG_MUL_VAL_ 2621308418 MsgType_AV16 TIMFunctionID 16-16;
SG_MUL_VAL_ 2621308418 MsgType_AV15 TIMFunctionID 15-15;
SG_MUL_VAL_ 2621308418 MsgType_AV14 TIMFunctionID 14-14;
SG_MUL_VAL_ 2621308418 MsgType_AV13 TIMFunctionID 13-13;
SG_MUL_VAL_ 2621308418 MsgType_AV12 TIMFunctionID 12-12;
SG_MUL_VAL_ 2621308418 MsgType_AV11 TIMFunctionID 11-11;
SG_MUL_VAL_ 2621308418 MsgType_AV10 TIMFunctionID 10-10;
SG_MUL_VAL_ 2621308418 MsgType_AV09 TIMFunctionID 9-9;
SG_MUL_VAL_ 2621308418 MsgType_AV08 TIMFunctionID 8-8;
SG_MUL_VAL_ 2621308418 MsgType_AV07 TIMFunctionID 7-7;
SG_MUL_VAL_ 2621308418 MsgType_AV06 TIMFunctionID 6-6;
SG_MUL_VAL_ 2621308418 MsgType_AV05 TIMFunctionID 5-5;
SG_MUL_VAL_ 2621308418 MsgType_AV04 TIMFunctionID 4-4;
SG_MUL_VAL_ 2621308418 MsgType_AV03 TIMFunctionID 3-3;
SG_MUL_VAL_ 2621308418 MsgType_AV02 TIMFunctionID 2-2;
SG_MUL_VAL_ 2621308418 MsgType_AV01 TIMFunctionID 1-1;
SG_MUL_VAL_ 2621308418 FlowRequest_AV32 MsgType_AV32 17-17;
SG_MUL_VAL_ 2621308418 FlowRequest_AV31 MsgType_AV31 17-17;
SG_MUL_VAL_ 2621308418 FlowRequest_AV30 MsgType_AV30 17-17;
SG_MUL_VAL_ 2621308418 FlowRequest_AV29 MsgType_AV29 17-17;
SG_MUL_VAL_ 2621308418 FlowRequest_AV28 MsgType_AV28 17-17;
SG_MUL_VAL_ 2621308418 FlowRequest_AV27 MsgType_AV27 17-17;
SG_MUL_VAL_ 2621308418 FlowRequest_AV26 MsgType_AV26 17-17;
SG_MUL_VAL_ 2621308418 FlowRequest_AV25 MsgType_AV25 17-17;
SG_MUL_VAL_ 2621308418 FlowRequest_AV24 MsgType_AV24 17-17;
SG_MUL_VAL_ 2621308418 FlowRequest_AV23 MsgType_AV23 17-17;
SG_MUL_VAL_ 2621308418 FlowRequest_AV22 MsgType_AV22 17-17;
SG_MUL_VAL_ 2621308418 FlowRequest_AV21 MsgType_AV21 17-17;
SG_MUL_VAL_ 2621308418 FlowRequest_AV20 MsgType_AV20 17-17;
SG_MUL_VAL_ 2621308418 FlowRequest_AV19 MsgType_AV19 17-17;
SG_MUL_VAL_ 2621308418 FlowRequest_AV18 MsgType_AV18 17-17;
SG_MUL_VAL_ 2621308418 FlowRequest_AV17 MsgType_AV17 17-17;
SG_MUL_VAL_ 2621308418 FlowRequest_AV16 MsgType_AV16 17-17;
SG_MUL_VAL_ 2621308418 FlowRequest_AV15 MsgType_AV15 17-17;
SG_MUL_VAL_ 2621308418 FlowRequest_AV14 MsgType_AV14 17-17;
SG_MUL_VAL_ 2621308418 FlowRequest_AV13 MsgType_AV13 17-17;
SG_MUL_VAL_ 2621308418 FlowRequest_AV12 MsgType_AV12 17-17;
SG_MUL_VAL_ 2621308418 FlowRequest_AV11 MsgType_AV11 17-17;
SG_MUL_VAL_ 2621308418 FlowRequest_AV10 MsgType_AV10 17-17;
SG_MUL_VAL_ 2621308418 FlowRequest_AV09 MsgType_AV09 17-17;
SG_MUL_VAL_ 2621308418 FlowRequest_AV08 MsgType_AV08 17-17;
SG_MUL_VAL_ 2621308418 FlowRequest_AV07 MsgType_AV07 17-17;
SG_MUL_VAL_ 2621308418 FlowRequest_AV06 MsgType_AV06 17-17;
SG_MUL_VAL_ 2621308418 FlowRequest_AV05 MsgType_AV05 17-17;
SG_MUL_VAL_ 2621308418 FlowRequest_AV04 MsgType_AV04 17-17;
SG_MUL_VAL_ 2621308418 FlowRequest_AV03 MsgType_AV03 17-17;
SG_MUL_VAL_ 2621308418 FlowRequest_AV02 MsgType_AV02 17-17;
SG_MUL_VAL_ 2621308418 PositionRequest_RH MsgType_RH 17-17;
SG_MUL_VAL_ 2621308418 OutputShaftSpeedRequest_RPTO MsgType_RPTO 17-17;
SG_MUL_VAL_ 2621308418 CurvatureRequest_EG MsgType_EG 17-17;
SG_MUL_VAL_ 2621308418 VehicleSpeedRequest_VS MsgType_VS 17-17;
SG_MUL_VAL_ 2621308418 PositionRequest_FH MsgType_FH 17-17;
SG_MUL_VAL_ 2621308418 OutputShaftSpeedRequest_FPTO MsgType_FPTO 17-17;
SG_MUL_VAL_ 2621308418 FlowRequest_AV01 MsgType_AV01 17-17;
SG_MUL_VAL_ 2621308417 SecurityByte_VS MsgType_VS 17-17;
SG_MUL_VAL_ 2621308417 SecurityByte_RTL MsgType_RTL 17-17;
SG_MUL_VAL_ 2621308417 SecurityByte_RPTO MsgType_RPTO 17-17;
SG_MUL_VAL_ 2621308417 SecurityByte_RH MsgType_RH 17-17;
SG_MUL_VAL_ 2621308417 SecurityByte_FTL MsgType_FTL 17-17;
SG_MUL_VAL_ 2621308417 SecurityByte_FPTO MsgType_FPTO 17-17;
SG_MUL_VAL_ 2621308417 SecurityByte_FH MsgType_FH 17-17;
SG_MUL_VAL_ 2621308417 SecurityByte_EG MsgType_EG 17-17;
SG_MUL_VAL_ 2621308417 SecurityByte_AV32 MsgType_AV32 17-17;
SG_MUL_VAL_ 2621308417 SecurityByte_AV31 MsgType_AV31 17-17;
SG_MUL_VAL_ 2621308417 SecurityByte_AV30 MsgType_AV30 17-17;
SG_MUL_VAL_ 2621308417 SecurityByte_AV29 MsgType_AV29 17-17;
SG_MUL_VAL_ 2621308417 SecurityByte_AV28 MsgType_AV28 17-17;
SG_MUL_VAL_ 2621308417 SecurityByte_AV27 MsgType_AV27 17-17;
SG_MUL_VAL_ 2621308417 SecurityByte_AV26 MsgType_AV26 17-17;
SG_MUL_VAL_ 2621308417 SecurityByte_AV25 MsgType_AV25 17-17;
SG_MUL_VAL_ 2621308417 SecurityByte_AV24 MsgType_AV24 17-17;
SG_MUL_VAL_ 2621308417 SecurityByte_AV23 MsgType_AV23 17-17;
SG_MUL_VAL_ 2621308417 SecurityByte_AV22 MsgType_AV22 17-17;
SG_MUL_VAL_ 2621308417 SecurityByte_AV21 MsgType_AV21 17-17;
SG_MUL_VAL_ 2621308417 SecurityByte_AV20 MsgType_AV20 17-17;
SG_MUL_VAL_ 2621308417 SecurityByte_AV19 MsgType_AV19 17-17;
SG_MUL_VAL_ 2621308417 SecurityByte_AV18 MsgType_AV18 17-17;
SG_MUL_VAL_ 2621308417 SecurityByte_AV17 MsgType_AV17 17-17;
SG_MUL_VAL_ 2621308417 SecurityByte_AV16 MsgType_AV16 17-17;
SG_MUL_VAL_ 2621308417 SecurityByte_AV15 MsgType_AV15 17-17;
SG_MUL_VAL_ 2621308417 SecurityByte_AV14 MsgType_AV14 17-17;
SG_MUL_VAL_ 2621308417 SecurityByte_AV13 MsgType_AV13 17-17;
SG_MUL_VAL_ 2621308417 SecurityByte_AV12 MsgType_AV12 17-17;
SG_MUL_VAL_ 2621308417 SecurityByte_AV11 MsgType_AV11 17-17;
SG_MUL_VAL_ 2621308417 SecurityByte_AV10 MsgType_AV10 17-17;
SG_MUL_VAL_ 2621308417 SecurityByte_AV09 MsgType_AV09 17-17;
SG_MUL_VAL_ 2621308417 SecurityByte_AV08 MsgType_AV08 17-17;
SG_MUL_VAL_ 2621308417 SecurityByte_AV07 MsgType_AV07 17-17;
SG_MUL_VAL_ 2621308417 SecurityByte_AV06 MsgType_AV06 17-17;
SG_MUL_VAL_ 2621308417 SecurityByte_AV05 MsgType_AV05 17-17;
SG_MUL_VAL_ 2621308417 SecurityByte_AV04 MsgType_AV04 17-17;
SG_MUL_VAL_ 2621308417 SecurityByte_AV03 MsgType_AV03 17-17;
SG_MUL_VAL_ 2621308417 SecurityByte_AV02 MsgType_AV02 17-17;
SG_MUL_VAL_ 2621308417 SecurityByte_AV01 MsgType_AV01 17-17;
SG_MUL_VAL_ 2621308417 PositionRequest_RTL MsgType_RTL 17-17;
SG_MUL_VAL_ 2621308417 PositionRequest_FTL MsgType_FTL 17-17;
SG_MUL_VAL_ 2621308417 ControlMode1_VS MsgType_VS 0-0;
SG_MUL_VAL_ 2621308417 ControlMode1_RTL MsgType_RTL 0-0;
SG_MUL_VAL_ 2621308417 ControlMode1_FTL MsgType_FTL 0-0;
SG_MUL_VAL_ 2621308417 NumOfControlModes_VS MsgType_VS 0-0;
SG_MUL_VAL_ 2621308417 NumOfControlModes_RTL MsgType_RTL 0-0;
SG_MUL_VAL_ 2621308417 NumOfControlModes_FTL MsgType_FTL 0-0;
SG_MUL_VAL_ 2621308417 NumOfBytes_CM1_VS MsgType_VS 0-0;
SG_MUL_VAL_ 2621308417 NumOfBytes_CM1_RTL MsgType_RTL 0-0;
SG_MUL_VAL_ 2621308417 NumOfBytes_CM1_FTL MsgType_FTL 0-0;
SG_MUL_VAL_ 2621308417 MsgType_RTL TIMFunctionID 72-72;
SG_MUL_VAL_ 2621308417 MsgType_FTL TIMFunctionID 71-71;
SG_MUL_VAL_ 2621308417 MsgType_EG TIMFunctionID 70-70;
SG_MUL_VAL_ 2621308417 MsgType_VS TIMFunctionID 68-68;
SG_MUL_VAL_ 2621308417 MsgType_RH TIMFunctionID 67-67;
SG_MUL_VAL_ 2621308417 MsgType_FH TIMFunctionID 66-66;
SG_MUL_VAL_ 2621308417 MsgType_RPTO TIMFunctionID 65-65;
SG_MUL_VAL_ 2621308417 MsgType_FPTO TIMFunctionID 64-64;
SG_MUL_VAL_ 2621308417 MsgType_AV32 TIMFunctionID 32-32;
SG_MUL_VAL_ 2621308417 MsgType_AV31 TIMFunctionID 31-31;
SG_MUL_VAL_ 2621308417 MsgType_AV30 TIMFunctionID 30-30;
SG_MUL_VAL_ 2621308417 MsgType_AV29 TIMFunctionID 29-29;
SG_MUL_VAL_ 2621308417 MsgType_AV28 TIMFunctionID 28-28;
SG_MUL_VAL_ 2621308417 MsgType_AV27 TIMFunctionID 27-27;
SG_MUL_VAL_ 2621308417 MsgType_AV26 TIMFunctionID 26-26;
SG_MUL_VAL_ 2621308417 MsgType_AV25 TIMFunctionID 25-25;
SG_MUL_VAL_ 2621308417 MsgType_AV24 TIMFunctionID 24-24;
SG_MUL_VAL_ 2621308417 MsgType_AV23 TIMFunctionID 23-23;
SG_MUL_VAL_ 2621308417 MsgType_AV22 TIMFunctionID 22-22;
SG_MUL_VAL_ 2621308417 MsgType_AV21 TIMFunctionID 21-21;
SG_MUL_VAL_ 2621308417 MsgType_AV20 TIMFunctionID 20-20;
SG_MUL_VAL_ 2621308417 MsgType_AV19 TIMFunctionID 19-19;
SG_MUL_VAL_ 2621308417 MsgType_AV18 TIMFunctionID 18-18;
SG_MUL_VAL_ 2621308417 MsgType_AV17 TIMFunctionID 17-17;
SG_MUL_VAL_ 2621308417 MsgType_AV16 TIMFunctionID 16-16;
SG_MUL_VAL_ 2621308417 MsgType_AV15 TIMFunctionID 15-15;
SG_MUL_VAL_ 2621308417 MsgType_AV14 TIMFunctionID 14-14;
SG_MUL_VAL_ 2621308417 MsgType_AV13 TIMFunctionID 13-13;
SG_MUL_VAL_ 2621308417 MsgType_AV12 TIMFunctionID 12-12;
SG_MUL_VAL_ 2621308417 MsgType_AV11 TIMFunctionID 11-11;
SG_MUL_VAL_ 2621308417 MsgType_AV10 TIMFunctionID 10-10;
SG_MUL_VAL_ 2621308417 MsgType_AV09 TIMFunctionID 9-9;
SG_MUL_VAL_ 2621308417 MsgType_AV08 TIMFunctionID 8-8;
SG_MUL_VAL_ 2621308417 MsgType_AV07 TIMFunctionID 7-7;
SG_MUL_VAL_ 2621308417 MsgType_AV06 TIMFunctionID 6-6;
SG_MUL_VAL_ 2621308417 MsgType_AV05 TIMFunctionID 5-5;
SG_MUL_VAL_ 2621308417 MsgType_AV04 TIMFunctionID 4-4;
SG_MUL_VAL_ 2621308417 MsgType_AV03 TIMFunctionID 3-3;
SG_MUL_VAL_ 2621308417 MsgType_AV02 TIMFunctionID 2-2;
SG_MUL_VAL_ 2621308417 MsgType_AV01 TIMFunctionID 1-1;
SG_MUL_VAL_ 2621308417 FlowRequest_AV32 MsgType_AV32 17-17;
SG_MUL_VAL_ 2621308417 FlowRequest_AV31 MsgType_AV31 17-17;
SG_MUL_VAL_ 2621308417 FlowRequest_AV30 MsgType_AV30 17-17;
SG_MUL_VAL_ 2621308417 FlowRequest_AV29 MsgType_AV29 17-17;
SG_MUL_VAL_ 2621308417 FlowRequest_AV28 MsgType_AV28 17-17;
SG_MUL_VAL_ 2621308417 FlowRequest_AV27 MsgType_AV27 17-17;
SG_MUL_VAL_ 2621308417 FlowRequest_AV26 MsgType_AV26 17-17;
SG_MUL_VAL_ 2621308417 FlowRequest_AV25 MsgType_AV25 17-17;
SG_MUL_VAL_ 2621308417 FlowRequest_AV24 MsgType_AV24 17-17;
SG_MUL_VAL_ 2621308417 FlowRequest_AV23 MsgType_AV23 17-17;
SG_MUL_VAL_ 2621308417 FlowRequest_AV22 MsgType_AV22 17-17;
SG_MUL_VAL_ 2621308417 FlowRequest_AV21 MsgType_AV21 17-17;
SG_MUL_VAL_ 2621308417 FlowRequest_AV20 MsgType_AV20 17-17;
SG_MUL_VAL_ 2621308417 FlowRequest_AV19 MsgType_AV19 17-17;
SG_MUL_VAL_ 2621308417 FlowRequest_AV18 MsgType_AV18 17-17;
SG_MUL_VAL_ 2621308417 FlowRequest_AV17 MsgType_AV17 17-17;
SG_MUL_VAL_ 2621308417 FlowRequest_AV16 MsgType_AV16 17-17;
SG_MUL_VAL_ 2621308417 FlowRequest_AV15 MsgType_AV15 17-17;
SG_MUL_VAL_ 2621308417 FlowRequest_AV14 MsgType_AV14 17-17;
SG_MUL_VAL_ 2621308417 FlowRequest_AV13 MsgType_AV13 17-17;
SG_MUL_VAL_ 2621308417 FlowRequest_AV12 MsgType_AV12 17-17;
SG_MUL_VAL_ 2621308417 FlowRequest_AV11 MsgType_AV11 17-17;
SG_MUL_VAL_ 2621308417 FlowRequest_AV10 MsgType_AV10 17-17;
SG_MUL_VAL_ 2621308417 FlowRequest_AV09 MsgType_AV09 17-17;
SG_MUL_VAL_ 2621308417 FlowRequest_AV08 MsgType_AV08 17-17;
SG_MUL_VAL_ 2621308417 FlowRequest_AV07 MsgType_AV07 17-17;
SG_MUL_VAL_ 2621308417 FlowRequest_AV06 MsgType_AV06 17-17;
SG_MUL_VAL_ 2621308417 FlowRequest_AV05 MsgType_AV05 17-17;
SG_MUL_VAL_ 2621308417 FlowRequest_AV04 MsgType_AV04 17-17;
SG_MUL_VAL_ 2621308417 FlowRequest_AV03 MsgType_AV03 17-17;
SG_MUL_VAL_ 2621308417 FlowRequest_AV02 MsgType_AV02 17-17;
SG_MUL_VAL_ 2621308417 PositionRequest_RH MsgType_RH 17-17;
SG_MUL_VAL_ 2621308417 OutputShaftSpeedRequest_RPTO MsgType_RPTO 17-17;
SG_MUL_VAL_ 2621308417 CurvatureRequest_EG MsgType_EG 17-17;
SG_MUL_VAL_ 2621308417 VehicleSpeedRequest_VS MsgType_VS 17-17;
SG_MUL_VAL_ 2621308417 PositionRequest_FH MsgType_FH 17-17;
SG_MUL_VAL_ 2621308417 OutputShaftSpeedRequest_FPTO MsgType_FPTO 17-17;
SG_MUL_VAL_ 2621308417 FlowRequest_AV01 MsgType_AV01 17-17;
SG_MUL_VAL_ 2619670019 TIMMessageType GroupFunctionValue 1-32, 64-68, 70-70;
SG_MUL_VAL_ 2619670018 TIMMessageType GroupFunctionValue 1-32, 64-68, 70-70;
