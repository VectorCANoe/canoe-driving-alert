VERSION ""

NS_ :

BS_:

BU_: TIMServer TIMClient3 TIMClient2 TIMClient1 DiagnosticNode
VAL_TABLE_ TIM_AuthErrorCode 39 "LwAPossibleBitMismatch" 38 "AuthenticationAbortedDueToGeneralPeerError" 37 "AuthenticationAbortedByPeerDueToError" 36 "ChallengeDataCorrupt" 35 "InvalidChallengeLength" 34 "FunctionFacilityNotCertified" 33 "RequestNotAllowed" 32 "Reserved_0x20" 31 "AuthenticationTimeout" 30 "CertificateTypeInvalid" 29 "DeviceCertificateRevoked" 28 "ManufacturerSeriesCertificateRevoked" 27 "ManufacturerCertificateRevoked" 26 "LabCertificateRevoked" 25 "RootCertificateRevoked" 24 "CertificateTypeMismatch" 23 "CertificateChainInvalid" 22 "ECU_CCID_Mismatch" 21 "NAME_Mismatch" 20 "ECC_PublicKeyValidationFailed" 19 "UnexpectedRestartAuthenticationBitSet" 18 "AuthenticationStatusInvalid" 17 "AuthenticationTypeNotSupported" 16 "AuthenticationStatusLost" 15 "DeviceCertificateDataCorrupt" 14 "ManufacturerSeriesCertificateDataCorrupt" 13 "ManufacturerCertificateDataCorrupt" 12 "TestLabCertificateDataCorrupt" 11 "RootCertificateDataCorrupt" 10 "InternalError" 9 "ChallengesDontMatch" 8 "DeviceCertificateSignatureInvalid" 7 "ManufacturerSeriesCertificateSignatureInvalid" 6 "ManufacturerCertificateSignatureInvalid" 5 "LabCertificateSignatureInvalid" 4 "RootCertificateSignatureInvalid" 3 "NotAuthenticationServerOrClient" 2 "CertificateFormatNotSupported" 1 "ParticipantBusy" 0 "NoError" ;
VAL_TABLE_ TIM_CertificateType 255 "NotAvailable" 6 "CRLCertificate" 5 "CRLSigningCertificate" 4 "DeviceCertificate" 3 "ManufacturerSeriesCertificate" 2 "ManufacturerCertificate" 1 "TestlabCertificate" 0 "AEFRootCertificate" ;
VAL_TABLE_ NetworkInterconnUnitParametrics 16 "NetworkInterconnectionUnitType" 15 "NumberOfPorts" 14 "UptimeSinceLastPowerOnReset " 13 "AverageNumOfMsgsFilteredPerSec" 12 "AverageNumOfMsgsForwardedPerSec" 11 "AverageNumOfMsgsReceivedPerSec" 10 "NumOfMsgsWithExcessTransitDelayTime " 9 "NumOfMsgsLostDueToBufferOverflow " 8 "AverageTransitDelayTime" 7 "MaxTransitDelayTime" 6 "MaxNumOfMsgsFilteredPerSec" 5 "MaxNumOfMsgsForwardedPerSec" 4 "MaxNumOfMsgsReceivedPerSec" 3 "NumberOfFilterDatabaseEntries" 2 "MaxFilterDatabaseSize" 1 "BufferSize" 0 "RequestAllParameters" ;
VAL_TABLE_ FMI 0 "Above normal (most severe)" 1 "Below normal (most severe)" 2 "Data erratic" 3 "Voltage above normal" 4 "Voltage below normal" 5 "Current below normal" 6 "Current above normal" 7 "Mechanical system not responding" 8 "Abnormal frequency" 9 "Abnormal update rate" 10 "Abnormal rate of change" 11 "Root cause not known" 12 "Bad intelligent device" 13 "Out of calibration" 14 "Special intstructions" 15 "Above normal (least severe)" 16 "Above normal (moderately severe)" 17 "Below normal (least severe)" 18 "Below normal (moderately severe)" 19 "Received network data in error" 31 "Condition exists" 20 "Data drifted high" 21 "Data drifted low" ;

BO_ 2621243117 TIM12_CS_TIMServer: 16 TIMServer
 SG_ SecurityByte_VS m1 : 56|8@1+ (1,0) [0|255] "" Vector__XXX
 SG_ SecurityByte_RTL m1 : 56|8@1+ (1,0) [0|255] "" Vector__XXX
 SG_ SecurityByte_RPTO m1 : 56|8@1+ (1,0) [0|255] "" Vector__XXX
 SG_ SecurityByte_RH m1 : 56|8@1+ (1,0) [0|255] "" Vector__XXX
 SG_ SecurityByte_FTL m1 : 56|8@1+ (1,0) [0|255] "" Vector__XXX
 SG_ SecurityByte_FPTO m1 : 56|8@1+ (1,0) [0|255] "" Vector__XXX
 SG_ SecurityByte_FH m1 : 56|8@1+ (1,0) [0|255] "" Vector__XXX
 SG_ SecurityByte_EG m1 : 56|8@1+ (1,0) [0|255] "" Vector__XXX
 SG_ SecurityByte_AV32 m1 : 56|8@1+ (1,0) [0|255] "" Vector__XXX
 SG_ SecurityByte_AV31 m1 : 56|8@1+ (1,0) [0|255] "" Vector__XXX
 SG_ SecurityByte_AV30 m1 : 56|8@1+ (1,0) [0|255] "" Vector__XXX
 SG_ SecurityByte_AV29 m1 : 56|8@1+ (1,0) [0|255] "" Vector__XXX
 SG_ SecurityByte_AV28 m1 : 56|8@1+ (1,0) [0|255] "" Vector__XXX
 SG_ SecurityByte_AV27 m1 : 56|8@1+ (1,0) [0|255] "" Vector__XXX
 SG_ SecurityByte_AV26 m1 : 56|8@1+ (1,0) [0|255] "" Vector__XXX
 SG_ SecurityByte_AV25 m1 : 56|8@1+ (1,0) [0|255] "" Vector__XXX
 SG_ SecurityByte_AV24 m1 : 56|8@1+ (1,0) [0|255] "" Vector__XXX
 SG_ SecurityByte_AV23 m1 : 56|8@1+ (1,0) [0|255] "" Vector__XXX
 SG_ SecurityByte_AV22 m1 : 56|8@1+ (1,0) [0|255] "" Vector__XXX
 SG_ SecurityByte_AV21 m1 : 56|8@1+ (1,0) [0|255] "" Vector__XXX
 SG_ SecurityByte_AV20 m1 : 56|8@1+ (1,0) [0|255] "" Vector__XXX
 SG_ SecurityByte_AV19 m1 : 56|8@1+ (1,0) [0|255] "" Vector__XXX
 SG_ SecurityByte_AV18 m1 : 56|8@1+ (1,0) [0|255] "" Vector__XXX
 SG_ SecurityByte_AV17 m1 : 56|8@1+ (1,0) [0|255] "" Vector__XXX
 SG_ SecurityByte_AV16 m1 : 56|8@1+ (1,0) [0|255] "" Vector__XXX
 SG_ SecurityByte_AV15 m1 : 56|8@1+ (1,0) [0|255] "" Vector__XXX
 SG_ SecurityByte_AV14 m1 : 56|8@1+ (1,0) [0|255] "" Vector__XXX
 SG_ SecurityByte_AV13 m1 : 56|8@1+ (1,0) [0|255] "" Vector__XXX
 SG_ SecurityByte_AV12 m1 : 56|8@1+ (1,0) [0|255] "" Vector__XXX
 SG_ SecurityByte_AV11 m1 : 56|8@1+ (1,0) [0|255] "" Vector__XXX
 SG_ SecurityByte_AV10 m1 : 56|8@1+ (1,0) [0|255] "" Vector__XXX
 SG_ SecurityByte_AV09 m1 : 56|8@1+ (1,0) [0|255] "" Vector__XXX
 SG_ SecurityByte_AV08 m1 : 56|8@1+ (1,0) [0|255] "" Vector__XXX
 SG_ SecurityByte_AV07 m1 : 56|8@1+ (1,0) [0|255] "" Vector__XXX
 SG_ SecurityByte_AV06 m1 : 56|8@1+ (1,0) [0|255] "" Vector__XXX
 SG_ SecurityByte_AV05 m1 : 56|8@1+ (1,0) [0|255] "" Vector__XXX
 SG_ SecurityByte_AV04 m1 : 56|8@1+ (1,0) [0|255] "" Vector__XXX
 SG_ SecurityByte_AV03 m1 : 56|8@1+ (1,0) [0|255] "" Vector__XXX
 SG_ SecurityByte_AV02 m1 : 56|8@1+ (1,0) [0|255] "" Vector__XXX
 SG_ SecurityByte_AV01 m1 : 56|8@1+ (1,0) [0|255] "" Vector__XXX
 SG_ State_RH m17 : 48|4@1+ (1,0) [0|0] "" Vector__XXX
 SG_ State_RTL m17 : 48|4@1+ (1,0) [0|15] "" Vector__XXX
 SG_ State_FTL m17 : 48|4@1+ (1,0) [0|15] "" Vector__XXX
 SG_ State_FH m17 : 48|4@1+ (1,0) [0|255] "" Vector__XXX
 SG_ StrokeLength_CM1GP_RTL m0 : 56|16@1+ (1,0.01) [0|65535] "%" Vector__XXX
 SG_ BaseLength_CM1GP_RTL m0 : 40|16@1+ (1,0.01) [0|65535] "%" Vector__XXX
 SG_ StrokeLength_CM1GP_FTL m0 : 56|16@1+ (1,0.01) [0|65535] "%" Vector__XXX
 SG_ BaseLength_CM1GP_FTL m0 : 40|16@1+ (1,0.01) [0|65535] "%" Vector__XXX
 SG_ MinimumSpeedBackward_CM1GP_VS m0 : 80|16@1+ (0.001,-32.128) [-32.128|33.407] "m/s" Vector__XXX
 SG_ MaximumSpeedBackward_CM1GP_VS m0 : 96|16@1+ (0.001,-32.128) [-32.128|33.407] "m/s" Vector__XXX
 SG_ MinimumSpeedForward_CM1GP_VS m0 : 48|16@1+ (0.001,-32.128) [-32.128|33.407] "m/s" Vector__XXX
 SG_ MaximumSpeedForward_CM1GP_VS m0 : 64|16@1+ (0.001,-32.128) [-32.128|33.407] "m/s" Vector__XXX
 SG_ TransmissionType_CM1GP_VS m0 : 40|8@1+ (1,0) [0|255] "" Vector__XXX
 SG_ ControlMode1_RTL m0M : 24|4@1+ (1,0) [0|15] "" Vector__XXX
 SG_ NumOfControlModes_RTL m0 : 16|4@1+ (1,0) [0|15] "" Vector__XXX
 SG_ NumOfBytes_CM1_RTL m0 : 32|8@1+ (1,0) [0|255] "" Vector__XXX
 SG_ Position_RTL m17M : 32|16@1+ (0.01,0) [0|100] "%" Vector__XXX
 SG_ Position_FTL m17 : 32|16@1+ (0.01,0) [0|100] "%" Vector__XXX
 SG_ ExitReasonCode_RTL m1 : 27|5@1+ (1,0) [0|0] "" Vector__XXX
 SG_ ExitReasonCode_FTL m1 : 27|5@1+ (1,0) [0|0] "" Vector__XXX
 SG_ AutomationStatus_RTL m1 : 16|4@1+ (1,0) [0|0] "" Vector__XXX
 SG_ AutomationStatus_FTL m1 : 16|4@1+ (1,0) [0|0] "" Vector__XXX
 SG_ ControlMode1_FTL m0M : 24|4@1+ (1,0) [0|15] "" Vector__XXX
 SG_ NumOfBytes_CM1_FTL m0 : 32|8@1+ (1,0) [0|255] "" Vector__XXX
 SG_ NumOfControlModes_FTL m0 : 16|4@1+ (1,0) [0|15] "" Vector__XXX
 SG_ MsgType_RTL m72M : 8|8@1+ (1,0) [0|255] "" Vector__XXX
 SG_ MsgType_FTL m71M : 8|8@1+ (1,0) [0|255] "" Vector__XXX
 SG_ MsgType_EG m70M : 8|8@1+ (1,0) [0|255] "" Vector__XXX
 SG_ NumOfBytes_CM1_VS m0 : 32|8@1+ (1,0) [0|255] "" Vector__XXX
 SG_ ControlMode1_VS m0M : 24|4@1+ (1,0) [0|15] "" Vector__XXX
 SG_ NumOfControlModes_VS m0 : 16|4@1+ (1,0) [0|15] "" Vector__XXX
 SG_ MsgType_VS m68M : 8|8@1+ (1,0) [0|255] "" Vector__XXX
 SG_ MsgType_RH m67M : 8|8@1+ (1,0) [0|255] "" Vector__XXX
 SG_ MsgType_FH m66M : 8|8@1+ (1,0) [0|255] "" Vector__XXX
 SG_ MsgType_RPTO m65M : 8|8@1+ (1,0) [0|255] "" Vector__XXX
 SG_ MsgType_FPTO m64M : 8|8@1+ (1,0) [0|255] "" Vector__XXX
 SG_ MsgType_AV32 m32M : 8|8@1+ (1,0) [0|255] "" Vector__XXX
 SG_ MsgType_AV31 m31M : 8|8@1+ (1,0) [0|255] "" Vector__XXX
 SG_ MsgType_AV30 m30M : 8|8@1+ (1,0) [0|255] "" Vector__XXX
 SG_ MsgType_AV29 m29M : 8|8@1+ (1,0) [0|255] "" Vector__XXX
 SG_ MsgType_AV28 m28M : 8|8@1+ (1,0) [0|255] "" Vector__XXX
 SG_ MsgType_AV27 m27M : 8|8@1+ (1,0) [0|255] "" Vector__XXX
 SG_ MsgType_AV26 m26M : 8|8@1+ (1,0) [0|255] "" Vector__XXX
 SG_ MsgType_AV25 m25M : 8|8@1+ (1,0) [0|255] "" Vector__XXX
 SG_ MsgType_AV24 m24M : 8|8@1+ (1,0) [0|255] "" Vector__XXX
 SG_ MsgType_AV23 m23M : 8|8@1+ (1,0) [0|255] "" Vector__XXX
 SG_ MsgType_AV22 m22M : 8|8@1+ (1,0) [0|255] "" Vector__XXX
 SG_ MsgType_AV21 m21M : 8|8@1+ (1,0) [0|255] "" Vector__XXX
 SG_ MsgType_AV20 m20M : 8|8@1+ (1,0) [0|255] "" Vector__XXX
 SG_ MsgType_AV19 m19M : 8|8@1+ (1,0) [0|255] "" Vector__XXX
 SG_ MsgType_AV18 m18M : 8|8@1+ (1,0) [0|255] "" Vector__XXX
 SG_ MsgType_AV17 m17M : 8|8@1+ (1,0) [0|255] "" Vector__XXX
 SG_ MsgType_AV16 m16M : 8|8@1+ (1,0) [0|255] "" Vector__XXX
 SG_ MsgType_AV15 m15M : 8|8@1+ (1,0) [0|255] "" Vector__XXX
 SG_ MsgType_AV14 m14M : 8|8@1+ (1,0) [0|255] "" Vector__XXX
 SG_ MsgType_AV13 m13M : 8|8@1+ (1,0) [0|255] "" Vector__XXX
 SG_ MsgType_AV12 m12M : 8|8@1+ (1,0) [0|255] "" Vector__XXX
 SG_ MsgType_AV11 m11M : 8|8@1+ (1,0) [0|255] "" Vector__XXX
 SG_ MsgType_AV10 m10M : 8|8@1+ (1,0) [0|255] "" Vector__XXX
 SG_ MsgType_AV09 m9M : 8|8@1+ (1,0) [0|255] "" Vector__XXX
 SG_ MsgType_AV08 m8M : 8|8@1+ (1,0) [0|255] "" Vector__XXX
 SG_ MsgType_AV07 m7M : 8|8@1+ (1,0) [0|255] "" Vector__XXX
 SG_ MsgType_AV06 m6M : 8|8@1+ (1,0) [0|255] "" Vector__XXX
 SG_ MsgType_AV05 m5M : 8|8@1+ (1,0) [0|255] "" Vector__XXX
 SG_ MsgType_AV04 m4M : 8|8@1+ (1,0) [0|255] "" Vector__XXX
 SG_ MsgType_AV03 m3M : 8|8@1+ (1,0) [0|255] "" Vector__XXX
 SG_ MsgType_AV02 m2M : 8|8@1+ (1,0) [0|255] "" Vector__XXX
 SG_ MsgType_AV01 m1M : 8|8@1+ (1,0) [0|255] "" Vector__XXX
 SG_ Position_RH m17 : 32|16@1+ (0.01,0) [0|100] "%" Vector__XXX
 SG_ Speed_RPTO m17 : 32|16@1+ (0.125,-4016) [0|0] "1/min" Vector__XXX
 SG_ Flow_AV32 m17 : 32|16@1+ (0.004,-128.512) [0|0] "%" Vector__XXX
 SG_ Flow_AV31 m17 : 32|16@1+ (0.004,-128.512) [0|0] "%" Vector__XXX
 SG_ Flow_AV30 m17 : 32|16@1+ (0.004,-128.512) [0|0] "%" Vector__XXX
 SG_ Flow_AV29 m17 : 32|16@1+ (0.004,-128.512) [0|0] "%" Vector__XXX
 SG_ Flow_AV28 m17 : 32|16@1+ (0.004,-128.512) [0|0] "%" Vector__XXX
 SG_ Flow_AV27 m17 : 32|16@1+ (0.004,-128.512) [0|0] "%" Vector__XXX
 SG_ Flow_AV26 m17 : 32|16@1+ (0.004,-128.512) [0|0] "%" Vector__XXX
 SG_ Flow_AV25 m17 : 32|16@1+ (0.004,-128.512) [0|0] "%" Vector__XXX
 SG_ Flow_AV24 m17 : 32|16@1+ (0.004,-128.512) [0|0] "%" Vector__XXX
 SG_ Flow_AV23 m17 : 32|16@1+ (0.004,-128.512) [0|0] "%" Vector__XXX
 SG_ Flow_AV22 m17 : 32|16@1+ (0.004,-128.512) [0|0] "%" Vector__XXX
 SG_ Flow_AV21 m17 : 32|16@1+ (0.004,-128.512) [0|0] "%" Vector__XXX
 SG_ Flow_AV20 m17 : 32|16@1+ (0.004,-128.512) [0|0] "%" Vector__XXX
 SG_ Flow_AV19 m17 : 32|16@1+ (0.004,-128.512) [0|0] "%" Vector__XXX
 SG_ Flow_AV18 m17 : 32|16@1+ (0.004,-128.512) [0|0] "%" Vector__XXX
 SG_ Flow_AV17 m17 : 32|16@1+ (0.004,-128.512) [0|0] "%" Vector__XXX
 SG_ Flow_AV16 m17 : 32|16@1+ (0.004,-128.512) [0|0] "%" Vector__XXX
 SG_ Flow_AV15 m17 : 32|16@1+ (0.004,-128.512) [0|0] "%" Vector__XXX
 SG_ Flow_AV14 m17 : 32|16@1+ (0.004,-128.512) [0|0] "%" Vector__XXX
 SG_ Flow_AV13 m17 : 32|16@1+ (0.004,-128.512) [0|0] "%" Vector__XXX
 SG_ Flow_AV12 m17 : 32|16@1+ (0.004,-128.512) [0|0] "%" Vector__XXX
 SG_ Flow_AV11 m17 : 32|16@1+ (0.004,-128.512) [0|0] "%" Vector__XXX
 SG_ Flow_AV10 m17 : 32|16@1+ (0.004,-128.512) [0|0] "%" Vector__XXX
 SG_ Flow_AV09 m17 : 32|16@1+ (0.004,-128.512) [0|0] "%" Vector__XXX
 SG_ Flow_AV08 m17 : 32|16@1+ (0.004,-128.512) [0|0] "%" Vector__XXX
 SG_ Flow_AV07 m17 : 32|16@1+ (0.004,-128.512) [0|0] "%" Vector__XXX
 SG_ Flow_AV06 m17 : 32|16@1+ (0.004,-128.512) [0|0] "%" Vector__XXX
 SG_ Flow_AV05 m17 : 32|16@1+ (0.004,-128.512) [0|0] "%" Vector__XXX
 SG_ Flow_AV04 m17 : 32|16@1+ (0.004,-128.512) [0|0] "%" Vector__XXX
 SG_ Flow_AV03 m17 : 32|16@1+ (0.004,-128.512) [0|0] "%" Vector__XXX
 SG_ Flow_AV02 m17 : 32|16@1+ (0.004,-128.512) [0|0] "%" Vector__XXX
 SG_ FlowType_AV32 m1 : 24|2@1+ (1,0) [0|0] "" Vector__XXX
 SG_ FlowType_AV31 m1 : 24|2@1+ (1,0) [0|0] "" Vector__XXX
 SG_ FlowType_AV30 m1 : 24|2@1+ (1,0) [0|0] "" Vector__XXX
 SG_ FlowType_AV29 m1 : 24|2@1+ (1,0) [0|0] "" Vector__XXX
 SG_ FlowType_AV28 m1 : 24|2@1+ (1,0) [0|0] "" Vector__XXX
 SG_ FlowType_AV27 m1 : 24|2@1+ (1,0) [0|0] "" Vector__XXX
 SG_ FlowType_AV26 m1 : 24|2@1+ (1,0) [0|0] "" Vector__XXX
 SG_ FlowType_AV25 m1 : 24|2@1+ (1,0) [0|0] "" Vector__XXX
 SG_ FlowType_AV24 m1 : 24|2@1+ (1,0) [0|0] "" Vector__XXX
 SG_ FlowType_AV23 m1 : 24|2@1+ (1,0) [0|0] "" Vector__XXX
 SG_ FlowType_AV22 m1 : 24|2@1+ (1,0) [0|0] "" Vector__XXX
 SG_ FlowType_AV21 m1 : 24|2@1+ (1,0) [0|0] "" Vector__XXX
 SG_ FlowType_AV20 m1 : 24|2@1+ (1,0) [0|0] "" Vector__XXX
 SG_ FlowType_AV19 m1 : 24|2@1+ (1,0) [0|0] "" Vector__XXX
 SG_ FlowType_AV18 m1 : 24|2@1+ (1,0) [0|0] "" Vector__XXX
 SG_ FlowType_AV17 m1 : 24|2@1+ (1,0) [0|0] "" Vector__XXX
 SG_ FlowType_AV16 m1 : 24|2@1+ (1,0) [0|0] "" Vector__XXX
 SG_ FlowType_AV15 m1 : 24|2@1+ (1,0) [0|0] "" Vector__XXX
 SG_ FlowType_AV14 m1 : 24|2@1+ (1,0) [0|0] "" Vector__XXX
 SG_ FlowType_AV13 m1 : 24|2@1+ (1,0) [0|0] "" Vector__XXX
 SG_ FlowType_AV12 m1 : 24|2@1+ (1,0) [0|0] "" Vector__XXX
 SG_ FlowType_AV11 m1 : 24|2@1+ (1,0) [0|0] "" Vector__XXX
 SG_ FlowType_AV10 m1 : 24|2@1+ (1,0) [0|0] "" Vector__XXX
 SG_ FlowType_AV09 m1 : 24|2@1+ (1,0) [0|0] "" Vector__XXX
 SG_ FlowType_AV08 m1 : 24|2@1+ (1,0) [0|0] "" Vector__XXX
 SG_ FlowType_AV07 m1 : 24|2@1+ (1,0) [0|0] "" Vector__XXX
 SG_ FlowType_AV06 m1 : 24|2@1+ (1,0) [0|0] "" Vector__XXX
 SG_ FlowType_AV05 m1 : 24|2@1+ (1,0) [0|0] "" Vector__XXX
 SG_ FlowType_AV04 m1 : 24|2@1+ (1,0) [0|0] "" Vector__XXX
 SG_ FlowType_AV03 m1 : 24|2@1+ (1,0) [0|0] "" Vector__XXX
 SG_ FlowType_AV02 m1 : 24|2@1+ (1,0) [0|0] "" Vector__XXX
 SG_ FlowType_AV01 m1 : 24|2@1+ (1,0) [0|0] "" Vector__XXX
 SG_ ExitReasonCode_RPTO m1 : 27|5@1+ (1,0) [0|0] "" Vector__XXX
 SG_ ExitReasonCode_RH m1 : 27|5@1+ (1,0) [0|0] "" Vector__XXX
 SG_ ExitReasonCode_AV32 m1 : 27|5@1+ (1,0) [0|0] "" Vector__XXX
 SG_ ExitReasonCode_AV31 m1 : 27|5@1+ (1,0) [0|0] "" Vector__XXX
 SG_ ExitReasonCode_AV30 m1 : 27|5@1+ (1,0) [0|0] "" Vector__XXX
 SG_ ExitReasonCode_AV29 m1 : 27|5@1+ (1,0) [0|0] "" Vector__XXX
 SG_ ExitReasonCode_AV28 m1 : 27|5@1+ (1,0) [0|0] "" Vector__XXX
 SG_ ExitReasonCode_AV27 m1 : 27|5@1+ (1,0) [0|0] "" Vector__XXX
 SG_ ExitReasonCode_AV26 m1 : 27|5@1+ (1,0) [0|0] "" Vector__XXX
 SG_ ExitReasonCode_AV25 m1 : 27|5@1+ (1,0) [0|0] "" Vector__XXX
 SG_ ExitReasonCode_AV24 m1 : 27|5@1+ (1,0) [0|0] "" Vector__XXX
 SG_ ExitReasonCode_AV23 m1 : 27|5@1+ (1,0) [0|0] "" Vector__XXX
 SG_ ExitReasonCode_AV22 m1 : 27|5@1+ (1,0) [0|0] "" Vector__XXX
 SG_ ExitReasonCode_AV21 m1 : 27|5@1+ (1,0) [0|0] "" Vector__XXX
 SG_ ExitReasonCode_AV20 m1 : 27|5@1+ (1,0) [0|0] "" Vector__XXX
 SG_ ExitReasonCode_AV19 m1 : 27|5@1+ (1,0) [0|0] "" Vector__XXX
 SG_ ExitReasonCode_AV18 m1 : 27|5@1+ (1,0) [0|0] "" Vector__XXX
 SG_ ExitReasonCode_AV17 m1 : 27|5@1+ (1,0) [0|0] "" Vector__XXX
 SG_ ExitReasonCode_AV16 m1 : 27|5@1+ (1,0) [0|0] "" Vector__XXX
 SG_ ExitReasonCode_AV15 m1 : 27|5@1+ (1,0) [0|0] "" Vector__XXX
 SG_ ExitReasonCode_AV14 m1 : 27|5@1+ (1,0) [0|0] "" Vector__XXX
 SG_ ExitReasonCode_AV13 m1 : 27|5@1+ (1,0) [0|0] "" Vector__XXX
 SG_ ExitReasonCode_AV12 m1 : 27|5@1+ (1,0) [0|0] "" Vector__XXX
 SG_ ExitReasonCode_AV11 m1 : 27|5@1+ (1,0) [0|0] "" Vector__XXX
 SG_ ExitReasonCode_AV10 m1 : 27|5@1+ (1,0) [0|0] "" Vector__XXX
 SG_ ExitReasonCode_AV09 m1 : 27|5@1+ (1,0) [0|0] "" Vector__XXX
 SG_ ExitReasonCode_AV08 m1 : 27|5@1+ (1,0) [0|0] "" Vector__XXX
 SG_ ExitReasonCode_AV07 m1 : 27|5@1+ (1,0) [0|0] "" Vector__XXX
 SG_ ExitReasonCode_AV06 m1 : 27|5@1+ (1,0) [0|0] "" Vector__XXX
 SG_ ExitReasonCode_AV05 m1 : 27|5@1+ (1,0) [0|0] "" Vector__XXX
 SG_ ExitReasonCode_AV04 m1 : 27|5@1+ (1,0) [0|0] "" Vector__XXX
 SG_ ExitReasonCode_AV03 m1 : 27|5@1+ (1,0) [0|0] "" Vector__XXX
 SG_ ExitReasonCode_AV02 m1 : 27|5@1+ (1,0) [0|0] "" Vector__XXX
 SG_ AutomationStatus_AV04 m1 : 16|4@1+ (1,0) [0|0] "" Vector__XXX
 SG_ AutomationStatus_AV03 m1 : 16|4@1+ (1,0) [0|0] "" Vector__XXX
 SG_ AutomationStatus_AV02 m1 : 16|4@1+ (1,0) [0|0] "" Vector__XXX
 SG_ AutomationStatus_AV01 m1 : 16|4@1+ (1,0) [0|0] "" Vector__XXX
 SG_ AutomationStatus_EG m1 : 16|4@1+ (1,0) [0|0] "" Vector__XXX
 SG_ AutomationStatus_VS m1 : 16|4@1+ (1,0) [0|0] "" Vector__XXX
 SG_ AutomationStatus_RH m1 : 16|4@1+ (1,0) [0|0] "" Vector__XXX
 SG_ AutomationStatus_FH m1 : 16|4@1+ (1,0) [0|0] "" Vector__XXX
 SG_ AutomationStatus_RPTO m1 : 16|4@1+ (1,0) [0|0] "" Vector__XXX
 SG_ AutomationStatus_FPTO m1 : 16|4@1+ (1,0) [0|0] "" Vector__XXX
 SG_ AutomationStatus_AV32 m1 : 16|4@1+ (1,0) [0|0] "" Vector__XXX
 SG_ AutomationStatus_AV31 m1 : 16|4@1+ (1,0) [0|0] "" Vector__XXX
 SG_ AutomationStatus_AV30 m1 : 16|4@1+ (1,0) [0|0] "" Vector__XXX
 SG_ AutomationStatus_AV29 m1 : 16|4@1+ (1,0) [0|0] "" Vector__XXX
 SG_ AutomationStatus_AV28 m1 : 16|4@1+ (1,0) [0|0] "" Vector__XXX
 SG_ AutomationStatus_AV27 m1 : 16|4@1+ (1,0) [0|0] "" Vector__XXX
 SG_ AutomationStatus_AV26 m1 : 16|4@1+ (1,0) [0|0] "" Vector__XXX
 SG_ AutomationStatus_AV25 m1 : 16|4@1+ (1,0) [0|0] "" Vector__XXX
 SG_ AutomationStatus_AV24 m1 : 16|4@1+ (1,0) [0|0] "" Vector__XXX
 SG_ AutomationStatus_AV23 m1 : 16|4@1+ (1,0) [0|0] "" Vector__XXX
 SG_ AutomationStatus_AV22 m1 : 16|4@1+ (1,0) [0|0] "" Vector__XXX
 SG_ AutomationStatus_AV21 m1 : 16|4@1+ (1,0) [0|0] "" Vector__XXX
 SG_ AutomationStatus_AV20 m1 : 16|4@1+ (1,0) [0|0] "" Vector__XXX
 SG_ AutomationStatus_AV19 m1 : 16|4@1+ (1,0) [0|0] "" Vector__XXX
 SG_ AutomationStatus_AV18 m1 : 16|4@1+ (1,0) [0|0] "" Vector__XXX
 SG_ AutomationStatus_AV17 m1 : 16|4@1+ (1,0) [0|0] "" Vector__XXX
 SG_ AutomationStatus_AV16 m1 : 16|4@1+ (1,0) [0|0] "" Vector__XXX
 SG_ AutomationStatus_AV15 m1 : 16|4@1+ (1,0) [0|0] "" Vector__XXX
 SG_ AutomationStatus_AV14 m1 : 16|4@1+ (1,0) [0|0] "" Vector__XXX
 SG_ AutomationStatus_AV13 m1 : 16|4@1+ (1,0) [0|0] "" Vector__XXX
 SG_ AutomationStatus_AV12 m1 : 16|4@1+ (1,0) [0|0] "" Vector__XXX
 SG_ AutomationStatus_AV11 m1 : 16|4@1+ (1,0) [0|0] "" Vector__XXX
 SG_ AutomationStatus_AV10 m1 : 16|4@1+ (1,0) [0|0] "" Vector__XXX
 SG_ AutomationStatus_AV09 m1 : 16|4@1+ (1,0) [0|0] "" Vector__XXX
 SG_ AutomationStatus_AV08 m1 : 16|4@1+ (1,0) [0|0] "" Vector__XXX
 SG_ AutomationStatus_AV07 m1 : 16|4@1+ (1,0) [0|0] "" Vector__XXX
 SG_ AutomationStatus_AV06 m1 : 16|4@1+ (1,0) [0|0] "" Vector__XXX
 SG_ AutomationStatus_AV05 m1 : 16|4@1+ (1,0) [0|0] "" Vector__XXX
 SG_ Curvature_EG m17 : 32|16@1+ (0.25,-8032) [-8032|8031.75] "1/km" Vector__XXX
 SG_ ExitReasonCode_EG m1 : 27|5@1+ (1,0) [0|0] "" Vector__XXX
 SG_ VehicleSpeed_VS m17 : 32|16@1+ (0.001,-32.128) [-32.127|32.127] "m/s" Vector__XXX
 SG_ ExitReasonCode_VS m1 : 27|5@1+ (1,0) [0|0] "" Vector__XXX
 SG_ Position_FH m17 : 32|16@1+ (0.01,0) [0|100] "%" Vector__XXX
 SG_ ExitReasonCode_FH m1 : 27|5@1+ (1,0) [0|0] "" Vector__XXX
 SG_ Speed_FPTO m17 : 32|16@1+ (0.125,-4016) [0|0] "1/min" Vector__XXX
 SG_ ExitReasonCode_FPTO m1 : 27|5@1+ (1,0) [0|0] "" Vector__XXX
 SG_ Flow_AV01 m17 : 32|16@1+ (0.004,-128.512) [0|0] "%" Vector__XXX
 SG_ ExitReasonCode_AV01 m1 : 27|5@1+ (1,0) [0|0] "" Vector__XXX
 SG_ TIMFunctionID M : 0|8@1+ (1,0) [0|255] "" Vector__XXX

BO_ 2619604717 TIM12_TIMServer: 16 TIMServer
 SG_ GroupFunctionValue M : 0|8@1+ (1,0) [0|0] "" Vector__XXX
 SG_ RearHitchPosition m67 : 32|16@1+ (0.01,0) [0|100] "%" Vector__XXX
 SG_ RearPTOSpeed m65 : 32|16@1+ (0.125,-4016) [0|0] "1/min" Vector__XXX
 SG_ FlowAuxValve32 m32 : 32|16@1+ (0.004,-128.512) [0|0] "%" Vector__XXX
 SG_ FlowAuxValve31 m31 : 32|16@1+ (0.004,-128.512) [0|0] "%" Vector__XXX
 SG_ FlowAuxValve30 m30 : 32|16@1+ (0.004,-128.512) [0|0] "%" Vector__XXX
 SG_ FlowAuxValve29 m29 : 32|16@1+ (0.004,-128.512) [0|0] "%" Vector__XXX
 SG_ FlowAuxValve28 m28 : 32|16@1+ (0.004,-128.512) [0|0] "%" Vector__XXX
 SG_ FlowAuxValve27 m27 : 32|16@1+ (0.004,-128.512) [0|0] "%" Vector__XXX
 SG_ FlowAuxValve26 m26 : 32|16@1+ (0.004,-128.512) [0|0] "%" Vector__XXX
 SG_ FlowAuxValve25 m25 : 32|16@1+ (0.004,-128.512) [0|0] "%" Vector__XXX
 SG_ FlowAuxValve24 m24 : 32|16@1+ (0.004,-128.512) [0|0] "%" Vector__XXX
 SG_ FlowAuxValve23 m23 : 32|16@1+ (0.004,-128.512) [0|0] "%" Vector__XXX
 SG_ FlowAuxValve22 m22 : 32|16@1+ (0.004,-128.512) [0|0] "%" Vector__XXX
 SG_ FlowAuxValve21 m21 : 32|16@1+ (0.004,-128.512) [0|0] "%" Vector__XXX
 SG_ FlowAuxValve20 m20 : 32|16@1+ (0.004,-128.512) [0|0] "%" Vector__XXX
 SG_ FlowAuxValve19 m19 : 32|16@1+ (0.004,-128.512) [0|0] "%" Vector__XXX
 SG_ FlowAuxValve18 m18 : 32|16@1+ (0.004,-128.512) [0|0] "%" Vector__XXX
 SG_ FlowAuxValve17 m17 : 32|16@1+ (0.004,-128.512) [0|0] "%" Vector__XXX
 SG_ FlowAuxValve16 m16 : 32|16@1+ (0.004,-128.512) [0|0] "%" Vector__XXX
 SG_ FlowAuxValve15 m15 : 32|16@1+ (0.004,-128.512) [0|0] "%" Vector__XXX
 SG_ FlowAuxValve14 m14 : 32|16@1+ (0.004,-128.512) [0|0] "%" Vector__XXX
 SG_ FlowAuxValve13 m13 : 32|16@1+ (0.004,-128.512) [0|0] "%" Vector__XXX
 SG_ FlowAuxValve12 m12 : 32|16@1+ (0.004,-128.512) [0|0] "%" Vector__XXX
 SG_ FlowAuxValve11 m11 : 32|16@1+ (0.004,-128.512) [0|0] "%" Vector__XXX
 SG_ FlowAuxValve10 m10 : 32|16@1+ (0.004,-128.512) [0|0] "%" Vector__XXX
 SG_ FlowAuxValve09 m9 : 32|16@1+ (0.004,-128.512) [0|0] "%" Vector__XXX
 SG_ FlowAuxValve08 m8 : 32|16@1+ (0.004,-128.512) [0|0] "%" Vector__XXX
 SG_ FlowAuxValve07 m7 : 32|16@1+ (0.004,-128.512) [0|0] "%" Vector__XXX
 SG_ FlowAuxValve06 m6 : 32|16@1+ (0.004,-128.512) [0|0] "%" Vector__XXX
 SG_ FlowAuxValve05 m5 : 32|16@1+ (0.004,-128.512) [0|0] "%" Vector__XXX
 SG_ FlowAuxValve04 m4 : 32|16@1+ (0.004,-128.512) [0|0] "%" Vector__XXX
 SG_ FlowAuxValve03 m3 : 32|16@1+ (0.004,-128.512) [0|0] "%" Vector__XXX
 SG_ FlowAuxValve02 m2 : 32|16@1+ (0.004,-128.512) [0|0] "%" Vector__XXX
 SG_ FlowTypeAuxValve32 m32 : 24|2@1+ (1,0) [0|0] "" Vector__XXX
 SG_ FlowTypeAuxValve31 m31 : 24|2@1+ (1,0) [0|0] "" Vector__XXX
 SG_ FlowTypeAuxValve30 m30 : 24|2@1+ (1,0) [0|0] "" Vector__XXX
 SG_ FlowTypeAuxValve29 m29 : 24|2@1+ (1,0) [0|0] "" Vector__XXX
 SG_ FlowTypeAuxValve28 m28 : 24|2@1+ (1,0) [0|0] "" Vector__XXX
 SG_ FlowTypeAuxValve27 m27 : 24|2@1+ (1,0) [0|0] "" Vector__XXX
 SG_ FlowTypeAuxValve26 m26 : 24|2@1+ (1,0) [0|0] "" Vector__XXX
 SG_ FlowTypeAuxValve25 m25 : 24|2@1+ (1,0) [0|0] "" Vector__XXX
 SG_ FlowTypeAuxValve24 m24 : 24|2@1+ (1,0) [0|0] "" Vector__XXX
 SG_ FlowTypeAuxValve23 m23 : 24|2@1+ (1,0) [0|0] "" Vector__XXX
 SG_ FlowTypeAuxValve22 m22 : 24|2@1+ (1,0) [0|0] "" Vector__XXX
 SG_ FlowTypeAuxValve21 m21 : 24|2@1+ (1,0) [0|0] "" Vector__XXX
 SG_ FlowTypeAuxValve20 m20 : 24|2@1+ (1,0) [0|0] "" Vector__XXX
 SG_ FlowTypeAuxValve19 m19 : 24|2@1+ (1,0) [0|0] "" Vector__XXX
 SG_ FlowTypeAuxValve18 m18 : 24|2@1+ (1,0) [0|0] "" Vector__XXX
 SG_ FlowTypeAuxValve17 m17 : 24|2@1+ (1,0) [0|0] "" Vector__XXX
 SG_ FlowTypeAuxValve16 m16 : 24|2@1+ (1,0) [0|0] "" Vector__XXX
 SG_ FlowTypeAuxValve15 m15 : 24|2@1+ (1,0) [0|0] "" Vector__XXX
 SG_ FlowTypeAuxValve14 m14 : 24|2@1+ (1,0) [0|0] "" Vector__XXX
 SG_ FlowTypeAuxValve13 m13 : 24|2@1+ (1,0) [0|0] "" Vector__XXX
 SG_ FlowTypeAuxValve12 m12 : 24|2@1+ (1,0) [0|0] "" Vector__XXX
 SG_ FlowTypeAuxValve11 m11 : 24|2@1+ (1,0) [0|0] "" Vector__XXX
 SG_ FlowTypeAuxValve10 m10 : 24|2@1+ (1,0) [0|0] "" Vector__XXX
 SG_ FlowTypeAuxValve09 m9 : 24|2@1+ (1,0) [0|0] "" Vector__XXX
 SG_ FlowTypeAuxValve08 m8 : 24|2@1+ (1,0) [0|0] "" Vector__XXX
 SG_ FlowTypeAuxValve07 m7 : 24|2@1+ (1,0) [0|0] "" Vector__XXX
 SG_ FlowTypeAuxValve06 m6 : 24|2@1+ (1,0) [0|0] "" Vector__XXX
 SG_ FlowTypeAuxValve05 m5 : 24|2@1+ (1,0) [0|0] "" Vector__XXX
 SG_ FlowTypeAuxValve04 m4 : 24|2@1+ (1,0) [0|0] "" Vector__XXX
 SG_ FlowTypeAuxValve03 m3 : 24|2@1+ (1,0) [0|0] "" Vector__XXX
 SG_ FlowTypeAuxValve02 m2 : 24|2@1+ (1,0) [0|0] "" Vector__XXX
 SG_ FlowTypeAuxValve01 m1 : 24|2@1+ (1,0) [0|0] "" Vector__XXX
 SG_ ExitReasonCodeRearPTO m65 : 27|5@1+ (1,0) [0|0] "" Vector__XXX
 SG_ ExitReasonCodeRearHitch m67 : 27|5@1+ (1,0) [0|0] "" Vector__XXX
 SG_ ExitReasonCodeAuxValve32 m32 : 27|5@1+ (1,0) [0|0] "" Vector__XXX
 SG_ ExitReasonCodeAuxValve31 m31 : 27|5@1+ (1,0) [0|0] "" Vector__XXX
 SG_ ExitReasonCodeAuxValve30 m30 : 27|5@1+ (1,0) [0|0] "" Vector__XXX
 SG_ ExitReasonCodeAuxValve29 m29 : 27|5@1+ (1,0) [0|0] "" Vector__XXX
 SG_ ExitReasonCodeAuxValve28 m28 : 27|5@1+ (1,0) [0|0] "" Vector__XXX
 SG_ ExitReasonCodeAuxValve27 m27 : 27|5@1+ (1,0) [0|0] "" Vector__XXX
 SG_ ExitReasonCodeAuxValve26 m26 : 27|5@1+ (1,0) [0|0] "" Vector__XXX
 SG_ ExitReasonCodeAuxValve25 m25 : 27|5@1+ (1,0) [0|0] "" Vector__XXX
 SG_ ExitReasonCodeAuxValve24 m24 : 27|5@1+ (1,0) [0|0] "" Vector__XXX
 SG_ ExitReasonCodeAuxValve23 m23 : 27|5@1+ (1,0) [0|0] "" Vector__XXX
 SG_ ExitReasonCodeAuxValve22 m22 : 27|5@1+ (1,0) [0|0] "" Vector__XXX
 SG_ ExitReasonCodeAuxValve21 m21 : 27|5@1+ (1,0) [0|0] "" Vector__XXX
 SG_ ExitReasonCodeAuxValve20 m20 : 27|5@1+ (1,0) [0|0] "" Vector__XXX
 SG_ ExitReasonCodeAuxValve19 m19 : 27|5@1+ (1,0) [0|0] "" Vector__XXX
 SG_ ExitReasonCodeAuxValve18 m18 : 27|5@1+ (1,0) [0|0] "" Vector__XXX
 SG_ ExitReasonCodeAuxValve17 m17 : 27|5@1+ (1,0) [0|0] "" Vector__XXX
 SG_ ExitReasonCodeAuxValve16 m16 : 27|5@1+ (1,0) [0|0] "" Vector__XXX
 SG_ ExitReasonCodeAuxValve15 m15 : 27|5@1+ (1,0) [0|0] "" Vector__XXX
 SG_ ExitReasonCodeAuxValve14 m14 : 27|5@1+ (1,0) [0|0] "" Vector__XXX
 SG_ ExitReasonCodeAuxValve13 m13 : 27|5@1+ (1,0) [0|0] "" Vector__XXX
 SG_ ExitReasonCodeAuxValve12 m12 : 27|5@1+ (1,0) [0|0] "" Vector__XXX
 SG_ ExitReasonCodeAuxValve11 m11 : 27|5@1+ (1,0) [0|0] "" Vector__XXX
 SG_ ExitReasonCodeAuxValve10 m10 : 27|5@1+ (1,0) [0|0] "" Vector__XXX
 SG_ ExitReasonCodeAuxValve09 m9 : 27|5@1+ (1,0) [0|0] "" Vector__XXX
 SG_ ExitReasonCodeAuxValve08 m8 : 27|5@1+ (1,0) [0|0] "" Vector__XXX
 SG_ ExitReasonCodeAuxValve07 m7 : 27|5@1+ (1,0) [0|0] "" Vector__XXX
 SG_ ExitReasonCodeAuxValve06 m6 : 27|5@1+ (1,0) [0|0] "" Vector__XXX
 SG_ ExitReasonCodeAuxValve05 m5 : 27|5@1+ (1,0) [0|0] "" Vector__XXX
 SG_ ExitReasonCodeAuxValve04 m4 : 27|5@1+ (1,0) [0|0] "" Vector__XXX
 SG_ ExitReasonCodeAuxValve03 m3 : 27|5@1+ (1,0) [0|0] "" Vector__XXX
 SG_ ExitReasonCodeAuxValve02 m2 : 27|5@1+ (1,0) [0|0] "" Vector__XXX
 SG_ AutomationStatusAuxValve04 m4 : 16|4@1+ (1,0) [0|0] "" Vector__XXX
 SG_ AutomationStatusAuxValve03 m3 : 16|4@1+ (1,0) [0|0] "" Vector__XXX
 SG_ AutomationStatusAuxValve02 m2 : 16|4@1+ (1,0) [0|0] "" Vector__XXX
 SG_ AutomationStatusAuxValve01 m1 : 16|4@1+ (1,0) [0|0] "" Vector__XXX
 SG_ AutomationStatusExternalGuidance m70 : 16|4@1+ (1,0) [0|0] "" Vector__XXX
 SG_ AutomationStatusVehicleSpeed m68 : 16|4@1+ (1,0) [0|0] "" Vector__XXX
 SG_ AutomationStatusRearHitch m67 : 16|4@1+ (1,0) [0|0] "" Vector__XXX
 SG_ AutomationStatusFrontHitch m66 : 16|4@1+ (1,0) [0|0] "" Vector__XXX
 SG_ AutomationStatusRearPTO m65 : 16|4@1+ (1,0) [0|0] "" Vector__XXX
 SG_ AutomationStatusFrontPTO m64 : 16|4@1+ (1,0) [0|0] "" Vector__XXX
 SG_ AutomationStatusAuxValve32 m32 : 16|4@1+ (1,0) [0|0] "" Vector__XXX
 SG_ AutomationStatusAuxValve31 m31 : 16|4@1+ (1,0) [0|0] "" Vector__XXX
 SG_ AutomationStatusAuxValve30 m30 : 16|4@1+ (1,0) [0|0] "" Vector__XXX
 SG_ AutomationStatusAuxValve29 m29 : 16|4@1+ (1,0) [0|0] "" Vector__XXX
 SG_ AutomationStatusAuxValve28 m28 : 16|4@1+ (1,0) [0|0] "" Vector__XXX
 SG_ AutomationStatusAuxValve27 m27 : 16|4@1+ (1,0) [0|0] "" Vector__XXX
 SG_ AutomationStatusAuxValve26 m26 : 16|4@1+ (1,0) [0|0] "" Vector__XXX
 SG_ AutomationStatusAuxValve25 m25 : 16|4@1+ (1,0) [0|0] "" Vector__XXX
 SG_ AutomationStatusAuxValve24 m24 : 16|4@1+ (1,0) [0|0] "" Vector__XXX
 SG_ AutomationStatusAuxValve23 m23 : 16|4@1+ (1,0) [0|0] "" Vector__XXX
 SG_ AutomationStatusAuxValve22 m22 : 16|4@1+ (1,0) [0|0] "" Vector__XXX
 SG_ AutomationStatusAuxValve21 m21 : 16|4@1+ (1,0) [0|0] "" Vector__XXX
 SG_ AutomationStatusAuxValve20 m20 : 16|4@1+ (1,0) [0|0] "" Vector__XXX
 SG_ AutomationStatusAuxValve19 m19 : 16|4@1+ (1,0) [0|0] "" Vector__XXX
 SG_ AutomationStatusAuxValve18 m18 : 16|4@1+ (1,0) [0|0] "" Vector__XXX
 SG_ AutomationStatusAuxValve17 m17 : 16|4@1+ (1,0) [0|0] "" Vector__XXX
 SG_ AutomationStatusAuxValve16 m16 : 16|4@1+ (1,0) [0|0] "" Vector__XXX
 SG_ AutomationStatusAuxValve15 m15 : 16|4@1+ (1,0) [0|0] "" Vector__XXX
 SG_ AutomationStatusAuxValve14 m14 : 16|4@1+ (1,0) [0|0] "" Vector__XXX
 SG_ AutomationStatusAuxValve13 m13 : 16|4@1+ (1,0) [0|0] "" Vector__XXX
 SG_ AutomationStatusAuxValve12 m12 : 16|4@1+ (1,0) [0|0] "" Vector__XXX
 SG_ AutomationStatusAuxValve11 m11 : 16|4@1+ (1,0) [0|0] "" Vector__XXX
 SG_ AutomationStatusAuxValve10 m10 : 16|4@1+ (1,0) [0|0] "" Vector__XXX
 SG_ AutomationStatusAuxValve09 m9 : 16|4@1+ (1,0) [0|0] "" Vector__XXX
 SG_ AutomationStatusAuxValve08 m8 : 16|4@1+ (1,0) [0|0] "" Vector__XXX
 SG_ AutomationStatusAuxValve07 m7 : 16|4@1+ (1,0) [0|0] "" Vector__XXX
 SG_ AutomationStatusAuxValve06 m6 : 16|4@1+ (1,0) [0|0] "" Vector__XXX
 SG_ AutomationStatusAuxValve05 m5 : 16|4@1+ (1,0) [0|0] "" Vector__XXX
 SG_ NumOfUnassignedServerFcts m243 : 8|8@1+ (1,0) [0|255] "" Vector__XXX
 SG_ Curvature m70 : 32|16@1+ (0.25,-8032) [-8032|8031.75] "1/km" Vector__XXX
 SG_ ExitReasonCodeExternalGuidance m70 : 27|5@1+ (1,0) [0|0] "" Vector__XXX
 SG_ VehicleSpeed m68 : 32|16@1+ (0.001,-32.128) [-32.127|32.127] "m/s" Vector__XXX
 SG_ ExitReasonCodeVehicleSpeed m68 : 27|5@1+ (1,0) [0|0] "" Vector__XXX
 SG_ FrontHitchPosition m66 : 32|16@1+ (0.01,0) [0|100] "%" Vector__XXX
 SG_ ExitReasonCodeFrontHitch m66 : 27|5@1+ (1,0) [0|0] "" Vector__XXX
 SG_ FrontPTOSpeed m64 : 32|16@1+ (0.125,-4016) [0|0] "1/min" Vector__XXX
 SG_ ExitReasonCodeFrontPTO m64 : 27|5@1+ (1,0) [0|0] "" Vector__XXX
 SG_ FlowAuxValve01 m1 : 32|16@1+ (0.004,-128.512) [0|0] "%" Vector__XXX
 SG_ ReflectedRequestCounter m1 : 8|4@1+ (1,0) [0|0] "" Vector__XXX
 SG_ ExitReasonCodeAuxValve01 m1 : 27|5@1+ (1,0) [0|0] "" Vector__XXX
 SG_ TIMSystemOperationState m250 : 24|4@1+ (1,0) [0|15] "" Vector__XXX
 SG_ TIMServerState m250 : 28|4@1+ (1,0) [0|0] "" Vector__XXX
 SG_ TIMSystemState m250 : 16|4@1+ (1,0) [0|0] "" Vector__XXX
 SG_ LeadTIMServerIndication m250 : 20|4@1+ (1,0) [0|0] "" Vector__XXX
 SG_ ServerHeartbeatCounter m250 : 8|8@1+ (1,0) [0|0] "" Vector__XXX
 SG_ AssignmentResult_4 m245 : 77|3@1+ (1,0) [0|0] "" Vector__XXX
 SG_ AssignmentResult_3 m245 : 61|3@1+ (1,0) [0|0] "" Vector__XXX
 SG_ AssignmentResult_2 m245 : 45|3@1+ (1,0) [0|0] "" Vector__XXX
 SG_ AssignmentErrorReason_4 m245 : 72|5@1+ (1,0) [0|0] "" Vector__XXX
 SG_ AssignmentErrorReason_3 m245 : 56|5@1+ (1,0) [0|0] "" Vector__XXX
 SG_ AssignmentErrorReason_2 m245 : 40|5@1+ (1,0) [0|0] "" Vector__XXX
 SG_ AssignmentErrorReason_1 m245 : 24|5@1+ (1,0) [0|0] "" Vector__XXX
 SG_ AssignmentResult_1 m245 : 29|3@1+ (1,0) [0|0] "" Vector__XXX
 SG_ TIMFunctionId_4 m245 : 64|8@1+ (1,0) [0|0] "" Vector__XXX
 SG_ TIMFunctionId_3 m245 : 48|8@1+ (1,0) [0|0] "" Vector__XXX
 SG_ TIMFunctionId_2 m245 : 32|8@1+ (1,0) [0|0] "" Vector__XXX
 SG_ TIMFunctionId_1 m245 : 16|8@1+ (1,0) [0|0] "" Vector__XXX
 SG_ NumOfTIMFunctions m245 : 8|8@1+ (1,0) [1|250] "" Vector__XXX
 SG_ NumOfSupportedTIMFunctions m244 : 8|8@1+ (1,0) [1|250] "" Vector__XXX
 SG_ TIMConnectionVersion m246 : 16|8@1+ (1,0) [0|0] "" Vector__XXX
 SG_ ErrorCode m246 : 8|8@1+ (1,0) [0|0] "" Vector__XXX
 SG_ MinimumTIMVersionNr m248 : 24|8@1+ (1,0) [0|0] "" Vector__XXX
 SG_ ImplementedTIMVersionNr m248 : 16|8@1+ (1,0) [0|0] "" Vector__XXX
 SG_ BootTime m248 : 8|8@1+ (1,0) [0|0] "" Vector__XXX
 SG_ TIMMessageType m1 : 12|4@1+ (1,0) [0|0] "" Vector__XXX

CM_ BO_ 2621243117 "TIM server to TIM client (control status, v.2 and higher)";
CM_ SG_ 2621243117 State_RH "Front Hitch State";
CM_ SG_ 2621243117 State_RTL "Front Hitch State";
CM_ SG_ 2621243117 State_FTL "Front Hitch State";
CM_ SG_ 2621243117 State_FH "Front Hitch State";
CM_ BO_ 2619604717 "TIM message: TIM server to TIM client";
BA_DEF_  "ISO11783_TIM_040_Security" STRING ;
BA_DEF_  "ISO11783_11_SpecVersion" STRING ;
BA_DEF_  "ISO11783_07_SpecVersion" STRING ;
BA_DEF_  "ISO11783_06_SpecVersion" STRING ;
BA_DEF_ SG_  "DDI" INT 0 65535;
BA_DEF_ BO_  "SingleFrame" INT 0 1;
BA_DEF_ BU_  "NodeLayerModules" STRING ;
BA_DEF_  "ProtocolType" STRING ;
BA_DEF_  "BusType" STRING ;
BA_DEF_  "ISO11783_TIM_023_Automation" STRING ;
BA_DEF_ BU_  "NmStationAddress" INT 0 255;
BA_DEF_ BU_  "NmJ1939AAC" INT 0 1;
BA_DEF_ BU_  "NmJ1939IndustryGroup" INT 0 7;
BA_DEF_ BU_  "NmJ1939System" INT 0 127;
BA_DEF_ BU_  "NmJ1939SystemInstance" INT 0 15;
BA_DEF_ BU_  "NmJ1939Function" INT 0 255;
BA_DEF_ BU_  "NmJ1939FunctionInstance" INT 0 7;
BA_DEF_ BU_  "NmJ1939ECUInstance" INT 0 7;
BA_DEF_ BU_  "NmJ1939ManufacturerCode" INT 0 2047;
BA_DEF_ BU_  "NmJ1939IdentityNumber" INT 0 2097151;
BA_DEF_ BU_  "ECU" STRING ;
BA_DEF_ BO_  "VFrameFormat" ENUM  "StandardCAN","ExtendedCAN","reserved","J1939PG","vector_leerstring";
BA_DEF_ BO_  "GenMsgSendType" ENUM  "cyclic","NotUsed","IfActive","NotUsed","NotUsed","NotUsed","NotUsed","NotUsed","noMsgSendType","vector_leerstring";
BA_DEF_ BO_  "GenMsgCycleTime" INT 0 3600000;
BA_DEF_ BO_  "GenMsgRequestable" INT 0 1;
BA_DEF_ BO_  "GenMsgNrOfRepetition" INT 0 1000000;
BA_DEF_ BO_  "GenMsgCycleTimeFast" INT 0 3600000;
BA_DEF_ SG_  "GenSigInactiveValue" INT 0 0;
BA_DEF_ BO_  "GenMsgFastOnStart" INT 0 100000;
BA_DEF_ BO_  "GenMsgStartDelayTime" INT 0 100000;
BA_DEF_ BO_  "GenMsgILSupport" ENUM  "No","Yes";
BA_DEF_ BO_  "GenMsgDelayTime" INT 0 1000;
BA_DEF_ SG_  "SPN" INT 0 524287;
BA_DEF_  "DatabaseVersion" STRING ;
BA_DEF_ SG_  "GenSigSendType" ENUM  "Cyclic","OnWrite","OnWriteWithRepetition","OnChange","OnChangeWithRepetition","IfActive","IfActiveWithRepetition","NoSigSendType";
BA_DEF_ SG_  "SigType" ENUM  "Default","Range","RangeSigned","ASCII","Discrete","Control","ReferencePGN","DTC","StringDelimiter","StringLength","StringLengthControl","MessageCounter","MessageChecksum";
BA_DEF_  "ISO11783_12_SpecVersion" STRING ;
BA_DEF_  "ISO11783_13_SpecVersion" STRING ;
BA_DEF_ SG_  "GenSigStartValue" INT -2147483648 2147483647;
BA_DEF_ BU_  "ISO11783IOPFilename" STRING ;
BA_DEF_ BU_  "ISO11783IOPVersion" ENUM  "0","1","2","3","4","5","6","7";
BA_DEF_ BU_  "ISO11783PDDFilename" STRING ;
BA_DEF_ BU_  "ISO11783PDDVersion" ENUM  "0","1","2","3";
BA_DEF_ SG_  "GenSigILSupport" ENUM  "No","Yes";
BA_DEF_DEF_  "ISO11783_TIM_040_Security" "";
BA_DEF_DEF_  "ISO11783_11_SpecVersion" "";
BA_DEF_DEF_  "ISO11783_07_SpecVersion" "";
BA_DEF_DEF_  "ISO11783_06_SpecVersion" "";
BA_DEF_DEF_  "DDI" 0;
BA_DEF_DEF_  "SingleFrame" 1;
BA_DEF_DEF_  "NodeLayerModules" "";
BA_DEF_DEF_  "ProtocolType" "";
BA_DEF_DEF_  "BusType" "";
BA_DEF_DEF_  "ISO11783_TIM_023_Automation" "";
BA_DEF_DEF_  "NmStationAddress" 254;
BA_DEF_DEF_  "NmJ1939AAC" 0;
BA_DEF_DEF_  "NmJ1939IndustryGroup" 0;
BA_DEF_DEF_  "NmJ1939System" 0;
BA_DEF_DEF_  "NmJ1939SystemInstance" 0;
BA_DEF_DEF_  "NmJ1939Function" 0;
BA_DEF_DEF_  "NmJ1939FunctionInstance" 0;
BA_DEF_DEF_  "NmJ1939ECUInstance" 0;
BA_DEF_DEF_  "NmJ1939ManufacturerCode" 0;
BA_DEF_DEF_  "NmJ1939IdentityNumber" 0;
BA_DEF_DEF_  "ECU" "";
BA_DEF_DEF_  "VFrameFormat" "J1939PG";
BA_DEF_DEF_  "GenMsgSendType" "noMsgSendType";
BA_DEF_DEF_  "GenMsgCycleTime" 0;
BA_DEF_DEF_  "GenMsgRequestable" 1;
BA_DEF_DEF_  "GenMsgNrOfRepetition" 0;
BA_DEF_DEF_  "GenMsgCycleTimeFast" 0;
BA_DEF_DEF_  "GenSigInactiveValue" 0;
BA_DEF_DEF_  "GenMsgFastOnStart" 0;
BA_DEF_DEF_  "GenMsgStartDelayTime" 0;
BA_DEF_DEF_  "GenMsgILSupport" "Yes";
BA_DEF_DEF_  "GenMsgDelayTime" 0;
BA_DEF_DEF_  "SPN" 0;
BA_DEF_DEF_  "DatabaseVersion" "";
BA_DEF_DEF_  "GenSigSendType" "NoSigSendType";
BA_DEF_DEF_  "SigType" "Default";
BA_DEF_DEF_  "ISO11783_12_SpecVersion" "";
BA_DEF_DEF_  "ISO11783_13_SpecVersion" "";
BA_DEF_DEF_  "GenSigStartValue" 0;
BA_DEF_DEF_  "ISO11783IOPFilename" "";
BA_DEF_DEF_  "ISO11783IOPVersion" "6";
BA_DEF_DEF_  "ISO11783PDDFilename" "";
BA_DEF_DEF_  "ISO11783PDDVersion" "3";
BA_DEF_DEF_  "GenSigILSupport" "Yes";
BA_ "ISO11783_12_SpecVersion" "2018";
BA_ "DatabaseVersion" "19 SP3";
BA_ "ProtocolType" "ISO11783";
BA_ "ISO11783_06_SpecVersion" "2018";
BA_ "ISO11783_07_SpecVersion" "2014";
BA_ "ISO11783_11_SpecVersion" "2022";
BA_ "BusType" "CAN";
BA_ "ISO11783_13_SpecVersion" "2021";
BA_ "ISO11783_TIM_023_Automation" "2025 (4.00.001)";
BA_ "ISO11783_TIM_040_Security" "2025 (1.00.002)";
BA_ "ISO11783IOPVersion" BU_ TIMServer 5;
BA_ "NmJ1939IdentityNumber" BU_ TIMServer 2;
BA_ "NmJ1939ManufacturerCode" BU_ TIMServer 1861;
BA_ "NmJ1939Function" BU_ TIMServer 142;
BA_ "NmJ1939IndustryGroup" BU_ TIMServer 2;
BA_ "NmJ1939AAC" BU_ TIMServer 1;
BA_ "NmStationAddress" BU_ TIMServer 237;
BA_ "NodeLayerModules" BU_ TIMServer "ISO11783_IL.vmodule";
BA_ "ISO11783IOPVersion" BU_ TIMClient3 5;
BA_ "NmJ1939ManufacturerCode" BU_ TIMClient3 1861;
BA_ "NmJ1939FunctionInstance" BU_ TIMClient3 3;
BA_ "NmJ1939IndustryGroup" BU_ TIMClient3 2;
BA_ "NmJ1939AAC" BU_ TIMClient3 1;
BA_ "NmStationAddress" BU_ TIMClient3 3;
BA_ "NodeLayerModules" BU_ TIMClient3 "ISO11783_IL.vmodule";
BA_ "ISO11783IOPVersion" BU_ TIMClient2 5;
BA_ "NmJ1939ManufacturerCode" BU_ TIMClient2 1861;
BA_ "NmJ1939FunctionInstance" BU_ TIMClient2 2;
BA_ "NmJ1939IndustryGroup" BU_ TIMClient2 2;
BA_ "NmJ1939AAC" BU_ TIMClient2 1;
BA_ "NmStationAddress" BU_ TIMClient2 2;
BA_ "NodeLayerModules" BU_ TIMClient2 "ISO11783_IL.vmodule";
BA_ "ISO11783IOPVersion" BU_ TIMClient1 5;
BA_ "NmJ1939ManufacturerCode" BU_ TIMClient1 1861;
BA_ "NmJ1939FunctionInstance" BU_ TIMClient1 1;
BA_ "NmJ1939IndustryGroup" BU_ TIMClient1 2;
BA_ "NmJ1939AAC" BU_ TIMClient1 1;
BA_ "NmStationAddress" BU_ TIMClient1 1;
BA_ "NodeLayerModules" BU_ TIMClient1 "ISO11783_IL.vmodule";
BA_ "ISO11783IOPVersion" BU_ DiagnosticNode 5;
BA_ "NmJ1939ManufacturerCode" BU_ DiagnosticNode 1861;
BA_ "NmJ1939Function" BU_ DiagnosticNode 129;
BA_ "NmJ1939AAC" BU_ DiagnosticNode 1;
BA_ "NmStationAddress" BU_ DiagnosticNode 251;
BA_ "NodeLayerModules" BU_ DiagnosticNode "ISO11783_IL.vmodule";
BA_ "SPN" SG_ 2621243117 State_RH 23869;
BA_ "SPN" SG_ 2621243117 State_RTL 23871;
BA_ "SPN" SG_ 2621243117 State_FTL 23870;
BA_ "SPN" SG_ 2621243117 State_FH 23868;
BA_ "GenSigStartValue" SG_ 2621243117 MinimumSpeedBackward_CM1GP_VS 32128;
BA_ "GenSigStartValue" SG_ 2621243117 MaximumSpeedBackward_CM1GP_VS 32128;
BA_ "GenSigStartValue" SG_ 2621243117 MinimumSpeedForward_CM1GP_VS 32128;
BA_ "GenSigStartValue" SG_ 2621243117 MaximumSpeedForward_CM1GP_VS 32128;
BA_ "SPN" SG_ 2621243117 ControlMode1_RTL 23578;
BA_ "SPN" SG_ 2621243117 NumOfControlModes_RTL 23872;
BA_ "SPN" SG_ 2621243117 NumOfBytes_CM1_RTL 23873;
BA_ "SPN" SG_ 2621243117 Position_RTL 23584;
BA_ "SPN" SG_ 2621243117 Position_FTL 23583;
BA_ "SPN" SG_ 2621243117 ExitReasonCode_RTL 23588;
BA_ "SPN" SG_ 2621243117 ExitReasonCode_FTL 23587;
BA_ "SPN" SG_ 2621243117 AutomationStatus_RTL 23586;
BA_ "SPN" SG_ 2621243117 AutomationStatus_FTL 23585;
BA_ "SPN" SG_ 2621243117 ControlMode1_FTL 23578;
BA_ "SPN" SG_ 2621243117 NumOfBytes_CM1_FTL 23873;
BA_ "SPN" SG_ 2621243117 NumOfControlModes_FTL 23872;
BA_ "SPN" SG_ 2621243117 NumOfBytes_CM1_VS 23873;
BA_ "SPN" SG_ 2621243117 ControlMode1_VS 23578;
BA_ "SPN" SG_ 2621243117 NumOfControlModes_VS 23872;
BA_ "SPN" SG_ 2621243117 Position_RH 8768;
BA_ "SigType" SG_ 2621243117 Position_RH 1;
BA_ "SPN" SG_ 2621243117 Speed_RPTO 8762;
BA_ "GenSigStartValue" SG_ 2621243117 Speed_RPTO 32128;
BA_ "SigType" SG_ 2621243117 Speed_RPTO 1;
BA_ "GenSigStartValue" SG_ 2621243117 Flow_AV32 32128;
BA_ "SigType" SG_ 2621243117 Flow_AV32 1;
BA_ "SPN" SG_ 2621243117 Flow_AV32 8696;
BA_ "GenSigStartValue" SG_ 2621243117 Flow_AV31 32128;
BA_ "SigType" SG_ 2621243117 Flow_AV31 1;
BA_ "SPN" SG_ 2621243117 Flow_AV31 8695;
BA_ "GenSigStartValue" SG_ 2621243117 Flow_AV30 32128;
BA_ "SigType" SG_ 2621243117 Flow_AV30 1;
BA_ "SPN" SG_ 2621243117 Flow_AV30 8694;
BA_ "GenSigStartValue" SG_ 2621243117 Flow_AV29 32128;
BA_ "SigType" SG_ 2621243117 Flow_AV29 1;
BA_ "SPN" SG_ 2621243117 Flow_AV29 8693;
BA_ "GenSigStartValue" SG_ 2621243117 Flow_AV28 32128;
BA_ "SigType" SG_ 2621243117 Flow_AV28 1;
BA_ "SPN" SG_ 2621243117 Flow_AV28 8692;
BA_ "GenSigStartValue" SG_ 2621243117 Flow_AV27 32128;
BA_ "SigType" SG_ 2621243117 Flow_AV27 1;
BA_ "SPN" SG_ 2621243117 Flow_AV27 8691;
BA_ "GenSigStartValue" SG_ 2621243117 Flow_AV26 32128;
BA_ "SigType" SG_ 2621243117 Flow_AV26 1;
BA_ "SPN" SG_ 2621243117 Flow_AV26 8690;
BA_ "GenSigStartValue" SG_ 2621243117 Flow_AV25 32128;
BA_ "SigType" SG_ 2621243117 Flow_AV25 1;
BA_ "SPN" SG_ 2621243117 Flow_AV25 8689;
BA_ "GenSigStartValue" SG_ 2621243117 Flow_AV24 32128;
BA_ "SigType" SG_ 2621243117 Flow_AV24 1;
BA_ "SPN" SG_ 2621243117 Flow_AV24 8688;
BA_ "GenSigStartValue" SG_ 2621243117 Flow_AV23 32128;
BA_ "SigType" SG_ 2621243117 Flow_AV23 1;
BA_ "SPN" SG_ 2621243117 Flow_AV23 8687;
BA_ "GenSigStartValue" SG_ 2621243117 Flow_AV22 32128;
BA_ "SigType" SG_ 2621243117 Flow_AV22 1;
BA_ "SPN" SG_ 2621243117 Flow_AV22 8686;
BA_ "GenSigStartValue" SG_ 2621243117 Flow_AV21 32128;
BA_ "SigType" SG_ 2621243117 Flow_AV21 1;
BA_ "SPN" SG_ 2621243117 Flow_AV21 8685;
BA_ "GenSigStartValue" SG_ 2621243117 Flow_AV20 32128;
BA_ "SigType" SG_ 2621243117 Flow_AV20 1;
BA_ "SPN" SG_ 2621243117 Flow_AV20 8684;
BA_ "GenSigStartValue" SG_ 2621243117 Flow_AV19 32128;
BA_ "SigType" SG_ 2621243117 Flow_AV19 1;
BA_ "SPN" SG_ 2621243117 Flow_AV19 8683;
BA_ "GenSigStartValue" SG_ 2621243117 Flow_AV18 32128;
BA_ "SigType" SG_ 2621243117 Flow_AV18 1;
BA_ "SPN" SG_ 2621243117 Flow_AV18 8682;
BA_ "GenSigStartValue" SG_ 2621243117 Flow_AV17 32128;
BA_ "SigType" SG_ 2621243117 Flow_AV17 1;
BA_ "SPN" SG_ 2621243117 Flow_AV17 8681;
BA_ "GenSigStartValue" SG_ 2621243117 Flow_AV16 32128;
BA_ "SigType" SG_ 2621243117 Flow_AV16 1;
BA_ "SPN" SG_ 2621243117 Flow_AV16 8680;
BA_ "GenSigStartValue" SG_ 2621243117 Flow_AV15 32128;
BA_ "SigType" SG_ 2621243117 Flow_AV15 1;
BA_ "SPN" SG_ 2621243117 Flow_AV15 8679;
BA_ "GenSigStartValue" SG_ 2621243117 Flow_AV14 32128;
BA_ "SigType" SG_ 2621243117 Flow_AV14 1;
BA_ "SPN" SG_ 2621243117 Flow_AV14 8678;
BA_ "GenSigStartValue" SG_ 2621243117 Flow_AV13 32128;
BA_ "SigType" SG_ 2621243117 Flow_AV13 1;
BA_ "SPN" SG_ 2621243117 Flow_AV13 8677;
BA_ "GenSigStartValue" SG_ 2621243117 Flow_AV12 32128;
BA_ "SigType" SG_ 2621243117 Flow_AV12 1;
BA_ "SPN" SG_ 2621243117 Flow_AV12 8676;
BA_ "GenSigStartValue" SG_ 2621243117 Flow_AV11 32128;
BA_ "SigType" SG_ 2621243117 Flow_AV11 1;
BA_ "SPN" SG_ 2621243117 Flow_AV11 8675;
BA_ "GenSigStartValue" SG_ 2621243117 Flow_AV10 32128;
BA_ "SigType" SG_ 2621243117 Flow_AV10 1;
BA_ "SPN" SG_ 2621243117 Flow_AV10 8674;
BA_ "GenSigStartValue" SG_ 2621243117 Flow_AV09 32128;
BA_ "SigType" SG_ 2621243117 Flow_AV09 1;
BA_ "SPN" SG_ 2621243117 Flow_AV09 8673;
BA_ "GenSigStartValue" SG_ 2621243117 Flow_AV08 32128;
BA_ "SigType" SG_ 2621243117 Flow_AV08 1;
BA_ "SPN" SG_ 2621243117 Flow_AV08 8672;
BA_ "GenSigStartValue" SG_ 2621243117 Flow_AV07 32128;
BA_ "SigType" SG_ 2621243117 Flow_AV07 1;
BA_ "SPN" SG_ 2621243117 Flow_AV07 8671;
BA_ "GenSigStartValue" SG_ 2621243117 Flow_AV06 32128;
BA_ "SigType" SG_ 2621243117 Flow_AV06 1;
BA_ "SPN" SG_ 2621243117 Flow_AV06 8670;
BA_ "GenSigStartValue" SG_ 2621243117 Flow_AV05 32128;
BA_ "SigType" SG_ 2621243117 Flow_AV05 1;
BA_ "SPN" SG_ 2621243117 Flow_AV05 8669;
BA_ "GenSigStartValue" SG_ 2621243117 Flow_AV04 32128;
BA_ "SigType" SG_ 2621243117 Flow_AV04 1;
BA_ "SPN" SG_ 2621243117 Flow_AV04 8668;
BA_ "GenSigStartValue" SG_ 2621243117 Flow_AV03 32128;
BA_ "SigType" SG_ 2621243117 Flow_AV03 1;
BA_ "SPN" SG_ 2621243117 Flow_AV03 8667;
BA_ "GenSigStartValue" SG_ 2621243117 Flow_AV02 32128;
BA_ "SigType" SG_ 2621243117 Flow_AV02 1;
BA_ "SPN" SG_ 2621243117 Flow_AV02 8666;
BA_ "SPN" SG_ 2621243117 FlowType_AV32 13282;
BA_ "SPN" SG_ 2621243117 FlowType_AV31 13281;
BA_ "SPN" SG_ 2621243117 FlowType_AV30 13280;
BA_ "SPN" SG_ 2621243117 FlowType_AV29 13279;
BA_ "SPN" SG_ 2621243117 FlowType_AV28 13278;
BA_ "SPN" SG_ 2621243117 FlowType_AV27 13277;
BA_ "SPN" SG_ 2621243117 FlowType_AV26 13276;
BA_ "SPN" SG_ 2621243117 FlowType_AV25 13275;
BA_ "SPN" SG_ 2621243117 FlowType_AV24 13274;
BA_ "SPN" SG_ 2621243117 FlowType_AV23 13273;
BA_ "SPN" SG_ 2621243117 FlowType_AV22 13272;
BA_ "SPN" SG_ 2621243117 FlowType_AV21 13271;
BA_ "SPN" SG_ 2621243117 FlowType_AV20 13270;
BA_ "SPN" SG_ 2621243117 FlowType_AV19 13269;
BA_ "SPN" SG_ 2621243117 FlowType_AV18 13268;
BA_ "SPN" SG_ 2621243117 FlowType_AV17 13267;
BA_ "SPN" SG_ 2621243117 FlowType_AV16 13266;
BA_ "SPN" SG_ 2621243117 FlowType_AV15 13265;
BA_ "SPN" SG_ 2621243117 FlowType_AV14 13264;
BA_ "SPN" SG_ 2621243117 FlowType_AV13 13263;
BA_ "SPN" SG_ 2621243117 FlowType_AV12 13262;
BA_ "SPN" SG_ 2621243117 FlowType_AV11 13261;
BA_ "SPN" SG_ 2621243117 FlowType_AV10 13260;
BA_ "SPN" SG_ 2621243117 FlowType_AV09 13259;
BA_ "SPN" SG_ 2621243117 FlowType_AV08 13258;
BA_ "SPN" SG_ 2621243117 FlowType_AV07 13257;
BA_ "SPN" SG_ 2621243117 FlowType_AV06 13256;
BA_ "SPN" SG_ 2621243117 FlowType_AV05 13255;
BA_ "SPN" SG_ 2621243117 FlowType_AV04 13254;
BA_ "SPN" SG_ 2621243117 FlowType_AV03 13253;
BA_ "SPN" SG_ 2621243117 FlowType_AV02 13252;
BA_ "SPN" SG_ 2621243117 FlowType_AV01 13251;
BA_ "SPN" SG_ 2621243117 ExitReasonCode_RPTO 8766;
BA_ "SPN" SG_ 2621243117 ExitReasonCode_RH 8772;
BA_ "SPN" SG_ 2621243117 ExitReasonCode_AV32 8760;
BA_ "SPN" SG_ 2621243117 ExitReasonCode_AV31 8759;
BA_ "SPN" SG_ 2621243117 ExitReasonCode_AV30 8758;
BA_ "SPN" SG_ 2621243117 ExitReasonCode_AV29 8757;
BA_ "SPN" SG_ 2621243117 ExitReasonCode_AV28 8756;
BA_ "SPN" SG_ 2621243117 ExitReasonCode_AV27 8755;
BA_ "SPN" SG_ 2621243117 ExitReasonCode_AV26 8754;
BA_ "SPN" SG_ 2621243117 ExitReasonCode_AV25 8753;
BA_ "SPN" SG_ 2621243117 ExitReasonCode_AV24 8752;
BA_ "SPN" SG_ 2621243117 ExitReasonCode_AV23 8751;
BA_ "SPN" SG_ 2621243117 ExitReasonCode_AV22 8750;
BA_ "SPN" SG_ 2621243117 ExitReasonCode_AV21 8749;
BA_ "SPN" SG_ 2621243117 ExitReasonCode_AV20 8748;
BA_ "SPN" SG_ 2621243117 ExitReasonCode_AV19 8747;
BA_ "SPN" SG_ 2621243117 ExitReasonCode_AV18 8746;
BA_ "SPN" SG_ 2621243117 ExitReasonCode_AV17 8745;
BA_ "SPN" SG_ 2621243117 ExitReasonCode_AV16 8744;
BA_ "SPN" SG_ 2621243117 ExitReasonCode_AV15 8743;
BA_ "SPN" SG_ 2621243117 ExitReasonCode_AV14 8742;
BA_ "SPN" SG_ 2621243117 ExitReasonCode_AV13 8741;
BA_ "SPN" SG_ 2621243117 ExitReasonCode_AV12 8740;
BA_ "SPN" SG_ 2621243117 ExitReasonCode_AV11 8739;
BA_ "SPN" SG_ 2621243117 ExitReasonCode_AV10 8738;
BA_ "SPN" SG_ 2621243117 ExitReasonCode_AV09 8737;
BA_ "SPN" SG_ 2621243117 ExitReasonCode_AV08 8736;
BA_ "SPN" SG_ 2621243117 ExitReasonCode_AV07 8735;
BA_ "SPN" SG_ 2621243117 ExitReasonCode_AV06 8734;
BA_ "SPN" SG_ 2621243117 ExitReasonCode_AV05 8733;
BA_ "SPN" SG_ 2621243117 ExitReasonCode_AV04 8732;
BA_ "SPN" SG_ 2621243117 ExitReasonCode_AV03 8731;
BA_ "SPN" SG_ 2621243117 ExitReasonCode_AV02 8730;
BA_ "SPN" SG_ 2621243117 AutomationStatus_AV04 8700;
BA_ "SPN" SG_ 2621243117 AutomationStatus_AV03 8699;
BA_ "SPN" SG_ 2621243117 AutomationStatus_AV02 8698;
BA_ "SPN" SG_ 2621243117 AutomationStatus_AV01 8697;
BA_ "SPN" SG_ 2621243117 AutomationStatus_EG 8777;
BA_ "SPN" SG_ 2621243117 AutomationStatus_VS 8774;
BA_ "SPN" SG_ 2621243117 AutomationStatus_RH 8770;
BA_ "SPN" SG_ 2621243117 AutomationStatus_FH 8769;
BA_ "SPN" SG_ 2621243117 AutomationStatus_RPTO 8764;
BA_ "SPN" SG_ 2621243117 AutomationStatus_FPTO 8763;
BA_ "SPN" SG_ 2621243117 AutomationStatus_AV32 8728;
BA_ "SPN" SG_ 2621243117 AutomationStatus_AV31 8727;
BA_ "SPN" SG_ 2621243117 AutomationStatus_AV30 8726;
BA_ "SPN" SG_ 2621243117 AutomationStatus_AV29 8725;
BA_ "SPN" SG_ 2621243117 AutomationStatus_AV28 8724;
BA_ "SPN" SG_ 2621243117 AutomationStatus_AV27 8723;
BA_ "SPN" SG_ 2621243117 AutomationStatus_AV26 8722;
BA_ "SPN" SG_ 2621243117 AutomationStatus_AV25 8721;
BA_ "SPN" SG_ 2621243117 AutomationStatus_AV24 8720;
BA_ "SPN" SG_ 2621243117 AutomationStatus_AV23 8719;
BA_ "SPN" SG_ 2621243117 AutomationStatus_AV22 8718;
BA_ "SPN" SG_ 2621243117 AutomationStatus_AV21 8717;
BA_ "SPN" SG_ 2621243117 AutomationStatus_AV20 8716;
BA_ "SPN" SG_ 2621243117 AutomationStatus_AV19 8715;
BA_ "SPN" SG_ 2621243117 AutomationStatus_AV18 8714;
BA_ "SPN" SG_ 2621243117 AutomationStatus_AV17 8713;
BA_ "SPN" SG_ 2621243117 AutomationStatus_AV16 8712;
BA_ "SPN" SG_ 2621243117 AutomationStatus_AV15 8711;
BA_ "SPN" SG_ 2621243117 AutomationStatus_AV14 8710;
BA_ "SPN" SG_ 2621243117 AutomationStatus_AV13 8709;
BA_ "SPN" SG_ 2621243117 AutomationStatus_AV12 8708;
BA_ "SPN" SG_ 2621243117 AutomationStatus_AV11 8707;
BA_ "SPN" SG_ 2621243117 AutomationStatus_AV10 8706;
BA_ "SPN" SG_ 2621243117 AutomationStatus_AV09 8705;
BA_ "SPN" SG_ 2621243117 AutomationStatus_AV08 8704;
BA_ "SPN" SG_ 2621243117 AutomationStatus_AV07 8703;
BA_ "SPN" SG_ 2621243117 AutomationStatus_AV06 8702;
BA_ "SPN" SG_ 2621243117 AutomationStatus_AV05 8701;
BA_ "SPN" SG_ 2621243117 Curvature_EG 8776;
BA_ "SigType" SG_ 2621243117 Curvature_EG 1;
BA_ "GenSigStartValue" SG_ 2621243117 Curvature_EG 32128;
BA_ "SPN" SG_ 2621243117 ExitReasonCode_EG 8778;
BA_ "SPN" SG_ 2621243117 VehicleSpeed_VS 8773;
BA_ "SigType" SG_ 2621243117 VehicleSpeed_VS 1;
BA_ "GenSigStartValue" SG_ 2621243117 VehicleSpeed_VS 32128;
BA_ "SPN" SG_ 2621243117 ExitReasonCode_VS 8775;
BA_ "SPN" SG_ 2621243117 Position_FH 8767;
BA_ "SigType" SG_ 2621243117 Position_FH 1;
BA_ "SPN" SG_ 2621243117 ExitReasonCode_FH 8771;
BA_ "SPN" SG_ 2621243117 Speed_FPTO 8761;
BA_ "SigType" SG_ 2621243117 Speed_FPTO 1;
BA_ "GenSigStartValue" SG_ 2621243117 Speed_FPTO 32128;
BA_ "SPN" SG_ 2621243117 ExitReasonCode_FPTO 8765;
BA_ "SPN" SG_ 2621243117 Flow_AV01 8665;
BA_ "SigType" SG_ 2621243117 Flow_AV01 1;
BA_ "GenSigStartValue" SG_ 2621243117 Flow_AV01 32128;
BA_ "SPN" SG_ 2621243117 ExitReasonCode_AV01 8729;
BA_ "SPN" SG_ 2621243117 TIMFunctionID 23577;
BA_ "SPN" SG_ 2619604717 GroupFunctionValue 23573;
BA_ "SPN" SG_ 2619604717 RearHitchPosition 8768;
BA_ "SigType" SG_ 2619604717 RearHitchPosition 1;
BA_ "SPN" SG_ 2619604717 RearPTOSpeed 8762;
BA_ "GenSigStartValue" SG_ 2619604717 RearPTOSpeed 32128;
BA_ "SigType" SG_ 2619604717 RearPTOSpeed 1;
BA_ "GenSigStartValue" SG_ 2619604717 FlowAuxValve32 32128;
BA_ "SigType" SG_ 2619604717 FlowAuxValve32 1;
BA_ "SPN" SG_ 2619604717 FlowAuxValve32 8696;
BA_ "GenSigStartValue" SG_ 2619604717 FlowAuxValve31 32128;
BA_ "SigType" SG_ 2619604717 FlowAuxValve31 1;
BA_ "SPN" SG_ 2619604717 FlowAuxValve31 8695;
BA_ "GenSigStartValue" SG_ 2619604717 FlowAuxValve30 32128;
BA_ "SigType" SG_ 2619604717 FlowAuxValve30 1;
BA_ "SPN" SG_ 2619604717 FlowAuxValve30 8694;
BA_ "GenSigStartValue" SG_ 2619604717 FlowAuxValve29 32128;
BA_ "SigType" SG_ 2619604717 FlowAuxValve29 1;
BA_ "SPN" SG_ 2619604717 FlowAuxValve29 8693;
BA_ "GenSigStartValue" SG_ 2619604717 FlowAuxValve28 32128;
BA_ "SigType" SG_ 2619604717 FlowAuxValve28 1;
BA_ "SPN" SG_ 2619604717 FlowAuxValve28 8692;
BA_ "GenSigStartValue" SG_ 2619604717 FlowAuxValve27 32128;
BA_ "SigType" SG_ 2619604717 FlowAuxValve27 1;
BA_ "SPN" SG_ 2619604717 FlowAuxValve27 8691;
BA_ "GenSigStartValue" SG_ 2619604717 FlowAuxValve26 32128;
BA_ "SigType" SG_ 2619604717 FlowAuxValve26 1;
BA_ "SPN" SG_ 2619604717 FlowAuxValve26 8690;
BA_ "GenSigStartValue" SG_ 2619604717 FlowAuxValve25 32128;
BA_ "SigType" SG_ 2619604717 FlowAuxValve25 1;
BA_ "SPN" SG_ 2619604717 FlowAuxValve25 8689;
BA_ "GenSigStartValue" SG_ 2619604717 FlowAuxValve24 32128;
BA_ "SigType" SG_ 2619604717 FlowAuxValve24 1;
BA_ "SPN" SG_ 2619604717 FlowAuxValve24 8688;
BA_ "GenSigStartValue" SG_ 2619604717 FlowAuxValve23 32128;
BA_ "SigType" SG_ 2619604717 FlowAuxValve23 1;
BA_ "SPN" SG_ 2619604717 FlowAuxValve23 8687;
BA_ "GenSigStartValue" SG_ 2619604717 FlowAuxValve22 32128;
BA_ "SigType" SG_ 2619604717 FlowAuxValve22 1;
BA_ "SPN" SG_ 2619604717 FlowAuxValve22 8686;
BA_ "GenSigStartValue" SG_ 2619604717 FlowAuxValve21 32128;
BA_ "SigType" SG_ 2619604717 FlowAuxValve21 1;
BA_ "SPN" SG_ 2619604717 FlowAuxValve21 8685;
BA_ "GenSigStartValue" SG_ 2619604717 FlowAuxValve20 32128;
BA_ "SigType" SG_ 2619604717 FlowAuxValve20 1;
BA_ "SPN" SG_ 2619604717 FlowAuxValve20 8684;
BA_ "GenSigStartValue" SG_ 2619604717 FlowAuxValve19 32128;
BA_ "SigType" SG_ 2619604717 FlowAuxValve19 1;
BA_ "SPN" SG_ 2619604717 FlowAuxValve19 8683;
BA_ "GenSigStartValue" SG_ 2619604717 FlowAuxValve18 32128;
BA_ "SigType" SG_ 2619604717 FlowAuxValve18 1;
BA_ "SPN" SG_ 2619604717 FlowAuxValve18 8682;
BA_ "GenSigStartValue" SG_ 2619604717 FlowAuxValve17 32128;
BA_ "SigType" SG_ 2619604717 FlowAuxValve17 1;
BA_ "SPN" SG_ 2619604717 FlowAuxValve17 8681;
BA_ "GenSigStartValue" SG_ 2619604717 FlowAuxValve16 32128;
BA_ "SigType" SG_ 2619604717 FlowAuxValve16 1;
BA_ "SPN" SG_ 2619604717 FlowAuxValve16 8680;
BA_ "GenSigStartValue" SG_ 2619604717 FlowAuxValve15 32128;
BA_ "SigType" SG_ 2619604717 FlowAuxValve15 1;
BA_ "SPN" SG_ 2619604717 FlowAuxValve15 8679;
BA_ "GenSigStartValue" SG_ 2619604717 FlowAuxValve14 32128;
BA_ "SigType" SG_ 2619604717 FlowAuxValve14 1;
BA_ "SPN" SG_ 2619604717 FlowAuxValve14 8678;
BA_ "GenSigStartValue" SG_ 2619604717 FlowAuxValve13 32128;
BA_ "SigType" SG_ 2619604717 FlowAuxValve13 1;
BA_ "SPN" SG_ 2619604717 FlowAuxValve13 8677;
BA_ "GenSigStartValue" SG_ 2619604717 FlowAuxValve12 32128;
BA_ "SigType" SG_ 2619604717 FlowAuxValve12 1;
BA_ "SPN" SG_ 2619604717 FlowAuxValve12 8676;
BA_ "GenSigStartValue" SG_ 2619604717 FlowAuxValve11 32128;
BA_ "SigType" SG_ 2619604717 FlowAuxValve11 1;
BA_ "SPN" SG_ 2619604717 FlowAuxValve11 8675;
BA_ "GenSigStartValue" SG_ 2619604717 FlowAuxValve10 32128;
BA_ "SigType" SG_ 2619604717 FlowAuxValve10 1;
BA_ "SPN" SG_ 2619604717 FlowAuxValve10 8674;
BA_ "GenSigStartValue" SG_ 2619604717 FlowAuxValve09 32128;
BA_ "SigType" SG_ 2619604717 FlowAuxValve09 1;
BA_ "SPN" SG_ 2619604717 FlowAuxValve09 8673;
BA_ "GenSigStartValue" SG_ 2619604717 FlowAuxValve08 32128;
BA_ "SigType" SG_ 2619604717 FlowAuxValve08 1;
BA_ "SPN" SG_ 2619604717 FlowAuxValve08 8672;
BA_ "GenSigStartValue" SG_ 2619604717 FlowAuxValve07 32128;
BA_ "SigType" SG_ 2619604717 FlowAuxValve07 1;
BA_ "SPN" SG_ 2619604717 FlowAuxValve07 8671;
BA_ "GenSigStartValue" SG_ 2619604717 FlowAuxValve06 32128;
BA_ "SigType" SG_ 2619604717 FlowAuxValve06 1;
BA_ "SPN" SG_ 2619604717 FlowAuxValve06 8670;
BA_ "GenSigStartValue" SG_ 2619604717 FlowAuxValve05 32128;
BA_ "SigType" SG_ 2619604717 FlowAuxValve05 1;
BA_ "SPN" SG_ 2619604717 FlowAuxValve05 8669;
BA_ "GenSigStartValue" SG_ 2619604717 FlowAuxValve04 32128;
BA_ "SigType" SG_ 2619604717 FlowAuxValve04 1;
BA_ "SPN" SG_ 2619604717 FlowAuxValve04 8668;
BA_ "GenSigStartValue" SG_ 2619604717 FlowAuxValve03 32128;
BA_ "SigType" SG_ 2619604717 FlowAuxValve03 1;
BA_ "SPN" SG_ 2619604717 FlowAuxValve03 8667;
BA_ "GenSigStartValue" SG_ 2619604717 FlowAuxValve02 32128;
BA_ "SigType" SG_ 2619604717 FlowAuxValve02 1;
BA_ "SPN" SG_ 2619604717 FlowAuxValve02 8666;
BA_ "SPN" SG_ 2619604717 FlowTypeAuxValve32 13282;
BA_ "SPN" SG_ 2619604717 FlowTypeAuxValve31 13281;
BA_ "SPN" SG_ 2619604717 FlowTypeAuxValve30 13280;
BA_ "SPN" SG_ 2619604717 FlowTypeAuxValve29 13279;
BA_ "SPN" SG_ 2619604717 FlowTypeAuxValve28 13278;
BA_ "SPN" SG_ 2619604717 FlowTypeAuxValve27 13277;
BA_ "SPN" SG_ 2619604717 FlowTypeAuxValve26 13276;
BA_ "SPN" SG_ 2619604717 FlowTypeAuxValve25 13275;
BA_ "SPN" SG_ 2619604717 FlowTypeAuxValve24 13274;
BA_ "SPN" SG_ 2619604717 FlowTypeAuxValve23 13273;
BA_ "SPN" SG_ 2619604717 FlowTypeAuxValve22 13272;
BA_ "SPN" SG_ 2619604717 FlowTypeAuxValve21 13271;
BA_ "SPN" SG_ 2619604717 FlowTypeAuxValve20 13270;
BA_ "SPN" SG_ 2619604717 FlowTypeAuxValve19 13269;
BA_ "SPN" SG_ 2619604717 FlowTypeAuxValve18 13268;
BA_ "SPN" SG_ 2619604717 FlowTypeAuxValve17 13267;
BA_ "SPN" SG_ 2619604717 FlowTypeAuxValve16 13266;
BA_ "SPN" SG_ 2619604717 FlowTypeAuxValve15 13265;
BA_ "SPN" SG_ 2619604717 FlowTypeAuxValve14 13264;
BA_ "SPN" SG_ 2619604717 FlowTypeAuxValve13 13263;
BA_ "SPN" SG_ 2619604717 FlowTypeAuxValve12 13262;
BA_ "SPN" SG_ 2619604717 FlowTypeAuxValve11 13261;
BA_ "SPN" SG_ 2619604717 FlowTypeAuxValve10 13260;
BA_ "SPN" SG_ 2619604717 FlowTypeAuxValve09 13259;
BA_ "SPN" SG_ 2619604717 FlowTypeAuxValve08 13258;
BA_ "SPN" SG_ 2619604717 FlowTypeAuxValve07 13257;
BA_ "SPN" SG_ 2619604717 FlowTypeAuxValve06 13256;
BA_ "SPN" SG_ 2619604717 FlowTypeAuxValve05 13255;
BA_ "SPN" SG_ 2619604717 FlowTypeAuxValve04 13254;
BA_ "SPN" SG_ 2619604717 FlowTypeAuxValve03 13253;
BA_ "SPN" SG_ 2619604717 FlowTypeAuxValve02 13252;
BA_ "SPN" SG_ 2619604717 FlowTypeAuxValve01 13251;
BA_ "SPN" SG_ 2619604717 ExitReasonCodeRearPTO 8766;
BA_ "SPN" SG_ 2619604717 ExitReasonCodeRearHitch 8772;
BA_ "SPN" SG_ 2619604717 ExitReasonCodeAuxValve32 8760;
BA_ "SPN" SG_ 2619604717 ExitReasonCodeAuxValve31 8769;
BA_ "SPN" SG_ 2619604717 ExitReasonCodeAuxValve30 8758;
BA_ "SPN" SG_ 2619604717 ExitReasonCodeAuxValve29 8757;
BA_ "SPN" SG_ 2619604717 ExitReasonCodeAuxValve28 8756;
BA_ "SPN" SG_ 2619604717 ExitReasonCodeAuxValve27 8755;
BA_ "SPN" SG_ 2619604717 ExitReasonCodeAuxValve26 8754;
BA_ "SPN" SG_ 2619604717 ExitReasonCodeAuxValve25 8753;
BA_ "SPN" SG_ 2619604717 ExitReasonCodeAuxValve24 8752;
BA_ "SPN" SG_ 2619604717 ExitReasonCodeAuxValve23 8751;
BA_ "SPN" SG_ 2619604717 ExitReasonCodeAuxValve22 8750;
BA_ "SPN" SG_ 2619604717 ExitReasonCodeAuxValve21 8749;
BA_ "SPN" SG_ 2619604717 ExitReasonCodeAuxValve20 8748;
BA_ "SPN" SG_ 2619604717 ExitReasonCodeAuxValve19 8747;
BA_ "SPN" SG_ 2619604717 ExitReasonCodeAuxValve18 8746;
BA_ "SPN" SG_ 2619604717 ExitReasonCodeAuxValve17 8745;
BA_ "SPN" SG_ 2619604717 ExitReasonCodeAuxValve16 8744;
BA_ "SPN" SG_ 2619604717 ExitReasonCodeAuxValve15 8743;
BA_ "SPN" SG_ 2619604717 ExitReasonCodeAuxValve14 8742;
BA_ "SPN" SG_ 2619604717 ExitReasonCodeAuxValve13 8741;
BA_ "SPN" SG_ 2619604717 ExitReasonCodeAuxValve12 8740;
BA_ "SPN" SG_ 2619604717 ExitReasonCodeAuxValve11 8739;
BA_ "SPN" SG_ 2619604717 ExitReasonCodeAuxValve10 8738;
BA_ "SPN" SG_ 2619604717 ExitReasonCodeAuxValve09 8737;
BA_ "SPN" SG_ 2619604717 ExitReasonCodeAuxValve08 8736;
BA_ "SPN" SG_ 2619604717 ExitReasonCodeAuxValve07 8735;
BA_ "SPN" SG_ 2619604717 ExitReasonCodeAuxValve06 8734;
BA_ "SPN" SG_ 2619604717 ExitReasonCodeAuxValve05 8733;
BA_ "SPN" SG_ 2619604717 ExitReasonCodeAuxValve04 8732;
BA_ "SPN" SG_ 2619604717 ExitReasonCodeAuxValve03 8731;
BA_ "SPN" SG_ 2619604717 ExitReasonCodeAuxValve02 8730;
BA_ "SPN" SG_ 2619604717 AutomationStatusAuxValve04 8700;
BA_ "SPN" SG_ 2619604717 AutomationStatusAuxValve03 8699;
BA_ "SPN" SG_ 2619604717 AutomationStatusAuxValve02 8698;
BA_ "SPN" SG_ 2619604717 AutomationStatusAuxValve01 8697;
BA_ "SPN" SG_ 2619604717 AutomationStatusExternalGuidance 8777;
BA_ "SPN" SG_ 2619604717 AutomationStatusVehicleSpeed 8774;
BA_ "SPN" SG_ 2619604717 AutomationStatusRearHitch 8770;
BA_ "SPN" SG_ 2619604717 AutomationStatusFrontHitch 8769;
BA_ "SPN" SG_ 2619604717 AutomationStatusRearPTO 8764;
BA_ "SPN" SG_ 2619604717 AutomationStatusFrontPTO 8763;
BA_ "SPN" SG_ 2619604717 AutomationStatusAuxValve32 8728;
BA_ "SPN" SG_ 2619604717 AutomationStatusAuxValve31 8727;
BA_ "SPN" SG_ 2619604717 AutomationStatusAuxValve30 8726;
BA_ "SPN" SG_ 2619604717 AutomationStatusAuxValve29 8725;
BA_ "SPN" SG_ 2619604717 AutomationStatusAuxValve28 8724;
BA_ "SPN" SG_ 2619604717 AutomationStatusAuxValve27 8723;
BA_ "SPN" SG_ 2619604717 AutomationStatusAuxValve26 8722;
BA_ "SPN" SG_ 2619604717 AutomationStatusAuxValve25 8721;
BA_ "SPN" SG_ 2619604717 AutomationStatusAuxValve24 8720;
BA_ "SPN" SG_ 2619604717 AutomationStatusAuxValve23 8719;
BA_ "SPN" SG_ 2619604717 AutomationStatusAuxValve22 8718;
BA_ "SPN" SG_ 2619604717 AutomationStatusAuxValve21 8717;
BA_ "SPN" SG_ 2619604717 AutomationStatusAuxValve20 8716;
BA_ "SPN" SG_ 2619604717 AutomationStatusAuxValve19 8715;
BA_ "SPN" SG_ 2619604717 AutomationStatusAuxValve18 8714;
BA_ "SPN" SG_ 2619604717 AutomationStatusAuxValve17 8713;
BA_ "SPN" SG_ 2619604717 AutomationStatusAuxValve16 8712;
BA_ "SPN" SG_ 2619604717 AutomationStatusAuxValve15 8711;
BA_ "SPN" SG_ 2619604717 AutomationStatusAuxValve14 8710;
BA_ "SPN" SG_ 2619604717 AutomationStatusAuxValve13 8709;
BA_ "SPN" SG_ 2619604717 AutomationStatusAuxValve12 8708;
BA_ "SPN" SG_ 2619604717 AutomationStatusAuxValve11 8707;
BA_ "SPN" SG_ 2619604717 AutomationStatusAuxValve10 8706;
BA_ "SPN" SG_ 2619604717 AutomationStatusAuxValve09 8705;
BA_ "SPN" SG_ 2619604717 AutomationStatusAuxValve08 8704;
BA_ "SPN" SG_ 2619604717 AutomationStatusAuxValve07 8703;
BA_ "SPN" SG_ 2619604717 AutomationStatusAuxValve06 8702;
BA_ "SPN" SG_ 2619604717 AutomationStatusAuxValve05 8701;
BA_ "SPN" SG_ 2619604717 NumOfUnassignedServerFcts 23886;
BA_ "SPN" SG_ 2619604717 Curvature 8776;
BA_ "SigType" SG_ 2619604717 Curvature 1;
BA_ "GenSigStartValue" SG_ 2619604717 Curvature 32128;
BA_ "SPN" SG_ 2619604717 ExitReasonCodeExternalGuidance 8778;
BA_ "SPN" SG_ 2619604717 VehicleSpeed 8773;
BA_ "SigType" SG_ 2619604717 VehicleSpeed 1;
BA_ "GenSigStartValue" SG_ 2619604717 VehicleSpeed 32128;
BA_ "SPN" SG_ 2619604717 ExitReasonCodeVehicleSpeed 8775;
BA_ "SPN" SG_ 2619604717 FrontHitchPosition 8767;
BA_ "SigType" SG_ 2619604717 FrontHitchPosition 1;
BA_ "SPN" SG_ 2619604717 ExitReasonCodeFrontHitch 8771;
BA_ "SPN" SG_ 2619604717 FrontPTOSpeed 8761;
BA_ "SigType" SG_ 2619604717 FrontPTOSpeed 1;
BA_ "GenSigStartValue" SG_ 2619604717 FrontPTOSpeed 32128;
BA_ "SPN" SG_ 2619604717 ExitReasonCodeFrontPTO 8765;
BA_ "SPN" SG_ 2619604717 FlowAuxValve01 8665;
BA_ "SigType" SG_ 2619604717 FlowAuxValve01 1;
BA_ "GenSigStartValue" SG_ 2619604717 FlowAuxValve01 32128;
BA_ "SPN" SG_ 2619604717 ReflectedRequestCounter 13250;
BA_ "SPN" SG_ 2619604717 ExitReasonCodeAuxValve01 8729;
BA_ "SPN" SG_ 2619604717 TIMSystemOperationState 13215;
BA_ "SPN" SG_ 2619604717 TIMServerState 13211;
BA_ "SPN" SG_ 2619604717 TIMSystemState 13214;
BA_ "SPN" SG_ 2619604717 LeadTIMServerIndication 23592;
BA_ "SPN" SG_ 2619604717 ServerHeartbeatCounter 13212;
BA_ "SPN" SG_ 2619604717 AssignmentErrorReason_1 23885;
BA_ "SPN" SG_ 2619604717 AssignmentResult_1 23884;
BA_ "SPN" SG_ 2619604717 NumOfTIMFunctions 23883;
BA_ "GenSigStartValue" SG_ 2619604717 NumOfTIMFunctions 1;
BA_ "GenSigStartValue" SG_ 2619604717 NumOfSupportedTIMFunctions 1;
BA_ "SPN" SG_ 2619604717 NumOfSupportedTIMFunctions 23878;
BA_ "SPN" SG_ 2619604717 TIMConnectionVersion 13220;
BA_ "SPN" SG_ 2619604717 ErrorCode 13219;
BA_ "SPN" SG_ 2619604717 MinimumTIMVersionNr 13218;
BA_ "SPN" SG_ 2619604717 ImplementedTIMVersionNr 13217;
BA_ "SPN" SG_ 2619604717 BootTime 13216;
BA_ "SPN" SG_ 2619604717 TIMMessageType 23574;
VAL_ 2621243117 SecurityByte_VS 17 "LinearMotion_Request" 0 "Parametrization_Request" ;
VAL_ 2621243117 SecurityByte_RTL 17 "PercentagePosition_Request" 0 "Parametrization_Request" ;
VAL_ 2621243117 SecurityByte_RPTO 17 "RotationalSpeed_Request" ;
VAL_ 2621243117 SecurityByte_RH 17 "PercentagePosition_Request" ;
VAL_ 2621243117 SecurityByte_FTL 17 "PercentagePosition_Request" 0 "Parametrization_Request" ;
VAL_ 2621243117 SecurityByte_FPTO 17 "RotationalSpeed_Request" ;
VAL_ 2621243117 SecurityByte_FH 17 "PercentagePosition_Request" ;
VAL_ 2621243117 SecurityByte_EG 17 "Curvature_Request" ;
VAL_ 2621243117 SecurityByte_AV32 17 "PercentageFlow_Request" ;
VAL_ 2621243117 SecurityByte_AV31 17 "PercentageFlow_Request" ;
VAL_ 2621243117 SecurityByte_AV30 17 "PercentageFlow_Request" ;
VAL_ 2621243117 SecurityByte_AV29 17 "PercentageFlow_Request" ;
VAL_ 2621243117 SecurityByte_AV28 17 "PercentageFlow_Request" ;
VAL_ 2621243117 SecurityByte_AV27 17 "PercentageFlow_Request" ;
VAL_ 2621243117 SecurityByte_AV26 17 "PercentageFlow_Request" ;
VAL_ 2621243117 SecurityByte_AV25 17 "PercentageFlow_Request" ;
VAL_ 2621243117 SecurityByte_AV24 17 "PercentageFlow_Request" ;
VAL_ 2621243117 SecurityByte_AV23 17 "PercentageFlow_Request" ;
VAL_ 2621243117 SecurityByte_AV22 17 "PercentageFlow_Request" ;
VAL_ 2621243117 SecurityByte_AV21 17 "PercentageFlow_Request" ;
VAL_ 2621243117 SecurityByte_AV20 17 "PercentageFlow_Request" ;
VAL_ 2621243117 SecurityByte_AV19 17 "PercentageFlow_Request" ;
VAL_ 2621243117 SecurityByte_AV18 17 "PercentageFlow_Request" ;
VAL_ 2621243117 SecurityByte_AV17 17 "PercentageFlow_Request" ;
VAL_ 2621243117 SecurityByte_AV16 17 "PercentageFlow_Request" ;
VAL_ 2621243117 SecurityByte_AV15 17 "PercentageFlow_Request" ;
VAL_ 2621243117 SecurityByte_AV14 17 "PercentageFlow_Request" ;
VAL_ 2621243117 SecurityByte_AV13 17 "PercentageFlow_Request" ;
VAL_ 2621243117 SecurityByte_AV12 17 "PercentageFlow_Request" ;
VAL_ 2621243117 SecurityByte_AV11 17 "PercentageFlow_Request" ;
VAL_ 2621243117 SecurityByte_AV10 17 "PercentageFlow_Request" ;
VAL_ 2621243117 SecurityByte_AV09 17 "PercentageFlow_Request" ;
VAL_ 2621243117 SecurityByte_AV08 17 "PercentageFlow_Request" ;
VAL_ 2621243117 SecurityByte_AV07 17 "PercentageFlow_Request" ;
VAL_ 2621243117 SecurityByte_AV06 17 "PercentageFlow_Request" ;
VAL_ 2621243117 SecurityByte_AV05 17 "PercentageFlow_Request" ;
VAL_ 2621243117 SecurityByte_AV04 17 "PercentageFlow_Request" ;
VAL_ 2621243117 SecurityByte_AV03 17 "PercentageFlow_Request" ;
VAL_ 2621243117 SecurityByte_AV02 17 "PercentageFlow_Request" ;
VAL_ 2621243117 SecurityByte_AV01 17 "PercentageFlow_Request" ;
VAL_ 2621243117 State_RH 15 "NotAvailable" 14 "Error" 3 "Raising" 2 "Lowering" 1 "Stop" 0 "Float" ;
VAL_ 2621243117 State_RTL 15 "NotAvailable" 14 "Error" 3 "Extending" 2 "Retracting" 1 "Stop" 0 "Float" ;
VAL_ 2621243117 State_FTL 15 "NotAvailable" 14 "Error" 3 "Extending" 2 "Retracting" 1 "Stop" 0 "Float" ;
VAL_ 2621243117 State_FH 15 "NotAvailable" 14 "Error" 3 "Raising" 2 "Lowering" 1 "Stop" 0 "Float" ;
VAL_ 2621243117 StrokeLength_CM1GP_RTL 65535 "NotAvailable" 65534 "Error" ;
VAL_ 2621243117 BaseLength_CM1GP_RTL 65535 "NotAvailable" 65534 "Error" ;
VAL_ 2621243117 StrokeLength_CM1GP_FTL 65535 "NotAvailable" 65534 "Error" ;
VAL_ 2621243117 BaseLength_CM1GP_FTL 65535 "NotAvailable" 65534 "Error" ;
VAL_ 2621243117 MinimumSpeedBackward_CM1GP_VS 65535 "NotAvailable" ;
VAL_ 2621243117 MaximumSpeedBackward_CM1GP_VS 65535 "NotAvailable" ;
VAL_ 2621243117 MinimumSpeedForward_CM1GP_VS 65535 "NotAvailable" ;
VAL_ 2621243117 MaximumSpeedForward_CM1GP_VS 65535 "NotAvailable" ;
VAL_ 2621243117 TransmissionType_CM1GP_VS 255 "NotAvailable" 1 "ContinuouslyVariableTransmission" 0 "SteppedTransmission" ;
VAL_ 2621243117 ControlMode1_RTL 0 "GeneralParametrization" ;
VAL_ 2621243117 Position_RTL 65535 "NotAvailable" 65534 "Error" ;
VAL_ 2621243117 Position_FTL 65535 "NotAvailable" 65534 "Error" ;
VAL_ 2621243117 ExitReasonCode_RTL 31 "NotAvailable" 30 "Error" 16 "ValveLockedOut_TransportLock" 15 "HydraulicOilLevelLow" 9 "FunctionFault" 8 "OperatorControlFault" 5 "RemoteCommandTimeout" 4 "OperatorControlNotInValidPosition" 3 "OperatorOverrideOfFunction" 2 "ImplementReleasedControlOfFunction" 7 "FunctionNotCalibrated" 6 "RemoteCommandOutOfRange_Invalid" 1 "RequiredLevelOfOperatorPresence_AwarenessNotDetected" 0 "NoReason_AllClear" ;
VAL_ 2621243117 ExitReasonCode_FTL 31 "NotAvailable" 30 "Error" 16 "ValveLockedOut_TransportLock" 15 "HydraulicOilLevelLow" 9 "FunctionFault" 8 "OperatorControlFault" 5 "RemoteCommandTimeout" 4 "OperatorControlNotInValidPosition" 3 "OperatorOverrideOfFunction" 2 "ImplementReleasedControlOfFunction" 7 "FunctionNotCalibrated" 6 "RemoteCommandOutOfRange_Invalid" 1 "RequiredLevelOfOperatorPresence_AwarenessNotDetected" 0 "NoReason_AllClear" ;
VAL_ 2621243117 AutomationStatus_RTL 13 "AutomationFault" 7 "ActiveLimitedLow" 6 "ActiveLimitedHigh" 5 "ActiveNotLimited" 0 "AutomationUnavailable" 1 "AutomationNotReady" 2 "AutomationReadyToEnable" 3 "AutomationEnabled" 4 "AutomationPending" 14 "NonRecoverableFault" 15 "NotAvailable" ;
VAL_ 2621243117 AutomationStatus_FTL 13 "AutomationFault" 7 "ActiveLimitedLow" 6 "ActiveLimitedHigh" 5 "ActiveNotLimited" 0 "AutomationUnavailable" 1 "AutomationNotReady" 2 "AutomationReadyToEnable" 3 "AutomationEnabled" 4 "AutomationPending" 14 "NonRecoverableFault" 15 "NotAvailable" ;
VAL_ 2621243117 ControlMode1_FTL 0 "GeneralParametrization" ;
VAL_ 2621243117 MsgType_RTL 17 "PercentagePosition_Status" 1 "PercentagePosition_AutomationStatus" 0 "Parametrization_Response" ;
VAL_ 2621243117 MsgType_FTL 17 "PercentagePosition_Status" 1 "PercentagePosition_AutomationStatus" 0 "Parametrization_Response" ;
VAL_ 2621243117 MsgType_EG 17 "Curvature_Status" 1 "Curvature_AutomationStatus" ;
VAL_ 2621243117 ControlMode1_VS 0 "GeneralParametrization" ;
VAL_ 2621243117 MsgType_VS 17 "LinearMotion_Status" 1 "LinearMotion_AutomationStatus" 0 "Parametrization_Response" ;
VAL_ 2621243117 MsgType_RH 17 "PercentagePosition_Status" 1 "PercentagePosition_AutomationStatus" ;
VAL_ 2621243117 MsgType_FH 17 "PercentagePosition_Status" 1 "PercentagePosition_AutomationStatus" ;
VAL_ 2621243117 MsgType_RPTO 17 "RotationalSpeed_Status" 1 "RotationalSpeed_AutomationStatus" ;
VAL_ 2621243117 MsgType_FPTO 17 "RotationalSpeed_Status" 1 "RotationalSpeed_AutomationStatus" ;
VAL_ 2621243117 MsgType_AV32 17 "PercentageFlow_Status" 1 "PercentageFlow_AutomationStatus" ;
VAL_ 2621243117 MsgType_AV31 17 "PercentageFlow_Status" 1 "PercentageFlow_AutomationStatus" ;
VAL_ 2621243117 MsgType_AV30 17 "PercentageFlow_Status" 1 "PercentageFlow_AutomationStatus" ;
VAL_ 2621243117 MsgType_AV29 17 "PercentageFlow_Status" 1 "PercentageFlow_AutomationStatus" ;
VAL_ 2621243117 MsgType_AV28 17 "PercentageFlow_Status" 1 "PercentageFlow_AutomationStatus" ;
VAL_ 2621243117 MsgType_AV27 17 "PercentageFlow_Status" 1 "PercentageFlow_AutomationStatus" ;
VAL_ 2621243117 MsgType_AV26 17 "PercentageFlow_Status" 1 "PercentageFlow_AutomationStatus" ;
VAL_ 2621243117 MsgType_AV25 17 "PercentageFlow_Status" 1 "PercentageFlow_AutomationStatus" ;
VAL_ 2621243117 MsgType_AV24 17 "PercentageFlow_Status" 1 "PercentageFlow_AutomationStatus" ;
VAL_ 2621243117 MsgType_AV23 17 "PercentageFlow_Status" 1 "PercentageFlow_AutomationStatus" ;
VAL_ 2621243117 MsgType_AV22 17 "PercentageFlow_Status" 1 "PercentageFlow_AutomationStatus" ;
VAL_ 2621243117 MsgType_AV21 17 "PercentageFlow_Status" 1 "PercentageFlow_AutomationStatus" ;
VAL_ 2621243117 MsgType_AV20 17 "PercentageFlow_Status" 1 "PercentageFlow_AutomationStatus" ;
VAL_ 2621243117 MsgType_AV19 17 "PercentageFlow_Status" 1 "PercentageFlow_AutomationStatus" ;
VAL_ 2621243117 MsgType_AV18 17 "PercentageFlow_Status" 1 "PercentageFlow_AutomationStatus" ;
VAL_ 2621243117 MsgType_AV17 17 "PercentageFlow_Status" 1 "PercentageFlow_AutomationStatus" ;
VAL_ 2621243117 MsgType_AV16 17 "PercentageFlow_Status" 1 "PercentageFlow_AutomationStatus" ;
VAL_ 2621243117 MsgType_AV15 17 "PercentageFlow_Status" 1 "PercentageFlow_AutomationStatus" ;
VAL_ 2621243117 MsgType_AV14 17 "PercentageFlow_Status" 1 "PercentageFlow_AutomationStatus" ;
VAL_ 2621243117 MsgType_AV13 17 "PercentageFlow_Status" 1 "PercentageFlow_AutomationStatus" ;
VAL_ 2621243117 MsgType_AV12 17 "PercentageFlow_Status" 1 "PercentageFlow_AutomationStatus" ;
VAL_ 2621243117 MsgType_AV11 17 "PercentageFlow_Status" 1 "PercentageFlow_AutomationStatus" ;
VAL_ 2621243117 MsgType_AV10 17 "PercentageFlow_Status" 1 "PercentageFlow_AutomationStatus" ;
VAL_ 2621243117 MsgType_AV09 17 "PercentageFlow_Status" 1 "PercentageFlow_AutomationStatus" ;
VAL_ 2621243117 MsgType_AV08 17 "PercentageFlow_Status" 1 "PercentageFlow_AutomationStatus" ;
VAL_ 2621243117 MsgType_AV07 17 "PercentageFlow_Status" 1 "PercentageFlow_AutomationStatus" ;
VAL_ 2621243117 MsgType_AV06 17 "PercentageFlow_Status" 1 "PercentageFlow_AutomationStatus" ;
VAL_ 2621243117 MsgType_AV05 17 "PercentageFlow_Status" 1 "PercentageFlow_AutomationStatus" ;
VAL_ 2621243117 MsgType_AV04 17 "PercentageFlow_Status" 1 "PercentageFlow_AutomationStatus" ;
VAL_ 2621243117 MsgType_AV03 17 "PercentageFlow_Status" 1 "PercentageFlow_AutomationStatus" ;
VAL_ 2621243117 MsgType_AV02 17 "PercentageFlow_Status" 1 "PercentageFlow_AutomationStatus" ;
VAL_ 2621243117 MsgType_AV01 17 "PercentageFlow_Status" 1 "PercentageFlow_AutomationStatus" ;
VAL_ 2621243117 Position_RH 65535 "NotAvailable" 65534 "Error" ;
VAL_ 2621243117 Speed_RPTO 65535 "NotAvailable" 65534 "Error" ;
VAL_ 2621243117 Flow_AV32 65535 "NotAvailable" 65534 "Error" 64257 "Float" 64256 "ValveFullyOpened_Retract" 32128 "NoFlow_Block" 0 "ValveFullyOpened_Extend" ;
VAL_ 2621243117 Flow_AV31 65535 "NotAvailable" 65534 "Error" 64257 "Float" 64256 "ValveFullyOpened_Retract" 32128 "NoFlow_Block" 0 "ValveFullyOpened_Extend" ;
VAL_ 2621243117 Flow_AV30 65535 "NotAvailable" 65534 "Error" 64257 "Float" 64256 "ValveFullyOpened_Retract" 32128 "NoFlow_Block" 0 "ValveFullyOpened_Extend" ;
VAL_ 2621243117 Flow_AV29 65535 "NotAvailable" 65534 "Error" 64257 "Float" 64256 "ValveFullyOpened_Retract" 32128 "NoFlow_Block" 0 "ValveFullyOpened_Extend" ;
VAL_ 2621243117 Flow_AV28 65535 "NotAvailable" 65534 "Error" 64257 "Float" 64256 "ValveFullyOpened_Retract" 32128 "NoFlow_Block" 0 "ValveFullyOpened_Extend" ;
VAL_ 2621243117 Flow_AV27 65535 "NotAvailable" 65534 "Error" 64257 "Float" 64256 "ValveFullyOpened_Retract" 32128 "NoFlow_Block" 0 "ValveFullyOpened_Extend" ;
VAL_ 2621243117 Flow_AV26 65535 "NotAvailable" 65534 "Error" 64257 "Float" 64256 "ValveFullyOpened_Retract" 32128 "NoFlow_Block" 0 "ValveFullyOpened_Extend" ;
VAL_ 2621243117 Flow_AV25 65535 "NotAvailable" 65534 "Error" 64257 "Float" 64256 "ValveFullyOpened_Retract" 32128 "NoFlow_Block" 0 "ValveFullyOpened_Extend" ;
VAL_ 2621243117 Flow_AV24 65535 "NotAvailable" 65534 "Error" 64257 "Float" 64256 "ValveFullyOpened_Retract" 32128 "NoFlow_Block" 0 "ValveFullyOpened_Extend" ;
VAL_ 2621243117 Flow_AV23 65535 "NotAvailable" 65534 "Error" 64257 "Float" 64256 "ValveFullyOpened_Retract" 32128 "NoFlow_Block" 0 "ValveFullyOpened_Extend" ;
VAL_ 2621243117 Flow_AV22 65535 "NotAvailable" 65534 "Error" 64257 "Float" 64256 "ValveFullyOpened_Retract" 32128 "NoFlow_Block" 0 "ValveFullyOpened_Extend" ;
VAL_ 2621243117 Flow_AV21 65535 "NotAvailable" 65534 "Error" 64257 "Float" 64256 "ValveFullyOpened_Retract" 32128 "NoFlow_Block" 0 "ValveFullyOpened_Extend" ;
VAL_ 2621243117 Flow_AV20 65535 "NotAvailable" 65534 "Error" 64257 "Float" 64256 "ValveFullyOpened_Retract" 32128 "NoFlow_Block" 0 "ValveFullyOpened_Extend" ;
VAL_ 2621243117 Flow_AV19 65535 "NotAvailable" 65534 "Error" 64257 "Float" 64256 "ValveFullyOpened_Retract" 32128 "NoFlow_Block" 0 "ValveFullyOpened_Extend" ;
VAL_ 2621243117 Flow_AV18 65535 "NotAvailable" 65534 "Error" 64257 "Float" 64256 "ValveFullyOpened_Retract" 32128 "NoFlow_Block" 0 "ValveFullyOpened_Extend" ;
VAL_ 2621243117 Flow_AV17 65535 "NotAvailable" 65534 "Error" 64257 "Float" 64256 "ValveFullyOpened_Retract" 32128 "NoFlow_Block" 0 "ValveFullyOpened_Extend" ;
VAL_ 2621243117 Flow_AV16 65535 "NotAvailable" 65534 "Error" 64257 "Float" 64256 "ValveFullyOpened_Retract" 32128 "NoFlow_Block" 0 "ValveFullyOpened_Extend" ;
VAL_ 2621243117 Flow_AV15 65535 "NotAvailable" 65534 "Error" 64257 "Float" 64256 "ValveFullyOpened_Retract" 32128 "NoFlow_Block" 0 "ValveFullyOpened_Extend" ;
VAL_ 2621243117 Flow_AV14 65535 "NotAvailable" 65534 "Error" 64257 "Float" 64256 "ValveFullyOpened_Retract" 32128 "NoFlow_Block" 0 "ValveFullyOpened_Extend" ;
VAL_ 2621243117 Flow_AV13 65535 "NotAvailable" 65534 "Error" 64257 "Float" 64256 "ValveFullyOpened_Retract" 32128 "NoFlow_Block" 0 "ValveFullyOpened_Extend" ;
VAL_ 2621243117 Flow_AV12 65535 "NotAvailable" 65534 "Error" 64257 "Float" 64256 "ValveFullyOpened_Retract" 32128 "NoFlow_Block" 0 "ValveFullyOpened_Extend" ;
VAL_ 2621243117 Flow_AV11 65535 "NotAvailable" 65534 "Error" 64257 "Float" 64256 "ValveFullyOpened_Retract" 32128 "NoFlow_Block" 0 "ValveFullyOpened_Extend" ;
VAL_ 2621243117 Flow_AV10 65535 "NotAvailable" 65534 "Error" 64257 "Float" 64256 "ValveFullyOpened_Retract" 32128 "NoFlow_Block" 0 "ValveFullyOpened_Extend" ;
VAL_ 2621243117 Flow_AV09 65535 "NotAvailable" 65534 "Error" 64257 "Float" 64256 "ValveFullyOpened_Retract" 32128 "NoFlow_Block" 0 "ValveFullyOpened_Extend" ;
VAL_ 2621243117 Flow_AV08 65535 "NotAvailable" 65534 "Error" 64257 "Float" 64256 "ValveFullyOpened_Retract" 32128 "NoFlow_Block" 0 "ValveFullyOpened_Extend" ;
VAL_ 2621243117 Flow_AV07 65535 "NotAvailable" 65534 "Error" 64257 "Float" 64256 "ValveFullyOpened_Retract" 32128 "NoFlow_Block" 0 "ValveFullyOpened_Extend" ;
VAL_ 2621243117 Flow_AV06 65535 "NotAvailable" 65534 "Error" 64257 "Float" 64256 "ValveFullyOpened_Retract" 32128 "NoFlow_Block" 0 "ValveFullyOpened_Extend" ;
VAL_ 2621243117 Flow_AV05 65535 "NotAvailable" 65534 "Error" 64257 "Float" 64256 "ValveFullyOpened_Retract" 32128 "NoFlow_Block" 0 "ValveFullyOpened_Extend" ;
VAL_ 2621243117 Flow_AV04 65535 "NotAvailable" 65534 "Error" 64257 "Float" 64256 "ValveFullyOpened_Retract" 32128 "NoFlow_Block" 0 "ValveFullyOpened_Extend" ;
VAL_ 2621243117 Flow_AV03 65535 "NotAvailable" 65534 "Error" 64257 "Float" 64256 "ValveFullyOpened_Retract" 32128 "NoFlow_Block" 0 "ValveFullyOpened_Extend" ;
VAL_ 2621243117 Flow_AV02 65535 "NotAvailable" 65534 "Error" 64257 "Float" 64256 "ValveFullyOpened_Retract" 32128 "NoFlow_Block" 0 "ValveFullyOpened_Extend" ;
VAL_ 2621243117 FlowType_AV32 3 "NotAvailable" 2 "Error" 1 "Measured" 0 "Estimated" ;
VAL_ 2621243117 FlowType_AV31 3 "NotAvailable" 2 "Error" 1 "Measured" 0 "Estimated" ;
VAL_ 2621243117 FlowType_AV30 3 "NotAvailable" 2 "Error" 1 "Measured" 0 "Estimated" ;
VAL_ 2621243117 FlowType_AV29 3 "NotAvailable" 2 "Error" 1 "Measured" 0 "Estimated" ;
VAL_ 2621243117 FlowType_AV28 3 "NotAvailable" 2 "Error" 1 "Measured" 0 "Estimated" ;
VAL_ 2621243117 FlowType_AV27 3 "NotAvailable" 2 "Error" 1 "Measured" 0 "Estimated" ;
VAL_ 2621243117 FlowType_AV26 3 "NotAvailable" 2 "Error" 1 "Measured" 0 "Estimated" ;
VAL_ 2621243117 FlowType_AV25 3 "NotAvailable" 2 "Error" 1 "Measured" 0 "Estimated" ;
VAL_ 2621243117 FlowType_AV24 3 "NotAvailable" 2 "Error" 1 "Measured" 0 "Estimated" ;
VAL_ 2621243117 FlowType_AV23 3 "NotAvailable" 2 "Error" 1 "Measured" 0 "Estimated" ;
VAL_ 2621243117 FlowType_AV22 3 "NotAvailable" 2 "Error" 1 "Measured" 0 "Estimated" ;
VAL_ 2621243117 FlowType_AV21 3 "NotAvailable" 2 "Error" 1 "Measured" 0 "Estimated" ;
VAL_ 2621243117 FlowType_AV20 3 "NotAvailable" 2 "Error" 1 "Measured" 0 "Estimated" ;
VAL_ 2621243117 FlowType_AV19 3 "NotAvailable" 2 "Error" 1 "Measured" 0 "Estimated" ;
VAL_ 2621243117 FlowType_AV18 3 "NotAvailable" 2 "Error" 1 "Measured" 0 "Estimated" ;
VAL_ 2621243117 FlowType_AV17 3 "NotAvailable" 2 "Error" 1 "Measured" 0 "Estimated" ;
VAL_ 2621243117 FlowType_AV16 3 "NotAvailable" 2 "Error" 1 "Measured" 0 "Estimated" ;
VAL_ 2621243117 FlowType_AV15 3 "NotAvailable" 2 "Error" 1 "Measured" 0 "Estimated" ;
VAL_ 2621243117 FlowType_AV14 3 "NotAvailable" 2 "Error" 1 "Measured" 0 "Estimated" ;
VAL_ 2621243117 FlowType_AV13 3 "NotAvailable" 2 "Error" 1 "Measured" 0 "Estimated" ;
VAL_ 2621243117 FlowType_AV12 3 "NotAvailable" 2 "Error" 1 "Measured" 0 "Estimated" ;
VAL_ 2621243117 FlowType_AV11 3 "NotAvailable" 2 "Error" 1 "Measured" 0 "Estimated" ;
VAL_ 2621243117 FlowType_AV10 3 "NotAvailable" 2 "Error" 1 "Measured" 0 "Estimated" ;
VAL_ 2621243117 FlowType_AV09 3 "NotAvailable" 2 "Error" 1 "Measured" 0 "Estimated" ;
VAL_ 2621243117 FlowType_AV08 3 "NotAvailable" 2 "Error" 1 "Measured" 0 "Estimated" ;
VAL_ 2621243117 FlowType_AV07 3 "NotAvailable" 2 "Error" 1 "Measured" 0 "Estimated" ;
VAL_ 2621243117 FlowType_AV06 3 "NotAvailable" 2 "Error" 1 "Measured" 0 "Estimated" ;
VAL_ 2621243117 FlowType_AV05 3 "NotAvailable" 2 "Error" 1 "Measured" 0 "Estimated" ;
VAL_ 2621243117 FlowType_AV04 3 "NotAvailable" 2 "Error" 1 "Measured" 0 "Estimated" ;
VAL_ 2621243117 FlowType_AV03 3 "NotAvailable" 2 "Error" 1 "Measured" 0 "Estimated" ;
VAL_ 2621243117 FlowType_AV02 3 "NotAvailable" 2 "Error" 1 "Measured" 0 "Estimated" ;
VAL_ 2621243117 FlowType_AV01 3 "NotAvailable" 2 "Error" 1 "Measured" 0 "Estimated" ;
VAL_ 2621243117 ExitReasonCode_RPTO 31 "NotAvailable" 30 "Error" 15 "InvalidPtoGear" 9 "FunctionFault" 8 "OperatorControlFault" 5 "RemoteCommandTimeout" 4 "OperatorControlNotInValidPosition" 3 "OperatorOverrideOfFunction" 2 "ImplementReleasedControlOfFunction" 7 "FunctionNotCalibrated" 6 "RemoteCommandOutOfRange_Invalid" 1 "RequiredLevelOfOperatorPresence_AwarenessNotDetected" 0 "NoReason_AllClear" ;
VAL_ 2621243117 ExitReasonCode_RH 16 "HitchLockedOut" 31 "NotAvailable" 30 "Error" 15 "HydraulicOilLevelLow" 9 "FunctionFault" 8 "OperatorControlFault" 5 "RemoteCommandTimeout" 4 "OperatorControlNotInValidPosition" 3 "OperatorOverrideOfFunction" 2 "ImplementReleasedControlOfFunction" 7 "FunctionNotCalibrated" 6 "RemoteCommandOutOfRangeOrInvalid" 1 "RequiredLevelOfOperatorPresence_AwarenessNotDetected" 0 "NoReason_AllClear" ;
VAL_ 2621243117 ExitReasonCode_AV32 31 "NotAvailable" 30 "Error" 16 "ValveLockedOut_TransportLock" 15 "HydraulicOilLevelLow" 9 "FunctionFault" 8 "OperatorControlFault" 5 "RemoteCommandTimeout" 4 "OperatorControlNotInValidPosition" 3 "OperatorOverrideOfFunction" 2 "ImplementReleasedControlOfFunction" 7 "FunctionNotCalibrated" 6 "RemoteCommandOutOfRange_Invalid" 1 "RequiredLevelOfOperatorPresence_AwarenessNotDetected" 0 "NoReason_AllClear" ;
VAL_ 2621243117 ExitReasonCode_AV31 31 "NotAvailable" 30 "Error" 16 "ValveLockedOut_TransportLock" 15 "HydraulicOilLevelLow" 9 "FunctionFault" 8 "OperatorControlFault" 5 "RemoteCommandTimeout" 4 "OperatorControlNotInValidPosition" 3 "OperatorOverrideOfFunction" 2 "ImplementReleasedControlOfFunction" 7 "FunctionNotCalibrated" 6 "RemoteCommandOutOfRange_Invalid" 1 "RequiredLevelOfOperatorPresence_AwarenessNotDetected" 0 "NoReason_AllClear" ;
VAL_ 2621243117 ExitReasonCode_AV30 31 "NotAvailable" 30 "Error" 16 "ValveLockedOut_TransportLock" 15 "HydraulicOilLevelLow" 9 "FunctionFault" 8 "OperatorControlFault" 5 "RemoteCommandTimeout" 4 "OperatorControlNotInValidPosition" 3 "OperatorOverrideOfFunction" 2 "ImplementReleasedControlOfFunction" 7 "FunctionNotCalibrated" 6 "RemoteCommandOutOfRange_Invalid" 1 "RequiredLevelOfOperatorPresence_AwarenessNotDetected" 0 "NoReason_AllClear" ;
VAL_ 2621243117 ExitReasonCode_AV29 31 "NotAvailable" 30 "Error" 16 "ValveLockedOut_TransportLock" 15 "HydraulicOilLevelLow" 9 "FunctionFault" 8 "OperatorControlFault" 5 "RemoteCommandTimeout" 4 "OperatorControlNotInValidPosition" 3 "OperatorOverrideOfFunction" 2 "ImplementReleasedControlOfFunction" 7 "FunctionNotCalibrated" 6 "RemoteCommandOutOfRange_Invalid" 1 "RequiredLevelOfOperatorPresence_AwarenessNotDetected" 0 "NoReason_AllClear" ;
VAL_ 2621243117 ExitReasonCode_AV28 31 "NotAvailable" 30 "Error" 16 "ValveLockedOut_TransportLock" 15 "HydraulicOilLevelLow" 9 "FunctionFault" 8 "OperatorControlFault" 5 "RemoteCommandTimeout" 4 "OperatorControlNotInValidPosition" 3 "OperatorOverrideOfFunction" 2 "ImplementReleasedControlOfFunction" 7 "FunctionNotCalibrated" 6 "RemoteCommandOutOfRange_Invalid" 1 "RequiredLevelOfOperatorPresence_AwarenessNotDetected" 0 "NoReason_AllClear" ;
VAL_ 2621243117 ExitReasonCode_AV27 31 "NotAvailable" 30 "Error" 16 "ValveLockedOut_TransportLock" 15 "HydraulicOilLevelLow" 9 "FunctionFault" 8 "OperatorControlFault" 5 "RemoteCommandTimeout" 4 "OperatorControlNotInValidPosition" 3 "OperatorOverrideOfFunction" 2 "ImplementReleasedControlOfFunction" 7 "FunctionNotCalibrated" 6 "RemoteCommandOutOfRange_Invalid" 1 "RequiredLevelOfOperatorPresence_AwarenessNotDetected" 0 "NoReason_AllClear" ;
VAL_ 2621243117 ExitReasonCode_AV26 31 "NotAvailable" 30 "Error" 16 "ValveLockedOut_TransportLock" 15 "HydraulicOilLevelLow" 9 "FunctionFault" 8 "OperatorControlFault" 5 "RemoteCommandTimeout" 4 "OperatorControlNotInValidPosition" 3 "OperatorOverrideOfFunction" 2 "ImplementReleasedControlOfFunction" 7 "FunctionNotCalibrated" 6 "RemoteCommandOutOfRange_Invalid" 1 "RequiredLevelOfOperatorPresence_AwarenessNotDetected" 0 "NoReason_AllClear" ;
VAL_ 2621243117 ExitReasonCode_AV25 31 "NotAvailable" 30 "Error" 16 "ValveLockedOut_TransportLock" 15 "HydraulicOilLevelLow" 9 "FunctionFault" 8 "OperatorControlFault" 5 "RemoteCommandTimeout" 4 "OperatorControlNotInValidPosition" 3 "OperatorOverrideOfFunction" 2 "ImplementReleasedControlOfFunction" 7 "FunctionNotCalibrated" 6 "RemoteCommandOutOfRange_Invalid" 1 "RequiredLevelOfOperatorPresence_AwarenessNotDetected" 0 "NoReason_AllClear" ;
VAL_ 2621243117 ExitReasonCode_AV24 31 "NotAvailable" 30 "Error" 16 "ValveLockedOut_TransportLock" 15 "HydraulicOilLevelLow" 9 "FunctionFault" 8 "OperatorControlFault" 5 "RemoteCommandTimeout" 4 "OperatorControlNotInValidPosition" 3 "OperatorOverrideOfFunction" 2 "ImplementReleasedControlOfFunction" 7 "FunctionNotCalibrated" 6 "RemoteCommandOutOfRange_Invalid" 1 "RequiredLevelOfOperatorPresence_AwarenessNotDetected" 0 "NoReason_AllClear" ;
VAL_ 2621243117 ExitReasonCode_AV23 31 "NotAvailable" 30 "Error" 16 "ValveLockedOut_TransportLock" 15 "HydraulicOilLevelLow" 9 "FunctionFault" 8 "OperatorControlFault" 5 "RemoteCommandTimeout" 4 "OperatorControlNotInValidPosition" 3 "OperatorOverrideOfFunction" 2 "ImplementReleasedControlOfFunction" 7 "FunctionNotCalibrated" 6 "RemoteCommandOutOfRange_Invalid" 1 "RequiredLevelOfOperatorPresence_AwarenessNotDetected" 0 "NoReason_AllClear" ;
VAL_ 2621243117 ExitReasonCode_AV22 31 "NotAvailable" 30 "Error" 16 "ValveLockedOut_TransportLock" 15 "HydraulicOilLevelLow" 9 "FunctionFault" 8 "OperatorControlFault" 5 "RemoteCommandTimeout" 4 "OperatorControlNotInValidPosition" 3 "OperatorOverrideOfFunction" 2 "ImplementReleasedControlOfFunction" 7 "FunctionNotCalibrated" 6 "RemoteCommandOutOfRange_Invalid" 1 "RequiredLevelOfOperatorPresence_AwarenessNotDetected" 0 "NoReason_AllClear" ;
VAL_ 2621243117 ExitReasonCode_AV21 31 "NotAvailable" 30 "Error" 16 "ValveLockedOut_TransportLock" 15 "HydraulicOilLevelLow" 9 "FunctionFault" 8 "OperatorControlFault" 5 "RemoteCommandTimeout" 4 "OperatorControlNotInValidPosition" 3 "OperatorOverrideOfFunction" 2 "ImplementReleasedControlOfFunction" 7 "FunctionNotCalibrated" 6 "RemoteCommandOutOfRange_Invalid" 1 "RequiredLevelOfOperatorPresence_AwarenessNotDetected" 0 "NoReason_AllClear" ;
VAL_ 2621243117 ExitReasonCode_AV20 31 "NotAvailable" 30 "Error" 16 "ValveLockedOut_TransportLock" 15 "HydraulicOilLevelLow" 9 "FunctionFault" 8 "OperatorControlFault" 5 "RemoteCommandTimeout" 4 "OperatorControlNotInValidPosition" 3 "OperatorOverrideOfFunction" 2 "ImplementReleasedControlOfFunction" 7 "FunctionNotCalibrated" 6 "RemoteCommandOutOfRange_Invalid" 1 "RequiredLevelOfOperatorPresence_AwarenessNotDetected" 0 "NoReason_AllClear" ;
VAL_ 2621243117 ExitReasonCode_AV19 31 "NotAvailable" 30 "Error" 16 "ValveLockedOut_TransportLock" 15 "HydraulicOilLevelLow" 9 "FunctionFault" 8 "OperatorControlFault" 5 "RemoteCommandTimeout" 4 "OperatorControlNotInValidPosition" 3 "OperatorOverrideOfFunction" 2 "ImplementReleasedControlOfFunction" 7 "FunctionNotCalibrated" 6 "RemoteCommandOutOfRange_Invalid" 1 "RequiredLevelOfOperatorPresence_AwarenessNotDetected" 0 "NoReason_AllClear" ;
VAL_ 2621243117 ExitReasonCode_AV18 31 "NotAvailable" 30 "Error" 16 "ValveLockedOut_TransportLock" 15 "HydraulicOilLevelLow" 9 "FunctionFault" 8 "OperatorControlFault" 5 "RemoteCommandTimeout" 4 "OperatorControlNotInValidPosition" 3 "OperatorOverrideOfFunction" 2 "ImplementReleasedControlOfFunction" 7 "FunctionNotCalibrated" 6 "RemoteCommandOutOfRange_Invalid" 1 "RequiredLevelOfOperatorPresence_AwarenessNotDetected" 0 "NoReason_AllClear" ;
VAL_ 2621243117 ExitReasonCode_AV17 31 "NotAvailable" 30 "Error" 16 "ValveLockedOut_TransportLock" 15 "HydraulicOilLevelLow" 9 "FunctionFault" 8 "OperatorControlFault" 5 "RemoteCommandTimeout" 4 "OperatorControlNotInValidPosition" 3 "OperatorOverrideOfFunction" 2 "ImplementReleasedControlOfFunction" 7 "FunctionNotCalibrated" 6 "RemoteCommandOutOfRange_Invalid" 1 "RequiredLevelOfOperatorPresence_AwarenessNotDetected" 0 "NoReason_AllClear" ;
VAL_ 2621243117 ExitReasonCode_AV16 31 "NotAvailable" 30 "Error" 16 "ValveLockedOut_TransportLock" 15 "HydraulicOilLevelLow" 9 "FunctionFault" 8 "OperatorControlFault" 5 "RemoteCommandTimeout" 4 "OperatorControlNotInValidPosition" 3 "OperatorOverrideOfFunction" 2 "ImplementReleasedControlOfFunction" 7 "FunctionNotCalibrated" 6 "RemoteCommandOutOfRange_Invalid" 1 "RequiredLevelOfOperatorPresence_AwarenessNotDetected" 0 "NoReason_AllClear" ;
VAL_ 2621243117 ExitReasonCode_AV15 31 "NotAvailable" 30 "Error" 16 "ValveLockedOut_TransportLock" 15 "HydraulicOilLevelLow" 9 "FunctionFault" 8 "OperatorControlFault" 5 "RemoteCommandTimeout" 4 "OperatorControlNotInValidPosition" 3 "OperatorOverrideOfFunction" 2 "ImplementReleasedControlOfFunction" 7 "FunctionNotCalibrated" 6 "RemoteCommandOutOfRange_Invalid" 1 "RequiredLevelOfOperatorPresence_AwarenessNotDetected" 0 "NoReason_AllClear" ;
VAL_ 2621243117 ExitReasonCode_AV14 31 "NotAvailable" 30 "Error" 16 "ValveLockedOut_TransportLock" 15 "HydraulicOilLevelLow" 9 "FunctionFault" 8 "OperatorControlFault" 5 "RemoteCommandTimeout" 4 "OperatorControlNotInValidPosition" 3 "OperatorOverrideOfFunction" 2 "ImplementReleasedControlOfFunction" 7 "FunctionNotCalibrated" 6 "RemoteCommandOutOfRange_Invalid" 1 "RequiredLevelOfOperatorPresence_AwarenessNotDetected" 0 "NoReason_AllClear" ;
VAL_ 2621243117 ExitReasonCode_AV13 31 "NotAvailable" 30 "Error" 16 "ValveLockedOut_TransportLock" 15 "HydraulicOilLevelLow" 9 "FunctionFault" 8 "OperatorControlFault" 5 "RemoteCommandTimeout" 4 "OperatorControlNotInValidPosition" 3 "OperatorOverrideOfFunction" 2 "ImplementReleasedControlOfFunction" 7 "FunctionNotCalibrated" 6 "RemoteCommandOutOfRange_Invalid" 1 "RequiredLevelOfOperatorPresence_AwarenessNotDetected" 0 "NoReason_AllClear" ;
VAL_ 2621243117 ExitReasonCode_AV12 31 "NotAvailable" 30 "Error" 16 "ValveLockedOut_TransportLock" 15 "HydraulicOilLevelLow" 9 "FunctionFault" 8 "OperatorControlFault" 5 "RemoteCommandTimeout" 4 "OperatorControlNotInValidPosition" 3 "OperatorOverrideOfFunction" 2 "ImplementReleasedControlOfFunction" 7 "FunctionNotCalibrated" 6 "RemoteCommandOutOfRange_Invalid" 1 "RequiredLevelOfOperatorPresence_AwarenessNotDetected" 0 "NoReason_AllClear" ;
VAL_ 2621243117 ExitReasonCode_AV11 31 "NotAvailable" 30 "Error" 16 "ValveLockedOut_TransportLock" 15 "HydraulicOilLevelLow" 9 "FunctionFault" 8 "OperatorControlFault" 5 "RemoteCommandTimeout" 4 "OperatorControlNotInValidPosition" 3 "OperatorOverrideOfFunction" 2 "ImplementReleasedControlOfFunction" 7 "FunctionNotCalibrated" 6 "RemoteCommandOutOfRange_Invalid" 1 "RequiredLevelOfOperatorPresence_AwarenessNotDetected" 0 "NoReason_AllClear" ;
VAL_ 2621243117 ExitReasonCode_AV10 31 "NotAvailable" 30 "Error" 16 "ValveLockedOut_TransportLock" 15 "HydraulicOilLevelLow" 9 "FunctionFault" 8 "OperatorControlFault" 5 "RemoteCommandTimeout" 4 "OperatorControlNotInValidPosition" 3 "OperatorOverrideOfFunction" 2 "ImplementReleasedControlOfFunction" 7 "FunctionNotCalibrated" 6 "RemoteCommandOutOfRange_Invalid" 1 "RequiredLevelOfOperatorPresence_AwarenessNotDetected" 0 "NoReason_AllClear" ;
VAL_ 2621243117 ExitReasonCode_AV09 31 "NotAvailable" 30 "Error" 16 "ValveLockedOut_TransportLock" 15 "HydraulicOilLevelLow" 9 "FunctionFault" 8 "OperatorControlFault" 5 "RemoteCommandTimeout" 4 "OperatorControlNotInValidPosition" 3 "OperatorOverrideOfFunction" 2 "ImplementReleasedControlOfFunction" 7 "FunctionNotCalibrated" 6 "RemoteCommandOutOfRange_Invalid" 1 "RequiredLevelOfOperatorPresence_AwarenessNotDetected" 0 "NoReason_AllClear" ;
VAL_ 2621243117 ExitReasonCode_AV08 31 "NotAvailable" 30 "Error" 16 "ValveLockedOut_TransportLock" 15 "HydraulicOilLevelLow" 9 "FunctionFault" 8 "OperatorControlFault" 5 "RemoteCommandTimeout" 4 "OperatorControlNotInValidPosition" 3 "OperatorOverrideOfFunction" 2 "ImplementReleasedControlOfFunction" 7 "FunctionNotCalibrated" 6 "RemoteCommandOutOfRange_Invalid" 1 "RequiredLevelOfOperatorPresence_AwarenessNotDetected" 0 "NoReason_AllClear" ;
VAL_ 2621243117 ExitReasonCode_AV07 31 "NotAvailable" 30 "Error" 16 "ValveLockedOut_TransportLock" 15 "HydraulicOilLevelLow" 9 "FunctionFault" 8 "OperatorControlFault" 5 "RemoteCommandTimeout" 4 "OperatorControlNotInValidPosition" 3 "OperatorOverrideOfFunction" 2 "ImplementReleasedControlOfFunction" 7 "FunctionNotCalibrated" 6 "RemoteCommandOutOfRange_Invalid" 1 "RequiredLevelOfOperatorPresence_AwarenessNotDetected" 0 "NoReason_AllClear" ;
VAL_ 2621243117 ExitReasonCode_AV06 31 "NotAvailable" 30 "Error" 16 "ValveLockedOut_TransportLock" 15 "HydraulicOilLevelLow" 9 "FunctionFault" 8 "OperatorControlFault" 5 "RemoteCommandTimeout" 4 "OperatorControlNotInValidPosition" 3 "OperatorOverrideOfFunction" 2 "ImplementReleasedControlOfFunction" 7 "FunctionNotCalibrated" 6 "RemoteCommandOutOfRange_Invalid" 1 "RequiredLevelOfOperatorPresence_AwarenessNotDetected" 0 "NoReason_AllClear" ;
VAL_ 2621243117 ExitReasonCode_AV05 31 "NotAvailable" 30 "Error" 16 "ValveLockedOut_TransportLock" 15 "HydraulicOilLevelLow" 9 "FunctionFault" 8 "OperatorControlFault" 5 "RemoteCommandTimeout" 4 "OperatorControlNotInValidPosition" 3 "OperatorOverrideOfFunction" 2 "ImplementReleasedControlOfFunction" 7 "FunctionNotCalibrated" 6 "RemoteCommandOutOfRange_Invalid" 1 "RequiredLevelOfOperatorPresence_AwarenessNotDetected" 0 "NoReason_AllClear" ;
VAL_ 2621243117 ExitReasonCode_AV04 31 "NotAvailable" 30 "Error" 16 "ValveLockedOut_TransportLock" 15 "HydraulicOilLevelLow" 9 "FunctionFault" 8 "OperatorControlFault" 5 "RemoteCommandTimeout" 4 "OperatorControlNotInValidPosition" 3 "OperatorOverrideOfFunction" 2 "ImplementReleasedControlOfFunction" 7 "FunctionNotCalibrated" 6 "RemoteCommandOutOfRange_Invalid" 1 "RequiredLevelOfOperatorPresence_AwarenessNotDetected" 0 "NoReason_AllClear" ;
VAL_ 2621243117 ExitReasonCode_AV03 31 "NotAvailable" 30 "Error" 16 "ValveLockedOut_TransportLock" 15 "HydraulicOilLevelLow" 9 "FunctionFault" 8 "OperatorControlFault" 5 "RemoteCommandTimeout" 4 "OperatorControlNotInValidPosition" 3 "OperatorOverrideOfFunction" 2 "ImplementReleasedControlOfFunction" 7 "FunctionNotCalibrated" 6 "RemoteCommandOutOfRange_Invalid" 1 "RequiredLevelOfOperatorPresence_AwarenessNotDetected" 0 "NoReason_AllClear" ;
VAL_ 2621243117 ExitReasonCode_AV02 31 "NotAvailable" 30 "Error" 16 "ValveLockedOut_TransportLock" 15 "HydraulicOilLevelLow" 9 "FunctionFault" 8 "OperatorControlFault" 5 "RemoteCommandTimeout" 4 "OperatorControlNotInValidPosition" 3 "OperatorOverrideOfFunction" 2 "ImplementReleasedControlOfFunction" 7 "FunctionNotCalibrated" 6 "RemoteCommandOutOfRange_Invalid" 1 "RequiredLevelOfOperatorPresence_AwarenessNotDetected" 0 "NoReason_AllClear" ;
VAL_ 2621243117 AutomationStatus_AV04 13 "AutomationFault" 7 "ActiveLimitedLow" 6 "ActiveLimitedHigh" 5 "ActiveNotLimited" 0 "AutomationUnavailable" 1 "AutomationNotReady" 2 "AutomationReadyToEnable" 3 "AutomationEnabled" 4 "AutomationPending" 14 "NonRecoverableFault" 15 "NotAvailable" ;
VAL_ 2621243117 AutomationStatus_AV03 13 "AutomationFault" 7 "ActiveLimitedLow" 6 "ActiveLimitedHigh" 5 "ActiveNotLimited" 0 "AutomationUnavailable" 1 "AutomationNotReady" 2 "AutomationReadyToEnable" 3 "AutomationEnabled" 4 "AutomationPending" 14 "NonRecoverableFault" 15 "NotAvailable" ;
VAL_ 2621243117 AutomationStatus_AV02 13 "AutomationFault" 7 "ActiveLimitedLow" 6 "ActiveLimitedHigh" 5 "ActiveNotLimited" 0 "AutomationUnavailable" 1 "AutomationNotReady" 2 "AutomationReadyToEnable" 3 "AutomationEnabled" 4 "AutomationPending" 14 "NonRecoverableFault" 15 "NotAvailable" ;
VAL_ 2621243117 AutomationStatus_AV01 13 "AutomationFault" 7 "ActiveLimitedLow" 6 "ActiveLimitedHigh" 5 "ActiveNotLimited" 0 "AutomationUnavailable" 1 "AutomationNotReady" 2 "AutomationReadyToEnable" 3 "AutomationEnabled" 4 "AutomationPending" 14 "NonRecoverableFault" 15 "NotAvailable" ;
VAL_ 2621243117 AutomationStatus_EG 13 "AutomationFault" 7 "ActiveLimitedLow" 6 "ActiveLimitedHigh" 5 "ActiveNotLimited" 0 "AutomationUnavailable" 1 "AutomationNotReady" 2 "AutomationReadyToEnable" 3 "AutomationEnabled" 4 "AutomationPending" 14 "NonRecoverableFault" 15 "NotAvailable" ;
VAL_ 2621243117 AutomationStatus_VS 13 "AutomationFault" 7 "ActiveLimitedLow" 6 "ActiveLimitedHigh" 5 "ActiveNotLimited" 0 "AutomationUnavailable" 1 "AutomationNotReady" 2 "AutomationReadyToEnable" 3 "AutomationEnabled" 4 "AutomationPending" 14 "NonRecoverableFault" 15 "NotAvailable" ;
VAL_ 2621243117 AutomationStatus_RH 13 "AutomationFault" 7 "ActiveLimitedLow" 6 "ActiveLimitedHigh" 5 "ActiveNotLimited" 0 "AutomationUnavailable" 1 "AutomationNotReady" 2 "AutomationReadyToEnable" 3 "AutomationEnabled" 4 "AutomationPending" 14 "NonRecoverableFault" 15 "NotAvailable" ;
VAL_ 2621243117 AutomationStatus_FH 13 "AutomationFault" 7 "ActiveLimitedLow" 6 "ActiveLimitedHigh" 5 "ActiveNotLimited" 0 "AutomationUnavailable" 1 "AutomationNotReady" 2 "AutomationReadyToEnable" 3 "AutomationEnabled" 4 "AutomationPending" 14 "NonRecoverableFault" 15 "NotAvailable" ;
VAL_ 2621243117 AutomationStatus_RPTO 13 "AutomationFault" 7 "ActiveLimitedLow" 6 "ActiveLimitedHigh" 5 "ActiveNotLimited" 0 "AutomationUnavailable" 1 "AutomationNotReady" 2 "AutomationReadyToEnable" 3 "AutomationEnabled" 4 "AutomationPending" 14 "NonRecoverableFault" 15 "NotAvailable" ;
VAL_ 2621243117 AutomationStatus_FPTO 13 "AutomationFault" 7 "ActiveLimitedLow" 6 "ActiveLimitedHigh" 5 "ActiveNotLimited" 0 "AutomationUnavailable" 1 "AutomationNotReady" 2 "AutomationReadyToEnable" 3 "AutomationEnabled" 4 "AutomationPending" 14 "NonRecoverableFault" 15 "NotAvailable" ;
VAL_ 2621243117 AutomationStatus_AV32 13 "AutomationFault" 7 "ActiveLimitedLow" 6 "ActiveLimitedHigh" 5 "ActiveNotLimited" 0 "AutomationUnavailable" 1 "AutomationNotReady" 2 "AutomationReadyToEnable" 3 "AutomationEnabled" 4 "AutomationPending" 14 "NonRecoverableFault" 15 "NotAvailable" ;
VAL_ 2621243117 AutomationStatus_AV31 13 "AutomationFault" 7 "ActiveLimitedLow" 6 "ActiveLimitedHigh" 5 "ActiveNotLimited" 0 "AutomationUnavailable" 1 "AutomationNotReady" 2 "AutomationReadyToEnable" 3 "AutomationEnabled" 4 "AutomationPending" 14 "NonRecoverableFault" 15 "NotAvailable" ;
VAL_ 2621243117 AutomationStatus_AV30 13 "AutomationFault" 7 "ActiveLimitedLow" 6 "ActiveLimitedHigh" 5 "ActiveNotLimited" 0 "AutomationUnavailable" 1 "AutomationNotReady" 2 "AutomationReadyToEnable" 3 "AutomationEnabled" 4 "AutomationPending" 14 "NonRecoverableFault" 15 "NotAvailable" ;
VAL_ 2621243117 AutomationStatus_AV29 13 "AutomationFault" 7 "ActiveLimitedLow" 6 "ActiveLimitedHigh" 5 "ActiveNotLimited" 0 "AutomationUnavailable" 1 "AutomationNotReady" 2 "AutomationReadyToEnable" 3 "AutomationEnabled" 4 "AutomationPending" 14 "NonRecoverableFault" 15 "NotAvailable" ;
VAL_ 2621243117 AutomationStatus_AV28 13 "AutomationFault" 7 "ActiveLimitedLow" 6 "ActiveLimitedHigh" 5 "ActiveNotLimited" 0 "AutomationUnavailable" 1 "AutomationNotReady" 2 "AutomationReadyToEnable" 3 "AutomationEnabled" 4 "AutomationPending" 14 "NonRecoverableFault" 15 "NotAvailable" ;
VAL_ 2621243117 AutomationStatus_AV27 13 "AutomationFault" 7 "ActiveLimitedLow" 6 "ActiveLimitedHigh" 5 "ActiveNotLimited" 0 "AutomationUnavailable" 1 "AutomationNotReady" 2 "AutomationReadyToEnable" 3 "AutomationEnabled" 4 "AutomationPending" 14 "NonRecoverableFault" 15 "NotAvailable" ;
VAL_ 2621243117 AutomationStatus_AV26 13 "AutomationFault" 7 "ActiveLimitedLow" 6 "ActiveLimitedHigh" 5 "ActiveNotLimited" 0 "AutomationUnavailable" 1 "AutomationNotReady" 2 "AutomationReadyToEnable" 3 "AutomationEnabled" 4 "AutomationPending" 14 "NonRecoverableFault" 15 "NotAvailable" ;
VAL_ 2621243117 AutomationStatus_AV25 13 "AutomationFault" 7 "ActiveLimitedLow" 6 "ActiveLimitedHigh" 5 "ActiveNotLimited" 0 "AutomationUnavailable" 1 "AutomationNotReady" 2 "AutomationReadyToEnable" 3 "AutomationEnabled" 4 "AutomationPending" 14 "NonRecoverableFault" 15 "NotAvailable" ;
VAL_ 2621243117 AutomationStatus_AV24 13 "AutomationFault" 7 "ActiveLimitedLow" 6 "ActiveLimitedHigh" 5 "ActiveNotLimited" 0 "AutomationUnavailable" 1 "AutomationNotReady" 2 "AutomationReadyToEnable" 3 "AutomationEnabled" 4 "AutomationPending" 14 "NonRecoverableFault" 15 "NotAvailable" ;
VAL_ 2621243117 AutomationStatus_AV23 13 "AutomationFault" 7 "ActiveLimitedLow" 6 "ActiveLimitedHigh" 5 "ActiveNotLimited" 0 "AutomationUnavailable" 1 "AutomationNotReady" 2 "AutomationReadyToEnable" 3 "AutomationEnabled" 4 "AutomationPending" 14 "NonRecoverableFault" 15 "NotAvailable" ;
VAL_ 2621243117 AutomationStatus_AV22 13 "AutomationFault" 7 "ActiveLimitedLow" 6 "ActiveLimitedHigh" 5 "ActiveNotLimited" 0 "AutomationUnavailable" 1 "AutomationNotReady" 2 "AutomationReadyToEnable" 3 "AutomationEnabled" 4 "AutomationPending" 14 "NonRecoverableFault" 15 "NotAvailable" ;
VAL_ 2621243117 AutomationStatus_AV21 13 "AutomationFault" 7 "ActiveLimitedLow" 6 "ActiveLimitedHigh" 5 "ActiveNotLimited" 0 "AutomationUnavailable" 1 "AutomationNotReady" 2 "AutomationReadyToEnable" 3 "AutomationEnabled" 4 "AutomationPending" 14 "NonRecoverableFault" 15 "NotAvailable" ;
VAL_ 2621243117 AutomationStatus_AV20 13 "AutomationFault" 7 "ActiveLimitedLow" 6 "ActiveLimitedHigh" 5 "ActiveNotLimited" 0 "AutomationUnavailable" 1 "AutomationNotReady" 2 "AutomationReadyToEnable" 3 "AutomationEnabled" 4 "AutomationPending" 14 "NonRecoverableFault" 15 "NotAvailable" ;
VAL_ 2621243117 AutomationStatus_AV19 13 "AutomationFault" 7 "ActiveLimitedLow" 6 "ActiveLimitedHigh" 5 "ActiveNotLimited" 0 "AutomationUnavailable" 1 "AutomationNotReady" 2 "AutomationReadyToEnable" 3 "AutomationEnabled" 4 "AutomationPending" 14 "NonRecoverableFault" 15 "NotAvailable" ;
VAL_ 2621243117 AutomationStatus_AV18 13 "AutomationFault" 7 "ActiveLimitedLow" 6 "ActiveLimitedHigh" 5 "ActiveNotLimited" 0 "AutomationUnavailable" 1 "AutomationNotReady" 2 "AutomationReadyToEnable" 3 "AutomationEnabled" 4 "AutomationPending" 14 "NonRecoverableFault" 15 "NotAvailable" ;
VAL_ 2621243117 AutomationStatus_AV17 13 "AutomationFault" 7 "ActiveLimitedLow" 6 "ActiveLimitedHigh" 5 "ActiveNotLimited" 0 "AutomationUnavailable" 1 "AutomationNotReady" 2 "AutomationReadyToEnable" 3 "AutomationEnabled" 4 "AutomationPending" 14 "NonRecoverableFault" 15 "NotAvailable" ;
VAL_ 2621243117 AutomationStatus_AV16 13 "AutomationFault" 7 "ActiveLimitedLow" 6 "ActiveLimitedHigh" 5 "ActiveNotLimited" 0 "AutomationUnavailable" 1 "AutomationNotReady" 2 "AutomationReadyToEnable" 3 "AutomationEnabled" 4 "AutomationPending" 14 "NonRecoverableFault" 15 "NotAvailable" ;
VAL_ 2621243117 AutomationStatus_AV15 13 "AutomationFault" 7 "ActiveLimitedLow" 6 "ActiveLimitedHigh" 5 "ActiveNotLimited" 0 "AutomationUnavailable" 1 "AutomationNotReady" 2 "AutomationReadyToEnable" 3 "AutomationEnabled" 4 "AutomationPending" 14 "NonRecoverableFault" 15 "NotAvailable" ;
VAL_ 2621243117 AutomationStatus_AV14 13 "AutomationFault" 7 "ActiveLimitedLow" 6 "ActiveLimitedHigh" 5 "ActiveNotLimited" 0 "AutomationUnavailable" 1 "AutomationNotReady" 2 "AutomationReadyToEnable" 3 "AutomationEnabled" 4 "AutomationPending" 14 "NonRecoverableFault" 15 "NotAvailable" ;
VAL_ 2621243117 AutomationStatus_AV13 13 "AutomationFault" 7 "ActiveLimitedLow" 6 "ActiveLimitedHigh" 5 "ActiveNotLimited" 0 "AutomationUnavailable" 1 "AutomationNotReady" 2 "AutomationReadyToEnable" 3 "AutomationEnabled" 4 "AutomationPending" 14 "NonRecoverableFault" 15 "NotAvailable" ;
VAL_ 2621243117 AutomationStatus_AV12 13 "AutomationFault" 7 "ActiveLimitedLow" 6 "ActiveLimitedHigh" 5 "ActiveNotLimited" 0 "AutomationUnavailable" 1 "AutomationNotReady" 2 "AutomationReadyToEnable" 3 "AutomationEnabled" 4 "AutomationPending" 14 "NonRecoverableFault" 15 "NotAvailable" ;
VAL_ 2621243117 AutomationStatus_AV11 13 "AutomationFault" 7 "ActiveLimitedLow" 6 "ActiveLimitedHigh" 5 "ActiveNotLimited" 0 "AutomationUnavailable" 1 "AutomationNotReady" 2 "AutomationReadyToEnable" 3 "AutomationEnabled" 4 "AutomationPending" 14 "NonRecoverableFault" 15 "NotAvailable" ;
VAL_ 2621243117 AutomationStatus_AV10 13 "AutomationFault" 7 "ActiveLimitedLow" 6 "ActiveLimitedHigh" 5 "ActiveNotLimited" 0 "AutomationUnavailable" 1 "AutomationNotReady" 2 "AutomationReadyToEnable" 3 "AutomationEnabled" 4 "AutomationPending" 14 "NonRecoverableFault" 15 "NotAvailable" ;
VAL_ 2621243117 AutomationStatus_AV09 13 "AutomationFault" 7 "ActiveLimitedLow" 6 "ActiveLimitedHigh" 5 "ActiveNotLimited" 0 "AutomationUnavailable" 1 "AutomationNotReady" 2 "AutomationReadyToEnable" 3 "AutomationEnabled" 4 "AutomationPending" 14 "NonRecoverableFault" 15 "NotAvailable" ;
VAL_ 2621243117 AutomationStatus_AV08 13 "AutomationFault" 7 "ActiveLimitedLow" 6 "ActiveLimitedHigh" 5 "ActiveNotLimited" 0 "AutomationUnavailable" 1 "AutomationNotReady" 2 "AutomationReadyToEnable" 3 "AutomationEnabled" 4 "AutomationPending" 14 "NonRecoverableFault" 15 "NotAvailable" ;
VAL_ 2621243117 AutomationStatus_AV07 13 "AutomationFault" 7 "ActiveLimitedLow" 6 "ActiveLimitedHigh" 5 "ActiveNotLimited" 0 "AutomationUnavailable" 1 "AutomationNotReady" 2 "AutomationReadyToEnable" 3 "AutomationEnabled" 4 "AutomationPending" 14 "NonRecoverableFault" 15 "NotAvailable" ;
VAL_ 2621243117 AutomationStatus_AV06 13 "AutomationFault" 7 "ActiveLimitedLow" 6 "ActiveLimitedHigh" 5 "ActiveNotLimited" 0 "AutomationUnavailable" 1 "AutomationNotReady" 2 "AutomationReadyToEnable" 3 "AutomationEnabled" 4 "AutomationPending" 14 "NonRecoverableFault" 15 "NotAvailable" ;
VAL_ 2621243117 AutomationStatus_AV05 13 "AutomationFault" 7 "ActiveLimitedLow" 6 "ActiveLimitedHigh" 5 "ActiveNotLimited" 0 "AutomationUnavailable" 1 "AutomationNotReady" 2 "AutomationReadyToEnable" 3 "AutomationEnabled" 4 "AutomationPending" 14 "NonRecoverableFault" 15 "NotAvailable" ;
VAL_ 2621243117 Curvature_EG 65535 "NotAvailable" 65534 "Error" 32128 "Straight" ;
VAL_ 2621243117 ExitReasonCode_EG 21 "HydraulicOilLevelTooLow" 20 "HydraulicOilTemperatureTooLow" 19 "VehicleTransmissionGearDoesntAllowRemoteCommands" 18 "VehicleSpeedTooLow" 17 "VehicleSpeedTooHigh" 16 "AlternateGuidanceSystemActive" 31 "NotAvailable" 30 "Error" 15 "ControlUnitInDiagnosticMode" 9 "FunctionFault" 8 "OperatorControlFault" 5 "RemoteCommandTimeout" 4 "OperatorControlNotInValidPosition" 3 "OperatorOverrideOfFunction" 2 "ImplementReleasedControlOfFunction" 7 "FunctionNotCalibrated" 6 "RemoteCommandOutOfRangeOrInvalid" 1 "RequiredLevelOfOperatorPresence_AwarenessNotDetected" 0 "NoReason_AllClear" ;
VAL_ 2621243117 VehicleSpeed_VS 65535 "NotAvailable" 65534 "Error" ;
VAL_ 2621243117 ExitReasonCode_VS 31 "NotAvailable" 30 "Error" 15 "VehicleTransmissionGearDoesntAllowRemoteCommands " 9 "FunctionFault" 8 "OperatorControlFault" 5 "RemoteCommandTimeout" 4 "OperatorControlNotInValidPosition" 3 "OperatorOverrideOfFunction" 2 "ImplementReleasedControlOfFunction" 7 "FunctionNotCalibrated" 6 "RemoteCommandOutOfRangeOrInvalid" 1 "RequiredLevelOfOperatorPresence_AwarenessNotDetected" 0 "NoReason_AllClear" ;
VAL_ 2621243117 Position_FH 65535 "NotAvailable" 65534 "Error" ;
VAL_ 2621243117 ExitReasonCode_FH 16 "HitchLockedOut" 31 "NotAvailable" 30 "Error" 15 "HydraulicOilLevelLow" 9 "FunctionFault" 8 "OperatorControlFault" 5 "RemoteCommandTimeout" 4 "OperatorControlNotInValidPosition" 3 "OperatorOverrideOfFunction" 2 "ImplementReleasedControlOfFunction" 7 "FunctionNotCalibrated" 6 "RemoteCommandOutOfRangeOrInvalid" 1 "RequiredLevelOfOperatorPresence_AwarenessNotDetected" 0 "NoReason_AllClear" ;
VAL_ 2621243117 Speed_FPTO 65535 "NotAvailable" 65534 "Error" ;
VAL_ 2621243117 ExitReasonCode_FPTO 31 "NotAvailable" 30 "Error" 15 "InvalidPtoGear" 9 "FunctionFault" 8 "OperatorControlFault" 5 "RemoteCommandTimeout" 4 "OperatorControlNotInValidPosition" 3 "OperatorOverrideOfFunction" 2 "ImplementReleasedControlOfFunction" 7 "FunctionNotCalibrated" 6 "RemoteCommandOutOfRange_Invalid" 1 "RequiredLevelOfOperatorPresence_AwarenessNotDetected" 0 "NoReason_AllClear" ;
VAL_ 2621243117 Flow_AV01 65535 "NotAvailable" 65534 "Error" 64257 "Float" 64256 "ValveFullyOpened_Retract" 32128 "NoFlow_Block" 0 "ValveFullyOpened_Extend" ;
VAL_ 2621243117 ExitReasonCode_AV01 31 "NotAvailable" 30 "Error" 16 "ValveLockedOut_TransportLock" 15 "HydraulicOilLevelLow" 9 "FunctionFault" 8 "OperatorControlFault" 5 "RemoteCommandTimeout" 4 "OperatorControlNotInValidPosition" 3 "OperatorOverrideOfFunction" 2 "ImplementReleasedControlOfFunction" 7 "FunctionNotCalibrated" 6 "RemoteCommandOutOfRange_Invalid" 1 "RequiredLevelOfOperatorPresence_AwarenessNotDetected" 0 "NoReason_AllClear" ;
VAL_ 2621243117 TIMFunctionID 72 "RearTopLinkage" 71 "FrontTopLinkage" 32 "TIM_AuxValve32" 70 "ExternalGuidance" 68 "VehicleSpeed" 67 "RearHitch" 66 "FrontHitch" 65 "RearPTO" 64 "FrontPTO" 31 "TIM_AuxValve31" 30 "TIM_AuxValve30" 29 "TIM_AuxValve29" 28 "TIM_AuxValve28" 27 "TIM_AuxValve27" 26 "TIM_AuxValve26" 25 "TIM_AuxValve25" 24 "TIM_AuxValve24" 23 "TIM_AuxValve23" 22 "TIM_AuxValve22" 21 "TIM_AuxValve21" 20 "TIM_AuxValve20" 19 "TIM_AuxValve19" 18 "TIM_AuxValve18" 17 "TIM_AuxValve17" 16 "TIM_AuxValve16" 15 "TIM_AuxValve15" 14 "TIM_AuxValve14" 13 "TIM_AuxValve13" 12 "TIM_AuxValve12" 11 "TIM_AuxValve11" 10 "TIM_AuxValve10" 9 "TIM_AuxValve9" 8 "TIM_AuxValve8" 7 "TIM_AuxValve7" 6 "TIM_AuxValve6" 5 "TIM_AuxValve5" 4 "TIM_AuxValve4" 3 "TIM_AuxValve3" 2 "TIM_AuxValve2" 1 "TIM_AuxValve1" ;
VAL_ 2619604717 GroupFunctionValue 32 "TIM_AuxValve32Status" 243 "FunctionsAssignmentStatusResponse" 250 "ServerStatus" 248 "ServerVersionResponse" 247 "ClientVersionRequest" 246 "ConnectionVersionResponse" 245 "FunctionsAssignmentResponse" 244 "FunctionsSupportResponse" 70 "ExternalGuidanceStatus" 68 "VehicleSpeedStatus" 67 "RearHitchStatus" 66 "FrontHitchStatus" 65 "RearPTOStatus" 64 "FrontPTOStatus" 31 "TIM_AuxValve31Status" 30 "TIM_AuxValve30Status" 29 "TIM_AuxValve29Status" 28 "TIM_AuxValve28Status" 27 "TIM_AuxValve27Status" 26 "TIM_AuxValve26Status" 25 "TIM_AuxValve25Status" 24 "TIM_AuxValve24Status" 23 "TIM_AuxValve23Status" 22 "TIM_AuxValve22Status" 21 "TIM_AuxValve21Status" 20 "TIM_AuxValve20Status" 19 "TIM_AuxValve19Status" 18 "TIM_AuxValve18Status" 17 "TIM_AuxValve17Status" 16 "TIM_AuxValve16Status" 15 "TIM_AuxValve15Status" 14 "TIM_AuxValve14Status" 13 "TIM_AuxValve13Status" 12 "TIM_AuxValve12Status" 11 "TIM_AuxValve11Status" 10 "TIM_AuxValve10Status" 9 "TIM_AuxValve9Status" 8 "TIM_AuxValve8Status" 7 "TIM_AuxValve7Status" 6 "TIM_AuxValve6Status" 5 "TIM_AuxValve5Status" 4 "TIM_AuxValve4Status" 3 "TIM_AuxValve3Status" 2 "TIM_AuxValve2Status" 1 "TIM_AuxValve1Status" ;
VAL_ 2619604717 RearHitchPosition 65535 "NotAvailable" 65534 "Error" 64259 "Raising" 64258 "Lowering" 64257 "Stop" 10000 "FullRaise" 0 "FullLower" 64256 "Float" ;
VAL_ 2619604717 RearPTOSpeed 65535 "NotAvailable" 65534 "Error" ;
VAL_ 2619604717 FlowAuxValve32 65535 "NotAvailable" 65534 "Error" 64257 "Float" 64256 "ValveFullyOpened_Retract" 32128 "NoFlow_Block" 0 "ValveFullyOpened_Extend" ;
VAL_ 2619604717 FlowAuxValve31 65535 "NotAvailable" 65534 "Error" 64257 "Float" 64256 "ValveFullyOpened_Retract" 32128 "NoFlow_Block" 0 "ValveFullyOpened_Extend" ;
VAL_ 2619604717 FlowAuxValve30 65535 "NotAvailable" 65534 "Error" 64257 "Float" 64256 "ValveFullyOpened_Retract" 32128 "NoFlow_Block" 0 "ValveFullyOpened_Extend" ;
VAL_ 2619604717 FlowAuxValve29 65535 "NotAvailable" 65534 "Error" 64257 "Float" 64256 "ValveFullyOpened_Retract" 32128 "NoFlow_Block" 0 "ValveFullyOpened_Extend" ;
VAL_ 2619604717 FlowAuxValve28 65535 "NotAvailable" 65534 "Error" 64257 "Float" 64256 "ValveFullyOpened_Retract" 32128 "NoFlow_Block" 0 "ValveFullyOpened_Extend" ;
VAL_ 2619604717 FlowAuxValve27 65535 "NotAvailable" 65534 "Error" 64257 "Float" 64256 "ValveFullyOpened_Retract" 32128 "NoFlow_Block" 0 "ValveFullyOpened_Extend" ;
VAL_ 2619604717 FlowAuxValve26 65535 "NotAvailable" 65534 "Error" 64257 "Float" 64256 "ValveFullyOpened_Retract" 32128 "NoFlow_Block" 0 "ValveFullyOpened_Extend" ;
VAL_ 2619604717 FlowAuxValve25 65535 "NotAvailable" 65534 "Error" 64257 "Float" 64256 "ValveFullyOpened_Retract" 32128 "NoFlow_Block" 0 "ValveFullyOpened_Extend" ;
VAL_ 2619604717 FlowAuxValve24 65535 "NotAvailable" 65534 "Error" 64257 "Float" 64256 "ValveFullyOpened_Retract" 32128 "NoFlow_Block" 0 "ValveFullyOpened_Extend" ;
VAL_ 2619604717 FlowAuxValve23 65535 "NotAvailable" 65534 "Error" 64257 "Float" 64256 "ValveFullyOpened_Retract" 32128 "NoFlow_Block" 0 "ValveFullyOpened_Extend" ;
VAL_ 2619604717 FlowAuxValve22 65535 "NotAvailable" 65534 "Error" 64257 "Float" 64256 "ValveFullyOpened_Retract" 32128 "NoFlow_Block" 0 "ValveFullyOpened_Extend" ;
VAL_ 2619604717 FlowAuxValve21 65535 "NotAvailable" 65534 "Error" 64257 "Float" 64256 "ValveFullyOpened_Retract" 32128 "NoFlow_Block" 0 "ValveFullyOpened_Extend" ;
VAL_ 2619604717 FlowAuxValve20 65535 "NotAvailable" 65534 "Error" 64257 "Float" 64256 "ValveFullyOpened_Retract" 32128 "NoFlow_Block" 0 "ValveFullyOpened_Extend" ;
VAL_ 2619604717 FlowAuxValve19 65535 "NotAvailable" 65534 "Error" 64257 "Float" 64256 "ValveFullyOpened_Retract" 32128 "NoFlow_Block" 0 "ValveFullyOpened_Extend" ;
VAL_ 2619604717 FlowAuxValve18 65535 "NotAvailable" 65534 "Error" 64257 "Float" 64256 "ValveFullyOpened_Retract" 32128 "NoFlow_Block" 0 "ValveFullyOpened_Extend" ;
VAL_ 2619604717 FlowAuxValve17 65535 "NotAvailable" 65534 "Error" 64257 "Float" 64256 "ValveFullyOpened_Retract" 32128 "NoFlow_Block" 0 "ValveFullyOpened_Extend" ;
VAL_ 2619604717 FlowAuxValve16 65535 "NotAvailable" 65534 "Error" 64257 "Float" 64256 "ValveFullyOpened_Retract" 32128 "NoFlow_Block" 0 "ValveFullyOpened_Extend" ;
VAL_ 2619604717 FlowAuxValve15 65535 "NotAvailable" 65534 "Error" 64257 "Float" 64256 "ValveFullyOpened_Retract" 32128 "NoFlow_Block" 0 "ValveFullyOpened_Extend" ;
VAL_ 2619604717 FlowAuxValve14 65535 "NotAvailable" 65534 "Error" 64257 "Float" 64256 "ValveFullyOpened_Retract" 32128 "NoFlow_Block" 0 "ValveFullyOpened_Extend" ;
VAL_ 2619604717 FlowAuxValve13 65535 "NotAvailable" 65534 "Error" 64257 "Float" 64256 "ValveFullyOpened_Retract" 32128 "NoFlow_Block" 0 "ValveFullyOpened_Extend" ;
VAL_ 2619604717 FlowAuxValve12 65535 "NotAvailable" 65534 "Error" 64257 "Float" 64256 "ValveFullyOpened_Retract" 32128 "NoFlow_Block" 0 "ValveFullyOpened_Extend" ;
VAL_ 2619604717 FlowAuxValve11 65535 "NotAvailable" 65534 "Error" 64257 "Float" 64256 "ValveFullyOpened_Retract" 32128 "NoFlow_Block" 0 "ValveFullyOpened_Extend" ;
VAL_ 2619604717 FlowAuxValve10 65535 "NotAvailable" 65534 "Error" 64257 "Float" 64256 "ValveFullyOpened_Retract" 32128 "NoFlow_Block" 0 "ValveFullyOpened_Extend" ;
VAL_ 2619604717 FlowAuxValve09 65535 "NotAvailable" 65534 "Error" 64257 "Float" 64256 "ValveFullyOpened_Retract" 32128 "NoFlow_Block" 0 "ValveFullyOpened_Extend" ;
VAL_ 2619604717 FlowAuxValve08 65535 "NotAvailable" 65534 "Error" 64257 "Float" 64256 "ValveFullyOpened_Retract" 32128 "NoFlow_Block" 0 "ValveFullyOpened_Extend" ;
VAL_ 2619604717 FlowAuxValve07 65535 "NotAvailable" 65534 "Error" 64257 "Float" 64256 "ValveFullyOpened_Retract" 32128 "NoFlow_Block" 0 "ValveFullyOpened_Extend" ;
VAL_ 2619604717 FlowAuxValve06 65535 "NotAvailable" 65534 "Error" 64257 "Float" 64256 "ValveFullyOpened_Retract" 32128 "NoFlow_Block" 0 "ValveFullyOpened_Extend" ;
VAL_ 2619604717 FlowAuxValve05 65535 "NotAvailable" 65534 "Error" 64257 "Float" 64256 "ValveFullyOpened_Retract" 32128 "NoFlow_Block" 0 "ValveFullyOpened_Extend" ;
VAL_ 2619604717 FlowAuxValve04 65535 "NotAvailable" 65534 "Error" 64257 "Float" 64256 "ValveFullyOpened_Retract" 32128 "NoFlow_Block" 0 "ValveFullyOpened_Extend" ;
VAL_ 2619604717 FlowAuxValve03 65535 "NotAvailable" 65534 "Error" 64257 "Float" 64256 "ValveFullyOpened_Retract" 32128 "NoFlow_Block" 0 "ValveFullyOpened_Extend" ;
VAL_ 2619604717 FlowAuxValve02 65535 "NotAvailable" 65534 "Error" 64257 "Float" 64256 "ValveFullyOpened_Retract" 32128 "NoFlow_Block" 0 "ValveFullyOpened_Extend" ;
VAL_ 2619604717 FlowTypeAuxValve32 3 "NotAvailable" 2 "Error" 1 "Measured" 0 "Estimated" ;
VAL_ 2619604717 FlowTypeAuxValve31 3 "NotAvailable" 2 "Error" 1 "Measured" 0 "Estimated" ;
VAL_ 2619604717 FlowTypeAuxValve30 3 "NotAvailable" 2 "Error" 1 "Measured" 0 "Estimated" ;
VAL_ 2619604717 FlowTypeAuxValve29 3 "NotAvailable" 2 "Error" 1 "Measured" 0 "Estimated" ;
VAL_ 2619604717 FlowTypeAuxValve28 3 "NotAvailable" 2 "Error" 1 "Measured" 0 "Estimated" ;
VAL_ 2619604717 FlowTypeAuxValve27 3 "NotAvailable" 2 "Error" 1 "Measured" 0 "Estimated" ;
VAL_ 2619604717 FlowTypeAuxValve26 3 "NotAvailable" 2 "Error" 1 "Measured" 0 "Estimated" ;
VAL_ 2619604717 FlowTypeAuxValve25 3 "NotAvailable" 2 "Error" 1 "Measured" 0 "Estimated" ;
VAL_ 2619604717 FlowTypeAuxValve24 3 "NotAvailable" 2 "Error" 1 "Measured" 0 "Estimated" ;
VAL_ 2619604717 FlowTypeAuxValve23 3 "NotAvailable" 2 "Error" 1 "Measured" 0 "Estimated" ;
VAL_ 2619604717 FlowTypeAuxValve22 3 "NotAvailable" 2 "Error" 1 "Measured" 0 "Estimated" ;
VAL_ 2619604717 FlowTypeAuxValve21 3 "NotAvailable" 2 "Error" 1 "Measured" 0 "Estimated" ;
VAL_ 2619604717 FlowTypeAuxValve20 3 "NotAvailable" 2 "Error" 1 "Measured" 0 "Estimated" ;
VAL_ 2619604717 FlowTypeAuxValve19 3 "NotAvailable" 2 "Error" 1 "Measured" 0 "Estimated" ;
VAL_ 2619604717 FlowTypeAuxValve18 3 "NotAvailable" 2 "Error" 1 "Measured" 0 "Estimated" ;
VAL_ 2619604717 FlowTypeAuxValve17 3 "NotAvailable" 2 "Error" 1 "Measured" 0 "Estimated" ;
VAL_ 2619604717 FlowTypeAuxValve16 3 "NotAvailable" 2 "Error" 1 "Measured" 0 "Estimated" ;
VAL_ 2619604717 FlowTypeAuxValve15 3 "NotAvailable" 2 "Error" 1 "Measured" 0 "Estimated" ;
VAL_ 2619604717 FlowTypeAuxValve14 3 "NotAvailable" 2 "Error" 1 "Measured" 0 "Estimated" ;
VAL_ 2619604717 FlowTypeAuxValve13 3 "NotAvailable" 2 "Error" 1 "Measured" 0 "Estimated" ;
VAL_ 2619604717 FlowTypeAuxValve12 3 "NotAvailable" 2 "Error" 1 "Measured" 0 "Estimated" ;
VAL_ 2619604717 FlowTypeAuxValve11 3 "NotAvailable" 2 "Error" 1 "Measured" 0 "Estimated" ;
VAL_ 2619604717 FlowTypeAuxValve10 3 "NotAvailable" 2 "Error" 1 "Measured" 0 "Estimated" ;
VAL_ 2619604717 FlowTypeAuxValve09 3 "NotAvailable" 2 "Error" 1 "Measured" 0 "Estimated" ;
VAL_ 2619604717 FlowTypeAuxValve08 3 "NotAvailable" 2 "Error" 1 "Measured" 0 "Estimated" ;
VAL_ 2619604717 FlowTypeAuxValve07 3 "NotAvailable" 2 "Error" 1 "Measured" 0 "Estimated" ;
VAL_ 2619604717 FlowTypeAuxValve06 3 "NotAvailable" 2 "Error" 1 "Measured" 0 "Estimated" ;
VAL_ 2619604717 FlowTypeAuxValve05 3 "NotAvailable" 2 "Error" 1 "Measured" 0 "Estimated" ;
VAL_ 2619604717 FlowTypeAuxValve04 3 "NotAvailable" 2 "Error" 1 "Measured" 0 "Estimated" ;
VAL_ 2619604717 FlowTypeAuxValve03 3 "NotAvailable" 2 "Error" 1 "Measured" 0 "Estimated" ;
VAL_ 2619604717 FlowTypeAuxValve02 3 "NotAvailable" 2 "Error" 1 "Measured" 0 "Estimated" ;
VAL_ 2619604717 FlowTypeAuxValve01 3 "NotAvailable" 2 "Error" 1 "Measured" 0 "Estimated" ;
VAL_ 2619604717 ExitReasonCodeRearPTO 31 "NotAvailable" 30 "Error" 15 "InvalidPtoGear" 9 "FunctionFault" 8 "OperatorControlFault" 5 "RemoteCommandTimeout" 4 "OperatorControlNotInValidPosition" 3 "OperatorOverrideOfFunction" 2 "ImplementReleasedControlOfFunction" 7 "FunctionNotCalibrated" 6 "RemoteCommandOutOfRange_Invalid" 1 "RequiredLevelOfOperatorPresence_AwarenessNotDetected" 0 "NoReason_AllClear" ;
VAL_ 2619604717 ExitReasonCodeRearHitch 16 "HitchLockedOut" 31 "NotAvailable" 30 "Error" 15 "HydraulicOilLevelLow" 9 "FunctionFault" 8 "OperatorControlFault" 5 "RemoteCommandTimeout" 4 "OperatorControlNotInValidPosition" 3 "OperatorOverrideOfFunction" 2 "ImplementReleasedControlOfFunction" 7 "FunctionNotCalibrated" 6 "RemoteCommandOutOfRangeOrInvalid" 1 "RequiredLevelOfOperatorPresence_AwarenessNotDetected" 0 "NoReason_AllClear" ;
VAL_ 2619604717 ExitReasonCodeAuxValve32 31 "NotAvailable" 30 "Error" 16 "ValveLockedOut_TransportLock" 15 "HydraulicOilLevelLow" 9 "FunctionFault" 8 "OperatorControlFault" 5 "RemoteCommandTimeout" 4 "OperatorControlNotInValidPosition" 3 "OperatorOverrideOfFunction" 2 "ImplementReleasedControlOfFunction" 7 "FunctionNotCalibrated" 6 "RemoteCommandOutOfRange_Invalid" 1 "RequiredLevelOfOperatorPresence_AwarenessNotDetected" 0 "NoReason_AllClear" ;
VAL_ 2619604717 ExitReasonCodeAuxValve31 31 "NotAvailable" 30 "Error" 16 "ValveLockedOut_TransportLock" 15 "HydraulicOilLevelLow" 9 "FunctionFault" 8 "OperatorControlFault" 5 "RemoteCommandTimeout" 4 "OperatorControlNotInValidPosition" 3 "OperatorOverrideOfFunction" 2 "ImplementReleasedControlOfFunction" 7 "FunctionNotCalibrated" 6 "RemoteCommandOutOfRange_Invalid" 1 "RequiredLevelOfOperatorPresence_AwarenessNotDetected" 0 "NoReason_AllClear" ;
VAL_ 2619604717 ExitReasonCodeAuxValve30 31 "NotAvailable" 30 "Error" 16 "ValveLockedOut_TransportLock" 15 "HydraulicOilLevelLow" 9 "FunctionFault" 8 "OperatorControlFault" 5 "RemoteCommandTimeout" 4 "OperatorControlNotInValidPosition" 3 "OperatorOverrideOfFunction" 2 "ImplementReleasedControlOfFunction" 7 "FunctionNotCalibrated" 6 "RemoteCommandOutOfRange_Invalid" 1 "RequiredLevelOfOperatorPresence_AwarenessNotDetected" 0 "NoReason_AllClear" ;
VAL_ 2619604717 ExitReasonCodeAuxValve29 31 "NotAvailable" 30 "Error" 16 "ValveLockedOut_TransportLock" 15 "HydraulicOilLevelLow" 9 "FunctionFault" 8 "OperatorControlFault" 5 "RemoteCommandTimeout" 4 "OperatorControlNotInValidPosition" 3 "OperatorOverrideOfFunction" 2 "ImplementReleasedControlOfFunction" 7 "FunctionNotCalibrated" 6 "RemoteCommandOutOfRange_Invalid" 1 "RequiredLevelOfOperatorPresence_AwarenessNotDetected" 0 "NoReason_AllClear" ;
VAL_ 2619604717 ExitReasonCodeAuxValve28 31 "NotAvailable" 30 "Error" 16 "ValveLockedOut_TransportLock" 15 "HydraulicOilLevelLow" 9 "FunctionFault" 8 "OperatorControlFault" 5 "RemoteCommandTimeout" 4 "OperatorControlNotInValidPosition" 3 "OperatorOverrideOfFunction" 2 "ImplementReleasedControlOfFunction" 7 "FunctionNotCalibrated" 6 "RemoteCommandOutOfRange_Invalid" 1 "RequiredLevelOfOperatorPresence_AwarenessNotDetected" 0 "NoReason_AllClear" ;
VAL_ 2619604717 ExitReasonCodeAuxValve27 31 "NotAvailable" 30 "Error" 16 "ValveLockedOut_TransportLock" 15 "HydraulicOilLevelLow" 9 "FunctionFault" 8 "OperatorControlFault" 5 "RemoteCommandTimeout" 4 "OperatorControlNotInValidPosition" 3 "OperatorOverrideOfFunction" 2 "ImplementReleasedControlOfFunction" 7 "FunctionNotCalibrated" 6 "RemoteCommandOutOfRange_Invalid" 1 "RequiredLevelOfOperatorPresence_AwarenessNotDetected" 0 "NoReason_AllClear" ;
VAL_ 2619604717 ExitReasonCodeAuxValve26 31 "NotAvailable" 30 "Error" 16 "ValveLockedOut_TransportLock" 15 "HydraulicOilLevelLow" 9 "FunctionFault" 8 "OperatorControlFault" 5 "RemoteCommandTimeout" 4 "OperatorControlNotInValidPosition" 3 "OperatorOverrideOfFunction" 2 "ImplementReleasedControlOfFunction" 7 "FunctionNotCalibrated" 6 "RemoteCommandOutOfRange_Invalid" 1 "RequiredLevelOfOperatorPresence_AwarenessNotDetected" 0 "NoReason_AllClear" ;
VAL_ 2619604717 ExitReasonCodeAuxValve25 31 "NotAvailable" 30 "Error" 16 "ValveLockedOut_TransportLock" 15 "HydraulicOilLevelLow" 9 "FunctionFault" 8 "OperatorControlFault" 5 "RemoteCommandTimeout" 4 "OperatorControlNotInValidPosition" 3 "OperatorOverrideOfFunction" 2 "ImplementReleasedControlOfFunction" 7 "FunctionNotCalibrated" 6 "RemoteCommandOutOfRange_Invalid" 1 "RequiredLevelOfOperatorPresence_AwarenessNotDetected" 0 "NoReason_AllClear" ;
VAL_ 2619604717 ExitReasonCodeAuxValve24 31 "NotAvailable" 30 "Error" 16 "ValveLockedOut_TransportLock" 15 "HydraulicOilLevelLow" 9 "FunctionFault" 8 "OperatorControlFault" 5 "RemoteCommandTimeout" 4 "OperatorControlNotInValidPosition" 3 "OperatorOverrideOfFunction" 2 "ImplementReleasedControlOfFunction" 7 "FunctionNotCalibrated" 6 "RemoteCommandOutOfRange_Invalid" 1 "RequiredLevelOfOperatorPresence_AwarenessNotDetected" 0 "NoReason_AllClear" ;
VAL_ 2619604717 ExitReasonCodeAuxValve23 31 "NotAvailable" 30 "Error" 16 "ValveLockedOut_TransportLock" 15 "HydraulicOilLevelLow" 9 "FunctionFault" 8 "OperatorControlFault" 5 "RemoteCommandTimeout" 4 "OperatorControlNotInValidPosition" 3 "OperatorOverrideOfFunction" 2 "ImplementReleasedControlOfFunction" 7 "FunctionNotCalibrated" 6 "RemoteCommandOutOfRange_Invalid" 1 "RequiredLevelOfOperatorPresence_AwarenessNotDetected" 0 "NoReason_AllClear" ;
VAL_ 2619604717 ExitReasonCodeAuxValve22 31 "NotAvailable" 30 "Error" 16 "ValveLockedOut_TransportLock" 15 "HydraulicOilLevelLow" 9 "FunctionFault" 8 "OperatorControlFault" 5 "RemoteCommandTimeout" 4 "OperatorControlNotInValidPosition" 3 "OperatorOverrideOfFunction" 2 "ImplementReleasedControlOfFunction" 7 "FunctionNotCalibrated" 6 "RemoteCommandOutOfRange_Invalid" 1 "RequiredLevelOfOperatorPresence_AwarenessNotDetected" 0 "NoReason_AllClear" ;
VAL_ 2619604717 ExitReasonCodeAuxValve21 31 "NotAvailable" 30 "Error" 16 "ValveLockedOut_TransportLock" 15 "HydraulicOilLevelLow" 9 "FunctionFault" 8 "OperatorControlFault" 5 "RemoteCommandTimeout" 4 "OperatorControlNotInValidPosition" 3 "OperatorOverrideOfFunction" 2 "ImplementReleasedControlOfFunction" 7 "FunctionNotCalibrated" 6 "RemoteCommandOutOfRange_Invalid" 1 "RequiredLevelOfOperatorPresence_AwarenessNotDetected" 0 "NoReason_AllClear" ;
VAL_ 2619604717 ExitReasonCodeAuxValve20 31 "NotAvailable" 30 "Error" 16 "ValveLockedOut_TransportLock" 15 "HydraulicOilLevelLow" 9 "FunctionFault" 8 "OperatorControlFault" 5 "RemoteCommandTimeout" 4 "OperatorControlNotInValidPosition" 3 "OperatorOverrideOfFunction" 2 "ImplementReleasedControlOfFunction" 7 "FunctionNotCalibrated" 6 "RemoteCommandOutOfRange_Invalid" 1 "RequiredLevelOfOperatorPresence_AwarenessNotDetected" 0 "NoReason_AllClear" ;
VAL_ 2619604717 ExitReasonCodeAuxValve19 31 "NotAvailable" 30 "Error" 16 "ValveLockedOut_TransportLock" 15 "HydraulicOilLevelLow" 9 "FunctionFault" 8 "OperatorControlFault" 5 "RemoteCommandTimeout" 4 "OperatorControlNotInValidPosition" 3 "OperatorOverrideOfFunction" 2 "ImplementReleasedControlOfFunction" 7 "FunctionNotCalibrated" 6 "RemoteCommandOutOfRange_Invalid" 1 "RequiredLevelOfOperatorPresence_AwarenessNotDetected" 0 "NoReason_AllClear" ;
VAL_ 2619604717 ExitReasonCodeAuxValve18 31 "NotAvailable" 30 "Error" 16 "ValveLockedOut_TransportLock" 15 "HydraulicOilLevelLow" 9 "FunctionFault" 8 "OperatorControlFault" 5 "RemoteCommandTimeout" 4 "OperatorControlNotInValidPosition" 3 "OperatorOverrideOfFunction" 2 "ImplementReleasedControlOfFunction" 7 "FunctionNotCalibrated" 6 "RemoteCommandOutOfRange_Invalid" 1 "RequiredLevelOfOperatorPresence_AwarenessNotDetected" 0 "NoReason_AllClear" ;
VAL_ 2619604717 ExitReasonCodeAuxValve17 31 "NotAvailable" 30 "Error" 16 "ValveLockedOut_TransportLock" 15 "HydraulicOilLevelLow" 9 "FunctionFault" 8 "OperatorControlFault" 5 "RemoteCommandTimeout" 4 "OperatorControlNotInValidPosition" 3 "OperatorOverrideOfFunction" 2 "ImplementReleasedControlOfFunction" 7 "FunctionNotCalibrated" 6 "RemoteCommandOutOfRange_Invalid" 1 "RequiredLevelOfOperatorPresence_AwarenessNotDetected" 0 "NoReason_AllClear" ;
VAL_ 2619604717 ExitReasonCodeAuxValve16 31 "NotAvailable" 30 "Error" 16 "ValveLockedOut_TransportLock" 15 "HydraulicOilLevelLow" 9 "FunctionFault" 8 "OperatorControlFault" 5 "RemoteCommandTimeout" 4 "OperatorControlNotInValidPosition" 3 "OperatorOverrideOfFunction" 2 "ImplementReleasedControlOfFunction" 7 "FunctionNotCalibrated" 6 "RemoteCommandOutOfRange_Invalid" 1 "RequiredLevelOfOperatorPresence_AwarenessNotDetected" 0 "NoReason_AllClear" ;
VAL_ 2619604717 ExitReasonCodeAuxValve15 31 "NotAvailable" 30 "Error" 16 "ValveLockedOut_TransportLock" 15 "HydraulicOilLevelLow" 9 "FunctionFault" 8 "OperatorControlFault" 5 "RemoteCommandTimeout" 4 "OperatorControlNotInValidPosition" 3 "OperatorOverrideOfFunction" 2 "ImplementReleasedControlOfFunction" 7 "FunctionNotCalibrated" 6 "RemoteCommandOutOfRange_Invalid" 1 "RequiredLevelOfOperatorPresence_AwarenessNotDetected" 0 "NoReason_AllClear" ;
VAL_ 2619604717 ExitReasonCodeAuxValve14 31 "NotAvailable" 30 "Error" 16 "ValveLockedOut_TransportLock" 15 "HydraulicOilLevelLow" 9 "FunctionFault" 8 "OperatorControlFault" 5 "RemoteCommandTimeout" 4 "OperatorControlNotInValidPosition" 3 "OperatorOverrideOfFunction" 2 "ImplementReleasedControlOfFunction" 7 "FunctionNotCalibrated" 6 "RemoteCommandOutOfRange_Invalid" 1 "RequiredLevelOfOperatorPresence_AwarenessNotDetected" 0 "NoReason_AllClear" ;
VAL_ 2619604717 ExitReasonCodeAuxValve13 31 "NotAvailable" 30 "Error" 16 "ValveLockedOut_TransportLock" 15 "HydraulicOilLevelLow" 9 "FunctionFault" 8 "OperatorControlFault" 5 "RemoteCommandTimeout" 4 "OperatorControlNotInValidPosition" 3 "OperatorOverrideOfFunction" 2 "ImplementReleasedControlOfFunction" 7 "FunctionNotCalibrated" 6 "RemoteCommandOutOfRange_Invalid" 1 "RequiredLevelOfOperatorPresence_AwarenessNotDetected" 0 "NoReason_AllClear" ;
VAL_ 2619604717 ExitReasonCodeAuxValve12 31 "NotAvailable" 30 "Error" 16 "ValveLockedOut_TransportLock" 15 "HydraulicOilLevelLow" 9 "FunctionFault" 8 "OperatorControlFault" 5 "RemoteCommandTimeout" 4 "OperatorControlNotInValidPosition" 3 "OperatorOverrideOfFunction" 2 "ImplementReleasedControlOfFunction" 7 "FunctionNotCalibrated" 6 "RemoteCommandOutOfRange_Invalid" 1 "RequiredLevelOfOperatorPresence_AwarenessNotDetected" 0 "NoReason_AllClear" ;
VAL_ 2619604717 ExitReasonCodeAuxValve11 31 "NotAvailable" 30 "Error" 16 "ValveLockedOut_TransportLock" 15 "HydraulicOilLevelLow" 9 "FunctionFault" 8 "OperatorControlFault" 5 "RemoteCommandTimeout" 4 "OperatorControlNotInValidPosition" 3 "OperatorOverrideOfFunction" 2 "ImplementReleasedControlOfFunction" 7 "FunctionNotCalibrated" 6 "RemoteCommandOutOfRange_Invalid" 1 "RequiredLevelOfOperatorPresence_AwarenessNotDetected" 0 "NoReason_AllClear" ;
VAL_ 2619604717 ExitReasonCodeAuxValve10 31 "NotAvailable" 30 "Error" 16 "ValveLockedOut_TransportLock" 15 "HydraulicOilLevelLow" 9 "FunctionFault" 8 "OperatorControlFault" 5 "RemoteCommandTimeout" 4 "OperatorControlNotInValidPosition" 3 "OperatorOverrideOfFunction" 2 "ImplementReleasedControlOfFunction" 7 "FunctionNotCalibrated" 6 "RemoteCommandOutOfRange_Invalid" 1 "RequiredLevelOfOperatorPresence_AwarenessNotDetected" 0 "NoReason_AllClear" ;
VAL_ 2619604717 ExitReasonCodeAuxValve09 31 "NotAvailable" 30 "Error" 16 "ValveLockedOut_TransportLock" 15 "HydraulicOilLevelLow" 9 "FunctionFault" 8 "OperatorControlFault" 5 "RemoteCommandTimeout" 4 "OperatorControlNotInValidPosition" 3 "OperatorOverrideOfFunction" 2 "ImplementReleasedControlOfFunction" 7 "FunctionNotCalibrated" 6 "RemoteCommandOutOfRange_Invalid" 1 "RequiredLevelOfOperatorPresence_AwarenessNotDetected" 0 "NoReason_AllClear" ;
VAL_ 2619604717 ExitReasonCodeAuxValve08 31 "NotAvailable" 30 "Error" 16 "ValveLockedOut_TransportLock" 15 "HydraulicOilLevelLow" 9 "FunctionFault" 8 "OperatorControlFault" 5 "RemoteCommandTimeout" 4 "OperatorControlNotInValidPosition" 3 "OperatorOverrideOfFunction" 2 "ImplementReleasedControlOfFunction" 7 "FunctionNotCalibrated" 6 "RemoteCommandOutOfRange_Invalid" 1 "RequiredLevelOfOperatorPresence_AwarenessNotDetected" 0 "NoReason_AllClear" ;
VAL_ 2619604717 ExitReasonCodeAuxValve07 31 "NotAvailable" 30 "Error" 16 "ValveLockedOut_TransportLock" 15 "HydraulicOilLevelLow" 9 "FunctionFault" 8 "OperatorControlFault" 5 "RemoteCommandTimeout" 4 "OperatorControlNotInValidPosition" 3 "OperatorOverrideOfFunction" 2 "ImplementReleasedControlOfFunction" 7 "FunctionNotCalibrated" 6 "RemoteCommandOutOfRange_Invalid" 1 "RequiredLevelOfOperatorPresence_AwarenessNotDetected" 0 "NoReason_AllClear" ;
VAL_ 2619604717 ExitReasonCodeAuxValve06 31 "NotAvailable" 30 "Error" 16 "ValveLockedOut_TransportLock" 15 "HydraulicOilLevelLow" 9 "FunctionFault" 8 "OperatorControlFault" 5 "RemoteCommandTimeout" 4 "OperatorControlNotInValidPosition" 3 "OperatorOverrideOfFunction" 2 "ImplementReleasedControlOfFunction" 7 "FunctionNotCalibrated" 6 "RemoteCommandOutOfRange_Invalid" 1 "RequiredLevelOfOperatorPresence_AwarenessNotDetected" 0 "NoReason_AllClear" ;
VAL_ 2619604717 ExitReasonCodeAuxValve05 31 "NotAvailable" 30 "Error" 16 "ValveLockedOut_TransportLock" 15 "HydraulicOilLevelLow" 9 "FunctionFault" 8 "OperatorControlFault" 5 "RemoteCommandTimeout" 4 "OperatorControlNotInValidPosition" 3 "OperatorOverrideOfFunction" 2 "ImplementReleasedControlOfFunction" 7 "FunctionNotCalibrated" 6 "RemoteCommandOutOfRange_Invalid" 1 "RequiredLevelOfOperatorPresence_AwarenessNotDetected" 0 "NoReason_AllClear" ;
VAL_ 2619604717 ExitReasonCodeAuxValve04 31 "NotAvailable" 30 "Error" 16 "ValveLockedOut_TransportLock" 15 "HydraulicOilLevelLow" 9 "FunctionFault" 8 "OperatorControlFault" 5 "RemoteCommandTimeout" 4 "OperatorControlNotInValidPosition" 3 "OperatorOverrideOfFunction" 2 "ImplementReleasedControlOfFunction" 7 "FunctionNotCalibrated" 6 "RemoteCommandOutOfRange_Invalid" 1 "RequiredLevelOfOperatorPresence_AwarenessNotDetected" 0 "NoReason_AllClear" ;
VAL_ 2619604717 ExitReasonCodeAuxValve03 31 "NotAvailable" 30 "Error" 16 "ValveLockedOut_TransportLock" 15 "HydraulicOilLevelLow" 9 "FunctionFault" 8 "OperatorControlFault" 5 "RemoteCommandTimeout" 4 "OperatorControlNotInValidPosition" 3 "OperatorOverrideOfFunction" 2 "ImplementReleasedControlOfFunction" 7 "FunctionNotCalibrated" 6 "RemoteCommandOutOfRange_Invalid" 1 "RequiredLevelOfOperatorPresence_AwarenessNotDetected" 0 "NoReason_AllClear" ;
VAL_ 2619604717 ExitReasonCodeAuxValve02 31 "NotAvailable" 30 "Error" 16 "ValveLockedOut_TransportLock" 15 "HydraulicOilLevelLow" 9 "FunctionFault" 8 "OperatorControlFault" 5 "RemoteCommandTimeout" 4 "OperatorControlNotInValidPosition" 3 "OperatorOverrideOfFunction" 2 "ImplementReleasedControlOfFunction" 7 "FunctionNotCalibrated" 6 "RemoteCommandOutOfRange_Invalid" 1 "RequiredLevelOfOperatorPresence_AwarenessNotDetected" 0 "NoReason_AllClear" ;
VAL_ 2619604717 AutomationStatusAuxValve04 13 "AutomationFault" 7 "ActiveLimitedLow" 6 "ActiveLimitedHigh" 5 "ActiveNotLimited" 0 "AutomationUnavailable" 1 "AutomationNotReady" 2 "AutomationReadyToEnable" 3 "AutomationEnabled" 4 "AutomationPending" 14 "NonRecoverableFault" 15 "NotAvailable" ;
VAL_ 2619604717 AutomationStatusAuxValve03 13 "AutomationFault" 7 "ActiveLimitedLow" 6 "ActiveLimitedHigh" 5 "ActiveNotLimited" 0 "AutomationUnavailable" 1 "AutomationNotReady" 2 "AutomationReadyToEnable" 3 "AutomationEnabled" 4 "AutomationPending" 14 "NonRecoverableFault" 15 "NotAvailable" ;
VAL_ 2619604717 AutomationStatusAuxValve02 13 "AutomationFault" 7 "ActiveLimitedLow" 6 "ActiveLimitedHigh" 5 "ActiveNotLimited" 0 "AutomationUnavailable" 1 "AutomationNotReady" 2 "AutomationReadyToEnable" 3 "AutomationEnabled" 4 "AutomationPending" 14 "NonRecoverableFault" 15 "NotAvailable" ;
VAL_ 2619604717 AutomationStatusAuxValve01 13 "AutomationFault" 7 "ActiveLimitedLow" 6 "ActiveLimitedHigh" 5 "ActiveNotLimited" 0 "AutomationUnavailable" 1 "AutomationNotReady" 2 "AutomationReadyToEnable" 3 "AutomationEnabled" 4 "AutomationPending" 14 "NonRecoverableFault" 15 "NotAvailable" ;
VAL_ 2619604717 AutomationStatusExternalGuidance 13 "AutomationFault" 7 "ActiveLimitedLow" 6 "ActiveLimitedHigh" 5 "ActiveNotLimited" 0 "AutomationUnavailable" 1 "AutomationNotReady" 2 "AutomationReadyToEnable" 3 "AutomationEnabled" 4 "AutomationPending" 14 "NonRecoverableFault" 15 "NotAvailable" ;
VAL_ 2619604717 AutomationStatusVehicleSpeed 13 "AutomationFault" 7 "ActiveLimitedLow" 6 "ActiveLimitedHigh" 5 "ActiveNotLimited" 0 "AutomationUnavailable" 1 "AutomationNotReady" 2 "AutomationReadyToEnable" 3 "AutomationEnabled" 4 "AutomationPending" 14 "NonRecoverableFault" 15 "NotAvailable" ;
VAL_ 2619604717 AutomationStatusRearHitch 13 "AutomationFault" 7 "ActiveLimitedLow" 6 "ActiveLimitedHigh" 5 "ActiveNotLimited" 0 "AutomationUnavailable" 1 "AutomationNotReady" 2 "AutomationReadyToEnable" 3 "AutomationEnabled" 4 "AutomationPending" 14 "NonRecoverableFault" 15 "NotAvailable" ;
VAL_ 2619604717 AutomationStatusFrontHitch 13 "AutomationFault" 7 "ActiveLimitedLow" 6 "ActiveLimitedHigh" 5 "ActiveNotLimited" 0 "AutomationUnavailable" 1 "AutomationNotReady" 2 "AutomationReadyToEnable" 3 "AutomationEnabled" 4 "AutomationPending" 14 "NonRecoverableFault" 15 "NotAvailable" ;
VAL_ 2619604717 AutomationStatusRearPTO 13 "AutomationFault" 7 "ActiveLimitedLow" 6 "ActiveLimitedHigh" 5 "ActiveNotLimited" 0 "AutomationUnavailable" 1 "AutomationNotReady" 2 "AutomationReadyToEnable" 3 "AutomationEnabled" 4 "AutomationPending" 14 "NonRecoverableFault" 15 "NotAvailable" ;
VAL_ 2619604717 AutomationStatusFrontPTO 13 "AutomationFault" 7 "ActiveLimitedLow" 6 "ActiveLimitedHigh" 5 "ActiveNotLimited" 0 "AutomationUnavailable" 1 "AutomationNotReady" 2 "AutomationReadyToEnable" 3 "AutomationEnabled" 4 "AutomationPending" 14 "NonRecoverableFault" 15 "NotAvailable" ;
VAL_ 2619604717 AutomationStatusAuxValve32 13 "AutomationFault" 7 "ActiveLimitedLow" 6 "ActiveLimitedHigh" 5 "ActiveNotLimited" 0 "AutomationUnavailable" 1 "AutomationNotReady" 2 "AutomationReadyToEnable" 3 "AutomationEnabled" 4 "AutomationPending" 14 "NonRecoverableFault" 15 "NotAvailable" ;
VAL_ 2619604717 AutomationStatusAuxValve31 13 "AutomationFault" 7 "ActiveLimitedLow" 6 "ActiveLimitedHigh" 5 "ActiveNotLimited" 0 "AutomationUnavailable" 1 "AutomationNotReady" 2 "AutomationReadyToEnable" 3 "AutomationEnabled" 4 "AutomationPending" 14 "NonRecoverableFault" 15 "NotAvailable" ;
VAL_ 2619604717 AutomationStatusAuxValve30 13 "AutomationFault" 7 "ActiveLimitedLow" 6 "ActiveLimitedHigh" 5 "ActiveNotLimited" 0 "AutomationUnavailable" 1 "AutomationNotReady" 2 "AutomationReadyToEnable" 3 "AutomationEnabled" 4 "AutomationPending" 14 "NonRecoverableFault" 15 "NotAvailable" ;
VAL_ 2619604717 AutomationStatusAuxValve29 13 "AutomationFault" 7 "ActiveLimitedLow" 6 "ActiveLimitedHigh" 5 "ActiveNotLimited" 0 "AutomationUnavailable" 1 "AutomationNotReady" 2 "AutomationReadyToEnable" 3 "AutomationEnabled" 4 "AutomationPending" 14 "NonRecoverableFault" 15 "NotAvailable" ;
VAL_ 2619604717 AutomationStatusAuxValve28 13 "AutomationFault" 7 "ActiveLimitedLow" 6 "ActiveLimitedHigh" 5 "ActiveNotLimited" 0 "AutomationUnavailable" 1 "AutomationNotReady" 2 "AutomationReadyToEnable" 3 "AutomationEnabled" 4 "AutomationPending" 14 "NonRecoverableFault" 15 "NotAvailable" ;
VAL_ 2619604717 AutomationStatusAuxValve27 13 "AutomationFault" 7 "ActiveLimitedLow" 6 "ActiveLimitedHigh" 5 "ActiveNotLimited" 0 "AutomationUnavailable" 1 "AutomationNotReady" 2 "AutomationReadyToEnable" 3 "AutomationEnabled" 4 "AutomationPending" 14 "NonRecoverableFault" 15 "NotAvailable" ;
VAL_ 2619604717 AutomationStatusAuxValve26 13 "AutomationFault" 7 "ActiveLimitedLow" 6 "ActiveLimitedHigh" 5 "ActiveNotLimited" 0 "AutomationUnavailable" 1 "AutomationNotReady" 2 "AutomationReadyToEnable" 3 "AutomationEnabled" 4 "AutomationPending" 14 "NonRecoverableFault" 15 "NotAvailable" ;
VAL_ 2619604717 AutomationStatusAuxValve25 13 "AutomationFault" 7 "ActiveLimitedLow" 6 "ActiveLimitedHigh" 5 "ActiveNotLimited" 0 "AutomationUnavailable" 1 "AutomationNotReady" 2 "AutomationReadyToEnable" 3 "AutomationEnabled" 4 "AutomationPending" 14 "NonRecoverableFault" 15 "NotAvailable" ;
VAL_ 2619604717 AutomationStatusAuxValve24 13 "AutomationFault" 7 "ActiveLimitedLow" 6 "ActiveLimitedHigh" 5 "ActiveNotLimited" 0 "AutomationUnavailable" 1 "AutomationNotReady" 2 "AutomationReadyToEnable" 3 "AutomationEnabled" 4 "AutomationPending" 14 "NonRecoverableFault" 15 "NotAvailable" ;
VAL_ 2619604717 AutomationStatusAuxValve23 13 "AutomationFault" 7 "ActiveLimitedLow" 6 "ActiveLimitedHigh" 5 "ActiveNotLimited" 0 "AutomationUnavailable" 1 "AutomationNotReady" 2 "AutomationReadyToEnable" 3 "AutomationEnabled" 4 "AutomationPending" 14 "NonRecoverableFault" 15 "NotAvailable" ;
VAL_ 2619604717 AutomationStatusAuxValve22 13 "AutomationFault" 7 "ActiveLimitedLow" 6 "ActiveLimitedHigh" 5 "ActiveNotLimited" 0 "AutomationUnavailable" 1 "AutomationNotReady" 2 "AutomationReadyToEnable" 3 "AutomationEnabled" 4 "AutomationPending" 14 "NonRecoverableFault" 15 "NotAvailable" ;
VAL_ 2619604717 AutomationStatusAuxValve21 13 "AutomationFault" 7 "ActiveLimitedLow" 6 "ActiveLimitedHigh" 5 "ActiveNotLimited" 0 "AutomationUnavailable" 1 "AutomationNotReady" 2 "AutomationReadyToEnable" 3 "AutomationEnabled" 4 "AutomationPending" 14 "NonRecoverableFault" 15 "NotAvailable" ;
VAL_ 2619604717 AutomationStatusAuxValve20 13 "AutomationFault" 7 "ActiveLimitedLow" 6 "ActiveLimitedHigh" 5 "ActiveNotLimited" 0 "AutomationUnavailable" 1 "AutomationNotReady" 2 "AutomationReadyToEnable" 3 "AutomationEnabled" 4 "AutomationPending" 14 "NonRecoverableFault" 15 "NotAvailable" ;
VAL_ 2619604717 AutomationStatusAuxValve19 13 "AutomationFault" 7 "ActiveLimitedLow" 6 "ActiveLimitedHigh" 5 "ActiveNotLimited" 0 "AutomationUnavailable" 1 "AutomationNotReady" 2 "AutomationReadyToEnable" 3 "AutomationEnabled" 4 "AutomationPending" 14 "NonRecoverableFault" 15 "NotAvailable" ;
VAL_ 2619604717 AutomationStatusAuxValve18 13 "AutomationFault" 7 "ActiveLimitedLow" 6 "ActiveLimitedHigh" 5 "ActiveNotLimited" 0 "AutomationUnavailable" 1 "AutomationNotReady" 2 "AutomationReadyToEnable" 3 "AutomationEnabled" 4 "AutomationPending" 14 "NonRecoverableFault" 15 "NotAvailable" ;
VAL_ 2619604717 AutomationStatusAuxValve17 13 "AutomationFault" 7 "ActiveLimitedLow" 6 "ActiveLimitedHigh" 5 "ActiveNotLimited" 0 "AutomationUnavailable" 1 "AutomationNotReady" 2 "AutomationReadyToEnable" 3 "AutomationEnabled" 4 "AutomationPending" 14 "NonRecoverableFault" 15 "NotAvailable" ;
VAL_ 2619604717 AutomationStatusAuxValve16 13 "AutomationFault" 7 "ActiveLimitedLow" 6 "ActiveLimitedHigh" 5 "ActiveNotLimited" 0 "AutomationUnavailable" 1 "AutomationNotReady" 2 "AutomationReadyToEnable" 3 "AutomationEnabled" 4 "AutomationPending" 14 "NonRecoverableFault" 15 "NotAvailable" ;
VAL_ 2619604717 AutomationStatusAuxValve15 13 "AutomationFault" 7 "ActiveLimitedLow" 6 "ActiveLimitedHigh" 5 "ActiveNotLimited" 0 "AutomationUnavailable" 1 "AutomationNotReady" 2 "AutomationReadyToEnable" 3 "AutomationEnabled" 4 "AutomationPending" 14 "NonRecoverableFault" 15 "NotAvailable" ;
VAL_ 2619604717 AutomationStatusAuxValve14 13 "AutomationFault" 7 "ActiveLimitedLow" 6 "ActiveLimitedHigh" 5 "ActiveNotLimited" 0 "AutomationUnavailable" 1 "AutomationNotReady" 2 "AutomationReadyToEnable" 3 "AutomationEnabled" 4 "AutomationPending" 14 "NonRecoverableFault" 15 "NotAvailable" ;
VAL_ 2619604717 AutomationStatusAuxValve13 13 "AutomationFault" 7 "ActiveLimitedLow" 6 "ActiveLimitedHigh" 5 "ActiveNotLimited" 0 "AutomationUnavailable" 1 "AutomationNotReady" 2 "AutomationReadyToEnable" 3 "AutomationEnabled" 4 "AutomationPending" 14 "NonRecoverableFault" 15 "NotAvailable" ;
VAL_ 2619604717 AutomationStatusAuxValve12 13 "AutomationFault" 7 "ActiveLimitedLow" 6 "ActiveLimitedHigh" 5 "ActiveNotLimited" 0 "AutomationUnavailable" 1 "AutomationNotReady" 2 "AutomationReadyToEnable" 3 "AutomationEnabled" 4 "AutomationPending" 14 "NonRecoverableFault" 15 "NotAvailable" ;
VAL_ 2619604717 AutomationStatusAuxValve11 13 "AutomationFault" 7 "ActiveLimitedLow" 6 "ActiveLimitedHigh" 5 "ActiveNotLimited" 0 "AutomationUnavailable" 1 "AutomationNotReady" 2 "AutomationReadyToEnable" 3 "AutomationEnabled" 4 "AutomationPending" 14 "NonRecoverableFault" 15 "NotAvailable" ;
VAL_ 2619604717 AutomationStatusAuxValve10 13 "AutomationFault" 7 "ActiveLimitedLow" 6 "ActiveLimitedHigh" 5 "ActiveNotLimited" 0 "AutomationUnavailable" 1 "AutomationNotReady" 2 "AutomationReadyToEnable" 3 "AutomationEnabled" 4 "AutomationPending" 14 "NonRecoverableFault" 15 "NotAvailable" ;
VAL_ 2619604717 AutomationStatusAuxValve09 13 "AutomationFault" 7 "ActiveLimitedLow" 6 "ActiveLimitedHigh" 5 "ActiveNotLimited" 0 "AutomationUnavailable" 1 "AutomationNotReady" 2 "AutomationReadyToEnable" 3 "AutomationEnabled" 4 "AutomationPending" 14 "NonRecoverableFault" 15 "NotAvailable" ;
VAL_ 2619604717 AutomationStatusAuxValve08 13 "AutomationFault" 7 "ActiveLimitedLow" 6 "ActiveLimitedHigh" 5 "ActiveNotLimited" 0 "AutomationUnavailable" 1 "AutomationNotReady" 2 "AutomationReadyToEnable" 3 "AutomationEnabled" 4 "AutomationPending" 14 "NonRecoverableFault" 15 "NotAvailable" ;
VAL_ 2619604717 AutomationStatusAuxValve07 13 "AutomationFault" 7 "ActiveLimitedLow" 6 "ActiveLimitedHigh" 5 "ActiveNotLimited" 0 "AutomationUnavailable" 1 "AutomationNotReady" 2 "AutomationReadyToEnable" 3 "AutomationEnabled" 4 "AutomationPending" 14 "NonRecoverableFault" 15 "NotAvailable" ;
VAL_ 2619604717 AutomationStatusAuxValve06 13 "AutomationFault" 7 "ActiveLimitedLow" 6 "ActiveLimitedHigh" 5 "ActiveNotLimited" 0 "AutomationUnavailable" 1 "AutomationNotReady" 2 "AutomationReadyToEnable" 3 "AutomationEnabled" 4 "AutomationPending" 14 "NonRecoverableFault" 15 "NotAvailable" ;
VAL_ 2619604717 AutomationStatusAuxValve05 13 "AutomationFault" 7 "ActiveLimitedLow" 6 "ActiveLimitedHigh" 5 "ActiveNotLimited" 0 "AutomationUnavailable" 1 "AutomationNotReady" 2 "AutomationReadyToEnable" 3 "AutomationEnabled" 4 "AutomationPending" 14 "NonRecoverableFault" 15 "NotAvailable" ;
VAL_ 2619604717 Curvature 65535 "NotAvailable" 65534 "Error" 32128 "Straight" ;
VAL_ 2619604717 ExitReasonCodeExternalGuidance 21 "HydraulicOilLevelTooLow" 20 "HydraulicOilTemperatureTooLow" 19 "VehicleTransmissionGearDoesntAllowRemoteCommands" 18 "VehicleSpeedTooLow" 17 "VehicleSpeedTooHigh" 16 "AlternateGuidanceSystemActive" 31 "NotAvailable" 30 "Error" 15 "ControlUnitInDiagnosticMode" 9 "FunctionFault" 8 "OperatorControlFault" 5 "RemoteCommandTimeout" 4 "OperatorControlNotInValidPosition" 3 "OperatorOverrideOfFunction" 2 "ImplementReleasedControlOfFunction" 7 "FunctionNotCalibrated" 6 "RemoteCommandOutOfRangeOrInvalid" 1 "RequiredLevelOfOperatorPresence_AwarenessNotDetected" 0 "NoReason_AllClear" ;
VAL_ 2619604717 VehicleSpeed 65535 "NotAvailable" 65534 "Error" ;
VAL_ 2619604717 ExitReasonCodeVehicleSpeed 31 "NotAvailable" 30 "Error" 15 "VehicleTransmissionGearDoesntAllowRemoteCommands " 9 "FunctionFault" 8 "OperatorControlFault" 5 "RemoteCommandTimeout" 4 "OperatorControlNotInValidPosition" 3 "OperatorOverrideOfFunction" 2 "ImplementReleasedControlOfFunction" 7 "FunctionNotCalibrated" 6 "RemoteCommandOutOfRangeOrInvalid" 1 "RequiredLevelOfOperatorPresence_AwarenessNotDetected" 0 "NoReason_AllClear" ;
VAL_ 2619604717 FrontHitchPosition 65535 "NotAvailable" 65534 "Error" 64259 "Raising" 64258 "Lowering" 64257 "Stop" 10000 "FullRaise" 0 "FullLower" 64256 "Float" ;
VAL_ 2619604717 ExitReasonCodeFrontHitch 16 "HitchLockedOut" 31 "NotAvailable" 30 "Error" 15 "HydraulicOilLevelLow" 9 "FunctionFault" 8 "OperatorControlFault" 5 "RemoteCommandTimeout" 4 "OperatorControlNotInValidPosition" 3 "OperatorOverrideOfFunction" 2 "ImplementReleasedControlOfFunction" 7 "FunctionNotCalibrated" 6 "RemoteCommandOutOfRangeOrInvalid" 1 "RequiredLevelOfOperatorPresence_AwarenessNotDetected" 0 "NoReason_AllClear" ;
VAL_ 2619604717 FrontPTOSpeed 65535 "NotAvailable" 65534 "Error" ;
VAL_ 2619604717 ExitReasonCodeFrontPTO 31 "NotAvailable" 30 "Error" 15 "InvalidPtoGear" 9 "FunctionFault" 8 "OperatorControlFault" 5 "RemoteCommandTimeout" 4 "OperatorControlNotInValidPosition" 3 "OperatorOverrideOfFunction" 2 "ImplementReleasedControlOfFunction" 7 "FunctionNotCalibrated" 6 "RemoteCommandOutOfRange_Invalid" 1 "RequiredLevelOfOperatorPresence_AwarenessNotDetected" 0 "NoReason_AllClear" ;
VAL_ 2619604717 FlowAuxValve01 64257 "Float" 64256 "ValveFullyOpened_Retract" 32128 "NoFlow_Block" 0 "ValveFullyOpened_Extend" ;
VAL_ 2619604717 ReflectedRequestCounter 15 "NotAvailable_DontCare " 14 "Reserved" ;
VAL_ 2619604717 ExitReasonCodeAuxValve01 31 "NotAvailable" 30 "Error" 16 "ValveLockedOut_TransportLock" 15 "HydraulicOilLevelLow" 9 "FunctionFault" 8 "OperatorControlFault" 5 "RemoteCommandTimeout" 4 "OperatorControlNotInValidPosition" 3 "OperatorOverrideOfFunction" 2 "ImplementReleasedControlOfFunction" 7 "FunctionNotCalibrated" 6 "RemoteCommandOutOfRange_Invalid" 1 "RequiredLevelOfOperatorPresence_AwarenessNotDetected" 0 "NoReason_AllClear" ;
VAL_ 2619604717 TIMSystemOperationState 15 "NotAvailable" 14 "Error" 3 "RequirementsStationaryFulfilled" 2 "RequirementsStandstillFulfilled" 1 "RequirementsNormalFulfilled" 0 "RequirementsNotFulfilled" ;
VAL_ 2619604717 TIMServerState 13 "AutomationFault" 5 "AutomationActive" 3 "AutomationEnabled" 15 "NotAvailable" 14 "Error" 1 "AutomationNotReady" 0 "AutomationUnavailable" ;
VAL_ 2619604717 TIMSystemState 15 "NotAvailable" 14 "Error" 5 "AutomationActive" 1 "NoAutomationActive" ;
VAL_ 2619604717 LeadTIMServerIndication 15 "NotAvailable" 14 "Error" 1 "IsLeadAndAutomationAllowed" 0 "IsLeadButAutomationNotAllowed" ;
VAL_ 2619604717 ServerHeartbeatCounter 255 "GracefulShutdown" 254 "ErrorConditionOnSender" 251 "ResetOfHeartbeatCounter" ;
VAL_ 2619604717 AssignmentResult_4 7 "NotAvailable" 6 "Error" 5 "AssignmentNotSuccessful" 1 "IsAssigned" 0 "IsNotAssigned" ;
VAL_ 2619604717 AssignmentResult_3 7 "NotAvailable" 6 "Error" 5 "AssignmentNotSuccessful" 1 "IsAssigned" 0 "IsNotAssigned" ;
VAL_ 2619604717 AssignmentResult_2 7 "NotAvailable" 6 "Error" 5 "AssignmentNotSuccessful" 1 "IsAssigned" 0 "IsNotAssigned" ;
VAL_ 2619604717 AssignmentErrorReason_4 31 "NotAvailable" 30 "AnyOtherError" 8 "ClientNotAuthenticated" 7 "NoMatchingFacility" 6 "ServerBusyWithAssignmentRequest" 5 "ClientNotCertifiedForFunction" 4 "ErrorInRequestMessage" 3 "UnknownRequestType" 2 "FunctionCurrentlyNotAvailable" 1 "FunctionNotSupportedByServer" 0 "AllClearNoReason" ;
VAL_ 2619604717 AssignmentErrorReason_3 31 "NotAvailable" 30 "AnyOtherError" 8 "ClientNotAuthenticated" 7 "NoMatchingFacility" 6 "ServerBusyWithAssignmentRequest" 5 "ClientNotCertifiedForFunction" 4 "ErrorInRequestMessage" 3 "UnknownRequestType" 2 "FunctionCurrentlyNotAvailable" 1 "FunctionNotSupportedByServer" 0 "AllClearNoReason" ;
VAL_ 2619604717 AssignmentErrorReason_2 31 "NotAvailable" 30 "AnyOtherError" 8 "ClientNotAuthenticated" 7 "NoMatchingFacility" 6 "ServerBusyWithAssignmentRequest" 5 "ClientNotCertifiedForFunction" 4 "ErrorInRequestMessage" 3 "UnknownRequestType" 2 "FunctionCurrentlyNotAvailable" 1 "FunctionNotSupportedByServer" 0 "AllClearNoReason" ;
VAL_ 2619604717 AssignmentErrorReason_1 31 "NotAvailable" 30 "AnyOtherError" 8 "ClientNotAuthenticated" 7 "NoMatchingFacility" 6 "ServerBusyWithAssignmentRequest" 5 "ClientNotCertifiedForFunction" 4 "ErrorInRequestMessage" 3 "UnknownRequestType" 2 "FunctionCurrentlyNotAvailable" 1 "FunctionNotSupportedByServer" 0 "AllClearNoReason" ;
VAL_ 2619604717 AssignmentResult_1 7 "NotAvailable" 6 "Error" 5 "AssignmentNotSuccessful" 1 "IsAssigned" 0 "IsNotAssigned" ;
VAL_ 2619604717 TIMFunctionId_4 72 "RearTopLinkage" 71 "FrontTopLinkage" 32 "AuxValve32" 70 "ExternalGuidance" 68 "VehicleSpeed" 67 "RearHitch" 66 "FrontHitch" 65 "RearPTO" 64 "FrontPTO" 31 "AuxValve31" 30 "AuxValve30" 29 "AuxValve29" 28 "AuxValve28" 27 "AuxValve27" 26 "AuxValve26" 25 "AuxValve25" 24 "AuxValve24" 23 "AuxValve23" 22 "AuxValve22" 21 "AuxValve21" 20 "AuxValve20" 19 "AuxValve19" 18 "AuxValve18" 17 "AuxValve17" 16 "AuxValve16" 15 "AuxValve15" 14 "AuxValve14" 13 "AuxValve13" 12 "AuxValve12" 11 "AuxValve11" 10 "AuxValve10" 9 "AuxValve9" 8 "AuxValve8" 7 "AuxValve7" 6 "AuxValve6" 5 "AuxValve5" 4 "AuxValve4" 3 "AuxValve3" 2 "AuxValve2" 1 "AuxValve1" ;
VAL_ 2619604717 TIMFunctionId_3 72 "RearTopLinkage" 71 "FrontTopLinkage" 32 "AuxValve32" 70 "ExternalGuidance" 68 "VehicleSpeed" 67 "RearHitch" 66 "FrontHitch" 65 "RearPTO" 64 "FrontPTO" 31 "AuxValve31" 30 "AuxValve30" 29 "AuxValve29" 28 "AuxValve28" 27 "AuxValve27" 26 "AuxValve26" 25 "AuxValve25" 24 "AuxValve24" 23 "AuxValve23" 22 "AuxValve22" 21 "AuxValve21" 20 "AuxValve20" 19 "AuxValve19" 18 "AuxValve18" 17 "AuxValve17" 16 "AuxValve16" 15 "AuxValve15" 14 "AuxValve14" 13 "AuxValve13" 12 "AuxValve12" 11 "AuxValve11" 10 "AuxValve10" 9 "AuxValve9" 8 "AuxValve8" 7 "AuxValve7" 6 "AuxValve6" 5 "AuxValve5" 4 "AuxValve4" 3 "AuxValve3" 2 "AuxValve2" 1 "AuxValve1" ;
VAL_ 2619604717 TIMFunctionId_2 72 "RearTopLinkage" 71 "FrontTopLinkage" 32 "AuxValve32" 70 "ExternalGuidance" 68 "VehicleSpeed" 67 "RearHitch" 66 "FrontHitch" 65 "RearPTO" 64 "FrontPTO" 31 "AuxValve31" 30 "AuxValve30" 29 "AuxValve29" 28 "AuxValve28" 27 "AuxValve27" 26 "AuxValve26" 25 "AuxValve25" 24 "AuxValve24" 23 "AuxValve23" 22 "AuxValve22" 21 "AuxValve21" 20 "AuxValve20" 19 "AuxValve19" 18 "AuxValve18" 17 "AuxValve17" 16 "AuxValve16" 15 "AuxValve15" 14 "AuxValve14" 13 "AuxValve13" 12 "AuxValve12" 11 "AuxValve11" 10 "AuxValve10" 9 "AuxValve9" 8 "AuxValve8" 7 "AuxValve7" 6 "AuxValve6" 5 "AuxValve5" 4 "AuxValve4" 3 "AuxValve3" 2 "AuxValve2" 1 "AuxValve1" ;
VAL_ 2619604717 TIMFunctionId_1 72 "RearTopLinkage" 71 "FrontTopLinkage" 32 "AuxValve32" 70 "ExternalGuidance" 68 "VehicleSpeed" 67 "RearHitch" 66 "FrontHitch" 65 "RearPTO" 64 "FrontPTO" 31 "AuxValve31" 30 "AuxValve30" 29 "AuxValve29" 28 "AuxValve28" 27 "AuxValve27" 26 "AuxValve26" 25 "AuxValve25" 24 "AuxValve24" 23 "AuxValve23" 22 "AuxValve22" 21 "AuxValve21" 20 "AuxValve20" 19 "AuxValve19" 18 "AuxValve18" 17 "AuxValve17" 16 "AuxValve16" 15 "AuxValve15" 14 "AuxValve14" 13 "AuxValve13" 12 "AuxValve12" 11 "AuxValve11" 10 "AuxValve10" 9 "AuxValve9" 8 "AuxValve8" 7 "AuxValve7" 6 "AuxValve6" 5 "AuxValve5" 4 "AuxValve4" 3 "AuxValve3" 2 "AuxValve2" 1 "AuxValve1" ;
VAL_ 2619604717 TIMConnectionVersion 255 "IncompatibleTIMServerAndClientVersions" ;
VAL_ 2619604717 ErrorCode 1 "IncompatibleTIMServerAndClientVersions" 0 "NoError" ;
VAL_ 2619604717 TIMMessageType 1 "TIMFunctionStatus" 0 "TIMFunctionRequest" ;

SG_MUL_VAL_ 2621243117 SecurityByte_VS MsgType_VS 1-1, 17-17;
SG_MUL_VAL_ 2621243117 SecurityByte_RTL Position_RTL 1-1, 17-17;
SG_MUL_VAL_ 2621243117 SecurityByte_RPTO MsgType_RPTO 1-1, 17-17;
SG_MUL_VAL_ 2621243117 SecurityByte_RH MsgType_RH 1-1, 17-17;
SG_MUL_VAL_ 2621243117 SecurityByte_FTL MsgType_FTL 1-1, 17-17;
SG_MUL_VAL_ 2621243117 SecurityByte_FPTO MsgType_FPTO 1-1, 17-17;
SG_MUL_VAL_ 2621243117 SecurityByte_FH MsgType_FH 1-1, 17-17;
SG_MUL_VAL_ 2621243117 SecurityByte_EG MsgType_EG 1-1, 17-17;
SG_MUL_VAL_ 2621243117 SecurityByte_AV32 MsgType_AV32 1-1, 17-17;
SG_MUL_VAL_ 2621243117 SecurityByte_AV31 MsgType_AV31 1-1, 17-17;
SG_MUL_VAL_ 2621243117 SecurityByte_AV30 MsgType_AV30 1-1, 17-17;
SG_MUL_VAL_ 2621243117 SecurityByte_AV29 MsgType_AV29 1-1, 17-17;
SG_MUL_VAL_ 2621243117 SecurityByte_AV28 MsgType_AV28 1-1, 17-17;
SG_MUL_VAL_ 2621243117 SecurityByte_AV27 MsgType_AV27 1-1, 17-17;
SG_MUL_VAL_ 2621243117 SecurityByte_AV26 MsgType_AV26 1-1, 17-17;
SG_MUL_VAL_ 2621243117 SecurityByte_AV25 MsgType_AV25 1-1, 17-17;
SG_MUL_VAL_ 2621243117 SecurityByte_AV24 MsgType_AV24 1-1, 17-17;
SG_MUL_VAL_ 2621243117 SecurityByte_AV23 MsgType_AV23 1-1, 17-17;
SG_MUL_VAL_ 2621243117 SecurityByte_AV22 MsgType_AV22 1-1, 17-17;
SG_MUL_VAL_ 2621243117 SecurityByte_AV21 MsgType_AV21 1-1, 17-17;
SG_MUL_VAL_ 2621243117 SecurityByte_AV20 MsgType_AV20 1-1, 17-17;
SG_MUL_VAL_ 2621243117 SecurityByte_AV19 MsgType_AV19 1-1, 17-17;
SG_MUL_VAL_ 2621243117 SecurityByte_AV18 MsgType_AV18 1-1, 17-17;
SG_MUL_VAL_ 2621243117 SecurityByte_AV17 MsgType_AV17 1-1, 17-17;
SG_MUL_VAL_ 2621243117 SecurityByte_AV16 MsgType_AV16 1-1, 17-17;
SG_MUL_VAL_ 2621243117 SecurityByte_AV15 MsgType_AV15 1-1, 17-17;
SG_MUL_VAL_ 2621243117 SecurityByte_AV14 MsgType_AV14 1-1, 17-17;
SG_MUL_VAL_ 2621243117 SecurityByte_AV13 MsgType_AV13 1-1, 17-17;
SG_MUL_VAL_ 2621243117 SecurityByte_AV12 MsgType_AV12 1-1, 17-17;
SG_MUL_VAL_ 2621243117 SecurityByte_AV11 MsgType_AV11 1-1, 17-17;
SG_MUL_VAL_ 2621243117 SecurityByte_AV10 MsgType_AV10 1-1, 17-17;
SG_MUL_VAL_ 2621243117 SecurityByte_AV09 MsgType_AV09 1-1, 17-17;
SG_MUL_VAL_ 2621243117 SecurityByte_AV08 MsgType_AV08 1-1, 17-17;
SG_MUL_VAL_ 2621243117 SecurityByte_AV07 MsgType_AV07 1-1, 17-17;
SG_MUL_VAL_ 2621243117 SecurityByte_AV06 MsgType_AV06 1-1, 17-17;
SG_MUL_VAL_ 2621243117 SecurityByte_AV05 MsgType_AV05 1-1, 17-17;
SG_MUL_VAL_ 2621243117 SecurityByte_AV04 MsgType_AV04 1-1, 17-17;
SG_MUL_VAL_ 2621243117 SecurityByte_AV03 MsgType_AV03 1-1, 17-17;
SG_MUL_VAL_ 2621243117 SecurityByte_AV02 MsgType_AV02 1-1, 17-17;
SG_MUL_VAL_ 2621243117 SecurityByte_AV01 MsgType_AV01 1-1, 17-17;
SG_MUL_VAL_ 2621243117 State_RH MsgType_RH 17-17;
SG_MUL_VAL_ 2621243117 State_RTL MsgType_RTL 17-17;
SG_MUL_VAL_ 2621243117 State_FTL MsgType_FTL 17-17;
SG_MUL_VAL_ 2621243117 State_FH MsgType_FH 17-17;
SG_MUL_VAL_ 2621243117 StrokeLength_CM1GP_RTL ControlMode1_RTL 0-0;
SG_MUL_VAL_ 2621243117 BaseLength_CM1GP_RTL ControlMode1_RTL 0-0;
SG_MUL_VAL_ 2621243117 StrokeLength_CM1GP_FTL ControlMode1_FTL 0-0;
SG_MUL_VAL_ 2621243117 BaseLength_CM1GP_FTL ControlMode1_FTL 0-0;
SG_MUL_VAL_ 2621243117 MinimumSpeedBackward_CM1GP_VS ControlMode1_VS 0-0;
SG_MUL_VAL_ 2621243117 MaximumSpeedBackward_CM1GP_VS ControlMode1_VS 0-0;
SG_MUL_VAL_ 2621243117 MinimumSpeedForward_CM1GP_VS ControlMode1_VS 0-0;
SG_MUL_VAL_ 2621243117 MaximumSpeedForward_CM1GP_VS ControlMode1_VS 0-0;
SG_MUL_VAL_ 2621243117 TransmissionType_CM1GP_VS ControlMode1_VS 0-0;
SG_MUL_VAL_ 2621243117 ControlMode1_RTL MsgType_RTL 0-0;
SG_MUL_VAL_ 2621243117 NumOfControlModes_RTL MsgType_RTL 0-0;
SG_MUL_VAL_ 2621243117 NumOfBytes_CM1_RTL MsgType_RTL 0-0;
SG_MUL_VAL_ 2621243117 Position_RTL MsgType_RTL 17-17;
SG_MUL_VAL_ 2621243117 Position_FTL MsgType_FTL 17-17;
SG_MUL_VAL_ 2621243117 ExitReasonCode_RTL MsgType_RTL 1-1;
SG_MUL_VAL_ 2621243117 ExitReasonCode_FTL MsgType_FTL 1-1;
SG_MUL_VAL_ 2621243117 AutomationStatus_RTL MsgType_RTL 1-1;
SG_MUL_VAL_ 2621243117 AutomationStatus_FTL MsgType_FTL 1-1;
SG_MUL_VAL_ 2621243117 ControlMode1_FTL MsgType_FTL 0-0;
SG_MUL_VAL_ 2621243117 NumOfBytes_CM1_FTL MsgType_FTL 0-0;
SG_MUL_VAL_ 2621243117 NumOfControlModes_FTL MsgType_FTL 0-0;
SG_MUL_VAL_ 2621243117 MsgType_RTL TIMFunctionID 72-72;
SG_MUL_VAL_ 2621243117 MsgType_FTL TIMFunctionID 71-71;
SG_MUL_VAL_ 2621243117 MsgType_EG TIMFunctionID 70-70;
SG_MUL_VAL_ 2621243117 NumOfBytes_CM1_VS MsgType_VS 0-0;
SG_MUL_VAL_ 2621243117 ControlMode1_VS MsgType_VS 0-0;
SG_MUL_VAL_ 2621243117 NumOfControlModes_VS MsgType_VS 0-0;
SG_MUL_VAL_ 2621243117 MsgType_VS TIMFunctionID 68-68;
SG_MUL_VAL_ 2621243117 MsgType_RH TIMFunctionID 67-67;
SG_MUL_VAL_ 2621243117 MsgType_FH TIMFunctionID 66-66;
SG_MUL_VAL_ 2621243117 MsgType_RPTO TIMFunctionID 65-65;
SG_MUL_VAL_ 2621243117 MsgType_FPTO TIMFunctionID 64-64;
SG_MUL_VAL_ 2621243117 MsgType_AV32 TIMFunctionID 32-32;
SG_MUL_VAL_ 2621243117 MsgType_AV31 TIMFunctionID 31-31;
SG_MUL_VAL_ 2621243117 MsgType_AV30 TIMFunctionID 30-30;
SG_MUL_VAL_ 2621243117 MsgType_AV29 TIMFunctionID 29-29;
SG_MUL_VAL_ 2621243117 MsgType_AV28 TIMFunctionID 28-28;
SG_MUL_VAL_ 2621243117 MsgType_AV27 TIMFunctionID 27-27;
SG_MUL_VAL_ 2621243117 MsgType_AV26 TIMFunctionID 26-26;
SG_MUL_VAL_ 2621243117 MsgType_AV25 TIMFunctionID 25-25;
SG_MUL_VAL_ 2621243117 MsgType_AV24 TIMFunctionID 24-24;
SG_MUL_VAL_ 2621243117 MsgType_AV23 TIMFunctionID 23-23;
SG_MUL_VAL_ 2621243117 MsgType_AV22 TIMFunctionID 22-22;
SG_MUL_VAL_ 2621243117 MsgType_AV21 TIMFunctionID 21-21;
SG_MUL_VAL_ 2621243117 MsgType_AV20 TIMFunctionID 20-20;
SG_MUL_VAL_ 2621243117 MsgType_AV19 TIMFunctionID 19-19;
SG_MUL_VAL_ 2621243117 MsgType_AV18 TIMFunctionID 18-18;
SG_MUL_VAL_ 2621243117 MsgType_AV17 TIMFunctionID 17-17;
SG_MUL_VAL_ 2621243117 MsgType_AV16 TIMFunctionID 16-16;
SG_MUL_VAL_ 2621243117 MsgType_AV15 TIMFunctionID 15-15;
SG_MUL_VAL_ 2621243117 MsgType_AV14 TIMFunctionID 14-14;
SG_MUL_VAL_ 2621243117 MsgType_AV13 TIMFunctionID 13-13;
SG_MUL_VAL_ 2621243117 MsgType_AV12 TIMFunctionID 12-12;
SG_MUL_VAL_ 2621243117 MsgType_AV11 TIMFunctionID 11-11;
SG_MUL_VAL_ 2621243117 MsgType_AV10 TIMFunctionID 10-10;
SG_MUL_VAL_ 2621243117 MsgType_AV09 TIMFunctionID 9-9;
SG_MUL_VAL_ 2621243117 MsgType_AV08 TIMFunctionID 8-8;
SG_MUL_VAL_ 2621243117 MsgType_AV07 TIMFunctionID 7-7;
SG_MUL_VAL_ 2621243117 MsgType_AV06 TIMFunctionID 6-6;
SG_MUL_VAL_ 2621243117 MsgType_AV05 TIMFunctionID 5-5;
SG_MUL_VAL_ 2621243117 MsgType_AV04 TIMFunctionID 4-4;
SG_MUL_VAL_ 2621243117 MsgType_AV03 TIMFunctionID 3-3;
SG_MUL_VAL_ 2621243117 MsgType_AV02 TIMFunctionID 2-2;
SG_MUL_VAL_ 2621243117 MsgType_AV01 TIMFunctionID 1-1;
SG_MUL_VAL_ 2621243117 Position_RH MsgType_RH 17-17;
SG_MUL_VAL_ 2621243117 Speed_RPTO MsgType_RPTO 17-17;
SG_MUL_VAL_ 2621243117 Flow_AV32 MsgType_AV32 17-17;
SG_MUL_VAL_ 2621243117 Flow_AV31 MsgType_AV31 17-17;
SG_MUL_VAL_ 2621243117 Flow_AV30 MsgType_AV30 17-17;
SG_MUL_VAL_ 2621243117 Flow_AV29 MsgType_AV29 17-17;
SG_MUL_VAL_ 2621243117 Flow_AV28 MsgType_AV28 17-17;
SG_MUL_VAL_ 2621243117 Flow_AV27 MsgType_AV27 17-17;
SG_MUL_VAL_ 2621243117 Flow_AV26 MsgType_AV26 17-17;
SG_MUL_VAL_ 2621243117 Flow_AV25 MsgType_AV25 17-17;
SG_MUL_VAL_ 2621243117 Flow_AV24 MsgType_AV24 17-17;
SG_MUL_VAL_ 2621243117 Flow_AV23 MsgType_AV23 17-17;
SG_MUL_VAL_ 2621243117 Flow_AV22 MsgType_AV22 17-17;
SG_MUL_VAL_ 2621243117 Flow_AV21 MsgType_AV21 17-17;
SG_MUL_VAL_ 2621243117 Flow_AV20 MsgType_AV20 17-17;
SG_MUL_VAL_ 2621243117 Flow_AV19 MsgType_AV19 17-17;
SG_MUL_VAL_ 2621243117 Flow_AV18 MsgType_AV18 17-17;
SG_MUL_VAL_ 2621243117 Flow_AV17 MsgType_AV17 17-17;
SG_MUL_VAL_ 2621243117 Flow_AV16 MsgType_AV16 17-17;
SG_MUL_VAL_ 2621243117 Flow_AV15 MsgType_AV15 17-17;
SG_MUL_VAL_ 2621243117 Flow_AV14 MsgType_AV14 17-17;
SG_MUL_VAL_ 2621243117 Flow_AV13 MsgType_AV13 17-17;
SG_MUL_VAL_ 2621243117 Flow_AV12 MsgType_AV12 17-17;
SG_MUL_VAL_ 2621243117 Flow_AV11 MsgType_AV11 17-17;
SG_MUL_VAL_ 2621243117 Flow_AV10 MsgType_AV10 17-17;
SG_MUL_VAL_ 2621243117 Flow_AV09 MsgType_AV09 17-17;
SG_MUL_VAL_ 2621243117 Flow_AV08 MsgType_AV08 17-17;
SG_MUL_VAL_ 2621243117 Flow_AV07 MsgType_AV07 17-17;
SG_MUL_VAL_ 2621243117 Flow_AV06 MsgType_AV06 17-17;
SG_MUL_VAL_ 2621243117 Flow_AV05 MsgType_AV05 17-17;
SG_MUL_VAL_ 2621243117 Flow_AV04 MsgType_AV04 17-17;
SG_MUL_VAL_ 2621243117 Flow_AV03 MsgType_AV03 17-17;
SG_MUL_VAL_ 2621243117 Flow_AV02 MsgType_AV02 17-17;
SG_MUL_VAL_ 2621243117 FlowType_AV32 MsgType_AV32 1-1;
SG_MUL_VAL_ 2621243117 FlowType_AV31 MsgType_AV31 1-1;
SG_MUL_VAL_ 2621243117 FlowType_AV30 MsgType_AV30 1-1;
SG_MUL_VAL_ 2621243117 FlowType_AV29 MsgType_AV29 1-1;
SG_MUL_VAL_ 2621243117 FlowType_AV28 MsgType_AV28 1-1;
SG_MUL_VAL_ 2621243117 FlowType_AV27 MsgType_AV27 1-1;
SG_MUL_VAL_ 2621243117 FlowType_AV26 MsgType_AV26 1-1;
SG_MUL_VAL_ 2621243117 FlowType_AV25 MsgType_AV25 1-1;
SG_MUL_VAL_ 2621243117 FlowType_AV24 MsgType_AV24 1-1;
SG_MUL_VAL_ 2621243117 FlowType_AV23 MsgType_AV23 1-1;
SG_MUL_VAL_ 2621243117 FlowType_AV22 MsgType_AV22 1-1;
SG_MUL_VAL_ 2621243117 FlowType_AV21 MsgType_AV21 1-1;
SG_MUL_VAL_ 2621243117 FlowType_AV20 MsgType_AV20 1-1;
SG_MUL_VAL_ 2621243117 FlowType_AV19 MsgType_AV19 1-1;
SG_MUL_VAL_ 2621243117 FlowType_AV18 MsgType_AV18 1-1;
SG_MUL_VAL_ 2621243117 FlowType_AV17 MsgType_AV17 1-1;
SG_MUL_VAL_ 2621243117 FlowType_AV16 MsgType_AV16 1-1;
SG_MUL_VAL_ 2621243117 FlowType_AV15 MsgType_AV15 1-1;
SG_MUL_VAL_ 2621243117 FlowType_AV14 MsgType_AV14 1-1;
SG_MUL_VAL_ 2621243117 FlowType_AV13 MsgType_AV13 1-1;
SG_MUL_VAL_ 2621243117 FlowType_AV12 MsgType_AV12 1-1;
SG_MUL_VAL_ 2621243117 FlowType_AV11 MsgType_AV11 1-1;
SG_MUL_VAL_ 2621243117 FlowType_AV10 MsgType_AV10 1-1;
SG_MUL_VAL_ 2621243117 FlowType_AV09 MsgType_AV09 1-1;
SG_MUL_VAL_ 2621243117 FlowType_AV08 MsgType_AV08 1-1;
SG_MUL_VAL_ 2621243117 FlowType_AV07 MsgType_AV07 1-1;
SG_MUL_VAL_ 2621243117 FlowType_AV06 MsgType_AV06 1-1;
SG_MUL_VAL_ 2621243117 FlowType_AV05 MsgType_AV05 1-1;
SG_MUL_VAL_ 2621243117 FlowType_AV04 MsgType_AV04 1-1;
SG_MUL_VAL_ 2621243117 FlowType_AV03 MsgType_AV03 1-1;
SG_MUL_VAL_ 2621243117 FlowType_AV02 MsgType_AV02 1-1;
SG_MUL_VAL_ 2621243117 FlowType_AV01 MsgType_AV01 1-1;
SG_MUL_VAL_ 2621243117 ExitReasonCode_RPTO MsgType_RPTO 1-1;
SG_MUL_VAL_ 2621243117 ExitReasonCode_RH MsgType_RH 1-1;
SG_MUL_VAL_ 2621243117 ExitReasonCode_AV32 MsgType_AV32 1-1;
SG_MUL_VAL_ 2621243117 ExitReasonCode_AV31 MsgType_AV31 1-1;
SG_MUL_VAL_ 2621243117 ExitReasonCode_AV30 MsgType_AV30 1-1;
SG_MUL_VAL_ 2621243117 ExitReasonCode_AV29 MsgType_AV29 1-1;
SG_MUL_VAL_ 2621243117 ExitReasonCode_AV28 MsgType_AV28 1-1;
SG_MUL_VAL_ 2621243117 ExitReasonCode_AV27 MsgType_AV27 1-1;
SG_MUL_VAL_ 2621243117 ExitReasonCode_AV26 MsgType_AV26 1-1;
SG_MUL_VAL_ 2621243117 ExitReasonCode_AV25 MsgType_AV25 1-1;
SG_MUL_VAL_ 2621243117 ExitReasonCode_AV24 MsgType_AV24 1-1;
SG_MUL_VAL_ 2621243117 ExitReasonCode_AV23 MsgType_AV23 1-1;
SG_MUL_VAL_ 2621243117 ExitReasonCode_AV22 MsgType_AV22 1-1;
SG_MUL_VAL_ 2621243117 ExitReasonCode_AV21 MsgType_AV21 1-1;
SG_MUL_VAL_ 2621243117 ExitReasonCode_AV20 MsgType_AV20 1-1;
SG_MUL_VAL_ 2621243117 ExitReasonCode_AV19 MsgType_AV19 1-1;
SG_MUL_VAL_ 2621243117 ExitReasonCode_AV18 MsgType_AV18 1-1;
SG_MUL_VAL_ 2621243117 ExitReasonCode_AV17 MsgType_AV17 1-1;
SG_MUL_VAL_ 2621243117 ExitReasonCode_AV16 MsgType_AV16 1-1;
SG_MUL_VAL_ 2621243117 ExitReasonCode_AV15 MsgType_AV15 1-1;
SG_MUL_VAL_ 2621243117 ExitReasonCode_AV14 MsgType_AV14 1-1;
SG_MUL_VAL_ 2621243117 ExitReasonCode_AV13 MsgType_AV13 1-1;
SG_MUL_VAL_ 2621243117 ExitReasonCode_AV12 MsgType_AV12 1-1;
SG_MUL_VAL_ 2621243117 ExitReasonCode_AV11 MsgType_AV11 1-1;
SG_MUL_VAL_ 2621243117 ExitReasonCode_AV10 MsgType_AV10 1-1;
SG_MUL_VAL_ 2621243117 ExitReasonCode_AV09 MsgType_AV09 1-1;
SG_MUL_VAL_ 2621243117 ExitReasonCode_AV08 MsgType_AV08 1-1;
SG_MUL_VAL_ 2621243117 ExitReasonCode_AV07 MsgType_AV07 1-1;
SG_MUL_VAL_ 2621243117 ExitReasonCode_AV06 MsgType_AV06 1-1;
SG_MUL_VAL_ 2621243117 ExitReasonCode_AV05 MsgType_AV05 1-1;
SG_MUL_VAL_ 2621243117 ExitReasonCode_AV04 MsgType_AV04 1-1;
SG_MUL_VAL_ 2621243117 ExitReasonCode_AV03 MsgType_AV03 1-1;
SG_MUL_VAL_ 2621243117 ExitReasonCode_AV02 MsgType_AV02 1-1;
SG_MUL_VAL_ 2621243117 AutomationStatus_AV04 MsgType_AV04 1-1;
SG_MUL_VAL_ 2621243117 AutomationStatus_AV03 MsgType_AV03 1-1;
SG_MUL_VAL_ 2621243117 AutomationStatus_AV02 MsgType_AV02 1-1;
SG_MUL_VAL_ 2621243117 AutomationStatus_AV01 MsgType_AV01 1-1;
SG_MUL_VAL_ 2621243117 AutomationStatus_EG MsgType_EG 1-1;
SG_MUL_VAL_ 2621243117 AutomationStatus_VS MsgType_VS 1-1;
SG_MUL_VAL_ 2621243117 AutomationStatus_RH MsgType_RH 1-1;
SG_MUL_VAL_ 2621243117 AutomationStatus_FH MsgType_FH 1-1;
SG_MUL_VAL_ 2621243117 AutomationStatus_RPTO MsgType_RPTO 1-1;
SG_MUL_VAL_ 2621243117 AutomationStatus_FPTO MsgType_FPTO 1-1;
SG_MUL_VAL_ 2621243117 AutomationStatus_AV32 MsgType_AV32 1-1;
SG_MUL_VAL_ 2621243117 AutomationStatus_AV31 MsgType_AV31 1-1;
SG_MUL_VAL_ 2621243117 AutomationStatus_AV30 MsgType_AV30 1-1;
SG_MUL_VAL_ 2621243117 AutomationStatus_AV29 MsgType_AV29 1-1;
SG_MUL_VAL_ 2621243117 AutomationStatus_AV28 MsgType_AV28 1-1;
SG_MUL_VAL_ 2621243117 AutomationStatus_AV27 MsgType_AV27 1-1;
SG_MUL_VAL_ 2621243117 AutomationStatus_AV26 MsgType_AV26 1-1;
SG_MUL_VAL_ 2621243117 AutomationStatus_AV25 MsgType_AV25 1-1;
SG_MUL_VAL_ 2621243117 AutomationStatus_AV24 MsgType_AV24 1-1;
SG_MUL_VAL_ 2621243117 AutomationStatus_AV23 MsgType_AV23 1-1;
SG_MUL_VAL_ 2621243117 AutomationStatus_AV22 MsgType_AV22 1-1;
SG_MUL_VAL_ 2621243117 AutomationStatus_AV21 MsgType_AV21 1-1;
SG_MUL_VAL_ 2621243117 AutomationStatus_AV20 MsgType_AV20 1-1;
SG_MUL_VAL_ 2621243117 AutomationStatus_AV19 MsgType_AV19 1-1;
SG_MUL_VAL_ 2621243117 AutomationStatus_AV18 MsgType_AV18 1-1;
SG_MUL_VAL_ 2621243117 AutomationStatus_AV17 MsgType_AV17 1-1;
SG_MUL_VAL_ 2621243117 AutomationStatus_AV16 MsgType_AV16 1-1;
SG_MUL_VAL_ 2621243117 AutomationStatus_AV15 MsgType_AV15 1-1;
SG_MUL_VAL_ 2621243117 AutomationStatus_AV14 MsgType_AV14 1-1;
SG_MUL_VAL_ 2621243117 AutomationStatus_AV13 MsgType_AV13 1-1;
SG_MUL_VAL_ 2621243117 AutomationStatus_AV12 MsgType_AV12 1-1;
SG_MUL_VAL_ 2621243117 AutomationStatus_AV11 MsgType_AV11 1-1;
SG_MUL_VAL_ 2621243117 AutomationStatus_AV10 MsgType_AV10 1-1;
SG_MUL_VAL_ 2621243117 AutomationStatus_AV09 MsgType_AV09 1-1;
SG_MUL_VAL_ 2621243117 AutomationStatus_AV08 MsgType_AV08 1-1;
SG_MUL_VAL_ 2621243117 AutomationStatus_AV07 MsgType_AV07 1-1;
SG_MUL_VAL_ 2621243117 AutomationStatus_AV06 MsgType_AV06 1-1;
SG_MUL_VAL_ 2621243117 AutomationStatus_AV05 MsgType_AV05 1-1;
SG_MUL_VAL_ 2621243117 Curvature_EG MsgType_EG 17-17;
SG_MUL_VAL_ 2621243117 ExitReasonCode_EG MsgType_EG 1-1;
SG_MUL_VAL_ 2621243117 VehicleSpeed_VS MsgType_VS 17-17;
SG_MUL_VAL_ 2621243117 ExitReasonCode_VS MsgType_VS 1-1;
SG_MUL_VAL_ 2621243117 Position_FH MsgType_FH 17-17;
SG_MUL_VAL_ 2621243117 ExitReasonCode_FH MsgType_FH 1-1;
SG_MUL_VAL_ 2621243117 Speed_FPTO MsgType_FPTO 17-17;
SG_MUL_VAL_ 2621243117 ExitReasonCode_FPTO MsgType_FPTO 1-1;
SG_MUL_VAL_ 2621243117 Flow_AV01 MsgType_AV01 17-17;
SG_MUL_VAL_ 2621243117 ExitReasonCode_AV01 MsgType_AV01 1-1;
SG_MUL_VAL_ 2619604717 ReflectedRequestCounter GroupFunctionValue 1-32, 64-68, 70-70;
SG_MUL_VAL_ 2619604717 TIMMessageType GroupFunctionValue 1-32, 64-68, 70-70;
