/*@!Encoding:1252*/

///////////////////////////////////////
// v. 2.1
///////////////////////////////////////
includes
{
  #include "CommonConst.CIN"
  #include "CommonFunctions.cin"
  #include "Plugin\Plugin_CT_TIMClient.cin"
}

variables
{
  /////////////////////////////////////////////////////////////////////////////////
  //Adjust client number (1, 2, or 3)                                            //
  word sClientNumber=3;                                                          //
  using namespace TIMClient3;                                                    //
  using namespace ISO11783TIMClientAndServerDemo::TIMClient3;                    //
  /////////////////////////////////////////////////////////////////////////////////

  char sPanelNameClient[32];
  char sClientName[32];
  char sPanelNameAuxValves[32];
  char sClientNamespace[32];

  byte sAutoStart = 0; // > 0 if auto start of the server is enabled
  char sLwATableFile[100] = "ClientLwATable.txt";

  int  sFreezedHearbeatCounter = -1;

  int sNumOfReqForTestlabCertToIgnore;
  int sNumOfReqForManufactCertToIgnore;
  int sNumOfReqForManufactSeriesCertToIgnore;
  int sNumOfReqForDeviceCertToIgnore;
  
  int sRequiredAuxValve[33]; // value 0 is not used
  int sRequiredFrontPTO;
  int sRequiredRearPTO;
  int sRequiredFrontHitch;
  int sRequiredRearHitch;
  int sRequiredVehicleSpeed;
  int sRequiredExtGuidance;
  int sRequiredFrontTopLinkage;
  int sRequiredRearTopLinkage;
  
  // Values for the first Function Request (to transit from 'automation pending' to 'active not limited')
}

on start
{
  snprintf(sPanelNameClient, elcount(sPanelNameClient), "TIM Client %d", sClientNumber);
  snprintf(sClientName, elcount(sClientName), "TIM Client %d", sClientNumber);
  snprintf(sPanelNameAuxValves, elcount(sPanelNameAuxValves), "TIM Client %d Auxiliary Valves", sClientNumber);
  snprintf(sClientNamespace, elcount(sClientNamespace), "TIMClient%d", sClientNumber);
  

  sysSetVariableInt(sysvar::svStart, 0);
  @svTIMClientFreezeState = 0;
  
  ConnectSysVarsToFunctionState();

  Iso11783IL_SetVerbosity(cVerbosityErrorsAndWarnings);
  
  ReflectRequiredFacilitiesByVisibility_Reset();
  
  Plugin_OnStart();
  
//  UpdateTextColor("TIM Client 1", "btnRearPTO_EngagementCCW", 0);
}

/*
 Values for the first Function Request (to transit from 'automation pending' to 'active not limited')
*/
void InitFunctionValues()
{
  @Functions::AuxValve01::svValue = 0;
  @Functions::AuxValve02::svValue = 0;
  @Functions::AuxValve03::svValue = 0;
  @Functions::AuxValve04::svValue = 0;
  @Functions::AuxValve05::svValue = 0;
  @Functions::AuxValve06::svValue = 0;
  @Functions::AuxValve07::svValue = 0;
  @Functions::AuxValve08::svValue = 0;
  @Functions::AuxValve09::svValue = 0;
  @Functions::AuxValve10::svValue = 0;
  @Functions::AuxValve11::svValue = 0;
  @Functions::AuxValve12::svValue = 0;
  @Functions::AuxValve13::svValue = 0;
  @Functions::AuxValve14::svValue = 0;
  @Functions::AuxValve15::svValue = 0;
  @Functions::AuxValve16::svValue = 0;
  @Functions::AuxValve17::svValue = 0;
  @Functions::AuxValve18::svValue = 0;
  @Functions::AuxValve19::svValue = 0;
  @Functions::AuxValve20::svValue = 0;
  @Functions::AuxValve21::svValue = 0;
  @Functions::AuxValve22::svValue = 0;
  @Functions::AuxValve23::svValue = 0;
  @Functions::AuxValve24::svValue = 0;
  @Functions::AuxValve25::svValue = 0;
  @Functions::AuxValve26::svValue = 0;
  @Functions::AuxValve27::svValue = 0;
  @Functions::AuxValve28::svValue = 0;
  @Functions::AuxValve29::svValue = 0;
  @Functions::AuxValve30::svValue = 0;
  @Functions::AuxValve31::svValue = 0;
  @Functions::AuxValve32::svValue = 0;
  @Functions::FrontPTO::svSpeed   = 0;
  @Functions::RearPTO::svSpeed    = 0;
  @Functions::VehicleSpeed::svValue= 0;
  @Functions::ExtGuidance::svCurvature = 0;
  
  @Functions::FrontHitch::svPosition      = 0;  // full lower hitch
  @Functions::RearHitch::svPosition       = 0;  // full lower hitch
  @Functions::FrontTopLinkage::svPosition = 0;  //fully retracted top linkage
  @Functions::RearTopLinkage::svPosition  = 0;  //fully retracted top linkage
}

on sysvar sysvar::ILState
{
  if (sAutoStart && @this == 2) //Online
  {
    if(@svIdentifyTIMServerByAddress == 0)
      Iso11783IL_TIMConnectToServer(TIMServer);
    else
      Iso11783IL_TIMConnectToServer(@svAddressOfTIMServer);
  }
}

/*
*/
on pg 0x2400 //TIM21
{
  if(this.sa != Iso11783IL_GetAddress()) //is not my message
  {
    return;
  }
  if(this.byte(0) > 0xEF)
  {
    return; //it isn't a function id
  }
  if((this.byte(1) & 0xF0) != 0)  //TIM Function Request
  {
    return;
  }
  {
    byte functionId;
    dword functionState;
    functionId = this.byte(0);
    Iso11783IL_TIMGetFunctionState(functionId, functionState);
    if(functionState != cAutomationPending)
    {
      return;
    }
    if(functionId <= 32)
    {
      EnableControls_AuxValve(functionId, 1);
    }
    else
    {
      switch(functionId)
      {
        case cFrontPTO:         EnableControls_FrontPTO(1);         break;
        case cRearPTO:          EnableControls_RearPTO(1);          break;
        case cFrontHitch:       EnableControls_FrontHitch(1);       break;
        case cRearHitch:        EnableControls_RearHitch(1);        break;
        case cVehicleSpeed:     EnableControls_VehicleSpeed(1);     break;
        case cExternalGuidance: EnableControls_ExtGuidance(1);      break;
        case cFrontTopLinkage:  EnableControls_FrontTopLinkage(1);  break;
        case cRearTopLinkage:   EnableControls_RearTopLinkage(1);   break;
      }
    }
    EnableAssignOrUnassign(functionId, 0); 
  }
}

/*
*/
on pg 0x3d00 //TIM21_CS
{
  if(this.sa != Iso11783IL_GetAddress()) //is not my message
  {
    return;
  }
  if(this.byte(1) != 0x11)  //request
  {
    return;
  }
  {
    byte functionId;
    dword functionState;
    functionId = this.byte(0);
    Iso11783IL_TIMGetFunctionState(functionId, functionState);
    if(functionState != cAutomationPending)
    {
      return;
    }
    if(functionId <= 32)
    {
      EnableControls_AuxValve(functionId, 1);
    }
    else
    {
      switch(functionId)
      {
        case cFrontPTO:         EnableControls_FrontPTO(1);         break;
        case cRearPTO:          EnableControls_RearPTO(1);          break;
        case cFrontHitch:       EnableControls_FrontHitch(1);       break;
        case cRearHitch:        EnableControls_RearHitch(1);        break;
        case cVehicleSpeed:     EnableControls_VehicleSpeed(1);     break;
        case cExternalGuidance: EnableControls_ExtGuidance(1);      break;
        case cFrontTopLinkage:  EnableControls_FrontTopLinkage(1);  break;
        case cRearTopLinkage:   EnableControls_RearTopLinkage(1);   break;
      }
    }
    EnableAssignOrUnassign(functionId, 0); 
  }
}

on sysvar sysvar::svStart
{
  if(@this > 0)
  {
    Iso11783IL_TIMSetProperty("enableDemoMode", @svDemoModeActive);
    if(@svDemoModeActive == 1)
    {
      writeEx(0, 2, "\n%s: Demo mode is activated (Certificates and keys are not validated)", sClientName);
    }
    InitFunctionValues();
    EnableSettingsControls(0);
    StartClient();
    AdjustControlVisibilityAccordingToVersion(0);
  }
  else
  {
    StopClient();
    EnableSettingsControls(1);
    AdjustControlVisibilityAccordingToVersion(1);
  }
  setDefaultControlColors(sPanelNameClient, "btnOperatorEnable");
  setDefaultControlColors(sPanelNameClient, "txtActivateFunctions");
  
}

on preStop
{
  EnableSettingsControls(1);
  ReflectRequiredFacilitiesByVisibility_Reset();  
  EnableAllFunctionGroups(1);
  setDefaultControlColors(sPanelNameClient, "btnOperatorEnable");
  setDefaultControlColors(sPanelNameClient, "txtActivateFunctions");
  @svStart = 0;
}

void AdjustControlVisibilityAccordingToVersion(word visible)
{
  if(@svImplementedVersion < 2)
  {
    SetControlVisibility(sPanelNameClient, "grpReqFacilities_FTL", visible);
    SetControlVisibility(sPanelNameClient, "grpReqFacilities_RTL", visible);
    SetControlVisibility(sPanelNameClient, "cbChangeOfDirection", visible);
    SetControlVisibility(sPanelNameClient, "grpFrontTopLinkage", visible);
    SetControlVisibility(sPanelNameClient, "grpRearTopLinkage", visible);
  }
}


void EnableSettingsControls(word enable) 
{
  char varNameWithNamespace[100];
  snprintf(varNameWithNamespace, elcount(varNameWithNamespace), "%s::svTIMClientState", sClientNamespace);
  
  EnableControl(sPanelNameClient, "grpCertSequence", enable);
  EnableControl(sPanelNameClient, "grpNumOfCertRequestsToIgnore", enable);
  EnableControl(sPanelNameClient, "grpDeactivatedChecks", enable);
  
  EnableControl(sPanelNameClient, "gbCertificates", enable);
  EnableControl(sPanelNameClient, "gbComplianceInformation", enable);
  EnableControl(sPanelNameClient, "gbRequiredFacilities", enable);
  EnableControl(sPanelNameClient, "ioMinVersion", enable);
  EnableControl(sPanelNameClient, "ioImplVersion", enable);
  EnableControl(sPanelNameClient, "cbServerMaster", enable);
  EnableControl(sPanelNameClient, "ioProductId", enable);
  EnableControl(sPanelNameClient, "ioBootTime", enable);
  EnableControl(sPanelNameClient, "ioMinAuthVersion", enable);
  EnableControl(sPanelNameClient, "ioImplAuthVersion", enable);
}

on sysvar sysvar::svReconnectClientToServer
{
  if(@this > 0)
  {
    ReconnectClientToServer();
  }
}

on sysvar sysvar::svRestartAuthentication
{
  if(@this > 0)
  {
    if(@svIdentifyTIMServerByAddress == 0)
      Iso11783IL_TIMRestartAuthentication(TIMServer);
    else
      Iso11783IL_TIMRestartAuthentication(@svAddressOfTIMServer);
  }
}

on sysvar sysvar::svOperatorEnable
{
  if(@this == 0)
  {
    if(@svIdentifyTIMServerByAddress == 0)
      Iso11783IL_TIMOperatorEnable(TIMServer);
    else
      Iso11783IL_TIMOperatorEnable(@svAddressOfTIMServer);
  }
  setDefaultControlColors(sPanelNameClient, "btnOperatorEnable");
}

on sysvar sysvar::svStoreLwAKeyTable
{
  if(@this > 0)
  {
    Iso11783IL_TIMSaveLwATable(sLwATableFile);
  }
}

on sysvar sysvar::svClearLwAKeyTable
{
  if(@this > 0)
  {
    Iso11783IL_TIMClearLwATable();
    Iso11783IL_TIMSaveLwATable(sLwATableFile);
  }
}

on sysvar sysvar::svContinue
{
  if(@this > 0)
  {
    if(@svIdentifyTIMServerByAddress == 0)
      Iso11783IL_TIMContinueConnection(TIMServer);
    else
      Iso11783IL_TIMContinueConnection(@svAddressOfTIMServer);
  } 
}

on sysvar sysvar::svContinueAndFreeze
{
  if(@this > 0)
  {
    if(@svIdentifyTIMServerByAddress == 0)
      Iso11783IL_TIMContinueConnection(TIMServer);
    else
      Iso11783IL_TIMContinueConnection(@svAddressOfTIMServer);
  } 
  
  // set new freeze state if state has been changed
  if (@svTIMClientFreezeState > 0)
  {
    if(@svIdentifyTIMServerByAddress == 0)
      Iso11783IL_TIMFreezeConnection(TIMServer, @svTIMClientFreezeState);
    else
      Iso11783IL_TIMFreezeConnection(@svAddressOfTIMServer, @svTIMClientFreezeState);
  }
}

on sysvar sysvar::svDisableNameCheck
{
  UpdateDeactivatedCertificateChecks();
}

on sysvar sysvar::svDisableICCCheck
{
  UpdateDeactivatedCertificateChecks();
}

on sysvar sysvar::svDisableFctCapabilitiesCheck
{
  UpdateDeactivatedCertificateChecks();
}

on sysvar sysvar::svDisableCRLCheck
{
  UpdateDeactivatedCertificateChecks();
}

on sysvar sysvar::svDisableCertificateTypeCheck
{
  UpdateDeactivatedCertificateChecks();
}

/*
*/
void HighlightOperatorEnableButtonIfNecessary()
{
  if(@svAssignAllFunctionsAutomatically != 0)
  {
    return;
  }
  if(@svTIMClientState != @svTIMClientState::AuthenticationSucceed)
  {
    return;
  }
  ActivateControlColors(sPanelNameClient, "btnOperatorEnable");
}

////////////////////////////////////////////////////////
//            Rear PTO                               //
////////////////////////////////////////////////////////

on sysvar sysvar::Functions::RearPTO::svAssignFct
{
  if (@this == 0)
  {
    AssignFunction(cRearPTO);
    EnableAssignOrUnassign(cRearPTO, 0);    
    HighlightOperatorEnableButtonIfNecessary();
  }
}

on sysvar sysvar::Functions::RearPTO::svUnassignFct
{
  if (@this == 0)
  {
    Iso11783IL_TIMUnassignFunction(cRearPTO);  
    EnableAssignOrUnassign(cRearPTO, 1);
    EnableControls_RearPTO(0);
  }
}

on sysvar sysvar::Functions::RearPTO::svReleaseControl
{
  if (@this == 1)
  {
    Iso11783IL_TIMFunctionRequest(cRearPTO, cReleasedControlRequestingOperator);   
  }
  else
  {
    Iso11783IL_TIMFunctionRequest(cRearPTO, cReadyToControl);   
  }
}

on sysvar sysvar::Functions::RearPTO::svSpeed
{
  int result;
  
  result = SetPTOSpeed(cRearPTO, @this);
  if(result != 0)    
    writeLineEx(cWriteTargetCaplPage, cWriteSeverityError, "%s: Failed to set Rear PTO to %f 1/min", sClientName, @this);
}

on sysvar sysvar::Functions::RearPTO::svEngagement
{
  if(Iso11783IL_TIMFunctionRequest(cRearPTO, 0xFB00 ) != 0)
  {
    writeLineEx(cWriteTargetCaplPage, cWriteSeverityError, "%s: Failed to set Rear PTO to 0xFB00 (PTO on, Speed clockwise set by TIM Server)", sClientName);
  }
}

on sysvar sysvar::Functions::RearPTO::svEngagementCCW
{
  if(Iso11783IL_TIMFunctionRequest(cRearPTO, 0x0 ) != 0)
  {
    writeLineEx(cWriteTargetCaplPage, cWriteSeverityError, "%s: Failed to set Rear PTO to 0x0 (PTO on, Speed counter-clockwise set by TIM Server)", sClientName);
  }
}

on sysvar sysvar::Functions::RearPTO::svDisengagement
{
  if(Iso11783IL_TIMFunctionRequest(cRearPTO, 0x7D80 ) != 0)
  {
    writeLineEx(cWriteTargetCaplPage, cWriteSeverityError, "%s: Failed to set Rear PTO to 0x7D80 (PTO off)", sClientName);
  }
}


////////////////////////////////////////////////////////
//            Front PTO                               //
////////////////////////////////////////////////////////

on sysvar sysvar::Functions::FrontPTO::svAssignFct
{
  if (@this == 0)
  {
    AssignFunction(cFrontPTO);
    EnableAssignOrUnassign(cFrontPTO, 0);
  }
}

on sysvar sysvar::Functions::FrontPTO::svUnassignFct
{
  if (@this == 0)
  {
    Iso11783IL_TIMUnassignFunction(cFrontPTO);    
    EnableAssignOrUnassign(cFrontPTO, 1);
    EnableControls_FrontPTO(0);
  }
}

on sysvar sysvar::Functions::FrontPTO::svReleaseControl
{
  if (@this == 1)
  {
    Iso11783IL_TIMFunctionRequest(cFrontPTO, cReleasedControlRequestingOperator);   
  }
  else
  {
    Iso11783IL_TIMFunctionRequest(cFrontPTO, cReadyToControl);   
  }
}

on sysvar sysvar::Functions::FrontPTO::svSpeed
{
  int result;
  
  result = SetPTOSpeed(cFrontPTO, @this);
  if(result != 0)    
    writeLineEx(cWriteTargetCaplPage, cWriteSeverityError, "%s: Failed to set Front PTO to %f 1/min", sClientName, @this);
}

on sysvar sysvar::Functions::FrontPTO::svEngagement
{
  if(Iso11783IL_TIMFunctionRequest(cFrontPTO, 0xFB00 ) != 0)
  {
    writeLineEx(cWriteTargetCaplPage, cWriteSeverityError, "%s: Failed to set Front PTO to 0xFB00 (PTO on, Speed clockwise set by TIM Server)", sClientName);
  }
}

on sysvar sysvar::Functions::FrontPTO::svEngagementCCW
{
  if(Iso11783IL_TIMFunctionRequest(cFrontPTO, 0x0 ) != 0)
  {
    writeLineEx(cWriteTargetCaplPage, cWriteSeverityError, "%s: Failed to set Front PTO to 0x0 (PTO on, Speed counter-clockwise set by TIM Server)", sClientName);
  }
}

on sysvar sysvar::Functions::FrontPTO::svDisengagement
{
  if(Iso11783IL_TIMFunctionRequest(cFrontPTO, 0x7D80 ) != 0)
  {
    writeLineEx(cWriteTargetCaplPage, cWriteSeverityError, "%s: Failed to set Front PTO to 0x7D80 (PTO off)", sClientName);
  }
}

int SetPTOSpeed(int funcId, double physSpeed)
{
  int result;
  word rawValue;
  
  rawValue = (physSpeed + 4016.0) * 8;
  result = Iso11783IL_TIMFunctionRequest(funcId, rawValue );
  
  return result;
}


////////////////////////////////////////////////////////
//            Rear Hitch                              //
////////////////////////////////////////////////////////

on sysvar sysvar::Functions::RearHitch::svAssignFct
{
  if (@this == 0)
  {
    AssignFunction(cRearHitch);
    EnableAssignOrUnassign(cRearHitch, 0);
  }
}

on sysvar sysvar::Functions::RearHitch::svUnassignFct
{
  if (@this == 0)
  {
    Iso11783IL_TIMUnassignFunction(cRearHitch);    
    EnableAssignOrUnassign(cRearHitch, 1);
    EnableControls_RearHitch(0);
  }
}

on sysvar sysvar::Functions::RearHitch::svReleaseControl
{
  if (@this == 1)
  {
    Iso11783IL_TIMFunctionRequest(cRearHitch, cReleasedControlRequestingOperator);   
  }
  else
  {
    Iso11783IL_TIMFunctionRequest(cRearHitch, cReadyToControl);   
  }
}

on sysvar sysvar::Functions::RearHitch::svPosition
{
  int result;
  
  result = SetHitchPosition(cRearHitch, @this);
  if(result != 0)    
    writeLineEx(cWriteTargetCaplPage, cWriteSeverityError, "%s: Failed to set Rear Hitch to %f %%", sClientName, @this);
}

on sysvar sysvar::Functions::RearHitch::svFloat
{
  if(Iso11783IL_TIMFunctionRequest(cRearHitch, 0xFB00 ) != 0)
  {
    writeLineEx(cWriteTargetCaplPage, cWriteSeverityError, "%s: Failed to set Rear Hitch to 0xFB00 (Float)", sClientName);
  }
}

on sysvar sysvar::Functions::RearHitch::svStop
{
  if(Iso11783IL_TIMFunctionRequest(cRearHitch, 0xFB01 ) != 0)
  {
    writeLineEx(cWriteTargetCaplPage, cWriteSeverityError, "%s: Failed to set Rear Hitch to 0xFB01 (Stop)", sClientName);
  }
}

on sysvar sysvar::Functions::RearHitch::svLowerUntilStop
{
  if(Iso11783IL_TIMFunctionRequest(cRearHitch, 0xFB02 ) != 0)
  {
    writeLineEx(cWriteTargetCaplPage, cWriteSeverityError, "%s: Failed to set Rear Hitch to 0xFB02 (Lower until Stop request)", sClientName);
  }
}

on sysvar sysvar::Functions::RearHitch::svRaiseUntilStop
{
  if(Iso11783IL_TIMFunctionRequest(cRearHitch, 0xFB03 ) != 0)
  {
    writeLineEx(cWriteTargetCaplPage, cWriteSeverityError, "%s: Failed to set Rear Hitch to 0xFB03 (Raise until Stop request)", sClientName);
  }
}

////////////////////////////////////////////////////////
//            Front Hitch                              //
////////////////////////////////////////////////////////

on sysvar sysvar::Functions::FrontHitch::svAssignFct
{
  if (@this == 0)
  {
    AssignFunction(cFrontHitch);
    EnableAssignOrUnassign(cFrontHitch, 0);
  }
}

on sysvar sysvar::Functions::FrontHitch::svUnassignFct
{
  if (@this == 0)
  {
    Iso11783IL_TIMUnassignFunction(cFrontHitch);  
    EnableAssignOrUnassign(cFrontHitch, 1);
    EnableControls_FrontHitch(0);
  }
}

on sysvar sysvar::Functions::FrontHitch::svReleaseControl
{
  if (@this == 1)
  {
    Iso11783IL_TIMFunctionRequest(cFrontHitch, cReleasedControlRequestingOperator);   
  }
  else
  {
    Iso11783IL_TIMFunctionRequest(cFrontHitch, cReadyToControl);   
  }
}

on sysvar sysvar::Functions::FrontHitch::svPosition
{
  int result;
  
  result = SetHitchPosition(cFrontHitch, @this);
  if(result != 0)    
    writeLineEx(cWriteTargetCaplPage, cWriteSeverityError, "%s: Failed to set Front Hitch to %f %%", sClientName, @this);
}

on sysvar sysvar::Functions::FrontHitch::svFloat
{
  if(Iso11783IL_TIMFunctionRequest(cFrontHitch, 0xFB00 ) != 0)
  {
    writeLineEx(cWriteTargetCaplPage, cWriteSeverityError, "%s: Failed to set Front Hitch to 0xFB00 (Float)", sClientName);
  }
}

on sysvar sysvar::Functions::FrontHitch::svStop
{
  if(Iso11783IL_TIMFunctionRequest(cFrontHitch, 0xFB01 ) != 0)
  {
    writeLineEx(cWriteTargetCaplPage, cWriteSeverityError, "%s: Failed to set Front Hitch to 0xFB01 (Stop)", sClientName);
  }
}

on sysvar sysvar::Functions::FrontHitch::svLowerUntilStop
{
  if(Iso11783IL_TIMFunctionRequest(cFrontHitch, 0xFB02 ) != 0)
  {
    writeLineEx(cWriteTargetCaplPage, cWriteSeverityError, "%s: Failed to set Front Hitch to 0xFB02 (Lower until Stop request)", sClientName);
  }
}

on sysvar sysvar::Functions::FrontHitch::svRaiseUntilStop
{
  if(Iso11783IL_TIMFunctionRequest(cFrontHitch, 0xFB03 ) != 0)
  {
    writeLineEx(cWriteTargetCaplPage, cWriteSeverityError, "%s: Failed to set Front Hitch to 0xFB03 (Raise until Stop request)", sClientName);
  }
}


int SetHitchPosition(int funcId, double hitchPos)
{
  int result;
  word rawValue;
  
  rawValue = hitchPos * 100.0;
  result = Iso11783IL_TIMFunctionRequest(funcId, rawValue );
  
  return result;
}

int SetHitchState(int funcId, word hitchState)
{
  return Iso11783IL_TIMFunctionRequest(funcId, hitchState);
}


///////////////////////////////////////////////////////////////////
// Aux Valve 1                                                   //
///////////////////////////////////////////////////////////////////

on sysvar sysvar::Functions::AuxValve01::svAssignFct
{
  if (@this == 0)
  {
    AssignFunction(cAuxValve01);
    EnableAssignOrUnassign(cAuxValve01, 0);
  }
}

on sysvar sysvar::Functions::AuxValve01::svUnassignFct
{
  if (@this == 0)
  {
    Iso11783IL_TIMUnassignFunction(cAuxValve01);  
    EnableAssignOrUnassign(cAuxValve01, 1);
    EnableControls_AuxValve(1, 0);
  }
}

on sysvar sysvar::Functions::AuxValve01::svReleaseControl
{
  if (@this == 1)
  {
    Iso11783IL_TIMFunctionRequest(cAuxValve01, cReleasedControlRequestingOperator);   
  }
  else
  {
    Iso11783IL_TIMFunctionRequest(cAuxValve01, cReadyToControl);   
  }
}

on sysvar sysvar::Functions::AuxValve01::svValue
{
  int result;
  
  result = SetCurrentAuxValveFlow(cAuxValve01, @this);
  if(result != 0)    
    writeLineEx(cWriteTargetCaplPage, cWriteSeverityError, "%s: Failed to set AuxValve01 to %f %%", sClientName, @this);
}

on sysvar sysvar::Functions::AuxValve01::svFullyOpenedExtend
{
  if(Iso11783IL_TIMFunctionRequest(cAuxValve01, 0x0 ) != 0)
  {
    writeLineEx(cWriteTargetCaplPage, cWriteSeverityError, "%s: Failed to set AuxValve01 to 0x0 (Fully Opened, Extend)", sClientName);
  }
}

on sysvar sysvar::Functions::AuxValve01::svBlock
{
  if(Iso11783IL_TIMFunctionRequest(cAuxValve01, 0x7D80 ) != 0)
  {
    writeLineEx(cWriteTargetCaplPage, cWriteSeverityError, "%s: Failed to set AuxValve01 to 0x7D80 (Block)", sClientName);
  }
}

on sysvar sysvar::Functions::AuxValve01::svFullyOpenedRetract
{
  if(Iso11783IL_TIMFunctionRequest(cAuxValve01, 0xFB00 ) != 0)
  {
    writeLineEx(cWriteTargetCaplPage, cWriteSeverityError, "%s: Failed to set AuxValve01 to 0xFB00 (Fully Opened, Retract)", sClientName);
  }
}

on sysvar sysvar::Functions::AuxValve01::svFloat
{
  if(Iso11783IL_TIMFunctionRequest(cAuxValve01, 0xFB01 ) != 0)
  {
    writeLineEx(cWriteTargetCaplPage, cWriteSeverityError, "%s: Failed to set AuxValve01 to 0xFB01 (Float)", sClientName);
  }
}

///////////////////////////////////////////////////////////////////
// Aux Valve 2                                                   //
///////////////////////////////////////////////////////////////////

on sysvar sysvar::Functions::AuxValve02::svAssignFct
{
  if (@this == 0)
  {
    AssignFunction(cAuxValve02);
    EnableAssignOrUnassign(cAuxValve02, 0);
  }
}

on sysvar sysvar::Functions::AuxValve02::svUnassignFct
{
  if (@this == 0)
  {
    Iso11783IL_TIMUnassignFunction(cAuxValve02);     
    EnableAssignOrUnassign(cAuxValve02, 1);
    EnableControls_AuxValve(2, 0);
  }
}

on sysvar sysvar::Functions::AuxValve02::svReleaseControl
{
  if (@this)
  {
    Iso11783IL_TIMFunctionRequest(cAuxValve02, cReleasedControlRequestingOperator);   
  }
  else
  {
    Iso11783IL_TIMFunctionRequest(cAuxValve02, cReadyToControl);   
  }
}

on sysvar sysvar::Functions::AuxValve02::svValue
{
  int result;
  
  result = SetCurrentAuxValveFlow(cAuxValve02, @this);
  if(result != 0)    
    writeLineEx(cWriteTargetCaplPage, cWriteSeverityError, "%s: Failed to set AuxValve2 to %f %%", sClientName, @this);
}

on sysvar sysvar::Functions::AuxValve02::svFullyOpenedExtend
{
  if(Iso11783IL_TIMFunctionRequest(cAuxValve02, 0x0 ) != 0)
  {
    writeLineEx(cWriteTargetCaplPage, cWriteSeverityError, "%s: Failed to set AuxValve02 to 0x0 (Fully Opened, Extend)", sClientName);
  }
}

on sysvar sysvar::Functions::AuxValve02::svBlock
{
  if(Iso11783IL_TIMFunctionRequest(cAuxValve02, 0x7D80 ) != 0)
  {
    writeLineEx(cWriteTargetCaplPage, cWriteSeverityError, "%s: Failed to set AuxValve02 to 0x7D80 (Block)", sClientName);
  }
}

on sysvar sysvar::Functions::AuxValve02::svFullyOpenedRetract
{
  if(Iso11783IL_TIMFunctionRequest(cAuxValve02, 0xFB00 ) != 0)
  {
    writeLineEx(cWriteTargetCaplPage, cWriteSeverityError, "%s: Failed to set AuxValve02 to 0xFB00 (Fully Opened, Retract)", sClientName);
  }
}

on sysvar sysvar::Functions::AuxValve02::svFloat
{
  if(Iso11783IL_TIMFunctionRequest(cAuxValve02, 0xFB01 ) != 0)
  {
    writeLineEx(cWriteTargetCaplPage, cWriteSeverityError, "%s: Failed to set AuxValve02 to 0xFB01 (Float)", sClientName);
  }
}

///////////////////////////////////////////////////////////////////
// Aux Valve 3                                                   //
///////////////////////////////////////////////////////////////////

on sysvar sysvar::Functions::AuxValve03::svAssignFct
{
  if (@this == 0)
  {
    AssignFunction(cAuxValve03);
    EnableAssignOrUnassign(cAuxValve03, 0);
  }
}

on sysvar sysvar::Functions::AuxValve03::svUnassignFct
{
  if (@this == 0)
  {
    Iso11783IL_TIMUnassignFunction(cAuxValve03);   
    EnableAssignOrUnassign(cAuxValve03, 1);
    EnableControls_AuxValve(3, 0);
  }
}

on sysvar sysvar::Functions::AuxValve03::svReleaseControl
{
  if (@this)
  {
    Iso11783IL_TIMFunctionRequest(cAuxValve03, cReleasedControlRequestingOperator);   
  }
  else
  {
    Iso11783IL_TIMFunctionRequest(cAuxValve03, cReadyToControl);   
  }
}

on sysvar sysvar::Functions::AuxValve03::svValue
{
  int result;
  
  result = SetCurrentAuxValveFlow(cAuxValve03, @this);
  if(result != 0)    
    writeLineEx(cWriteTargetCaplPage, cWriteSeverityError, "%s: Failed to set AuxValve3 to %f %%", sClientName, @this);
}

on sysvar sysvar::Functions::AuxValve03::svFullyOpenedExtend
{
  if(Iso11783IL_TIMFunctionRequest(cAuxValve03, 0x0 ) != 0)
  {
    writeLineEx(cWriteTargetCaplPage, cWriteSeverityError, "%s: Failed to set AuxValve03 to 0x0 (Fully Opened, Extend)", sClientName);
  }
}

on sysvar sysvar::Functions::AuxValve03::svBlock
{
  if(Iso11783IL_TIMFunctionRequest(cAuxValve03, 0x7D80 ) != 0)
  {
    writeLineEx(cWriteTargetCaplPage, cWriteSeverityError, "%s: Failed to set AuxValve03 to 0x7D80 (Block)", sClientName);
  }
}

on sysvar sysvar::Functions::AuxValve03::svFullyOpenedRetract
{
  if(Iso11783IL_TIMFunctionRequest(cAuxValve03, 0xFB00 ) != 0)
  {
    writeLineEx(cWriteTargetCaplPage, cWriteSeverityError, "%s: Failed to set AuxValve03 to 0xFB00 (Fully Opened, Retract)", sClientName);
  }
}

on sysvar sysvar::Functions::AuxValve03::svFloat
{
  if(Iso11783IL_TIMFunctionRequest(cAuxValve03, 0xFB01 ) != 0)
  {
    writeLineEx(cWriteTargetCaplPage, cWriteSeverityError, "%s: Failed to set AuxValve03 to 0xFB01 (Float)", sClientName);
  }
}

///////////////////////////////////////////////////////////////////
// Aux Valve 4                                                   //
///////////////////////////////////////////////////////////////////

on sysvar sysvar::Functions::AuxValve04::svAssignFct
{
  if (@this == 0)
  {
    AssignFunction(cAuxValve04);
    EnableAssignOrUnassign(cAuxValve04, 0);
  }
}

on sysvar sysvar::Functions::AuxValve04::svUnassignFct
{
  if (@this == 0)
  {
    Iso11783IL_TIMUnassignFunction(cAuxValve04);       
    EnableAssignOrUnassign(cAuxValve04, 1);
    EnableControls_AuxValve(4, 0);
  }
}

on sysvar sysvar::Functions::AuxValve04::svReleaseControl
{
  if (@this)
  {
    Iso11783IL_TIMFunctionRequest(cAuxValve04, cReleasedControlRequestingOperator);   
  }
  else
  {
    Iso11783IL_TIMFunctionRequest(cAuxValve04, cReadyToControl);   
  }
}

on sysvar sysvar::Functions::AuxValve04::svValue
{
  int result;
  
  result = SetCurrentAuxValveFlow(cAuxValve04, @this);
  if(result != 0)    
    writeLineEx(cWriteTargetCaplPage, cWriteSeverityError, "%s: Failed to set AuxValve4 to %f %%", sClientName, @this);
}

on sysvar sysvar::Functions::AuxValve04::svFullyOpenedExtend
{
  if(Iso11783IL_TIMFunctionRequest(cAuxValve04, 0x0 ) != 0)
  {
    writeLineEx(cWriteTargetCaplPage, cWriteSeverityError, "%s: Failed to set AuxValve04 to 0x0 (Fully Opened, Extend)", sClientName);
  }
}

on sysvar sysvar::Functions::AuxValve04::svBlock
{
  if(Iso11783IL_TIMFunctionRequest(cAuxValve04, 0x7D80 ) != 0)
  {
    writeLineEx(cWriteTargetCaplPage, cWriteSeverityError, "%s: Failed to set AuxValve04 to 0x7D80 (Block)", sClientName);
  }
}

on sysvar sysvar::Functions::AuxValve04::svFullyOpenedRetract
{
  if(Iso11783IL_TIMFunctionRequest(cAuxValve04, 0xFB00 ) != 0)
  {
    writeLineEx(cWriteTargetCaplPage, cWriteSeverityError, "%s: Failed to set AuxValve04 to 0xFB00 (Fully Opened, Retract)", sClientName);
  }
}

on sysvar sysvar::Functions::AuxValve04::svFloat
{
  if(Iso11783IL_TIMFunctionRequest(cAuxValve04, 0xFB01 ) != 0)
  {
    writeLineEx(cWriteTargetCaplPage, cWriteSeverityError, "%s: Failed to set AuxValve04 to 0xFB01 (Float)", sClientName);
  }
}

///////////////////////////////////////////////////////////////////
// Aux Valve 1                                                   //
///////////////////////////////////////////////////////////////////

on sysvar sysvar::Functions::AuxValve05::svAssignFct
{
  if (@this == 0)
  {
    AssignFunction(cAuxValve05);
    EnableAssignOrUnassign(cAuxValve05, 0);
  }
}

on sysvar sysvar::Functions::AuxValve05::svUnassignFct
{
  if (@this == 0)
  {
    Iso11783IL_TIMUnassignFunction(cAuxValve05);       
    EnableAssignOrUnassign(cAuxValve05, 1); 
    EnableControls_AuxValve(5, 0);
  }
}

on sysvar sysvar::Functions::AuxValve05::svReleaseControl
{
  if (@this == 1)
  {
    Iso11783IL_TIMFunctionRequest(cAuxValve05, cReleasedControlRequestingOperator);   
  }
  else
  {
    Iso11783IL_TIMFunctionRequest(cAuxValve05, cReadyToControl);   
  }
}

on sysvar sysvar::Functions::AuxValve05::svValue
{
  int result;
  
  result = SetCurrentAuxValveFlow(cAuxValve05, @this);
  if(result != 0)    
    writeLineEx(cWriteTargetCaplPage, cWriteSeverityError, "%s: Failed to set AuxValve05 to %f %%", sClientName, @this);
}

on sysvar sysvar::Functions::AuxValve05::svFullyOpenedExtend
{
  if(Iso11783IL_TIMFunctionRequest(cAuxValve05, 0x0 ) != 0)
  {
    writeLineEx(cWriteTargetCaplPage, cWriteSeverityError, "%s: Failed to set AuxValve05 to 0x0 (Fully Opened, Extend)", sClientName);
  }
}

on sysvar sysvar::Functions::AuxValve05::svBlock
{
  if(Iso11783IL_TIMFunctionRequest(cAuxValve05, 0x7D80 ) != 0)
  {
    writeLineEx(cWriteTargetCaplPage, cWriteSeverityError, "%s: Failed to set AuxValve05 to 0x7D80 (Block)", sClientName);
  }
}

on sysvar sysvar::Functions::AuxValve05::svFullyOpenedRetract
{
  if(Iso11783IL_TIMFunctionRequest(cAuxValve05, 0xFB00 ) != 0)
  {
    writeLineEx(cWriteTargetCaplPage, cWriteSeverityError, "%s: Failed to set AuxValve05 to 0xFB00 (Fully Opened, Retract)", sClientName);
  }
}

on sysvar sysvar::Functions::AuxValve05::svFloat
{
  if(Iso11783IL_TIMFunctionRequest(cAuxValve05, 0xFB01 ) != 0)
  {
    writeLineEx(cWriteTargetCaplPage, cWriteSeverityError, "%s: Failed to set AuxValve05 to 0xFB01 (Float)", sClientName);
  }
}

///////////////////////////////////////////////////////////////////
// Aux Valve 6                                                   //
///////////////////////////////////////////////////////////////////

on sysvar sysvar::Functions::AuxValve06::svAssignFct
{
  if (@this == 0)
  {
    AssignFunction(cAuxValve06);
    EnableAssignOrUnassign(cAuxValve06, 0);
  }
}

on sysvar sysvar::Functions::AuxValve06::svUnassignFct
{
  if (@this == 0)
  {
    Iso11783IL_TIMUnassignFunction(cAuxValve06);  
    EnableAssignOrUnassign(cAuxValve06, 1);
    EnableControls_AuxValve(6, 0);
  }
}

on sysvar sysvar::Functions::AuxValve06::svReleaseControl
{
  if (@this == 1)
  {
    Iso11783IL_TIMFunctionRequest(cAuxValve06, cReleasedControlRequestingOperator);   
  }
  else
  {
    Iso11783IL_TIMFunctionRequest(cAuxValve06, cReadyToControl);   
  }
}

on sysvar sysvar::Functions::AuxValve06::svValue
{
  int result;
  
  result = SetCurrentAuxValveFlow(cAuxValve06, @this);
  if(result != 0)    
    writeLineEx(cWriteTargetCaplPage, cWriteSeverityError, "%s: Failed to set AuxValve06 to %f %%", sClientName, @this);
}

on sysvar sysvar::Functions::AuxValve06::svFullyOpenedExtend
{
  if(Iso11783IL_TIMFunctionRequest(cAuxValve06, 0x0 ) != 0)
  {
    writeLineEx(cWriteTargetCaplPage, cWriteSeverityError, "%s: Failed to set AuxValve06 to 0x0 (Fully Opened, Extend)", sClientName);
  }
}

on sysvar sysvar::Functions::AuxValve06::svBlock
{
  if(Iso11783IL_TIMFunctionRequest(cAuxValve06, 0x7D80 ) != 0)
  {
    writeLineEx(cWriteTargetCaplPage, cWriteSeverityError, "%s: Failed to set AuxValve06 to 0x7D80 (Block)", sClientName);
  }
}

on sysvar sysvar::Functions::AuxValve06::svFullyOpenedRetract
{
  if(Iso11783IL_TIMFunctionRequest(cAuxValve06, 0xFB00 ) != 0)
  {
    writeLineEx(cWriteTargetCaplPage, cWriteSeverityError, "%s: Failed to set AuxValve06 to 0xFB00 (Fully Opened, Retract)", sClientName);
  }
}

on sysvar sysvar::Functions::AuxValve06::svFloat
{
  if(Iso11783IL_TIMFunctionRequest(cAuxValve06, 0xFB01 ) != 0)
  {
    writeLineEx(cWriteTargetCaplPage, cWriteSeverityError, "%s: Failed to set AuxValve06 to 0xFB01 (Float)", sClientName);
  }
}

///////////////////////////////////////////////////////////////////
// Aux Valve 7                                                 //
///////////////////////////////////////////////////////////////////

on sysvar sysvar::Functions::AuxValve07::svAssignFct
{
  if (@this == 0)
  {
    AssignFunction(cAuxValve07);
    EnableAssignOrUnassign(cAuxValve07, 0);
  }
}

on sysvar sysvar::Functions::AuxValve07::svUnassignFct
{
  if (@this == 0)
  {
    Iso11783IL_TIMUnassignFunction(cAuxValve07);    
    EnableAssignOrUnassign(cAuxValve07, 1);
    EnableControls_AuxValve(7, 0);
  }
}

on sysvar sysvar::Functions::AuxValve07::svReleaseControl
{
  if (@this == 1)
  {
    Iso11783IL_TIMFunctionRequest(cAuxValve07, cReleasedControlRequestingOperator);   
  }
  else
  {
    Iso11783IL_TIMFunctionRequest(cAuxValve07, cReadyToControl);   
  }
}

on sysvar sysvar::Functions::AuxValve07::svValue
{
  int result;
  
  result = SetCurrentAuxValveFlow(cAuxValve07, @this);
  if(result != 0)    
    writeLineEx(cWriteTargetCaplPage, cWriteSeverityError, "%s: Failed to set AuxValve07 to %f %%", sClientName, @this);
}

on sysvar sysvar::Functions::AuxValve07::svFullyOpenedExtend
{
  if(Iso11783IL_TIMFunctionRequest(cAuxValve07, 0x0 ) != 0)
  {
    writeLineEx(cWriteTargetCaplPage, cWriteSeverityError, "%s: Failed to set AuxValve07 to 0x0 (Fully Opened, Extend)", sClientName);
  }
}

on sysvar sysvar::Functions::AuxValve07::svBlock
{
  if(Iso11783IL_TIMFunctionRequest(cAuxValve07, 0x7D80 ) != 0)
  {
    writeLineEx(cWriteTargetCaplPage, cWriteSeverityError, "%s: Failed to set AuxValve07 to 0x7D80 (Block)", sClientName);
  }
}

on sysvar sysvar::Functions::AuxValve07::svFullyOpenedRetract
{
  if(Iso11783IL_TIMFunctionRequest(cAuxValve07, 0xFB00 ) != 0)
  {
    writeLineEx(cWriteTargetCaplPage, cWriteSeverityError, "%s: Failed to set AuxValve07 to 0xFB00 (Fully Opened, Retract)", sClientName);
  }
}

on sysvar sysvar::Functions::AuxValve07::svFloat
{
  if(Iso11783IL_TIMFunctionRequest(cAuxValve07, 0xFB01 ) != 0)
  {
    writeLineEx(cWriteTargetCaplPage, cWriteSeverityError, "%s: Failed to set AuxValve07 to 0xFB01 (Float)", sClientName);
  }
}

///////////////////////////////////////////////////////////////////
// Aux Valve 8                                                   //
///////////////////////////////////////////////////////////////////

on sysvar sysvar::Functions::AuxValve08::svAssignFct
{
  if (@this == 0)
  {
    AssignFunction(cAuxValve08);
    EnableAssignOrUnassign(cAuxValve08, 0);
  }
}

on sysvar sysvar::Functions::AuxValve08::svUnassignFct
{
  if (@this == 0)
  {
    Iso11783IL_TIMUnassignFunction(cAuxValve08);  
    EnableAssignOrUnassign(cAuxValve08, 1);
    EnableControls_AuxValve(8, 0);
  }
}

on sysvar sysvar::Functions::AuxValve08::svReleaseControl
{
  if (@this == 1)
  {
    Iso11783IL_TIMFunctionRequest(cAuxValve08, cReleasedControlRequestingOperator);   
  }
  else
  {
    Iso11783IL_TIMFunctionRequest(cAuxValve08, cReadyToControl);   
  }
}

on sysvar sysvar::Functions::AuxValve08::svValue
{
  int result;
  
  result = SetCurrentAuxValveFlow(cAuxValve08, @this);
  if(result != 0)    
    writeLineEx(cWriteTargetCaplPage, cWriteSeverityError, "%s: Failed to set AuxValve08 to %f %%", sClientName, @this);
}

on sysvar sysvar::Functions::AuxValve08::svFullyOpenedExtend
{
  if(Iso11783IL_TIMFunctionRequest(cAuxValve08, 0x0 ) != 0)
  {
    writeLineEx(cWriteTargetCaplPage, cWriteSeverityError, "%s: Failed to set AuxValve08 to 0x0 (Fully Opened, Extend)", sClientName);
  }
}

on sysvar sysvar::Functions::AuxValve08::svBlock
{
  if(Iso11783IL_TIMFunctionRequest(cAuxValve08, 0x7D80 ) != 0)
  {
    writeLineEx(cWriteTargetCaplPage, cWriteSeverityError, "%s: Failed to set AuxValve08 to 0x7D80 (Block)", sClientName);
  }
}

on sysvar sysvar::Functions::AuxValve08::svFullyOpenedRetract
{
  if(Iso11783IL_TIMFunctionRequest(cAuxValve08, 0xFB00 ) != 0)
  {
    writeLineEx(cWriteTargetCaplPage, cWriteSeverityError, "%s: Failed to set AuxValve08 to 0xFB00 (Fully Opened, Retract)", sClientName);
  }
}

on sysvar sysvar::Functions::AuxValve08::svFloat
{
  if(Iso11783IL_TIMFunctionRequest(cAuxValve08, 0xFB01 ) != 0)
  {
    writeLineEx(cWriteTargetCaplPage, cWriteSeverityError, "%s: Failed to set AuxValve08 to 0xFB01 (Float)", sClientName);
  }
}

///////////////////////////////////////////////////////////////////
// Aux Valve 9                                                   //
///////////////////////////////////////////////////////////////////

on sysvar sysvar::Functions::AuxValve09::svAssignFct
{
  if (@this == 0)
  {
    AssignFunction(cAuxValve09);
    EnableAssignOrUnassign(cAuxValve09, 0);
  }
}

on sysvar sysvar::Functions::AuxValve09::svUnassignFct
{
  if (@this == 0)
  {
    Iso11783IL_TIMUnassignFunction(cAuxValve09);       
    EnableAssignOrUnassign(cAuxValve09, 1);
    EnableControls_AuxValve(9, 0);
  }
}

on sysvar sysvar::Functions::AuxValve09::svReleaseControl
{
  if (@this == 1)
  {
    Iso11783IL_TIMFunctionRequest(cAuxValve09, cReleasedControlRequestingOperator);   
  }
  else
  {
    Iso11783IL_TIMFunctionRequest(cAuxValve09, cReadyToControl);   
  }
}

on sysvar sysvar::Functions::AuxValve09::svValue
{
  int result;
  
  result = SetCurrentAuxValveFlow(cAuxValve09, @this);
  if(result != 0)    
    writeLineEx(cWriteTargetCaplPage, cWriteSeverityError, "%s: Failed to set AuxValve09 to %f %%", sClientName, @this);
}

on sysvar sysvar::Functions::AuxValve09::svFullyOpenedExtend
{
  if(Iso11783IL_TIMFunctionRequest(cAuxValve09, 0x0 ) != 0)
  {
    writeLineEx(cWriteTargetCaplPage, cWriteSeverityError, "%s: Failed to set AuxValve09 to 0x0 (Fully Opened, Extend)", sClientName);
  }
}

on sysvar sysvar::Functions::AuxValve09::svBlock
{
  if(Iso11783IL_TIMFunctionRequest(cAuxValve09, 0x7D80 ) != 0)
  {
    writeLineEx(cWriteTargetCaplPage, cWriteSeverityError, "%s: Failed to set AuxValve09 to 0x7D80 (Block)", sClientName);
  }
}

on sysvar sysvar::Functions::AuxValve09::svFullyOpenedRetract
{
  if(Iso11783IL_TIMFunctionRequest(cAuxValve09, 0xFB00 ) != 0)
  {
    writeLineEx(cWriteTargetCaplPage, cWriteSeverityError, "%s: Failed to set AuxValve09 to 0xFB00 (Fully Opened, Retract)", sClientName);
  }
}

on sysvar sysvar::Functions::AuxValve09::svFloat
{
  if(Iso11783IL_TIMFunctionRequest(cAuxValve09, 0xFB01 ) != 0)
  {
    writeLineEx(cWriteTargetCaplPage, cWriteSeverityError, "%s: Failed to set AuxValve09 to 0xFB01 (Float)", sClientName);
  }
}

///////////////////////////////////////////////////////////////////
// Aux Valve 10                                                  //
///////////////////////////////////////////////////////////////////

on sysvar sysvar::Functions::AuxValve10::svAssignFct
{
  if (@this == 0)
  {
    AssignFunction(cAuxValve10);
    EnableAssignOrUnassign(cAuxValve10, 0);
  }
}

on sysvar sysvar::Functions::AuxValve10::svUnassignFct
{
  if (@this == 0)
  {
    Iso11783IL_TIMUnassignFunction(cAuxValve10);       
    EnableAssignOrUnassign(cAuxValve10, 1);
    EnableControls_AuxValve(10, 0);
  }
}

on sysvar sysvar::Functions::AuxValve10::svReleaseControl
{
  if (@this == 1)
  {
    Iso11783IL_TIMFunctionRequest(cAuxValve10, cReleasedControlRequestingOperator);   
  }
  else
  {
    Iso11783IL_TIMFunctionRequest(cAuxValve10, cReadyToControl);   
  }
}

on sysvar sysvar::Functions::AuxValve10::svValue
{
  int result;
  
  result = SetCurrentAuxValveFlow(cAuxValve10, @this);
  if(result != 0)    
    writeLineEx(cWriteTargetCaplPage, cWriteSeverityError, "%s: Failed to set AuxValve10 to %f %%", sClientName, @this);
}

on sysvar sysvar::Functions::AuxValve10::svFullyOpenedExtend
{
  if(Iso11783IL_TIMFunctionRequest(cAuxValve10, 0x0 ) != 0)
  {
    writeLineEx(cWriteTargetCaplPage, cWriteSeverityError, "%s: Failed to set AuxValve10 to 0x0 (Fully Opened, Extend)", sClientName);
  }
}

on sysvar sysvar::Functions::AuxValve10::svBlock
{
  if(Iso11783IL_TIMFunctionRequest(cAuxValve10, 0x7D80 ) != 0)
  {
    writeLineEx(cWriteTargetCaplPage, cWriteSeverityError, "%s: Failed to set AuxValve10 to 0x7D80 (Block)", sClientName);
  }
}

on sysvar sysvar::Functions::AuxValve10::svFullyOpenedRetract
{
  if(Iso11783IL_TIMFunctionRequest(cAuxValve10, 0xFB00 ) != 0)
  {
    writeLineEx(cWriteTargetCaplPage, cWriteSeverityError, "%s: Failed to set AuxValve10 to 0xFB00 (Fully Opened, Retract)", sClientName);
  }
}

on sysvar sysvar::Functions::AuxValve10::svFloat
{
  if(Iso11783IL_TIMFunctionRequest(cAuxValve10, 0xFB01 ) != 0)
  {
    writeLineEx(cWriteTargetCaplPage, cWriteSeverityError, "%s: Failed to set AuxValve10 to 0xFB01 (Float)", sClientName);
  }
}

///////////////////////////////////////////////////////////////////
// Aux Valve 11                                                   //
///////////////////////////////////////////////////////////////////

on sysvar sysvar::Functions::AuxValve11::svAssignFct
{
  if (@this == 0)
  {
    AssignFunction(cAuxValve11);
    EnableAssignOrUnassign(cAuxValve11, 0);
  }
}

on sysvar sysvar::Functions::AuxValve11::svUnassignFct
{
  if (@this == 0)
  {
    Iso11783IL_TIMUnassignFunction(cAuxValve11); 
    EnableAssignOrUnassign(cAuxValve11, 1);
    EnableControls_AuxValve(11, 0);
  }
}

on sysvar sysvar::Functions::AuxValve11::svReleaseControl
{
  if (@this == 1)
  {
    Iso11783IL_TIMFunctionRequest(cAuxValve11, cReleasedControlRequestingOperator);   
  }
  else
  {
    Iso11783IL_TIMFunctionRequest(cAuxValve11, cReadyToControl);   
  }
}

on sysvar sysvar::Functions::AuxValve11::svValue
{
  int result;
  
  result = SetCurrentAuxValveFlow(cAuxValve11, @this);
  if(result != 0)    
    writeLineEx(cWriteTargetCaplPage, cWriteSeverityError, "%s: Failed to set AuxValve11 to %f %%", sClientName, @this);
}

on sysvar sysvar::Functions::AuxValve11::svFullyOpenedExtend
{
  if(Iso11783IL_TIMFunctionRequest(cAuxValve11, 0x0 ) != 0)
  {
    writeLineEx(cWriteTargetCaplPage, cWriteSeverityError, "%s: Failed to set AuxValve11 to 0x0 (Fully Opened, Extend)", sClientName);
  }
}

on sysvar sysvar::Functions::AuxValve11::svBlock
{
  if(Iso11783IL_TIMFunctionRequest(cAuxValve11, 0x7D80 ) != 0)
  {
    writeLineEx(cWriteTargetCaplPage, cWriteSeverityError, "%s: Failed to set AuxValve11 to 0x7D80 (Block)", sClientName);
  }
}

on sysvar sysvar::Functions::AuxValve11::svFullyOpenedRetract
{
  if(Iso11783IL_TIMFunctionRequest(cAuxValve11, 0xFB00 ) != 0)
  {
    writeLineEx(cWriteTargetCaplPage, cWriteSeverityError, "%s: Failed to set AuxValve11 to 0xFB00 (Fully Opened, Retract)", sClientName);
  }
}

on sysvar sysvar::Functions::AuxValve11::svFloat
{
  if(Iso11783IL_TIMFunctionRequest(cAuxValve11, 0xFB01 ) != 0)
  {
    writeLineEx(cWriteTargetCaplPage, cWriteSeverityError, "%s: Failed to set AuxValve11 to 0xFB01 (Float)", sClientName);
  }
}

///////////////////////////////////////////////////////////////////
// Aux Valve 12                                                  //
///////////////////////////////////////////////////////////////////

on sysvar sysvar::Functions::AuxValve12::svAssignFct
{
  if (@this == 0)
  {
    AssignFunction(cAuxValve12);
    EnableAssignOrUnassign(cAuxValve12, 0);
  }
}

on sysvar sysvar::Functions::AuxValve12::svUnassignFct
{
  if (@this == 0)
  {
    Iso11783IL_TIMUnassignFunction(cAuxValve12);   
    EnableAssignOrUnassign(cAuxValve12, 1);
    EnableControls_AuxValve(12, 0);
  }
}

on sysvar sysvar::Functions::AuxValve12::svReleaseControl
{
  if (@this == 1)
  {
    Iso11783IL_TIMFunctionRequest(cAuxValve12, cReleasedControlRequestingOperator);   
  }
  else
  {
    Iso11783IL_TIMFunctionRequest(cAuxValve12, cReadyToControl);   
  }
}

on sysvar sysvar::Functions::AuxValve12::svValue
{
  int result;
  
  result = SetCurrentAuxValveFlow(cAuxValve12, @this);
  if(result != 0)    
    writeLineEx(cWriteTargetCaplPage, cWriteSeverityError, "%s: Failed to set AuxValve12 to %f %%", sClientName, @this);
}

on sysvar sysvar::Functions::AuxValve12::svFullyOpenedExtend
{
  if(Iso11783IL_TIMFunctionRequest(cAuxValve12, 0x0 ) != 0)
  {
    writeLineEx(cWriteTargetCaplPage, cWriteSeverityError, "%s: Failed to set AuxValve12 to 0x0 (Fully Opened, Extend)", sClientName);
  }
}

on sysvar sysvar::Functions::AuxValve12::svBlock
{
  if(Iso11783IL_TIMFunctionRequest(cAuxValve12, 0x7D80 ) != 0)
  {
    writeLineEx(cWriteTargetCaplPage, cWriteSeverityError, "%s: Failed to set AuxValve12 to 0x7D80 (Block)", sClientName);
  }
}

on sysvar sysvar::Functions::AuxValve12::svFullyOpenedRetract
{
  if(Iso11783IL_TIMFunctionRequest(cAuxValve12, 0xFB00 ) != 0)
  {
    writeLineEx(cWriteTargetCaplPage, cWriteSeverityError, "%s: Failed to set AuxValve12 to 0xFB00 (Fully Opened, Retract)", sClientName);
  }
}

on sysvar sysvar::Functions::AuxValve12::svFloat
{
  if(Iso11783IL_TIMFunctionRequest(cAuxValve12, 0xFB01 ) != 0)
  {
    writeLineEx(cWriteTargetCaplPage, cWriteSeverityError, "%s: Failed to set AuxValve12 to 0xFB01 (Float)", sClientName);
  }
}

///////////////////////////////////////////////////////////////////
// Aux Valve 13                                                  //
///////////////////////////////////////////////////////////////////

on sysvar sysvar::Functions::AuxValve13::svAssignFct
{
  if (@this == 0)
  {
    AssignFunction(cAuxValve13);
    EnableAssignOrUnassign(cAuxValve13, 0);
  }
}

on sysvar sysvar::Functions::AuxValve13::svUnassignFct
{
  if (@this == 0)
  {
    Iso11783IL_TIMUnassignFunction(cAuxValve13);   
    EnableAssignOrUnassign(cAuxValve13, 1);
    EnableControls_AuxValve(13, 0);
  }
}

on sysvar sysvar::Functions::AuxValve13::svReleaseControl
{
  if (@this == 1)
  {
    Iso11783IL_TIMFunctionRequest(cAuxValve13, cReleasedControlRequestingOperator);   
  }
  else
  {
    Iso11783IL_TIMFunctionRequest(cAuxValve13, cReadyToControl);   
  }
}

on sysvar sysvar::Functions::AuxValve13::svValue
{
  int result;
  
  result = SetCurrentAuxValveFlow(cAuxValve13, @this);
  if(result != 0)    
    writeLineEx(cWriteTargetCaplPage, cWriteSeverityError, "%s: Failed to set AuxValve13 to %f %%", sClientName, @this);
}

on sysvar sysvar::Functions::AuxValve13::svFullyOpenedExtend
{
  if(Iso11783IL_TIMFunctionRequest(cAuxValve13, 0x0 ) != 0)
  {
    writeLineEx(cWriteTargetCaplPage, cWriteSeverityError, "%s: Failed to set AuxValve13 to 0x0 (Fully Opened, Extend)", sClientName);
  }
}

on sysvar sysvar::Functions::AuxValve13::svBlock
{
  if(Iso11783IL_TIMFunctionRequest(cAuxValve13, 0x7D80 ) != 0)
  {
    writeLineEx(cWriteTargetCaplPage, cWriteSeverityError, "%s: Failed to set AuxValve13 to 0x7D80 (Block)", sClientName);
  }
}

on sysvar sysvar::Functions::AuxValve13::svFullyOpenedRetract
{
  if(Iso11783IL_TIMFunctionRequest(cAuxValve13, 0xFB00 ) != 0)
  {
    writeLineEx(cWriteTargetCaplPage, cWriteSeverityError, "%s: Failed to set AuxValve13 to 0xFB00 (Fully Opened, Retract)", sClientName);
  }
}

on sysvar sysvar::Functions::AuxValve13::svFloat
{
  if(Iso11783IL_TIMFunctionRequest(cAuxValve13, 0xFB01 ) != 0)
  {
    writeLineEx(cWriteTargetCaplPage, cWriteSeverityError, "%s: Failed to set AuxValve13 to 0xFB01 (Float)", sClientName);
  }
}

///////////////////////////////////////////////////////////////////
// Aux Valve 14                                                  //
///////////////////////////////////////////////////////////////////

on sysvar sysvar::Functions::AuxValve14::svAssignFct
{
  if (@this == 0)
  {
    AssignFunction(cAuxValve14);
    EnableAssignOrUnassign(cAuxValve14, 0);
  }
}

on sysvar sysvar::Functions::AuxValve14::svUnassignFct
{
  if (@this == 0)
  {
    Iso11783IL_TIMUnassignFunction(cAuxValve14);     
    EnableAssignOrUnassign(cAuxValve14, 1);
    EnableControls_AuxValve(14, 0);
  }
}

on sysvar sysvar::Functions::AuxValve14::svReleaseControl
{
  if (@this == 1)
  {
    Iso11783IL_TIMFunctionRequest(cAuxValve14, cReleasedControlRequestingOperator);   
  }
  else
  {
    Iso11783IL_TIMFunctionRequest(cAuxValve14, cReadyToControl);   
  }
}

on sysvar sysvar::Functions::AuxValve14::svValue
{
  int result;
  
  result = SetCurrentAuxValveFlow(cAuxValve14, @this);
  if(result != 0)    
    writeLineEx(cWriteTargetCaplPage, cWriteSeverityError, "%s: Failed to set AuxValve14 to %f %%", sClientName, @this);
}

on sysvar sysvar::Functions::AuxValve14::svFullyOpenedExtend
{
  if(Iso11783IL_TIMFunctionRequest(cAuxValve14, 0x0 ) != 0)
  {
    writeLineEx(cWriteTargetCaplPage, cWriteSeverityError, "%s: Failed to set AuxValve14 to 0x0 (Fully Opened, Extend)", sClientName);
  }
}

on sysvar sysvar::Functions::AuxValve14::svBlock
{
  if(Iso11783IL_TIMFunctionRequest(cAuxValve14, 0x7D80 ) != 0)
  {
    writeLineEx(cWriteTargetCaplPage, cWriteSeverityError, "%s: Failed to set AuxValve14 to 0x7D80 (Block)", sClientName);
  }
}

on sysvar sysvar::Functions::AuxValve14::svFullyOpenedRetract
{
  if(Iso11783IL_TIMFunctionRequest(cAuxValve14, 0xFB00 ) != 0)
  {
    writeLineEx(cWriteTargetCaplPage, cWriteSeverityError, "%s: Failed to set AuxValve14 to 0xFB00 (Fully Opened, Retract)", sClientName);
  }
}

on sysvar sysvar::Functions::AuxValve14::svFloat
{
  if(Iso11783IL_TIMFunctionRequest(cAuxValve14, 0xFB01 ) != 0)
  {
    writeLineEx(cWriteTargetCaplPage, cWriteSeverityError, "%s: Failed to set AuxValve14 to 0xFB01 (Float)", sClientName);
  }
}

///////////////////////////////////////////////////////////////////
// Aux Valve 15                                                  //
///////////////////////////////////////////////////////////////////

on sysvar sysvar::Functions::AuxValve15::svAssignFct
{
  if (@this == 0)
  {
    AssignFunction(cAuxValve15);
    EnableAssignOrUnassign(cAuxValve15, 0);
  }
}

on sysvar sysvar::Functions::AuxValve15::svUnassignFct
{
  if (@this == 0)
  {
    Iso11783IL_TIMUnassignFunction(cAuxValve15); 
    EnableAssignOrUnassign(cAuxValve15, 1);
    EnableControls_AuxValve(15, 0);
  }
}

on sysvar sysvar::Functions::AuxValve15::svReleaseControl
{
  if (@this == 1)
  {
    Iso11783IL_TIMFunctionRequest(cAuxValve15, cReleasedControlRequestingOperator);   
  }
  else
  {
    Iso11783IL_TIMFunctionRequest(cAuxValve15, cReadyToControl);   
  }
}

on sysvar sysvar::Functions::AuxValve15::svValue
{
  int result;
  
  result = SetCurrentAuxValveFlow(cAuxValve15, @this);
  if(result != 0)    
    writeLineEx(cWriteTargetCaplPage, cWriteSeverityError, "%s: Failed to set AuxValve15 to %f %%", sClientName, @this);
}

on sysvar sysvar::Functions::AuxValve15::svFullyOpenedExtend
{
  if(Iso11783IL_TIMFunctionRequest(cAuxValve15, 0x0 ) != 0)
  {
    writeLineEx(cWriteTargetCaplPage, cWriteSeverityError, "%s: Failed to set AuxValve15 to 0x0 (Fully Opened, Extend)", sClientName);
  }
}

on sysvar sysvar::Functions::AuxValve15::svBlock
{
  if(Iso11783IL_TIMFunctionRequest(cAuxValve15, 0x7D80 ) != 0)
  {
    writeLineEx(cWriteTargetCaplPage, cWriteSeverityError, "%s: Failed to set AuxValve15 to 0x7D80 (Block)", sClientName);
  }
}

on sysvar sysvar::Functions::AuxValve15::svFullyOpenedRetract
{
  if(Iso11783IL_TIMFunctionRequest(cAuxValve15, 0xFB00 ) != 0)
  {
    writeLineEx(cWriteTargetCaplPage, cWriteSeverityError, "%s: Failed to set AuxValve15 to 0xFB00 (Fully Opened, Retract)", sClientName);
  }
}

on sysvar sysvar::Functions::AuxValve15::svFloat
{
  if(Iso11783IL_TIMFunctionRequest(cAuxValve15, 0xFB01 ) != 0)
  {
    writeLineEx(cWriteTargetCaplPage, cWriteSeverityError, "%s: Failed to set AuxValve15 to 0xFB01 (Float)", sClientName);
  }
}

///////////////////////////////////////////////////////////////////
// Aux Valve 16                                                  //
///////////////////////////////////////////////////////////////////

on sysvar sysvar::Functions::AuxValve16::svAssignFct
{
  if (@this == 0)
  {
    AssignFunction(cAuxValve16);
    EnableAssignOrUnassign(cAuxValve16, 0);
  }
}

on sysvar sysvar::Functions::AuxValve16::svUnassignFct
{
  if (@this == 0)
  {
    Iso11783IL_TIMUnassignFunction(cAuxValve16);      
    EnableAssignOrUnassign(cAuxValve16, 1);
    EnableControls_AuxValve(16, 0);
  }
}

on sysvar sysvar::Functions::AuxValve16::svReleaseControl
{
  if (@this == 1)
  {
    Iso11783IL_TIMFunctionRequest(cAuxValve16, cReleasedControlRequestingOperator);   
  }
  else
  {
    Iso11783IL_TIMFunctionRequest(cAuxValve16, cReadyToControl);   
  }
}

on sysvar sysvar::Functions::AuxValve16::svValue
{
  int result;
  
  result = SetCurrentAuxValveFlow(cAuxValve16, @this);
  if(result != 0)    
    writeLineEx(cWriteTargetCaplPage, cWriteSeverityError, "%s: Failed to set AuxValve16 to %f %%", sClientName, @this);
}

on sysvar sysvar::Functions::AuxValve16::svFullyOpenedExtend
{
  if(Iso11783IL_TIMFunctionRequest(cAuxValve16, 0x0 ) != 0)
  {
    writeLineEx(cWriteTargetCaplPage, cWriteSeverityError, "%s: Failed to set AuxValve16 to 0x0 (Fully Opened, Extend)", sClientName);
  }
}

on sysvar sysvar::Functions::AuxValve16::svBlock
{
  if(Iso11783IL_TIMFunctionRequest(cAuxValve16, 0x7D80 ) != 0)
  {
    writeLineEx(cWriteTargetCaplPage, cWriteSeverityError, "%s: Failed to set AuxValve16 to 0x7D80 (Block)", sClientName);
  }
}

on sysvar sysvar::Functions::AuxValve16::svFullyOpenedRetract
{
  if(Iso11783IL_TIMFunctionRequest(cAuxValve16, 0xFB00 ) != 0)
  {
    writeLineEx(cWriteTargetCaplPage, cWriteSeverityError, "%s: Failed to set AuxValve16 to 0xFB00 (Fully Opened, Retract)", sClientName);
  }
}

on sysvar sysvar::Functions::AuxValve16::svFloat
{
  if(Iso11783IL_TIMFunctionRequest(cAuxValve16, 0xFB01 ) != 0)
  {
    writeLineEx(cWriteTargetCaplPage, cWriteSeverityError, "%s: Failed to set AuxValve16 to 0xFB01 (Float)", sClientName);
  }
}

///////////////////////////////////////////////////////////////////
// Aux Valve 17                                                   //
///////////////////////////////////////////////////////////////////

on sysvar sysvar::Functions::AuxValve17::svAssignFct
{
  if (@this == 0)
  {
    AssignFunction(cAuxValve17);
    EnableAssignOrUnassign(cAuxValve17, 0);
  }
}

on sysvar sysvar::Functions::AuxValve17::svUnassignFct
{
  if (@this == 0)
  {
    Iso11783IL_TIMUnassignFunction(cAuxValve17);    
    EnableAssignOrUnassign(cAuxValve17, 1);
    EnableControls_AuxValve(17, 0);
  }
}

on sysvar sysvar::Functions::AuxValve17::svReleaseControl
{
  if (@this == 1)
  {
    Iso11783IL_TIMFunctionRequest(cAuxValve17, cReleasedControlRequestingOperator);   
  }
  else
  {
    Iso11783IL_TIMFunctionRequest(cAuxValve17, cReadyToControl);   
  }
}

on sysvar sysvar::Functions::AuxValve17::svValue
{
  int result;
  
  result = SetCurrentAuxValveFlow(cAuxValve17, @this);
  if(result != 0)    
    writeLineEx(cWriteTargetCaplPage, cWriteSeverityError, "%s: Failed to set AuxValve17 to %f %%", sClientName, @this);
}

on sysvar sysvar::Functions::AuxValve17::svFullyOpenedExtend
{
  if(Iso11783IL_TIMFunctionRequest(cAuxValve17, 0x0 ) != 0)
  {
    writeLineEx(cWriteTargetCaplPage, cWriteSeverityError, "%s: Failed to set AuxValve17 to 0x0 (Fully Opened, Extend)", sClientName);
  }
}

on sysvar sysvar::Functions::AuxValve17::svBlock
{
  if(Iso11783IL_TIMFunctionRequest(cAuxValve17, 0x7D80 ) != 0)
  {
    writeLineEx(cWriteTargetCaplPage, cWriteSeverityError, "%s: Failed to set AuxValve17 to 0x7D80 (Block)", sClientName);
  }
}

on sysvar sysvar::Functions::AuxValve17::svFullyOpenedRetract
{
  if(Iso11783IL_TIMFunctionRequest(cAuxValve17, 0xFB00 ) != 0)
  {
    writeLineEx(cWriteTargetCaplPage, cWriteSeverityError, "%s: Failed to set AuxValve17 to 0xFB00 (Fully Opened, Retract)", sClientName);
  }
}

on sysvar sysvar::Functions::AuxValve17::svFloat
{
  if(Iso11783IL_TIMFunctionRequest(cAuxValve17, 0xFB01 ) != 0)
  {
    writeLineEx(cWriteTargetCaplPage, cWriteSeverityError, "%s: Failed to set AuxValve17 to 0xFB01 (Float)", sClientName);
  }
}

///////////////////////////////////////////////////////////////////
// Aux Valve 18                                                   //
///////////////////////////////////////////////////////////////////

on sysvar sysvar::Functions::AuxValve18::svAssignFct
{
  if (@this == 0)
  {
    AssignFunction(cAuxValve18);
    EnableAssignOrUnassign(cAuxValve18, 0);
  }
}

on sysvar sysvar::Functions::AuxValve18::svUnassignFct
{
  if (@this == 0)
  {
    Iso11783IL_TIMUnassignFunction(cAuxValve18);       
    EnableAssignOrUnassign(cAuxValve18, 1);
    EnableControls_AuxValve(18, 0);
  }
}

on sysvar sysvar::Functions::AuxValve18::svReleaseControl
{
  if (@this == 1)
  {
    Iso11783IL_TIMFunctionRequest(cAuxValve18, cReleasedControlRequestingOperator);   
  }
  else
  {
    Iso11783IL_TIMFunctionRequest(cAuxValve18, cReadyToControl);   
  }
}

on sysvar sysvar::Functions::AuxValve18::svValue
{
  int result;
  
  result = SetCurrentAuxValveFlow(cAuxValve18, @this);
  if(result != 0)    
    writeLineEx(cWriteTargetCaplPage, cWriteSeverityError, "%s: Failed to set AuxValve18 to %f %%", sClientName, @this);
}

on sysvar sysvar::Functions::AuxValve18::svFullyOpenedExtend
{
  if(Iso11783IL_TIMFunctionRequest(cAuxValve18, 0x0 ) != 0)
  {
    writeLineEx(cWriteTargetCaplPage, cWriteSeverityError, "%s: Failed to set AuxValve18 to 0x0 (Fully Opened, Extend)", sClientName);
  }
}

on sysvar sysvar::Functions::AuxValve18::svBlock
{
  if(Iso11783IL_TIMFunctionRequest(cAuxValve18, 0x7D80 ) != 0)
  {
    writeLineEx(cWriteTargetCaplPage, cWriteSeverityError, "%s: Failed to set AuxValve18 to 0x7D80 (Block)", sClientName);
  }
}

on sysvar sysvar::Functions::AuxValve18::svFullyOpenedRetract
{
  if(Iso11783IL_TIMFunctionRequest(cAuxValve18, 0xFB00 ) != 0)
  {
    writeLineEx(cWriteTargetCaplPage, cWriteSeverityError, "%s: Failed to set AuxValve18 to 0xFB00 (Fully Opened, Retract)", sClientName);
  }
}

on sysvar sysvar::Functions::AuxValve18::svFloat
{
  if(Iso11783IL_TIMFunctionRequest(cAuxValve18, 0xFB01 ) != 0)
  {
    writeLineEx(cWriteTargetCaplPage, cWriteSeverityError, "%s: Failed to set AuxValve18 to 0xFB01 (Float)", sClientName);
  }
}

///////////////////////////////////////////////////////////////////
// Aux Valve 19                                                  //
///////////////////////////////////////////////////////////////////

on sysvar sysvar::Functions::AuxValve19::svAssignFct
{
  if (@this == 0)
  {
    AssignFunction(cAuxValve19);
    EnableAssignOrUnassign(cAuxValve19, 0);
  }
}

on sysvar sysvar::Functions::AuxValve19::svUnassignFct
{
  if (@this == 0)
  {
    Iso11783IL_TIMUnassignFunction(cAuxValve19);   
    EnableAssignOrUnassign(cAuxValve19, 1);
    EnableControls_AuxValve(19, 0);
  }
}

on sysvar sysvar::Functions::AuxValve19::svReleaseControl
{
  if (@this == 1)
  {
    Iso11783IL_TIMFunctionRequest(cAuxValve19, cReleasedControlRequestingOperator);   
  }
  else
  {
    Iso11783IL_TIMFunctionRequest(cAuxValve19, cReadyToControl);   
  }
}

on sysvar sysvar::Functions::AuxValve19::svValue
{
  int result;
  
  result = SetCurrentAuxValveFlow(cAuxValve19, @this);
  if(result != 0)    
    writeLineEx(cWriteTargetCaplPage, cWriteSeverityError, "%s: Failed to set AuxValve19 to %f %%", sClientName, @this);
}

on sysvar sysvar::Functions::AuxValve19::svFullyOpenedExtend
{
  if(Iso11783IL_TIMFunctionRequest(cAuxValve19, 0x0 ) != 0)
  {
    writeLineEx(cWriteTargetCaplPage, cWriteSeverityError, "%s: Failed to set AuxValve19 to 0x0 (Fully Opened, Extend)", sClientName);
  }
}

on sysvar sysvar::Functions::AuxValve19::svBlock
{
  if(Iso11783IL_TIMFunctionRequest(cAuxValve19, 0x7D80 ) != 0)
  {
    writeLineEx(cWriteTargetCaplPage, cWriteSeverityError, "%s: Failed to set AuxValve19 to 0x7D80 (Block)", sClientName);
  }
}

on sysvar sysvar::Functions::AuxValve19::svFullyOpenedRetract
{
  if(Iso11783IL_TIMFunctionRequest(cAuxValve19, 0xFB00 ) != 0)
  {
    writeLineEx(cWriteTargetCaplPage, cWriteSeverityError, "%s: Failed to set AuxValve19 to 0xFB00 (Fully Opened, Retract)", sClientName);
  }
}

on sysvar sysvar::Functions::AuxValve19::svFloat
{
  if(Iso11783IL_TIMFunctionRequest(cAuxValve19, 0xFB01 ) != 0)
  {
    writeLineEx(cWriteTargetCaplPage, cWriteSeverityError, "%s: Failed to set AuxValve19 to 0xFB01 (Float)", sClientName);
  }
}

///////////////////////////////////////////////////////////////////
// Aux Valve 20                                                   //
///////////////////////////////////////////////////////////////////

on sysvar sysvar::Functions::AuxValve20::svAssignFct
{
  if (@this == 0)
  {
    AssignFunction(cAuxValve20);
    EnableAssignOrUnassign(cAuxValve20, 0); 
  }
}

on sysvar sysvar::Functions::AuxValve20::svUnassignFct
{
  if (@this == 0)
  {
    Iso11783IL_TIMUnassignFunction(cAuxValve20);       
    EnableAssignOrUnassign(cAuxValve20, 1);
    EnableControls_AuxValve(20, 0);
  }
}

on sysvar sysvar::Functions::AuxValve20::svReleaseControl
{
  if (@this == 1)
  {
    Iso11783IL_TIMFunctionRequest(cAuxValve20, cReleasedControlRequestingOperator);   
  }
  else
  {
    Iso11783IL_TIMFunctionRequest(cAuxValve20, cReadyToControl);   
  }
}

on sysvar sysvar::Functions::AuxValve20::svValue
{
  int result;
  
  result = SetCurrentAuxValveFlow(cAuxValve20, @this);
  if(result != 0)    
    writeLineEx(cWriteTargetCaplPage, cWriteSeverityError, "%s: Failed to set AuxValve20 to %f %%", sClientName, @this);
}

on sysvar sysvar::Functions::AuxValve20::svFullyOpenedExtend
{
  if(Iso11783IL_TIMFunctionRequest(cAuxValve20, 0x0 ) != 0)
  {
    writeLineEx(cWriteTargetCaplPage, cWriteSeverityError, "%s: Failed to set AuxValve20 to 0x0 (Fully Opened, Extend)", sClientName);
  }
}

on sysvar sysvar::Functions::AuxValve20::svBlock
{
  if(Iso11783IL_TIMFunctionRequest(cAuxValve20, 0x7D80 ) != 0)
  {
    writeLineEx(cWriteTargetCaplPage, cWriteSeverityError, "%s: Failed to set AuxValve20 to 0x7D80 (Block)", sClientName);
  }
}

on sysvar sysvar::Functions::AuxValve20::svFullyOpenedRetract
{
  if(Iso11783IL_TIMFunctionRequest(cAuxValve20, 0xFB00 ) != 0)
  {
    writeLineEx(cWriteTargetCaplPage, cWriteSeverityError, "%s: Failed to set AuxValve20 to 0xFB00 (Fully Opened, Retract)", sClientName);
  }
}

on sysvar sysvar::Functions::AuxValve20::svFloat
{
  if(Iso11783IL_TIMFunctionRequest(cAuxValve20, 0xFB01 ) != 0)
  {
    writeLineEx(cWriteTargetCaplPage, cWriteSeverityError, "%s: Failed to set AuxValve20 to 0xFB01 (Float)", sClientName);
  }
}

///////////////////////////////////////////////////////////////////
// Aux Valve 21                                                  //
///////////////////////////////////////////////////////////////////

on sysvar sysvar::Functions::AuxValve21::svAssignFct
{
  if (@this == 0)
  {
    AssignFunction(cAuxValve21);
    EnableAssignOrUnassign(cAuxValve21, 0);
  }
}

on sysvar sysvar::Functions::AuxValve21::svUnassignFct
{
  if (@this == 0)
  {
    Iso11783IL_TIMUnassignFunction(cAuxValve21);    
    EnableAssignOrUnassign(cAuxValve21, 1);
    EnableControls_AuxValve(21, 0);
  }
}

on sysvar sysvar::Functions::AuxValve21::svReleaseControl
{
  if (@this == 1)
  {
    Iso11783IL_TIMFunctionRequest(cAuxValve21, cReleasedControlRequestingOperator);   
  }
  else
  {
    Iso11783IL_TIMFunctionRequest(cAuxValve21, cReadyToControl);   
  }
}

on sysvar sysvar::Functions::AuxValve21::svValue
{
  int result;
  
  result = SetCurrentAuxValveFlow(cAuxValve21, @this);
  if(result != 0)    
    writeLineEx(cWriteTargetCaplPage, cWriteSeverityError, "%s: Failed to set AuxValve21 to %f %%", sClientName, @this);
}

on sysvar sysvar::Functions::AuxValve21::svFullyOpenedExtend
{
  if(Iso11783IL_TIMFunctionRequest(cAuxValve21, 0x0 ) != 0)
  {
    writeLineEx(cWriteTargetCaplPage, cWriteSeverityError, "%s: Failed to set AuxValve21 to 0x0 (Fully Opened, Extend)", sClientName);
  }
}

on sysvar sysvar::Functions::AuxValve21::svBlock
{
  if(Iso11783IL_TIMFunctionRequest(cAuxValve21, 0x7D80 ) != 0)
  {
    writeLineEx(cWriteTargetCaplPage, cWriteSeverityError, "%s: Failed to set AuxValve21 to 0x7D80 (Block)", sClientName);
  }
}

on sysvar sysvar::Functions::AuxValve21::svFullyOpenedRetract
{
  if(Iso11783IL_TIMFunctionRequest(cAuxValve21, 0xFB00 ) != 0)
  {
    writeLineEx(cWriteTargetCaplPage, cWriteSeverityError, "%s: Failed to set AuxValve21 to 0xFB00 (Fully Opened, Retract)", sClientName);
  }
}

on sysvar sysvar::Functions::AuxValve21::svFloat
{
  if(Iso11783IL_TIMFunctionRequest(cAuxValve21, 0xFB01 ) != 0)
  {
    writeLineEx(cWriteTargetCaplPage, cWriteSeverityError, "%s: Failed to set AuxValve21 to 0xFB01 (Float)", sClientName);
  }
}

///////////////////////////////////////////////////////////////////
// Aux Valve 22                                                   //
///////////////////////////////////////////////////////////////////

on sysvar sysvar::Functions::AuxValve22::svAssignFct
{
  if (@this == 0)
  {
    AssignFunction(cAuxValve22);
    EnableAssignOrUnassign(cAuxValve22, 0);
  }
}

on sysvar sysvar::Functions::AuxValve22::svUnassignFct
{
  if (@this == 0)
  {
    Iso11783IL_TIMUnassignFunction(cAuxValve22);  
    EnableAssignOrUnassign(cAuxValve22, 1);
    EnableControls_AuxValve(22, 0);
  }
}

on sysvar sysvar::Functions::AuxValve22::svReleaseControl
{
  if (@this == 1)
  {
    Iso11783IL_TIMFunctionRequest(cAuxValve22, cReleasedControlRequestingOperator);   
  }
  else
  {
    Iso11783IL_TIMFunctionRequest(cAuxValve22, cReadyToControl);   
  }
}

on sysvar sysvar::Functions::AuxValve22::svValue
{
  int result;
  
  result = SetCurrentAuxValveFlow(cAuxValve22, @this);
  if(result != 0)    
    writeLineEx(cWriteTargetCaplPage, cWriteSeverityError, "%s: Failed to set AuxValve22 to %f %%", sClientName, @this);
}

on sysvar sysvar::Functions::AuxValve22::svFullyOpenedExtend
{
  if(Iso11783IL_TIMFunctionRequest(cAuxValve22, 0x0 ) != 0)
  {
    writeLineEx(cWriteTargetCaplPage, cWriteSeverityError, "%s: Failed to set AuxValve22 to 0x0 (Fully Opened, Extend)", sClientName);
  }
}

on sysvar sysvar::Functions::AuxValve22::svBlock
{
  if(Iso11783IL_TIMFunctionRequest(cAuxValve22, 0x7D80 ) != 0)
  {
    writeLineEx(cWriteTargetCaplPage, cWriteSeverityError, "%s: Failed to set AuxValve22 to 0x7D80 (Block)", sClientName);
  }
}

on sysvar sysvar::Functions::AuxValve22::svFullyOpenedRetract
{
  if(Iso11783IL_TIMFunctionRequest(cAuxValve22, 0xFB00 ) != 0)
  {
    writeLineEx(cWriteTargetCaplPage, cWriteSeverityError, "%s: Failed to set AuxValve22 to 0xFB00 (Fully Opened, Retract)", sClientName);
  }
}

on sysvar sysvar::Functions::AuxValve22::svFloat
{
  if(Iso11783IL_TIMFunctionRequest(cAuxValve22, 0xFB01 ) != 0)
  {
    writeLineEx(cWriteTargetCaplPage, cWriteSeverityError, "%s: Failed to set AuxValve22 to 0xFB01 (Float)", sClientName);
  }
}

///////////////////////////////////////////////////////////////////
// Aux Valve 23                                                   //
///////////////////////////////////////////////////////////////////

on sysvar sysvar::Functions::AuxValve23::svAssignFct
{
  if (@this == 0)
  {
    AssignFunction(cAuxValve23);
    EnableAssignOrUnassign(cAuxValve23, 0);
  }
}

on sysvar sysvar::Functions::AuxValve23::svUnassignFct
{
  if (@this == 0)
  {
    Iso11783IL_TIMUnassignFunction(cAuxValve23);    
    EnableAssignOrUnassign(cAuxValve23, 1);
    EnableControls_AuxValve(23, 0);
  }
}

on sysvar sysvar::Functions::AuxValve23::svReleaseControl
{
  if (@this == 1)
  {
    Iso11783IL_TIMFunctionRequest(cAuxValve23, cReleasedControlRequestingOperator);   
  }
  else
  {
    Iso11783IL_TIMFunctionRequest(cAuxValve23, cReadyToControl);   
  }
}

on sysvar sysvar::Functions::AuxValve23::svValue
{
  int result;
  
  result = SetCurrentAuxValveFlow(cAuxValve23, @this);
  if(result != 0)    
    writeLineEx(cWriteTargetCaplPage, cWriteSeverityError, "%s: Failed to set AuxValve23 to %f %%", sClientName, @this);
}

on sysvar sysvar::Functions::AuxValve23::svFullyOpenedExtend
{
  if(Iso11783IL_TIMFunctionRequest(cAuxValve23, 0x0 ) != 0)
  {
    writeLineEx(cWriteTargetCaplPage, cWriteSeverityError, "%s: Failed to set AuxValve23 to 0x0 (Fully Opened, Extend)", sClientName);
  }
}

on sysvar sysvar::Functions::AuxValve23::svBlock
{
  if(Iso11783IL_TIMFunctionRequest(cAuxValve23, 0x7D80 ) != 0)
  {
    writeLineEx(cWriteTargetCaplPage, cWriteSeverityError, "%s: Failed to set AuxValve23 to 0x7D80 (Block)", sClientName);
  }
}

on sysvar sysvar::Functions::AuxValve23::svFullyOpenedRetract
{
  if(Iso11783IL_TIMFunctionRequest(cAuxValve23, 0xFB00 ) != 0)
  {
    writeLineEx(cWriteTargetCaplPage, cWriteSeverityError, "%s: Failed to set AuxValve23 to 0xFB00 (Fully Opened, Retract)", sClientName);
  }
}

on sysvar sysvar::Functions::AuxValve23::svFloat
{
  if(Iso11783IL_TIMFunctionRequest(cAuxValve23, 0xFB01 ) != 0)
  {
    writeLineEx(cWriteTargetCaplPage, cWriteSeverityError, "%s: Failed to set AuxValve23 to 0xFB01 (Float)", sClientName);
  }
}

///////////////////////////////////////////////////////////////////
// Aux Valve 24                                                  //
///////////////////////////////////////////////////////////////////

on sysvar sysvar::Functions::AuxValve24::svAssignFct
{
  if (@this == 0)
  {
    AssignFunction(cAuxValve24);
    EnableAssignOrUnassign(cAuxValve24, 0);
  }
}

on sysvar sysvar::Functions::AuxValve24::svUnassignFct
{
  if (@this == 0)
  {
    Iso11783IL_TIMUnassignFunction(cAuxValve24);      
    EnableAssignOrUnassign(cAuxValve24, 1);
    EnableControls_AuxValve(24, 0);
  }
}

on sysvar sysvar::Functions::AuxValve24::svReleaseControl
{
  if (@this == 1)
  {
    Iso11783IL_TIMFunctionRequest(cAuxValve24, cReleasedControlRequestingOperator);   
  }
  else
  {
    Iso11783IL_TIMFunctionRequest(cAuxValve24, cReadyToControl);   
  }
}

on sysvar sysvar::Functions::AuxValve24::svValue
{
  int result;
  
  result = SetCurrentAuxValveFlow(cAuxValve24, @this);
  if(result != 0)    
    writeLineEx(cWriteTargetCaplPage, cWriteSeverityError, "%s: Failed to set AuxValve24 to %f %%", sClientName, @this);
}

on sysvar sysvar::Functions::AuxValve24::svFullyOpenedExtend
{
  if(Iso11783IL_TIMFunctionRequest(cAuxValve24, 0x0 ) != 0)
  {
    writeLineEx(cWriteTargetCaplPage, cWriteSeverityError, "%s: Failed to set AuxValve24 to 0x0 (Fully Opened, Extend)", sClientName);
  }
}

on sysvar sysvar::Functions::AuxValve24::svBlock
{
  if(Iso11783IL_TIMFunctionRequest(cAuxValve24, 0x7D80 ) != 0)
  {
    writeLineEx(cWriteTargetCaplPage, cWriteSeverityError, "%s: Failed to set AuxValve24 to 0x7D80 (Block)", sClientName);
  }
}

on sysvar sysvar::Functions::AuxValve24::svFullyOpenedRetract
{
  if(Iso11783IL_TIMFunctionRequest(cAuxValve24, 0xFB00 ) != 0)
  {
    writeLineEx(cWriteTargetCaplPage, cWriteSeverityError, "%s: Failed to set AuxValve24 to 0xFB00 (Fully Opened, Retract)", sClientName);
  }
}

on sysvar sysvar::Functions::AuxValve24::svFloat
{
  if(Iso11783IL_TIMFunctionRequest(cAuxValve24, 0xFB01 ) != 0)
  {
    writeLineEx(cWriteTargetCaplPage, cWriteSeverityError, "%s: Failed to set AuxValve24 to 0xFB01 (Float)", sClientName);
  }
}

///////////////////////////////////////////////////////////////////
// Aux Valve 25                                                  //
///////////////////////////////////////////////////////////////////

on sysvar sysvar::Functions::AuxValve25::svAssignFct
{
  if (@this == 0)
  {
    AssignFunction(cAuxValve25);
    EnableAssignOrUnassign(cAuxValve25, 0);
  }
}

on sysvar sysvar::Functions::AuxValve25::svUnassignFct
{
  if (@this == 0)
  {
    Iso11783IL_TIMUnassignFunction(cAuxValve25);
    EnableAssignOrUnassign(cAuxValve25, 1);
    EnableControls_AuxValve(25, 0);
  }
}

on sysvar sysvar::Functions::AuxValve25::svReleaseControl
{
  if (@this == 1)
  {
    Iso11783IL_TIMFunctionRequest(cAuxValve25, cReleasedControlRequestingOperator);   
  }
  else
  {
    Iso11783IL_TIMFunctionRequest(cAuxValve25, cReadyToControl);   
  }
}

on sysvar sysvar::Functions::AuxValve25::svValue
{
  int result;
  
  result = SetCurrentAuxValveFlow(cAuxValve25, @this);
  if(result != 0)    
    writeLineEx(cWriteTargetCaplPage, cWriteSeverityError, "%s: Failed to set AuxValve25 to %f %%", sClientName, @this);
}

on sysvar sysvar::Functions::AuxValve25::svFullyOpenedExtend
{
  if(Iso11783IL_TIMFunctionRequest(cAuxValve25, 0x0 ) != 0)
  {
    writeLineEx(cWriteTargetCaplPage, cWriteSeverityError, "%s: Failed to set AuxValve25 to 0x0 (Fully Opened, Extend)", sClientName);
  }
}

on sysvar sysvar::Functions::AuxValve25::svBlock
{
  if(Iso11783IL_TIMFunctionRequest(cAuxValve25, 0x7D80 ) != 0)
  {
    writeLineEx(cWriteTargetCaplPage, cWriteSeverityError, "%s: Failed to set AuxValve25 to 0x7D80 (Block)", sClientName);
  }
}

on sysvar sysvar::Functions::AuxValve25::svFullyOpenedRetract
{
  if(Iso11783IL_TIMFunctionRequest(cAuxValve25, 0xFB00 ) != 0)
  {
    writeLineEx(cWriteTargetCaplPage, cWriteSeverityError, "%s: Failed to set AuxValve25 to 0xFB00 (Fully Opened, Retract)", sClientName);
  }
}

on sysvar sysvar::Functions::AuxValve25::svFloat
{
  if(Iso11783IL_TIMFunctionRequest(cAuxValve25, 0xFB01 ) != 0)
  {
    writeLineEx(cWriteTargetCaplPage, cWriteSeverityError, "%s: Failed to set AuxValve25 to 0xFB01 (Float)", sClientName);
  }
}

///////////////////////////////////////////////////////////////////
// Aux Valve 26                                                  //
///////////////////////////////////////////////////////////////////

on sysvar sysvar::Functions::AuxValve26::svAssignFct
{
  if (@this == 0)
  {
    AssignFunction(cAuxValve26);
    EnableAssignOrUnassign(cAuxValve26, 0);
  }
}

on sysvar sysvar::Functions::AuxValve26::svUnassignFct
{
  if (@this == 0)
  {
    Iso11783IL_TIMUnassignFunction(cAuxValve26);    
    EnableAssignOrUnassign(cAuxValve26, 1);
    EnableControls_AuxValve(26, 0);
  }
}

on sysvar sysvar::Functions::AuxValve26::svReleaseControl
{
  if (@this == 1)
  {
    Iso11783IL_TIMFunctionRequest(cAuxValve26, cReleasedControlRequestingOperator);   
  }
  else
  {
    Iso11783IL_TIMFunctionRequest(cAuxValve26, cReadyToControl);   
  }
}

on sysvar sysvar::Functions::AuxValve26::svValue
{
  int result;
  
  result = SetCurrentAuxValveFlow(cAuxValve26, @this);
  if(result != 0)    
    writeLineEx(cWriteTargetCaplPage, cWriteSeverityError, "%s: Failed to set AuxValve26 to %f %%", sClientName, @this);
}

on sysvar sysvar::Functions::AuxValve26::svFullyOpenedExtend
{
  if(Iso11783IL_TIMFunctionRequest(cAuxValve26, 0x0 ) != 0)
  {
    writeLineEx(cWriteTargetCaplPage, cWriteSeverityError, "%s: Failed to set AuxValve26 to 0x0 (Fully Opened, Extend)", sClientName);
  }
}

on sysvar sysvar::Functions::AuxValve26::svBlock
{
  if(Iso11783IL_TIMFunctionRequest(cAuxValve26, 0x7D80 ) != 0)
  {
    writeLineEx(cWriteTargetCaplPage, cWriteSeverityError, "%s: Failed to set AuxValve26 to 0x7D80 (Block)", sClientName);
  }
}

on sysvar sysvar::Functions::AuxValve26::svFullyOpenedRetract
{
  if(Iso11783IL_TIMFunctionRequest(cAuxValve26, 0xFB00 ) != 0)
  {
    writeLineEx(cWriteTargetCaplPage, cWriteSeverityError, "%s: Failed to set AuxValve26 to 0xFB00 (Fully Opened, Retract)", sClientName);
  }
}

on sysvar sysvar::Functions::AuxValve26::svFloat
{
  if(Iso11783IL_TIMFunctionRequest(cAuxValve26, 0xFB01 ) != 0)
  {
    writeLineEx(cWriteTargetCaplPage, cWriteSeverityError, "%s: Failed to set AuxValve26 to 0xFB01 (Float)", sClientName);
  }
}

///////////////////////////////////////////////////////////////////
// Aux Valve 27                                                   //
///////////////////////////////////////////////////////////////////

on sysvar sysvar::Functions::AuxValve27::svAssignFct
{
  if (@this == 0)
  {
    AssignFunction(cAuxValve27);
    EnableAssignOrUnassign(cAuxValve27, 0);
  }
}

on sysvar sysvar::Functions::AuxValve27::svUnassignFct
{
  if (@this == 0)
  {
    Iso11783IL_TIMUnassignFunction(cAuxValve27);   
    EnableAssignOrUnassign(cAuxValve27, 1);
    EnableControls_AuxValve(27, 0);
  }
}

on sysvar sysvar::Functions::AuxValve27::svReleaseControl
{
  if (@this == 1)
  {
    Iso11783IL_TIMFunctionRequest(cAuxValve27, cReleasedControlRequestingOperator);   
  }
  else
  {
    Iso11783IL_TIMFunctionRequest(cAuxValve27, cReadyToControl);   
  }
}

on sysvar sysvar::Functions::AuxValve27::svValue
{
  int result;
  
  result = SetCurrentAuxValveFlow(cAuxValve27, @this);
  if(result != 0)    
    writeLineEx(cWriteTargetCaplPage, cWriteSeverityError, "%s: Failed to set AuxValve27 to %f %%", sClientName, @this);
}

on sysvar sysvar::Functions::AuxValve27::svFullyOpenedExtend
{
  if(Iso11783IL_TIMFunctionRequest(cAuxValve27, 0x0 ) != 0)
  {
    writeLineEx(cWriteTargetCaplPage, cWriteSeverityError, "%s: Failed to set AuxValve27 to 0x0 (Fully Opened, Extend)", sClientName);
  }
}

on sysvar sysvar::Functions::AuxValve27::svBlock
{
  if(Iso11783IL_TIMFunctionRequest(cAuxValve27, 0x7D80 ) != 0)
  {
    writeLineEx(cWriteTargetCaplPage, cWriteSeverityError, "%s: Failed to set AuxValve27 to 0x7D80 (Block)", sClientName);
  }
}

on sysvar sysvar::Functions::AuxValve27::svFullyOpenedRetract
{
  if(Iso11783IL_TIMFunctionRequest(cAuxValve27, 0xFB00 ) != 0)
  {
    writeLineEx(cWriteTargetCaplPage, cWriteSeverityError, "%s: Failed to set AuxValve27 to 0xFB00 (Fully Opened, Retract)", sClientName);
  }
}

on sysvar sysvar::Functions::AuxValve27::svFloat
{
  if(Iso11783IL_TIMFunctionRequest(cAuxValve27, 0xFB01 ) != 0)
  {
    writeLineEx(cWriteTargetCaplPage, cWriteSeverityError, "%s: Failed to set AuxValve27 to 0xFB01 (Float)", sClientName);
  }
}

///////////////////////////////////////////////////////////////////
// Aux Valve 28                                                   //
///////////////////////////////////////////////////////////////////

on sysvar sysvar::Functions::AuxValve28::svAssignFct
{
  if (@this == 0)
  {
    AssignFunction(cAuxValve28);
    EnableAssignOrUnassign(cAuxValve28, 0);
  }
}

on sysvar sysvar::Functions::AuxValve28::svUnassignFct
{
  if (@this == 0)
  {
    Iso11783IL_TIMUnassignFunction(cAuxValve28);       
    EnableAssignOrUnassign(cAuxValve28, 1);
    EnableControls_AuxValve(28, 0);
  }
}

on sysvar sysvar::Functions::AuxValve28::svReleaseControl
{
  if (@this == 1)
  {
    Iso11783IL_TIMFunctionRequest(cAuxValve28, cReleasedControlRequestingOperator);   
  }
  else
  {
    Iso11783IL_TIMFunctionRequest(cAuxValve28, cReadyToControl);   
  }
}

on sysvar sysvar::Functions::AuxValve28::svValue
{
  int result;
  
  result = SetCurrentAuxValveFlow(cAuxValve28, @this);
  if(result != 0)    
    writeLineEx(cWriteTargetCaplPage, cWriteSeverityError, "%s: Failed to set AuxValve28 to %f %%", sClientName, @this);
}

on sysvar sysvar::Functions::AuxValve28::svFullyOpenedExtend
{
  if(Iso11783IL_TIMFunctionRequest(cAuxValve28, 0x0 ) != 0)
  {
    writeLineEx(cWriteTargetCaplPage, cWriteSeverityError, "%s: Failed to set AuxValve28 to 0x0 (Fully Opened, Extend)", sClientName);
  }
}

on sysvar sysvar::Functions::AuxValve28::svBlock
{
  if(Iso11783IL_TIMFunctionRequest(cAuxValve28, 0x7D80 ) != 0)
  {
    writeLineEx(cWriteTargetCaplPage, cWriteSeverityError, "%s: Failed to set AuxValve28 to 0x7D80 (Block)", sClientName);
  }
}

on sysvar sysvar::Functions::AuxValve28::svFullyOpenedRetract
{
  if(Iso11783IL_TIMFunctionRequest(cAuxValve28, 0xFB00 ) != 0)
  {
    writeLineEx(cWriteTargetCaplPage, cWriteSeverityError, "%s: Failed to set AuxValve28 to 0xFB00 (Fully Opened, Retract)", sClientName);
  }
}

on sysvar sysvar::Functions::AuxValve28::svFloat
{
  if(Iso11783IL_TIMFunctionRequest(cAuxValve28, 0xFB01 ) != 0)
  {
    writeLineEx(cWriteTargetCaplPage, cWriteSeverityError, "%s: Failed to set AuxValve28 to 0xFB01 (Float)", sClientName);
  }
}

///////////////////////////////////////////////////////////////////
// Aux Valve 29                                                  //
///////////////////////////////////////////////////////////////////

on sysvar sysvar::Functions::AuxValve29::svAssignFct
{
  if (@this == 0)
  {
    AssignFunction(cAuxValve29);
    EnableAssignOrUnassign(cAuxValve29, 0);
  }
}

on sysvar sysvar::Functions::AuxValve29::svUnassignFct
{
  if (@this == 0)
  {
    Iso11783IL_TIMUnassignFunction(cAuxValve29);       
    EnableAssignOrUnassign(cAuxValve29, 1);
    EnableControls_AuxValve(29, 0);
  }
}

on sysvar sysvar::Functions::AuxValve29::svReleaseControl
{
  if (@this == 1)
  {
    Iso11783IL_TIMFunctionRequest(cAuxValve29, cReleasedControlRequestingOperator);   
  }
  else
  {
    Iso11783IL_TIMFunctionRequest(cAuxValve29, cReadyToControl);   
  }
}

on sysvar sysvar::Functions::AuxValve29::svValue
{
  int result;
  
  result = SetCurrentAuxValveFlow(cAuxValve29, @this);
  if(result != 0)    
    writeLineEx(cWriteTargetCaplPage, cWriteSeverityError, "%s: Failed to set AuxValve29 to %f %%", sClientName, @this);
}

on sysvar sysvar::Functions::AuxValve29::svFullyOpenedExtend
{
  if(Iso11783IL_TIMFunctionRequest(cAuxValve29, 0x0 ) != 0)
  {
    writeLineEx(cWriteTargetCaplPage, cWriteSeverityError, "%s: Failed to set AuxValve29 to 0x0 (Fully Opened, Extend)", sClientName);
  }
}

on sysvar sysvar::Functions::AuxValve29::svBlock
{
  if(Iso11783IL_TIMFunctionRequest(cAuxValve29, 0x7D80 ) != 0)
  {
    writeLineEx(cWriteTargetCaplPage, cWriteSeverityError, "%s: Failed to set AuxValve29 to 0x7D80 (Block)", sClientName);
  }
}

on sysvar sysvar::Functions::AuxValve29::svFullyOpenedRetract
{
  if(Iso11783IL_TIMFunctionRequest(cAuxValve29, 0xFB00 ) != 0)
  {
    writeLineEx(cWriteTargetCaplPage, cWriteSeverityError, "%s: Failed to set AuxValve29 to 0xFB00 (Fully Opened, Retract)", sClientName);
  }
}

on sysvar sysvar::Functions::AuxValve29::svFloat
{
  if(Iso11783IL_TIMFunctionRequest(cAuxValve29, 0xFB01 ) != 0)
  {
    writeLineEx(cWriteTargetCaplPage, cWriteSeverityError, "%s: Failed to set AuxValve29 to 0xFB01 (Float)", sClientName);
  }
}

///////////////////////////////////////////////////////////////////
// Aux Valve 30                                                  //
///////////////////////////////////////////////////////////////////

on sysvar sysvar::Functions::AuxValve30::svAssignFct
{
  if (@this == 0)
  {
    AssignFunction(cAuxValve30);
    EnableAssignOrUnassign(cAuxValve30, 0);
  }
}

on sysvar sysvar::Functions::AuxValve30::svUnassignFct
{
  if (@this == 0)
  {
    Iso11783IL_TIMUnassignFunction(cAuxValve30);   
    EnableAssignOrUnassign(cAuxValve30, 1);
    EnableControls_AuxValve(30, 0);
  }
}

on sysvar sysvar::Functions::AuxValve30::svReleaseControl
{
  if (@this == 1)
  {
    Iso11783IL_TIMFunctionRequest(cAuxValve30, cReleasedControlRequestingOperator);   
  }
  else
  {
    Iso11783IL_TIMFunctionRequest(cAuxValve30, cReadyToControl);   
  }
}

on sysvar sysvar::Functions::AuxValve30::svValue
{
  int result;
  
  result = SetCurrentAuxValveFlow(cAuxValve30, @this);
  if(result != 0)    
    writeLineEx(cWriteTargetCaplPage, cWriteSeverityError, "%s: Failed to set AuxValve30 to %f %%", sClientName, @this);
}

on sysvar sysvar::Functions::AuxValve30::svFullyOpenedExtend
{
  if(Iso11783IL_TIMFunctionRequest(cAuxValve30, 0x0 ) != 0)
  {
    writeLineEx(cWriteTargetCaplPage, cWriteSeverityError, "%s: Failed to set AuxValve30 to 0x0 (Fully Opened, Extend)", sClientName);
  }
}

on sysvar sysvar::Functions::AuxValve30::svBlock
{
  if(Iso11783IL_TIMFunctionRequest(cAuxValve30, 0x7D80 ) != 0)
  {
    writeLineEx(cWriteTargetCaplPage, cWriteSeverityError, "%s: Failed to set AuxValve30 to 0x7D80 (Block)", sClientName);
  }
}

on sysvar sysvar::Functions::AuxValve30::svFullyOpenedRetract
{
  if(Iso11783IL_TIMFunctionRequest(cAuxValve30, 0xFB00 ) != 0)
  {
    writeLineEx(cWriteTargetCaplPage, cWriteSeverityError, "%s: Failed to set AuxValve30 to 0xFB00 (Fully Opened, Retract)", sClientName);
  }
}

on sysvar sysvar::Functions::AuxValve30::svFloat
{
  if(Iso11783IL_TIMFunctionRequest(cAuxValve30, 0xFB01 ) != 0)
  {
    writeLineEx(cWriteTargetCaplPage, cWriteSeverityError, "%s: Failed to set AuxValve30 to 0xFB01 (Float)", sClientName);
  }
}

///////////////////////////////////////////////////////////////////
// Aux Valve 31                                                   //
///////////////////////////////////////////////////////////////////

on sysvar sysvar::Functions::AuxValve31::svAssignFct
{
  if (@this == 0)
  {
    AssignFunction(cAuxValve31);
    EnableAssignOrUnassign(cAuxValve31, 0);
  }
}

on sysvar sysvar::Functions::AuxValve31::svUnassignFct
{
  if (@this == 0)
  {
    Iso11783IL_TIMUnassignFunction(cAuxValve31);     
    EnableAssignOrUnassign(cAuxValve31, 1);
    EnableControls_AuxValve(31, 0);
  }
}

on sysvar sysvar::Functions::AuxValve31::svReleaseControl
{
  if (@this == 1)
  {
    Iso11783IL_TIMFunctionRequest(cAuxValve31, cReleasedControlRequestingOperator);   
  }
  else
  {
    Iso11783IL_TIMFunctionRequest(cAuxValve31, cReadyToControl);   
  }
}

on sysvar sysvar::Functions::AuxValve31::svValue
{
  int result;
  
  result = SetCurrentAuxValveFlow(cAuxValve31, @this);
  if(result != 0)    
    writeLineEx(cWriteTargetCaplPage, cWriteSeverityError, "%s: Failed to set AuxValve31 to %f %%", sClientName, @this);
}

on sysvar sysvar::Functions::AuxValve31::svFullyOpenedExtend
{
  if(Iso11783IL_TIMFunctionRequest(cAuxValve31, 0x0 ) != 0)
  {
    writeLineEx(cWriteTargetCaplPage, cWriteSeverityError, "%s: Failed to set AuxValve31 to 0x0 (Fully Opened, Extend)", sClientName);
  }
}

on sysvar sysvar::Functions::AuxValve31::svBlock
{
  if(Iso11783IL_TIMFunctionRequest(cAuxValve31, 0x7D80 ) != 0)
  {
    writeLineEx(cWriteTargetCaplPage, cWriteSeverityError, "%s: Failed to set AuxValve31 to 0x7D80 (Block)", sClientName);
  }
}

on sysvar sysvar::Functions::AuxValve31::svFullyOpenedRetract
{
  if(Iso11783IL_TIMFunctionRequest(cAuxValve31, 0xFB00 ) != 0)
  {
    writeLineEx(cWriteTargetCaplPage, cWriteSeverityError, "%s: Failed to set AuxValve31 to 0xFB00 (Fully Opened, Retract)", sClientName);
  }
}

on sysvar sysvar::Functions::AuxValve31::svFloat
{
  if(Iso11783IL_TIMFunctionRequest(cAuxValve31, 0xFB01 ) != 0)
  {
    writeLineEx(cWriteTargetCaplPage, cWriteSeverityError, "%s: Failed to set AuxValve31 to 0xFB01 (Float)", sClientName);
  }
}

///////////////////////////////////////////////////////////////////
// Aux Valve 32                                                   //
///////////////////////////////////////////////////////////////////

on sysvar sysvar::Functions::AuxValve32::svAssignFct
{
  if (@this == 0)
  {
    AssignFunction(cAuxValve32);
    EnableAssignOrUnassign(cAuxValve32, 0);
  }
}

on sysvar sysvar::Functions::AuxValve32::svUnassignFct
{
  if (@this == 0)
  {
    Iso11783IL_TIMUnassignFunction(cAuxValve32);       
    EnableAssignOrUnassign(cAuxValve32, 1); 
    EnableControls_AuxValve(32, 0);
  }
}

on sysvar sysvar::Functions::AuxValve32::svReleaseControl
{
  if (@this == 1)
  {
    Iso11783IL_TIMFunctionRequest(cAuxValve32, cReleasedControlRequestingOperator);   
  }
  else
  {
    Iso11783IL_TIMFunctionRequest(cAuxValve32, cReadyToControl);   
  }
}

on sysvar sysvar::Functions::AuxValve32::svValue
{
  int result;
  
  result = SetCurrentAuxValveFlow(cAuxValve32, @this);
  if(result != 0)    
    writeLineEx(cWriteTargetCaplPage, cWriteSeverityError, "%s: Failed to set AuxValve32 to %f %%", sClientName, @this);
}

on sysvar sysvar::Functions::AuxValve32::svFullyOpenedExtend
{
  if(Iso11783IL_TIMFunctionRequest(cAuxValve32, 0x0 ) != 0)
  {
    writeLineEx(cWriteTargetCaplPage, cWriteSeverityError, "%s: Failed to set AuxValve32 to 0x0 (Fully Opened, Extend)", sClientName);
  }
}

on sysvar sysvar::Functions::AuxValve32::svBlock
{
  if(Iso11783IL_TIMFunctionRequest(cAuxValve32, 0x7D80 ) != 0)
  {
    writeLineEx(cWriteTargetCaplPage, cWriteSeverityError, "%s: Failed to set AuxValve32 to 0x7D80 (Block)", sClientName);
  }
}

on sysvar sysvar::Functions::AuxValve32::svFullyOpenedRetract
{
  if(Iso11783IL_TIMFunctionRequest(cAuxValve32, 0xFB00 ) != 0)
  {
    writeLineEx(cWriteTargetCaplPage, cWriteSeverityError, "%s: Failed to set AuxValve32 to 0xFB00 (Fully Opened, Retract)", sClientName);
  }
}

on sysvar sysvar::Functions::AuxValve32::svFloat
{
  if(Iso11783IL_TIMFunctionRequest(cAuxValve32, 0xFB01 ) != 0)
  {
    writeLineEx(cWriteTargetCaplPage, cWriteSeverityError, "%s: Failed to set AuxValve32 to 0xFB01 (Float)", sClientName);
  }
}


int SetCurrentAuxValveFlow(int funcId, double auxValveFlow)
{
  int result;
  word rawValue;
  
  rawValue = _round(((auxValveFlow + 128.512) * 250.0));
  result = Iso11783IL_TIMFunctionRequest(funcId, rawValue );
  
  return result;
}


//////////////////////////////////////////////////////////
// Vehicle Speed                                        //
//////////////////////////////////////////////////////////

on sysvar sysvar::Functions::VehicleSpeed::svValue
{
  int result;
  
  result = SetVehicleSpeed(@this);
  if(result != 0)    
    writeLineEx(cWriteTargetCaplPage, cWriteSeverityError, "%s: Failed to set Vehicle Speed to %f m/s", sClientName, @this);
  
}

on sysvar sysvar::Functions::VehicleSpeed::svForwardSetByServer
{
  if(Iso11783IL_TIMFunctionRequest(cVehicleSpeed, 0xFB00 ) != 0)
  {
    writeLineEx(cWriteTargetCaplPage, cWriteSeverityError, "%s: Failed to set VehicleSpeed to 0xFB00 (Forward speed set by TIM Server)", sClientName);
    
  }
}

on sysvar sysvar::Functions::VehicleSpeed::svReverseSetByServer
{
  if(Iso11783IL_TIMFunctionRequest(cVehicleSpeed, 0x0 ) != 0)
  {
    writeLineEx(cWriteTargetCaplPage, cWriteSeverityError, "%s: Failed to set VehicleSpeed to 0x0 (Reverse speed set by TIM Server)", sClientName);
  }
}

on sysvar sysvar::Functions::VehicleSpeed::svStop
{
  if(Iso11783IL_TIMFunctionRequest(cVehicleSpeed, 0x7D80 ) != 0)
  {
    writeLineEx(cWriteTargetCaplPage, cWriteSeverityError, "%s: Failed to set VehicleSpeed to 0x7D80 (Stop)", sClientName);
  }
}

on sysvar sysvar::Functions::VehicleSpeed::svAssignFct
{
  if (@this == 0)
  {
    AssignFunction(cVehicleSpeed);
    EnableAssignOrUnassign(cVehicleSpeed, 0); 
  }
}

on sysvar sysvar::Functions::VehicleSpeed::svUnassignFct
{
  if (@this == 0)
  {
    Iso11783IL_TIMUnassignFunction(cVehicleSpeed);    
    EnableAssignOrUnassign(cVehicleSpeed, 1); 
    EnableControls_VehicleSpeed(0);
  }
}

on sysvar sysvar::Functions::VehicleSpeed::svReleaseControl
{
  if (@this == 1)
  {
    Iso11783IL_TIMFunctionRequest(cVehicleSpeed, cReleasedControlRequestingOperator);   
  }
  else
  {
    Iso11783IL_TIMFunctionRequest(cVehicleSpeed, cReadyToControl);   
  }
}

on sysvar sysvar::Functions::VehicleSpeed::svReleaseControlWithoutAwareness
{
  if (@this == 0)
  {
    Iso11783IL_TIMFunctionRequest(cVehicleSpeed, cReleasedControlAndAcceptFunctionValueIncrease);   
  }
}

int SetVehicleSpeed(double speed)
{
  int result;
  word rawValue;
  
  rawValue = (@Functions::VehicleSpeed::svValue + 32.128) * 1000;
  result = Iso11783IL_TIMFunctionRequest(cVehicleSpeed, rawValue );
  return result;
}

//////////////////////////////////////////////////////////
// External Guidance                                        //
//////////////////////////////////////////////////////////

on sysvar sysvar::Functions::ExtGuidance::svCurvature
{
  int result;
  
  result = SetExtGuidanceCurvature(@this);
  if(result != 0)    
    writeLineEx(cWriteTargetCaplPage, cWriteSeverityError, "%s: Failed to set External Guidance Curvature to %f 1/km", sClientName, @this);
  
}

int SetExtGuidanceCurvature(double extGuidanceCurvature)
{
  int result;
  word rawValue;
  
  rawValue = (@Functions::ExtGuidance::svCurvature + 8032) * 4;
  result = Iso11783IL_TIMFunctionRequest(cExternalGuidance, rawValue );
  return result;
}

on sysvar sysvar::Functions::ExtGuidance::svAssignFct
{
  if (@this == 0)
  {
    AssignFunction(cExternalGuidance);
    EnableAssignOrUnassign(cExternalGuidance, 0); 
  }
}

on sysvar sysvar::Functions::ExtGuidance::svUnassignFct
{
  if (@this == 0)
  {
    Iso11783IL_TIMUnassignFunction(cExternalGuidance); 
    EnableAssignOrUnassign(cExternalGuidance, 1); 
    EnableControls_ExtGuidance(0);
  }
}

on sysvar sysvar::Functions::ExtGuidance::svReleaseControl
{
  if (@this == 1)
  {
    Iso11783IL_TIMFunctionRequest(cExternalGuidance, cReleasedControlRequestingOperator);   
  }
  else
  {
    Iso11783IL_TIMFunctionRequest(cExternalGuidance, cReadyToControl);   
  }
}

////////////////////////////////////////////////////////
//            Rear Top Linkage                        //
////////////////////////////////////////////////////////

on sysvar sysvar::Functions::RearTopLinkage::svAssignFct
{
  if (@this == 0)
  {
    AssignFunction(cRearTopLinkage);
    EnableAssignOrUnassign(cRearTopLinkage, 0); 
  }
}

on sysvar sysvar::Functions::RearTopLinkage::svUnassignFct
{
  if (@this == 0)
  {
    Iso11783IL_TIMUnassignFunction(cRearTopLinkage);    
    EnableAssignOrUnassign(cRearTopLinkage, 1); 
    EnableControls_RearTopLinkage(0);
  }
}

on sysvar sysvar::Functions::RearTopLinkage::svReleaseControl
{
  if (@this == 1)
  {
    Iso11783IL_TIMFunctionRequest(cRearTopLinkage, cReleasedControlRequestingOperator);   
  }
  else
  {
    Iso11783IL_TIMFunctionRequest(cRearTopLinkage, cReadyToControl);   
  }
}

on sysvar sysvar::Functions::RearTopLinkage::svPosition
{
  int result;
  
  result = SetTopLinkagePosition(cRearTopLinkage, @this);
  if(result != 0)    
    writeLineEx(cWriteTargetCaplPage, cWriteSeverityError, "%s: Failed to set Rear Top Linkage to %f %%", sClientName, @this);
}

on sysvar sysvar::Functions::RearTopLinkage::svFloat
{
  if(Iso11783IL_TIMFunctionRequest(cRearTopLinkage, 0xFB00 ) != 0)
  {
    writeLineEx(cWriteTargetCaplPage, cWriteSeverityError, "%s: Failed to set Rear Top Linkage to 0xFB00 (Float)", sClientName);
  }
}

on sysvar sysvar::Functions::RearTopLinkage::svStop
{
  if(Iso11783IL_TIMFunctionRequest(cRearTopLinkage, 0xFB01 ) != 0)
  {
    writeLineEx(cWriteTargetCaplPage, cWriteSeverityError, "%s: Failed to set Rear Top Linkage to 0xFB01 (Stop)", sClientName);
  }
}

on sysvar sysvar::Functions::RearTopLinkage::svRetractUntilStop
{
  if(Iso11783IL_TIMFunctionRequest(cRearTopLinkage, 0xFB02 ) != 0)
  {
    writeLineEx(cWriteTargetCaplPage, cWriteSeverityError, "%s: Failed to set Rear Top Linkage to 0xFB02 (Lower until Stop request)", sClientName);
  }
}

on sysvar sysvar::Functions::RearTopLinkage::svExtendUntilStop
{
  if(Iso11783IL_TIMFunctionRequest(cRearTopLinkage, 0xFB03 ) != 0)
  {
    writeLineEx(cWriteTargetCaplPage, cWriteSeverityError, "%s: Failed to set Rear Top Linkage to 0xFB03 (Raise until Stop request)", sClientName);
  }
}

////////////////////////////////////////////////////////
//            Front Top Linkage                       //
////////////////////////////////////////////////////////

on sysvar sysvar::Functions::FrontTopLinkage::svAssignFct
{
  if (@this == 0)
  {
    AssignFunction(cFrontTopLinkage);
    EnableAssignOrUnassign(cFrontTopLinkage, 0); 
  }
}

on sysvar sysvar::Functions::FrontTopLinkage::svUnassignFct
{
  if (@this == 0)
  {
    Iso11783IL_TIMUnassignFunction(cFrontTopLinkage);  
    EnableAssignOrUnassign(cFrontTopLinkage, 1);
    EnableControls_FrontTopLinkage(0);
  }
}

//Wna: Jetzt muss ich bei allen "on svAssign" und "on svUnassign" und "on pg 0x3d00" die Funktion EnableAssignOrUnassign() aufrufen
/*
if "Assign" is activate, then "Unassign has te be deactivated
*/
void EnableAssignOrUnassign(byte functionId, byte enableAssign)
{
  char functionName[64], btnAssign[64], btnUnassign[64];
  GetFunctionNameByFunctionId(functionId, functionName);
  snprintf(btnAssign, elcount(btnAssign), "btn%s_Assign", functionName); 
  snprintf(btnUnassign, elcount(btnUnassign), "btn%s_Unassign", functionName); 
  
  if(functionId <= 32)
  {
    EnableControlOnTwoPanels(sPanelNameClient, sPanelNameAuxValves, btnAssign, enableAssign);
    EnableControlOnTwoPanels(sPanelNameClient, sPanelNameAuxValves, btnUnassign, 1-enableAssign);
  }
  else
  {
    EnableControl(sPanelNameClient, btnAssign, enableAssign);
    EnableControl(sPanelNameClient, btnUnassign, 1-enableAssign);
  }
}

on sysvar sysvar::Functions::FrontTopLinkage::svReleaseControl
{
  if (@this == 1)
  {
    Iso11783IL_TIMFunctionRequest(cFrontTopLinkage, cReleasedControlRequestingOperator);   
  }
  else
  {
    Iso11783IL_TIMFunctionRequest(cFrontTopLinkage, cReadyToControl);   
  }
}

on sysvar sysvar::Functions::FrontTopLinkage::svPosition
{
  int result;
  
  result = SetTopLinkagePosition(cFrontTopLinkage, @this);
  if(result != 0)    
    writeLineEx(cWriteTargetCaplPage, cWriteSeverityError, "%s: Failed to set Front Top Linkage to %f %%", sClientName, @this);
}

on sysvar sysvar::Functions::FrontTopLinkage::svFloat
{
  if(Iso11783IL_TIMFunctionRequest(cFrontTopLinkage, 0xFB00 ) != 0)
  {
    writeLineEx(cWriteTargetCaplPage, cWriteSeverityError, "%s: Failed to set Front Top Linkage to 0xFB00 (Float)", sClientName);
  }
}

on sysvar sysvar::Functions::FrontTopLinkage::svStop
{
  if(Iso11783IL_TIMFunctionRequest(cFrontTopLinkage, 0xFB01 ) != 0)
  {
    writeLineEx(cWriteTargetCaplPage, cWriteSeverityError, "%s: Failed to set Front Top Linkage to 0xFB01 (Stop)", sClientName);
  }
}

on sysvar sysvar::Functions::FrontTopLinkage::svRetractUntilStop
{
  if(Iso11783IL_TIMFunctionRequest(cFrontTopLinkage, 0xFB02 ) != 0)
  {
    writeLineEx(cWriteTargetCaplPage, cWriteSeverityError, "%s: Failed to set Front Top Linkage to 0xFB02 (Lower until Stop request)", sClientName);
  }
}

on sysvar sysvar::Functions::FrontTopLinkage::svExtendUntilStop
{
  if(Iso11783IL_TIMFunctionRequest(cFrontTopLinkage, 0xFB03 ) != 0)
  {
    writeLineEx(cWriteTargetCaplPage, cWriteSeverityError, "%s: Failed to set Front Top Linkage to 0xFB03 (Raise until Stop request)", sClientName);
  }
}


int SetTopLinkagePosition(int funcId, double topLinkagePos)
{
  int result;
  word rawValue;
  
  rawValue = topLinkagePos * 100.0;
  result = Iso11783IL_TIMFunctionRequest(funcId, rawValue );
  
  return result;
}

int SetTopLinkageState(int funcId, word topLinkageState)
{
  return Iso11783IL_TIMFunctionRequest(funcId, topLinkageState);
}


on sysvar sysvar::svSetAllRequiredFacilities
{
  SetAllAuxValveFacilities(1);

  @RequiredFacilities::FrontPTO::svDisengagement = 1;
  @RequiredFacilities::FrontPTO::svEngagementCounterClockwise = 1;
  @RequiredFacilities::FrontPTO::svEngagementClockwise = 1;
  @RequiredFacilities::FrontPTO::svSpeedCounterClockwise = 1;
  @RequiredFacilities::FrontPTO::svSpeedClockwise = 1;
  @RequiredFacilities::RearPTO::svDisengagement = 1;
  @RequiredFacilities::RearPTO::svEngagementCounterClockwise = 1;
  @RequiredFacilities::RearPTO::svEngagementClockwise = 1;
  @RequiredFacilities::RearPTO::svSpeedCounterClockwise = 1;
  @RequiredFacilities::RearPTO::svSpeedClockwise = 1;
  @RequiredFacilities::FrontHitch::svMotion = 1;
  @RequiredFacilities::FrontHitch::svPosition = 1;
  @RequiredFacilities::RearHitch::svMotion = 1;
  @RequiredFacilities::RearHitch::svPosition = 1;
  @RequiredFacilities::VehicleSpeed::svForwardDirection = 1;
  @RequiredFacilities::VehicleSpeed::svReverseDirection = 1;
  @RequiredFacilities::VehicleSpeed::svStopMotion = 1;
  @RequiredFacilities::VehicleSpeed::svStartMotion = 1;
  @RequiredFacilities::VehicleSpeed::svForwardSpeed = 1;
  @RequiredFacilities::VehicleSpeed::svReverseSpeed = 1;
//  @RequiredFacilities::VehicleSpeed::svChangeOfDirection = 1;
  @RequiredFacilities::ExtGuidance::svCurvature = 1;
  @RequiredFacilities::FrontTopLinkage::svMotion = 1;
  @RequiredFacilities::FrontTopLinkage::svPosition = 1;
  @RequiredFacilities::RearTopLinkage::svMotion = 1;
  @RequiredFacilities::RearTopLinkage::svPosition = 1;
}

on sysvar sysvar::svSetAllAuxValveRequiredFacilities
{
  SetAllAuxValveFacilities(1);
}

on sysvar sysvar::svResetAllRequiredFacilities
{
  SetAllAuxValveFacilities(0);
  
  @RequiredFacilities::FrontPTO::svDisengagement = 0;
  @RequiredFacilities::FrontPTO::svEngagementCounterClockwise = 0;
  @RequiredFacilities::FrontPTO::svEngagementClockwise = 0;
  @RequiredFacilities::FrontPTO::svSpeedCounterClockwise = 0;
  @RequiredFacilities::FrontPTO::svSpeedClockwise = 0;
  @RequiredFacilities::RearPTO::svDisengagement = 0;
  @RequiredFacilities::RearPTO::svEngagementCounterClockwise = 0;
  @RequiredFacilities::RearPTO::svEngagementClockwise = 0;
  @RequiredFacilities::RearPTO::svSpeedCounterClockwise = 0;
  @RequiredFacilities::RearPTO::svSpeedClockwise = 0;
  @RequiredFacilities::FrontHitch::svMotion = 0;
  @RequiredFacilities::FrontHitch::svPosition = 0;
  @RequiredFacilities::RearHitch::svMotion = 0;
  @RequiredFacilities::RearHitch::svPosition = 0;
  @RequiredFacilities::VehicleSpeed::svForwardDirection = 0;
  @RequiredFacilities::VehicleSpeed::svReverseDirection = 0;
  @RequiredFacilities::VehicleSpeed::svStopMotion = 0;
  @RequiredFacilities::VehicleSpeed::svStartMotion = 0;
  @RequiredFacilities::VehicleSpeed::svForwardSpeed = 0;
  @RequiredFacilities::VehicleSpeed::svReverseSpeed = 0;
  @RequiredFacilities::VehicleSpeed::svChangeOfDirection = 0;
  @RequiredFacilities::ExtGuidance::svCurvature = 0;
  @RequiredFacilities::FrontTopLinkage::svMotion = 0;
  @RequiredFacilities::FrontTopLinkage::svPosition = 0;
  @RequiredFacilities::RearTopLinkage::svMotion = 0;
  @RequiredFacilities::RearTopLinkage::svPosition = 0;
}

on sysvar sysvar::svResetAllAuxValveRequiredFacilities
{
  SetAllAuxValveFacilities(0);
}

on sysvar sysvar::svTIMClientState
{  
  if(@this == 54) // Client state switches to AuthenticationSucceeded
  {
    if(@svAssignAllFunctionsAutomatically == 1)
    {
      AssignAndEnableRequiredFunctions();
    }
    else
    {
      EnableCommonControlForEveryFunction("btn%s_Assign", 1);
      ActivateControlColors(sPanelNameClient, "btnOperatorEnable");
      setControlForeColor(sPanelNameClient, "txtAssignFunctions", makeRGB(0, 150, 0));
    }
  }
}

/*
For each TIM function, the name of a control is created according to the specified pattern and this control is activated or deactivated.
Only controls that occur for each function can be addressed here.
Therefore, the following patterns are currently possible:
  "btn%s_Assign"
  "btn%s_Unassign"
  "swControlReleased_%s"
  "grp%s"
*/
void EnableCommonControlForEveryFunction(char controlNamePatternFormat[], word enable)
{
  char controlName[100];
  EnableCommonControlForAuxValveFunctionsUsingPattern(controlNamePatternFormat, enable);
  EnableCommonControlUsingPattern(sPanelNameClient, "FrontPTO",         enable, controlNamePatternFormat);
  EnableCommonControlUsingPattern(sPanelNameClient, "RearPTO",          enable, controlNamePatternFormat);
  EnableCommonControlUsingPattern(sPanelNameClient, "FrontHitch",       enable, controlNamePatternFormat);
  EnableCommonControlUsingPattern(sPanelNameClient, "RearHitch",        enable, controlNamePatternFormat);
  EnableCommonControlUsingPattern(sPanelNameClient, "VehicleSpeed",     enable, controlNamePatternFormat);
  EnableCommonControlUsingPattern(sPanelNameClient, "ExtGuidance",      enable, controlNamePatternFormat);
  EnableCommonControlUsingPattern(sPanelNameClient, "FrontTopLinkage",  enable, controlNamePatternFormat);
  EnableCommonControlUsingPattern(sPanelNameClient, "RearTopLinkage",   enable, controlNamePatternFormat);
}

/*
For each TIM function, the name of a control is created according to the specified pattern and this control is activated or deactivated.
Examples for control patterns:
  "btn%s_Assign"
  "grp%s"
*/
void EnableCommonControlForAuxValveFunctionsUsingPattern(char controlNamePatternFormat[], word enable)
{
  byte valveNumber;
  char controlName[100];
  for (valveNumber = 1; valveNumber<=32; ++valveNumber)
  {
    snprintf(controlName, elcount(controlName), "AuxValve%02d", valveNumber); 
    EnableCommonControlUsingPattern(sPanelNameClient, controlName, enable, controlNamePatternFormat);
    EnableCommonControlUsingPattern(sPanelNameAuxValves, controlName, enable, controlNamePatternFormat);
  }
}

/*
*/
void EnableCommonControlUsingPattern(char panelName[], char functionName[], word enable, char controlNamePatternFormat[])
{
  char controlName[100];
  snprintf(controlName, elcount(controlName), controlNamePatternFormat, functionName); 
  EnableControl(panelName, controlName, enable);
}

void AssignAndEnableRequiredFunctions()
{
  byte valveNumber;

  //assign all enabled facilities
  for (valveNumber = 1; valveNumber<=32; ++valveNumber)
  {
    AssignFunctionIfRequired(valveNumber, sRequiredAuxValve[valveNumber]);
  }
  AssignFunctionIfRequired(cFrontPTO, sRequiredFrontPTO);
  AssignFunctionIfRequired(cRearPTO, sRequiredRearPTO);
  AssignFunctionIfRequired(cFrontHitch, sRequiredFrontHitch);
  AssignFunctionIfRequired(cRearHitch, sRequiredRearHitch);
  AssignFunctionIfRequired(cVehicleSpeed, sRequiredVehicleSpeed);
  AssignFunctionIfRequired(cExternalGuidance, sRequiredExtGuidance);
  if(@svImplementedVersion > 1)
  {
    AssignFunctionIfRequired(cFrontTopLinkage, sRequiredFrontTopLinkage);
    AssignFunctionIfRequired(cRearTopLinkage, sRequiredRearTopLinkage);
  }
  
  //Now enable it
  if(@svIdentifyTIMServerByAddress == 0)
    Iso11783IL_TIMOperatorEnable(TIMServer);
  else
    Iso11783IL_TIMOperatorEnable(@svAddressOfTIMServer);
}

on sysvar sysvar::svOpenAuxValvesPanel
{
  if (@this == 0)
  {
    openPanel(sPanelNameAuxValves);
  }
}

on sysvar sysvar::Functions::VehicleSpeed::svParametrizationRequest
{
  if (@this == 0)
  {
    SendParametrizationRequest(cVehicleSpeed);
  }
}

on sysvar sysvar::Functions::FrontTopLinkage::svParametrizationRequest
{
  if (@this == 0)
  {
    SendParametrizationRequest(cFrontTopLinkage);
  }
}

on sysvar sysvar::Functions::RearTopLinkage::svParametrizationRequest
{
  if (@this == 0)
  {
    SendParametrizationRequest(cRearTopLinkage);
  }
}


///////////////////////////////////////////////////////////
// Functions
///////////////////////////////////////////////////////////

void SetAllAuxValveFacilities(byte enable)
{
  byte valveNumber;
  char valveNamespace[100];
  for (valveNumber = 1; valveNumber<=32; ++valveNumber)
  {
    snprintf(valveNamespace, elcount(valveNamespace), "%s::RequiredFacilities::AuxValve%02d", sClientNamespace, valveNumber);
    if (sysSetVariableDWord(valveNamespace, "svState", enable) != 0)
    {
      writeLineEx(cWriteTargetCaplPage, cWriteSeverityError, "%s: Failed to set state value of %s", sClientName, valveNamespace);
    }      
    if (sysSetVariableDWord(valveNamespace, "svFlow", enable) != 0)
    {
      writeLineEx(cWriteTargetCaplPage, cWriteSeverityError, "%s: Failed to set flow value of %s", sClientName, valveNamespace);
    }     
  } 
}

void AssignFunctionIfRequired(int functionId, int required)
{
  if(required)
  {
    AssignFunction(functionId);
  }
}

void AssignFunction(int function)
{
  if(@svIdentifyTIMServerByAddress == 0)
  {
    Iso11783IL_TIMAssignFunction(function, TIMServer);
  }
  else
  {
    Iso11783IL_TIMAssignFunction(function, @svAddressOfTIMServer);
  }
}

void StartClient()
{
  dword fileHandle;

  Plugin_StartClient();
  ReflectRequiredFacilitiesByVisibility();
  EnableAllFunctionGroups(0);
  
  sNumOfReqForTestlabCertToIgnore        = @svNumOfIgnRqstForTestlab;
  sNumOfReqForManufactCertToIgnore       = @svNumOfIgnRqstForManufact;  
  sNumOfReqForManufactSeriesCertToIgnore = @svNumOfIgnRqstForManufactSeries;  
  sNumOfReqForDeviceCertToIgnore         = @svNumOfIgnRqstForDevice;  

  DefaultPreparationSequence_Client();
  
  {
    char varNameWithNamespace[100];
    snprintf(varNameWithNamespace, elcount(varNameWithNamespace), "%s::svTIMClientState", sClientNamespace);
    
    if(@svIdentifyTIMServerByAddress == 0)
      Iso11783IL_TIMConnectSysVarToState(TIMServer, varNameWithNamespace);
    else
      Iso11783IL_TIMConnectSysVarToState(@svAddressOfTIMServer, varNameWithNamespace);
  }
  
  // load LwA key table if file exists
  fileHandle = openFileRead(sLwATableFile, 0);
  if (fileHandle)
  {
    fileClose(fileHandle);
    Iso11783IL_TIMLoadLwATable(sLwATableFile);
  }
  
  if(@svTIMClientFreezeState > 0)
  {
    if(@svIdentifyTIMServerByAddress == 0)
      Iso11783IL_TIMFreezeConnection(TIMServer, @svTIMClientFreezeState);
    else
      Iso11783IL_TIMFreezeConnection(@svAddressOfTIMServer, @svTIMClientFreezeState);
  }
  
  if(@svIdentifyTIMServerByAddress == 0)
    Iso11783IL_TIMConnectToServer(TIMServer);
  else
    Iso11783IL_TIMConnectToServer(@svAddressOfTIMServer);
}

void ReconnectClientToServer()
{ 
  SetRequiredFunctionFacilities();
  ReflectRequiredFacilitiesByVisibility();
  ControlReleased_ResetAll(); //Set all “Control released” switches to “Off”
  EnableAllFunctionGroups(0);
  
  if(@svIdentifyTIMServerByAddress == 0)
  {
    Iso11783IL_TIMConnectToServer(TIMServer);
  }
  else
  {
    Iso11783IL_TIMConnectToServer(@svAddressOfTIMServer);
  }
}

void StopClient()
{
  byte useGracefulShutown;
  useGracefulShutown = Plugin_ClientIsConfiguredFromCT() ? 0 : 1;
  
  if(@svIdentifyTIMServerByAddress == 0)
  {
    Iso11783IL_TIMDisconnectFromServer(TIMServer, useGracefulShutown);
  }
  else
  {
    Iso11783IL_TIMDisconnectFromServer(@svAddressOfTIMServer, useGracefulShutown);
  }
  ReflectRequiredFacilitiesByVisibility_Reset();
  EnableAllFunctionGroups(1);

 Plugin_StopClient();
}

/*
- all user settings (tabs "Settings" and "Behavior") are applied
- all controls on the “Settings” tab are then set to read-only.
- Controls for functions that are not required are hidden
*/
void DefaultPreparationSequence_Client()
{
  char buf[100], version[100];
  
  UpdateDeactivatedCertificateChecks();

  Iso11783IL_TIMSetProperty("useRequestCounter", @svUseRequestCounter);

  Iso11783IL_TIMSetProperty("minimumVersion", @svMinimumVersion);
  Iso11783IL_TIMSetProperty("implementedVersion", @svImplementedVersion);
  Iso11783IL_TIMSetProperty("minimumAuthVersion", @svMinimumAuthVersion);
  Iso11783IL_TIMSetProperty("implementedAuthVersion", @svImplementedAuthVersion);
  //Set product identification
  sysGetVariableString(sysvar::svProductIdentification, buf, elcount(buf));
  Iso11783IL_TIMSetProductIdentification(buf);

  //Set compliance information
  Iso11783IL_TIMSetComplianceCertification( @svCCITestProtocolPublicationYear, 
                                            @svCCITestProtocolRevision, 
                                            @svCCILaboratoryType, 
                                            @svCCILaboratoryID, 
                                            @svCCIReferenceNumber);
  
  // Set sequence of requested certficates
  if (Iso11783IL_TIMSetCertificateSequence( @svCertificateType1, 
                                            @svCertificateType2, 
                                            @svCertificateType3, 
                                            @svCertificateType4) != 0)
  {
    writeLineEx(cWriteTargetCaplPage, cWriteSeverityError, "%s: Failed to set certificate sequence", sClientName);
  }
  
  //Set required functions
  CheckRequiredFunctions();
  if (!Plugin_ClientIsConfiguredFromCT())
  {
     SetRequiredFunctionFacilities();
  }
//  ReflectRequiredFacilitiesByVisibility();
  ControlReleased_ResetAll(); //Set all “Control released” switches to “Off”
  
  // Define which functions have to be assigned to which server
  Iso11783IL_TIMUnAssignFunction(-1);
   
  // Set root certificates
  sysGetVariableString(sysvar::svRootCertificate, buf, elcount(buf));
  Iso11783IL_TIMAddCertificate(cCertificateType_AEFRoot, buf);     
  
  // Set test lab certifiates 
  sysGetVariableString(sysvar::svAEFTestlabCertificate, buf, elcount(buf));
  Iso11783IL_TIMAddCertificate(cCertificateType_Testlab, buf); 
  
  // Set manufacturer certificate
  sysGetVariableString(sysvar::svManufacturerCertificate, buf, elcount(buf));
  Iso11783IL_TIMAddCertificate(cCertificateType_Manufacturer, buf);
  
  // Set manufacturer series certificate (if there is one)
  sysGetVariableString(sysvar::svManufacturerSeriesCertificate, buf, elcount(buf));
  if (strncmp(buf, "-", elcount(buf)) == 0)
  {
    Iso11783IL_TIMRemoveCertificate(cCertificateType_ManufacturerSeries);
  }
  else if (strlen(buf) > 0)
  {
    Iso11783IL_TIMAddCertificate(cCertificateType_ManufacturerSeries, buf);
  }
  
  // Set device certificate
  sysGetVariableString(sysvar::svDeviceCertificate, buf, elcount(buf));
  Iso11783IL_TIMAddCertificate(cCertificateType_Device, buf);
  
  // Set server private key
  sysGetVariableString(sysvar::svPrivateKey, buf, elcount(buf));
  Iso11783IL_TIMSetPrivateKey(buf);
  
  // Set CRL Signing
  sysGetVariableString(sysvar::svCRLSigningCertificate, buf, elcount(buf));
  Iso11783IL_TIMAddCertificate(cCertificateType_CRLSigning, buf);   
  
  // Set CRL
  sysGetVariableString(sysvar::svCRLCertificate, buf, elcount(buf));
  Iso11783IL_TIMSetCRL(cCRLType_CRL, buf);                             

  // Set CRL Sub CA
  sysGetVariableString(sysvar::svCRLSubCACertificate, buf, elcount(buf));
  Iso11783IL_TIMSetCRL(cCRLType_CRLSignCA, buf);                
}

/*
connect system variable to function states
*/
void  ConnectSysVarsToFunctionState()
{
  // connect system variable to function states
  ConnectSystemVariablesToAllAuxValveStates();
  {
    char varNameWithNamespace[100];
    
    snprintf(varNameWithNamespace, elcount(varNameWithNamespace), "%s::Functions::FrontPTO::svState", sClientNamespace);
    Iso11783IL_TIMConnectSysVarToFunctionState(cFrontPTO, varNameWithNamespace);

    snprintf(varNameWithNamespace, elcount(varNameWithNamespace), "%s::Functions::RearPTO::svState", sClientNamespace);
    Iso11783IL_TIMConnectSysVarToFunctionState(cRearPTO, varNameWithNamespace);
    
    snprintf(varNameWithNamespace, elcount(varNameWithNamespace), "%s::Functions::FrontHitch::svState", sClientNamespace);
    Iso11783IL_TIMConnectSysVarToFunctionState(cFrontHitch, varNameWithNamespace);
    
    snprintf(varNameWithNamespace, elcount(varNameWithNamespace), "%s::Functions::RearHitch::svState", sClientNamespace);
    Iso11783IL_TIMConnectSysVarToFunctionState(cRearHitch, varNameWithNamespace);
    
    snprintf(varNameWithNamespace, elcount(varNameWithNamespace), "%s::Functions::VehicleSpeed::svState", sClientNamespace);
    Iso11783IL_TIMConnectSysVarToFunctionState(cVehicleSpeed, varNameWithNamespace);
    
    snprintf(varNameWithNamespace, elcount(varNameWithNamespace), "%s::Functions::ExtGuidance::svState", sClientNamespace);
    Iso11783IL_TIMConnectSysVarToFunctionState(cExternalGuidance, varNameWithNamespace);
    
    snprintf(varNameWithNamespace, elcount(varNameWithNamespace), "%s::Functions::FrontTopLinkage::svState", sClientNamespace);
    Iso11783IL_TIMConnectSysVarToFunctionState(cFrontTopLinkage, varNameWithNamespace);
    
    snprintf(varNameWithNamespace, elcount(varNameWithNamespace), "%s::Functions::RearTopLinkage::svState", sClientNamespace);
    Iso11783IL_TIMConnectSysVarToFunctionState(cRearTopLinkage, varNameWithNamespace);
  }
}

void ConnectSystemVariablesToAllAuxValveStates()
{
  byte valveNumber;
  char valveStateWithNamespace[100];
  
  for (valveNumber = 1; valveNumber<=32; ++valveNumber)
  {
    snprintf(valveStateWithNamespace, elcount(valveStateWithNamespace), "%s::Functions::AuxValve%02d::svState", sClientNamespace, valveNumber);
    Iso11783IL_TIMConnectSysVarToFunctionState(valveNumber, valveStateWithNamespace);
  }
}

/*
Set all “Control released” switches to “Off”
*/
void ControlReleased_ResetAll()
{
  byte valveNumber;
  char valveNamespace[100];
  for (valveNumber = 1; valveNumber<=32; ++valveNumber)
  {
    snprintf(valveNamespace, elcount(valveNamespace), "%s::Functions::AuxValve%02d", sClientNamespace, valveNumber);
    if (sysSetVariableDWord(valveNamespace, "svReleaseControl", 0) != 0)
    {
      writeLineEx(cWriteTargetCaplPage, cWriteSeverityError, "TIM Server: Failed to set release control value of %s", valveNamespace);
    }
  } 
  
  @Functions::FrontPTO::svReleaseControl = 0;
  @Functions::RearPTO::svReleaseControl = 0;

  @Functions::FrontHitch::svReleaseControl = 0;
  @Functions::RearHitch::svReleaseControl = 0;
  
  @Functions::VehicleSpeed::svReleaseControl = 0;
  
  @Functions::ExtGuidance::svReleaseControl = 0;

  @Functions::FrontTopLinkage::svReleaseControl = 0;
  @Functions::RearTopLinkage::svReleaseControl = 0;
}

void CheckRequiredFunctions()
{
  byte valveNumber;
  char valveNamespace[100], facilityStateName[30], facilityFlowName[30];
  dword stateValue, flowValue;

  for (valveNumber = 1; valveNumber<=32; ++valveNumber)
  {
    snprintf(valveNamespace, elcount(valveNamespace), "%s::RequiredFacilities::AuxValve%02d", sClientNamespace, valveNumber); 
    stateValue = sysGetVariableDWord(valveNamespace, "svState");
    flowValue  = sysGetVariableDWord(valveNamespace, "svFlow");
    sRequiredAuxValve[valveNumber] = stateValue | flowValue;
  }
  
  sRequiredFrontPTO = ( @RequiredFacilities::FrontPTO::svDisengagement ||
                        @RequiredFacilities::FrontPTO::svEngagementCounterClockwise ||
                        @RequiredFacilities::FrontPTO::svEngagementClockwise ||
                        @RequiredFacilities::FrontPTO::svSpeedCounterClockwise ||
                        @RequiredFacilities::FrontPTO::svSpeedClockwise);
  
  sRequiredRearPTO = (  @RequiredFacilities::RearPTO::svDisengagement ||
                        @RequiredFacilities::RearPTO::svEngagementCounterClockwise ||
                        @RequiredFacilities::RearPTO::svEngagementClockwise ||
                        @RequiredFacilities::RearPTO::svSpeedCounterClockwise ||
                        @RequiredFacilities::RearPTO::svSpeedClockwise);
  
  sRequiredFrontHitch = ( @RequiredFacilities::FrontHitch::svMotion ||
                          @RequiredFacilities::FrontHitch::svPosition);
  
  sRequiredRearHitch = (@RequiredFacilities::RearHitch::svMotion ||
                        @RequiredFacilities::RearHitch::svPosition);
  
  sRequiredVehicleSpeed = ( @RequiredFacilities::VehicleSpeed::svForwardSpeed ||
                            @RequiredFacilities::VehicleSpeed::svReverseSpeed ||
                            @RequiredFacilities::VehicleSpeed::svStartMotion ||
                            @RequiredFacilities::VehicleSpeed::svStopMotion ||
                            @RequiredFacilities::VehicleSpeed::svForwardDirection ||
                            @RequiredFacilities::VehicleSpeed::svReverseDirection);
  
  sRequiredExtGuidance = @RequiredFacilities::ExtGuidance::svCurvature;

  sRequiredFrontTopLinkage = ( @RequiredFacilities::FrontTopLinkage::svMotion ||
                          @RequiredFacilities::FrontTopLinkage::svPosition);
  
  sRequiredRearTopLinkage = (@RequiredFacilities::RearTopLinkage::svMotion ||
                        @RequiredFacilities::RearTopLinkage::svPosition);
}

void SetRequiredFunctionFacilities()
{
  //Set required functions
  
  Iso11783IL_TIMResetAllRequiredFunctions();
  
  SetRequiredAuxValvuesFacilities();
  
  // Front PTO
  if( sRequiredFrontPTO)
  {
    Iso11783IL_TIMSetRequiredFacility("frontPTODisengagement",             @RequiredFacilities::FrontPTO::svDisengagement);
    Iso11783IL_TIMSetRequiredFacility("frontPTOEngagementCounterClockwise",@RequiredFacilities::FrontPTO::svEngagementCounterClockwise);
    Iso11783IL_TIMSetRequiredFacility("frontPTOEngagementClockwise",       @RequiredFacilities::FrontPTO::svEngagementClockwise);
    Iso11783IL_TIMSetRequiredFacility("frontPTOSpeedCounterClockwise",     @RequiredFacilities::FrontPTO::svSpeedCounterClockwise);
    Iso11783IL_TIMSetRequiredFacility("frontPTOSpeedClockwise",            @RequiredFacilities::FrontPTO::svSpeedClockwise);
  }

  // Rear PTO
  if(sRequiredRearPTO)
  {
    Iso11783IL_TIMSetRequiredFacility("rearPTODisengagement",             @RequiredFacilities::RearPTO::svDisengagement);
    Iso11783IL_TIMSetRequiredFacility("rearPTOEngagementCounterClockwise",@RequiredFacilities::RearPTO::svEngagementCounterClockwise);
    Iso11783IL_TIMSetRequiredFacility("rearPTOEngagementClockwise",       @RequiredFacilities::RearPTO::svEngagementClockwise);
    Iso11783IL_TIMSetRequiredFacility("rearPTOSpeedCounterClockwise",     @RequiredFacilities::RearPTO::svSpeedCounterClockwise);
    Iso11783IL_TIMSetRequiredFacility("rearPTOSpeedClockwise",            @RequiredFacilities::RearPTO::svSpeedClockwise);
  }
  
  // Front Hitch
  if(sRequiredFrontHitch)
  {
    Iso11783IL_TIMSetRequiredFacility("frontHitchMotion",             @RequiredFacilities::FrontHitch::svMotion);
    Iso11783IL_TIMSetRequiredFacility("frontHitchPosition",           @RequiredFacilities::FrontHitch::svPosition);
  }

  // Rear Hitch
  if(sRequiredRearHitch)
  {
    Iso11783IL_TIMSetRequiredFacility("rearHitchMotion",             @RequiredFacilities::RearHitch::svMotion);
    Iso11783IL_TIMSetRequiredFacility("rearHitchPosition",           @RequiredFacilities::RearHitch::svPosition);
  }
  
  // Vehicle Speed
  if( sRequiredVehicleSpeed)
  {  
    Iso11783IL_TIMSetRequiredFacility("vehicleSpeedForward",            @RequiredFacilities::VehicleSpeed::svForwardSpeed);
    Iso11783IL_TIMSetRequiredFacility("vehicleSpeedReverse",            @RequiredFacilities::VehicleSpeed::svReverseSpeed);
    Iso11783IL_TIMSetRequiredFacility("vehicleSpeedStartMotion",        @RequiredFacilities::VehicleSpeed::svStartMotion);
    Iso11783IL_TIMSetRequiredFacility("vehicleSpeedStopMotion",         @RequiredFacilities::VehicleSpeed::svStopMotion);
    Iso11783IL_TIMSetRequiredFacility("vehicleSpeedForwardDirection",   @RequiredFacilities::VehicleSpeed::svForwardDirection);
    Iso11783IL_TIMSetRequiredFacility("vehicleSpeedReverseDirection",   @RequiredFacilities::VehicleSpeed::svReverseDirection);
    if(@svImplementedVersion > 2)
    {
      Iso11783IL_TIMSetRequiredFacility("vehicleSpeedChangeOfDirection", @RequiredFacilities::VehicleSpeed::svChangeOfDirection); // call only succeeds if implemented version is > 2  
    }
  }
  
  //External Guidance
  if(sRequiredExtGuidance)
  {
    Iso11783IL_TIMSetRequiredFacility("externalGuidanceCurvature",   @RequiredFacilities::ExtGuidance::svCurvature);
  }
  
  // Front Top Linkage
  if(sRequiredFrontTopLinkage)
  {
    Iso11783IL_TIMSetRequiredFacility("frontTopLinkageMotion",             @RequiredFacilities::FrontTopLinkage::svMotion);
    Iso11783IL_TIMSetRequiredFacility("frontTopLinkagePosition",           @RequiredFacilities::FrontTopLinkage::svPosition);
  }

  // Rear Top Linkage
  if(sRequiredRearTopLinkage)
  {
    Iso11783IL_TIMSetRequiredFacility("rearTopLinkageMotion",             @RequiredFacilities::RearTopLinkage::svMotion);
    Iso11783IL_TIMSetRequiredFacility("rearTopLinkagePosition",           @RequiredFacilities::RearTopLinkage::svPosition);
  }
}

void SetRequiredAuxValvuesFacilities()
{
  byte valveNumber;
  char valveNamespace[100], facilityStateName[30], facilityFlowName[30];
  dword stateValue, flowValue;
  long result;
  
  for (valveNumber = 1; valveNumber<=32; ++valveNumber)
  {
    snprintf(valveNamespace, elcount(valveNamespace), "%s::RequiredFacilities::AuxValve%02d", sClientNamespace, valveNumber);
    snprintf(facilityStateName, elcount(facilityStateName), "auxiliaryValve%dState", valveNumber);
    snprintf(facilityFlowName, elcount(facilityFlowName), "auxiliaryValve%dFlow", valveNumber);
    
    // get system variable values
    if (sysGetVariableDWord(valveNamespace, "svState", stateValue) != 0)
    {
      writeLineEx(cWriteTargetCaplPage, cWriteSeverityError, "%s: Failed to get state value of %s", sClientName, valveNamespace);
    }      
    if (sysGetVariableDWord(valveNamespace, "svFlow", flowValue) != 0)
    {
      writeLineEx(cWriteTargetCaplPage, cWriteSeverityError, "%s: Failed to get flow value of %s", sClientName, valveNamespace);
    }
    
    // set supported TIM server facilities
    if (stateValue || flowValue)
    {
      if (Iso11783IL_TIMSetRequiredFacility(facilityStateName, stateValue) != 0)
      {
        writeLineEx(cWriteTargetCaplPage, cWriteSeverityError, "%s: Failed to set required state facility of valve %02d", sClientName, valveNumber);
      }
      if (Iso11783IL_TIMSetRequiredFacility(facilityFlowName,  flowValue) != 0)
      {
        writeLineEx(cWriteTargetCaplPage, cWriteSeverityError, "%s: Failed to set supported valve facility of valve %02d", sClientName, valveNumber);
      }
    }
  }
}

void EnableAllFunctionGroups(byte enable)
{
  //Common Controls 
  EnableCommonControlForEveryFunction("btn%s_Assign", enable);
  EnableCommonControlForEveryFunction("btn%s_Unassign", enable);
//  EnableCommonControlForEveryFunction("swControlReleased_%s", enable);
  //AuxValve
  {
    byte valveNumber;
    for (valveNumber = 1; valveNumber<=32; ++valveNumber)
    {
      EnableControls_AuxValve(valveNumber, enable);
    }
  }
  EnableControls_FrontPTO(enable);
  EnableControls_RearPTO(enable);
  EnableControls_FrontHitch(enable);
  EnableControls_RearHitch(enable);
  EnableControls_VehicleSpeed(enable);
  EnableControls_ExtGuidance(enable);
  EnableControls_FrontTopLinkage(enable);
  EnableControls_RearTopLinkage(enable);
}

/*
*/
void EnableControls_AuxValve(byte valveNumber, byte enable)
{
  char controlName[100];
  snprintf(controlName, elcount(controlName), "tbAuxValve%02d_Flow", valveNumber); 
  EnableControlOnTwoPanels(sPanelNameClient, sPanelNameAuxValves, controlName, enable);
  snprintf(controlName, elcount(controlName), "ioAuxValve%02d_Flow", valveNumber); 
  EnableControlOnTwoPanels(sPanelNameClient, sPanelNameAuxValves, controlName, enable);
  snprintf(controlName, elcount(controlName), "btnAuxValve%02d_FOE", valveNumber); 
  EnableControlOnTwoPanels(sPanelNameClient, sPanelNameAuxValves, controlName, enable);
  snprintf(controlName, elcount(controlName), "btnAuxValve%02d_Block", valveNumber); 
  EnableControlOnTwoPanels(sPanelNameClient, sPanelNameAuxValves, controlName, enable);
  snprintf(controlName, elcount(controlName), "btnAuxValve%02d_FOR", valveNumber); 
  EnableControlOnTwoPanels(sPanelNameClient, sPanelNameAuxValves, controlName, enable);
  snprintf(controlName, elcount(controlName), "btnAuxValve%02d_Float", valveNumber); 
  EnableControlOnTwoPanels(sPanelNameClient, sPanelNameAuxValves, controlName, enable);
}

/*
*/
void EnableControls_FrontPTO(byte enable)
{
  EnableControl(sPanelNameClient, "tbFrontPTO_SpeedCCW", enable);
  EnableControl(sPanelNameClient, "ioFrontPTO_SpeedByValue", enable);
  EnableControl(sPanelNameClient, "tbFrontPTO_Speed", enable);
  EnableControl(sPanelNameClient, "btnFrontPTO_EngagementCCW", enable);
  EnableControl(sPanelNameClient, "btnFrontPTO_Disengagement", enable);
  EnableControl(sPanelNameClient, "btnFrontPTO_Engagement", enable);
}

/*
*/
void EnableControls_RearPTO(byte enable)
{
  EnableControl(sPanelNameClient, "tbRearPTO_SpeedCCW", enable);
  EnableControl(sPanelNameClient, "ioRearPTO_SpeedByValue", enable);
  EnableControl(sPanelNameClient, "tbRearPTO_Speed", enable);
  EnableControl(sPanelNameClient, "btnRearPTO_EngagementCCW", enable);
  EnableControl(sPanelNameClient, "btnRearPTO_Disengagement", enable);
  EnableControl(sPanelNameClient, "btnRearPTO_Engagement", enable);
}

/*
*/
void EnableControls_FrontHitch(byte enable)
{
  EnableControl(sPanelNameClient, "tbFrontHitch_Position", enable);
  EnableControl(sPanelNameClient, "ioFrontHitch_Position", enable);
  EnableControl(sPanelNameClient, "btnFrontHitch_Float", enable);
  EnableControl(sPanelNameClient, "btnFrontHitch_Stop", enable);
  EnableControl(sPanelNameClient, "btnFrontHitch_LowerUntilStop", enable);
  EnableControl(sPanelNameClient, "btnFrontHitch_RaiseUntilStop", enable);
}

/*
*/
void EnableControls_RearHitch(byte enable)
{
  EnableControl(sPanelNameClient, "tbRearHitch_Position", enable);
  EnableControl(sPanelNameClient, "ioRearHitch_Position", enable);
  EnableControl(sPanelNameClient, "btnRearHitch_Float", enable);
  EnableControl(sPanelNameClient, "btnRearHitch_Stop", enable);
  EnableControl(sPanelNameClient, "btnRearHitch_LowerUntilStop", enable);
  EnableControl(sPanelNameClient, "btnRearHitch_RaiseUntilStop", enable);
}

/*
*/
void EnableControls_VehicleSpeed(byte enable)
{
  EnableControl(sPanelNameClient, "tbVehicleSpeed_Reverse", enable);
  EnableControl(sPanelNameClient, "ioVehicleSpeed", enable);
  EnableControl(sPanelNameClient, "tbVehicleSpeed_Forward", enable);
  EnableControl(sPanelNameClient, "btnVehicleSpeed_Reverse", enable);
  EnableControl(sPanelNameClient, "btnVehicleSpeed_Stop", enable);
  EnableControl(sPanelNameClient, "btnVehicleSpeed_Forward", enable);
  EnableControl(sPanelNameClient, "btnVehicleSpeed_ParamRequest", enable);
  EnableControl(sPanelNameClient, "btnVehicleSpeed_ReleaseWithoutAwareness", enable);
}

/*
*/
void EnableControls_ExtGuidance(byte enable)
{
  EnableControl(sPanelNameClient, "tbExtGuidance_Curvature", enable);
  EnableControl(sPanelNameClient, "ioExtGuidance_Curvature", enable);
}

/*
*/
void EnableControls_FrontTopLinkage(byte enable)
{
  EnableControl(sPanelNameClient, "tbFrontTopLinkage_Position", enable);
  EnableControl(sPanelNameClient, "ioFrontTopLinkage_Position", enable);
  EnableControl(sPanelNameClient, "btnFrontTopLinkage_Float", enable);
  EnableControl(sPanelNameClient, "btnFrontTopLinkage_Stop", enable);
  EnableControl(sPanelNameClient, "btnFrontTopLinkage_RetractUntilStop", enable);
  EnableControl(sPanelNameClient, "btnFrontTopLinkage_ExtendUntilStop", enable);
  EnableControl(sPanelNameClient, "btnFrontTopLinkage_ParamRequest", enable);
}

/*
*/
void EnableControls_RearTopLinkage(byte enable)
{
  EnableControl(sPanelNameClient, "tbRearTopLinkage_Position", enable);
  EnableControl(sPanelNameClient, "ioRearTopLinkage_Position", enable);
  EnableControl(sPanelNameClient, "btnRearTopLinkage_Float", enable);
  EnableControl(sPanelNameClient, "btnRearTopLinkage_Stop", enable);
  EnableControl(sPanelNameClient, "btnRearTopLinkage_RetractUntilStop", enable);
  EnableControl(sPanelNameClient, "btnRearTopLinkage_ExtendUntilStop", enable);
  EnableControl(sPanelNameClient, "btnRearTopLinkage_ParamRequest", enable);
}

/*
*/
void ReflectRequiredFacilitiesByVisibility_Reset()
{
  byte valveNumber;

  // Auxiliary Values ----------------------------------------------------------
  for (valveNumber = 1; valveNumber<=32; ++valveNumber)
  {
    AdjustVilibility_AuxValveGroup_Client(sPanelNameClient, sPanelNameAuxValves, valveNumber, 1, 1);
  }
  AdjustVisibility_PTOGroup_Client(sPanelNameClient, "RearPTO", 1, 1, 1, 1, 1);
  AdjustVisibility_PTOGroup_Client(sPanelNameClient, "FrontPTO", 1, 1, 1, 1, 1);
  AdjustVisibility_HitchGroup_Client(sPanelNameClient, "RearHitch", 1, 1);
  AdjustVisibility_HitchGroup_Client(sPanelNameClient, "FrontHitch", 1, 1);
  AdjustVisibility_VehicleSpeed_Client(sPanelNameClient, 1, 1, 1, 1, 1, 1);
  AdjustVisibility_ExtGuidance_Client(sPanelNameClient, 1);
  AdjustVisibility_TopLinkage_Client(sPanelNameClient, "RearTopLinkage", 1, 1);
  AdjustVisibility_TopLinkage_Client(sPanelNameClient, "FrontTopLinkage", 1, 1);
}

void UpdateColorGrp(char panel1[], char panel2[], char control[], int facilityRequired)
{
  long white, gray;
  white = MakeRGB(255,255,255);
  gray = MakeRGB(242,242,242);
  
  if(facilityRequired == 1)
  {
    setControlBackColor(panel1, control, gray);
    setControlBackColor(panel2, control, gray);
  }
  else
  {
    setControlBackColor(panel1, control, white);
    setControlBackColor(panel1, control, white);
  }
}

void ReflectRequiredFacilitiesByVisibility()
{
  byte valveNumber;
  
  
  char valveNamespace[100], facilityStateName[30], facilityFlowName[30], buffer[100];
  dword stateValue, flowValue;

  // Auxiliary Values ----------------------------------------------------------
  for (valveNumber = 1; valveNumber<=32; ++valveNumber)
  {
    dword stateValue, flowValue;
    snprintf(valveNamespace, elcount(valveNamespace), "%s::RequiredFacilities::AuxValve%02d", sClientNamespace, valveNumber); 
    stateValue = sysGetVariableDWord(valveNamespace, "svState");
    flowValue  = sysGetVariableDWord(valveNamespace, "svFlow");
    AdjustVilibility_AuxValveGroup_Client(sPanelNameClient, sPanelNameAuxValves, valveNumber, stateValue, flowValue);
  }
  AdjustVisibility_PTOGroup_Client(sPanelNameClient, "RearPTO",   @RequiredFacilities::RearPTO::svSpeedCounterClockwise, 
                                                                  @RequiredFacilities::RearPTO::svSpeedClockwise,
                                                                  @RequiredFacilities::RearPTO::svEngagementCounterClockwise,
                                                                  @RequiredFacilities::RearPTO::svDisengagement,
                                                                  @RequiredFacilities::RearPTO::svEngagementClockwise);
  AdjustVisibility_PTOGroup_Client(sPanelNameClient, "FrontPTO",  @RequiredFacilities::FrontPTO::svSpeedCounterClockwise, 
                                                                  @RequiredFacilities::FrontPTO::svSpeedClockwise,
                                                                  @RequiredFacilities::FrontPTO::svEngagementCounterClockwise,
                                                                  @RequiredFacilities::FrontPTO::svDisengagement,
                                                                  @RequiredFacilities::FrontPTO::svEngagementClockwise);
  AdjustVisibility_HitchGroup_Client(sPanelNameClient, "RearHitch",  @RequiredFacilities::RearHitch::svMotion,      
                                                              @RequiredFacilities::RearHitch::svPosition);
  AdjustVisibility_HitchGroup_Client(sPanelNameClient, "FrontHitch", @RequiredFacilities::FrontHitch::svMotion,      
                                                              @RequiredFacilities::FrontHitch::svPosition);
  AdjustVisibility_VehicleSpeed_Client(sPanelNameClient,  @RequiredFacilities::VehicleSpeed::svReverseSpeed, 
                                                        @RequiredFacilities::VehicleSpeed::svForwardSpeed, 
                                                        @RequiredFacilities::VehicleSpeed::svStartMotion, 
                                                        @RequiredFacilities::VehicleSpeed::svStopMotion, 
                                                        @RequiredFacilities::VehicleSpeed::svReverseDirection, 
                                                        @RequiredFacilities::VehicleSpeed::svForwardDirection);
  AdjustVisibility_ExtGuidance_Client(sPanelNameClient, @RequiredFacilities::ExtGuidance::svCurvature);
  AdjustVisibility_TopLinkage_Client(sPanelNameClient, "RearTopLinkage",  @RequiredFacilities::RearTopLinkage::svMotion, 
                                                                        @RequiredFacilities::RearTopLinkage::svPosition);
  AdjustVisibility_TopLinkage_Client(sPanelNameClient, "FrontTopLinkage", @RequiredFacilities::FrontTopLinkage::svMotion, 
                                                                        @RequiredFacilities::FrontTopLinkage::svPosition);
}

void UpdateDeactivatedCertificateChecks()
{
  long deactivatedChecks;
  
  deactivatedChecks = 0;
  deactivatedChecks |= (@svDisableICCCheck > 0)             ?  0x01 : 0;   
  deactivatedChecks |= (@svDisableNameCheck > 0)            ?  0x02 : 0;   
  deactivatedChecks |= (@svDisableFctCapabilitiesCheck > 0) ?  0x04 : 0;   
  deactivatedChecks |= (@svDisableCRLCheck > 0)             ?  0x08 : 0;   
  deactivatedChecks |= (@svDisableCertificateTypeCheck > 0) ?  0x10 : 0;   
  
  if (Iso11783IL_TIMSetProperty("deactivateCertificateValidation", deactivatedChecks) != 0)
  {
    writeLineEx(cWriteTargetCaplPage, cWriteSeverityError, "%s: Failed to set deactivated certificate validations", sClientName);
  }
}

void SetValueForFirstFunctionRequest(dword functionID, int supportContinuousFacility, dword rowContinuousValue, dword rowDiscontinuousValue)
{
  if(supportContinuousFacility == 1)
  {
    Iso11783IL_TIMFunctionRequest(functionID, rowContinuousValue );
  }
  else
  {
    Iso11783IL_TIMFunctionRequest(functionID, rowDiscontinuousValue );
  }
}

void Iso11783IL_TIMOnFunctionStateChanged(dword functionID, dword newState) 
{
  switch (newState)
  {
    case 4: // // Automation Pending
    {
      switch(functionID)
      {
        case cAuxValve01:       SetValueForFirstFunctionRequest(functionID, @RequiredFacilities::AuxValve01::svFlow,          0x7D80, 0x7D80);  break;
        case cAuxValve02:       SetValueForFirstFunctionRequest(functionID, @RequiredFacilities::AuxValve02::svFlow,          0x7D80, 0x7D80);  break;
        case cAuxValve03:       SetValueForFirstFunctionRequest(functionID, @RequiredFacilities::AuxValve03::svFlow,          0x7D80, 0x7D80);  break;
        case cAuxValve04:       SetValueForFirstFunctionRequest(functionID, @RequiredFacilities::AuxValve04::svFlow,          0x7D80, 0x7D80);  break;
        case cAuxValve05:       SetValueForFirstFunctionRequest(functionID, @RequiredFacilities::AuxValve05::svFlow,          0x7D80, 0x7D80);  break;
        case cAuxValve06:       SetValueForFirstFunctionRequest(functionID, @RequiredFacilities::AuxValve06::svFlow,          0x7D80, 0x7D80);  break;
        case cAuxValve07:       SetValueForFirstFunctionRequest(functionID, @RequiredFacilities::AuxValve07::svFlow,          0x7D80, 0x7D80);  break;
        case cAuxValve08:       SetValueForFirstFunctionRequest(functionID, @RequiredFacilities::AuxValve08::svFlow,          0x7D80, 0x7D80);  break;
        case cAuxValve09:       SetValueForFirstFunctionRequest(functionID, @RequiredFacilities::AuxValve09::svFlow,          0x7D80, 0x7D80);  break;
        case cAuxValve10:       SetValueForFirstFunctionRequest(functionID, @RequiredFacilities::AuxValve10::svFlow,          0x7D80, 0x7D80);  break;
        case cAuxValve11:       SetValueForFirstFunctionRequest(functionID, @RequiredFacilities::AuxValve11::svFlow,          0x7D80, 0x7D80);  break;
        case cAuxValve12:       SetValueForFirstFunctionRequest(functionID, @RequiredFacilities::AuxValve12::svFlow,          0x7D80, 0x7D80);  break;
        case cAuxValve13:       SetValueForFirstFunctionRequest(functionID, @RequiredFacilities::AuxValve13::svFlow,          0x7D80, 0x7D80);  break;
        case cAuxValve14:       SetValueForFirstFunctionRequest(functionID, @RequiredFacilities::AuxValve14::svFlow,          0x7D80, 0x7D80);  break;
        case cAuxValve15:       SetValueForFirstFunctionRequest(functionID, @RequiredFacilities::AuxValve15::svFlow,          0x7D80, 0x7D80);  break;
        case cAuxValve16:       SetValueForFirstFunctionRequest(functionID, @RequiredFacilities::AuxValve16::svFlow,          0x7D80, 0x7D80);  break;
        case cAuxValve17:       SetValueForFirstFunctionRequest(functionID, @RequiredFacilities::AuxValve17::svFlow,          0x7D80, 0x7D80);  break;
        case cAuxValve18:       SetValueForFirstFunctionRequest(functionID, @RequiredFacilities::AuxValve18::svFlow,          0x7D80, 0x7D80);  break;
        case cAuxValve19:       SetValueForFirstFunctionRequest(functionID, @RequiredFacilities::AuxValve19::svFlow,          0x7D80, 0x7D80);  break;
        case cAuxValve20:       SetValueForFirstFunctionRequest(functionID, @RequiredFacilities::AuxValve20::svFlow,          0x7D80, 0x7D80);  break;
        case cAuxValve21:       SetValueForFirstFunctionRequest(functionID, @RequiredFacilities::AuxValve21::svFlow,          0x7D80, 0x7D80);  break;
        case cAuxValve22:       SetValueForFirstFunctionRequest(functionID, @RequiredFacilities::AuxValve22::svFlow,          0x7D80, 0x7D80);  break;
        case cAuxValve23:       SetValueForFirstFunctionRequest(functionID, @RequiredFacilities::AuxValve23::svFlow,          0x7D80, 0x7D80);  break;
        case cAuxValve24:       SetValueForFirstFunctionRequest(functionID, @RequiredFacilities::AuxValve24::svFlow,          0x7D80, 0x7D80);  break;
        case cAuxValve25:       SetValueForFirstFunctionRequest(functionID, @RequiredFacilities::AuxValve25::svFlow,          0x7D80, 0x7D80);  break;
        case cAuxValve26:       SetValueForFirstFunctionRequest(functionID, @RequiredFacilities::AuxValve26::svFlow,          0x7D80, 0x7D80);  break;
        case cAuxValve27:       SetValueForFirstFunctionRequest(functionID, @RequiredFacilities::AuxValve27::svFlow,          0x7D80, 0x7D80);  break;
        case cAuxValve28:       SetValueForFirstFunctionRequest(functionID, @RequiredFacilities::AuxValve28::svFlow,          0x7D80, 0x7D80);  break;
        case cAuxValve29:       SetValueForFirstFunctionRequest(functionID, @RequiredFacilities::AuxValve29::svFlow,          0x7D80, 0x7D80);  break;
        case cAuxValve30:       SetValueForFirstFunctionRequest(functionID, @RequiredFacilities::AuxValve30::svFlow,          0x7D80, 0x7D80);  break;
        case cAuxValve31:       SetValueForFirstFunctionRequest(functionID, @RequiredFacilities::AuxValve31::svFlow,          0x7D80, 0x7D80);  break;
        case cAuxValve32:       SetValueForFirstFunctionRequest(functionID, @RequiredFacilities::AuxValve32::svFlow,          0x7D80, 0x7D80);  break;

        case cFrontHitch:       SetValueForFirstFunctionRequest(functionID, @RequiredFacilities::FrontHitch::svPosition,      0,      0xFB01);  break;
        case cRearHitch:        SetValueForFirstFunctionRequest(functionID, @RequiredFacilities::RearHitch::svPosition,       0,      0xFB01);  break;
        case cFrontTopLinkage:  SetValueForFirstFunctionRequest(functionID, @RequiredFacilities::FrontTopLinkage::svPosition, 0,      0xFB01);  break;
        case cRearTopLinkage:   SetValueForFirstFunctionRequest(functionID, @RequiredFacilities::RearTopLinkage::svPosition,  0,      0xFB01);  break;
          
        case cExternalGuidance: SetExtGuidanceCurvature(@Functions::ExtGuidance::svCurvature);  break;

        case cFrontPTO:
        {
          dword rowInitValue;
          if      (@RequiredFacilities::FrontPTO::svDisengagement == 1)               {rowInitValue = 0x7D80;}
          else if (@RequiredFacilities::FrontPTO::svSpeedClockwise == 1)              {rowInitValue = 0x7D81;}
          else if (@RequiredFacilities::FrontPTO::svSpeedCounterClockwise == 1)       {rowInitValue = 0x7D7F;}
          else if (@RequiredFacilities::FrontPTO::svEngagementClockwise == 1)         {rowInitValue = 0xFB00;}
          else if (@RequiredFacilities::FrontPTO::svEngagementCounterClockwise == 1)  {rowInitValue = 0;}
          Iso11783IL_TIMFunctionRequest(cFrontPTO, rowInitValue);
          
        }
        break;
        
        case cRearPTO:
        {
          dword rowInitValue;
          if      (@RequiredFacilities::RearPTO::svDisengagement == 1)               {rowInitValue = 0x7D80;}
          else if (@RequiredFacilities::RearPTO::svSpeedClockwise == 1)              {rowInitValue = 0x7D81;}
          else if (@RequiredFacilities::RearPTO::svSpeedCounterClockwise == 1)       {rowInitValue = 0x7D7F;}
          else if (@RequiredFacilities::RearPTO::svEngagementClockwise == 1)         {rowInitValue = 0xFB00;}
          else if (@RequiredFacilities::RearPTO::svEngagementCounterClockwise == 1)  {rowInitValue = 0;}
          Iso11783IL_TIMFunctionRequest(cRearPTO, rowInitValue);
          
        }
        break;

        case cVehicleSpeed:     
        {
          dword rowInitValue;
          if      (@RequiredFacilities::VehicleSpeed::svStopMotion == 1)        {rowInitValue = 0x7D80;}
          else if (@RequiredFacilities::VehicleSpeed::svForwardSpeed == 1)      {rowInitValue = 0x7D81;}
          else if (@RequiredFacilities::VehicleSpeed::svReverseSpeed == 1)      {rowInitValue = 0x7D7F;}
          else if (@RequiredFacilities::VehicleSpeed::svForwardDirection == 1)  {rowInitValue = 0xFB00;}
          else if (@RequiredFacilities::VehicleSpeed::svReverseDirection == 1)  {rowInitValue = 0;}
          Iso11783IL_TIMFunctionRequest(cRearPTO, rowInitValue);
          
        }
        break;
          
        default:
          break;
      }
    }
    default:
      break;
  }
}


long Iso11783IL_OnTxPrepare( pg * txPG )
{ 
  switch( txPG.PGN ) 
  {
    case TIM21.pgn:
    {
      switch (txPG.byte(0))
      {
        case TIMClientStatus_Msg:
        {
          if (sysGetVariableInt(sysvar::svFreezeClientHeartbeatCounter) > 0)
          {
            // if error injection is active we always send the same heartbeat counter
            if (sFreezedHearbeatCounter < 0)
            {
              sFreezedHearbeatCounter =  txPG.byte(1);
            }
            txPG.byte(1) = sFreezedHearbeatCounter;
          }
          else
          {
            // if error injection is deactivated we reset the heartbeat variable  
            sFreezedHearbeatCounter = -1;
          }
          break;
        }
        default:
        {
          break;
        }
      }
      break;
    }
    
    default:
    {
      break;
    }
  }
    
  return Plugin_OnTxPrepare(txPG); // send message
}

long Iso11783IL_OnRxMessage(pg * rxPG)
{
  if((rxPG.pgn == AUTH12.pgn) && (rxPG.byte(0) == 3)) // Client Certificate Request
  {
    switch(rxPG.Byte(4))
    {
      case 1: // testlab
      {
        if(sNumOfReqForTestlabCertToIgnore > 0)
        {
          sNumOfReqForTestlabCertToIgnore--;
          return 0;
        }
        else
        {
          return 1;
        }
      }
      break;

      case 2: // Manufacturer
      {
        if(sNumOfReqForManufactCertToIgnore > 0)
        {
          sNumOfReqForManufactCertToIgnore--;
          return 0;
        }
        else
        {
          return 1;
        }
      }
      break;
      
      case 3: // Manufacturer Series
      {
        if(sNumOfReqForManufactSeriesCertToIgnore > 0)
        {
          sNumOfReqForManufactSeriesCertToIgnore--;
          return 0;
        }
        else
        {
          return 1;
        }
      }
      break;
      
      case 4: // Device
      {
        if(sNumOfReqForDeviceCertToIgnore > 0)
        {
          sNumOfReqForDeviceCertToIgnore--;
          return 0;
        }
        else
        {
          return 1;
        }
      }
      break;
    }
  }
   
  return Plugin_OnRxMessage(rxPG);
}
