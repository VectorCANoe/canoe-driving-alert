/*@!Encoding:65001*/
includes
{
  #include "Common.cin"
}

variables
{
  // Compliance Certification information
  const dword cciTestProtocolPublicationYear = 2024;
  const dword cciTestProtocolRevision = 0;
  const dword cciLaboratoryType = 1;
  const dword cciLaboratoryID = 1010;
  const dword cciReferenceNumber = 40;  
  
  word gAuthenticationSucceeded = 0;
}

// 
// Start TIM Client if measurement starts
//
on start
{
  if (@Client::Start > 0)
  {
    StartClient();
  }
}


// 
// System variables
//

//
// Start/stop TIM Client
//
on sysvar_update sysvar::Client::Start
{
  if(@this > 0)
  {
   StartClient();
  }
  else
  {
    StopClient();
  }
}

//
// Send a function request for Auxlilary Value 01
//
on sysvar_update sysvar::Client::AuxValve01_RequestValue
{
  RequestAuxValue01(@this);
}


//
// Signals
//

//
// If authentication status signal reports a succeeded authentication 
// we start controlling the TIM function
//
on signal_update TIMClient::AUTH21_TIMClient::AuthenticationStatus
{
  if (this == 1)
  {
    if (getSignal(TIMServer::AUTH12_TIMServer::AuthenticationStatus) == 1)
    {
      OnAuthenticationSucceeded();
    }
  }
}

//
// Inistialize TIM Client and connect it to TIM Server
//
on signal_update TIMServer::AUTH12_TIMServer::AuthenticationStatus
{
  if (this == 1)
  {
    if (getSignal(TIMClient::AUTH21_TIMClient::AuthenticationStatus) == 1)
    {
      OnAuthenticationSucceeded();
    }
  }
}


// 
// Functions
//

//
// Enable/disable demonstration mode
//
void EnableDemoMode(word enable)
{
  Iso11783IL_TIMSetProperty("enableDemoMode", enable > 0 ? 1 : 0);
}

//
// Initialization of TIM Client
//
// If you want to use the real mode then please modify the path for certificates, CRLs and keys. 
// Also customize the variables for Compliance Certification information that are defined at the 
// beginning of the file.
//
void InitializeClient()
{
  long result;
  
  // Certificates
  result = Iso11783IL_TIMAddCertificate(cCertificateType_AEFRoot,           "Certificates\\dummy_root_ca.der");
  if (result != 0) write("<TIMClient> Failed to add AEF Root Certificate");
  result = Iso11783IL_TIMAddCertificate(cCertificateType_Testlab,           "Certificates\\dummy_aef_testlab.der");
  if (result != 0) write("<TIMClient> Failed to add Testlab Certificate");
  result = Iso11783IL_TIMAddCertificate(cCertificateType_Manufacturer,      "Certificates\\dummy_manufacturer.der");
  if (result != 0) write("<TIMClient> Failed to add Manufacturer Certificate");
  result = Iso11783IL_TIMAddCertificate(cCertificateType_ManufacturerSeries,"Certificates\\dummy_manufacturer_series_client.der");
  if (result != 0) write("<TIMClient> Failed to add Manufacturer Series Certificate");
  result = Iso11783IL_TIMAddCertificate(cCertificateType_Device,            "Certificates\\dummy_client.der");
  if (result != 0) write("<TIMClient> Failed to add Device Certificate");
  result = Iso11783IL_TIMAddCertificate(cCertificateType_CRLSigning,        "Certificates\\dummy_crl_ca.der");
  if (result != 0) write("<TIMClient> Failed to add CRL Signing");
  
  // CRLs
  result = Iso11783IL_TIMSetCRL(cCRLType_CRL, "Certificates\\dummy_crl.crl");
  if (result != 0) write("<TIMClient> Failed to add CRL");
  result = Iso11783IL_TIMSetCRL( cCRLType_CRLSignCA, "Certificates\\dummy_crl_sub_ca.crl");
  if (result != 0) write("<TIMClient> Failed to add CRLSignCA");
  
  // Private key
  result = Iso11783IL_TIMSetPrivateKey( "Certificates\\dummy_client.key.hex");
  if (result != 0) write("<TIMClient> Failed to add private key");
  
  // Compliance Certification information
  result = Iso11783IL_TIMSetComplianceCertification(
    cciTestProtocolPublicationYear, cciTestProtocolRevision, 
    cciLaboratoryType, cciLaboratoryID, cciReferenceNumber);
  if (result != 0) write("<TIMClient> Failed to set Compliance Certification");

  // Facilities
  SetRequiredFunctionFacilities();
  
  // Versions
  result = Iso11783IL_TIMSetProperty("minimumVersion", 1);
  if (result != 0) write("<TIMClient> Failed to set minimum version");
  result = Iso11783IL_TIMSetProperty("implementedVersion", 2);
  if (result != 0) write("<TIMClient> Failed to set implemented version");
  result = Iso11783IL_TIMSetProperty("minimumAuthVersion", 2);
  if (result != 0) write("<TIMClient> Failed to set minimum authenticaton version");
  result = Iso11783IL_TIMSetProperty("implementedAuthVersion", 3);
  if (result != 0) write("<TIMClient> Failed to set implemented authenticaton version");
  
  EnableAuxValve01Control(0);
}

//
// Set functions required by TIM Client
//
void SetRequiredFunctionFacilities()
{
  long result;
  
  Iso11783IL_TIMResetAllRequiredFunctions();
  
  result = Iso11783IL_TIMSetRequiredFacility("auxiliaryValve01State", 1);
  if (result != 0) write("<TIMClient> Failed set required facility 'auxiliaryValve01State'");
  result = Iso11783IL_TIMSetRequiredFacility("auxiliaryValve01Flow", 1);
  if (result != 0) write("<TIMClient> Failed set required facility 'auxiliaryValve01Flow'");
}

//
// Inistialize TIM Client and connect it to TIM Server
//
void StartClient()
{
  long result;
  EnableDemoMode(@DemoMode);
  InitializeClient();
  result = Iso11783IL_TIMConnectToServer(TIMServer);
  if (result != 0) write("<TIMClient> Failed to connect to server");
  gAuthenticationSucceeded = 0;
}

// 
// This functins stops connection of the TIM Client to the TIM Server
// 
void StopClient()
{
  long result;
  byte useGracefulShutown = 1;
  result = Iso11783IL_TIMDisconnectFromServer(TIMServer, useGracefulShutown);
  if (result != 0) write("<TIMClient> Failed to disconnect from server");
}

//
// This functions is called when authentication succeeded and starts 
// controlling TIM function Auxiliary Valve 01
// 
void OnAuthenticationSucceeded()
{
  if (gAuthenticationSucceeded == 0)
  {
    write("<TIMClient> Authentication succeeded. Try to assign TIM Functions"); 
    AssignFunctions();
  }
  gAuthenticationSucceeded = 1;
}

//
// This functions enables the TIM Client (so it can control TIM functions) and
// sends a request to the TIM Server to control TIM function Auxiliary Valve 01
// 
void AssignFunctions()
{
  long result;  

  // enable 
  result = Iso11783IL_TIMOperatorEnable(TIMServer);
  if (result != 0) write("<TIMClient> Operator enable failed ");

  result = Iso11783IL_TIMAssignFunction(cAuxValve01, TIMServer);
  if (result != 0) write("<TIMClient> Assign AuxValve01 failed ");
}

//
// Ths function sends a request to the TIM Server to change the value of TIM function Auxiliary Valve 01
//
void RequestAuxValue01(dword value)
{
  long result;
  result = Iso11783IL_TIMFunctionRequest(cAuxValve01, value);
  if (result != 0) write("<TIMClient> Failed to request AuxValve01 value");
}

//
// Ths function enables/disables the control for modifying the value of TIM function Auxiliary Valve 01
//
void EnableAuxValve01Control(long enable)
{
  enableControl("TIMClient", "TrackBarAuxValve01", enable);
}


// 
// Callbacks
//

// 
// This callback is called every time the value of a TIM function has been changed
//
void Iso11783IL_TIMOnFunctionStateChanged(dword functionID, dword newState)
{
  char buffer[255];
  GetTimFunctionStateString(newState, buffer);
  write("<TIMClient> Function %u changed to state %s", functionID, buffer); 
  
  switch (newState)
  {
    case cAutomationEnabled:
      RequestAuxValue01(0x7D80);
      break;
    case cActiveNotLimited:
    case cActiveLimitedHigh:
    case cActiveLimitedLow:
      EnableAuxValve01Control(1);
      break;
  }
}
