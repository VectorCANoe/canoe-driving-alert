/*@!Encoding:1252*/
/*
 * Version 2.4
 *
 * Copyright 2001-2020 - Vector Informatik GmbH
 *
 * You can use this CAPL programm to load and transmit an object pool
 * which is stored in a file (*.iop).
 *
 * Dependencies
 *   Interaction Layer DLL ISO11783_IL.dll
 *
 * History
 * 1.0  Created
 * 1.1  Increased buffers to 256kB
 * 1.2  Use Object Pool API 
 * 1.3  Clear environment variable evOPCFilename on measurement start
 * 2.0  Support commands of VT version 4 and 5
 * 2.1  Use new command ISO11783IL_OPDeleteObjectPool
 * 2.2  Remove obsolete command Execute OpCode
 * 2.3  Replace environment variables by system variables
 * 2.4  Store modified file paths in system variables
 *      Add possiblility to export an object pool
 */
variables
{
  //
  // Global variables for communication
  //

  char  gBus[20]                = "ISO11783";
  char  gECULabel[32]           = "OPC";               // Name of the node
  char  gAuxAssignmentFile[64]  = "MyAssignments.ini"; // Name of the file which stores auxiliary assignments
  pg    VT21 gVT21 = {dlc = 8};         // VT21 message
  byte  gVTAddress = 0x26;              // Address of the VT  
 

  // Sub commands of a graphics context object
  const kSetGraphicsCursor            = 0;
  const kMoveGraphicsCursor           = 1;
  const kSetForegroundColour          = 2;
  const kSetBackgroundColour          = 3;
  const kSetLineAttrObjId             = 4;
  const kSetFillAttrObjId             = 5;
  const kSetFontAttrObjId             = 6;
  const kEraseRectangle               = 7;
  const kDrawPoint                    = 8;
  const kDrawLine                     = 9;
  const kDrawRectangle                = 10;
  const kCreawClosedEllipse           = 11;
  const kDrawPolygon                  = 12;
  const kDrawText                     = 13;
  const kPanViewport                  = 14;
  const kZoomViewport                 = 15;
  const kPanAndZoomViewport           = 16;
  const kChangeViewportSize           = 17;
  const kDrawVTObject                 = 18;
  const kCopyCanvasToPictureGraphic   = 19;
  const kCopyViewportToPictureGraphic = 20;

  // Changing attributes cyclically
  msTimer gChangeAttrValueTimer;   // Timer to incremet attribute value
  word  gChangeAttrValueTime = 1;// This time is used to incremet attribute value
  const gChangeAttrValueTimeFact = 20; // Factor which is muliplied with the time value
}

on preStart
{
  OPCInit(); // initialize global variables
}

on start
{
  // init environment variables with default values
  @OPC::Address = OPC.NmStationAddress;

  // disable/enable controls
  OPCEnableControls( 0 );
}

//
// Switch on/off the Object Pool Checker ECU 
//
on sysvar OPC::OnOffSwitch
{
  char path[256];

  if (@this == 1) 
  {
    OPCStartUp();    
  }
  else 
  {
    OPCShutDown();
  }
}

//
// Load the object pool from file and transmit it to
// the virtual terminal.
//
on sysvar OPC::Transmit
{
  char nameOfFile[256];
  long result;
  dword options;

  if (@this == 1) 
  {
    // here we can get the current VT properties
    write( "<%s> Print current VT properties:", gECULabel, nameOfFile );    
    if ((result = Iso11783IL_OPGetVTInfo( "VersionNumber"          )) > 0) write( "<%s> VersionNumber          = %u", gECULabel , result );      
    if ((result = Iso11783IL_OPGetVTInfo( "NavigationSoftKeyCount" )) > 0) write( "<%s> NavigationSoftKeyCount = %u", gECULabel , result );      
    if ((result = Iso11783IL_OPGetVTInfo( "SoftKeyWidth"           )) > 0) write( "<%s> SoftKeyWidth           = %u", gECULabel , result );      
    if ((result = Iso11783IL_OPGetVTInfo( "SoftKeyHeight"          )) > 0) write( "<%s> SoftKeyHeight          = %u", gECULabel , result );      
    if ((result = Iso11783IL_OPGetVTInfo( "VirtualSoftKeyCount"    )) > 0) write( "<%s> VirtualSoftKeyCount    = %u", gECULabel , result );      
    if ((result = Iso11783IL_OPGetVTInfo( "PhysicalSoftKeyCount"   )) > 0) write( "<%s> PhysicalSoftKeyCount   = %u", gECULabel , result );      
    if ((result = Iso11783IL_OPGetVTInfo( "SmallFontSizes"         )) > 0) write( "<%s> SmallFontSizes         = %u", gECULabel , result );      
    if ((result = Iso11783IL_OPGetVTInfo( "LargeFontSizes"         )) > 0) write( "<%s> LargeFontSizes         = %u", gECULabel , result );      
    if ((result = Iso11783IL_OPGetVTInfo( "FontTypeAttribute"      )) > 0) write( "<%s> FontTypeAttribute      = %u", gECULabel , result );      
    if ((result = Iso11783IL_OPGetVTInfo( "BootTime"               )) > 0) write( "<%s> BootTime               = %u", gECULabel , result );      
    if ((result = Iso11783IL_OPGetVTInfo( "GraphicType"            )) > 0) write( "<%s> GraphicType            = %u", gECULabel , result );      
    if ((result = Iso11783IL_OPGetVTInfo( "Hardware"               )) > 0) write( "<%s> Hardware               = %u", gECULabel , result );      
    if ((result = Iso11783IL_OPGetVTInfo( "Width"                  )) > 0) write( "<%s> Width                  = %u", gECULabel , result );      
    if ((result = Iso11783IL_OPGetVTInfo( "Height"                 )) > 0) write( "<%s> Height                 = %u", gECULabel , result );      
        
    sysGetVariableString(sysvar::OPC::Filename, nameOfFile, elcount(nameOfFile));    
    options = (@sysvar::OPC::TransmitObjectPoolWithoutParsing << 1) | (!@sysvar::OPC::TransmitEndOfObjectPoolMessage);
    if (Iso11783IL_OPLoad( nameOfFile, "", options ) == 0)
    {
      write( "<%s> Object Pool '%s' is loaded", gECULabel, nameOfFile );
      enableControl( "", "Export", 1 );
      enableControl( "", "Object Pool Path Export", 1 );  
    }
    else
    {
      write( "<%s> Failed to load object Pool '%s'", gECULabel, nameOfFile );
    }
  }
}

//
// Send the load version command to the VT.
//
on sysvar OPC::Load
{
  char version[255];

  if (@this == 1) 
  {
    sysGetVariableString( sysvar::OPC::Version, version, elcount(version) );  
    Iso11783IL_OPLoadVersion( version );
  }
}

//
// Send the activation comand to the VT
//
on sysvar OPC::CmdActivate
{
  if (@this == 1) 
  {
    Iso11783IL_OPActivate( 15 );
  }
}

//
// Send the deactivation comand to the VT
//
on sysvar OPC::CmdDeactivate
{
  if (@this == 1) 
  {
    Iso11783IL_OPDeactivate(  );
  }
}

//
// Send the store version command to the VT.
//
on sysvar OPC::Store
{
  char version[255];

  if (@this == 1) 
  {
    sysGetVariableString( sysvar::OPC::Version, version, elcount(version) );  
    Iso11783IL_OPStoreVersion( version );
  }
}

//
// Send get version command to the VT
//
on sysvar OPC::GetVersion
{
  if (@this == 1) 
  {
    Iso11783IL_OPGetVersion();
  }
}

//
// Send get extended version command to the VT
//
on sysvar OPC::GetExtendedVersion
{
  if (@this == 1) 
  {
    Iso11783IL_OPGetVersion( 1 );
  }
}

//
// Send command 'Hide Show' to the VT
//
on sysvar OPC::CmdHideShow
{
  if (@this == 1) 
  {
    Iso11783IL_OPShowObject( @OPC::CmdShowHideObjectId, @OPC::CmdShow );
  }
}

//
// Send enable/disable command
//
on sysvar OPC::CmdEnableDisable
{
  if (@this == 1) 
  {
    Iso11783IL_OPEnableObject( @OPC::CmdEnableDisableObjectId, @OPC::CmdEnable );
  }
}

//
// Send command "Select Input' to the VT
//
on sysvar OPC::CmdSelect
{
  if (@this == 1) 
  {
    Iso11783IL_OPSelectInput( @OPC::CmdSelectObjectId, @OPC::CmdSelectSelectionType );
  }
}

//
// Send ESC command
//
on sysvar OPC::CmdESC
{
  if (@this == 1) 
  {
    Iso11783IL_OPESC();
  }
}

//
// Send control audio device command
//
on sysvar OPC::CmdControlAudioDevice
{
  if (@this == 1) 
  {
    Iso11783IL_OPControlAudio( @OPC::CmdControlAudioDeviceNumOfActivation, @OPC::CmdControlAudioDeviceFrequency,
                               @OPC::CmdControlAudioDeviceOnTimeDuration, @OPC::CmdControlAudioDeviceOffTimeDuration );
  }
}

//
// Send control audio device command
//
on sysvar OPC::CmdSetAudioVolume
{
  if (@this == 1) 
  {
    Iso11783IL_OPSetAudioVolume( @OPC::CmdSetAudioVolumeValue );
  }
}

//
// Send change numeric value command
//
on sysvar OPC::CmdChangeNumeric
{
  if (@this == 1) 
  {
    Iso11783IL_OPSetNumericValue( @OPC::CmdChangeNumericObjecId, @OPC::CmdChangeNumericValue );
  }
}

//
// Send change string command
//
on sysvar OPC::CmdChangeString
{
  char buffer[40];
  dword options = 0;

  if (@this == 1) 
  {
    sysGetVariableString( sysvar::OPC::CmdChangeStringValue, buffer, elcount(buffer) );
    Iso11783IL_OPSetStringValue( @OPC::CmdChangeStringObjectId, buffer, options, @OPC::CmdChangeStringUseWideCharacter > 0 ? 0 : 1);
  }
}

//
// Send change aktive mask command
//
on sysvar OPC::CmdChangeActiveMask
{
  if (@this == 1) 
  {
    Iso11783IL_OPChangeActiveMask( @OPC::CmdChangeMaskMaskId );
  }
}

//
// Send change softkey mask command
//
on sysvar OPC::CmdChangeSoftKeyMask
{
  if (@this == 1) 
  {
    Iso11783IL_OPChangeSoftKeyMask( @OPC::CmdChangeSoftDataMaskId, @OPC::CmdChangeSoftKeyMaskId );
  }
}

//
// Send change list item command
//
on sysvar OPC::CmdChangeListItem
{
  if (@this == 1) 
  {
    Iso11783IL_OPChangeListItem( 
      @OPC::CmdChangeListObjectId, 
      @OPC::CmdChangeListItemIndex, 
      @OPC::CmdChangeListNewId 
    );
  }
}

//
// Send change child location command to the VT.
//
on sysvar OPC::CmdChangeChildLocation
{
  if (@this == 1) 
  {
    Iso11783IL_OPChangeChildLocation( 
      @OPC::CmdChangeChildParentId, 
      @OPC::CmdChangeChildObjectId, 
      @OPC::CmdChangeChildX, 
      @OPC::CmdChangeChildY
    );
  }
}

//
// Send change size command to the VT.
//
on sysvar OPC::CmdChangeSize
{
  if (@this == 1) 
  {
    Iso11783IL_OPChangeSize(
      @OPC::CmdChangeSizeID,
      @OPC::CmdChangeSizeWidth,
      @OPC::CmdChangeSizeHeight
    );
  }
}

//
// Send change background color command to the VT.
//
on sysvar OPC::CmdChangeBkColor
{
  if (@this == 1) 
  {
    Iso11783IL_OPChangeBackgroundColor( 
      @OPC::CmdChangeBkColorID, 
      @OPC::CmdChangeBkColorValue 
    );
  }
}

//
// Send change end point command to the VT.
//
on sysvar OPC::CmdChangeEndPoint
{
  if (@this == 1) 
  {
    Iso11783IL_OPChangeEndPoint( 
      @OPC::CmdChangeEndPointID,
      @OPC::CmdChangeEndPointWidth,
      @OPC::CmdChangeEndPointHeight,
      @OPC::CmdChangeEndPointDirection 
    );
  }
}

//
// Send change font attribute command to the VT.
//
on sysvar OPC::CmdChangeFont
{
  if (@this == 1) 
  {
    Iso11783IL_OPChangeFontAttribute(
      @OPC::CmdChangeFontID,
      @OPC::CmdChangeFontColor,
      @OPC::CmdChangeFontSize,
      @OPC::CmdChangeFontType,
      @OPC::CmdChangeFontStyle
    );
  }
}

//
// Send change line attribute command to the VT.
//
on sysvar OPC::CmdChangeLine
{
  if (@this == 1) 
  {
    Iso11783IL_OPChangeLineAttribute(
      @OPC::CmdChangeLineID,
      @OPC::CmdChangeLineColor,
      @OPC::CmdChangeLineWidth,
      @OPC::CmdChangeLineArt
    );
  }
}

//
// Send change fill attribute command to the VT.
//
on sysvar OPC::CmdChangeFill
{
  if (@this == 1) 
  {
    Iso11783IL_OPChangeFillAttribute(
      @OPC::CmdChangeFillID,
      @OPC::CmdChangeFillColor,
      @OPC::CmdChangeFillType,
      @OPC::CmdChangeFillPatternID
    );
  }
}

//
// Send change attribute command to the VT.
//
on sysvar OPC::CmdChangeAttribute
{
  if (@this == 1) 
  {
    CmdChangeAttribute();
  }
}

//
// Send change priority command to the VT.
//
on sysvar OPC::CmdChangePriority
{
  if (@this == 1) 
  {
    Iso11783IL_OPChangePriority(
      @OPC::CmdChangePriorityID,
      @OPC::CmdChangePriorityValue
    );
  }
}

//
// Initiaialize all global variables in this function.
//
void OPCInit()
{
  // suppress the auto-start function of the IL
  Iso11783IL_ControlInit();
}

//
// Call this function to connect the node to the bus
//
void OPCStartUp()
{
  Write( "<%s> Supported VT Version: %u", gECULabel,  @OPC::VTVersion );
  Iso11783IL_OPSetProperty( "Version", @OPC::VTVersion );
  
  Iso11783IL_ControlStart();

  // select ECU page
  @OPC::CurrentTabPage = 0;

  // disable some controls
  OPCEnableControls( 1 );

  gVT21.da = gVTAddress;
  gVT21.sa = OPC.NmStationAddress;
}

//
// Call this function to disconnect the node from the bus
//
void OPCShutDown()
{
  Iso11783IL_ControlStop();
  
  // enable controls
  OPCEnableControls( 0 );
}

//
// Send change child position command to the VT.
//
on sysvar OPC::CmdChangeChildPosition
{
  if (@this == 1) 
  {
    Iso11783IL_OPChangeChildPosition( 
      @OPC::CmdChangeChildParentId, 
      @OPC::CmdChangeChildObjectId, 
      @OPC::CmdChangeChildX, 
      @OPC::CmdChangeChildY 
    );
  }
}

//
// Increase/decrease timer value for sending modified attribute values to the Vt
// 
on sysvar OPC::CmdChangeAttributeValueCycle
{
  if (@OPC::CmdChangeAttributeValueEnblCyc > 0) 
  {
    cancelTimer( gChangeAttrValueTimer );
    gChangeAttrValueTime = @this;
    if (gChangeAttrValueTime > 0) 
    {
      setTimer( gChangeAttrValueTimer, gChangeAttrValueTime * gChangeAttrValueTimeFact );
    }
  }
}

on timer gChangeAttrValueTimer
{
  int value;
  if (@OPC::CmdChangeAttributeValueCycle > 0) 
  {
    value = @OPC::CmdChangeAttributeValue;
    if (value < @OPC::CmdChangeAttributeValueMax) 
    {
      value++;
    }
    else {
      value = @OPC::CmdChangeAttributeValueMin; 
    }
    @OPC::CmdChangeAttributeValue = value; 

    CmdChangeAttribute();

    setTimer( gChangeAttrValueTimer, gChangeAttrValueTime * gChangeAttrValueTimeFact);
  }
}

//
// Enables/disables cyclically increment of the attribute value
// which is sent via command 'Change attribute' to the VT
//
on sysvar OPC::CmdChangeAttributeValueEnblCyc
{
  cancelTimer( gChangeAttrValueTimer ); 
  if (@this > 0) 
  {
    gChangeAttrValueTime = @OPC::CmdChangeAttributeValueCycle;
    if (gChangeAttrValueTime > 0) 
    {
      setTimer( gChangeAttrValueTimer, gChangeAttrValueTime * gChangeAttrValueTimeFact );
    }  
  }
}

//
// Increment attribute value and send it via command 'Change attribute' to the VT
//
on sysvar OPC::CmdChangeAttributeValueNext
{
  int value;

  if (@this == 1) 
  {
    value = @OPC::CmdChangeAttributeValue;
    if (value < @OPC::CmdChangeAttributeValueMax) 
    {
      value++;
    }
    else 
    {
      value = @OPC::CmdChangeAttributeValueMin; 
    }
    @OPC::CmdChangeAttributeValue = value; 

    CmdChangeAttribute();
  }
}

//
// Decrement attribute value and send it via command 'Change attribute' to the VT
//
on sysvar OPC::CmdChangeAttributeValuePrev
{
  int value;
  if (@this == 1) 
  {
    value = @OPC::CmdChangeAttributeValue;
    if (value > @OPC::CmdChangeAttributeValueMin) 
    {
      value--;
    }
    else 
    {
      value = @OPC::CmdChangeAttributeValueMax; 
    }
    @OPC::CmdChangeAttributeValue = value; 
    
    CmdChangeAttribute();
  }
}

//
// Send command 'Change Polygon Point' to the VT
//
on sysvar OPC::CmdChangePolygonPoint
{
  if (@this == 1) 
  {
    ResetVtData();
    gVT21.VTFunctionECUtoVT        = VT21.VTFunctionECUtoVT::ChangePolygonPoint;
    gVT21.PolygonObjectToChangeID  = @OPC::CmdChangePolygonPointId;
    gVT21.IndexOfThePointToReplace = @OPC::CmdChangePolygonPointIndex;
    gVT21.NewValueX                = @OPC::CmdChangePolygonPointX;
    gVT21.NewValueY                = @OPC::CmdChangePolygonPointY;
    output( gVT21 );
  }
}

//
// Send command 'Change Polygon Scale' to the VT
//
on sysvar OPC::CmdChangePoylgonScale
{
  if (@this == 1) 
  {
    ResetVtData();
    gVT21.VTFunctionECUtoVT       = VT21.VTFunctionECUtoVT::ChangePolygonScale;
    gVT21.PolygonObjectToScaleID  = @OPC::CmdChangePoylgonScaleId;
    gVT21.NewWidthAttribute       = @OPC::CmdChangePoylgonScaleWidth;
    gVT21.NewHeigthAttribute      = @OPC::CmdChangePoylgonScaleHeight;
    output( gVT21 );
  }
}

//
// Send command 'Execute Macro' to the VT
//
on sysvar OPC::CmdExecuteMacro
{
  if (@this == 1) 
  {
    ResetVtData();
    gVT21.VTFunctionECUtoVT = VT21.VTFunctionECUtoVT::ExecuteMacro;
    gVT21.MacroObjectID = @OPC::CmdExecuteMacroObjId;
    output( gVT21 );
  }
}

//
// Send Graphics Context command 'Change Viewport Size' to the VT
//
on sysvar OPC::CmdGcChangeViewportSize
{
  if (@this == 1) 
  {
    SendGraphicsContextCmd( kChangeViewportSize, @OPC::CmdGcChangeViewportSizeWidth, @OPC::CmdGcChangeViewportSizeHeight );
  }
}

//
// Send Graphics Context command 'Copy Canvas to Picture' to the VT
//
on sysvar OPC::CmdGcCopyCanvasToPicture
{
  if (@this == 1) 
  {
    SendGraphicsContextCmd( 19, @OPC::CmdGcCopyCanvasToPictureValue, 0xFFFF );
  }
}

//
// Send Graphics Context command 'Copy Viewport to Picture' to the VT
//
on sysvar OPC::CmdGcCopyViewportToPicture
{
  if (@this == 1) 
  {
    SendGraphicsContextCmd( 20, @OPC::CmdGcCopyViewportToPictureValue, 0xFFFF );
  }
}

//
// Send Graphics Context command 'Draw Closed Ellipse' to the VT
//
on sysvar OPC::CmdGcDrawClosedEllipse
{
  if (@this == 1) 
  {
    SendGraphicsContextCmd( 11, @OPC::CmdGcDrawClosedEllipseWidth, @OPC::CmdGcDrawClosedEllipseHeight );
  }
}

//
// Send Graphics Context command 'Draw Line' to the VT
//
on sysvar OPC::CmdGcDrawLine
{
  if (@this == 1) 
  {
    SendGraphicsContextCmd( 9, @OPC::CmdGcDrawLineX, @OPC::CmdGcDrawLineY );
  }
}

//
// Send Graphics Context command 'Draw Point' to the VT
//
on sysvar OPC::CmdGcDrawPoint
{
  if (@this == 1) 
  {
    SendGraphicsContextCmd( 8, @OPC::CmdGcDrawPointX, @OPC::CmdGcDrawPointY );
  }
}

//
// Send Graphics Context command 'Draw Polygon' to the VT
//
on sysvar OPC::CmdGcDrawPolygon
{
  if (@this == 1) 
  {  
    pg VT21 vt21 = {dlc = 21};
    vt21.sa = OPC.NmStationAddress;
    vt21.da = gVTAddress;

    vt21.byte(0)  = VT21.VTFunctionECUtoVT::GraphicsContextCommand;
    vt21.byte(1)  = @OPC::CmdGcObjectID & 0xff;
    vt21.byte(2)  = (@OPC::CmdGcObjectID >> 8) & 0xff;
    vt21.byte(3)  = 12;
    vt21.byte(4)  = 4; // num of points 
    vt21.byte(5)  =  @OPC::CmdGcDrawPolygonX1       & 0xff;
    vt21.byte(6)  = (@OPC::CmdGcDrawPolygonX1 >> 8) & 0xff;
    vt21.byte(7)  =  @OPC::CmdGcDrawPolygonY1       & 0xff;
    vt21.byte(8)  = (@OPC::CmdGcDrawPolygonY1 >> 8) & 0xff;
    vt21.byte(9)  =  @OPC::CmdGcDrawPolygonX2       & 0xff;
    vt21.byte(10) = (@OPC::CmdGcDrawPolygonX2 >> 8) & 0xff;
    vt21.byte(11) =  @OPC::CmdGcDrawPolygonY2       & 0xff;
    vt21.byte(12) = (@OPC::CmdGcDrawPolygonY2 >> 8) & 0xff;
    vt21.byte(13) =  @OPC::CmdGcDrawPolygonX3       & 0xff;
    vt21.byte(14) = (@OPC::CmdGcDrawPolygonX3 >> 8) & 0xff;
    vt21.byte(15) =  @OPC::CmdGcDrawPolygonY3       & 0xff;
    vt21.byte(16) = (@OPC::CmdGcDrawPolygonY3 >> 8) & 0xff;
    vt21.byte(17) =  @OPC::CmdGcDrawPolygonX4       & 0xff;
    vt21.byte(18) = (@OPC::CmdGcDrawPolygonX4 >> 8) & 0xff;
    vt21.byte(19) =  @OPC::CmdGcDrawPolygonY4       & 0xff;
    vt21.byte(20) = (@OPC::CmdGcDrawPolygonY4 >> 8) & 0xff;

    output( vt21 );
  }
}

//
// Send Graphics Context command 'Draw Rectangle' to the VT
//
on sysvar OPC::CmdGcDrawRecangle
{
  if (@this == 1) {
    SendGraphicsContextCmd( 10, @OPC::CmdGcDrawRecangleWidth, @OPC::CmdGcDrawRecangleHeight );
  }
}

//
// Send Graphics Context command 'Draw Text' to the VT
//
on sysvar OPC::CmdGcDrawText
{
  int  i;
  word length;
  char buf[25];
  pg VT21 vt21 = {dlc = 18};

  if (@this == 1) 
  {
    vt21.sa = OPC.NmStationAddress;
    vt21.da = gVTAddress;
    
    sysGetVariableString( sysvar::OPC::CmdGcDrawTextValue, buf, elcount(buf) );  

    length = strlen( buf );
    vt21.dlc = 6 + length;
    
    vt21.byte(0) = VT21.VTFunctionECUtoVT::GraphicsContextCommand;
    vt21.byte(1) = @OPC::CmdGcObjectID & 0xff;
    vt21.byte(2) = (@OPC::CmdGcObjectID >> 8) & 0xff;
    vt21.byte(3) = 13;
    vt21.byte(4) = @OPC::CmdGcDrawTextTransparent;
    vt21.byte(5) = length;

    for( i = 0; i < length; i++ ) 
    {
      vt21.byte(i+6) = buf[i];
    }
    
    output( vt21 );
  }
}

//
// Send Graphics Context command 'Draw VT Object' to the VT
//
on sysvar OPC::CmdGcDrawVTObject
{
  if (@this == 1) 
  {
    SendGraphicsContextCmd( 18, @OPC::CmdGcDrawVTObjectValue, 0xFFFF );
  }
}

//
// Draw a wide character text into the graphics context object 
//
on sysvar OPC::CmdGcDrawWideCharText
{
  int  i;
  word length;
  pg VT21 vt21 = {dlc = 18};

  vt21.sa = OPC.NmStationAddress;
  vt21.da = gVTAddress;

  if (@this == 1) 
  {
    length = 14;
    vt21.byte(0) = VT21.VTFunctionECUtoVT::GraphicsContextCommand;
    vt21.byte(1) = @OPC::CmdGcObjectID & 0xff;
    vt21.byte(2) = (@OPC::CmdGcObjectID >> 8) & 0xff;
    vt21.byte(3) = 13;
    vt21.byte(4) = @OPC::CmdGcDrawTextTransparent;
    vt21.byte(5) = length;
    // BOM
    vt21.byte(6) = 0xff;
    vt21.byte(7) = 0xfe;
    // Unicode text
    vt21.byte(8)  = 'U';
    vt21.byte(9)  = 0x00;
    vt21.byte(10) = 'N';
    vt21.byte(11) = 0x00;
    vt21.byte(12) = '\n';
    vt21.byte(13) = 0x00;
    vt21.byte(14) = 'I';
    vt21.byte(15) = 0x00;
    vt21.byte(16) = 'C';
    vt21.byte(17) = 0x00;

    output( vt21 );
  }
}

//
// Send Graphics Context command 'Erase Rectangle' to the VT
//
on sysvar OPC::CmdGcEraseRectangle
{
  if (@this == 1) 
  {
    SendGraphicsContextCmd( 7, @OPC::CmdGcEraseRectangleWidth, @OPC::CmdGcEraseRectangleHeight );
  }
}

//
// Send Graphics Context command 'Move Graphics Cursor' to the VT
//
on sysvar OPC::CmdGcMoveGraphicsCursor
{
  if (@this == 1) 
  {
    SendGraphicsContextCmd( 1, @OPC::CmdGcMoveGraphicsCursorX, @OPC::CmdGcMoveGraphicsCursorY );
  }
}

//
// Send Graphics Context command 'Pan and Zoom Viewport' to the VT
//
on sysvar OPC::CmdGcPanAndZoomViewport
{
  int  i;
  word length;
  float zoom;
  byte zoomValue[4];
  pg VT21 vt21 = {dlc = 12};

  vt21.sa = OPC.NmStationAddress;
  vt21.da = gVTAddress;
  
  if (@this == 1) {

    Float64ToInt32( @OPC::CmdGcZoomViewportValue, zoomValue );

    vt21.byte(0)  = VT21.VTFunctionECUtoVT::GraphicsContextCommand;
    vt21.byte(1)  =  @OPC::CmdGcObjectID       & 0xff;
    vt21.byte(2)  = (@OPC::CmdGcObjectID >> 8) & 0xff;
    vt21.byte(3)  = 16;
    vt21.byte(4)  =  @OPC::CmdGcPanViewportX       & 0xff;
    vt21.byte(5)  = (@OPC::CmdGcPanViewportX >> 8) & 0xff;
    vt21.byte(6)  =  @OPC::CmdGcPanViewportY       & 0xff;
    vt21.byte(7)  = (@OPC::CmdGcPanViewportY >> 8) & 0xff;
    vt21.byte(8)  =  zoomValue[0];
    vt21.byte(9)  =  zoomValue[1];
    vt21.byte(10) =  zoomValue[2];
    vt21.byte(11) =  zoomValue[3];

    output( vt21 );
  }
}

//
// Send Graphics Context command 'Pan Viewport' to the VT
//
on sysvar OPC::CmdGcPanViewport
{
  if (@this == 1) 
  {
    SendGraphicsContextCmd( 14, @OPC::CmdGcPanViewportX, @OPC::CmdGcPanViewportY );
  }
}

//
// Send Graphics Context command 'Set Background Colour' to the VT
//
on sysvar OPC::CmdGcSetBackgroundColour
{
  if (@this == 1) 
  {
    SendGraphicsContextCmd( 3, @OPC::CmdGcSetBackgroundColourValue, 0xFFFF );
  }
}

//
// Send Graphics Context command 'Set Fill Attributes' to the VT
//
on sysvar OPC::CmdGcSetFillAttributesID
{
  if (@this == 1) 
  {
    SendGraphicsContextCmd( 5, @OPC::CmdGcSetFillAttributesIDValue, 0xFFFF );
  }
}

//
// Send Graphics Context command 'Set Font Attributes' to the VT
//
on sysvar OPC::CmdGcSetFontAttributesID
{
  if (@this == 1) 
  {
    SendGraphicsContextCmd( 6, @OPC::CmdGcSetFontAttributesIDValue, 0xFFFF );
  }
}

//
// Send Graphics Context command 'SEt Foreground Colour' to the VT
//
on sysvar OPC::CmdGcSetForegroundColour
{
  if (@this == 1) 
  {
    SendGraphicsContextCmd( 2, @OPC::CmdGcSetForegroundColourValue, 0xFFFF );
  }
}

//
// Send Graphics Context command 'Set Graphics Cursor' to the VT
//
on sysvar OPC::CmdGcSetGraphicsCursor
{
  if (@this == 1) 
  {
    SendGraphicsContextCmd( 0, @OPC::CmdGcSetGraphicsCursorX, @OPC::CmdGcSetGraphicsCursorY );
  }
}

//
// Send Graphics Context command 'Set Line Attributes' to the VT
//
on sysvar OPC::CmdGcSetLineAttributesID
{
  if (@this == 1) 
  {
    SendGraphicsContextCmd( 4, @OPC::CmdGcSetLineAttributesIDValue, 0xFFFF );
  }
}

//
// Send Graphics Context command 'Zoom Viewport' to the VT
//
on sysvar OPC::CmdGcZoomViewport
{
  if (@this == 1) 
  {
    SendGraphicsContextCmdFloat( 15, @OPC::CmdGcZoomViewportValue );
  }
}

//
// Send command 'Get Attribute' to the VT
//
on sysvar OPC::CmdGetAttribute
{
  if (@this == 1) 
  {
    ResetVtData();
    gVT21.VTFunctionECUtoVT      = VT21.VTFunctionECUtoVT::GetAttribute;
    gVT21.ObjectToGetAttributeID = @OPC::CmdGetAttributeId;
    gVT21.AttributeID            = @OPC::CmdGetAttributeAttrId;
    output( gVT21 );
  }
}

//
// Send command 'Get Window Mask Data' to the VT
//
on sysvar OPC::CmdGetWindowMaskData
{
  if (@this == 1) 
  {
    ResetVtData();
    gVT21.VTFunctionECUtoVT = VT21.VTFunctionECUtoVT::GetWindowMaskData;
    output ( gVT21 );
  }
}

//
// Send command 'Get Memory' to the VT
//
on sysvar OPC::CmdGetMemory
{
  if (@this == 1) 
  {
    ResetVtData();
    gVT21.VTFunctionECUtoVT = VT21.VTFunctionECUtoVT::GetMemory; // get memory
    gVT21.MemoryRequired    = @OPC::CmdGetMemoryNumOfBytes;
    output( gVT21 );
  }
}

//
// Send command 'Get Supported Wide Characters' to the VT
//
on sysvar OPC::CmdGetSupportedWideChars
{
  if (@this == 1) 
  {
    ResetVtData();
    gVT21.VTFunctionECUtoVT = 193; // get supported wide chars
    gVT21.CodePlane         = @OPC::CmdGetSupportedWideCharsCodeplane;
    gVT21.FirstWideChar     = @OPC::CmdGetSupportedWideCharsFirstChar;
    gVT21.LastWideChar      = @OPC::CmdGetSupportedWideCharsLastChar;
    output( gVT21 );
  }
}

//
// Send command 'Get Supported Objects' to the VT
//
on sysvar OPC::CmdGetSupportedObjects
{
  if (@this == 1) 
  {
    ResetVtData();
    gVT21.VTFunctionECUtoVT = VT21.VTFunctionECUtoVT::GetSupportedObjects;
    output( gVT21 );
  }
}

//
// Send command 'Get Supported Objects' to the VT
//
on sysvar OPC::CmdGetNumberOfSoftKeys
{
  if (@this == 1) 
  {
    ResetVtData();
    gVT21.VTFunctionECUtoVT = VT21.VTFunctionECUtoVT::GetNumberOfSoftKeys;
    output( gVT21 );
  }
}

//
// Send command 'Identify VT' to the VT
//
on sysvar OPC::CmdIdentifyVT
{
  if (@this == 1) 
  {
    ResetVtData();
    gVT21.VTFunctionECUtoVT     = 187; // identify VT
    output( gVT21 );
  }
}

//
// Send command 'Lock Unlock Mask' to the VT
//
on sysvar OPC::CmdLockUnlockMask
{
  if (@this == 1) 
  {
    ResetVtData();
    gVT21.VTFunctionECUtoVT       = VT21.VTFunctionECUtoVT::LockUnlockMask;
    gVT21.LockUnlockCommand       = @OPC::CmdLockUnlockMaskType;
    gVT21.ObjectIdOfMaskToLock    = @OPC::CmdLockUnlockMaskId;
    gVT21.LockTimeout             = @OPC::CmdLockUnlockMaskTimeout;
    output( gVT21 );
  }
}

//
// Send command 'Select Colour Map' to the VT
//
on sysvar OPC::CmdSelectColourMap
{
  if (@this == 1) 
  {
    ResetVtData();
    gVT21.VTFunctionECUtoVT = VT21.VTFunctionECUtoVT::SelectColourMap;
    gVT21.ColourMapObjectID = @OPC::CmdSelectColourMapId;
    output( gVT21 );
  }
}

//
// Send command 'Change Object Label' to the VT
//
on sysvar OPC::CmdChangeObjectLabel
{
  if (@this == 1) {
    ResetVtData();
    gVT21.VTFunctionECUtoVT = VT21.VTFunctionECUtoVT::ChangeObjectLabel;
    gVT21.ObjectToAssociateLabelWithID   = @OPC::CmdSetObjectLabelId;
    gVT21.StringVariableObjectID         = @OPC::CmdSetObjectLabelStringVarId;
    gVT21.FontType                       = @OPC::CmdSetObjectLabelFontType;
    gVT21.GraphicRepresentationObjectID  = @OPC::CmdSetObjectLabelLabelObjId;
    output( gVT21 );
  }
}

//
// Send Graphics Context Command
//
SendGraphicsContextCmd( BYTE subCmd, WORD val1, WORD val2)
{
  ResetVtData();
  gVT21.VTFunctionECUtoVT         = VT21.VTFunctionECUtoVT::GraphicsContextCommand;
  gVT21.GraphicsContextObjectID   = @OPC::CmdGcObjectID;
  gVT21.SubCommandID              = subCmd;
  gVT21.byte(4) = val1 & 0xff;
  gVT21.byte(5) = (val1 >> 8) & 0xff;
  gVT21.byte(6) = val2 & 0xff;
  gVT21.byte(7) = (val2 >> 8) & 0xff;
  gVT21.dlc = 8;

  output( gVT21 );
}

//
// Send Graphics Context Command
//
SendGraphicsContextCmdFloat( BYTE subCmd, float val )
{
  byte floatValue[4];

  Float64ToInt32( val, floatValue );

  ResetVtData();
  gVT21.VTFunctionECUtoVT         = VT21.VTFunctionECUtoVT::GraphicsContextCommand;
  gVT21.GraphicsContextObjectID   = @OPC::CmdGcObjectID;
  gVT21.SubCommandID              = subCmd;
  gVT21.byte(4) = floatValue[0];
  gVT21.byte(5) = floatValue[1];
  gVT21.byte(6) = floatValue[2];
  gVT21.byte(7) = floatValue[3];

  output( gVT21 );
}

//
// Enable/disable some panel controls
//
void OPCEnableControls( byte measurementIsRunning )
{ 
  enableControl( "", "VT Version Box"   , measurementIsRunning > 0 ? 0 : 1 );
  enableControl( "", "ECU Address"      , measurementIsRunning > 0 ? 0 : 1 );
  enableControl( "", "Object Pool Path" , measurementIsRunning > 0 ? 1 : 0 );
  enableControl( "", "Transmit"         , measurementIsRunning > 0 ? 1 : 0 );
  enableControl( "", "Load"             , measurementIsRunning > 0 ? 1 : 0 );
  enableControl( "", "Store"            , measurementIsRunning > 0 ? 1 : 0 );
  enableControl( "", "Get"              , measurementIsRunning > 0 ? 1 : 0 );
  enableControl( "", "Get Extended"     , measurementIsRunning > 0 ? 1 : 0 );
  enableControl( "", "Delete"           , measurementIsRunning > 0 ? 1 : 0 );
  if (measurementIsRunning == 0)
  {
    enableControl( "", "Export", 0 );
    enableControl( "", "Object Pool Path Export", 0 );  
  }
}

// 
// Reset data of the VT12 message
//
void ResetVtData()
{
  int cnt;
  for (cnt=0; cnt<gVT21.dlc; ++cnt)
  {
    gVT21.byte(cnt) = 0xFF;
  }
}

//
// Send command 'Get Text Font Data' to the VT
//
on sysvar OPC::CmdGetTextFontData
{
  if (@this == 1) 
  {
    ResetVtData();
    gVT21.VTFunctionECUtoVT = VT21.VTFunctionECUtoVT::GetTextFontData;
    output ( gVT21 );
  }
}

int Float64ToInt32( float inValue, byte outValue[] )
{
  int intValue;
  int signBit; // 1 bit
  int exponent; // 11 bit (64 bit float) -> 8 bit (32 bit float)
  int64 mantisse; // 52 bit (64 bit float) -> 23 bit (32 bit float) 

  struct { float val; } floatStruct;
  byte buf[8];

  // check size
  if (elcount(outValue)<4) return -1;

  // get sign bit, mantisse and exponent
  floatStruct.val = inValue;
  memcpy( buf, floatStruct );
  signBit = buf[7] >> 7;
  exponent = ((buf[7] & 0x7F) << 4) | ((buf[6] & 0xF0) >> 4); // 8 bit
  if (exponent != 0)
  {
    exponent = (exponent - 1023) + 127;
  }
  mantisse = ((buf[6] & 0x0F) << 19) | (buf[5] << 11)  | (buf[4] << 3)  | (buf[3] >> 5); // 23 bit

  // create 32 bit float value
  outValue.byte(0) = mantisse & 0xFF;
  outValue.byte(1) = (mantisse >> 8) & 0xFF;
  outValue.byte(2) = ((exponent & 0x01) << 7) | (mantisse >> 16);
  outValue.byte(3) = (signBit << 7) | (exponent >> 0x01);

  return 0;
}

//
// Send the delete version command to the VT.
//
on sysvar OPC::Delete
{
  char version[255];
  int i, versionLength;

  if (@this == 1) 
  {
    sysGetVariableString( sysvar::OPC::Version, version, elcount(version) );    
    Iso11783IL_OPDeleteVersion(version);
  }
}

//
// Send command 'Delete Object Pool' to the VT
//
on sysvar OPC::CmdDeleteObjectPool
{
  if (@this == 1) 
  {
    Iso11783IL_OPDeleteObjectPool();
  }
}

on sysvar OPC::CmdSaveAuxAssignment
{
  if (@this == 1)
    {
    Iso11783IL_OPSaveAuxAssignment(gAuxAssignmentFile);
  }
}

on sysvar OPC::CmdLoadAuxAssignment
{
  if (@this == 1) 
  {
    Iso11783IL_OPLoadAuxAssignment(gAuxAssignmentFile);
  }
}

on sysvar OPC::CmdScreenCapture
{
  if (@this == 1) 
  {
    Iso11783IL_OPScreenCapture(
      @OPC::CmdScreenCaptureItem, 
      @OPC::CmdScreenCapturePath
    );
  }
}

on sysvar OPC::CmdShowWorkingSet
{
  byte buffer[8];
  long copiedBytes;
  sysvarData * sv;
  
  if (@this == 1) 
  {
    ResetVtData();
    gVT21.VTFunctionECUtoVT = VT21.VTFunctionECUtoVT::ShowWorkingSet;
    gVT21.dlc = 9;
    gVT21.qword(1)     = @OPC::CmdShowWorkingSetNAME;
    output( gVT21 );
  }
}

on sysvar OPC::CmdProprietaryCommand
{
  if (@this == 1) 
  {
    byte number;
      
    ResetVtData();
    number = @OPC::CmdProprietaryCommandNumber;
    if (number > 15)
    {
      writeEx(1, 2, "\nPlease enter a value between 0 and 15 to send a proprietary command"); 
      return;
    }
    gVT21.VTFunctionECUtoVT = 96 + @OPC::CmdProprietaryCommandNumber;
    output( gVT21 );
  }
}

on sysvar OPC::CmdGetFontVersion
{
  if (@this == 1) 
  {
    ResetVtData();
    gVT21.VTFunctionECUtoVT = VT21.VTFunctionECUtoVT::GetFontVersion;
    gVT21.dlc = 8;
    output( gVT21 );
  }
}

on sysvar OPC::ExportLoadedObjectPool
{
  if (@this == 1) 
  {
    char filePath[256];
    long result;

    sysGetVariableString(sysvar::OPC::FilenameExport, filePath, elcount(filePath));    
    result = Iso11783IL_OPSave(filePath);
    switch (result)
    {
      case 0:  writeEx(1, 1, "\n<%s> Object Pool is exported to file '%s'", gECULabel, filePath); break;
      default: writeEx(1, 2, "\n<%s> Failed to export Object Pool (error %i", gECULabel, result); break;
    } 
  }
}

void CmdChangeAttribute()
{
  byte floatValue[4];
  long rawValue;

  if (@OPC::CmdChangeAttributeUseFloat > 0)
  {
    Float64ToInt32( @OPC::CmdChangeAttributeValue, floatValue );
    rawValue =  (floatValue[3]<<24) | (floatValue[2]<<16) | (floatValue[1]<<8) | floatValue[0];
  }
  else
  {
    rawValue = @OPC::CmdChangeAttributeValue;
  }

  Iso11783IL_OPSetAttribute( @OPC::CmdChangeAttributeID, @OPC::CmdChangeAttributeAID, rawValue );

}

long Iso11783IL_OPOnKeyActivation( dword objectID, dword parentID, dword keyCode, dword activation )
{
  write("Iso11783IL_OPOnKeyActivation");
  return 0;
}


