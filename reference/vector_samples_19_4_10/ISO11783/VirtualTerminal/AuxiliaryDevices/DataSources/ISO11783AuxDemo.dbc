VERSION ""

NS_ :

BS_:

BU_: QuadAnalogue QuadBoolNonLatch Loader VT Analogue BoolLatch BoolNonLatch

BO_ 3221225472 VECTOR__INDEPENDENT_SIG_MSG: 0 Vector__XXX
 SG_ VTFunctionVTtoECU : 0|8@1+ (1,0) [0|255] "" Vector__XXX
 SG_ KeyActivationCode : 0|8@1+ (1,0) [0|2] "" Vector__XXX
 SG_ KeyObjectID : 0|16@1+ (1,0) [0|65535] "" Vector__XXX
 SG_ KeyObjectParentID : 0|16@1+ (1,0) [0|65535] "" Vector__XXX
 SG_ SoftKeyCode : 0|8@1+ (1,0) [0|255] "" Vector__XXX
 SG_ ButtonActivationCode : 0|8@1+ (1,0) [0|2] "" Vector__XXX
 SG_ ButtonObjectID : 0|16@1+ (1,0) [0|65535] "" Vector__XXX
 SG_ ButtonObjectParentID : 0|16@1+ (1,0) [0|65535] "" Vector__XXX
 SG_ ButtonKeyCode : 0|8@1+ (1,0) [0|255] "" Vector__XXX
 SG_ XPosition : 0|16@1+ (1,0) [0|65535] "" Vector__XXX
 SG_ YPosition : 0|16@1+ (1,0) [0|65535] "" Vector__XXX
 SG_ TouchState : 0|8@1+ (1,0) [0|255] "" Vector__XXX
 SG_ VTSelectInputObjectID : 0|16@1+ (1,0) [0|65535] "" Vector__XXX
 SG_ VTSelectInputObjectStatus : 0|8@1+ (1,0) [0|1] "" Vector__XXX
 SG_ VTSelectInputObjectIsEdited : 0|1@1+ (1,0) [0|1] "" Vector__XXX
 SG_ VTEscObjectID : 0|16@1+ (1,0) [0|65535] "" Vector__XXX
 SG_ ErrorCodeVTEsc1 : 0|1@1+ (1,0) [0|1] "" Vector__XXX
 SG_ ErrorCodeVTEsc2 : 0|1@1+ (1,0) [0|1] "" Vector__XXX
 SG_ VTChangeNumericValueObjectID : 0|16@1+ (1,0) [0|65535] "" Vector__XXX
 SG_ VTChangeNumericValueValue : 0|32@1+ (1,0) [0|4294967295] "" Vector__XXX
 SG_ VTChangeActiveMaskObjectID : 0|16@1+ (1,0) [0|65535] "" Vector__XXX
 SG_ ErrorCodeMissingObjects : 0|1@1+ (1,0) [0|1] "" Vector__XXX
 SG_ ErrorCodeMaskOrChildObjectError : 0|1@1+ (1,0) [0|1] "" Vector__XXX
 SG_ ErrorCodeAnyOtherError : 0|1@1+ (1,0) [0|1] "" Vector__XXX
 SG_ ErrorCodePoolDeleted : 0|1@1+ (1,0) [0|1] "" Vector__XXX
 SG_ VTChangeActiveMaskErrorID : 0|16@1+ (1,0) [0|65535] "" Vector__XXX
 SG_ VTChangeActiveMaskParentID : 0|16@1+ (1,0) [0|65535] "" Vector__XXX
 SG_ VTChangeSoftKeyMaskParentID : 0|16@1+ (1,0) [0|65535] "" Vector__XXX
 SG_ VTChangeSoftKeyMaskObjectID : 0|16@1+ (1,0) [0|65535] "" Vector__XXX
 SG_ ErrorCodeVTChangeSoftKeyMask1 : 0|1@1+ (1,0) [0|1] "" Vector__XXX
 SG_ ErrorCodeVTChangeSoftKeyMask2 : 0|1@1+ (1,0) [0|1] "" Vector__XXX
 SG_ ErrorCodeVTChangeSoftKeyMask3 : 0|1@1+ (1,0) [0|1] "" Vector__XXX
 SG_ ErrorCodeVTChangeSoftKeyMask4 : 0|1@1+ (1,0) [0|1] "" Vector__XXX
 SG_ ErrorCodeVTChangeSoftKeyMask5 : 0|1@1+ (1,0) [0|1] "" Vector__XXX
 SG_ ObjectToChangeStringID : 0|16@1+ (1,0) [0|65535] "" Vector__XXX
 SG_ EnteredStringValue : 0|8@1+ (1,0) [0|255] "" Vector__XXX
 SG_ DisplayActivationStatus1 : 0|1@1+ (1,0) [0|1] "" Vector__XXX
 SG_ VisibleDataAlarmMaskID : 0|16@1+ (1,0) [0|65535] "" Vector__XXX
 SG_ VisibleSoftKeyMaskID : 0|16@1+ (1,0) [0|65535] "" Vector__XXX
 SG_ ErrorCodeEndOfObjectPool1 : 0|1@1+ (1,0) [0|1] "" Vector__XXX
 SG_ ErrorCodeEndOfObjectPool2 : 0|1@1+ (1,0) [0|1] "" Vector__XXX
 SG_ ErrorCodeEndOfObjectPool3 : 0|1@1+ (1,0) [0|1] "" Vector__XXX
 SG_ ParentObjectIdOfFaultyObject : 0|16@1+ (1,0) [0|65535] "" Vector__XXX
 SG_ ObjectIdOfFaultyObject : 0|16@1+ (1,0) [0|65535] "" Vector__XXX
 SG_ ErrorCodeObjectPool1 : 0|1@1+ (1,0) [0|1] "" Vector__XXX
 SG_ ErrorCodeObjectPool2 : 0|1@1+ (1,0) [0|1] "" Vector__XXX
 SG_ ErrorCodeObjectPool3 : 0|1@1+ (1,0) [0|1] "" Vector__XXX
 SG_ ErrorCodeObjectPool4 : 0|1@1+ (1,0) [0|1] "" Vector__XXX
 SG_ IdentityNumber : 0|21@1+ (1,0) [0|2097150] "" Vector__XXX
 SG_ ManufacturerCode : 0|11@1+ (1,0) [0|2047] "" Vector__XXX
 SG_ ECUInstance : 0|3@1+ (1,0) [0|7] "" Vector__XXX
 SG_ FunctionInstance : 0|5@1+ (1,0) [0|31] "" Vector__XXX
 SG_ AuxiliaryInputObjectID : 0|16@1+ (1,0) [0|65535] "" Vector__XXX
 SG_ InputObjectId : 0|16@1+ (1,0) [0|255] "" Vector__XXX
 SG_ Value1 : 0|16@1+ (1,0) [0|65535] "" Vector__XXX
 SG_ Function : 0|8@1+ (1,0) [0|255] "" Vector__XXX
 SG_ DeviceClass : 0|7@1+ (1,0) [0|127] "" Vector__XXX
 SG_ IndustryGroup : 0|3@1+ (1,0) [0|7] "" Vector__XXX
 SG_ DeviceClassInstance : 0|4@1+ (1,0) [0|15] "" Vector__XXX
 SG_ SelfConfigurableAddress : 0|1@1+ (1,0) [0|1] "" Vector__XXX
 SG_ AuxiliaryFunctionType : 0|4@1+ (1,0) [0|15] "" Vector__XXX
 SG_ AuxiliaryFunctionObjectID : 0|16@1+ (1,0) [0|65535] "" Vector__XXX
 SG_ Value2 : 0|16@1+ (1,0) [0|65535] "" Vector__XXX
 SG_ AuxPreferredAssignmentRespError1 : 0|1@1+ (1,0) [0|1] "" Vector__XXX
 SG_ AuxPreferredAssignmentRespError2 : 0|1@1+ (1,0) [0|1] "" Vector__XXX
 SG_ AuxPreferredAssignmentRespError3 : 0|1@1+ (1,0) [0|1] "" Vector__XXX
 SG_ AuxPreferredAssignmentRespError4 : 0|1@1+ (1,0) [0|1] "" Vector__XXX
 SG_ InputStatusObjectId : 0|16@1+ (1,0) [0|255] "" Vector__XXX
 SG_ AuxInputEnable : 0|8@1+ (1,0) [0|1] "" Vector__XXX
 SG_ ObjectEscapeID : 0|16@1+ (1,0) [0|65535] "" Vector__XXX
 SG_ ErrorCodeEscapeObj1 : 0|1@1+ (1,0) [0|1] "" Vector__XXX
 SG_ ErrorCodeEscapeObj2 : 0|1@1+ (1,0) [0|1] "" Vector__XXX
 SG_ ObjectToHideShowID : 0|16@1+ (1,0) [0|65535] "" Vector__XXX
 SG_ ObjectShowStatus : 0|8@1+ (1,0) [0|1] "" Vector__XXX
 SG_ ErrorCodeHideShowObj1 : 0|1@1+ (1,0) [0|1] "" Vector__XXX
 SG_ ErrorCodeHideShowObj2 : 0|1@1+ (1,0) [0|1] "" Vector__XXX
 SG_ ErrorCodeHideShowObj3 : 0|1@1+ (1,0) [0|1] "" Vector__XXX
 SG_ ObjectToEnableDisableID : 0|16@1+ (1,0) [0|65535] "" Vector__XXX
 SG_ ObjectEnableStatus : 0|8@1+ (1,0) [0|1] "" Vector__XXX
 SG_ ErrorCodeEnableDisableObj1 : 0|1@1+ (1,0) [0|1] "" Vector__XXX
 SG_ ErrorCodeEnableDisableObj2 : 0|1@1+ (1,0) [0|1] "" Vector__XXX
 SG_ ErrorCodeEnableDisableObj3 : 0|1@1+ (1,0) [0|1] "" Vector__XXX
 SG_ ErrorCodeEnableDisableObj4 : 0|1@1+ (1,0) [0|1] "" Vector__XXX
 SG_ SelectInputObjectID : 0|16@1+ (1,0) [0|65535] "" Vector__XXX
 SG_ ObjectSelectStatus : 0|8@1+ (1,0) [0|2] "" Vector__XXX
 SG_ ErrorCodeSelectObject1 : 0|1@1+ (1,0) [0|1] "" Vector__XXX
 SG_ ErrorCodeSelectObject2 : 0|1@1+ (1,0) [0|1] "" Vector__XXX
 SG_ ErrorCodeSelectObject3 : 0|1@1+ (1,0) [0|1] "" Vector__XXX
 SG_ ErrorCodeSelectObject4 : 0|1@1+ (1,0) [0|1] "" Vector__XXX
 SG_ ErrorCodeSelectObject5 : 0|1@1+ (1,0) [0|1] "" Vector__XXX
 SG_ ErrorCodeControlAudioDevice1 : 0|1@1+ (1,0) [0|1] "" Vector__XXX
 SG_ ErrorCodeControlAudioDevice2 : 0|1@1+ (1,0) [0|1] "" Vector__XXX
 SG_ ErrorCodeAudioVolume1 : 0|1@1+ (1,0) [0|1] "" Vector__XXX
 SG_ ErrorCodeAudioVolume2 : 0|1@1+ (1,0) [0|1] "" Vector__XXX
 SG_ ParentObjectID3 : 0|16@1+ (1,0) [0|65535] "" Vector__XXX
 SG_ ObjectToMoveID : 0|16@1+ (1,0) [0|65535] "" Vector__XXX
 SG_ ErrorCodeChangeChildLocation1 : 0|1@1+ (1,0) [0|1] "" Vector__XXX
 SG_ ErrorCodeChangeChildLocation2 : 0|1@1+ (1,0) [0|1] "" Vector__XXX
 SG_ ErrorCodeChangeChildLocation5 : 0|1@1+ (1,0) [0|1] "" Vector__XXX
 SG_ ObjectToSizeID : 0|16@1+ (1,0) [0|65535] "" Vector__XXX
 SG_ ErrorCodeObjToSize1 : 0|1@1+ (1,0) [0|1] "" Vector__XXX
 SG_ ErrorCodeObjToSize2 : 0|1@1+ (1,0) [0|1] "" Vector__XXX
 SG_ ErrorCodeObjToSize3 : 0|1@1+ (1,0) [0|1] "" Vector__XXX
 SG_ ErrorCodeObjToSize4 : 0|1@1+ (1,0) [0|1] "" Vector__XXX
 SG_ ObjectToChangeColourID : 0|16@1+ (1,0) [0|65535] "" Vector__XXX
 SG_ NewBackgroundColour : 0|8@1+ (1,0) [0|255] "" Vector__XXX
 SG_ ErrorCodeChangeColour1 : 0|1@1+ (1,0) [0|1] "" Vector__XXX
 SG_ ErrorCodeChangeColour2 : 0|1@1+ (1,0) [0|1] "" Vector__XXX
 SG_ ErrorCodeChangeColour3 : 0|1@1+ (1,0) [0|1] "" Vector__XXX
 SG_ ObjectToChangeNumValueID : 0|16@1+ (1,0) [0|65535] "" Vector__XXX
 SG_ ErrorCodeChangeNumValue1 : 0|1@1+ (1,0) [0|1] "" Vector__XXX
 SG_ ErrorCodeChangeNumValue2 : 0|1@1+ (1,0) [0|1] "" Vector__XXX
 SG_ ErrorCodeChangeNumValue3 : 0|1@1+ (1,0) [0|1] "" Vector__XXX
 SG_ ValueOfTheObject : 0|32@1+ (1,0) [0|2704] "" Vector__XXX
 SG_ ObjectToChangeEndPointID : 0|16@1+ (1,0) [0|65535] "" Vector__XXX
 SG_ ErrorCodeChangeEditPoint1 : 0|1@1+ (1,0) [0|1] "" Vector__XXX
 SG_ ErrorCodeChangeEditPoint2 : 0|1@1+ (1,0) [0|1] "" Vector__XXX
 SG_ ErrorCodeChangeEditPoint3 : 0|1@1+ (1,0) [0|1] "" Vector__XXX
 SG_ ObjectToChangeFontID : 0|16@1+ (1,0) [0|65535] "" Vector__XXX
 SG_ ErrorCodeChangeFont1 : 0|1@1+ (1,0) [0|1] "" Vector__XXX
 SG_ ErrorCodeChangeFont2 : 0|1@1+ (1,0) [0|1] "" Vector__XXX
 SG_ ErrorCodeChangeFont4 : 0|1@1+ (1,0) [0|1] "" Vector__XXX
 SG_ ErrorCodeChangeFont3 : 0|1@1+ (1,0) [0|1] "" Vector__XXX
 SG_ ErrorCodeChangeFont5 : 0|1@1+ (1,0) [0|1] "" Vector__XXX
 SG_ ErrorCodeChangeFont6 : 0|1@1+ (1,0) [0|1] "" Vector__XXX
 SG_ ObjectToChangeLineAttributeID : 0|16@1+ (1,0) [0|65535] "" Vector__XXX
 SG_ ErrorCodeChangeLineAttribute1 : 0|1@1+ (1,0) [0|1] "" Vector__XXX
 SG_ ErrorCodeChangeLineAttribute2 : 0|1@1+ (1,0) [0|1] "" Vector__XXX
 SG_ ErrorCodeChangeLineAttribute3 : 0|1@1+ (1,0) [0|1] "" Vector__XXX
 SG_ ErrorCodeChangeLineAttribute4 : 0|1@1+ (1,0) [0|1] "" Vector__XXX
 SG_ ObjectToChangeFillAttributesID : 0|16@1+ (1,0) [0|65535] "" Vector__XXX
 SG_ ErrorCodeChangeFillAttributes1 : 0|1@1+ (1,0) [0|1] "" Vector__XXX
 SG_ ErrorCodeChangeFillAttributes2 : 0|1@1+ (1,0) [0|1] "" Vector__XXX
 SG_ ErrorCodeChangeFillAttributes3 : 0|1@1+ (1,0) [0|1] "" Vector__XXX
 SG_ ErrorCodeChangeFillAttributes4 : 0|1@1+ (1,0) [0|1] "" Vector__XXX
 SG_ ErrorCodeChangeFillAttributes5 : 0|1@1+ (1,0) [0|1] "" Vector__XXX
 SG_ ActiveMaskObjectID : 0|16@1+ (1,0) [0|0] "" Vector__XXX
 SG_ ErrorCodeChangeActiveMask1 : 0|1@1+ (1,0) [0|1] "" Vector__XXX
 SG_ ErrorCodeChangeActiveMask2 : 0|1@1+ (1,0) [0|1] "" Vector__XXX
 SG_ ErrorCodeChangeActiveMask3 : 0|1@1+ (1,0) [0|1] "" Vector__XXX
 SG_ ErrorCodeChangeActiveMask4 : 0|1@1+ (1,0) [0|1] "" Vector__XXX
 SG_ ErrorCodeChangeActiveMask5 : 0|1@1+ (1,0) [0|1] "" Vector__XXX
 SG_ DataOrAlarmMaskObjectID : 0|16@1+ (1,0) [0|65535] "" Vector__XXX
 SG_ SoftKeyMaskObjectID : 0|16@1+ (1,0) [0|65535] "" Vector__XXX
 SG_ ErrorCodeChangeSoftKeyMask1 : 0|1@1+ (1,0) [0|1] "" Vector__XXX
 SG_ ErrorCodeChangeSoftKeyMask2 : 0|1@1+ (1,0) [0|1] "" Vector__XXX
 SG_ ErrorCodeChangeSoftKeyMask3 : 0|1@1+ (1,0) [0|1] "" Vector__XXX
 SG_ ErrorCodeChangeSoftKeyMask4 : 0|1@1+ (1,0) [0|1] "" Vector__XXX
 SG_ ErrorCodeChangeSoftKeyMask5 : 0|1@1+ (1,0) [0|1] "" Vector__XXX
 SG_ ObjectToChangeAttributeID : 0|16@1+ (1,0) [0|65535] "" Vector__XXX
 SG_ AttributeID_Change : 0|8@1+ (1,0) [0|65535] "" Vector__XXX
 SG_ ErrorCodeChangeAttribute1 : 0|1@1+ (1,0) [0|1] "" Vector__XXX
 SG_ ErrorCodeChangeAttribute2 : 0|1@1+ (1,0) [0|1] "" Vector__XXX
 SG_ ErrorCodeChangeAttribute3 : 0|1@1+ (1,0) [0|1] "" Vector__XXX
 SG_ ErrorCodeChangeAttribute4 : 0|1@1+ (1,0) [0|1] "" Vector__XXX
 SG_ AlarmMaskObjectID : 0|16@1+ (1,0) [0|65535] "" Vector__XXX
 SG_ NewPriority : 0|8@1+ (1,0) [0|255] "" Vector__XXX
 SG_ ErrorCodeChangePriority1 : 0|1@1+ (1,0) [0|1] "" Vector__XXX
 SG_ ErrorCodeChangePriority2 : 0|1@1+ (1,0) [0|1] "" Vector__XXX
 SG_ ErrorCodeChangePriority3 : 0|1@1+ (1,0) [0|1] "" Vector__XXX
 SG_ ListInputObjectID : 0|16@1+ (1,0) [0|65535] "" Vector__XXX
 SG_ ListIndex : 0|8@1+ (1,0) [0|255] "" Vector__XXX
 SG_ NewObjectID : 0|16@1+ (1,0) [0|65535] "" Vector__XXX
 SG_ ErrorCodeChangeListItem1 : 0|1@1+ (1,0) [0|1] "" Vector__XXX
 SG_ ErrorCodeChangeListItem2 : 0|1@1+ (1,0) [0|1] "" Vector__XXX
 SG_ ErrorCodeChangeListItem3 : 0|1@1+ (1,0) [0|1] "" Vector__XXX
 SG_ ErrorCodeChangeListItem4 : 0|1@1+ (1,0) [0|1] "" Vector__XXX
 SG_ ErrorCodeDeleteObjectPool1 : 0|1@1+ (1,0) [0|1] "" Vector__XXX
 SG_ ErrorCodeDeleteObjectPool2 : 0|1@1+ (1,0) [0|1] "" Vector__XXX
 SG_ ParentObjectID2 : 0|16@1+ (1,0) [0|65535] "" Vector__XXX
 SG_ ObjectToChangeStringValueID : 0|16@1+ (1,0) [0|65535] "" Vector__XXX
 SG_ ErrorCodeChangeStrObjectID : 0|1@1+ (1,0) [0|1] "" Vector__XXX
 SG_ ErrorCodeChangeStrTooLong : 0|1@1+ (1,0) [0|1] "" Vector__XXX
 SG_ ErrorCodeChangeStrError : 0|1@1+ (1,0) [0|1] "" Vector__XXX
 SG_ ParentObjectID1 : 0|16@1+ (1,0) [0|65535] "" Vector__XXX
 SG_ ObjectToMoveID_Position : 0|16@1+ (1,0) [0|65535] "" Vector__XXX
 SG_ ErrorCodeChangePosInvalidParent : 0|1@1+ (1,0) [0|1] "" Vector__XXX
 SG_ ErrorCodeChangePosInvalidObject : 0|1@1+ (1,0) [0|1] "" Vector__XXX
 SG_ ErrorCodeChangePosInvalidError : 0|1@1+ (1,0) [0|1] "" Vector__XXX
 SG_ ErrorCodeSetObjectLabel1 : 0|1@1+ (1,0) [0|1] "" Vector__XXX
 SG_ ErrorCodeSetObjectLabel2 : 0|1@1+ (1,0) [0|1] "" Vector__XXX
 SG_ ErrorCodeSetObjectLabel3 : 0|1@1+ (1,0) [0|1] "" Vector__XXX
 SG_ ErrorCodeSetObjectLabel4 : 0|1@1+ (1,0) [0|1] "" Vector__XXX
 SG_ ErrorCodeSetObjectLabel5 : 0|1@1+ (1,0) [0|1] "" Vector__XXX
 SG_ ErrorCodeSetObjectLabel6 : 0|1@1+ (1,0) [0|1] "" Vector__XXX
 SG_ PolygonObjectToChangeID : 0|16@1+ (1,0) [0|65535] "" Vector__XXX
 SG_ ErrorCodeChangePoygonPoint1 : 0|1@1+ (1,0) [0|1] "" Vector__XXX
 SG_ ErrorCodeChangePoygonPoint2 : 0|1@1+ (1,0) [0|1] "" Vector__XXX
 SG_ ErrorCodeChangePoygonPoint3 : 0|1@1+ (1,0) [0|1] "" Vector__XXX
 SG_ PolygonObjectToScaleID : 0|16@1+ (1,0) [0|65535] "" Vector__XXX
 SG_ NewWidthAttribute : 0|16@1+ (1,0) [0|65535] "" Vector__XXX
 SG_ NewHeigthAttribute : 0|16@1+ (1,0) [0|0] "" Vector__XXX
 SG_ ErrorCodeChangePolygonScale1 : 0|1@1+ (1,0) [0|1] "" Vector__XXX
 SG_ ErrorCodeChangePolygonScale5 : 0|1@1+ (1,0) [0|1] "" Vector__XXX
 SG_ GraphicsContextObjectID : 0|16@1+ (1,0) [0|65535] "" Vector__XXX
 SG_ SubCommandID : 0|8@1+ (1,0) [0|0] "" Vector__XXX
 SG_ ErrorCodeGraphicsContextCmd1 : 0|1@1+ (1,0) [0|1] "" Vector__XXX
 SG_ ErrorCodeGraphicsContextCmd2 : 0|1@1+ (1,0) [0|1] "" Vector__XXX
 SG_ ErrorCodeGraphicsContextCmd3 : 0|1@1+ (1,0) [0|1] "" Vector__XXX
 SG_ ErrorCodeGraphicsContextCmd4 : 0|1@1+ (1,0) [0|1] "" Vector__XXX
 SG_ ErrorCodeGraphicsContextCmd5 : 0|1@1+ (1,0) [0|1] "" Vector__XXX
 SG_ ObjectToGetAttributeID_Resp : 0|16@1+ (1,0) [0|65535] "" Vector__XXX
 SG_ AttributeID : 0|8@1+ (1,0) [0|0] "" Vector__XXX
 SG_ ColourMapObjectID : 0|16@1+ (1,0) [0|65535] "" Vector__XXX
 SG_ ErrorCodeSelectColourMap2 : 0|1@1+ (1,0) [0|1] "" Vector__XXX
 SG_ ErrorCodeSelectColourMap1 : 0|1@1+ (1,0) [0|1] "" Vector__XXX
 SG_ ErrorCodeLockUnlockMask9 : 0|1@1+ (1,0) [0|1] "" Vector__XXX
 SG_ ErrorCodeLockUnlockMask8 : 0|1@1+ (1,0) [0|1] "" Vector__XXX
 SG_ ErrorCodeLockUnlockMask7 : 0|1@1+ (1,0) [0|1] "" Vector__XXX
 SG_ ErrorCodeLockUnlockMask6 : 0|1@1+ (1,0) [0|1] "" Vector__XXX
 SG_ ErrorCodeLockUnlockMask5 : 0|1@1+ (1,0) [0|1] "" Vector__XXX
 SG_ ErrorCodeLockUnlockMask4 : 0|1@1+ (1,0) [0|1] "" Vector__XXX
 SG_ ErrorCodeLockUnlockMask3 : 0|1@1+ (1,0) [0|1] "" Vector__XXX
 SG_ ErrorCodeLockUnlockMask2 : 0|1@1+ (1,0) [0|1] "" Vector__XXX
 SG_ ErrorCodeLockUnlockMask1 : 0|1@1+ (1,0) [0|1] "" Vector__XXX
 SG_ LockUnlockCommand : 0|8@1+ (1,0) [0|1] "" Vector__XXX
 SG_ MacroObjecID : 0|8@1+ (1,0) [0|255] "" Vector__XXX
 SG_ ErrorCodeExecuteMacro1 : 0|1@1+ (1,0) [0|1] "" Vector__XXX
 SG_ ErrorCodeExecuteMacro2 : 0|1@1+ (1,0) [0|1] "" Vector__XXX
 SG_ ErrorCodeExecuteMacro3 : 0|1@1+ (1,0) [0|1] "" Vector__XXX
 SG_ VersionNumberISO11783Part6 : 0|8@1+ (1,0) [0|255] "" Vector__XXX
 SG_ MemoryStatus : 0|8@1+ (1,0) [0|1] "" Vector__XXX
 SG_ FirstWideChar : 0|16@1+ (1,0) [0|65535] "" Vector__XXX
 SG_ LastWideChar : 0|16@1+ (1,0) [0|65535] "" Vector__XXX
 SG_ ErrorCodeGetSupportedWideChars2 : 0|1@1+ (1,0) [0|1] "" Vector__XXX
 SG_ ErrorCodeGetSupportedWideChars1 : 0|1@1+ (1,0) [0|1] "" Vector__XXX
 SG_ CodePlane : 0|8@1+ (1,0) [0|16] "" Vector__XXX
 SG_ NumberOfRanges : 0|8@1+ (1,0) [0|255] "" Vector__XXX
 SG_ NavigationSoftKeys : 0|8@1+ (1,0) [0|254] "" Vector__XXX
 SG_ XDotsForSoftKeyDescriptor : 0|8@1+ (1,0) [0|255] "" Vector__XXX
 SG_ YDotsForSoftKeyDescriptor : 0|8@1+ (1,0) [0|255] "" Vector__XXX
 SG_ NumberOfPossibleVirtualSoftKeys : 0|8@1+ (1,0) [0|255] "" Vector__XXX
 SG_ NumberOfPhysicalSoftKeys : 0|8@1+ (1,0) [0|255] "" Vector__XXX
 SG_ FontSize_8x8 : 0|1@1+ (1,0) [0|1] "" Vector__XXX
 SG_ FontSize_8x12 : 0|1@1+ (1,0) [0|1] "" Vector__XXX
 SG_ FontSize_12x16 : 0|1@1+ (1,0) [0|1] "" Vector__XXX
 SG_ FontSize_16x16 : 0|1@1+ (1,0) [0|1] "" Vector__XXX
 SG_ FontSize_16x24 : 0|1@1+ (1,0) [0|1] "" Vector__XXX
 SG_ FontSize_24x32 : 0|1@1+ (1,0) [0|1] "" Vector__XXX
 SG_ FontSize_32x32 : 0|1@1+ (1,0) [0|1] "" Vector__XXX
 SG_ FontSize_32x48 : 0|1@1+ (1,0) [0|1] "" Vector__XXX
 SG_ FontSize_48x64 : 0|1@1+ (1,0) [0|1] "" Vector__XXX
 SG_ FontSize_64x64 : 0|1@1+ (1,0) [0|1] "" Vector__XXX
 SG_ FontSize_64x96 : 0|1@1+ (1,0) [0|1] "" Vector__XXX
 SG_ FontSize_96x128 : 0|1@1+ (1,0) [0|1] "" Vector__XXX
 SG_ FontSize_128x128 : 0|1@1+ (1,0) [0|1] "" Vector__XXX
 SG_ FontSize_128x192 : 0|1@1+ (1,0) [0|1] "" Vector__XXX
 SG_ FontType_BoldText : 0|1@1+ (1,0) [0|1] "" Vector__XXX
 SG_ FontType_CrossedOutText : 0|1@1+ (1,0) [0|1] "" Vector__XXX
 SG_ FontType_UnderlinedText : 0|1@1+ (1,0) [0|1] "" Vector__XXX
 SG_ FontType_ItalicsText : 0|1@1+ (1,0) [0|1] "" Vector__XXX
 SG_ FontType_InvertedText : 0|1@1+ (1,0) [0|1] "" Vector__XXX
 SG_ FontType_FlashInverted : 0|1@1+ (1,0) [0|1] "" Vector__XXX
 SG_ FontType_FlashHidden : 0|1@1+ (1,0) [0|1] "" Vector__XXX
 SG_ FontType_ProportionalFont : 0|1@1+ (1,0) [0|1] "" Vector__XXX
 SG_ MaxLineWidth : 0|8@1+ (1,0) [0|255] "" Vector__XXX
 SG_ LineArts : 0|8@1+ (1,0) [0|1] "" Vector__XXX
 SG_ FillTypes : 0|8@1+ (1,0) [0|1] "" Vector__XXX
 SG_ ShapeFillTypes : 0|8@1+ (1,0) [0|3] "" Vector__XXX
 SG_ SupportedGrapicMode : 0|8@1+ (1,0) [0|2] "" Vector__XXX
 SG_ Hardware1 : 0|1@1+ (1,0) [0|1] "" Vector__XXX
 SG_ Hardware2 : 0|1@1+ (1,0) [0|1] "" Vector__XXX
 SG_ Hardware3 : 0|1@1+ (1,0) [0|1] "" Vector__XXX
 SG_ Hardware4 : 0|1@1+ (1,0) [0|1] "" Vector__XXX
 SG_ Hardware5 : 0|1@1+ (1,0) [0|1] "" Vector__XXX
 SG_ Hardware6 : 0|1@1+ (1,0) [0|1] "" Vector__XXX
 SG_ NrOfXPixelsInDataAreaMask : 0|16@1+ (1,0) [0|65535] "" Vector__XXX
 SG_ NrOfYPixelsInDataAreaMask : 0|16@1+ (1,0) [0|65535] "" Vector__XXX
 SG_ AcknowledgmentStoreVersion : 0|4@1+ (1,0) [0|8] "" Vector__XXX
 SG_ AcknowledgmentLoadVersion : 0|4@1+ (1,0) [0|8] "" Vector__XXX
 SG_ AcknowledgmentDeleteVersion : 0|4@1+ (1,0) [0|8] "" Vector__XXX
 SG_ NrOfVersionStrings : 0|8@1+ (1,0) [0|255] "" Vector__XXX
 SG_ VersionLables : 0|56@1+ (1,0) [0|0] "" Vector__XXX
 SG_ ParentObjectID : 0|16@1+ (1,0) [0|65535] "" Vector__XXX
 SG_ ObjectIDOfFaultyObject : 0|16@1+ (1,0) [0|65535] "" Vector__XXX
 SG_ ErrorCodeVtObjPoolError1 : 0|1@1+ (1,0) [0|1] "" Vector__XXX
 SG_ ErrorCodeVtObjPoolError2 : 0|1@1+ (1,0) [0|1] "" Vector__XXX
 SG_ ErrorCodeVtObjPoolError3 : 0|1@1+ (1,0) [0|1] "" Vector__XXX
 SG_ ErrorCodeVtObjPoolError4 : 0|1@1+ (1,0) [0|1] "" Vector__XXX
 SG_ SourceAdressOfActiveWSM : 0|8@1+ (1,0) [0|255] "" Vector__XXX
 SG_ VisibleDataOrAlarmMaskObjectID : 0|16@1+ (1,0) [0|65535] "" Vector__XXX
 SG_ VisibleSoftKeyMaskObjectID : 0|16@1+ (1,0) [0|65535] "" Vector__XXX
 SG_ VTBusyCode1 : 0|1@1+ (1,0) [0|1] "" Vector__XXX
 SG_ VTBusyCode2 : 0|1@1+ (1,0) [0|1] "" Vector__XXX
 SG_ VTBusyCode3 : 0|1@1+ (1,0) [0|1] "" Vector__XXX
 SG_ VTBusyCode4 : 0|1@1+ (1,0) [0|1] "" Vector__XXX
 SG_ VTBusyCode5 : 0|1@1+ (1,0) [0|1] "" Vector__XXX
 SG_ VTBusyCode8 : 0|1@1+ (1,0) [0|1] "" Vector__XXX
 SG_ VTFunctionCode : 0|8@1+ (1,0) [0|255] "" Vector__XXX
 SG_ VTFunctionVTtoECU : 0|8@1+ (1,0) [0|255] "" Vector__XXX
 SG_ KeyActivationCode : 0|8@1+ (1,0) [0|2] "" Vector__XXX
 SG_ KeyObjectID : 0|16@1+ (1,0) [0|65535] "" Vector__XXX
 SG_ KeyObjectParentID : 0|16@1+ (1,0) [0|65535] "" Vector__XXX
 SG_ SoftKeyCode : 0|8@1+ (1,0) [0|255] "" Vector__XXX
 SG_ ButtonActivationCode : 0|8@1+ (1,0) [0|2] "" Vector__XXX
 SG_ ButtonObjectID : 0|16@1+ (1,0) [0|65535] "" Vector__XXX
 SG_ ButtonObjectParentID : 0|16@1+ (1,0) [0|65535] "" Vector__XXX
 SG_ ButtonKeyCode : 0|8@1+ (1,0) [0|255] "" Vector__XXX
 SG_ XPosition : 0|16@1+ (1,0) [0|65535] "" Vector__XXX
 SG_ YPosition : 0|16@1+ (1,0) [0|65535] "" Vector__XXX
 SG_ TouchState : 0|8@1+ (1,0) [0|255] "" Vector__XXX
 SG_ VTSelectInputObjectID : 0|16@1+ (1,0) [0|65535] "" Vector__XXX
 SG_ VTSelectInputObjectStatus : 0|8@1+ (1,0) [0|1] "" Vector__XXX
 SG_ VTSelectInputObjectIsEdited : 0|1@1+ (1,0) [0|1] "" Vector__XXX
 SG_ VTEscObjectID : 0|16@1+ (1,0) [0|65535] "" Vector__XXX
 SG_ ErrorCodeVTEsc1 : 0|1@1+ (1,0) [0|1] "" Vector__XXX
 SG_ ErrorCodeVTEsc2 : 0|1@1+ (1,0) [0|1] "" Vector__XXX
 SG_ VTChangeNumericValueObjectID : 0|16@1+ (1,0) [0|65535] "" Vector__XXX
 SG_ VTChangeNumericValueValue : 0|32@1+ (1,0) [0|4294967295] "" Vector__XXX
 SG_ VTChangeActiveMaskObjectID : 0|16@1+ (1,0) [0|65535] "" Vector__XXX
 SG_ ErrorCodeMissingObjects : 0|1@1+ (1,0) [0|1] "" Vector__XXX
 SG_ ErrorCodeMaskOrChildObjectError : 0|1@1+ (1,0) [0|1] "" Vector__XXX
 SG_ ErrorCodeAnyOtherError : 0|1@1+ (1,0) [0|1] "" Vector__XXX
 SG_ ErrorCodePoolDeleted : 0|1@1+ (1,0) [0|1] "" Vector__XXX
 SG_ VTChangeActiveMaskErrorID : 0|16@1+ (1,0) [0|65535] "" Vector__XXX
 SG_ VTChangeActiveMaskParentID : 0|16@1+ (1,0) [0|65535] "" Vector__XXX
 SG_ VTChangeSoftKeyMaskParentID : 0|16@1+ (1,0) [0|65535] "" Vector__XXX
 SG_ VTChangeSoftKeyMaskObjectID : 0|16@1+ (1,0) [0|65535] "" Vector__XXX
 SG_ ErrorCodeVTChangeSoftKeyMask1 : 0|1@1+ (1,0) [0|1] "" Vector__XXX
 SG_ ErrorCodeVTChangeSoftKeyMask2 : 0|1@1+ (1,0) [0|1] "" Vector__XXX
 SG_ ErrorCodeVTChangeSoftKeyMask3 : 0|1@1+ (1,0) [0|1] "" Vector__XXX
 SG_ ErrorCodeVTChangeSoftKeyMask4 : 0|1@1+ (1,0) [0|1] "" Vector__XXX
 SG_ ErrorCodeVTChangeSoftKeyMask5 : 0|1@1+ (1,0) [0|1] "" Vector__XXX
 SG_ ObjectToChangeStringID : 0|16@1+ (1,0) [0|65535] "" Vector__XXX
 SG_ EnteredStringValue : 0|8@1+ (1,0) [0|255] "" Vector__XXX
 SG_ DisplayActivationStatus1 : 0|1@1+ (1,0) [0|1] "" Vector__XXX
 SG_ VisibleDataAlarmMaskID : 0|16@1+ (1,0) [0|65535] "" Vector__XXX
 SG_ VisibleSoftKeyMaskID : 0|16@1+ (1,0) [0|65535] "" Vector__XXX
 SG_ ErrorCodeEndOfObjectPool1 : 0|1@1+ (1,0) [0|1] "" Vector__XXX
 SG_ ErrorCodeEndOfObjectPool2 : 0|1@1+ (1,0) [0|1] "" Vector__XXX
 SG_ ErrorCodeEndOfObjectPool3 : 0|1@1+ (1,0) [0|1] "" Vector__XXX
 SG_ ParentObjectIdOfFaultyObject : 0|16@1+ (1,0) [0|65535] "" Vector__XXX
 SG_ ObjectIdOfFaultyObject : 0|16@1+ (1,0) [0|65535] "" Vector__XXX
 SG_ ErrorCodeObjectPool1 : 0|1@1+ (1,0) [0|1] "" Vector__XXX
 SG_ ErrorCodeObjectPool2 : 0|1@1+ (1,0) [0|1] "" Vector__XXX
 SG_ ErrorCodeObjectPool3 : 0|1@1+ (1,0) [0|1] "" Vector__XXX
 SG_ ErrorCodeObjectPool4 : 0|1@1+ (1,0) [0|1] "" Vector__XXX
 SG_ IdentityNumber : 0|21@1+ (1,0) [0|2097150] "" Vector__XXX
 SG_ ManufacturerCode : 0|11@1+ (1,0) [0|2047] "" Vector__XXX
 SG_ ECUInstance : 0|3@1+ (1,0) [0|7] "" Vector__XXX
 SG_ FunctionInstance : 0|5@1+ (1,0) [0|31] "" Vector__XXX
 SG_ AuxiliaryInputObjectID : 0|16@1+ (1,0) [0|65535] "" Vector__XXX
 SG_ InputObjectId : 0|16@1+ (1,0) [0|255] "" Vector__XXX
 SG_ Value1 : 0|16@1+ (1,0) [0|65535] "" Vector__XXX
 SG_ Function : 0|8@1+ (1,0) [0|255] "" Vector__XXX
 SG_ DeviceClass : 0|7@1+ (1,0) [0|127] "" Vector__XXX
 SG_ IndustryGroup : 0|3@1+ (1,0) [0|7] "" Vector__XXX
 SG_ DeviceClassInstance : 0|4@1+ (1,0) [0|15] "" Vector__XXX
 SG_ SelfConfigurableAddress : 0|1@1+ (1,0) [0|1] "" Vector__XXX
 SG_ AuxiliaryFunctionType : 0|4@1+ (1,0) [0|15] "" Vector__XXX
 SG_ AuxiliaryFunctionObjectID : 0|16@1+ (1,0) [0|65535] "" Vector__XXX
 SG_ Value2 : 0|16@1+ (1,0) [0|65535] "" Vector__XXX
 SG_ AuxPreferredAssignmentRespError1 : 0|1@1+ (1,0) [0|1] "" Vector__XXX
 SG_ AuxPreferredAssignmentRespError2 : 0|1@1+ (1,0) [0|1] "" Vector__XXX
 SG_ AuxPreferredAssignmentRespError3 : 0|1@1+ (1,0) [0|1] "" Vector__XXX
 SG_ AuxPreferredAssignmentRespError4 : 0|1@1+ (1,0) [0|1] "" Vector__XXX
 SG_ InputStatusObjectId : 0|16@1+ (1,0) [0|255] "" Vector__XXX
 SG_ AuxInputEnable : 0|8@1+ (1,0) [0|1] "" Vector__XXX
 SG_ ObjectEscapeID : 0|16@1+ (1,0) [0|65535] "" Vector__XXX
 SG_ ErrorCodeEscapeObj1 : 0|1@1+ (1,0) [0|1] "" Vector__XXX
 SG_ ErrorCodeEscapeObj2 : 0|1@1+ (1,0) [0|1] "" Vector__XXX
 SG_ ObjectToHideShowID : 0|16@1+ (1,0) [0|65535] "" Vector__XXX
 SG_ ObjectShowStatus : 0|8@1+ (1,0) [0|1] "" Vector__XXX
 SG_ ErrorCodeHideShowObj1 : 0|1@1+ (1,0) [0|1] "" Vector__XXX
 SG_ ErrorCodeHideShowObj2 : 0|1@1+ (1,0) [0|1] "" Vector__XXX
 SG_ ErrorCodeHideShowObj3 : 0|1@1+ (1,0) [0|1] "" Vector__XXX
 SG_ ObjectToEnableDisableID : 0|16@1+ (1,0) [0|65535] "" Vector__XXX
 SG_ ObjectEnableStatus : 0|8@1+ (1,0) [0|1] "" Vector__XXX
 SG_ ErrorCodeEnableDisableObj1 : 0|1@1+ (1,0) [0|1] "" Vector__XXX
 SG_ ErrorCodeEnableDisableObj2 : 0|1@1+ (1,0) [0|1] "" Vector__XXX
 SG_ ErrorCodeEnableDisableObj3 : 0|1@1+ (1,0) [0|1] "" Vector__XXX
 SG_ ErrorCodeEnableDisableObj4 : 0|1@1+ (1,0) [0|1] "" Vector__XXX
 SG_ SelectInputObjectID : 0|16@1+ (1,0) [0|65535] "" Vector__XXX
 SG_ ObjectSelectStatus : 0|8@1+ (1,0) [0|2] "" Vector__XXX
 SG_ ErrorCodeSelectObject1 : 0|1@1+ (1,0) [0|1] "" Vector__XXX
 SG_ ErrorCodeSelectObject2 : 0|1@1+ (1,0) [0|1] "" Vector__XXX
 SG_ ErrorCodeSelectObject3 : 0|1@1+ (1,0) [0|1] "" Vector__XXX
 SG_ ErrorCodeSelectObject4 : 0|1@1+ (1,0) [0|1] "" Vector__XXX
 SG_ ErrorCodeSelectObject5 : 0|1@1+ (1,0) [0|1] "" Vector__XXX
 SG_ ErrorCodeControlAudioDevice1 : 0|1@1+ (1,0) [0|1] "" Vector__XXX
 SG_ ErrorCodeControlAudioDevice2 : 0|1@1+ (1,0) [0|1] "" Vector__XXX
 SG_ ErrorCodeAudioVolume1 : 0|1@1+ (1,0) [0|1] "" Vector__XXX
 SG_ ErrorCodeAudioVolume2 : 0|1@1+ (1,0) [0|1] "" Vector__XXX
 SG_ ParentObjectID : 0|16@1+ (1,0) [0|65535] "" Vector__XXX
 SG_ ObjectToMoveID : 0|16@1+ (1,0) [0|65535] "" Vector__XXX
 SG_ ErrorCodeChangeChildLocation1 : 0|1@1+ (1,0) [0|1] "" Vector__XXX
 SG_ ErrorCodeChangeChildLocation2 : 0|1@1+ (1,0) [0|1] "" Vector__XXX
 SG_ ErrorCodeChangeChildLocation5 : 0|1@1+ (1,0) [0|1] "" Vector__XXX
 SG_ ObjectToSizeID : 0|16@1+ (1,0) [0|65535] "" Vector__XXX
 SG_ ErrorCodeObjToSize1 : 0|1@1+ (1,0) [0|1] "" Vector__XXX
 SG_ ErrorCodeObjToSize2 : 0|1@1+ (1,0) [0|1] "" Vector__XXX
 SG_ ErrorCodeObjToSize3 : 0|1@1+ (1,0) [0|1] "" Vector__XXX
 SG_ ErrorCodeObjToSize4 : 0|1@1+ (1,0) [0|1] "" Vector__XXX
 SG_ ObjectToChangeColourID : 0|16@1+ (1,0) [0|65535] "" Vector__XXX
 SG_ NewBackgroundColour : 0|8@1+ (1,0) [0|255] "" Vector__XXX
 SG_ ErrorCodeChangeColour1 : 0|1@1+ (1,0) [0|1] "" Vector__XXX
 SG_ ErrorCodeChangeColour2 : 0|1@1+ (1,0) [0|1] "" Vector__XXX
 SG_ ErrorCodeChangeColour3 : 0|1@1+ (1,0) [0|1] "" Vector__XXX
 SG_ ObjectToChangeNumValueID : 0|16@1+ (1,0) [0|65535] "" Vector__XXX
 SG_ ErrorCodeChangeNumValue1 : 0|1@1+ (1,0) [0|1] "" Vector__XXX
 SG_ ErrorCodeChangeNumValue2 : 0|1@1+ (1,0) [0|1] "" Vector__XXX
 SG_ ErrorCodeChangeNumValue3 : 0|1@1+ (1,0) [0|1] "" Vector__XXX
 SG_ ValueOfTheObject : 0|32@1+ (1,0) [0|2704] "" Vector__XXX
 SG_ ObjectToChangeEndPointID : 0|16@1+ (1,0) [0|65535] "" Vector__XXX
 SG_ ErrorCodeChangeEditPoint1 : 0|1@1+ (1,0) [0|1] "" Vector__XXX
 SG_ ErrorCodeChangeEditPoint2 : 0|1@1+ (1,0) [0|1] "" Vector__XXX
 SG_ ErrorCodeChangeEditPoint3 : 0|1@1+ (1,0) [0|1] "" Vector__XXX
 SG_ ObjectToChangeFontID : 0|16@1+ (1,0) [0|65535] "" Vector__XXX
 SG_ ErrorCodeChangeFont1 : 0|1@1+ (1,0) [0|1] "" Vector__XXX
 SG_ ErrorCodeChangeFont2 : 0|1@1+ (1,0) [0|1] "" Vector__XXX
 SG_ ErrorCodeChangeFont4 : 0|1@1+ (1,0) [0|1] "" Vector__XXX
 SG_ ErrorCodeChangeFont3 : 0|1@1+ (1,0) [0|1] "" Vector__XXX
 SG_ ErrorCodeChangeFont5 : 0|1@1+ (1,0) [0|1] "" Vector__XXX
 SG_ ErrorCodeChangeFont6 : 0|1@1+ (1,0) [0|1] "" Vector__XXX
 SG_ ObjectToChangeLineAttributeID : 0|16@1+ (1,0) [0|65535] "" Vector__XXX
 SG_ ErrorCodeChangeLineAttribute1 : 0|1@1+ (1,0) [0|1] "" Vector__XXX
 SG_ ErrorCodeChangeLineAttribute2 : 0|1@1+ (1,0) [0|1] "" Vector__XXX
 SG_ ErrorCodeChangeLineAttribute3 : 0|1@1+ (1,0) [0|1] "" Vector__XXX
 SG_ ErrorCodeChangeLineAttribute4 : 0|1@1+ (1,0) [0|1] "" Vector__XXX
 SG_ ObjectToChangeFillAttributesID : 0|16@1+ (1,0) [0|65535] "" Vector__XXX
 SG_ ErrorCodeChangeFillAttributes1 : 0|1@1+ (1,0) [0|1] "" Vector__XXX
 SG_ ErrorCodeChangeFillAttributes2 : 0|1@1+ (1,0) [0|1] "" Vector__XXX
 SG_ ErrorCodeChangeFillAttributes3 : 0|1@1+ (1,0) [0|1] "" Vector__XXX
 SG_ ErrorCodeChangeFillAttributes4 : 0|1@1+ (1,0) [0|1] "" Vector__XXX
 SG_ ErrorCodeChangeFillAttributes5 : 0|1@1+ (1,0) [0|1] "" Vector__XXX
 SG_ ActiveMaskObjectID : 0|16@1+ (1,0) [0|0] "" Vector__XXX
 SG_ ErrorCodeChangeActiveMask1 : 0|1@1+ (1,0) [0|1] "" Vector__XXX
 SG_ ErrorCodeChangeActiveMask2 : 0|1@1+ (1,0) [0|1] "" Vector__XXX
 SG_ ErrorCodeChangeActiveMask3 : 0|1@1+ (1,0) [0|1] "" Vector__XXX
 SG_ ErrorCodeChangeActiveMask4 : 0|1@1+ (1,0) [0|1] "" Vector__XXX
 SG_ ErrorCodeChangeActiveMask5 : 0|1@1+ (1,0) [0|1] "" Vector__XXX
 SG_ DataOrAlarmMaskObjectID : 0|16@1+ (1,0) [0|65535] "" Vector__XXX
 SG_ SoftKeyMaskObjectID : 0|16@1+ (1,0) [0|65535] "" Vector__XXX
 SG_ ErrorCodeChangeSoftKeyMask1 : 0|1@1+ (1,0) [0|1] "" Vector__XXX
 SG_ ErrorCodeChangeSoftKeyMask2 : 0|1@1+ (1,0) [0|1] "" Vector__XXX
 SG_ ErrorCodeChangeSoftKeyMask3 : 0|1@1+ (1,0) [0|1] "" Vector__XXX
 SG_ ErrorCodeChangeSoftKeyMask4 : 0|1@1+ (1,0) [0|1] "" Vector__XXX
 SG_ ErrorCodeChangeSoftKeyMask5 : 0|1@1+ (1,0) [0|1] "" Vector__XXX
 SG_ ObjectToChangeAttributeID : 0|16@1+ (1,0) [0|65535] "" Vector__XXX
 SG_ AttributeID : 0|8@1+ (1,0) [0|65535] "" Vector__XXX
 SG_ ErrorCodeChangeAttribute1 : 0|1@1+ (1,0) [0|1] "" Vector__XXX
 SG_ ErrorCodeChangeAttribute2 : 0|1@1+ (1,0) [0|1] "" Vector__XXX
 SG_ ErrorCodeChangeAttribute3 : 0|1@1+ (1,0) [0|1] "" Vector__XXX
 SG_ ErrorCodeChangeAttribute4 : 0|1@1+ (1,0) [0|1] "" Vector__XXX
 SG_ AlarmMaskObjectID : 0|16@1+ (1,0) [0|65535] "" Vector__XXX
 SG_ NewPriority : 0|8@1+ (1,0) [0|255] "" Vector__XXX
 SG_ ErrorCodeChangePriority1 : 0|1@1+ (1,0) [0|1] "" Vector__XXX
 SG_ ErrorCodeChangePriority2 : 0|1@1+ (1,0) [0|1] "" Vector__XXX
 SG_ ErrorCodeChangePriority3 : 0|1@1+ (1,0) [0|1] "" Vector__XXX
 SG_ ListInputObjectID : 0|16@1+ (1,0) [0|65535] "" Vector__XXX
 SG_ ListIndex : 0|8@1+ (1,0) [0|255] "" Vector__XXX
 SG_ NewObjectID : 0|16@1+ (1,0) [0|65535] "" Vector__XXX
 SG_ ErrorCodeChangeListItem1 : 0|1@1+ (1,0) [0|1] "" Vector__XXX
 SG_ ErrorCodeChangeListItem2 : 0|1@1+ (1,0) [0|1] "" Vector__XXX
 SG_ ErrorCodeChangeListItem3 : 0|1@1+ (1,0) [0|1] "" Vector__XXX
 SG_ ErrorCodeChangeListItem4 : 0|1@1+ (1,0) [0|1] "" Vector__XXX
 SG_ ErrorCodeDeleteObjectPool1 : 0|1@1+ (1,0) [0|1] "" Vector__XXX
 SG_ ErrorCodeDeleteObjectPool2 : 0|1@1+ (1,0) [0|1] "" Vector__XXX
 SG_ ParentObjectID : 0|16@1+ (1,0) [0|65535] "" Vector__XXX
 SG_ ObjectToChangeStringValueID : 0|16@1+ (1,0) [0|65535] "" Vector__XXX
 SG_ ErrorCodeChangeStrObjectID : 0|1@1+ (1,0) [0|1] "" Vector__XXX
 SG_ ErrorCodeChangeStrTooLong : 0|1@1+ (1,0) [0|1] "" Vector__XXX
 SG_ ErrorCodeChangeStrError : 0|1@1+ (1,0) [0|1] "" Vector__XXX
 SG_ ParentObjectID : 0|16@1+ (1,0) [0|65535] "" Vector__XXX
 SG_ ObjectToMoveID : 0|16@1+ (1,0) [0|65535] "" Vector__XXX
 SG_ ErrorCodeChangePosInvalidParent : 0|1@1+ (1,0) [0|1] "" Vector__XXX
 SG_ ErrorCodeChangePosInvalidObject : 0|1@1+ (1,0) [0|1] "" Vector__XXX
 SG_ ErrorCodeChangePosInvalidError : 0|1@1+ (1,0) [0|1] "" Vector__XXX
 SG_ ErrorCodeSetObjectLabel1 : 0|1@1+ (1,0) [0|1] "" Vector__XXX
 SG_ ErrorCodeSetObjectLabel2 : 0|1@1+ (1,0) [0|1] "" Vector__XXX
 SG_ ErrorCodeSetObjectLabel3 : 0|1@1+ (1,0) [0|1] "" Vector__XXX
 SG_ ErrorCodeSetObjectLabel4 : 0|1@1+ (1,0) [0|1] "" Vector__XXX
 SG_ ErrorCodeSetObjectLabel5 : 0|1@1+ (1,0) [0|1] "" Vector__XXX
 SG_ ErrorCodeSetObjectLabel6 : 0|1@1+ (1,0) [0|1] "" Vector__XXX
 SG_ PolygonObjectToChangeID : 0|16@1+ (1,0) [0|65535] "" Vector__XXX
 SG_ ErrorCodeChangePoygonPoint1 : 0|1@1+ (1,0) [0|1] "" Vector__XXX
 SG_ ErrorCodeChangePoygonPoint2 : 0|1@1+ (1,0) [0|1] "" Vector__XXX
 SG_ ErrorCodeChangePoygonPoint3 : 0|1@1+ (1,0) [0|1] "" Vector__XXX
 SG_ PolygonObjectToScaleID : 0|16@1+ (1,0) [0|65535] "" Vector__XXX
 SG_ NewWidthAttribute : 0|16@1+ (1,0) [0|65535] "" Vector__XXX
 SG_ NewHeigthAttribute : 0|16@1+ (1,0) [0|0] "" Vector__XXX
 SG_ ErrorCodeChangePolygonScale1 : 0|1@1+ (1,0) [0|1] "" Vector__XXX
 SG_ ErrorCodeChangePolygonScale5 : 0|1@1+ (1,0) [0|1] "" Vector__XXX
 SG_ GraphicsContextObjectID : 0|16@1+ (1,0) [0|65535] "" Vector__XXX
 SG_ SubCommandID : 0|8@1+ (1,0) [0|0] "" Vector__XXX
 SG_ ErrorCodeGraphicsContextCmd1 : 0|1@1+ (1,0) [0|1] "" Vector__XXX
 SG_ ErrorCodeGraphicsContextCmd2 : 0|1@1+ (1,0) [0|1] "" Vector__XXX
 SG_ ErrorCodeGraphicsContextCmd3 : 0|1@1+ (1,0) [0|1] "" Vector__XXX
 SG_ ErrorCodeGraphicsContextCmd4 : 0|1@1+ (1,0) [0|1] "" Vector__XXX
 SG_ ErrorCodeGraphicsContextCmd5 : 0|1@1+ (1,0) [0|1] "" Vector__XXX
 SG_ ObjectToGetAttributeID_Resp : 0|16@1+ (1,0) [0|65535] "" Vector__XXX
 SG_ AttributeID : 0|8@1+ (1,0) [0|0] "" Vector__XXX
 SG_ ColourMapObjectID : 0|16@1+ (1,0) [0|65535] "" Vector__XXX
 SG_ ErrorCodeSelectColourMap2 : 0|1@1+ (1,0) [0|1] "" Vector__XXX
 SG_ ErrorCodeSelectColourMap1 : 0|1@1+ (1,0) [0|1] "" Vector__XXX
 SG_ ErrorCodeLockUnlockMask9 : 0|1@1+ (1,0) [0|1] "" Vector__XXX
 SG_ ErrorCodeLockUnlockMask8 : 0|1@1+ (1,0) [0|1] "" Vector__XXX
 SG_ ErrorCodeLockUnlockMask7 : 0|1@1+ (1,0) [0|1] "" Vector__XXX
 SG_ ErrorCodeLockUnlockMask6 : 0|1@1+ (1,0) [0|1] "" Vector__XXX
 SG_ ErrorCodeLockUnlockMask5 : 0|1@1+ (1,0) [0|1] "" Vector__XXX
 SG_ ErrorCodeLockUnlockMask4 : 0|1@1+ (1,0) [0|1] "" Vector__XXX
 SG_ ErrorCodeLockUnlockMask3 : 0|1@1+ (1,0) [0|1] "" Vector__XXX
 SG_ ErrorCodeLockUnlockMask2 : 0|1@1+ (1,0) [0|1] "" Vector__XXX
 SG_ ErrorCodeLockUnlockMask1 : 0|1@1+ (1,0) [0|1] "" Vector__XXX
 SG_ LockUnlockCommand : 0|8@1+ (1,0) [0|1] "" Vector__XXX
 SG_ MacroObjecID : 0|8@1+ (1,0) [0|255] "" Vector__XXX
 SG_ ErrorCodeExecuteMacro1 : 0|1@1+ (1,0) [0|1] "" Vector__XXX
 SG_ ErrorCodeExecuteMacro2 : 0|1@1+ (1,0) [0|1] "" Vector__XXX
 SG_ ErrorCodeExecuteMacro3 : 0|1@1+ (1,0) [0|1] "" Vector__XXX
 SG_ VersionNumberISO11783Part6 : 0|8@1+ (1,0) [0|255] "" Vector__XXX
 SG_ MemoryStatus : 0|8@1+ (1,0) [0|1] "" Vector__XXX
 SG_ FirstWideChar : 0|16@1+ (1,0) [0|65535] "" Vector__XXX
 SG_ LastWideChar : 0|16@1+ (1,0) [0|65535] "" Vector__XXX
 SG_ ErrorCodeGetSupportedWideChars2 : 0|1@1+ (1,0) [0|1] "" Vector__XXX
 SG_ ErrorCodeGetSupportedWideChars1 : 0|1@1+ (1,0) [0|1] "" Vector__XXX
 SG_ CodePlane : 0|8@1+ (1,0) [0|16] "" Vector__XXX
 SG_ NumberOfRanges : 0|8@1+ (1,0) [0|255] "" Vector__XXX
 SG_ NavigationSoftKeys : 0|8@1+ (1,0) [0|254] "" Vector__XXX
 SG_ XDotsForSoftKeyDescriptor : 0|8@1+ (1,0) [0|255] "" Vector__XXX
 SG_ YDotsForSoftKeyDescriptor : 0|8@1+ (1,0) [0|255] "" Vector__XXX
 SG_ NumberOfPossibleVirtualSoftKeys : 0|8@1+ (1,0) [0|255] "" Vector__XXX
 SG_ NumberOfPhysicalSoftKeys : 0|8@1+ (1,0) [0|255] "" Vector__XXX
 SG_ FontSize_8x8 : 0|1@1+ (1,0) [0|1] "" Vector__XXX
 SG_ FontSize_8x12 : 0|1@1+ (1,0) [0|1] "" Vector__XXX
 SG_ FontSize_12x16 : 0|1@1+ (1,0) [0|1] "" Vector__XXX
 SG_ FontSize_16x16 : 0|1@1+ (1,0) [0|1] "" Vector__XXX
 SG_ FontSize_16x24 : 0|1@1+ (1,0) [0|1] "" Vector__XXX
 SG_ FontSize_24x32 : 0|1@1+ (1,0) [0|1] "" Vector__XXX
 SG_ FontSize_32x32 : 0|1@1+ (1,0) [0|1] "" Vector__XXX
 SG_ FontSize_32x48 : 0|1@1+ (1,0) [0|1] "" Vector__XXX
 SG_ FontSize_48x64 : 0|1@1+ (1,0) [0|1] "" Vector__XXX
 SG_ FontSize_64x64 : 0|1@1+ (1,0) [0|1] "" Vector__XXX
 SG_ FontSize_64x96 : 0|1@1+ (1,0) [0|1] "" Vector__XXX
 SG_ FontSize_96x128 : 0|1@1+ (1,0) [0|1] "" Vector__XXX
 SG_ FontSize_128x128 : 0|1@1+ (1,0) [0|1] "" Vector__XXX
 SG_ FontSize_128x192 : 0|1@1+ (1,0) [0|1] "" Vector__XXX
 SG_ FontType_BoldText : 0|1@1+ (1,0) [0|1] "" Vector__XXX
 SG_ FontType_CrossedOutText : 0|1@1+ (1,0) [0|1] "" Vector__XXX
 SG_ FontType_UnderlinedText : 0|1@1+ (1,0) [0|1] "" Vector__XXX
 SG_ FontType_ItalicsText : 0|1@1+ (1,0) [0|1] "" Vector__XXX
 SG_ FontType_InvertedText : 0|1@1+ (1,0) [0|1] "" Vector__XXX
 SG_ FontType_FlashInverted : 0|1@1+ (1,0) [0|1] "" Vector__XXX
 SG_ FontType_FlashHidden : 0|1@1+ (1,0) [0|1] "" Vector__XXX
 SG_ FontType_ProportionalFont : 0|1@1+ (1,0) [0|1] "" Vector__XXX
 SG_ MaxLineWidth : 0|8@1+ (1,0) [0|255] "" Vector__XXX
 SG_ LineArts : 0|8@1+ (1,0) [0|1] "" Vector__XXX
 SG_ FillTypes : 0|8@1+ (1,0) [0|1] "" Vector__XXX
 SG_ ShapeFillTypes : 0|8@1+ (1,0) [0|3] "" Vector__XXX
 SG_ SupportedGrapicMode : 0|8@1+ (1,0) [0|2] "" Vector__XXX
 SG_ Hardware1 : 0|1@1+ (1,0) [0|1] "" Vector__XXX
 SG_ Hardware2 : 0|1@1+ (1,0) [0|1] "" Vector__XXX
 SG_ Hardware3 : 0|1@1+ (1,0) [0|1] "" Vector__XXX
 SG_ Hardware4 : 0|1@1+ (1,0) [0|1] "" Vector__XXX
 SG_ Hardware5 : 0|1@1+ (1,0) [0|1] "" Vector__XXX
 SG_ Hardware6 : 0|1@1+ (1,0) [0|1] "" Vector__XXX
 SG_ NrOfXPixelsInDataAreaMask : 0|16@1+ (1,0) [0|65535] "" Vector__XXX
 SG_ NrOfYPixelsInDataAreaMask : 0|16@1+ (1,0) [0|65535] "" Vector__XXX
 SG_ AcknowledgmentStoreVersion : 0|4@1+ (1,0) [0|8] "" Vector__XXX
 SG_ AcknowledgmentLoadVersion : 0|4@1+ (1,0) [0|8] "" Vector__XXX
 SG_ AcknowledgmentDeleteVersion : 0|4@1+ (1,0) [0|8] "" Vector__XXX
 SG_ NrOfVersionStrings : 0|8@1+ (1,0) [0|255] "" Vector__XXX
 SG_ VersionLables : 0|56@1+ (1,0) [0|0] "" Vector__XXX
 SG_ ParentObjectID : 0|16@1+ (1,0) [0|65535] "" Vector__XXX
 SG_ ObjectIDOfFaultyObject : 0|16@1+ (1,0) [0|65535] "" Vector__XXX
 SG_ ErrorCodeVtObjPoolError1 : 0|1@1+ (1,0) [0|1] "" Vector__XXX
 SG_ ErrorCodeVtObjPoolError2 : 0|1@1+ (1,0) [0|1] "" Vector__XXX
 SG_ ErrorCodeVtObjPoolError3 : 0|1@1+ (1,0) [0|1] "" Vector__XXX
 SG_ ErrorCodeVtObjPoolError4 : 0|1@1+ (1,0) [0|1] "" Vector__XXX
 SG_ SourceAdressOfActiveWSM : 0|8@1+ (1,0) [0|255] "" Vector__XXX
 SG_ VisibleDataOrAlarmMaskObjectID : 0|16@1+ (1,0) [0|65535] "" Vector__XXX
 SG_ VisibleSoftKeyMaskObjectID : 0|16@1+ (1,0) [0|65535] "" Vector__XXX
 SG_ VTBusyCode1 : 0|1@1+ (1,0) [0|1] "" Vector__XXX
 SG_ VTBusyCode2 : 0|1@1+ (1,0) [0|1] "" Vector__XXX
 SG_ VTBusyCode3 : 0|1@1+ (1,0) [0|1] "" Vector__XXX
 SG_ VTBusyCode4 : 0|1@1+ (1,0) [0|1] "" Vector__XXX
 SG_ VTBusyCode5 : 0|1@1+ (1,0) [0|1] "" Vector__XXX
 SG_ VTBusyCode8 : 0|1@1+ (1,0) [0|1] "" Vector__XXX
 SG_ VTFunctionCode : 0|8@1+ (1,0) [0|255] "" Vector__XXX
 SG_ VTFunctionVTtoECU : 0|8@1+ (1,0) [0|255] "" Vector__XXX
 SG_ KeyActivationCode : 0|8@1+ (1,0) [0|2] "" Vector__XXX
 SG_ KeyObjectID : 0|16@1+ (1,0) [0|65535] "" Vector__XXX
 SG_ KeyObjectParentID : 0|16@1+ (1,0) [0|65535] "" Vector__XXX
 SG_ SoftKeyCode : 0|8@1+ (1,0) [0|255] "" Vector__XXX
 SG_ ButtonActivationCode : 0|8@1+ (1,0) [0|2] "" Vector__XXX
 SG_ ButtonObjectID : 0|16@1+ (1,0) [0|65535] "" Vector__XXX
 SG_ ButtonObjectParentID : 0|16@1+ (1,0) [0|65535] "" Vector__XXX
 SG_ ButtonKeyCode : 0|8@1+ (1,0) [0|255] "" Vector__XXX
 SG_ XPosition : 0|16@1+ (1,0) [0|65535] "" Vector__XXX
 SG_ YPosition : 0|16@1+ (1,0) [0|65535] "" Vector__XXX
 SG_ TouchState : 0|8@1+ (1,0) [0|255] "" Vector__XXX
 SG_ VTSelectInputObjectID : 0|16@1+ (1,0) [0|65535] "" Vector__XXX
 SG_ VTSelectInputObjectStatus : 0|8@1+ (1,0) [0|1] "" Vector__XXX
 SG_ VTSelectInputObjectIsEdited : 0|1@1+ (1,0) [0|1] "" Vector__XXX
 SG_ VTEscObjectID : 0|16@1+ (1,0) [0|65535] "" Vector__XXX
 SG_ ErrorCodeVTEsc1 : 0|1@1+ (1,0) [0|1] "" Vector__XXX
 SG_ ErrorCodeVTEsc2 : 0|1@1+ (1,0) [0|1] "" Vector__XXX
 SG_ VTChangeNumericValueObjectID : 0|16@1+ (1,0) [0|65535] "" Vector__XXX
 SG_ VTChangeNumericValueValue : 0|32@1+ (1,0) [0|4294967295] "" Vector__XXX
 SG_ VTChangeActiveMaskObjectID : 0|16@1+ (1,0) [0|65535] "" Vector__XXX
 SG_ ErrorCodeMissingObjects : 0|1@1+ (1,0) [0|1] "" Vector__XXX
 SG_ ErrorCodeMaskOrChildObjectError : 0|1@1+ (1,0) [0|1] "" Vector__XXX
 SG_ ErrorCodeAnyOtherError : 0|1@1+ (1,0) [0|1] "" Vector__XXX
 SG_ ErrorCodePoolDeleted : 0|1@1+ (1,0) [0|1] "" Vector__XXX
 SG_ VTChangeActiveMaskErrorID : 0|16@1+ (1,0) [0|65535] "" Vector__XXX
 SG_ VTChangeActiveMaskParentID : 0|16@1+ (1,0) [0|65535] "" Vector__XXX
 SG_ VTChangeSoftKeyMaskParentID : 0|16@1+ (1,0) [0|65535] "" Vector__XXX
 SG_ VTChangeSoftKeyMaskObjectID : 0|16@1+ (1,0) [0|65535] "" Vector__XXX
 SG_ ErrorCodeVTChangeSoftKeyMask1 : 0|1@1+ (1,0) [0|1] "" Vector__XXX
 SG_ ErrorCodeVTChangeSoftKeyMask2 : 0|1@1+ (1,0) [0|1] "" Vector__XXX
 SG_ ErrorCodeVTChangeSoftKeyMask3 : 0|1@1+ (1,0) [0|1] "" Vector__XXX
 SG_ ErrorCodeVTChangeSoftKeyMask4 : 0|1@1+ (1,0) [0|1] "" Vector__XXX
 SG_ ErrorCodeVTChangeSoftKeyMask5 : 0|1@1+ (1,0) [0|1] "" Vector__XXX
 SG_ ObjectToChangeStringID : 0|16@1+ (1,0) [0|65535] "" Vector__XXX
 SG_ EnteredStringValue : 0|8@1+ (1,0) [0|255] "" Vector__XXX
 SG_ DisplayActivationStatus1 : 0|1@1+ (1,0) [0|1] "" Vector__XXX
 SG_ VisibleDataAlarmMaskID : 0|16@1+ (1,0) [0|65535] "" Vector__XXX
 SG_ VisibleSoftKeyMaskID : 0|16@1+ (1,0) [0|65535] "" Vector__XXX
 SG_ ErrorCodeEndOfObjectPool1 : 0|1@1+ (1,0) [0|1] "" Vector__XXX
 SG_ ErrorCodeEndOfObjectPool2 : 0|1@1+ (1,0) [0|1] "" Vector__XXX
 SG_ ErrorCodeEndOfObjectPool3 : 0|1@1+ (1,0) [0|1] "" Vector__XXX
 SG_ ParentObjectIdOfFaultyObject : 0|16@1+ (1,0) [0|65535] "" Vector__XXX
 SG_ ObjectIdOfFaultyObject : 0|16@1+ (1,0) [0|65535] "" Vector__XXX
 SG_ ErrorCodeObjectPool1 : 0|1@1+ (1,0) [0|1] "" Vector__XXX
 SG_ ErrorCodeObjectPool2 : 0|1@1+ (1,0) [0|1] "" Vector__XXX
 SG_ ErrorCodeObjectPool3 : 0|1@1+ (1,0) [0|1] "" Vector__XXX
 SG_ ErrorCodeObjectPool4 : 0|1@1+ (1,0) [0|1] "" Vector__XXX
 SG_ IdentityNumber : 0|21@1+ (1,0) [0|2097150] "" Vector__XXX
 SG_ ManufacturerCode : 0|11@1+ (1,0) [0|2047] "" Vector__XXX
 SG_ ECUInstance : 0|3@1+ (1,0) [0|7] "" Vector__XXX
 SG_ FunctionInstance : 0|5@1+ (1,0) [0|31] "" Vector__XXX
 SG_ AuxiliaryInputObjectID : 0|16@1+ (1,0) [0|65535] "" Vector__XXX
 SG_ InputObjectId : 0|16@1+ (1,0) [0|255] "" Vector__XXX
 SG_ Value1 : 0|16@1+ (1,0) [0|65535] "" Vector__XXX
 SG_ Function : 0|8@1+ (1,0) [0|255] "" Vector__XXX
 SG_ DeviceClass : 0|7@1+ (1,0) [0|127] "" Vector__XXX
 SG_ IndustryGroup : 0|3@1+ (1,0) [0|7] "" Vector__XXX
 SG_ DeviceClassInstance : 0|4@1+ (1,0) [0|15] "" Vector__XXX
 SG_ SelfConfigurableAddress : 0|1@1+ (1,0) [0|1] "" Vector__XXX
 SG_ AuxiliaryFunctionType : 0|4@1+ (1,0) [0|15] "" Vector__XXX
 SG_ AuxiliaryFunctionObjectID : 0|16@1+ (1,0) [0|65535] "" Vector__XXX
 SG_ Value2 : 0|16@1+ (1,0) [0|65535] "" Vector__XXX
 SG_ AuxPreferredAssignmentRespError1 : 0|1@1+ (1,0) [0|1] "" Vector__XXX
 SG_ AuxPreferredAssignmentRespError2 : 0|1@1+ (1,0) [0|1] "" Vector__XXX
 SG_ AuxPreferredAssignmentRespError3 : 0|1@1+ (1,0) [0|1] "" Vector__XXX
 SG_ AuxPreferredAssignmentRespError4 : 0|1@1+ (1,0) [0|1] "" Vector__XXX
 SG_ InputStatusObjectId : 0|16@1+ (1,0) [0|255] "" Vector__XXX
 SG_ AuxInputEnable : 0|8@1+ (1,0) [0|1] "" Vector__XXX
 SG_ ObjectEscapeID : 0|16@1+ (1,0) [0|65535] "" Vector__XXX
 SG_ ErrorCodeEscapeObj1 : 0|1@1+ (1,0) [0|1] "" Vector__XXX
 SG_ ErrorCodeEscapeObj2 : 0|1@1+ (1,0) [0|1] "" Vector__XXX
 SG_ ObjectToHideShowID : 0|16@1+ (1,0) [0|65535] "" Vector__XXX
 SG_ ObjectShowStatus : 0|8@1+ (1,0) [0|1] "" Vector__XXX
 SG_ ErrorCodeHideShowObj1 : 0|1@1+ (1,0) [0|1] "" Vector__XXX
 SG_ ErrorCodeHideShowObj2 : 0|1@1+ (1,0) [0|1] "" Vector__XXX
 SG_ ErrorCodeHideShowObj3 : 0|1@1+ (1,0) [0|1] "" Vector__XXX
 SG_ ObjectToEnableDisableID : 0|16@1+ (1,0) [0|65535] "" Vector__XXX
 SG_ ObjectEnableStatus : 0|8@1+ (1,0) [0|1] "" Vector__XXX
 SG_ ErrorCodeEnableDisableObj1 : 0|1@1+ (1,0) [0|1] "" Vector__XXX
 SG_ ErrorCodeEnableDisableObj2 : 0|1@1+ (1,0) [0|1] "" Vector__XXX
 SG_ ErrorCodeEnableDisableObj3 : 0|1@1+ (1,0) [0|1] "" Vector__XXX
 SG_ ErrorCodeEnableDisableObj4 : 0|1@1+ (1,0) [0|1] "" Vector__XXX
 SG_ SelectInputObjectID : 0|16@1+ (1,0) [0|65535] "" Vector__XXX
 SG_ ObjectSelectStatus : 0|8@1+ (1,0) [0|2] "" Vector__XXX
 SG_ ErrorCodeSelectObject1 : 0|1@1+ (1,0) [0|1] "" Vector__XXX
 SG_ ErrorCodeSelectObject2 : 0|1@1+ (1,0) [0|1] "" Vector__XXX
 SG_ ErrorCodeSelectObject3 : 0|1@1+ (1,0) [0|1] "" Vector__XXX
 SG_ ErrorCodeSelectObject4 : 0|1@1+ (1,0) [0|1] "" Vector__XXX
 SG_ ErrorCodeSelectObject5 : 0|1@1+ (1,0) [0|1] "" Vector__XXX
 SG_ ErrorCodeControlAudioDevice1 : 0|1@1+ (1,0) [0|1] "" Vector__XXX
 SG_ ErrorCodeControlAudioDevice2 : 0|1@1+ (1,0) [0|1] "" Vector__XXX
 SG_ ErrorCodeAudioVolume1 : 0|1@1+ (1,0) [0|1] "" Vector__XXX
 SG_ ErrorCodeAudioVolume2 : 0|1@1+ (1,0) [0|1] "" Vector__XXX
 SG_ ParentObjectID : 0|16@1+ (1,0) [0|65535] "" Vector__XXX
 SG_ ObjectToMoveID : 0|16@1+ (1,0) [0|65535] "" Vector__XXX
 SG_ ErrorCodeChangeChildLocation1 : 0|1@1+ (1,0) [0|1] "" Vector__XXX
 SG_ ErrorCodeChangeChildLocation2 : 0|1@1+ (1,0) [0|1] "" Vector__XXX
 SG_ ErrorCodeChangeChildLocation5 : 0|1@1+ (1,0) [0|1] "" Vector__XXX
 SG_ ObjectToSizeID : 0|16@1+ (1,0) [0|65535] "" Vector__XXX
 SG_ ErrorCodeObjToSize1 : 0|1@1+ (1,0) [0|1] "" Vector__XXX
 SG_ ErrorCodeObjToSize2 : 0|1@1+ (1,0) [0|1] "" Vector__XXX
 SG_ ErrorCodeObjToSize3 : 0|1@1+ (1,0) [0|1] "" Vector__XXX
 SG_ ErrorCodeObjToSize4 : 0|1@1+ (1,0) [0|1] "" Vector__XXX
 SG_ ObjectToChangeColourID : 0|16@1+ (1,0) [0|65535] "" Vector__XXX
 SG_ NewBackgroundColour : 0|8@1+ (1,0) [0|255] "" Vector__XXX
 SG_ ErrorCodeChangeColour1 : 0|1@1+ (1,0) [0|1] "" Vector__XXX
 SG_ ErrorCodeChangeColour2 : 0|1@1+ (1,0) [0|1] "" Vector__XXX
 SG_ ErrorCodeChangeColour3 : 0|1@1+ (1,0) [0|1] "" Vector__XXX
 SG_ ObjectToChangeNumValueID : 0|16@1+ (1,0) [0|65535] "" Vector__XXX
 SG_ ErrorCodeChangeNumValue1 : 0|1@1+ (1,0) [0|1] "" Vector__XXX
 SG_ ErrorCodeChangeNumValue2 : 0|1@1+ (1,0) [0|1] "" Vector__XXX
 SG_ ErrorCodeChangeNumValue3 : 0|1@1+ (1,0) [0|1] "" Vector__XXX
 SG_ ValueOfTheObject : 0|32@1+ (1,0) [0|2704] "" Vector__XXX
 SG_ ObjectToChangeEndPointID : 0|16@1+ (1,0) [0|65535] "" Vector__XXX
 SG_ ErrorCodeChangeEditPoint1 : 0|1@1+ (1,0) [0|1] "" Vector__XXX
 SG_ ErrorCodeChangeEditPoint2 : 0|1@1+ (1,0) [0|1] "" Vector__XXX
 SG_ ErrorCodeChangeEditPoint3 : 0|1@1+ (1,0) [0|1] "" Vector__XXX
 SG_ ObjectToChangeFontID : 0|16@1+ (1,0) [0|65535] "" Vector__XXX
 SG_ ErrorCodeChangeFont1 : 0|1@1+ (1,0) [0|1] "" Vector__XXX
 SG_ ErrorCodeChangeFont2 : 0|1@1+ (1,0) [0|1] "" Vector__XXX
 SG_ ErrorCodeChangeFont4 : 0|1@1+ (1,0) [0|1] "" Vector__XXX
 SG_ ErrorCodeChangeFont3 : 0|1@1+ (1,0) [0|1] "" Vector__XXX
 SG_ ErrorCodeChangeFont5 : 0|1@1+ (1,0) [0|1] "" Vector__XXX
 SG_ ErrorCodeChangeFont6 : 0|1@1+ (1,0) [0|1] "" Vector__XXX
 SG_ ObjectToChangeLineAttributeID : 0|16@1+ (1,0) [0|65535] "" Vector__XXX
 SG_ ErrorCodeChangeLineAttribute1 : 0|1@1+ (1,0) [0|1] "" Vector__XXX
 SG_ ErrorCodeChangeLineAttribute2 : 0|1@1+ (1,0) [0|1] "" Vector__XXX
 SG_ ErrorCodeChangeLineAttribute3 : 0|1@1+ (1,0) [0|1] "" Vector__XXX
 SG_ ErrorCodeChangeLineAttribute4 : 0|1@1+ (1,0) [0|1] "" Vector__XXX
 SG_ ObjectToChangeFillAttributesID : 0|16@1+ (1,0) [0|65535] "" Vector__XXX
 SG_ ErrorCodeChangeFillAttributes1 : 0|1@1+ (1,0) [0|1] "" Vector__XXX
 SG_ ErrorCodeChangeFillAttributes2 : 0|1@1+ (1,0) [0|1] "" Vector__XXX
 SG_ ErrorCodeChangeFillAttributes3 : 0|1@1+ (1,0) [0|1] "" Vector__XXX
 SG_ ErrorCodeChangeFillAttributes4 : 0|1@1+ (1,0) [0|1] "" Vector__XXX
 SG_ ErrorCodeChangeFillAttributes5 : 0|1@1+ (1,0) [0|1] "" Vector__XXX
 SG_ ActiveMaskObjectID : 0|16@1+ (1,0) [0|0] "" Vector__XXX
 SG_ ErrorCodeChangeActiveMask1 : 0|1@1+ (1,0) [0|1] "" Vector__XXX
 SG_ ErrorCodeChangeActiveMask2 : 0|1@1+ (1,0) [0|1] "" Vector__XXX
 SG_ ErrorCodeChangeActiveMask3 : 0|1@1+ (1,0) [0|1] "" Vector__XXX
 SG_ ErrorCodeChangeActiveMask4 : 0|1@1+ (1,0) [0|1] "" Vector__XXX
 SG_ ErrorCodeChangeActiveMask5 : 0|1@1+ (1,0) [0|1] "" Vector__XXX
 SG_ DataOrAlarmMaskObjectID : 0|16@1+ (1,0) [0|65535] "" Vector__XXX
 SG_ SoftKeyMaskObjectID : 0|16@1+ (1,0) [0|65535] "" Vector__XXX
 SG_ ErrorCodeChangeSoftKeyMask1 : 0|1@1+ (1,0) [0|1] "" Vector__XXX
 SG_ ErrorCodeChangeSoftKeyMask2 : 0|1@1+ (1,0) [0|1] "" Vector__XXX
 SG_ ErrorCodeChangeSoftKeyMask3 : 0|1@1+ (1,0) [0|1] "" Vector__XXX
 SG_ ErrorCodeChangeSoftKeyMask4 : 0|1@1+ (1,0) [0|1] "" Vector__XXX
 SG_ ErrorCodeChangeSoftKeyMask5 : 0|1@1+ (1,0) [0|1] "" Vector__XXX
 SG_ ObjectToChangeAttributeID : 0|16@1+ (1,0) [0|65535] "" Vector__XXX
 SG_ AttributeID : 0|8@1+ (1,0) [0|65535] "" Vector__XXX
 SG_ ErrorCodeChangeAttribute1 : 0|1@1+ (1,0) [0|1] "" Vector__XXX
 SG_ ErrorCodeChangeAttribute2 : 0|1@1+ (1,0) [0|1] "" Vector__XXX
 SG_ ErrorCodeChangeAttribute3 : 0|1@1+ (1,0) [0|1] "" Vector__XXX
 SG_ ErrorCodeChangeAttribute4 : 0|1@1+ (1,0) [0|1] "" Vector__XXX
 SG_ AlarmMaskObjectID : 0|16@1+ (1,0) [0|65535] "" Vector__XXX
 SG_ NewPriority : 0|8@1+ (1,0) [0|255] "" Vector__XXX
 SG_ ErrorCodeChangePriority1 : 0|1@1+ (1,0) [0|1] "" Vector__XXX
 SG_ ErrorCodeChangePriority2 : 0|1@1+ (1,0) [0|1] "" Vector__XXX
 SG_ ErrorCodeChangePriority3 : 0|1@1+ (1,0) [0|1] "" Vector__XXX
 SG_ ListInputObjectID : 0|16@1+ (1,0) [0|65535] "" Vector__XXX
 SG_ ListIndex : 0|8@1+ (1,0) [0|255] "" Vector__XXX
 SG_ NewObjectID : 0|16@1+ (1,0) [0|65535] "" Vector__XXX
 SG_ ErrorCodeChangeListItem1 : 0|1@1+ (1,0) [0|1] "" Vector__XXX
 SG_ ErrorCodeChangeListItem2 : 0|1@1+ (1,0) [0|1] "" Vector__XXX
 SG_ ErrorCodeChangeListItem3 : 0|1@1+ (1,0) [0|1] "" Vector__XXX
 SG_ ErrorCodeChangeListItem4 : 0|1@1+ (1,0) [0|1] "" Vector__XXX
 SG_ ErrorCodeDeleteObjectPool1 : 0|1@1+ (1,0) [0|1] "" Vector__XXX
 SG_ ErrorCodeDeleteObjectPool2 : 0|1@1+ (1,0) [0|1] "" Vector__XXX
 SG_ ParentObjectID : 0|16@1+ (1,0) [0|65535] "" Vector__XXX
 SG_ ObjectToChangeStringValueID : 0|16@1+ (1,0) [0|65535] "" Vector__XXX
 SG_ ErrorCodeChangeStrObjectID : 0|1@1+ (1,0) [0|1] "" Vector__XXX
 SG_ ErrorCodeChangeStrTooLong : 0|1@1+ (1,0) [0|1] "" Vector__XXX
 SG_ ErrorCodeChangeStrError : 0|1@1+ (1,0) [0|1] "" Vector__XXX
 SG_ ParentObjectID : 0|16@1+ (1,0) [0|65535] "" Vector__XXX
 SG_ ObjectToMoveID : 0|16@1+ (1,0) [0|65535] "" Vector__XXX
 SG_ ErrorCodeChangePosInvalidParent : 0|1@1+ (1,0) [0|1] "" Vector__XXX
 SG_ ErrorCodeChangePosInvalidObject : 0|1@1+ (1,0) [0|1] "" Vector__XXX
 SG_ ErrorCodeChangePosInvalidError : 0|1@1+ (1,0) [0|1] "" Vector__XXX
 SG_ ErrorCodeSetObjectLabel1 : 0|1@1+ (1,0) [0|1] "" Vector__XXX
 SG_ ErrorCodeSetObjectLabel2 : 0|1@1+ (1,0) [0|1] "" Vector__XXX
 SG_ ErrorCodeSetObjectLabel3 : 0|1@1+ (1,0) [0|1] "" Vector__XXX
 SG_ ErrorCodeSetObjectLabel4 : 0|1@1+ (1,0) [0|1] "" Vector__XXX
 SG_ ErrorCodeSetObjectLabel5 : 0|1@1+ (1,0) [0|1] "" Vector__XXX
 SG_ ErrorCodeSetObjectLabel6 : 0|1@1+ (1,0) [0|1] "" Vector__XXX
 SG_ PolygonObjectToChangeID : 0|16@1+ (1,0) [0|65535] "" Vector__XXX
 SG_ ErrorCodeChangePoygonPoint1 : 0|1@1+ (1,0) [0|1] "" Vector__XXX
 SG_ ErrorCodeChangePoygonPoint2 : 0|1@1+ (1,0) [0|1] "" Vector__XXX
 SG_ ErrorCodeChangePoygonPoint3 : 0|1@1+ (1,0) [0|1] "" Vector__XXX
 SG_ PolygonObjectToScaleID : 0|16@1+ (1,0) [0|65535] "" Vector__XXX
 SG_ NewWidthAttribute : 0|16@1+ (1,0) [0|65535] "" Vector__XXX
 SG_ NewHeigthAttribute : 0|16@1+ (1,0) [0|0] "" Vector__XXX
 SG_ ErrorCodeChangePolygonScale1 : 0|1@1+ (1,0) [0|1] "" Vector__XXX
 SG_ ErrorCodeChangePolygonScale5 : 0|1@1+ (1,0) [0|1] "" Vector__XXX
 SG_ GraphicsContextObjectID : 0|16@1+ (1,0) [0|65535] "" Vector__XXX
 SG_ SubCommandID : 0|8@1+ (1,0) [0|0] "" Vector__XXX
 SG_ ErrorCodeGraphicsContextCmd1 : 0|1@1+ (1,0) [0|1] "" Vector__XXX
 SG_ ErrorCodeGraphicsContextCmd2 : 0|1@1+ (1,0) [0|1] "" Vector__XXX
 SG_ ErrorCodeGraphicsContextCmd3 : 0|1@1+ (1,0) [0|1] "" Vector__XXX
 SG_ ErrorCodeGraphicsContextCmd4 : 0|1@1+ (1,0) [0|1] "" Vector__XXX
 SG_ ErrorCodeGraphicsContextCmd5 : 0|1@1+ (1,0) [0|1] "" Vector__XXX
 SG_ ObjectToGetAttributeID_Resp : 0|16@1+ (1,0) [0|65535] "" Vector__XXX
 SG_ AttributeID : 0|8@1+ (1,0) [0|0] "" Vector__XXX
 SG_ ColourMapObjectID : 0|16@1+ (1,0) [0|65535] "" Vector__XXX
 SG_ ErrorCodeSelectColourMap2 : 0|1@1+ (1,0) [0|1] "" Vector__XXX
 SG_ ErrorCodeSelectColourMap1 : 0|1@1+ (1,0) [0|1] "" Vector__XXX
 SG_ ErrorCodeLockUnlockMask9 : 0|1@1+ (1,0) [0|1] "" Vector__XXX
 SG_ ErrorCodeLockUnlockMask8 : 0|1@1+ (1,0) [0|1] "" Vector__XXX
 SG_ ErrorCodeLockUnlockMask7 : 0|1@1+ (1,0) [0|1] "" Vector__XXX
 SG_ ErrorCodeLockUnlockMask6 : 0|1@1+ (1,0) [0|1] "" Vector__XXX
 SG_ ErrorCodeLockUnlockMask5 : 0|1@1+ (1,0) [0|1] "" Vector__XXX
 SG_ ErrorCodeLockUnlockMask4 : 0|1@1+ (1,0) [0|1] "" Vector__XXX
 SG_ ErrorCodeLockUnlockMask3 : 0|1@1+ (1,0) [0|1] "" Vector__XXX
 SG_ ErrorCodeLockUnlockMask2 : 0|1@1+ (1,0) [0|1] "" Vector__XXX
 SG_ ErrorCodeLockUnlockMask1 : 0|1@1+ (1,0) [0|1] "" Vector__XXX
 SG_ LockUnlockCommand : 0|8@1+ (1,0) [0|1] "" Vector__XXX
 SG_ MacroObjecID : 0|8@1+ (1,0) [0|255] "" Vector__XXX
 SG_ ErrorCodeExecuteMacro1 : 0|1@1+ (1,0) [0|1] "" Vector__XXX
 SG_ ErrorCodeExecuteMacro2 : 0|1@1+ (1,0) [0|1] "" Vector__XXX
 SG_ ErrorCodeExecuteMacro3 : 0|1@1+ (1,0) [0|1] "" Vector__XXX
 SG_ VersionNumberISO11783Part6 : 0|8@1+ (1,0) [0|255] "" Vector__XXX
 SG_ MemoryStatus : 0|8@1+ (1,0) [0|1] "" Vector__XXX
 SG_ FirstWideChar : 0|16@1+ (1,0) [0|65535] "" Vector__XXX
 SG_ LastWideChar : 0|16@1+ (1,0) [0|65535] "" Vector__XXX
 SG_ ErrorCodeGetSupportedWideChars2 : 0|1@1+ (1,0) [0|1] "" Vector__XXX
 SG_ ErrorCodeGetSupportedWideChars1 : 0|1@1+ (1,0) [0|1] "" Vector__XXX
 SG_ CodePlane : 0|8@1+ (1,0) [0|16] "" Vector__XXX
 SG_ NumberOfRanges : 0|8@1+ (1,0) [0|255] "" Vector__XXX
 SG_ NavigationSoftKeys : 0|8@1+ (1,0) [0|254] "" Vector__XXX
 SG_ XDotsForSoftKeyDescriptor : 0|8@1+ (1,0) [0|255] "" Vector__XXX
 SG_ YDotsForSoftKeyDescriptor : 0|8@1+ (1,0) [0|255] "" Vector__XXX
 SG_ NumberOfPossibleVirtualSoftKeys : 0|8@1+ (1,0) [0|255] "" Vector__XXX
 SG_ NumberOfPhysicalSoftKeys : 0|8@1+ (1,0) [0|255] "" Vector__XXX
 SG_ FontSize_8x8 : 0|1@1+ (1,0) [0|1] "" Vector__XXX
 SG_ FontSize_8x12 : 0|1@1+ (1,0) [0|1] "" Vector__XXX
 SG_ FontSize_12x16 : 0|1@1+ (1,0) [0|1] "" Vector__XXX
 SG_ FontSize_16x16 : 0|1@1+ (1,0) [0|1] "" Vector__XXX
 SG_ FontSize_16x24 : 0|1@1+ (1,0) [0|1] "" Vector__XXX
 SG_ FontSize_24x32 : 0|1@1+ (1,0) [0|1] "" Vector__XXX
 SG_ FontSize_32x32 : 0|1@1+ (1,0) [0|1] "" Vector__XXX
 SG_ FontSize_32x48 : 0|1@1+ (1,0) [0|1] "" Vector__XXX
 SG_ FontSize_48x64 : 0|1@1+ (1,0) [0|1] "" Vector__XXX
 SG_ FontSize_64x64 : 0|1@1+ (1,0) [0|1] "" Vector__XXX
 SG_ FontSize_64x96 : 0|1@1+ (1,0) [0|1] "" Vector__XXX
 SG_ FontSize_96x128 : 0|1@1+ (1,0) [0|1] "" Vector__XXX
 SG_ FontSize_128x128 : 0|1@1+ (1,0) [0|1] "" Vector__XXX
 SG_ FontSize_128x192 : 0|1@1+ (1,0) [0|1] "" Vector__XXX
 SG_ FontType_BoldText : 0|1@1+ (1,0) [0|1] "" Vector__XXX
 SG_ FontType_CrossedOutText : 0|1@1+ (1,0) [0|1] "" Vector__XXX
 SG_ FontType_UnderlinedText : 0|1@1+ (1,0) [0|1] "" Vector__XXX
 SG_ FontType_ItalicsText : 0|1@1+ (1,0) [0|1] "" Vector__XXX
 SG_ FontType_InvertedText : 0|1@1+ (1,0) [0|1] "" Vector__XXX
 SG_ FontType_FlashInverted : 0|1@1+ (1,0) [0|1] "" Vector__XXX
 SG_ FontType_FlashHidden : 0|1@1+ (1,0) [0|1] "" Vector__XXX
 SG_ FontType_ProportionalFont : 0|1@1+ (1,0) [0|1] "" Vector__XXX
 SG_ MaxLineWidth : 0|8@1+ (1,0) [0|255] "" Vector__XXX
 SG_ LineArts : 0|8@1+ (1,0) [0|1] "" Vector__XXX
 SG_ FillTypes : 0|8@1+ (1,0) [0|1] "" Vector__XXX
 SG_ ShapeFillTypes : 0|8@1+ (1,0) [0|3] "" Vector__XXX
 SG_ SupportedGrapicMode : 0|8@1+ (1,0) [0|2] "" Vector__XXX
 SG_ Hardware1 : 0|1@1+ (1,0) [0|1] "" Vector__XXX
 SG_ Hardware2 : 0|1@1+ (1,0) [0|1] "" Vector__XXX
 SG_ Hardware3 : 0|1@1+ (1,0) [0|1] "" Vector__XXX
 SG_ Hardware4 : 0|1@1+ (1,0) [0|1] "" Vector__XXX
 SG_ Hardware5 : 0|1@1+ (1,0) [0|1] "" Vector__XXX
 SG_ Hardware6 : 0|1@1+ (1,0) [0|1] "" Vector__XXX
 SG_ NrOfXPixelsInDataAreaMask : 0|16@1+ (1,0) [0|65535] "" Vector__XXX
 SG_ NrOfYPixelsInDataAreaMask : 0|16@1+ (1,0) [0|65535] "" Vector__XXX
 SG_ AcknowledgmentStoreVersion : 0|4@1+ (1,0) [0|8] "" Vector__XXX
 SG_ AcknowledgmentLoadVersion : 0|4@1+ (1,0) [0|8] "" Vector__XXX
 SG_ AcknowledgmentDeleteVersion : 0|4@1+ (1,0) [0|8] "" Vector__XXX
 SG_ NrOfVersionStrings : 0|8@1+ (1,0) [0|255] "" Vector__XXX
 SG_ VersionLables : 0|56@1+ (1,0) [0|0] "" Vector__XXX
 SG_ ParentObjectID : 0|16@1+ (1,0) [0|65535] "" Vector__XXX
 SG_ ObjectIDOfFaultyObject : 0|16@1+ (1,0) [0|65535] "" Vector__XXX
 SG_ ErrorCodeVtObjPoolError1 : 0|1@1+ (1,0) [0|1] "" Vector__XXX
 SG_ ErrorCodeVtObjPoolError2 : 0|1@1+ (1,0) [0|1] "" Vector__XXX
 SG_ ErrorCodeVtObjPoolError3 : 0|1@1+ (1,0) [0|1] "" Vector__XXX
 SG_ ErrorCodeVtObjPoolError4 : 0|1@1+ (1,0) [0|1] "" Vector__XXX
 SG_ SourceAdressOfActiveWSM : 0|8@1+ (1,0) [0|255] "" Vector__XXX
 SG_ VisibleDataOrAlarmMaskObjectID : 0|16@1+ (1,0) [0|65535] "" Vector__XXX
 SG_ VisibleSoftKeyMaskObjectID : 0|16@1+ (1,0) [0|65535] "" Vector__XXX
 SG_ VTBusyCode1 : 0|1@1+ (1,0) [0|1] "" Vector__XXX
 SG_ VTBusyCode2 : 0|1@1+ (1,0) [0|1] "" Vector__XXX
 SG_ VTBusyCode3 : 0|1@1+ (1,0) [0|1] "" Vector__XXX
 SG_ VTBusyCode4 : 0|1@1+ (1,0) [0|1] "" Vector__XXX
 SG_ VTBusyCode5 : 0|1@1+ (1,0) [0|1] "" Vector__XXX
 SG_ VTBusyCode8 : 0|1@1+ (1,0) [0|1] "" Vector__XXX
 SG_ VTFunctionCode : 0|8@1+ (1,0) [0|255] "" Vector__XXX
 SG_ VTFunctionVTtoECU : 0|8@1+ (1,0) [0|255] "" Vector__XXX
 SG_ KeyActivationCode : 0|8@1+ (1,0) [0|2] "" Vector__XXX
 SG_ KeyObjectID : 0|16@1+ (1,0) [0|65535] "" Vector__XXX
 SG_ KeyObjectParentID : 0|16@1+ (1,0) [0|65535] "" Vector__XXX
 SG_ SoftKeyCode : 0|8@1+ (1,0) [0|255] "" Vector__XXX
 SG_ ButtonActivationCode : 0|8@1+ (1,0) [0|2] "" Vector__XXX
 SG_ ButtonObjectID : 0|16@1+ (1,0) [0|65535] "" Vector__XXX
 SG_ ButtonObjectParentID : 0|16@1+ (1,0) [0|65535] "" Vector__XXX
 SG_ ButtonKeyCode : 0|8@1+ (1,0) [0|255] "" Vector__XXX
 SG_ XPosition : 0|16@1+ (1,0) [0|65535] "" Vector__XXX
 SG_ YPosition : 0|16@1+ (1,0) [0|65535] "" Vector__XXX
 SG_ TouchState : 0|8@1+ (1,0) [0|255] "" Vector__XXX
 SG_ VTSelectInputObjectID : 0|16@1+ (1,0) [0|65535] "" Vector__XXX
 SG_ VTSelectInputObjectStatus : 0|8@1+ (1,0) [0|1] "" Vector__XXX
 SG_ VTSelectInputObjectIsEdited : 0|1@1+ (1,0) [0|1] "" Vector__XXX
 SG_ VTEscObjectID : 0|16@1+ (1,0) [0|65535] "" Vector__XXX
 SG_ ErrorCodeVTEsc1 : 0|1@1+ (1,0) [0|1] "" Vector__XXX
 SG_ ErrorCodeVTEsc2 : 0|1@1+ (1,0) [0|1] "" Vector__XXX
 SG_ VTChangeNumericValueObjectID : 0|16@1+ (1,0) [0|65535] "" Vector__XXX
 SG_ VTChangeNumericValueValue : 0|32@1+ (1,0) [0|4294967295] "" Vector__XXX
 SG_ VTChangeActiveMaskObjectID : 0|16@1+ (1,0) [0|65535] "" Vector__XXX
 SG_ ErrorCodeMissingObjects : 0|1@1+ (1,0) [0|1] "" Vector__XXX
 SG_ ErrorCodeMaskOrChildObjectError : 0|1@1+ (1,0) [0|1] "" Vector__XXX
 SG_ ErrorCodeAnyOtherError : 0|1@1+ (1,0) [0|1] "" Vector__XXX
 SG_ ErrorCodePoolDeleted : 0|1@1+ (1,0) [0|1] "" Vector__XXX
 SG_ VTChangeActiveMaskErrorID : 0|16@1+ (1,0) [0|65535] "" Vector__XXX
 SG_ VTChangeActiveMaskParentID : 0|16@1+ (1,0) [0|65535] "" Vector__XXX
 SG_ VTChangeSoftKeyMaskParentID : 0|16@1+ (1,0) [0|65535] "" Vector__XXX
 SG_ VTChangeSoftKeyMaskObjectID : 0|16@1+ (1,0) [0|65535] "" Vector__XXX
 SG_ ErrorCodeVTChangeSoftKeyMask1 : 0|1@1+ (1,0) [0|1] "" Vector__XXX
 SG_ ErrorCodeVTChangeSoftKeyMask2 : 0|1@1+ (1,0) [0|1] "" Vector__XXX
 SG_ ErrorCodeVTChangeSoftKeyMask3 : 0|1@1+ (1,0) [0|1] "" Vector__XXX
 SG_ ErrorCodeVTChangeSoftKeyMask4 : 0|1@1+ (1,0) [0|1] "" Vector__XXX
 SG_ ErrorCodeVTChangeSoftKeyMask5 : 0|1@1+ (1,0) [0|1] "" Vector__XXX
 SG_ ObjectToChangeStringID : 0|16@1+ (1,0) [0|65535] "" Vector__XXX
 SG_ EnteredStringValue : 0|8@1+ (1,0) [0|255] "" Vector__XXX
 SG_ DisplayActivationStatus1 : 0|1@1+ (1,0) [0|1] "" Vector__XXX
 SG_ VisibleDataAlarmMaskID : 0|16@1+ (1,0) [0|65535] "" Vector__XXX
 SG_ VisibleSoftKeyMaskID : 0|16@1+ (1,0) [0|65535] "" Vector__XXX
 SG_ ErrorCodeEndOfObjectPool1 : 0|1@1+ (1,0) [0|1] "" Vector__XXX
 SG_ ErrorCodeEndOfObjectPool2 : 0|1@1+ (1,0) [0|1] "" Vector__XXX
 SG_ ErrorCodeEndOfObjectPool3 : 0|1@1+ (1,0) [0|1] "" Vector__XXX
 SG_ ParentObjectIdOfFaultyObject : 0|16@1+ (1,0) [0|65535] "" Vector__XXX
 SG_ ObjectIdOfFaultyObject : 0|16@1+ (1,0) [0|65535] "" Vector__XXX
 SG_ ErrorCodeObjectPool1 : 0|1@1+ (1,0) [0|1] "" Vector__XXX
 SG_ ErrorCodeObjectPool2 : 0|1@1+ (1,0) [0|1] "" Vector__XXX
 SG_ ErrorCodeObjectPool3 : 0|1@1+ (1,0) [0|1] "" Vector__XXX
 SG_ ErrorCodeObjectPool4 : 0|1@1+ (1,0) [0|1] "" Vector__XXX
 SG_ IdentityNumber : 0|21@1+ (1,0) [0|2097150] "" Vector__XXX
 SG_ ManufacturerCode : 0|11@1+ (1,0) [0|2047] "" Vector__XXX
 SG_ ECUInstance : 0|3@1+ (1,0) [0|7] "" Vector__XXX
 SG_ FunctionInstance : 0|5@1+ (1,0) [0|31] "" Vector__XXX
 SG_ AuxiliaryInputObjectID : 0|16@1+ (1,0) [0|65535] "" Vector__XXX
 SG_ InputObjectId : 0|16@1+ (1,0) [0|255] "" Vector__XXX
 SG_ Value1 : 0|16@1+ (1,0) [0|65535] "" Vector__XXX
 SG_ Function : 0|8@1+ (1,0) [0|255] "" Vector__XXX
 SG_ DeviceClass : 0|7@1+ (1,0) [0|127] "" Vector__XXX
 SG_ IndustryGroup : 0|3@1+ (1,0) [0|7] "" Vector__XXX
 SG_ DeviceClassInstance : 0|4@1+ (1,0) [0|15] "" Vector__XXX
 SG_ SelfConfigurableAddress : 0|1@1+ (1,0) [0|1] "" Vector__XXX
 SG_ AuxiliaryFunctionType : 0|4@1+ (1,0) [0|15] "" Vector__XXX
 SG_ AuxiliaryFunctionObjectID : 0|16@1+ (1,0) [0|65535] "" Vector__XXX
 SG_ Value2 : 0|16@1+ (1,0) [0|65535] "" Vector__XXX
 SG_ AuxPreferredAssignmentRespError1 : 0|1@1+ (1,0) [0|1] "" Vector__XXX
 SG_ AuxPreferredAssignmentRespError2 : 0|1@1+ (1,0) [0|1] "" Vector__XXX
 SG_ AuxPreferredAssignmentRespError3 : 0|1@1+ (1,0) [0|1] "" Vector__XXX
 SG_ AuxPreferredAssignmentRespError4 : 0|1@1+ (1,0) [0|1] "" Vector__XXX
 SG_ InputStatusObjectId : 0|16@1+ (1,0) [0|255] "" Vector__XXX
 SG_ AuxInputEnable : 0|8@1+ (1,0) [0|1] "" Vector__XXX
 SG_ ObjectEscapeID : 0|16@1+ (1,0) [0|65535] "" Vector__XXX
 SG_ ErrorCodeEscapeObj1 : 0|1@1+ (1,0) [0|1] "" Vector__XXX
 SG_ ErrorCodeEscapeObj2 : 0|1@1+ (1,0) [0|1] "" Vector__XXX
 SG_ ObjectToHideShowID : 0|16@1+ (1,0) [0|65535] "" Vector__XXX
 SG_ ObjectShowStatus : 0|8@1+ (1,0) [0|1] "" Vector__XXX
 SG_ ErrorCodeHideShowObj1 : 0|1@1+ (1,0) [0|1] "" Vector__XXX
 SG_ ErrorCodeHideShowObj2 : 0|1@1+ (1,0) [0|1] "" Vector__XXX
 SG_ ErrorCodeHideShowObj3 : 0|1@1+ (1,0) [0|1] "" Vector__XXX
 SG_ ObjectToEnableDisableID : 0|16@1+ (1,0) [0|65535] "" Vector__XXX
 SG_ ObjectEnableStatus : 0|8@1+ (1,0) [0|1] "" Vector__XXX
 SG_ ErrorCodeEnableDisableObj1 : 0|1@1+ (1,0) [0|1] "" Vector__XXX
 SG_ ErrorCodeEnableDisableObj2 : 0|1@1+ (1,0) [0|1] "" Vector__XXX
 SG_ ErrorCodeEnableDisableObj3 : 0|1@1+ (1,0) [0|1] "" Vector__XXX
 SG_ ErrorCodeEnableDisableObj4 : 0|1@1+ (1,0) [0|1] "" Vector__XXX
 SG_ SelectInputObjectID : 0|16@1+ (1,0) [0|65535] "" Vector__XXX
 SG_ ObjectSelectStatus : 0|8@1+ (1,0) [0|2] "" Vector__XXX
 SG_ ErrorCodeSelectObject1 : 0|1@1+ (1,0) [0|1] "" Vector__XXX
 SG_ ErrorCodeSelectObject2 : 0|1@1+ (1,0) [0|1] "" Vector__XXX
 SG_ ErrorCodeSelectObject3 : 0|1@1+ (1,0) [0|1] "" Vector__XXX
 SG_ ErrorCodeSelectObject4 : 0|1@1+ (1,0) [0|1] "" Vector__XXX
 SG_ ErrorCodeSelectObject5 : 0|1@1+ (1,0) [0|1] "" Vector__XXX
 SG_ ErrorCodeControlAudioDevice1 : 0|1@1+ (1,0) [0|1] "" Vector__XXX
 SG_ ErrorCodeControlAudioDevice2 : 0|1@1+ (1,0) [0|1] "" Vector__XXX
 SG_ ErrorCodeAudioVolume1 : 0|1@1+ (1,0) [0|1] "" Vector__XXX
 SG_ ErrorCodeAudioVolume2 : 0|1@1+ (1,0) [0|1] "" Vector__XXX
 SG_ ParentObjectID : 0|16@1+ (1,0) [0|65535] "" Vector__XXX
 SG_ ObjectToMoveID : 0|16@1+ (1,0) [0|65535] "" Vector__XXX
 SG_ ErrorCodeChangeChildLocation1 : 0|1@1+ (1,0) [0|1] "" Vector__XXX
 SG_ ErrorCodeChangeChildLocation2 : 0|1@1+ (1,0) [0|1] "" Vector__XXX
 SG_ ErrorCodeChangeChildLocation5 : 0|1@1+ (1,0) [0|1] "" Vector__XXX
 SG_ ObjectToSizeID : 0|16@1+ (1,0) [0|65535] "" Vector__XXX
 SG_ ErrorCodeObjToSize1 : 0|1@1+ (1,0) [0|1] "" Vector__XXX
 SG_ ErrorCodeObjToSize2 : 0|1@1+ (1,0) [0|1] "" Vector__XXX
 SG_ ErrorCodeObjToSize3 : 0|1@1+ (1,0) [0|1] "" Vector__XXX
 SG_ ErrorCodeObjToSize4 : 0|1@1+ (1,0) [0|1] "" Vector__XXX
 SG_ ObjectToChangeColourID : 0|16@1+ (1,0) [0|65535] "" Vector__XXX
 SG_ NewBackgroundColour : 0|8@1+ (1,0) [0|255] "" Vector__XXX
 SG_ ErrorCodeChangeColour1 : 0|1@1+ (1,0) [0|1] "" Vector__XXX
 SG_ ErrorCodeChangeColour2 : 0|1@1+ (1,0) [0|1] "" Vector__XXX
 SG_ ErrorCodeChangeColour3 : 0|1@1+ (1,0) [0|1] "" Vector__XXX
 SG_ ObjectToChangeNumValueID : 0|16@1+ (1,0) [0|65535] "" Vector__XXX
 SG_ ErrorCodeChangeNumValue1 : 0|1@1+ (1,0) [0|1] "" Vector__XXX
 SG_ ErrorCodeChangeNumValue2 : 0|1@1+ (1,0) [0|1] "" Vector__XXX
 SG_ ErrorCodeChangeNumValue3 : 0|1@1+ (1,0) [0|1] "" Vector__XXX
 SG_ ValueOfTheObject : 0|32@1+ (1,0) [0|2704] "" Vector__XXX
 SG_ ObjectToChangeEndPointID : 0|16@1+ (1,0) [0|65535] "" Vector__XXX
 SG_ ErrorCodeChangeEditPoint1 : 0|1@1+ (1,0) [0|1] "" Vector__XXX
 SG_ ErrorCodeChangeEditPoint2 : 0|1@1+ (1,0) [0|1] "" Vector__XXX
 SG_ ErrorCodeChangeEditPoint3 : 0|1@1+ (1,0) [0|1] "" Vector__XXX
 SG_ ObjectToChangeFontID : 0|16@1+ (1,0) [0|65535] "" Vector__XXX
 SG_ ErrorCodeChangeFont1 : 0|1@1+ (1,0) [0|1] "" Vector__XXX
 SG_ ErrorCodeChangeFont2 : 0|1@1+ (1,0) [0|1] "" Vector__XXX
 SG_ ErrorCodeChangeFont4 : 0|1@1+ (1,0) [0|1] "" Vector__XXX
 SG_ ErrorCodeChangeFont3 : 0|1@1+ (1,0) [0|1] "" Vector__XXX
 SG_ ErrorCodeChangeFont5 : 0|1@1+ (1,0) [0|1] "" Vector__XXX
 SG_ ErrorCodeChangeFont6 : 0|1@1+ (1,0) [0|1] "" Vector__XXX
 SG_ ObjectToChangeLineAttributeID : 0|16@1+ (1,0) [0|65535] "" Vector__XXX
 SG_ ErrorCodeChangeLineAttribute1 : 0|1@1+ (1,0) [0|1] "" Vector__XXX
 SG_ ErrorCodeChangeLineAttribute2 : 0|1@1+ (1,0) [0|1] "" Vector__XXX
 SG_ ErrorCodeChangeLineAttribute3 : 0|1@1+ (1,0) [0|1] "" Vector__XXX
 SG_ ErrorCodeChangeLineAttribute4 : 0|1@1+ (1,0) [0|1] "" Vector__XXX
 SG_ ObjectToChangeFillAttributesID : 0|16@1+ (1,0) [0|65535] "" Vector__XXX
 SG_ ErrorCodeChangeFillAttributes1 : 0|1@1+ (1,0) [0|1] "" Vector__XXX
 SG_ ErrorCodeChangeFillAttributes2 : 0|1@1+ (1,0) [0|1] "" Vector__XXX
 SG_ ErrorCodeChangeFillAttributes3 : 0|1@1+ (1,0) [0|1] "" Vector__XXX
 SG_ ErrorCodeChangeFillAttributes4 : 0|1@1+ (1,0) [0|1] "" Vector__XXX
 SG_ ErrorCodeChangeFillAttributes5 : 0|1@1+ (1,0) [0|1] "" Vector__XXX
 SG_ ActiveMaskObjectID : 0|16@1+ (1,0) [0|0] "" Vector__XXX
 SG_ ErrorCodeChangeActiveMask1 : 0|1@1+ (1,0) [0|1] "" Vector__XXX
 SG_ ErrorCodeChangeActiveMask2 : 0|1@1+ (1,0) [0|1] "" Vector__XXX
 SG_ ErrorCodeChangeActiveMask3 : 0|1@1+ (1,0) [0|1] "" Vector__XXX
 SG_ ErrorCodeChangeActiveMask4 : 0|1@1+ (1,0) [0|1] "" Vector__XXX
 SG_ ErrorCodeChangeActiveMask5 : 0|1@1+ (1,0) [0|1] "" Vector__XXX
 SG_ DataOrAlarmMaskObjectID : 0|16@1+ (1,0) [0|65535] "" Vector__XXX
 SG_ SoftKeyMaskObjectID : 0|16@1+ (1,0) [0|65535] "" Vector__XXX
 SG_ ErrorCodeChangeSoftKeyMask1 : 0|1@1+ (1,0) [0|1] "" Vector__XXX
 SG_ ErrorCodeChangeSoftKeyMask2 : 0|1@1+ (1,0) [0|1] "" Vector__XXX
 SG_ ErrorCodeChangeSoftKeyMask3 : 0|1@1+ (1,0) [0|1] "" Vector__XXX
 SG_ ErrorCodeChangeSoftKeyMask4 : 0|1@1+ (1,0) [0|1] "" Vector__XXX
 SG_ ErrorCodeChangeSoftKeyMask5 : 0|1@1+ (1,0) [0|1] "" Vector__XXX
 SG_ ObjectToChangeAttributeID : 0|16@1+ (1,0) [0|65535] "" Vector__XXX
 SG_ AttributeID : 0|8@1+ (1,0) [0|65535] "" Vector__XXX
 SG_ ErrorCodeChangeAttribute1 : 0|1@1+ (1,0) [0|1] "" Vector__XXX
 SG_ ErrorCodeChangeAttribute2 : 0|1@1+ (1,0) [0|1] "" Vector__XXX
 SG_ ErrorCodeChangeAttribute3 : 0|1@1+ (1,0) [0|1] "" Vector__XXX
 SG_ ErrorCodeChangeAttribute4 : 0|1@1+ (1,0) [0|1] "" Vector__XXX
 SG_ AlarmMaskObjectID : 0|16@1+ (1,0) [0|65535] "" Vector__XXX
 SG_ NewPriority : 0|8@1+ (1,0) [0|255] "" Vector__XXX
 SG_ ErrorCodeChangePriority1 : 0|1@1+ (1,0) [0|1] "" Vector__XXX
 SG_ ErrorCodeChangePriority2 : 0|1@1+ (1,0) [0|1] "" Vector__XXX
 SG_ ErrorCodeChangePriority3 : 0|1@1+ (1,0) [0|1] "" Vector__XXX
 SG_ ListInputObjectID : 0|16@1+ (1,0) [0|65535] "" Vector__XXX
 SG_ ListIndex : 0|8@1+ (1,0) [0|255] "" Vector__XXX
 SG_ NewObjectID : 0|16@1+ (1,0) [0|65535] "" Vector__XXX
 SG_ ErrorCodeChangeListItem1 : 0|1@1+ (1,0) [0|1] "" Vector__XXX
 SG_ ErrorCodeChangeListItem2 : 0|1@1+ (1,0) [0|1] "" Vector__XXX
 SG_ ErrorCodeChangeListItem3 : 0|1@1+ (1,0) [0|1] "" Vector__XXX
 SG_ ErrorCodeChangeListItem4 : 0|1@1+ (1,0) [0|1] "" Vector__XXX
 SG_ ErrorCodeDeleteObjectPool1 : 0|1@1+ (1,0) [0|1] "" Vector__XXX
 SG_ ErrorCodeDeleteObjectPool2 : 0|1@1+ (1,0) [0|1] "" Vector__XXX
 SG_ ParentObjectID : 0|16@1+ (1,0) [0|65535] "" Vector__XXX
 SG_ ObjectToChangeStringValueID : 0|16@1+ (1,0) [0|65535] "" Vector__XXX
 SG_ ErrorCodeChangeStrObjectID : 0|1@1+ (1,0) [0|1] "" Vector__XXX
 SG_ ErrorCodeChangeStrTooLong : 0|1@1+ (1,0) [0|1] "" Vector__XXX
 SG_ ErrorCodeChangeStrError : 0|1@1+ (1,0) [0|1] "" Vector__XXX
 SG_ ParentObjectID : 0|16@1+ (1,0) [0|65535] "" Vector__XXX
 SG_ ObjectToMoveID : 0|16@1+ (1,0) [0|65535] "" Vector__XXX
 SG_ ErrorCodeChangePosInvalidParent : 0|1@1+ (1,0) [0|1] "" Vector__XXX
 SG_ ErrorCodeChangePosInvalidObject : 0|1@1+ (1,0) [0|1] "" Vector__XXX
 SG_ ErrorCodeChangePosInvalidError : 0|1@1+ (1,0) [0|1] "" Vector__XXX
 SG_ ErrorCodeSetObjectLabel1 : 0|1@1+ (1,0) [0|1] "" Vector__XXX
 SG_ ErrorCodeSetObjectLabel2 : 0|1@1+ (1,0) [0|1] "" Vector__XXX
 SG_ ErrorCodeSetObjectLabel3 : 0|1@1+ (1,0) [0|1] "" Vector__XXX
 SG_ ErrorCodeSetObjectLabel4 : 0|1@1+ (1,0) [0|1] "" Vector__XXX
 SG_ ErrorCodeSetObjectLabel5 : 0|1@1+ (1,0) [0|1] "" Vector__XXX
 SG_ ErrorCodeSetObjectLabel6 : 0|1@1+ (1,0) [0|1] "" Vector__XXX
 SG_ PolygonObjectToChangeID : 0|16@1+ (1,0) [0|65535] "" Vector__XXX
 SG_ ErrorCodeChangePoygonPoint1 : 0|1@1+ (1,0) [0|1] "" Vector__XXX
 SG_ ErrorCodeChangePoygonPoint2 : 0|1@1+ (1,0) [0|1] "" Vector__XXX
 SG_ ErrorCodeChangePoygonPoint3 : 0|1@1+ (1,0) [0|1] "" Vector__XXX
 SG_ PolygonObjectToScaleID : 0|16@1+ (1,0) [0|65535] "" Vector__XXX
 SG_ NewWidthAttribute : 0|16@1+ (1,0) [0|65535] "" Vector__XXX
 SG_ NewHeigthAttribute : 0|16@1+ (1,0) [0|0] "" Vector__XXX
 SG_ ErrorCodeChangePolygonScale1 : 0|1@1+ (1,0) [0|1] "" Vector__XXX
 SG_ ErrorCodeChangePolygonScale5 : 0|1@1+ (1,0) [0|1] "" Vector__XXX
 SG_ GraphicsContextObjectID : 0|16@1+ (1,0) [0|65535] "" Vector__XXX
 SG_ SubCommandID : 0|8@1+ (1,0) [0|0] "" Vector__XXX
 SG_ ErrorCodeGraphicsContextCmd1 : 0|1@1+ (1,0) [0|1] "" Vector__XXX
 SG_ ErrorCodeGraphicsContextCmd2 : 0|1@1+ (1,0) [0|1] "" Vector__XXX
 SG_ ErrorCodeGraphicsContextCmd3 : 0|1@1+ (1,0) [0|1] "" Vector__XXX
 SG_ ErrorCodeGraphicsContextCmd4 : 0|1@1+ (1,0) [0|1] "" Vector__XXX
 SG_ ErrorCodeGraphicsContextCmd5 : 0|1@1+ (1,0) [0|1] "" Vector__XXX
 SG_ ObjectToGetAttributeID_Resp : 0|16@1+ (1,0) [0|65535] "" Vector__XXX
 SG_ AttributeID : 0|8@1+ (1,0) [0|0] "" Vector__XXX
 SG_ ColourMapObjectID : 0|16@1+ (1,0) [0|65535] "" Vector__XXX
 SG_ ErrorCodeSelectColourMap2 : 0|1@1+ (1,0) [0|1] "" Vector__XXX
 SG_ ErrorCodeSelectColourMap1 : 0|1@1+ (1,0) [0|1] "" Vector__XXX
 SG_ ErrorCodeLockUnlockMask9 : 0|1@1+ (1,0) [0|1] "" Vector__XXX
 SG_ ErrorCodeLockUnlockMask8 : 0|1@1+ (1,0) [0|1] "" Vector__XXX
 SG_ ErrorCodeLockUnlockMask7 : 0|1@1+ (1,0) [0|1] "" Vector__XXX
 SG_ ErrorCodeLockUnlockMask6 : 0|1@1+ (1,0) [0|1] "" Vector__XXX
 SG_ ErrorCodeLockUnlockMask5 : 0|1@1+ (1,0) [0|1] "" Vector__XXX
 SG_ ErrorCodeLockUnlockMask4 : 0|1@1+ (1,0) [0|1] "" Vector__XXX
 SG_ ErrorCodeLockUnlockMask3 : 0|1@1+ (1,0) [0|1] "" Vector__XXX
 SG_ ErrorCodeLockUnlockMask2 : 0|1@1+ (1,0) [0|1] "" Vector__XXX
 SG_ ErrorCodeLockUnlockMask1 : 0|1@1+ (1,0) [0|1] "" Vector__XXX
 SG_ LockUnlockCommand : 0|8@1+ (1,0) [0|1] "" Vector__XXX
 SG_ MacroObjecID : 0|8@1+ (1,0) [0|255] "" Vector__XXX
 SG_ ErrorCodeExecuteMacro1 : 0|1@1+ (1,0) [0|1] "" Vector__XXX
 SG_ ErrorCodeExecuteMacro2 : 0|1@1+ (1,0) [0|1] "" Vector__XXX
 SG_ ErrorCodeExecuteMacro3 : 0|1@1+ (1,0) [0|1] "" Vector__XXX
 SG_ VersionNumberISO11783Part6 : 0|8@1+ (1,0) [0|255] "" Vector__XXX
 SG_ MemoryStatus : 0|8@1+ (1,0) [0|1] "" Vector__XXX
 SG_ FirstWideChar : 0|16@1+ (1,0) [0|65535] "" Vector__XXX
 SG_ LastWideChar : 0|16@1+ (1,0) [0|65535] "" Vector__XXX
 SG_ ErrorCodeGetSupportedWideChars2 : 0|1@1+ (1,0) [0|1] "" Vector__XXX
 SG_ ErrorCodeGetSupportedWideChars1 : 0|1@1+ (1,0) [0|1] "" Vector__XXX
 SG_ CodePlane : 0|8@1+ (1,0) [0|16] "" Vector__XXX
 SG_ NumberOfRanges : 0|8@1+ (1,0) [0|255] "" Vector__XXX
 SG_ NavigationSoftKeys : 0|8@1+ (1,0) [0|254] "" Vector__XXX
 SG_ XDotsForSoftKeyDescriptor : 0|8@1+ (1,0) [0|255] "" Vector__XXX
 SG_ YDotsForSoftKeyDescriptor : 0|8@1+ (1,0) [0|255] "" Vector__XXX
 SG_ NumberOfPossibleVirtualSoftKeys : 0|8@1+ (1,0) [0|255] "" Vector__XXX
 SG_ NumberOfPhysicalSoftKeys : 0|8@1+ (1,0) [0|255] "" Vector__XXX
 SG_ FontSize_8x8 : 0|1@1+ (1,0) [0|1] "" Vector__XXX
 SG_ FontSize_8x12 : 0|1@1+ (1,0) [0|1] "" Vector__XXX
 SG_ FontSize_12x16 : 0|1@1+ (1,0) [0|1] "" Vector__XXX
 SG_ FontSize_16x16 : 0|1@1+ (1,0) [0|1] "" Vector__XXX
 SG_ FontSize_16x24 : 0|1@1+ (1,0) [0|1] "" Vector__XXX
 SG_ FontSize_24x32 : 0|1@1+ (1,0) [0|1] "" Vector__XXX
 SG_ FontSize_32x32 : 0|1@1+ (1,0) [0|1] "" Vector__XXX
 SG_ FontSize_32x48 : 0|1@1+ (1,0) [0|1] "" Vector__XXX
 SG_ FontSize_48x64 : 0|1@1+ (1,0) [0|1] "" Vector__XXX
 SG_ FontSize_64x64 : 0|1@1+ (1,0) [0|1] "" Vector__XXX
 SG_ FontSize_64x96 : 0|1@1+ (1,0) [0|1] "" Vector__XXX
 SG_ FontSize_96x128 : 0|1@1+ (1,0) [0|1] "" Vector__XXX
 SG_ FontSize_128x128 : 0|1@1+ (1,0) [0|1] "" Vector__XXX
 SG_ FontSize_128x192 : 0|1@1+ (1,0) [0|1] "" Vector__XXX
 SG_ FontType_BoldText : 0|1@1+ (1,0) [0|1] "" Vector__XXX
 SG_ FontType_CrossedOutText : 0|1@1+ (1,0) [0|1] "" Vector__XXX
 SG_ FontType_UnderlinedText : 0|1@1+ (1,0) [0|1] "" Vector__XXX
 SG_ FontType_ItalicsText : 0|1@1+ (1,0) [0|1] "" Vector__XXX
 SG_ FontType_InvertedText : 0|1@1+ (1,0) [0|1] "" Vector__XXX
 SG_ FontType_FlashInverted : 0|1@1+ (1,0) [0|1] "" Vector__XXX
 SG_ FontType_FlashHidden : 0|1@1+ (1,0) [0|1] "" Vector__XXX
 SG_ FontType_ProportionalFont : 0|1@1+ (1,0) [0|1] "" Vector__XXX
 SG_ MaxLineWidth : 0|8@1+ (1,0) [0|255] "" Vector__XXX
 SG_ LineArts : 0|8@1+ (1,0) [0|1] "" Vector__XXX
 SG_ FillTypes : 0|8@1+ (1,0) [0|1] "" Vector__XXX
 SG_ ShapeFillTypes : 0|8@1+ (1,0) [0|3] "" Vector__XXX
 SG_ SupportedGrapicMode : 0|8@1+ (1,0) [0|2] "" Vector__XXX
 SG_ Hardware1 : 0|1@1+ (1,0) [0|1] "" Vector__XXX
 SG_ Hardware2 : 0|1@1+ (1,0) [0|1] "" Vector__XXX
 SG_ Hardware3 : 0|1@1+ (1,0) [0|1] "" Vector__XXX
 SG_ Hardware4 : 0|1@1+ (1,0) [0|1] "" Vector__XXX
 SG_ Hardware5 : 0|1@1+ (1,0) [0|1] "" Vector__XXX
 SG_ Hardware6 : 0|1@1+ (1,0) [0|1] "" Vector__XXX
 SG_ NrOfXPixelsInDataAreaMask : 0|16@1+ (1,0) [0|65535] "" Vector__XXX
 SG_ NrOfYPixelsInDataAreaMask : 0|16@1+ (1,0) [0|65535] "" Vector__XXX
 SG_ AcknowledgmentStoreVersion : 0|4@1+ (1,0) [0|8] "" Vector__XXX
 SG_ AcknowledgmentLoadVersion : 0|4@1+ (1,0) [0|8] "" Vector__XXX
 SG_ AcknowledgmentDeleteVersion : 0|4@1+ (1,0) [0|8] "" Vector__XXX
 SG_ NrOfVersionStrings : 0|8@1+ (1,0) [0|255] "" Vector__XXX
 SG_ VersionLables : 0|56@1+ (1,0) [0|0] "" Vector__XXX
 SG_ ParentObjectID : 0|16@1+ (1,0) [0|65535] "" Vector__XXX
 SG_ ObjectIDOfFaultyObject : 0|16@1+ (1,0) [0|65535] "" Vector__XXX
 SG_ ErrorCodeVtObjPoolError1 : 0|1@1+ (1,0) [0|1] "" Vector__XXX
 SG_ ErrorCodeVtObjPoolError2 : 0|1@1+ (1,0) [0|1] "" Vector__XXX
 SG_ ErrorCodeVtObjPoolError3 : 0|1@1+ (1,0) [0|1] "" Vector__XXX
 SG_ ErrorCodeVtObjPoolError4 : 0|1@1+ (1,0) [0|1] "" Vector__XXX
 SG_ SourceAdressOfActiveWSM : 0|8@1+ (1,0) [0|255] "" Vector__XXX
 SG_ VisibleDataOrAlarmMaskObjectID : 0|16@1+ (1,0) [0|65535] "" Vector__XXX
 SG_ VisibleSoftKeyMaskObjectID : 0|16@1+ (1,0) [0|65535] "" Vector__XXX
 SG_ VTBusyCode1 : 0|1@1+ (1,0) [0|1] "" Vector__XXX
 SG_ VTBusyCode2 : 0|1@1+ (1,0) [0|1] "" Vector__XXX
 SG_ VTBusyCode3 : 0|1@1+ (1,0) [0|1] "" Vector__XXX
 SG_ VTBusyCode4 : 0|1@1+ (1,0) [0|1] "" Vector__XXX
 SG_ VTBusyCode5 : 0|1@1+ (1,0) [0|1] "" Vector__XXX
 SG_ VTBusyCode8 : 0|1@1+ (1,0) [0|1] "" Vector__XXX
 SG_ VTFunctionCode : 0|8@1+ (1,0) [0|255] "" Vector__XXX
 SG_ VTFunctionVTtoECU : 0|8@1+ (1,0) [0|255] "" Vector__XXX
 SG_ KeyActivationCode : 0|8@1+ (1,0) [0|2] "" Vector__XXX
 SG_ KeyObjectID : 0|16@1+ (1,0) [0|65535] "" Vector__XXX
 SG_ KeyObjectParentID : 0|16@1+ (1,0) [0|65535] "" Vector__XXX
 SG_ SoftKeyCode : 0|8@1+ (1,0) [0|255] "" Vector__XXX
 SG_ ButtonActivationCode : 0|8@1+ (1,0) [0|2] "" Vector__XXX
 SG_ ButtonObjectID : 0|16@1+ (1,0) [0|65535] "" Vector__XXX
 SG_ ButtonObjectParentID : 0|16@1+ (1,0) [0|65535] "" Vector__XXX
 SG_ ButtonKeyCode : 0|8@1+ (1,0) [0|255] "" Vector__XXX
 SG_ XPosition : 0|16@1+ (1,0) [0|65535] "" Vector__XXX
 SG_ YPosition : 0|16@1+ (1,0) [0|65535] "" Vector__XXX
 SG_ TouchState : 0|8@1+ (1,0) [0|255] "" Vector__XXX
 SG_ VTSelectInputObjectID : 0|16@1+ (1,0) [0|65535] "" Vector__XXX
 SG_ VTSelectInputObjectStatus : 0|8@1+ (1,0) [0|1] "" Vector__XXX
 SG_ VTSelectInputObjectIsEdited : 0|1@1+ (1,0) [0|1] "" Vector__XXX
 SG_ VTEscObjectID : 0|16@1+ (1,0) [0|65535] "" Vector__XXX
 SG_ ErrorCodeVTEsc1 : 0|1@1+ (1,0) [0|1] "" Vector__XXX
 SG_ ErrorCodeVTEsc2 : 0|1@1+ (1,0) [0|1] "" Vector__XXX
 SG_ VTChangeNumericValueObjectID : 0|16@1+ (1,0) [0|65535] "" Vector__XXX
 SG_ VTChangeNumericValueValue : 0|32@1+ (1,0) [0|4294967295] "" Vector__XXX
 SG_ VTChangeActiveMaskObjectID : 0|16@1+ (1,0) [0|65535] "" Vector__XXX
 SG_ ErrorCodeMissingObjects : 0|1@1+ (1,0) [0|1] "" Vector__XXX
 SG_ ErrorCodeMaskOrChildObjectError : 0|1@1+ (1,0) [0|1] "" Vector__XXX
 SG_ ErrorCodeAnyOtherError : 0|1@1+ (1,0) [0|1] "" Vector__XXX
 SG_ ErrorCodePoolDeleted : 0|1@1+ (1,0) [0|1] "" Vector__XXX
 SG_ VTChangeActiveMaskErrorID : 0|16@1+ (1,0) [0|65535] "" Vector__XXX
 SG_ VTChangeActiveMaskParentID : 0|16@1+ (1,0) [0|65535] "" Vector__XXX
 SG_ VTChangeSoftKeyMaskParentID : 0|16@1+ (1,0) [0|65535] "" Vector__XXX
 SG_ VTChangeSoftKeyMaskObjectID : 0|16@1+ (1,0) [0|65535] "" Vector__XXX
 SG_ ErrorCodeVTChangeSoftKeyMask1 : 0|1@1+ (1,0) [0|1] "" Vector__XXX
 SG_ ErrorCodeVTChangeSoftKeyMask2 : 0|1@1+ (1,0) [0|1] "" Vector__XXX
 SG_ ErrorCodeVTChangeSoftKeyMask3 : 0|1@1+ (1,0) [0|1] "" Vector__XXX
 SG_ ErrorCodeVTChangeSoftKeyMask4 : 0|1@1+ (1,0) [0|1] "" Vector__XXX
 SG_ ErrorCodeVTChangeSoftKeyMask5 : 0|1@1+ (1,0) [0|1] "" Vector__XXX
 SG_ ObjectToChangeStringID : 0|16@1+ (1,0) [0|65535] "" Vector__XXX
 SG_ EnteredStringValue : 0|8@1+ (1,0) [0|255] "" Vector__XXX
 SG_ DisplayActivationStatus1 : 0|1@1+ (1,0) [0|1] "" Vector__XXX
 SG_ VisibleDataAlarmMaskID : 0|16@1+ (1,0) [0|65535] "" Vector__XXX
 SG_ VisibleSoftKeyMaskID : 0|16@1+ (1,0) [0|65535] "" Vector__XXX
 SG_ ErrorCodeEndOfObjectPool1 : 0|1@1+ (1,0) [0|1] "" Vector__XXX
 SG_ ErrorCodeEndOfObjectPool2 : 0|1@1+ (1,0) [0|1] "" Vector__XXX
 SG_ ErrorCodeEndOfObjectPool3 : 0|1@1+ (1,0) [0|1] "" Vector__XXX
 SG_ ParentObjectIdOfFaultyObject : 0|16@1+ (1,0) [0|65535] "" Vector__XXX
 SG_ ObjectIdOfFaultyObject : 0|16@1+ (1,0) [0|65535] "" Vector__XXX
 SG_ ErrorCodeObjectPool1 : 0|1@1+ (1,0) [0|1] "" Vector__XXX
 SG_ ErrorCodeObjectPool2 : 0|1@1+ (1,0) [0|1] "" Vector__XXX
 SG_ ErrorCodeObjectPool3 : 0|1@1+ (1,0) [0|1] "" Vector__XXX
 SG_ ErrorCodeObjectPool4 : 0|1@1+ (1,0) [0|1] "" Vector__XXX
 SG_ IdentityNumber : 0|21@1+ (1,0) [0|2097150] "" Vector__XXX
 SG_ ManufacturerCode : 0|11@1+ (1,0) [0|2047] "" Vector__XXX
 SG_ ECUInstance : 0|3@1+ (1,0) [0|7] "" Vector__XXX
 SG_ FunctionInstance : 0|5@1+ (1,0) [0|31] "" Vector__XXX
 SG_ AuxiliaryInputObjectID : 0|16@1+ (1,0) [0|65535] "" Vector__XXX
 SG_ InputObjectId : 0|16@1+ (1,0) [0|255] "" Vector__XXX
 SG_ Value1 : 0|16@1+ (1,0) [0|65535] "" Vector__XXX
 SG_ Function : 0|8@1+ (1,0) [0|255] "" Vector__XXX
 SG_ DeviceClass : 0|7@1+ (1,0) [0|127] "" Vector__XXX
 SG_ IndustryGroup : 0|3@1+ (1,0) [0|7] "" Vector__XXX
 SG_ DeviceClassInstance : 0|4@1+ (1,0) [0|15] "" Vector__XXX
 SG_ SelfConfigurableAddress : 0|1@1+ (1,0) [0|1] "" Vector__XXX
 SG_ AuxiliaryFunctionType : 0|4@1+ (1,0) [0|15] "" Vector__XXX
 SG_ AuxiliaryFunctionObjectID : 0|16@1+ (1,0) [0|65535] "" Vector__XXX
 SG_ DoNotStoreAsPrefAssignment : 0|1@1+ (1,0) [0|1] "" Vector__XXX
 SG_ Value2 : 0|16@1+ (1,0) [0|65535] "" Vector__XXX
 SG_ AuxPreferredAssignmentRespError1 : 0|1@1+ (1,0) [0|1] "" Vector__XXX
 SG_ AuxPreferredAssignmentRespError2 : 0|1@1+ (1,0) [0|1] "" Vector__XXX
 SG_ AuxPreferredAssignmentRespError3 : 0|1@1+ (1,0) [0|1] "" Vector__XXX
 SG_ AuxPreferredAssignmentRespError4 : 0|1@1+ (1,0) [0|1] "" Vector__XXX
 SG_ InputStatusObjectId : 0|16@1+ (1,0) [0|255] "" Vector__XXX
 SG_ AuxInputEnable : 0|8@1+ (1,0) [0|1] "" Vector__XXX
 SG_ ObjectEscapeID : 0|16@1+ (1,0) [0|65535] "" Vector__XXX
 SG_ ErrorCodeEscapeObj1 : 0|1@1+ (1,0) [0|1] "" Vector__XXX
 SG_ ErrorCodeEscapeObj2 : 0|1@1+ (1,0) [0|1] "" Vector__XXX
 SG_ ObjectToHideShowID : 0|16@1+ (1,0) [0|65535] "" Vector__XXX
 SG_ ObjectShowStatus : 0|8@1+ (1,0) [0|1] "" Vector__XXX
 SG_ ErrorCodeHideShowObj1 : 0|1@1+ (1,0) [0|1] "" Vector__XXX
 SG_ ErrorCodeHideShowObj2 : 0|1@1+ (1,0) [0|1] "" Vector__XXX
 SG_ ErrorCodeHideShowObj3 : 0|1@1+ (1,0) [0|1] "" Vector__XXX
 SG_ ObjectToEnableDisableID : 0|16@1+ (1,0) [0|65535] "" Vector__XXX
 SG_ ObjectEnableStatus : 0|8@1+ (1,0) [0|1] "" Vector__XXX
 SG_ ErrorCodeEnableDisableObj1 : 0|1@1+ (1,0) [0|1] "" Vector__XXX
 SG_ ErrorCodeEnableDisableObj2 : 0|1@1+ (1,0) [0|1] "" Vector__XXX
 SG_ ErrorCodeEnableDisableObj3 : 0|1@1+ (1,0) [0|1] "" Vector__XXX
 SG_ ErrorCodeEnableDisableObj4 : 0|1@1+ (1,0) [0|1] "" Vector__XXX
 SG_ SelectInputObjectID : 0|16@1+ (1,0) [0|65535] "" Vector__XXX
 SG_ ObjectSelectStatus : 0|8@1+ (1,0) [0|2] "" Vector__XXX
 SG_ ErrorCodeSelectObject1 : 0|1@1+ (1,0) [0|1] "" Vector__XXX
 SG_ ErrorCodeSelectObject2 : 0|1@1+ (1,0) [0|1] "" Vector__XXX
 SG_ ErrorCodeSelectObject3 : 0|1@1+ (1,0) [0|1] "" Vector__XXX
 SG_ ErrorCodeSelectObject4 : 0|1@1+ (1,0) [0|1] "" Vector__XXX
 SG_ ErrorCodeSelectObject5 : 0|1@1+ (1,0) [0|1] "" Vector__XXX
 SG_ ErrorCodeControlAudioDevice1 : 0|1@1+ (1,0) [0|1] "" Vector__XXX
 SG_ ErrorCodeControlAudioDevice2 : 0|1@1+ (1,0) [0|1] "" Vector__XXX
 SG_ ErrorCodeAudioVolume1 : 0|1@1+ (1,0) [0|1] "" Vector__XXX
 SG_ ErrorCodeAudioVolume2 : 0|1@1+ (1,0) [0|1] "" Vector__XXX
 SG_ ParentObjectID : 0|16@1+ (1,0) [0|65535] "" Vector__XXX
 SG_ ObjectToMoveID : 0|16@1+ (1,0) [0|65535] "" Vector__XXX
 SG_ ErrorCodeChangeChildLocation1 : 0|1@1+ (1,0) [0|1] "" Vector__XXX
 SG_ ErrorCodeChangeChildLocation2 : 0|1@1+ (1,0) [0|1] "" Vector__XXX
 SG_ ErrorCodeChangeChildLocation5 : 0|1@1+ (1,0) [0|1] "" Vector__XXX
 SG_ ObjectToSizeID : 0|16@1+ (1,0) [0|65535] "" Vector__XXX
 SG_ ErrorCodeObjToSize1 : 0|1@1+ (1,0) [0|1] "" Vector__XXX
 SG_ ErrorCodeObjToSize2 : 0|1@1+ (1,0) [0|1] "" Vector__XXX
 SG_ ErrorCodeObjToSize3 : 0|1@1+ (1,0) [0|1] "" Vector__XXX
 SG_ ErrorCodeObjToSize4 : 0|1@1+ (1,0) [0|1] "" Vector__XXX
 SG_ ObjectToChangeColourID : 0|16@1+ (1,0) [0|65535] "" Vector__XXX
 SG_ NewBackgroundColour : 0|8@1+ (1,0) [0|255] "" Vector__XXX
 SG_ ErrorCodeChangeColour1 : 0|1@1+ (1,0) [0|1] "" Vector__XXX
 SG_ ErrorCodeChangeColour2 : 0|1@1+ (1,0) [0|1] "" Vector__XXX
 SG_ ErrorCodeChangeColour3 : 0|1@1+ (1,0) [0|1] "" Vector__XXX
 SG_ ObjectToChangeNumValueID : 0|16@1+ (1,0) [0|65535] "" Vector__XXX
 SG_ ErrorCodeChangeNumValue1 : 0|1@1+ (1,0) [0|1] "" Vector__XXX
 SG_ ErrorCodeChangeNumValue2 : 0|1@1+ (1,0) [0|1] "" Vector__XXX
 SG_ ErrorCodeChangeNumValue3 : 0|1@1+ (1,0) [0|1] "" Vector__XXX
 SG_ ValueOfTheObject : 0|32@1+ (1,0) [0|2704] "" Vector__XXX
 SG_ ObjectToChangeEndPointID : 0|16@1+ (1,0) [0|65535] "" Vector__XXX
 SG_ ErrorCodeChangeEditPoint1 : 0|1@1+ (1,0) [0|1] "" Vector__XXX
 SG_ ErrorCodeChangeEditPoint2 : 0|1@1+ (1,0) [0|1] "" Vector__XXX
 SG_ ErrorCodeChangeEditPoint3 : 0|1@1+ (1,0) [0|1] "" Vector__XXX
 SG_ ObjectToChangeFontID : 0|16@1+ (1,0) [0|65535] "" Vector__XXX
 SG_ ErrorCodeChangeFont1 : 0|1@1+ (1,0) [0|1] "" Vector__XXX
 SG_ ErrorCodeChangeFont2 : 0|1@1+ (1,0) [0|1] "" Vector__XXX
 SG_ ErrorCodeChangeFont4 : 0|1@1+ (1,0) [0|1] "" Vector__XXX
 SG_ ErrorCodeChangeFont3 : 0|1@1+ (1,0) [0|1] "" Vector__XXX
 SG_ ErrorCodeChangeFont5 : 0|1@1+ (1,0) [0|1] "" Vector__XXX
 SG_ ErrorCodeChangeFont6 : 0|1@1+ (1,0) [0|1] "" Vector__XXX
 SG_ ObjectToChangeLineAttributeID : 0|16@1+ (1,0) [0|65535] "" Vector__XXX
 SG_ ErrorCodeChangeLineAttribute1 : 0|1@1+ (1,0) [0|1] "" Vector__XXX
 SG_ ErrorCodeChangeLineAttribute2 : 0|1@1+ (1,0) [0|1] "" Vector__XXX
 SG_ ErrorCodeChangeLineAttribute3 : 0|1@1+ (1,0) [0|1] "" Vector__XXX
 SG_ ErrorCodeChangeLineAttribute4 : 0|1@1+ (1,0) [0|1] "" Vector__XXX
 SG_ ObjectToChangeFillAttributesID : 0|16@1+ (1,0) [0|65535] "" Vector__XXX
 SG_ ErrorCodeChangeFillAttributes1 : 0|1@1+ (1,0) [0|1] "" Vector__XXX
 SG_ ErrorCodeChangeFillAttributes2 : 0|1@1+ (1,0) [0|1] "" Vector__XXX
 SG_ ErrorCodeChangeFillAttributes3 : 0|1@1+ (1,0) [0|1] "" Vector__XXX
 SG_ ErrorCodeChangeFillAttributes4 : 0|1@1+ (1,0) [0|1] "" Vector__XXX
 SG_ ErrorCodeChangeFillAttributes5 : 0|1@1+ (1,0) [0|1] "" Vector__XXX
 SG_ ActiveMaskObjectID : 0|16@1+ (1,0) [0|0] "" Vector__XXX
 SG_ ErrorCodeChangeActiveMask1 : 0|1@1+ (1,0) [0|1] "" Vector__XXX
 SG_ ErrorCodeChangeActiveMask2 : 0|1@1+ (1,0) [0|1] "" Vector__XXX
 SG_ ErrorCodeChangeActiveMask3 : 0|1@1+ (1,0) [0|1] "" Vector__XXX
 SG_ ErrorCodeChangeActiveMask4 : 0|1@1+ (1,0) [0|1] "" Vector__XXX
 SG_ ErrorCodeChangeActiveMask5 : 0|1@1+ (1,0) [0|1] "" Vector__XXX
 SG_ DataOrAlarmMaskObjectID : 0|16@1+ (1,0) [0|65535] "" Vector__XXX
 SG_ SoftKeyMaskObjectID : 0|16@1+ (1,0) [0|65535] "" Vector__XXX
 SG_ ErrorCodeChangeSoftKeyMask1 : 0|1@1+ (1,0) [0|1] "" Vector__XXX
 SG_ ErrorCodeChangeSoftKeyMask2 : 0|1@1+ (1,0) [0|1] "" Vector__XXX
 SG_ ErrorCodeChangeSoftKeyMask3 : 0|1@1+ (1,0) [0|1] "" Vector__XXX
 SG_ ErrorCodeChangeSoftKeyMask4 : 0|1@1+ (1,0) [0|1] "" Vector__XXX
 SG_ ErrorCodeChangeSoftKeyMask5 : 0|1@1+ (1,0) [0|1] "" Vector__XXX
 SG_ ObjectToChangeAttributeID : 0|16@1+ (1,0) [0|65535] "" Vector__XXX
 SG_ AttributeID : 0|8@1+ (1,0) [0|65535] "" Vector__XXX
 SG_ ErrorCodeChangeAttribute1 : 0|1@1+ (1,0) [0|1] "" Vector__XXX
 SG_ ErrorCodeChangeAttribute2 : 0|1@1+ (1,0) [0|1] "" Vector__XXX
 SG_ ErrorCodeChangeAttribute3 : 0|1@1+ (1,0) [0|1] "" Vector__XXX
 SG_ ErrorCodeChangeAttribute4 : 0|1@1+ (1,0) [0|1] "" Vector__XXX
 SG_ AlarmMaskObjectID : 0|16@1+ (1,0) [0|65535] "" Vector__XXX
 SG_ NewPriority : 0|8@1+ (1,0) [0|255] "" Vector__XXX
 SG_ ErrorCodeChangePriority1 : 0|1@1+ (1,0) [0|1] "" Vector__XXX
 SG_ ErrorCodeChangePriority2 : 0|1@1+ (1,0) [0|1] "" Vector__XXX
 SG_ ErrorCodeChangePriority3 : 0|1@1+ (1,0) [0|1] "" Vector__XXX
 SG_ ListInputObjectID : 0|16@1+ (1,0) [0|65535] "" Vector__XXX
 SG_ ListIndex : 0|8@1+ (1,0) [0|255] "" Vector__XXX
 SG_ NewObjectID : 0|16@1+ (1,0) [0|65535] "" Vector__XXX
 SG_ ErrorCodeChangeListItem1 : 0|1@1+ (1,0) [0|1] "" Vector__XXX
 SG_ ErrorCodeChangeListItem2 : 0|1@1+ (1,0) [0|1] "" Vector__XXX
 SG_ ErrorCodeChangeListItem3 : 0|1@1+ (1,0) [0|1] "" Vector__XXX
 SG_ ErrorCodeChangeListItem4 : 0|1@1+ (1,0) [0|1] "" Vector__XXX
 SG_ ErrorCodeDeleteObjectPool1 : 0|1@1+ (1,0) [0|1] "" Vector__XXX
 SG_ ErrorCodeDeleteObjectPool2 : 0|1@1+ (1,0) [0|1] "" Vector__XXX
 SG_ ParentObjectID : 0|16@1+ (1,0) [0|65535] "" Vector__XXX
 SG_ ObjectToChangeStringValueID : 0|16@1+ (1,0) [0|65535] "" Vector__XXX
 SG_ ErrorCodeChangeStrObjectID : 0|1@1+ (1,0) [0|1] "" Vector__XXX
 SG_ ErrorCodeChangeStrTooLong : 0|1@1+ (1,0) [0|1] "" Vector__XXX
 SG_ ErrorCodeChangeStrError : 0|1@1+ (1,0) [0|1] "" Vector__XXX
 SG_ ParentObjectID : 0|16@1+ (1,0) [0|65535] "" Vector__XXX
 SG_ ObjectToMoveID : 0|16@1+ (1,0) [0|65535] "" Vector__XXX
 SG_ ErrorCodeChangePosInvalidParent : 0|1@1+ (1,0) [0|1] "" Vector__XXX
 SG_ ErrorCodeChangePosInvalidObject : 0|1@1+ (1,0) [0|1] "" Vector__XXX
 SG_ ErrorCodeChangePosInvalidError : 0|1@1+ (1,0) [0|1] "" Vector__XXX
 SG_ ErrorCodeSetObjectLabel1 : 0|1@1+ (1,0) [0|1] "" Vector__XXX
 SG_ ErrorCodeSetObjectLabel2 : 0|1@1+ (1,0) [0|1] "" Vector__XXX
 SG_ ErrorCodeSetObjectLabel3 : 0|1@1+ (1,0) [0|1] "" Vector__XXX
 SG_ ErrorCodeSetObjectLabel4 : 0|1@1+ (1,0) [0|1] "" Vector__XXX
 SG_ ErrorCodeSetObjectLabel5 : 0|1@1+ (1,0) [0|1] "" Vector__XXX
 SG_ ErrorCodeSetObjectLabel6 : 0|1@1+ (1,0) [0|1] "" Vector__XXX
 SG_ PolygonObjectToChangeID : 0|16@1+ (1,0) [0|65535] "" Vector__XXX
 SG_ ErrorCodeChangePoygonPoint1 : 0|1@1+ (1,0) [0|1] "" Vector__XXX
 SG_ ErrorCodeChangePoygonPoint2 : 0|1@1+ (1,0) [0|1] "" Vector__XXX
 SG_ ErrorCodeChangePoygonPoint3 : 0|1@1+ (1,0) [0|1] "" Vector__XXX
 SG_ PolygonObjectToScaleID : 0|16@1+ (1,0) [0|65535] "" Vector__XXX
 SG_ NewWidthAttribute : 0|16@1+ (1,0) [0|65535] "" Vector__XXX
 SG_ NewHeigthAttribute : 0|16@1+ (1,0) [0|0] "" Vector__XXX
 SG_ ErrorCodeChangePolygonScale1 : 0|1@1+ (1,0) [0|1] "" Vector__XXX
 SG_ ErrorCodeChangePolygonScale5 : 0|1@1+ (1,0) [0|1] "" Vector__XXX
 SG_ GraphicsContextObjectID : 0|16@1+ (1,0) [0|65535] "" Vector__XXX
 SG_ SubCommandID : 0|8@1+ (1,0) [0|0] "" Vector__XXX
 SG_ ErrorCodeGraphicsContextCmd1 : 0|1@1+ (1,0) [0|1] "" Vector__XXX
 SG_ ErrorCodeGraphicsContextCmd2 : 0|1@1+ (1,0) [0|1] "" Vector__XXX
 SG_ ErrorCodeGraphicsContextCmd3 : 0|1@1+ (1,0) [0|1] "" Vector__XXX
 SG_ ErrorCodeGraphicsContextCmd4 : 0|1@1+ (1,0) [0|1] "" Vector__XXX
 SG_ ErrorCodeGraphicsContextCmd5 : 0|1@1+ (1,0) [0|1] "" Vector__XXX
 SG_ ObjectToGetAttributeID_Resp : 0|16@1+ (1,0) [0|65535] "" Vector__XXX
 SG_ AttributeID : 0|8@1+ (1,0) [0|0] "" Vector__XXX
 SG_ ColourMapObjectID : 0|16@1+ (1,0) [0|65535] "" Vector__XXX
 SG_ ErrorCodeSelectColourMap2 : 0|1@1+ (1,0) [0|1] "" Vector__XXX
 SG_ ErrorCodeSelectColourMap1 : 0|1@1+ (1,0) [0|1] "" Vector__XXX
 SG_ ErrorCodeLockUnlockMask9 : 0|1@1+ (1,0) [0|1] "" Vector__XXX
 SG_ ErrorCodeLockUnlockMask8 : 0|1@1+ (1,0) [0|1] "" Vector__XXX
 SG_ ErrorCodeLockUnlockMask7 : 0|1@1+ (1,0) [0|1] "" Vector__XXX
 SG_ ErrorCodeLockUnlockMask6 : 0|1@1+ (1,0) [0|1] "" Vector__XXX
 SG_ ErrorCodeLockUnlockMask5 : 0|1@1+ (1,0) [0|1] "" Vector__XXX
 SG_ ErrorCodeLockUnlockMask4 : 0|1@1+ (1,0) [0|1] "" Vector__XXX
 SG_ ErrorCodeLockUnlockMask3 : 0|1@1+ (1,0) [0|1] "" Vector__XXX
 SG_ ErrorCodeLockUnlockMask2 : 0|1@1+ (1,0) [0|1] "" Vector__XXX
 SG_ ErrorCodeLockUnlockMask1 : 0|1@1+ (1,0) [0|1] "" Vector__XXX
 SG_ LockUnlockCommand : 0|8@1+ (1,0) [0|1] "" Vector__XXX
 SG_ MacroObjecID : 0|8@1+ (1,0) [0|255] "" Vector__XXX
 SG_ ErrorCodeExecuteMacro1 : 0|1@1+ (1,0) [0|1] "" Vector__XXX
 SG_ ErrorCodeExecuteMacro2 : 0|1@1+ (1,0) [0|1] "" Vector__XXX
 SG_ ErrorCodeExecuteMacro3 : 0|1@1+ (1,0) [0|1] "" Vector__XXX
 SG_ VersionNumberISO11783Part6 : 0|8@1+ (1,0) [0|255] "" Vector__XXX
 SG_ MemoryStatus : 0|8@1+ (1,0) [0|1] "" Vector__XXX
 SG_ FirstWideChar : 0|16@1+ (1,0) [0|65535] "" Vector__XXX
 SG_ LastWideChar : 0|16@1+ (1,0) [0|65535] "" Vector__XXX
 SG_ ErrorCodeGetSupportedWideChars2 : 0|1@1+ (1,0) [0|1] "" Vector__XXX
 SG_ ErrorCodeGetSupportedWideChars1 : 0|1@1+ (1,0) [0|1] "" Vector__XXX
 SG_ CodePlane : 0|8@1+ (1,0) [0|16] "" Vector__XXX
 SG_ NumberOfRanges : 0|8@1+ (1,0) [0|255] "" Vector__XXX
 SG_ NavigationSoftKeys : 0|8@1+ (1,0) [0|254] "" Vector__XXX
 SG_ XDotsForSoftKeyDescriptor : 0|8@1+ (1,0) [0|255] "" Vector__XXX
 SG_ YDotsForSoftKeyDescriptor : 0|8@1+ (1,0) [0|255] "" Vector__XXX
 SG_ NumberOfPossibleVirtualSoftKeys : 0|8@1+ (1,0) [0|255] "" Vector__XXX
 SG_ NumberOfPhysicalSoftKeys : 0|8@1+ (1,0) [0|255] "" Vector__XXX
 SG_ FontSize_8x8 : 0|1@1+ (1,0) [0|1] "" Vector__XXX
 SG_ FontSize_8x12 : 0|1@1+ (1,0) [0|1] "" Vector__XXX
 SG_ FontSize_12x16 : 0|1@1+ (1,0) [0|1] "" Vector__XXX
 SG_ FontSize_16x16 : 0|1@1+ (1,0) [0|1] "" Vector__XXX
 SG_ FontSize_16x24 : 0|1@1+ (1,0) [0|1] "" Vector__XXX
 SG_ FontSize_24x32 : 0|1@1+ (1,0) [0|1] "" Vector__XXX
 SG_ FontSize_32x32 : 0|1@1+ (1,0) [0|1] "" Vector__XXX
 SG_ FontSize_32x48 : 0|1@1+ (1,0) [0|1] "" Vector__XXX
 SG_ FontSize_48x64 : 0|1@1+ (1,0) [0|1] "" Vector__XXX
 SG_ FontSize_64x64 : 0|1@1+ (1,0) [0|1] "" Vector__XXX
 SG_ FontSize_64x96 : 0|1@1+ (1,0) [0|1] "" Vector__XXX
 SG_ FontSize_96x128 : 0|1@1+ (1,0) [0|1] "" Vector__XXX
 SG_ FontSize_128x128 : 0|1@1+ (1,0) [0|1] "" Vector__XXX
 SG_ FontSize_128x192 : 0|1@1+ (1,0) [0|1] "" Vector__XXX
 SG_ FontType_BoldText : 0|1@1+ (1,0) [0|1] "" Vector__XXX
 SG_ FontType_CrossedOutText : 0|1@1+ (1,0) [0|1] "" Vector__XXX
 SG_ FontType_UnderlinedText : 0|1@1+ (1,0) [0|1] "" Vector__XXX
 SG_ FontType_ItalicsText : 0|1@1+ (1,0) [0|1] "" Vector__XXX
 SG_ FontType_InvertedText : 0|1@1+ (1,0) [0|1] "" Vector__XXX
 SG_ FontType_FlashInverted : 0|1@1+ (1,0) [0|1] "" Vector__XXX
 SG_ FontType_FlashHidden : 0|1@1+ (1,0) [0|1] "" Vector__XXX
 SG_ FontType_ProportionalFont : 0|1@1+ (1,0) [0|1] "" Vector__XXX
 SG_ MaxLineWidth : 0|8@1+ (1,0) [0|255] "" Vector__XXX
 SG_ LineArts : 0|8@1+ (1,0) [0|1] "" Vector__XXX
 SG_ FillTypes : 0|8@1+ (1,0) [0|1] "" Vector__XXX
 SG_ ShapeFillTypes : 0|8@1+ (1,0) [0|3] "" Vector__XXX
 SG_ SupportedGrapicMode : 0|8@1+ (1,0) [0|2] "" Vector__XXX
 SG_ Hardware1 : 0|1@1+ (1,0) [0|1] "" Vector__XXX
 SG_ Hardware2 : 0|1@1+ (1,0) [0|1] "" Vector__XXX
 SG_ Hardware3 : 0|1@1+ (1,0) [0|1] "" Vector__XXX
 SG_ Hardware4 : 0|1@1+ (1,0) [0|1] "" Vector__XXX
 SG_ Hardware5 : 0|1@1+ (1,0) [0|1] "" Vector__XXX
 SG_ Hardware6 : 0|1@1+ (1,0) [0|1] "" Vector__XXX
 SG_ NrOfXPixelsInDataAreaMask : 0|16@1+ (1,0) [0|65535] "" Vector__XXX
 SG_ NrOfYPixelsInDataAreaMask : 0|16@1+ (1,0) [0|65535] "" Vector__XXX
 SG_ AcknowledgmentStoreVersion : 0|4@1+ (1,0) [0|8] "" Vector__XXX
 SG_ AcknowledgmentLoadVersion : 0|4@1+ (1,0) [0|8] "" Vector__XXX
 SG_ AcknowledgmentDeleteVersion : 0|4@1+ (1,0) [0|8] "" Vector__XXX
 SG_ NrOfVersionStrings : 0|8@1+ (1,0) [0|255] "" Vector__XXX
 SG_ VersionLables : 0|56@1+ (1,0) [0|0] "" Vector__XXX
 SG_ ParentObjectID : 0|16@1+ (1,0) [0|65535] "" Vector__XXX
 SG_ ObjectIDOfFaultyObject : 0|16@1+ (1,0) [0|65535] "" Vector__XXX
 SG_ ErrorCodeVtObjPoolError1 : 0|1@1+ (1,0) [0|1] "" Vector__XXX
 SG_ ErrorCodeVtObjPoolError2 : 0|1@1+ (1,0) [0|1] "" Vector__XXX
 SG_ ErrorCodeVtObjPoolError3 : 0|1@1+ (1,0) [0|1] "" Vector__XXX
 SG_ ErrorCodeVtObjPoolError4 : 0|1@1+ (1,0) [0|1] "" Vector__XXX
 SG_ SourceAdressOfActiveWSM : 0|8@1+ (1,0) [0|255] "" Vector__XXX
 SG_ VisibleDataOrAlarmMaskObjectID : 0|16@1+ (1,0) [0|65535] "" Vector__XXX
 SG_ VisibleSoftKeyMaskObjectID : 0|16@1+ (1,0) [0|65535] "" Vector__XXX
 SG_ VTBusyCode1 : 0|1@1+ (1,0) [0|1] "" Vector__XXX
 SG_ VTBusyCode2 : 0|1@1+ (1,0) [0|1] "" Vector__XXX
 SG_ VTBusyCode3 : 0|1@1+ (1,0) [0|1] "" Vector__XXX
 SG_ VTBusyCode4 : 0|1@1+ (1,0) [0|1] "" Vector__XXX
 SG_ VTBusyCode5 : 0|1@1+ (1,0) [0|1] "" Vector__XXX
 SG_ VTBusyCode8 : 0|1@1+ (1,0) [0|1] "" Vector__XXX
 SG_ VTFunctionCode : 0|8@1+ (1,0) [0|255] "" Vector__XXX

CM_ BU_ QuadAnalogue "AuxInput Quadrature Analogue";
CM_ BU_ QuadBoolNonLatch "AuxInput Quadrature Boolean Non-Latching";
CM_ BU_ Loader "Loader Implement";
CM_ BU_ VT "Virtual Terminal Implement";
CM_ BU_ Analogue "AuxInput Analogue";
CM_ BU_ BoolLatch "Aux Input Boolean Latching";
CM_ BU_ BoolNonLatch "AuxInput Boolean Non-Latching";
CM_ BO_ 3221225472 "This is a message for not used signals, created by Vector CANdb++ DBC OLE DB Provider.";
CM_ SG_ 3221225472 ErrorCodeAnyOtherError "VT change mask error code: Any other errorVT change mask error code: Any other errorVT change mask error code: Any other errorVT change mask error code: Any other errorVT change mask error code: Any other error";
CM_ SG_ 3221225472 ErrorCodePoolDeleted "VT change mask error code: Pool being deletedVT change mask error code: Pool being deletedVT change mask error code: Pool being deletedVT change mask error code: Pool being deletedVT change mask error code: Pool being deleted";
CM_ SG_ 3221225472 VTChangeActiveMaskErrorID "Object ID containing errorObject ID containing errorObject ID containing errorObject ID containing errorObject ID containing error";
CM_ SG_ 3221225472 VTChangeActiveMaskParentID "Parent object ID of error object IDParent object ID of error object IDParent object ID of error object IDParent object ID of error object IDParent object ID of error object ID";
CM_ SG_ 3221225472 AuxiliaryFunctionType "Auxiliary function type of assigned auxiliary inputAuxiliary function type of assigned auxiliary inputAuxiliary function type of assigned auxiliary inputAuxiliary function type of assigned auxiliary inputAuxiliary function type of assigned auxiliary input";
CM_ SG_ 3221225472 AuxInputEnable "Auxiliary Input EnableAuxiliary Input EnableAuxiliary Input EnableAuxiliary Input EnableAuxiliary Input Enable";
CM_ SG_ 3221225472 MaxLineWidth "Maximum pen and line thickness in pixels.
Any larger values inside attributes are automatically reduced to this value by the VT.Maximum pen and line thickness in pixels.
Any larger values inside attributes are automatically reduced to this value by the VT.Maximum pen and line thickness in pixels.
Any larger values inside attributes are automatically reduced to this value by the VT.Maximum pen and line thickness in pixels.
Any larger values inside attributes are automatically reduced to this value by the VT.Maximum pen and line thickness in pixels.
Any larger values inside attributes are automatically reduced to this value by the VT.";
BA_DEF_ BU_  "ISO11783IOPFilename" STRING ;
BA_DEF_ BU_  "ISO11783IOPVersion" ENUM  "1","2","3","4";
BA_DEF_  "ISO11783_12_SpecVersion" STRING ;
BA_DEF_ SG_  "SigType" ENUM  "Default","Range","RangeSigned","ASCII","Discrete","Control","ReferencePGN","DTC","StringDelimiter","StringLength","StringLengthControl";
BA_DEF_  "DatabaseVersion" STRING ;
BA_DEF_ SG_  "SPN" INT 0 524287;
BA_DEF_ BO_  "GenMsgRequestable" INT 0 1;
BA_DEF_ BO_  "GenMsgCycleTime" INT 0 3600000;
BA_DEF_ BO_  "GenMsgSendType" ENUM  "cyclic","reserved","cyclicIfActive","reserved","reserved","reserved","reserved","reserved","noMsgSendType","vector_leerstring";
BA_DEF_ BO_  "VFrameFormat" ENUM  "StandardCAN","ExtendedCAN","reserved","J1939PG","vector_leerstring";
BA_DEF_ BU_  "ECU" STRING ;
BA_DEF_ BU_  "NmJ1939IdentityNumber" INT 0 2097151;
BA_DEF_ BU_  "NmJ1939ManufacturerCode" INT 0 2047;
BA_DEF_ BU_  "NmJ1939ECUInstance" INT 0 7;
BA_DEF_ BU_  "NmJ1939FunctionInstance" INT 0 7;
BA_DEF_ BU_  "NmJ1939Function" INT 0 255;
BA_DEF_ BU_  "NmJ1939SystemInstance" INT 0 15;
BA_DEF_ BU_  "NmJ1939System" INT 0 127;
BA_DEF_ BU_  "NmJ1939IndustryGroup" INT 0 7;
BA_DEF_ BU_  "NmJ1939AAC" INT 0 1;
BA_DEF_ BU_  "NmStationAddress" INT 0 255;
BA_DEF_  "BusType" STRING ;
BA_DEF_  "ProtocolType" STRING ;
BA_DEF_ BU_  "NodeLayerModules" STRING ;
BA_DEF_ BO_  "SingleFrame" INT 0 1;
BA_DEF_  "ISO11783_6_SpecVersion" STRING ;
BA_DEF_  "ISO11783_7_SpecVersion" STRING ;
BA_DEF_  "ISO11783_11_SpecVersion" STRING ;
BA_DEF_DEF_  "ISO11783IOPFilename" "";
BA_DEF_DEF_  "ISO11783IOPVersion" "4";
BA_DEF_DEF_  "ISO11783_12_SpecVersion" "";
BA_DEF_DEF_  "SigType" "Default";
BA_DEF_DEF_  "DatabaseVersion" "";
BA_DEF_DEF_  "SPN" 0;
BA_DEF_DEF_  "GenMsgRequestable" 1;
BA_DEF_DEF_  "GenMsgCycleTime" 0;
BA_DEF_DEF_  "GenMsgSendType" "noMsgSendType";
BA_DEF_DEF_  "VFrameFormat" "J1939PG";
BA_DEF_DEF_  "ECU" "";
BA_DEF_DEF_  "NmJ1939IdentityNumber" 0;
BA_DEF_DEF_  "NmJ1939ManufacturerCode" 0;
BA_DEF_DEF_  "NmJ1939ECUInstance" 0;
BA_DEF_DEF_  "NmJ1939FunctionInstance" 0;
BA_DEF_DEF_  "NmJ1939Function" 0;
BA_DEF_DEF_  "NmJ1939SystemInstance" 0;
BA_DEF_DEF_  "NmJ1939System" 0;
BA_DEF_DEF_  "NmJ1939IndustryGroup" 0;
BA_DEF_DEF_  "NmJ1939AAC" 0;
BA_DEF_DEF_  "NmStationAddress" 254;
BA_DEF_DEF_  "BusType" "";
BA_DEF_DEF_  "ProtocolType" "";
BA_DEF_DEF_  "NodeLayerModules" "";
BA_DEF_DEF_  "SingleFrame" 1;
BA_DEF_DEF_  "ISO11783_6_SpecVersion" "";
BA_DEF_DEF_  "ISO11783_7_SpecVersion" "";
BA_DEF_DEF_  "ISO11783_11_SpecVersion" "";
BA_ "ISO11783_12_SpecVersion" "2006-10-24 DIS";
BA_ "DatabaseVersion" "4.1";
BA_ "ProtocolType" "ISO11783";
BA_ "ISO11783_6_SpecVersion" "2007-02-26 DIS";
BA_ "ISO11783_7_SpecVersion" "2007-03-17 DIS";
BA_ "ISO11783_11_SpecVersion" "2007-01-15 DIS";
BA_ "BusType" "CAN";
BA_ "ISO11783IOPFilename" BU_ QuadAnalogue "ObjectPools/AuxInputQuadAnalogue.iop";
BA_ "ISO11783IOPVersion" BU_ QuadAnalogue 2;
BA_ "ECU" BU_ QuadAnalogue "AuxInputAnalog";
BA_ "NmJ1939IdentityNumber" BU_ QuadAnalogue 701233;
BA_ "NmJ1939ManufacturerCode" BU_ QuadAnalogue 1861;
BA_ "NmJ1939Function" BU_ QuadAnalogue 66;
BA_ "NmJ1939IndustryGroup" BU_ QuadAnalogue 2;
BA_ "NmJ1939AAC" BU_ QuadAnalogue 1;
BA_ "NmStationAddress" BU_ QuadAnalogue 133;
BA_ "NodeLayerModules" BU_ QuadAnalogue "Iso11783_IL.vmodule";
BA_ "NmJ1939FunctionInstance" BU_ QuadBoolNonLatch 3;
BA_ "NmStationAddress" BU_ QuadBoolNonLatch 132;
BA_ "ECU" BU_ QuadBoolNonLatch "AuxInputKeyQuad";
BA_ "NodeLayerModules" BU_ QuadBoolNonLatch "Iso11783_IL.vmodule";
BA_ "NmJ1939Function" BU_ QuadBoolNonLatch 66;
BA_ "NmJ1939ManufacturerCode" BU_ QuadBoolNonLatch 1861;
BA_ "NmJ1939IdentityNumber" BU_ QuadBoolNonLatch 701234;
BA_ "NmJ1939IndustryGroup" BU_ QuadBoolNonLatch 2;
BA_ "NmJ1939AAC" BU_ QuadBoolNonLatch 1;
BA_ "ISO11783IOPFilename" BU_ QuadBoolNonLatch "ObjectPools/AuxInputQuadBoolNonLatch.iop";
BA_ "ISO11783IOPVersion" BU_ QuadBoolNonLatch 2;
BA_ "NodeLayerModules" BU_ Loader "Iso11783_IL.vmodule";
BA_ "NmStationAddress" BU_ Loader 144;
BA_ "NmJ1939AAC" BU_ Loader 1;
BA_ "NmJ1939IndustryGroup" BU_ Loader 2;
BA_ "NmJ1939Function" BU_ Loader 132;
BA_ "NmJ1939ManufacturerCode" BU_ Loader 1861;
BA_ "NmJ1939IdentityNumber" BU_ Loader 701231;
BA_ "ECU" BU_ Loader "Loader";
BA_ "ISO11783IOPVersion" BU_ Loader 2;
BA_ "ISO11783IOPFilename" BU_ Loader "ObjectPools/Loader.iop";
BA_ "NmJ1939IdentityNumber" BU_ VT 1;
BA_ "ECU" BU_ VT "VT";
BA_ "NmJ1939ManufacturerCode" BU_ VT 1861;
BA_ "NmJ1939Function" BU_ VT 29;
BA_ "NmJ1939IndustryGroup" BU_ VT 2;
BA_ "NmJ1939AAC" BU_ VT 1;
BA_ "NmStationAddress" BU_ VT 38;
BA_ "ECU" BU_ Analogue "AuxInputAnalog";
BA_ "NmJ1939IdentityNumber" BU_ Analogue 701231;
BA_ "NmJ1939ManufacturerCode" BU_ Analogue 1861;
BA_ "NmJ1939Function" BU_ Analogue 66;
BA_ "NmJ1939IndustryGroup" BU_ Analogue 2;
BA_ "NmJ1939AAC" BU_ Analogue 1;
BA_ "NmStationAddress" BU_ Analogue 131;
BA_ "NodeLayerModules" BU_ Analogue "Iso11783_IL.vmodule";
BA_ "ISO11783IOPFilename" BU_ Analogue "ObjectPools/AuxInputAnalogue.iop";
BA_ "ISO11783IOPVersion" BU_ Analogue 2;
BA_ "ECU" BU_ BoolLatch "AuxInputKeyLatchable";
BA_ "NmJ1939IdentityNumber" BU_ BoolLatch 701232;
BA_ "NmJ1939ManufacturerCode" BU_ BoolLatch 1861;
BA_ "NmJ1939FunctionInstance" BU_ BoolLatch 2;
BA_ "NmJ1939Function" BU_ BoolLatch 66;
BA_ "NmJ1939IndustryGroup" BU_ BoolLatch 2;
BA_ "NmJ1939AAC" BU_ BoolLatch 1;
BA_ "NmStationAddress" BU_ BoolLatch 129;
BA_ "NodeLayerModules" BU_ BoolLatch "Iso11783_IL.vmodule";
BA_ "ISO11783IOPFilename" BU_ BoolLatch "ObjectPools/AuxInputBoolLatch.iop";
BA_ "ISO11783IOPVersion" BU_ BoolLatch 2;
BA_ "ISO11783IOPVersion" BU_ BoolNonLatch 2;
BA_ "ISO11783IOPFilename" BU_ BoolNonLatch "ObjectPools/AuxInputBoolNonLatch.iop";
BA_ "ECU" BU_ BoolNonLatch "AuxInputKey";
BA_ "NmJ1939IdentityNumber" BU_ BoolNonLatch 701233;
BA_ "NmJ1939ManufacturerCode" BU_ BoolNonLatch 1861;
BA_ "NmJ1939FunctionInstance" BU_ BoolNonLatch 1;
BA_ "NmJ1939Function" BU_ BoolNonLatch 66;
BA_ "NmJ1939IndustryGroup" BU_ BoolNonLatch 2;
BA_ "NmJ1939AAC" BU_ BoolNonLatch 1;
BA_ "NmStationAddress" BU_ BoolNonLatch 130;
BA_ "NodeLayerModules" BU_ BoolNonLatch "Iso11783_IL.vmodule";
BA_ "SigType" SG_ 3221225472 VTFunctionVTtoECU 1;
BA_ "SigType" SG_ 3221225472 KeyActivationCode 1;
BA_ "SigType" SG_ 3221225472 KeyObjectID 1;
BA_ "SigType" SG_ 3221225472 KeyObjectParentID 1;
BA_ "SigType" SG_ 3221225472 SoftKeyCode 1;
BA_ "SigType" SG_ 3221225472 ButtonActivationCode 1;
BA_ "SigType" SG_ 3221225472 ButtonObjectID 1;
BA_ "SigType" SG_ 3221225472 ButtonObjectParentID 1;
BA_ "SigType" SG_ 3221225472 ButtonKeyCode 1;
BA_ "SigType" SG_ 3221225472 XPosition 1;
BA_ "SigType" SG_ 3221225472 YPosition 1;
BA_ "SigType" SG_ 3221225472 VTSelectInputObjectID 1;
BA_ "SigType" SG_ 3221225472 VTSelectInputObjectStatus 1;
BA_ "SigType" SG_ 3221225472 VTSelectInputObjectIsEdited 1;
BA_ "SigType" SG_ 3221225472 VTEscObjectID 1;
BA_ "SigType" SG_ 3221225472 ErrorCodeVTEsc1 4;
BA_ "SigType" SG_ 3221225472 ErrorCodeVTEsc2 4;
BA_ "SigType" SG_ 3221225472 VTChangeNumericValueObjectID 1;
BA_ "SigType" SG_ 3221225472 VTChangeNumericValueValue 1;
BA_ "SigType" SG_ 3221225472 VTChangeActiveMaskObjectID 1;
BA_ "SigType" SG_ 3221225472 ErrorCodeMissingObjects 4;
BA_ "SigType" SG_ 3221225472 ErrorCodeMaskOrChildObjectError 4;
BA_ "SigType" SG_ 3221225472 ErrorCodeAnyOtherError 4;
BA_ "SigType" SG_ 3221225472 ErrorCodePoolDeleted 4;
BA_ "SigType" SG_ 3221225472 VTChangeActiveMaskErrorID 1;
BA_ "SigType" SG_ 3221225472 VTChangeActiveMaskParentID 1;
BA_ "SigType" SG_ 3221225472 VTChangeSoftKeyMaskParentID 1;
BA_ "SigType" SG_ 3221225472 VTChangeSoftKeyMaskObjectID 1;
BA_ "SigType" SG_ 3221225472 ErrorCodeVTChangeSoftKeyMask1 4;
BA_ "SigType" SG_ 3221225472 ErrorCodeVTChangeSoftKeyMask2 4;
BA_ "SigType" SG_ 3221225472 ErrorCodeVTChangeSoftKeyMask3 4;
BA_ "SigType" SG_ 3221225472 ErrorCodeVTChangeSoftKeyMask4 4;
BA_ "SigType" SG_ 3221225472 ErrorCodeVTChangeSoftKeyMask5 4;
BA_ "SigType" SG_ 3221225472 ObjectToChangeStringID 1;
BA_ "SigType" SG_ 3221225472 EnteredStringValue 9;
BA_ "SigType" SG_ 3221225472 ErrorCodeEndOfObjectPool1 4;
BA_ "SigType" SG_ 3221225472 ErrorCodeEndOfObjectPool2 4;
BA_ "SigType" SG_ 3221225472 ErrorCodeEndOfObjectPool3 4;
BA_ "SigType" SG_ 3221225472 ParentObjectIdOfFaultyObject 1;
BA_ "SigType" SG_ 3221225472 ObjectIdOfFaultyObject 1;
BA_ "SigType" SG_ 3221225472 ErrorCodeObjectPool1 4;
BA_ "SigType" SG_ 3221225472 ErrorCodeObjectPool2 4;
BA_ "SigType" SG_ 3221225472 ErrorCodeObjectPool3 4;
BA_ "SigType" SG_ 3221225472 ErrorCodeObjectPool4 4;
BA_ "SigType" SG_ 3221225472 IdentityNumber 1;
BA_ "SigType" SG_ 3221225472 ManufacturerCode 1;
BA_ "SigType" SG_ 3221225472 ECUInstance 4;
BA_ "SigType" SG_ 3221225472 FunctionInstance 1;
BA_ "SigType" SG_ 3221225472 AuxiliaryInputObjectID 1;
BA_ "SigType" SG_ 3221225472 InputObjectId 1;
BA_ "SigType" SG_ 3221225472 Value1 1;
BA_ "SigType" SG_ 3221225472 Function 1;
BA_ "SigType" SG_ 3221225472 DeviceClass 1;
BA_ "SigType" SG_ 3221225472 IndustryGroup 4;
BA_ "SigType" SG_ 3221225472 DeviceClassInstance 4;
BA_ "SigType" SG_ 3221225472 SelfConfigurableAddress 4;
BA_ "SigType" SG_ 3221225472 AuxiliaryFunctionObjectID 1;
BA_ "SigType" SG_ 3221225472 Value2 1;
BA_ "SigType" SG_ 3221225472 InputStatusObjectId 1;
BA_ "SigType" SG_ 3221225472 ObjectEscapeID 1;
BA_ "SigType" SG_ 3221225472 ErrorCodeEscapeObj1 4;
BA_ "SigType" SG_ 3221225472 ErrorCodeEscapeObj2 4;
BA_ "SigType" SG_ 3221225472 ObjectToHideShowID 1;
BA_ "SigType" SG_ 3221225472 ObjectShowStatus 1;
BA_ "SigType" SG_ 3221225472 ErrorCodeHideShowObj1 4;
BA_ "SigType" SG_ 3221225472 ErrorCodeHideShowObj2 4;
BA_ "SigType" SG_ 3221225472 ErrorCodeHideShowObj3 4;
BA_ "SigType" SG_ 3221225472 ObjectToEnableDisableID 1;
BA_ "SigType" SG_ 3221225472 ObjectEnableStatus 1;
BA_ "SigType" SG_ 3221225472 ErrorCodeEnableDisableObj1 4;
BA_ "SigType" SG_ 3221225472 ErrorCodeEnableDisableObj2 4;
BA_ "SigType" SG_ 3221225472 ErrorCodeEnableDisableObj3 4;
BA_ "SigType" SG_ 3221225472 ErrorCodeEnableDisableObj4 4;
BA_ "SigType" SG_ 3221225472 SelectInputObjectID 1;
BA_ "SigType" SG_ 3221225472 ObjectSelectStatus 1;
BA_ "SigType" SG_ 3221225472 ErrorCodeSelectObject1 4;
BA_ "SigType" SG_ 3221225472 ErrorCodeSelectObject2 4;
BA_ "SigType" SG_ 3221225472 ErrorCodeSelectObject3 4;
BA_ "SigType" SG_ 3221225472 ErrorCodeSelectObject4 4;
BA_ "SigType" SG_ 3221225472 ErrorCodeSelectObject5 4;
BA_ "SigType" SG_ 3221225472 ErrorCodeControlAudioDevice1 4;
BA_ "SigType" SG_ 3221225472 ErrorCodeControlAudioDevice2 4;
BA_ "SigType" SG_ 3221225472 ErrorCodeAudioVolume1 4;
BA_ "SigType" SG_ 3221225472 ErrorCodeAudioVolume2 4;
BA_ "SigType" SG_ 3221225472 ParentObjectID3 1;
BA_ "SigType" SG_ 3221225472 ObjectToMoveID 1;
BA_ "SigType" SG_ 3221225472 ErrorCodeChangeChildLocation1 4;
BA_ "SigType" SG_ 3221225472 ErrorCodeChangeChildLocation2 4;
BA_ "SigType" SG_ 3221225472 ErrorCodeChangeChildLocation5 4;
BA_ "SigType" SG_ 3221225472 ObjectToSizeID 1;
BA_ "SigType" SG_ 3221225472 ErrorCodeObjToSize1 4;
BA_ "SigType" SG_ 3221225472 ErrorCodeObjToSize2 4;
BA_ "SigType" SG_ 3221225472 ErrorCodeObjToSize3 4;
BA_ "SigType" SG_ 3221225472 ErrorCodeObjToSize4 4;
BA_ "SigType" SG_ 3221225472 ObjectToChangeColourID 1;
BA_ "SigType" SG_ 3221225472 NewBackgroundColour 1;
BA_ "SigType" SG_ 3221225472 ErrorCodeChangeColour1 4;
BA_ "SigType" SG_ 3221225472 ErrorCodeChangeColour2 4;
BA_ "SigType" SG_ 3221225472 ErrorCodeChangeColour3 4;
BA_ "SigType" SG_ 3221225472 ObjectToChangeNumValueID 1;
BA_ "SigType" SG_ 3221225472 ErrorCodeChangeNumValue1 4;
BA_ "SigType" SG_ 3221225472 ErrorCodeChangeNumValue2 4;
BA_ "SigType" SG_ 3221225472 ErrorCodeChangeNumValue3 4;
BA_ "SigType" SG_ 3221225472 ValueOfTheObject 1;
BA_ "SigType" SG_ 3221225472 ObjectToChangeEndPointID 1;
BA_ "SigType" SG_ 3221225472 ErrorCodeChangeEditPoint1 4;
BA_ "SigType" SG_ 3221225472 ErrorCodeChangeEditPoint2 4;
BA_ "SigType" SG_ 3221225472 ErrorCodeChangeEditPoint3 4;
BA_ "SigType" SG_ 3221225472 ObjectToChangeFontID 1;
BA_ "SigType" SG_ 3221225472 ErrorCodeChangeFont1 4;
BA_ "SigType" SG_ 3221225472 ErrorCodeChangeFont2 4;
BA_ "SigType" SG_ 3221225472 ErrorCodeChangeFont4 4;
BA_ "SigType" SG_ 3221225472 ErrorCodeChangeFont3 4;
BA_ "SigType" SG_ 3221225472 ErrorCodeChangeFont5 4;
BA_ "SigType" SG_ 3221225472 ErrorCodeChangeFont6 4;
BA_ "SigType" SG_ 3221225472 ObjectToChangeLineAttributeID 1;
BA_ "SigType" SG_ 3221225472 ErrorCodeChangeLineAttribute1 4;
BA_ "SigType" SG_ 3221225472 ErrorCodeChangeLineAttribute2 4;
BA_ "SigType" SG_ 3221225472 ErrorCodeChangeLineAttribute3 4;
BA_ "SigType" SG_ 3221225472 ErrorCodeChangeLineAttribute4 4;
BA_ "SigType" SG_ 3221225472 ObjectToChangeFillAttributesID 1;
BA_ "SigType" SG_ 3221225472 ErrorCodeChangeFillAttributes1 4;
BA_ "SigType" SG_ 3221225472 ErrorCodeChangeFillAttributes2 4;
BA_ "SigType" SG_ 3221225472 ErrorCodeChangeFillAttributes3 4;
BA_ "SigType" SG_ 3221225472 ErrorCodeChangeFillAttributes4 4;
BA_ "SigType" SG_ 3221225472 ErrorCodeChangeFillAttributes5 4;
BA_ "SigType" SG_ 3221225472 ActiveMaskObjectID 1;
BA_ "SigType" SG_ 3221225472 ErrorCodeChangeActiveMask1 4;
BA_ "SigType" SG_ 3221225472 ErrorCodeChangeActiveMask2 4;
BA_ "SigType" SG_ 3221225472 ErrorCodeChangeActiveMask3 4;
BA_ "SigType" SG_ 3221225472 ErrorCodeChangeActiveMask4 4;
BA_ "SigType" SG_ 3221225472 ErrorCodeChangeActiveMask5 4;
BA_ "SigType" SG_ 3221225472 DataOrAlarmMaskObjectID 1;
BA_ "SigType" SG_ 3221225472 SoftKeyMaskObjectID 1;
BA_ "SigType" SG_ 3221225472 ErrorCodeChangeSoftKeyMask1 4;
BA_ "SigType" SG_ 3221225472 ErrorCodeChangeSoftKeyMask2 4;
BA_ "SigType" SG_ 3221225472 ErrorCodeChangeSoftKeyMask3 4;
BA_ "SigType" SG_ 3221225472 ErrorCodeChangeSoftKeyMask4 4;
BA_ "SigType" SG_ 3221225472 ErrorCodeChangeSoftKeyMask5 4;
BA_ "SigType" SG_ 3221225472 ObjectToChangeAttributeID 1;
BA_ "SigType" SG_ 3221225472 AttributeID_Change 1;
BA_ "SigType" SG_ 3221225472 ErrorCodeChangeAttribute1 4;
BA_ "SigType" SG_ 3221225472 ErrorCodeChangeAttribute2 4;
BA_ "SigType" SG_ 3221225472 ErrorCodeChangeAttribute3 4;
BA_ "SigType" SG_ 3221225472 ErrorCodeChangeAttribute4 4;
BA_ "SigType" SG_ 3221225472 AlarmMaskObjectID 1;
BA_ "SigType" SG_ 3221225472 NewPriority 1;
BA_ "SigType" SG_ 3221225472 ErrorCodeChangePriority1 4;
BA_ "SigType" SG_ 3221225472 ErrorCodeChangePriority2 4;
BA_ "SigType" SG_ 3221225472 ErrorCodeChangePriority3 4;
BA_ "SigType" SG_ 3221225472 ListInputObjectID 1;
BA_ "SigType" SG_ 3221225472 ListIndex 1;
BA_ "SigType" SG_ 3221225472 NewObjectID 1;
BA_ "SigType" SG_ 3221225472 ErrorCodeChangeListItem1 4;
BA_ "SigType" SG_ 3221225472 ErrorCodeChangeListItem2 4;
BA_ "SigType" SG_ 3221225472 ErrorCodeChangeListItem3 4;
BA_ "SigType" SG_ 3221225472 ErrorCodeChangeListItem4 4;
BA_ "SigType" SG_ 3221225472 ErrorCodeDeleteObjectPool1 4;
BA_ "SigType" SG_ 3221225472 ErrorCodeDeleteObjectPool2 4;
BA_ "SigType" SG_ 3221225472 ObjectToChangeStringValueID 1;
BA_ "SigType" SG_ 3221225472 ErrorCodeChangeStrObjectID 4;
BA_ "SigType" SG_ 3221225472 ErrorCodeChangeStrTooLong 4;
BA_ "SigType" SG_ 3221225472 ErrorCodeChangeStrError 4;
BA_ "SigType" SG_ 3221225472 ErrorCodeChangePosInvalidParent 4;
BA_ "SigType" SG_ 3221225472 ErrorCodeChangePosInvalidObject 4;
BA_ "SigType" SG_ 3221225472 ErrorCodeChangePosInvalidError 4;
BA_ "SigType" SG_ 3221225472 AttributeID 1;
BA_ "SigType" SG_ 3221225472 VersionNumberISO11783Part6 1;
BA_ "SigType" SG_ 3221225472 MemoryStatus 1;
BA_ "SigType" SG_ 3221225472 XDotsForSoftKeyDescriptor 1;
BA_ "SigType" SG_ 3221225472 YDotsForSoftKeyDescriptor 1;
BA_ "SigType" SG_ 3221225472 NumberOfPossibleVirtualSoftKeys 1;
BA_ "SigType" SG_ 3221225472 NumberOfPhysicalSoftKeys 1;
BA_ "SigType" SG_ 3221225472 FontSize_8x8 4;
BA_ "SigType" SG_ 3221225472 FontSize_8x12 4;
BA_ "SigType" SG_ 3221225472 FontSize_12x16 4;
BA_ "SigType" SG_ 3221225472 FontSize_16x16 4;
BA_ "SigType" SG_ 3221225472 FontSize_16x24 4;
BA_ "SigType" SG_ 3221225472 FontSize_24x32 4;
BA_ "SigType" SG_ 3221225472 FontSize_32x32 4;
BA_ "SigType" SG_ 3221225472 FontSize_32x48 4;
BA_ "SigType" SG_ 3221225472 FontSize_48x64 4;
BA_ "SigType" SG_ 3221225472 FontSize_64x64 4;
BA_ "SigType" SG_ 3221225472 FontSize_64x96 4;
BA_ "SigType" SG_ 3221225472 FontSize_96x128 4;
BA_ "SigType" SG_ 3221225472 FontSize_128x128 4;
BA_ "SigType" SG_ 3221225472 FontSize_128x192 4;
BA_ "SigType" SG_ 3221225472 FontType_BoldText 4;
BA_ "SigType" SG_ 3221225472 FontType_CrossedOutText 4;
BA_ "SigType" SG_ 3221225472 FontType_UnderlinedText 4;
BA_ "SigType" SG_ 3221225472 FontType_ItalicsText 4;
BA_ "SigType" SG_ 3221225472 FontType_InvertedText 4;
BA_ "SigType" SG_ 3221225472 FontType_FlashInverted 4;
BA_ "SigType" SG_ 3221225472 FontType_FlashHidden 4;
BA_ "SigType" SG_ 3221225472 FontType_ProportionalFont 4;
BA_ "SigType" SG_ 3221225472 MaxLineWidth 1;
BA_ "SigType" SG_ 3221225472 LineArts 1;
BA_ "SigType" SG_ 3221225472 FillTypes 1;
BA_ "SigType" SG_ 3221225472 ShapeFillTypes 1;
BA_ "SigType" SG_ 3221225472 SupportedGrapicMode 1;
BA_ "SigType" SG_ 3221225472 Hardware1 4;
BA_ "SigType" SG_ 3221225472 Hardware2 4;
BA_ "SigType" SG_ 3221225472 Hardware3 4;
BA_ "SigType" SG_ 3221225472 Hardware4 4;
BA_ "SigType" SG_ 3221225472 NrOfXPixelsInDataAreaMask 1;
BA_ "SigType" SG_ 3221225472 NrOfYPixelsInDataAreaMask 1;
BA_ "SigType" SG_ 3221225472 AcknowledgmentStoreVersion 4;
BA_ "SigType" SG_ 3221225472 AcknowledgmentLoadVersion 4;
BA_ "SigType" SG_ 3221225472 AcknowledgmentDeleteVersion 4;
BA_ "SigType" SG_ 3221225472 NrOfVersionStrings 1;
BA_ "SigType" SG_ 3221225472 VersionLables 3;
BA_ "SigType" SG_ 3221225472 ParentObjectID 1;
BA_ "SigType" SG_ 3221225472 ObjectIDOfFaultyObject 1;
BA_ "SigType" SG_ 3221225472 ErrorCodeVtObjPoolError1 4;
BA_ "SigType" SG_ 3221225472 ErrorCodeVtObjPoolError2 4;
BA_ "SigType" SG_ 3221225472 ErrorCodeVtObjPoolError3 4;
BA_ "SigType" SG_ 3221225472 ErrorCodeVtObjPoolError4 4;
BA_ "SigType" SG_ 3221225472 SourceAdressOfActiveWSM 1;
BA_ "SigType" SG_ 3221225472 VisibleDataOrAlarmMaskObjectID 1;
BA_ "SigType" SG_ 3221225472 VisibleSoftKeyMaskObjectID 1;
BA_ "SigType" SG_ 3221225472 VTBusyCode1 4;
BA_ "SigType" SG_ 3221225472 VTBusyCode2 4;
BA_ "SigType" SG_ 3221225472 VTBusyCode3 4;
BA_ "SigType" SG_ 3221225472 VTBusyCode4 4;
BA_ "SigType" SG_ 3221225472 VTBusyCode5 4;
BA_ "SigType" SG_ 3221225472 VTBusyCode8 4;
BA_ "SigType" SG_ 3221225472 VTFunctionCode 1;
VAL_ 3221225472 VTFunctionVTtoECU 36 "AuxiliaryAssignmentCommandType2" 38 "AuxiliaryInputStatusType2" 193 "GetSupported WideCharsResponse" 37 "AuxiliaryInputStatusEnableCommand" 190 "ExecuteMacroResponse" 189 "LockUnlockMaskResponse" 35 "AuxiliaryInputMaintenance" 10 "VTControlAudioDeviceTermination" 9 "DisplayActivation" 186 "SelectColourMapResponse" 185 "GetAttributeValueResponse" 184 "GraphicsContextCommandResponse" 183 "ChangePolygonScaleResponse" 182 "ChangePolygonPointResponse" 181 "SetObjectLabelResponse" 0 "SoftKeyActivation" 1 "ButtonActivation" 2 "PointingEvent" 18 "EndOfObjectPoolResponse" 32 "AuxiliaryAssignmentCommand" 146 "ESCResponse" 160 "ShowHideObjectResponse" 161 "EnableDisableObjectResponse" 162 "SelectInputObjectResponse" 163 "ControlAudioDeviceResponse" 164 "SetAudioVolumeResponse" 165 "ChangeChildLocationResponse" 166 "ChangeSizeResponse" 167 "ChangeBackgroundColourResponse" 168 "ChangeNumericValueResponse" 169 "ChangeEndPointResponse" 170 "ChangeFontAttributesResponse" 171 "ChangeLineAttributesResponse" 172 "ChangeFillAttributesResponse" 173 "ChangeActiveMaskResponse" 174 "ChangeSoftKeyMaskResponse" 175 "ChangeAttributeResponse" 176 "ChangePriorityResponse" 177 "ChangeListItemResponse" 178 "DeleteObjectPoolResponse" 192 "GetMemoryResponse" 194 "GetNumberOfSoftKeysResponse" 195 "GetTextFontDataResponse" 199 "GetHardwareResponse" 208 "StoreVersionResponse" 209 "LoadVersionResponse" 210 "DeleteVersionResponse" 224 "GetVersionsResponse" 254 "VTStatusMessage" 33 "AuxiliaryInputStatus" 3 "VTSelectInputObject" 4 "VTESC" 5 "VTChangeNumericValue" 6 "VTChangeActiveMask" 7 "VTChangeSoftKeyMask" 8 "InputStringValue" 196 "GetFillAndLineDataResponse" 240 "VTObjectPoolErrorMessage" 179 "ChangeStringValueResponse" 180 "ChangeChildPositionResponse" 34 "AuxiliaryPreferredAssignmentResponse" ;
VAL_ 3221225472 KeyActivationCode 3 "KeyPressAborted" 0 "KeyHasBeenReleased" 1 "KeyHasBeenPressed" 2 "KeyIsStillPressed" ;
VAL_ 3221225472 KeyObjectID 0 "KeyHasBeenReleased" 1 "KeyHasBeenPressed" 2 "KeyIsStillPressed" ;
VAL_ 3221225472 KeyObjectParentID 0 "KeyHasBeenReleased" 1 "KeyHasBeenPressed" 2 "KeyIsStillPressed" ;
VAL_ 3221225472 SoftKeyCode 0 "AlarmACK" ;
VAL_ 3221225472 ButtonActivationCode 3 "ButtonPressAborted" 0 "ButtonHasBeenUnlatched" 1 "ButtonHasBeenLatched" 2 "ButtonIsStillHeld" ;
VAL_ 3221225472 TouchState 255 "Pressed" 2 "Held" 1 "Pressed" 0 "Released" ;
VAL_ 3221225472 VTSelectInputObjectStatus 0 "ObjectIsDeselected" 1 "ObjectIsSelected" ;
VAL_ 3221225472 VTSelectInputObjectIsEdited 0 "ObjectIsNotEdited" 1 "ObjectIsOpenForEditing" ;
VAL_ 3221225472 ErrorCodeVTEsc1 0 "NoError" 1 "NoInputFieldSelected ESC_Ignored" ;
VAL_ 3221225472 ErrorCodeVTEsc2 0 "NoError" 1 "GeneralError" ;
VAL_ 3221225472 ErrorCodeMissingObjects 0 "NoErrors" 1 "MissingObjects" ;
VAL_ 3221225472 ErrorCodeMaskOrChildObjectError 0 "NoErrors" 1 "MaskOrChildObjectHasErrors" ;
VAL_ 3221225472 ErrorCodeAnyOtherError 0 "NoErrors" 1 "GeneralError" ;
VAL_ 3221225472 ErrorCodePoolDeleted 0 "NoErrors" 1 "PoolBeingDeleted" ;
VAL_ 3221225472 ErrorCodeVTChangeSoftKeyMask1 0 "NoError" 1 "InvalidDataOrAlarmMaskObjectID" ;
VAL_ 3221225472 ErrorCodeVTChangeSoftKeyMask2 0 "NoError" 1 "InvalidSoftKeyMaskObjectID" ;
VAL_ 3221225472 ErrorCodeVTChangeSoftKeyMask3 0 "NoError" 1 "MissingObjects" ;
VAL_ 3221225472 ErrorCodeVTChangeSoftKeyMask4 0 "NoError" 1 "MaskOrChildObjectHasErrors" ;
VAL_ 3221225472 ErrorCodeVTChangeSoftKeyMask5 0 "NoError" 1 "GeneralError" ;
VAL_ 3221225472 ErrorCodeEndOfObjectPool1 1 "ErrorsInTheObjectPool" 0 "NoErrors" ;
VAL_ 3221225472 ErrorCodeEndOfObjectPool2 0 "NoErrors" 1 "VTRanOutOfMemoryDuringTransfer" ;
VAL_ 3221225472 ErrorCodeEndOfObjectPool3 0 "NoErrors" 1 "GeneralError" ;
VAL_ 3221225472 ErrorCodeObjectPool1 0 "NoErrors" 1 "MethodOrAttributeNotSupportedByV" ;
VAL_ 3221225472 ErrorCodeObjectPool2 0 "NoErrors" 1 "UnknownObjectReference" ;
VAL_ 3221225472 ErrorCodeObjectPool3 0 "NoErrors" 1 "GeneralError" ;
VAL_ 3221225472 ErrorCodeObjectPool4 0 "NoErrors" 1 "ObjectPoolWasDeletedFromVolatile" ;
VAL_ 3221225472 ManufacturerCode 1863 "Thomas G. Faria Co." 1862 "Sanshin" 1861 "Vector North America" 1860 "MMP" 1859 "Kvasar AB" 1858 "Litton" 1857 "Simrad" 1856 "Trimble" 1855 "Furuno USA" 1854 "Northstar Technologies" 1853 "Japan Radio Co." 1852 "Navionics" 1851 "Raymarine" 1850 "Teleflex" 222 "Generac Power Systems, Inc." 221 "SiE" 220 "Beede Electrical Instrument Company, Inc." 219 "Cat OEM Solutions" 218 "Gits Manufacturing Company" 217 "RM Michaelides Software & Elektronik GmbH" 216 "Paneltronics Inc." 215 "Aetna Engineering/Fireboy-Xintex" 214 "MC elettronica Srl" 213 "CNH Belgium N.V." 212 "Sure Power Industries, Inc." 211 "DNA Group" 210 "Iteris, Inc." 209 "Bell Equip. Co. SA (PTY) LTD" 208 "Drew Technologies, Inc." 207 "Otto Engineering" 206 "port GmbH" 205 "SmarTire Systems Inc" 204 "The Morey Corporation" 203 "MILtronik GmbH" 202 "Curtis Instruments, Inc." 201 "Disenos y Tecnologia S.A." 200 "MGM Brakes" 199 "Actia Corp." 198 "Mystic Valley Communications" 197 "Mechron Power Systems" 196 "LEMKEN GmbH & Co. KG" 195 "General Engine Products" 194 "TriMark Corporation" 193 "Jeppesen Marine" 192 "Floscan" 191 "XATA Corporation" 190 "Hella KGaA Hueck & Co." 189 "QUALCOMM" 188 "EMP Corp." 187 "Air-Weigh" 186 "Altronic, Inc." 185 "Beede Electrical Instrument Company" 184 "EIA Electronics" 183 "KDS Controls, Inc." 182 "Vehicle Systems Engineering B.V." 181 "Coretronics, Inc." 180 "Smart Power Systems" 179 "Midwest Technologies Illinois, LLC" 178 "Siemens VDO Automotive AG" 177 "Diagnostic System Associates" 176 "Moritz Aerospace" 175 "Veris Technologies, Inc." 174 "AB Volvo Penta" 173 "Ryeso, Inc." 172 "Yanmar Marine USA" 171 "Wachendorff Elektronik GmbH & Co. KG" 170 "Computronics Corporation Ltd." 169 "Marlin Technologies Inc." 168 "Xantrex" 167 "JLG Industries Inc." 166 "Phoenix International" 165 "CPAC Systems AB" 164 "DaimlerChrysler Off-Highway" 163 "BRP Inc." 162 "Axiomatic Technologies" 161 "Offshore Systems (UK) Limited" 160 "Nido" 159 "NTech Industries Inc." 158 "Firestone Industrial Products Company" 157 "ISSPRO Inc." 156 "ITT Industries - Cannon" 155 "Vetronix Corporation" 154 "Westerbeke Corporation" 153 "Woodward, Industrial Controls Division" 152 "Elobau Elektrobauelemente GmbH & Co. KG" 151 "Raven Industries Inc. - Flow Controls Division" 150 "Fleetguard" 149 "Holset" 148 "Blue Water Data, Inc." 147 "Nautibus Electronic GmbH" 146 "Maxima Technologies" 145 "MurCal Controls" 144 "Mercury Marine" 143 "W. Gmeiner GmbH & Co." 142 "TRW Automotive (Commercial Steering Systems)" 141 "Thales Navigation Ltd." 140 "Lowrance Electronics, Inc." 139 "Caterpillar Trimble Control Technologies (CTCT), LLC" 138 "Georg Fritzmeier GmbH & Co. KG" 137 "Maretron" 136 "Komatsu Ltd." 135 "Airmar Technology Corporation" 134 "Iris Technology Ltd." 133 "Bucher Schoerling GmbH" 132 "Mulag-Fahrzeugwerk" 131 "ITT Industries" 130 "Nido - Universal Machines B.V." 129 "OMNEX Control Systems, Inc." 128 "Gerhard Duecker GmbH & Co. KG" 127 "Holland USA" 126 "Driver Tech" 125 "Nevada Automotive Test Center" 124 "Hydac Electronic" 123 "Basler Electric" 122 "FG Wilson (Engineering) Limited" 121 "HED (Hydro Electronic Devices, Inc.)" 120 "RDS Technology Ltd." 119 "IntegriNautics" 118 "Intron GmbH" 117 "HUSCO International" 116 "BEELINE Technologies" 115 "NACCO Materials Handling Group, Inc." 114 "EControls, Inc." 113 "Stress-Tek, Inc." 112 "MECALAC" 111 "Maschinenfabrik Bernhard Krone GmbH" 110 "EPIQ Sensor-Nite" 109 "LH Technologies ApS" 108 "WTK-Elecktronik GmbH" 107 "Grimme Landmaschinen GmbH & Co. KG" 106 "BAE Systems Controls, Inc." 105 "Kiepe Elektrik GmbH & Co. KG" 104 "Claas Selbstfahrende Erntemaschinen GmbH" 103 "Agrocom GmbH & Co. Agrarsystem KG" 102 "AGCO GmbH & Co." 101 "Sensoria" 100 "VDO Technik AG" 99 "International Transmissions Ltd (ITL)" 98 "Mueller-Elektronik GmbH & Co." 97 "Ag Leader Technology, Inc." 96 "Mech@tronic IT GmbH" 95 "Pacific Insight Electronics Corp." 94 "CNH Global N.V." 93 "Perkins Engines Company Ltd." 92 "Ag-Chem Equipment Co., Inc." 91 "BSG Bodensee Steuergeraete GmbH" 90 "Knorr-Bremse SfN GmbH" 89 "Kverneland Group, Electronics Division" 88 "Satloc Precision GPS" 87 "J.C. Bamford Excavators Ltd (JCB)" 86 "C.E. Niehoff & Company" 85 "Kohler Co." 84 "New Holland UK Limited" 83 "Eaton VORAD Technologies" 82 "Bobcat/Ingersoll-Rand" 81 "Fire Research Corp" 80 "Twin Disc, Inc." 79 "Daimler Benz AG - Engine Division (PBM)" 78 "Frank W. Murphy Manufacturing, Inc." 77 "Deere Power Systems Group" 76 "unused" 75 "Deere & Co. Agricultural Division" 74 "Eaton Axle-Brake Division" 73 "LeTourneau, Inc." 72 "Sisu Corporation" 71 "Vansco Electronics Ltd." 70 "Flex-Coil Limited" 69 "Trimble Navigation" 68 "Scania" 67 "Funk Manufacturing Company" 66 "John Deere Construction Equipment Division" 65 "MAN Nutzfahrzeuge AG" 64 "unused" 63 "ZF Industries Inc." 62 "Wabco" 61 "Volvo Truck Corp." 60 "Volvo Trucks North America Inc." 59 "VES Inc." 58 "SPX Corporation, OTC Division" 57 "Sauer-Danfoss Co." 56 "SAIC" 55 "Ryder System Inc." 54 "Meritor Wabco" 53 "Rockwell Land Transportation" 52 "Meritor Automotive, Inc." 51 "Robert Bosch GmbH" 50 "Robert Bosch Corp" 49 "RE America Inc." 48 "Pollak Alphabet" 47 "Phillips Semiconductor" 46 "Parasoft Computing Solutions" 45 "PACCAR" 44 "Nippondenso Co. Ltd." 43 "International Truck and Engine Corp. Vehicle Electronics" 42 "International Truck and Engine Corp. Engine Electronics" 41 "Motorola Inc." 40 "Motorola AIEG Inc." 39 "Microfirm Inc." 38 "Micro Processor Systems Inc." 37 "Mack Trucks Inc." 36 "Lucas Ltd." 35 "Kenworth Truck Co." 34 "Kelsey Hayes Co." 33 "John Deere" 32 "Jacobs Vehicle Systems" 31 "J Pollak Corp." 30 "Isuzu Motors Ltd." 29 "Hino Motors Ltd." 28 "Grote Ind. Inc." 27 "GMC" 26 "General Motors Corp., Service Technology Group" 25 "Freightliner LLC" 24 "Ford Motor Co., Vehicle Controls" 23 "Ford Motor Co., Heavy Truck" 22 "Ford Motor Co., Electronic Concepts $ Systems" 21 "Echilin Inc., Midland Brake Inc." 20 "Eaton Ltd" 19 "Eaton Corp. Trucking Info Services" 18 "Eaton Corp, Transmission Division" 17 "Eaton Corp. Res & Dev" 16 "Eaton Corp." 15 "Dickey-John Corp." 14 "Detroit Diesel Corporation" 13 "Delco Electronics" 12 "Deere & Company, Precision Farming" 11 "Dearborn Group Inc." 10 "Cummins Engine Co." 9 "Chrysler Corp." 8 "Caterpillar Inc." 7 "Case Corp." 6 "Berifors Electronics AB" 5 "AMP Inc." 4 "Ametek-Dixson" 3 "Ametek, US Gauge Division" 2 "Allison Transmission, GMC" 1 "Allied Signal Inc." 0 "Reserved" ;
VAL_ 3221225472 Function 127 "Reserved" 126 "Reserved" 125 "Reserved" 124 "Reserved" 123 "Reserved" 122 "Reserved" 121 "Reserved" 120 "Reserved" 119 "Reserved" 118 "Reserved" 117 "Reserved" 116 "Reserved" 115 "Reserved" 114 "Reserved" 113 "Reserved" 112 "Reserved" 111 "Reserved" 110 "Reserved" 109 "Reserved" 108 "Reserved" 107 "Reserved" 106 "Reserved" 105 "Reserved" 104 "Reserved" 103 "Reserved" 102 "Reserved" 101 "Reserved" 42 "Water Pump Control" 41 "Lighting - Operator Controls" 40 "Seat Control" 39 "Ignition Control Module" 38 "Tire Pressure Control" 37 "Cab Controller" 36 "Pneumatic - System Controller" 35 "Suspension - System Controller" 34 "Hydraulic Pump Controller" 33 "System Monitor" 32 "Headway Controller" 31 "Propulsion Battery Charger" 30 "Management Computer" 29 "Virtual Terminal (In Cab)" 28 "Off Vehicle Gateway" 27 "Power TakeOff (Secondary or Front)" 26 "Body Controller" 25 "Network Interconnect ECU" 24 "Vehicle Security" 23 "Vehicle Navigation" 22 "Aerodynamic Control" 21 "Cab Climate Control" 20 "Trip Recorder" 19 "Instrument Cluster" 18 "Suspension - Drive Axle" 17 "Suspension - Steer Axle" 16 "Steeting Controller" 15 "Fuel System" 14 "Cruise Control" 13 "Retarder - Driveline" 12 "Retarder - Engine" 11 "Brakes - Drive Axle" 10 "Brakes - Steer Axle" 9 "Brakes - System Controller" 8 "Axle - Drive" 7 "Axle - Steering" 6 "Power TakeOff - (Main or Rear)" 5 "Shift Control/Console" 4 "Battery Pack Monitor" 3 "Transmission" 2 "Electric Propulsion Control" 1 "Auxiliary Power Unit (APU)" 0 "Engine" 100 "Reserved" 99 "Reserved" 98 "Reserved" 97 "Reserved" 96 "Reserved" 95 "Reserved" 94 "Reserved" 93 "Reserved" 92 "Reserved" 91 "Reserved" 90 "Reserved" 89 "Reserved" 88 "Reserved" 87 "Reserved" 86 "Reserved" 85 "Reserved" 84 "Reserved" 83 "Reserved" 82 "Reserved" 81 "Reserved" 80 "Reserved" 79 "Reserved" 78 "Reserved" 77 "Reserved" 76 "Reserved" 75 "Reserved" 74 "Reserved" 73 "Reserved" 72 "Coolant Valve Controller" 71 "Transfer Case Control" 70 "Auxiliary Regeneration Device" 69 "Engine Emission Aftertreatement System" 68 "Aftertreatment system gas measurement" 67 "Electrical System Controller" 66 "I/O Controller" 65 "Gas Flow Measurement" 64 "Endurance Braking" 63 "Engine Valve Controller" 62 "On-Board Diagnostic Unit" 61 "File Server/Printer" 60 "Cab Display" 59 "Starter" 58 "Fan Drive Control" 57 "Steering Column Unit" 56 "Communications Unit, Radio" 55 "Communications Unit, Satellite" 54 "Communications Unit, Cellular" 53 "Alternator/Charging System" 52 "Chassis Controller" 51 "Forward-Looking Collision Warning System" 50 "Auxiliary Heater" 49 "Clutch/Converter Control" 48 "Ramp Control" 47 "Information System Controller" 46 "Oil Sensor Unit" 45 "Vehicle Dynamic Stability Control" 44 "Exhaust Emission Control" 43 "Transmission Display" ;
VAL_ 3221225472 IndustryGroup 0 "Global" 1 "OnHighway" 2 "AgriculturalAndForestry" 3 "Construction" 4 "Marine" 5 "Reserved" 7 "NotAvailable" ;
VAL_ 3221225472 AuxPreferredAssignmentRespError1 1 "AuxiliaryInputUnit(s)NotValid" 0 "NoErrors" ;
VAL_ 3221225472 AuxPreferredAssignmentRespError2 1 "FunctionObjectID(s)NotValid" 0 "NoErrors" ;
VAL_ 3221225472 AuxPreferredAssignmentRespError3 1 "InputObjectID(s)NotValid" 0 "NoErrors" ;
VAL_ 3221225472 AuxPreferredAssignmentRespError4 1 "GeneralError" 0 "NoErrors" ;
VAL_ 3221225472 ErrorCodeEscapeObj1 0 "NoErrors" 1 "NoInputFieldSelected" ;
VAL_ 3221225472 ErrorCodeEscapeObj2 0 "NoErrors" 1 "GeneralError" ;
VAL_ 3221225472 ObjectShowStatus 0 "ObjectIsHidden" 1 "ObjectIsShown" ;
VAL_ 3221225472 ErrorCodeHideShowObj1 0 "NoErrors" 1 "ReferencesToMissingObjects" ;
VAL_ 3221225472 ErrorCodeHideShowObj2 0 "NoErrors" 1 "InvalidObjectID" ;
VAL_ 3221225472 ErrorCodeHideShowObj3 0 "NoErrors" 1 "GeneralError" ;
VAL_ 3221225472 ObjectEnableStatus 0 "ObjectIsDisabled" 1 "ObjectIsEnabled" ;
VAL_ 3221225472 ErrorCodeEnableDisableObj1 0 "NoErrors" 1 "InvalidObjectID" ;
VAL_ 3221225472 ErrorCodeEnableDisableObj2 0 "NoErrors" 1 "CommandError" ;
VAL_ 3221225472 ErrorCodeEnableDisableObj3 1 "Could not complete. Operator inp" 0 "NoErrors" ;
VAL_ 3221225472 ErrorCodeEnableDisableObj4 0 "NoErrors" 1 "GeneralError" ;
VAL_ 3221225472 ObjectSelectStatus 2 "ObjectIsOpenedForEdit" 0 "ObjectIsDeselectedOrObjectIDIsNullObject" 1 "ObjectIsSelected" ;
VAL_ 3221225472 ErrorCodeSelectObject1 1 "ObjectIsDisabled" 0 "NoErrors" ;
VAL_ 3221225472 ErrorCodeSelectObject2 0 "NoErrors" 1 "InvalidObjectID" ;
VAL_ 3221225472 ErrorCodeSelectObject3 0 "NoErrors" 1 "ObjectIsNotVisible" ;
VAL_ 3221225472 ErrorCodeSelectObject4 0 "NoErrors" 1 "CouldNotComplete" ;
VAL_ 3221225472 ErrorCodeSelectObject5 0 "NoErrors" 1 "GeneralError" ;
VAL_ 3221225472 ErrorCodeControlAudioDevice1 0 "NoErrors" 1 "AudioDeviceIsBusy" ;
VAL_ 3221225472 ErrorCodeControlAudioDevice2 0 "NoErrors" 1 "GeneralError" ;
VAL_ 3221225472 ErrorCodeAudioVolume1 0 "NoErrors" 1 "AudioDeviceIsBusy" ;
VAL_ 3221225472 ErrorCodeAudioVolume2 0 "NoErrors" 1 "GeneralError" ;
VAL_ 3221225472 ErrorCodeChangeChildLocation1 0 "NoErrors" 1 "InvalidParentObjectID" ;
VAL_ 3221225472 ErrorCodeChangeChildLocation2 0 "NoErrors" 1 "InvalidObjectID" ;
VAL_ 3221225472 ErrorCodeChangeChildLocation5 0 "NoErrors" 1 "GeneralError" ;
VAL_ 3221225472 ErrorCodeObjToSize1 0 "NoErrors" 1 "InvalidObjectID" ;
VAL_ 3221225472 ErrorCodeObjToSize2 0 "NoErrors" 1 "InvalidWidth" ;
VAL_ 3221225472 ErrorCodeObjToSize3 0 "NoErrors" 1 "InvalidHeight" ;
VAL_ 3221225472 ErrorCodeObjToSize4 0 "NoErrors" 1 "GeneralError" ;
VAL_ 3221225472 ErrorCodeChangeColour1 0 "NoErrors" 1 "InvalidObjectID" ;
VAL_ 3221225472 ErrorCodeChangeColour2 0 "NoErrors" 1 "InvalidColourCode" ;
VAL_ 3221225472 ErrorCodeChangeColour3 0 "NoErrors" 1 "GeneralError" ;
VAL_ 3221225472 ErrorCodeChangeNumValue1 0 "NoErrors" 1 "InvalidObjectID" ;
VAL_ 3221225472 ErrorCodeChangeNumValue2 0 "NoErrors" 1 "InvalidValue" ;
VAL_ 3221225472 ErrorCodeChangeNumValue3 0 "NoErrors" 1 "GeneralError" ;
VAL_ 3221225472 ErrorCodeChangeEditPoint1 0 "NoErrors" 1 "InvalidObjectID" ;
VAL_ 3221225472 ErrorCodeChangeEditPoint2 0 "NoErrors" 1 "InvalidLineDirection" ;
VAL_ 3221225472 ErrorCodeChangeEditPoint3 0 "NoErrors" 1 "GeneralError" ;
VAL_ 3221225472 ErrorCodeChangeFont1 0 "NoErrors" 1 "InvalidObjectID" ;
VAL_ 3221225472 ErrorCodeChangeFont2 0 "NoErrors" 1 "InvalidColour" ;
VAL_ 3221225472 ErrorCodeChangeFont4 0 "NoErrors" 1 "InvalidType" ;
VAL_ 3221225472 ErrorCodeChangeFont3 0 "NoErrors" 1 "InvalidSize" ;
VAL_ 3221225472 ErrorCodeChangeFont5 0 "NoErrors" 1 "InvalidStyle" ;
VAL_ 3221225472 ErrorCodeChangeFont6 0 "NoErrors" 1 "GeneralError" ;
VAL_ 3221225472 ErrorCodeChangeLineAttribute1 0 "NoErrors" 1 "InvalidObjectID" ;
VAL_ 3221225472 ErrorCodeChangeLineAttribute2 0 "NoErrors" 1 "InvalidObjectColour" ;
VAL_ 3221225472 ErrorCodeChangeLineAttribute3 0 "NoErrors" 1 "InvalidWidth" ;
VAL_ 3221225472 ErrorCodeChangeLineAttribute4 0 "NoErrors" 1 "GeneralError" ;
VAL_ 3221225472 ErrorCodeChangeFillAttributes1 0 "NoErrors" 1 "InvalidObjectID" ;
VAL_ 3221225472 ErrorCodeChangeFillAttributes2 0 "NoErrors" 1 "InvalidType" ;
VAL_ 3221225472 ErrorCodeChangeFillAttributes3 0 "NoErrors" 1 "InvalidColour" ;
VAL_ 3221225472 ErrorCodeChangeFillAttributes4 0 "NoErrors" 1 "InvalidPatternObjectID" ;
VAL_ 3221225472 ErrorCodeChangeFillAttributes5 0 "NoErrors" 1 "GeneralError" ;
VAL_ 3221225472 ErrorCodeChangeActiveMask1 0 "NoErrors" 1 "InvalidWorkingSetObject" ;
VAL_ 3221225472 ErrorCodeChangeActiveMask2 0 "NoErrors" 1 "InvalidMaskObjectID" ;
VAL_ 3221225472 ErrorCodeChangeActiveMask3 0 "NoErrors" 1 "MissingObjects" ;
VAL_ 3221225472 ErrorCodeChangeActiveMask4 0 "NoErrors" 1 "MaskOrChildObjectHasErrors" ;
VAL_ 3221225472 ErrorCodeChangeActiveMask5 0 "NoErrors" 1 "GeneralError" ;
VAL_ 3221225472 ErrorCodeChangeSoftKeyMask1 0 "NoErrors" 1 "InvalidDataOrAlarmMaskObjectID" ;
VAL_ 3221225472 ErrorCodeChangeSoftKeyMask2 0 "NoErrors" 1 "InvalidSoftKeyMaskObjectID" ;
VAL_ 3221225472 ErrorCodeChangeSoftKeyMask3 0 "NoErrors" 1 "Missing Objects" ;
VAL_ 3221225472 ErrorCodeChangeSoftKeyMask4 0 "NoErrors" 1 "Mask or child object has errors" ;
VAL_ 3221225472 ErrorCodeChangeSoftKeyMask5 0 "NoErrors" 1 "GeneralError" ;
VAL_ 3221225472 ErrorCodeChangeAttribute1 0 "NoErrors" 1 "InvalidObjectID" ;
VAL_ 3221225472 ErrorCodeChangeAttribute2 0 "NoErrors" 1 "InvalidAttributeID" ;
VAL_ 3221225472 ErrorCodeChangeAttribute3 0 "NoErrors" 1 "InvalidValue" ;
VAL_ 3221225472 ErrorCodeChangeAttribute4 0 "NoErrors" 1 "GeneralError" ;
VAL_ 3221225472 ErrorCodeChangePriority1 0 "NoErrors" 1 "InvalidObjectID" ;
VAL_ 3221225472 ErrorCodeChangePriority2 0 "NoErrors" 1 "InvalidPriority" ;
VAL_ 3221225472 ErrorCodeChangePriority3 0 "NoErrors" 1 "GeneralError" ;
VAL_ 3221225472 ErrorCodeChangeListItem1 0 "NoErrors" 1 "InvalidListObjectID" ;
VAL_ 3221225472 ErrorCodeChangeListItem2 0 "NoErrors" 1 "InvalidListIndex" ;
VAL_ 3221225472 ErrorCodeChangeListItem3 0 "NoErrors" 1 "InvalidNewListItemObjectID" ;
VAL_ 3221225472 ErrorCodeChangeListItem4 0 "NoErrors" 1 "GeneralError" ;
VAL_ 3221225472 ErrorCodeDeleteObjectPool1 0 "NoErrors" 1 "DeletionError" ;
VAL_ 3221225472 ErrorCodeDeleteObjectPool2 0 "NoErrors" 1 "GeneralError" ;
VAL_ 3221225472 ErrorCodeChangeStrObjectID 0 "NoErrors" 1 "InvalidObjectID" ;
VAL_ 3221225472 ErrorCodeChangeStrTooLong 0 "NoErrors" 1 "StringTooLong" ;
VAL_ 3221225472 ErrorCodeChangeStrError 0 "NoErrors" 1 "GeneralError" ;
VAL_ 3221225472 ErrorCodeChangePosInvalidParent 0 "NoErrors" 1 "InvalidParentObjectID" ;
VAL_ 3221225472 ErrorCodeChangePosInvalidObject 0 "NoErrors" 1 "InvalidObjectID" ;
VAL_ 3221225472 ErrorCodeChangePosInvalidError 0 "NoErrors" 1 "GeneralError" ;
VAL_ 3221225472 ErrorCodeSetObjectLabel1 1 "InvalidObjectId" 0 "NoError" ;
VAL_ 3221225472 ErrorCodeSetObjectLabel2 1 "InvalidStringVariableObjectId" 0 "NoError" ;
VAL_ 3221225472 ErrorCodeSetObjectLabel3 1 "InvalidFontType" 0 "NoError" ;
VAL_ 3221225472 ErrorCodeSetObjectLabel4 1 "InvalidDesignatorObjectReference" 0 "NoError" ;
VAL_ 3221225472 ErrorCodeSetObjectLabel5 1 "DesignatorReferencesInvalidObjects" 0 "NoError" ;
VAL_ 3221225472 ErrorCodeSetObjectLabel6 1 "GeneralError" 0 "NoError" ;
VAL_ 3221225472 ErrorCodeChangePoygonPoint1 1 "InvalidObjectId" 0 "NoError" ;
VAL_ 3221225472 ErrorCodeChangePoygonPoint2 1 "InvalidPointIndex" 0 "NoError" ;
VAL_ 3221225472 ErrorCodeChangePoygonPoint3 1 "GeneralError" 0 "NoError" ;
VAL_ 3221225472 ErrorCodeChangePolygonScale1 1 "InvalidObjectId" 0 "NoError" ;
VAL_ 3221225472 ErrorCodeChangePolygonScale5 1 "GeneralError" 0 "NoError" ;
VAL_ 3221225472 ErrorCodeGraphicsContextCmd1 1 "InvalidObjectID" 0 "NoError" ;
VAL_ 3221225472 ErrorCodeGraphicsContextCmd2 1 "InvalidCommandID" 0 "NoError" ;
VAL_ 3221225472 ErrorCodeGraphicsContextCmd3 1 "InvalidParameter" 0 "NoError" ;
VAL_ 3221225472 ErrorCodeGraphicsContextCmd4 1 "CommandWillProduceInvalidResults" 0 "NoError" ;
VAL_ 3221225472 ErrorCodeGraphicsContextCmd5 1 "GeneralError" 0 "NoError" ;
VAL_ 3221225472 ErrorCodeSelectColourMap2 1 "GeneralError" 0 "NoError" ;
VAL_ 3221225472 ErrorCodeSelectColourMap1 1 "InvalidObjectID" 0 "NoError" ;
VAL_ 3221225472 ErrorCodeLockUnlockMask9 1 "GeneralError" 0 "NoError" ;
VAL_ 3221225472 ErrorCodeLockUnlockMask8 1 "UnsolicitedUnlock_OperatorInduced" 0 "NoError" ;
VAL_ 3221225472 ErrorCodeLockUnlockMask7 1 "UnsolicitedUnlock_MaskChanged" 0 "NoError" ;
VAL_ 3221225472 ErrorCodeLockUnlockMask6 1 "UnsolicitedUnlock_TimeoutOccured" 0 "NoError" ;
VAL_ 3221225472 ErrorCodeLockUnlockMask5 1 "AlarmMaskIsActive" 0 "NoError" ;
VAL_ 3221225472 ErrorCodeLockUnlockMask4 1 "MaskNotLocked" 0 "NoError" ;
VAL_ 3221225472 ErrorCodeLockUnlockMask3 1 "MaskAlreadyLocked" 0 "NoError" ;
VAL_ 3221225472 ErrorCodeLockUnlockMask2 1 "MaskNotVisibleOrInvalidObjectId" 0 "NoError" ;
VAL_ 3221225472 ErrorCodeLockUnlockMask1 1 "WorkingSetNotActive" 0 "NoError" ;
VAL_ 3221225472 ErrorCodeExecuteMacro1 1 "ObjectIdNotExist" 0 "NoError" ;
VAL_ 3221225472 ErrorCodeExecuteMacro2 1 "ObjectIdIsNoMacro" 0 "NoError" ;
VAL_ 3221225472 ErrorCodeExecuteMacro3 1 "GeneralError" 0 "NoError" ;
VAL_ 3221225472 VersionNumberISO11783Part6 0 "Hannover Agritechnica 2001 limit" 1 "FDIS_Version" 2 "VersionOfThe1PublishedEdition" 3 "VersionOfThe2PublishedEdition" 4 "VersionOfThe3PublishedEdition" 5 "VersionOfThe4PublishedEdition" 6 "VersionOfThe5PublishedEdition" 7 "VersionOfThe6PublishedEdition" 8 "VersionOfThe7PublishedEdition" 9 "VersionOfThe8PublishedEdition" 10 "VersionOfThe9PublishedEdition" 11 "VersionOfThe10PublishedEdition" 12 "VersionOfThe11PublishedEdition" 13 "VersionOfThe12PublishedEdition" 14 "VersionOfThe13PublishedEdition" 15 "VersionOfThe14PublishedEdition" 16 "VersionOfThe15PublishedEdition" 17 "VersionOfThe16PublishedEdition" 18 "VersionOfThe17PublishedEdition" 19 "VersionOfThe18PublishedEdition" 20 "VersionOfThe19PublishedEdition" 21 "VersionOfThe20PublishedEdition" 22 "VersionOfThe21PublishedEdition" 23 "VersionOfThe22PublishedEdition" 24 "VersionOfThe23PublishedEdition" 25 "VersionOfThe24PublishedEdition" 26 "VersionOfThe25PublishedEdition" 27 "VersionOfThe26PublishedEdition" 28 "VersionOfThe27PublishedEdition" 29 "VersionOfThe28PublishedEdition" 30 "VersionOfThe29PublishedEdition" 31 "VersionOfThe30PublishedEdition" 32 "VersionOfThe31PublishedEdition" 33 "VersionOfThe32PublishedEdition" 34 "VersionOfThe33PublishedEdition" 35 "VersionOfThe34PublishedEdition" 36 "VersionOfThe35PublishedEdition" 37 "VersionOfThe36PublishedEdition" 38 "VersionOfThe37PublishedEdition" 39 "VersionOfThe38PublishedEdition" 40 "VersionOfThe39PublishedEdition" 41 "VersionOfThe40PublishedEdition" 42 "VersionOfThe41PublishedEdition" 43 "VersionOfThe42PublishedEdition" 44 "VersionOfThe43PublishedEdition" 45 "VersionOfThe44PublishedEdition" 46 "VersionOfThe45PublishedEdition" 47 "VersionOfThe46PublishedEdition" 48 "VersionOfThe47PublishedEdition" 49 "VersionOfThe48PublishedEdition" 50 "VersionOfThe50PublishedEdition" ;
VAL_ 3221225472 MemoryStatus 0 "EnoughMemoryMayBeAvailable" 1 "NotEnoughMemoryAvailable" ;
VAL_ 3221225472 ErrorCodeGetSupportedWideChars2 1 "GeneralError" 0 "NoError" ;
VAL_ 3221225472 ErrorCodeGetSupportedWideChars1 1 "TooManyRanges" 0 "NoError" ;
VAL_ 3221225472 FontSize_8x8 0 "NotSupported" 1 "Supported" ;
VAL_ 3221225472 FontSize_8x12 0 "NotSupported" 1 "Supported" ;
VAL_ 3221225472 FontSize_12x16 0 "NotSupported" 1 "Supported" ;
VAL_ 3221225472 FontSize_16x16 0 "NotSupported" 1 "Supported" ;
VAL_ 3221225472 FontSize_16x24 0 "NotSupported" 1 "Supported" ;
VAL_ 3221225472 FontSize_24x32 0 "NotSupported" 1 "Supported" ;
VAL_ 3221225472 FontSize_32x32 0 "NotSupported" 1 "Supported" ;
VAL_ 3221225472 FontSize_32x48 0 "NotSupported" 1 "Supported" ;
VAL_ 3221225472 FontSize_48x64 0 "NotSupported" 1 "Supported" ;
VAL_ 3221225472 FontSize_64x64 0 "NotSupported" 1 "Supported" ;
VAL_ 3221225472 FontSize_64x96 0 "NotSupported" 1 "Supported" ;
VAL_ 3221225472 FontSize_96x128 0 "NotSupported" 1 "Supported" ;
VAL_ 3221225472 FontSize_128x128 0 "NotSupported" 1 "Supported" ;
VAL_ 3221225472 FontSize_128x192 0 "NotSupported" 1 "Supported" ;
VAL_ 3221225472 FontType_BoldText 0 "NotSupported" 1 "Supported" ;
VAL_ 3221225472 FontType_CrossedOutText 0 "NotSupported" 1 "Supported" ;
VAL_ 3221225472 FontType_UnderlinedText 0 "NotSupported" 1 "Supported" ;
VAL_ 3221225472 FontType_ItalicsText 0 "NotSupported" 1 "Supported" ;
VAL_ 3221225472 FontType_InvertedText 0 "NotSupported" 1 "Supported" ;
VAL_ 3221225472 FontType_FlashInverted 0 "NotSupported" 1 "Supported" ;
VAL_ 3221225472 FontType_FlashHidden 0 "NotSupported" 1 "Supported" ;
VAL_ 3221225472 FontType_ProportionalFont 0 "NotSupported" 1 "Supported" ;
VAL_ 3221225472 LineArts 0 "LineArtIsNotSupported" 1 "LineArtIsSupported" ;
VAL_ 3221225472 FillTypes 0 "FillPaternIsNotSupported" 1 "FillPaternIsSupported" ;
VAL_ 3221225472 ShapeFillTypes 0 "FillOfEllipseAndPolygonNotSup" 1 "FillEllipseSupAndFillPolygNotSup" 2 "FillEllipseNotSupAndFillPolygSup" 3 "FillOfEllipseAndPolygonSup" ;
VAL_ 3221225472 SupportedGrapicMode 0 "Monocrome" 1 "Colour16" 2 "Colour256" ;
VAL_ 3221225472 Hardware1 0 "VT has no touch screen and no pointing device" 1 "VT has a touch screen or pointing device" ;
VAL_ 3221225472 Hardware2 0 "VT does not report drag operation" 1 "VT reports drag operation" ;
VAL_ 3221225472 Hardware3 0 "VT has no multiple frequency audio output" 1 "VT has multiple frequency audio output" ;
VAL_ 3221225472 Hardware4 0 "VT has no adjustable volume audio output" 1 "VT has adjustable volume audio output" ;
VAL_ 3221225472 Hardware5 0 "VT does not support simultaneous activations of softkeys" 1 "VT supports simultaneous activations of softkeys" ;
VAL_ 3221225472 Hardware6 0 "VT does not support intermediate coordinates during a drag operation" 1 "VT supports intermediate coordinates during a drag operation" ;
VAL_ 3221225472 AcknowledgmentStoreVersion 0 "SuccessfullyStored" 2 "VersionLabelIsNotCorrect" 4 "InsufficientMemoryAvailable" 8 "GeneralError" ;
VAL_ 3221225472 AcknowledgmentLoadVersion 0 "SuccessfullyLoaded" 2 "VersionLabelNotCorrectOrUnknown" 4 "InsufficientMemoryAvailable" 8 "GeneralError" ;
VAL_ 3221225472 AcknowledgmentDeleteVersion 0 "SuccessfullyDeleted" 2 "VersionLabelIsNotCorrect" 4 "NA" 8 "GeneralError" ;
VAL_ 3221225472 ErrorCodeVtObjPoolError1 0 "NoErrors" 1 "UnsupportedMethodOrAttribute" ;
VAL_ 3221225472 ErrorCodeVtObjPoolError2 0 "NoErrors" 1 "UnknownObjectReference" ;
VAL_ 3221225472 ErrorCodeVtObjPoolError3 0 "NoErrors" 1 "RecursiveObjectReference" ;
VAL_ 3221225472 ErrorCodeVtObjPoolError4 0 "NoErrors" 1 "OtherError" ;
VAL_ 3221225472 VTBusyCode1 1 "VTIsBusyUpdatingVisibleMask" ;
VAL_ 3221225472 VTBusyCode2 1 "VTIsBusySavingDataToNonVolMemory" ;
VAL_ 3221225472 VTBusyCode3 1 "VTIsBusyExecutingCommand" ;
VAL_ 3221225472 VTBusyCode4 1 "VTIsBusyExecutingMacro" ;
VAL_ 3221225472 VTBusyCode5 1 "VTIsBusyParsingAnObjectPool" ;
VAL_ 3221225472 VTBusyCode8 1 "VTIsOutOfMemory" ;
