VERSION ""

NS_ :

BS_:

BU_:

BO_ 2621243134 TIM12_CS: 16 Vector__XXX
 SG_ FlowMaxIncAggressiveness_AV32 m65 : 16|16@1+ (0.004,0) [0|257.016] "% per sec." Vector__XXX
 SG_ FlowMaxIncAggressiveness_AV31 m65 : 16|16@1+ (0.004,0) [0|257.016] "% per sec." Vector__XXX
 SG_ FlowMaxIncAggressiveness_AV30 m65 : 16|16@1+ (0.004,0) [0|257.016] "% per sec." Vector__XXX
 SG_ FlowMaxIncAggressiveness_AV29 m65 : 16|16@1+ (0.004,0) [0|257.016] "% per sec." Vector__XXX
 SG_ FlowMaxIncAggressiveness_AV28 m65 : 16|16@1+ (0.004,0) [0|257.016] "% per sec." Vector__XXX
 SG_ FlowMaxIncAggressiveness_AV27 m65 : 16|16@1+ (0.004,0) [0|257.016] "% per sec." Vector__XXX
 SG_ FlowMaxIncAggressiveness_AV26 m65 : 16|16@1+ (0.004,0) [0|257.016] "% per sec." Vector__XXX
 SG_ FlowMaxIncAggressiveness_AV25 m65 : 16|16@1+ (0.004,0) [0|257.016] "% per sec." Vector__XXX
 SG_ FlowMaxIncAggressiveness_AV24 m65 : 16|16@1+ (0.004,0) [0|257.016] "% per sec." Vector__XXX
 SG_ FlowMaxIncAggressiveness_AV23 m65 : 16|16@1+ (0.004,0) [0|257.016] "% per sec." Vector__XXX
 SG_ FlowMaxIncAggressiveness_AV22 m65 : 16|16@1+ (0.004,0) [0|257.016] "% per sec." Vector__XXX
 SG_ FlowMaxIncAggressiveness_AV21 m65 : 16|16@1+ (0.004,0) [0|257.016] "% per sec." Vector__XXX
 SG_ FlowMaxIncAggressiveness_AV20 m65 : 16|16@1+ (0.004,0) [0|257.016] "% per sec." Vector__XXX
 SG_ FlowMaxIncAggressiveness_AV19 m65 : 16|16@1+ (0.004,0) [0|257.016] "% per sec." Vector__XXX
 SG_ FlowMaxIncAggressiveness_AV18 m65 : 16|16@1+ (0.004,0) [0|257.016] "% per sec." Vector__XXX
 SG_ FlowMaxIncAggressiveness_AV17 m65 : 16|16@1+ (0.004,0) [0|257.016] "% per sec." Vector__XXX
 SG_ FlowMaxIncAggressiveness_AV16 m65 : 16|16@1+ (0.004,0) [0|257.016] "% per sec." Vector__XXX
 SG_ FlowMaxIncAggressiveness_AV15 m65 : 16|16@1+ (0.004,0) [0|257.016] "% per sec." Vector__XXX
 SG_ FlowMaxIncAggressiveness_AV14 m65 : 16|16@1+ (0.004,0) [0|257.016] "% per sec." Vector__XXX
 SG_ FlowMaxIncAggressiveness_AV13 m65 : 16|16@1+ (0.004,0) [0|257.016] "% per sec." Vector__XXX
 SG_ FlowMaxIncAggressiveness_AV12 m65 : 16|16@1+ (0.004,0) [0|257.016] "% per sec." Vector__XXX
 SG_ FlowMaxIncAggressiveness_AV11 m65 : 16|16@1+ (0.004,0) [0|257.016] "% per sec." Vector__XXX
 SG_ FlowMaxIncAggressiveness_AV10 m65 : 16|16@1+ (0.004,0) [0|257.016] "% per sec." Vector__XXX
 SG_ FlowMaxIncAggressiveness_AV09 m65 : 16|16@1+ (0.004,0) [0|257.016] "% per sec." Vector__XXX
 SG_ FlowMaxIncAggressiveness_AV08 m65 : 16|16@1+ (0.004,0) [0|257.016] "% per sec." Vector__XXX
 SG_ FlowMaxIncAggressiveness_AV07 m65 : 16|16@1+ (0.004,0) [0|257.016] "% per sec." Vector__XXX
 SG_ FlowMaxIncAggressiveness_AV06 m65 : 16|16@1+ (0.004,0) [0|257.016] "% per sec." Vector__XXX
 SG_ FlowMaxIncAggressiveness_AV05 m65 : 16|16@1+ (0.004,0) [0|257.016] "% per sec." Vector__XXX
 SG_ FlowMaxIncAggressiveness_AV04 m65 : 16|16@1+ (0.004,0) [0|257.016] "% per sec." Vector__XXX
 SG_ FlowMaxIncAggressiveness_AV03 m65 : 16|16@1+ (0.004,0) [0|257.016] "% per sec." Vector__XXX
 SG_ FlowMaxIncAggressiveness_AV02 m65 : 16|16@1+ (0.004,0) [0|257.016] "% per sec." Vector__XXX
 SG_ FlowMaxIncAggressiveness_AV01 m65 : 16|16@1+ (0.004,0) [0|257.016] "% per sec." Vector__XXX
 SG_ FlowMaxDecAggressiveness_AV32 m65 : 32|16@1+ (0.004,0) [0|257.016] "% per sec." Vector__XXX
 SG_ FlowMaxDecAggressiveness_AV31 m65 : 32|16@1+ (0.004,0) [0|257.016] "% per sec." Vector__XXX
 SG_ FlowMaxDecAggressiveness_AV30 m65 : 32|16@1+ (0.004,0) [0|257.016] "% per sec." Vector__XXX
 SG_ FlowMaxDecAggressiveness_AV29 m65 : 32|16@1+ (0.004,0) [0|257.016] "% per sec." Vector__XXX
 SG_ FlowMaxDecAggressiveness_AV28 m65 : 32|16@1+ (0.004,0) [0|257.016] "% per sec." Vector__XXX
 SG_ FlowMaxDecAggressiveness_AV27 m65 : 32|16@1+ (0.004,0) [0|257.016] "% per sec." Vector__XXX
 SG_ FlowMaxDecAggressiveness_AV26 m65 : 32|16@1+ (0.004,0) [0|257.016] "% per sec." Vector__XXX
 SG_ FlowMaxDecAggressiveness_AV25 m65 : 32|16@1+ (0.004,0) [0|257.016] "% per sec." Vector__XXX
 SG_ FlowMaxDecAggressiveness_AV24 m65 : 32|16@1+ (0.004,0) [0|257.016] "% per sec." Vector__XXX
 SG_ FlowMaxDecAggressiveness_AV23 m65 : 32|16@1+ (0.004,0) [0|257.016] "% per sec." Vector__XXX
 SG_ FlowMaxDecAggressiveness_AV22 m65 : 32|16@1+ (0.004,0) [0|257.016] "% per sec." Vector__XXX
 SG_ FlowMaxDecAggressiveness_AV21 m65 : 32|16@1+ (0.004,0) [0|257.016] "% per sec." Vector__XXX
 SG_ FlowMaxDecAggressiveness_AV20 m65 : 32|16@1+ (0.004,0) [0|257.016] "% per sec." Vector__XXX
 SG_ FlowMaxDecAggressiveness_AV19 m65 : 32|16@1+ (0.004,0) [0|257.016] "% per sec." Vector__XXX
 SG_ FlowMaxDecAggressiveness_AV18 m65 : 32|16@1+ (0.004,0) [0|257.016] "% per sec." Vector__XXX
 SG_ FlowMaxDecAggressiveness_AV17 m65 : 32|16@1+ (0.004,0) [0|257.016] "% per sec." Vector__XXX
 SG_ FlowMaxDecAggressiveness_AV16 m65 : 32|16@1+ (0.004,0) [0|257.016] "% per sec." Vector__XXX
 SG_ FlowMaxDecAggressiveness_AV15 m65 : 32|16@1+ (0.004,0) [0|257.016] "% per sec." Vector__XXX
 SG_ FlowMaxDecAggressiveness_AV14 m65 : 32|16@1+ (0.004,0) [0|257.016] "% per sec." Vector__XXX
 SG_ FlowMaxDecAggressiveness_AV13 m65 : 32|16@1+ (0.004,0) [0|257.016] "% per sec." Vector__XXX
 SG_ FlowMaxDecAggressiveness_AV12 m65 : 32|16@1+ (0.004,0) [0|257.016] "% per sec." Vector__XXX
 SG_ FlowMaxDecAggressiveness_AV11 m65 : 32|16@1+ (0.004,0) [0|257.016] "% per sec." Vector__XXX
 SG_ FlowMaxDecAggressiveness_AV10 m65 : 32|16@1+ (0.004,0) [0|257.016] "% per sec." Vector__XXX
 SG_ FlowMaxDecAggressiveness_AV09 m65 : 32|16@1+ (0.004,0) [0|257.016] "% per sec." Vector__XXX
 SG_ FlowMaxDecAggressiveness_AV08 m65 : 32|16@1+ (0.004,0) [0|257.016] "% per sec." Vector__XXX
 SG_ FlowMaxDecAggressiveness_AV07 m65 : 32|16@1+ (0.004,0) [0|257.016] "% per sec." Vector__XXX
 SG_ FlowMaxDecAggressiveness_AV06 m65 : 32|16@1+ (0.004,0) [0|257.016] "% per sec." Vector__XXX
 SG_ FlowMaxDecAggressiveness_AV05 m65 : 32|16@1+ (0.004,0) [0|257.016] "% per sec." Vector__XXX
 SG_ FlowMaxDecAggressiveness_AV04 m65 : 32|16@1+ (0.004,0) [0|257.016] "% per sec." Vector__XXX
 SG_ FlowMaxDecAggressiveness_AV03 m65 : 32|16@1+ (0.004,0) [0|257.016] "% per sec." Vector__XXX
 SG_ FlowMaxDecAggressiveness_AV02 m65 : 32|16@1+ (0.004,0) [0|257.016] "% per sec." Vector__XXX
 SG_ FlowMaxDecAggressiveness_AV01 m65 : 32|16@1+ (0.004,0) [0|257.016] "% per sec." Vector__XXX
 SG_ CurvatureMaxAggressiveness_EG m65 : 16|16@1+ (0.25,0) [0|16063.75] "1/km per sec." Vector__XXX
 SG_ VSpeedMaxDecAggressiveness_VS m65 : 32|16@1+ (0.001,0) [0|64.255] "m/s per sec." Vector__XXX
 SG_ VSpeedMaxIncAggressiveness_VS m65 : 16|16@1+ (0.001,0) [0|64.255] "m/s per sec." Vector__XXX
 SG_ PositonMaxIncAggressiveness_RTL m65 : 16|16@1+ (0.01,0) [0|100] "% per sec." Vector__XXX
 SG_ PositonMaxIncAggressiveness_FTL m65 : 16|16@1+ (0.01,0) [0|100] "% per sec." Vector__XXX
 SG_ PositonMaxDecAggressiveness_RTL m65 : 32|16@1+ (0.01,0) [0|100] "% per sec." Vector__XXX
 SG_ PositonMaxDecAggressiveness_FTL m65 : 32|16@1+ (0.01,0) [0|100] "% per sec." Vector__XXX
 SG_ PositonMaxIncAggressiveness_RH m65 : 16|16@1+ (0.01,0) [0|100] "% per sec." Vector__XXX
 SG_ PositonMaxIncAggressiveness_FH m65 : 16|16@1+ (0.01,0) [0|100] "% per sec." Vector__XXX
 SG_ PositonMaxDecAggressiveness_RH m65 : 32|16@1+ (0.01,0) [0|100] "% per sec." Vector__XXX
 SG_ PositonMaxDecAggressiveness_FH m65 : 32|16@1+ (0.01,0) [0|100] "% per sec." Vector__XXX
 SG_ SpeedMaxDecAggressiveness_RPTO m65 : 32|16@1+ (0.125,0) [0|8031.875] "1/min per sec." Vector__XXX
 SG_ SpeedMaxDecAggressiveness_FPTO m65 : 32|16@1+ (0.125,0) [0|8031.875] "1/min per sec." Vector__XXX
 SG_ SpeedMaxIncAggressiveness_RPTO m65 : 16|16@1+ (0.125,0) [0|8031.875] "1/min per sec." Vector__XXX
 SG_ SpeedMaxIncAggressiveness_FPTO m65 : 16|16@1+ (0.125,0) [0|8031.875] "1/min per sec." Vector__XXX
 SG_ SecurityByte_VS m1 : 56|8@1+ (1,0) [0|255] "" Vector__XXX
 SG_ SecurityByte_RTL m1 : 56|8@1+ (1,0) [0|255] "" Vector__XXX
 SG_ SecurityByte_RPTO m1 : 56|8@1+ (1,0) [0|255] "" Vector__XXX
 SG_ SecurityByte_RH m1 : 56|8@1+ (1,0) [0|255] "" Vector__XXX
 SG_ SecurityByte_FTL m1 : 56|8@1+ (1,0) [0|255] "" Vector__XXX
 SG_ SecurityByte_FPTO m1 : 56|8@1+ (1,0) [0|255] "" Vector__XXX
 SG_ SecurityByte_FH m1 : 56|8@1+ (1,0) [0|255] "" Vector__XXX
 SG_ SecurityByte_EG m1 : 56|8@1+ (1,0) [0|255] "" Vector__XXX
 SG_ SecurityByte_AV32 m1 : 56|8@1+ (1,0) [0|255] "" Vector__XXX
 SG_ SecurityByte_AV31 m1 : 56|8@1+ (1,0) [0|255] "" Vector__XXX
 SG_ SecurityByte_AV30 m1 : 56|8@1+ (1,0) [0|255] "" Vector__XXX
 SG_ SecurityByte_AV29 m1 : 56|8@1+ (1,0) [0|255] "" Vector__XXX
 SG_ SecurityByte_AV28 m1 : 56|8@1+ (1,0) [0|255] "" Vector__XXX
 SG_ SecurityByte_AV27 m1 : 56|8@1+ (1,0) [0|255] "" Vector__XXX
 SG_ SecurityByte_AV26 m1 : 56|8@1+ (1,0) [0|255] "" Vector__XXX
 SG_ SecurityByte_AV25 m1 : 56|8@1+ (1,0) [0|255] "" Vector__XXX
 SG_ SecurityByte_AV24 m1 : 56|8@1+ (1,0) [0|255] "" Vector__XXX
 SG_ SecurityByte_AV23 m1 : 56|8@1+ (1,0) [0|255] "" Vector__XXX
 SG_ SecurityByte_AV22 m1 : 56|8@1+ (1,0) [0|255] "" Vector__XXX
 SG_ SecurityByte_AV21 m1 : 56|8@1+ (1,0) [0|255] "" Vector__XXX
 SG_ SecurityByte_AV20 m1 : 56|8@1+ (1,0) [0|255] "" Vector__XXX
 SG_ SecurityByte_AV19 m1 : 56|8@1+ (1,0) [0|255] "" Vector__XXX
 SG_ SecurityByte_AV18 m1 : 56|8@1+ (1,0) [0|255] "" Vector__XXX
 SG_ SecurityByte_AV17 m1 : 56|8@1+ (1,0) [0|255] "" Vector__XXX
 SG_ SecurityByte_AV16 m1 : 56|8@1+ (1,0) [0|255] "" Vector__XXX
 SG_ SecurityByte_AV15 m1 : 56|8@1+ (1,0) [0|255] "" Vector__XXX
 SG_ SecurityByte_AV14 m1 : 56|8@1+ (1,0) [0|255] "" Vector__XXX
 SG_ SecurityByte_AV13 m1 : 56|8@1+ (1,0) [0|255] "" Vector__XXX
 SG_ SecurityByte_AV12 m1 : 56|8@1+ (1,0) [0|255] "" Vector__XXX
 SG_ SecurityByte_AV11 m1 : 56|8@1+ (1,0) [0|255] "" Vector__XXX
 SG_ SecurityByte_AV10 m1 : 56|8@1+ (1,0) [0|255] "" Vector__XXX
 SG_ SecurityByte_AV09 m1 : 56|8@1+ (1,0) [0|255] "" Vector__XXX
 SG_ SecurityByte_AV08 m1 : 56|8@1+ (1,0) [0|255] "" Vector__XXX
 SG_ SecurityByte_AV07 m1 : 56|8@1+ (1,0) [0|255] "" Vector__XXX
 SG_ SecurityByte_AV06 m1 : 56|8@1+ (1,0) [0|255] "" Vector__XXX
 SG_ SecurityByte_AV05 m1 : 56|8@1+ (1,0) [0|255] "" Vector__XXX
 SG_ SecurityByte_AV04 m1 : 56|8@1+ (1,0) [0|255] "" Vector__XXX
 SG_ SecurityByte_AV03 m1 : 56|8@1+ (1,0) [0|255] "" Vector__XXX
 SG_ SecurityByte_AV02 m1 : 56|8@1+ (1,0) [0|255] "" Vector__XXX
 SG_ SecurityByte_AV01 m1 : 56|8@1+ (1,0) [0|255] "" Vector__XXX
 SG_ State_RH m17 : 48|4@1+ (1,0) [0|0] "" Vector__XXX
 SG_ State_RTL m17 : 48|4@1+ (1,0) [0|15] "" Vector__XXX
 SG_ State_FTL m17 : 48|4@1+ (1,0) [0|15] "" Vector__XXX
 SG_ State_FH m17 : 48|4@1+ (1,0) [0|255] "" Vector__XXX
 SG_ StrokeLength_CM1GP_RTL m0 : 56|16@1+ (1,0.01) [0|65535] "%" Vector__XXX
 SG_ BaseLength_CM1GP_RTL m0 : 40|16@1+ (1,0.01) [0|65535] "%" Vector__XXX
 SG_ StrokeLength_CM1GP_FTL m0 : 56|16@1+ (1,0.01) [0|65535] "%" Vector__XXX
 SG_ BaseLength_CM1GP_FTL m0 : 40|16@1+ (1,0.01) [0|65535] "%" Vector__XXX
 SG_ MinimumSpeedBackward_CM1GP_VS m0 : 80|16@1+ (0.001,-32.128) [-32.128|33.407] "m/s" Vector__XXX
 SG_ MaximumSpeedBackward_CM1GP_VS m0 : 96|16@1+ (0.001,-32.128) [-32.128|33.407] "m/s" Vector__XXX
 SG_ MinimumSpeedForward_CM1GP_VS m0 : 48|16@1+ (0.001,-32.128) [-32.128|33.407] "m/s" Vector__XXX
 SG_ MaximumSpeedForward_CM1GP_VS m0 : 64|16@1+ (0.001,-32.128) [-32.128|33.407] "m/s" Vector__XXX
 SG_ TransmissionType_CM1GP_VS m0 : 40|8@1+ (1,0) [0|255] "" Vector__XXX
 SG_ ControlMode1_RTL m0M : 24|4@1+ (1,0) [0|15] "" Vector__XXX
 SG_ NumOfControlModes_RTL m0 : 16|4@1+ (1,0) [0|15] "" Vector__XXX
 SG_ NumOfBytes_CM1_RTL m0 : 32|8@1+ (1,0) [0|255] "" Vector__XXX
 SG_ Position_RTL m17M : 32|16@1+ (0.01,0) [0|100] "%" Vector__XXX
 SG_ Position_FTL m17 : 32|16@1+ (0.01,0) [0|100] "%" Vector__XXX
 SG_ ExitReasonCode_RTL m1 : 27|5@1+ (1,0) [0|0] "" Vector__XXX
 SG_ ExitReasonCode_FTL m1 : 27|5@1+ (1,0) [0|0] "" Vector__XXX
 SG_ AutomationStatus_RTL m1 : 16|4@1+ (1,0) [0|0] "" Vector__XXX
 SG_ AutomationStatus_FTL m1 : 16|4@1+ (1,0) [0|0] "" Vector__XXX
 SG_ ControlMode1_FTL m0M : 24|4@1+ (1,0) [0|15] "" Vector__XXX
 SG_ NumOfBytes_CM1_FTL m0 : 32|8@1+ (1,0) [0|255] "" Vector__XXX
 SG_ NumOfControlModes_FTL m0 : 16|4@1+ (1,0) [0|15] "" Vector__XXX
 SG_ MsgType_RTL m72M : 8|8@1+ (1,0) [0|255] "" Vector__XXX
 SG_ MsgType_FTL m71M : 8|8@1+ (1,0) [0|255] "" Vector__XXX
 SG_ MsgType_EG m70M : 8|8@1+ (1,0) [0|255] "" Vector__XXX
 SG_ NumOfBytes_CM1_VS m0 : 32|8@1+ (1,0) [0|255] "" Vector__XXX
 SG_ ControlMode1_VS m0M : 24|4@1+ (1,0) [0|15] "" Vector__XXX
 SG_ NumOfControlModes_VS m0 : 16|4@1+ (1,0) [0|15] "" Vector__XXX
 SG_ MsgType_VS m68M : 8|8@1+ (1,0) [0|255] "" Vector__XXX
 SG_ MsgType_RH m67M : 8|8@1+ (1,0) [0|255] "" Vector__XXX
 SG_ MsgType_FH m66M : 8|8@1+ (1,0) [0|255] "" Vector__XXX
 SG_ MsgType_RPTO m65M : 8|8@1+ (1,0) [0|255] "" Vector__XXX
 SG_ MsgType_FPTO m64M : 8|8@1+ (1,0) [0|255] "" Vector__XXX
 SG_ MsgType_AV32 m32M : 8|8@1+ (1,0) [0|255] "" Vector__XXX
 SG_ MsgType_AV31 m31M : 8|8@1+ (1,0) [0|255] "" Vector__XXX
 SG_ MsgType_AV30 m30M : 8|8@1+ (1,0) [0|255] "" Vector__XXX
 SG_ MsgType_AV29 m29M : 8|8@1+ (1,0) [0|255] "" Vector__XXX
 SG_ MsgType_AV28 m28M : 8|8@1+ (1,0) [0|255] "" Vector__XXX
 SG_ MsgType_AV27 m27M : 8|8@1+ (1,0) [0|255] "" Vector__XXX
 SG_ MsgType_AV26 m26M : 8|8@1+ (1,0) [0|255] "" Vector__XXX
 SG_ MsgType_AV25 m25M : 8|8@1+ (1,0) [0|255] "" Vector__XXX
 SG_ MsgType_AV24 m24M : 8|8@1+ (1,0) [0|255] "" Vector__XXX
 SG_ MsgType_AV23 m23M : 8|8@1+ (1,0) [0|255] "" Vector__XXX
 SG_ MsgType_AV22 m22M : 8|8@1+ (1,0) [0|255] "" Vector__XXX
 SG_ MsgType_AV21 m21M : 8|8@1+ (1,0) [0|255] "" Vector__XXX
 SG_ MsgType_AV20 m20M : 8|8@1+ (1,0) [0|255] "" Vector__XXX
 SG_ MsgType_AV19 m19M : 8|8@1+ (1,0) [0|255] "" Vector__XXX
 SG_ MsgType_AV18 m18M : 8|8@1+ (1,0) [0|255] "" Vector__XXX
 SG_ MsgType_AV17 m17M : 8|8@1+ (1,0) [0|255] "" Vector__XXX
 SG_ MsgType_AV16 m16M : 8|8@1+ (1,0) [0|255] "" Vector__XXX
 SG_ MsgType_AV15 m15M : 8|8@1+ (1,0) [0|255] "" Vector__XXX
 SG_ MsgType_AV14 m14M : 8|8@1+ (1,0) [0|255] "" Vector__XXX
 SG_ MsgType_AV13 m13M : 8|8@1+ (1,0) [0|255] "" Vector__XXX
 SG_ MsgType_AV12 m12M : 8|8@1+ (1,0) [0|255] "" Vector__XXX
 SG_ MsgType_AV11 m11M : 8|8@1+ (1,0) [0|255] "" Vector__XXX
 SG_ MsgType_AV10 m10M : 8|8@1+ (1,0) [0|255] "" Vector__XXX
 SG_ MsgType_AV09 m9M : 8|8@1+ (1,0) [0|255] "" Vector__XXX
 SG_ MsgType_AV08 m8M : 8|8@1+ (1,0) [0|255] "" Vector__XXX
 SG_ MsgType_AV07 m7M : 8|8@1+ (1,0) [0|255] "" Vector__XXX
 SG_ MsgType_AV06 m6M : 8|8@1+ (1,0) [0|255] "" Vector__XXX
 SG_ MsgType_AV05 m5M : 8|8@1+ (1,0) [0|255] "" Vector__XXX
 SG_ MsgType_AV04 m4M : 8|8@1+ (1,0) [0|255] "" Vector__XXX
 SG_ MsgType_AV03 m3M : 8|8@1+ (1,0) [0|255] "" Vector__XXX
 SG_ MsgType_AV02 m2M : 8|8@1+ (1,0) [0|255] "" Vector__XXX
 SG_ MsgType_AV01 m1M : 8|8@1+ (1,0) [0|255] "" Vector__XXX
 SG_ Position_RH m17 : 32|16@1+ (0.01,0) [0|100] "%" Vector__XXX
 SG_ Speed_RPTO m17 : 32|16@1+ (0.125,-4016) [0|0] "1/min" Vector__XXX
 SG_ Flow_AV32 m17 : 32|16@1+ (0.004,-128.512) [0|0] "%" Vector__XXX
 SG_ Flow_AV31 m17 : 32|16@1+ (0.004,-128.512) [0|0] "%" Vector__XXX
 SG_ Flow_AV30 m17 : 32|16@1+ (0.004,-128.512) [0|0] "%" Vector__XXX
 SG_ Flow_AV29 m17 : 32|16@1+ (0.004,-128.512) [0|0] "%" Vector__XXX
 SG_ Flow_AV28 m17 : 32|16@1+ (0.004,-128.512) [0|0] "%" Vector__XXX
 SG_ Flow_AV27 m17 : 32|16@1+ (0.004,-128.512) [0|0] "%" Vector__XXX
 SG_ Flow_AV26 m17 : 32|16@1+ (0.004,-128.512) [0|0] "%" Vector__XXX
 SG_ Flow_AV25 m17 : 32|16@1+ (0.004,-128.512) [0|0] "%" Vector__XXX
 SG_ Flow_AV24 m17 : 32|16@1+ (0.004,-128.512) [0|0] "%" Vector__XXX
 SG_ Flow_AV23 m17 : 32|16@1+ (0.004,-128.512) [0|0] "%" Vector__XXX
 SG_ Flow_AV22 m17 : 32|16@1+ (0.004,-128.512) [0|0] "%" Vector__XXX
 SG_ Flow_AV21 m17 : 32|16@1+ (0.004,-128.512) [0|0] "%" Vector__XXX
 SG_ Flow_AV20 m17 : 32|16@1+ (0.004,-128.512) [0|0] "%" Vector__XXX
 SG_ Flow_AV19 m17 : 32|16@1+ (0.004,-128.512) [0|0] "%" Vector__XXX
 SG_ Flow_AV18 m17 : 32|16@1+ (0.004,-128.512) [0|0] "%" Vector__XXX
 SG_ Flow_AV17 m17 : 32|16@1+ (0.004,-128.512) [0|0] "%" Vector__XXX
 SG_ Flow_AV16 m17 : 32|16@1+ (0.004,-128.512) [0|0] "%" Vector__XXX
 SG_ Flow_AV15 m17 : 32|16@1+ (0.004,-128.512) [0|0] "%" Vector__XXX
 SG_ Flow_AV14 m17 : 32|16@1+ (0.004,-128.512) [0|0] "%" Vector__XXX
 SG_ Flow_AV13 m17 : 32|16@1+ (0.004,-128.512) [0|0] "%" Vector__XXX
 SG_ Flow_AV12 m17 : 32|16@1+ (0.004,-128.512) [0|0] "%" Vector__XXX
 SG_ Flow_AV11 m17 : 32|16@1+ (0.004,-128.512) [0|0] "%" Vector__XXX
 SG_ Flow_AV10 m17 : 32|16@1+ (0.004,-128.512) [0|0] "%" Vector__XXX
 SG_ Flow_AV09 m17 : 32|16@1+ (0.004,-128.512) [0|0] "%" Vector__XXX
 SG_ Flow_AV08 m17 : 32|16@1+ (0.004,-128.512) [0|0] "%" Vector__XXX
 SG_ Flow_AV07 m17 : 32|16@1+ (0.004,-128.512) [0|0] "%" Vector__XXX
 SG_ Flow_AV06 m17 : 32|16@1+ (0.004,-128.512) [0|0] "%" Vector__XXX
 SG_ Flow_AV05 m17 : 32|16@1+ (0.004,-128.512) [0|0] "%" Vector__XXX
 SG_ Flow_AV04 m17 : 32|16@1+ (0.004,-128.512) [0|0] "%" Vector__XXX
 SG_ Flow_AV03 m17 : 32|16@1+ (0.004,-128.512) [0|0] "%" Vector__XXX
 SG_ Flow_AV02 m17 : 32|16@1+ (0.004,-128.512) [0|0] "%" Vector__XXX
 SG_ FlowType_AV32 m1 : 24|2@1+ (1,0) [0|0] "" Vector__XXX
 SG_ FlowType_AV31 m1 : 24|2@1+ (1,0) [0|0] "" Vector__XXX
 SG_ FlowType_AV30 m1 : 24|2@1+ (1,0) [0|0] "" Vector__XXX
 SG_ FlowType_AV29 m1 : 24|2@1+ (1,0) [0|0] "" Vector__XXX
 SG_ FlowType_AV28 m1 : 24|2@1+ (1,0) [0|0] "" Vector__XXX
 SG_ FlowType_AV27 m1 : 24|2@1+ (1,0) [0|0] "" Vector__XXX
 SG_ FlowType_AV26 m1 : 24|2@1+ (1,0) [0|0] "" Vector__XXX
 SG_ FlowType_AV25 m1 : 24|2@1+ (1,0) [0|0] "" Vector__XXX
 SG_ FlowType_AV24 m1 : 24|2@1+ (1,0) [0|0] "" Vector__XXX
 SG_ FlowType_AV23 m1 : 24|2@1+ (1,0) [0|0] "" Vector__XXX
 SG_ FlowType_AV22 m1 : 24|2@1+ (1,0) [0|0] "" Vector__XXX
 SG_ FlowType_AV21 m1 : 24|2@1+ (1,0) [0|0] "" Vector__XXX
 SG_ FlowType_AV20 m1 : 24|2@1+ (1,0) [0|0] "" Vector__XXX
 SG_ FlowType_AV19 m1 : 24|2@1+ (1,0) [0|0] "" Vector__XXX
 SG_ FlowType_AV18 m1 : 24|2@1+ (1,0) [0|0] "" Vector__XXX
 SG_ FlowType_AV17 m1 : 24|2@1+ (1,0) [0|0] "" Vector__XXX
 SG_ FlowType_AV16 m1 : 24|2@1+ (1,0) [0|0] "" Vector__XXX
 SG_ FlowType_AV15 m1 : 24|2@1+ (1,0) [0|0] "" Vector__XXX
 SG_ FlowType_AV14 m1 : 24|2@1+ (1,0) [0|0] "" Vector__XXX
 SG_ FlowType_AV13 m1 : 24|2@1+ (1,0) [0|0] "" Vector__XXX
 SG_ FlowType_AV12 m1 : 24|2@1+ (1,0) [0|0] "" Vector__XXX
 SG_ FlowType_AV11 m1 : 24|2@1+ (1,0) [0|0] "" Vector__XXX
 SG_ FlowType_AV10 m1 : 24|2@1+ (1,0) [0|0] "" Vector__XXX
 SG_ FlowType_AV09 m1 : 24|2@1+ (1,0) [0|0] "" Vector__XXX
 SG_ FlowType_AV08 m1 : 24|2@1+ (1,0) [0|0] "" Vector__XXX
 SG_ FlowType_AV07 m1 : 24|2@1+ (1,0) [0|0] "" Vector__XXX
 SG_ FlowType_AV06 m1 : 24|2@1+ (1,0) [0|0] "" Vector__XXX
 SG_ FlowType_AV05 m1 : 24|2@1+ (1,0) [0|0] "" Vector__XXX
 SG_ FlowType_AV04 m1 : 24|2@1+ (1,0) [0|0] "" Vector__XXX
 SG_ FlowType_AV03 m1 : 24|2@1+ (1,0) [0|0] "" Vector__XXX
 SG_ FlowType_AV02 m1 : 24|2@1+ (1,0) [0|0] "" Vector__XXX
 SG_ FlowType_AV01 m1 : 24|2@1+ (1,0) [0|0] "" Vector__XXX
 SG_ ExitReasonCode_RPTO m1 : 27|5@1+ (1,0) [0|0] "" Vector__XXX
 SG_ ExitReasonCode_RH m1 : 27|5@1+ (1,0) [0|0] "" Vector__XXX
 SG_ ExitReasonCode_AV32 m1 : 27|5@1+ (1,0) [0|0] "" Vector__XXX
 SG_ ExitReasonCode_AV31 m1 : 27|5@1+ (1,0) [0|0] "" Vector__XXX
 SG_ ExitReasonCode_AV30 m1 : 27|5@1+ (1,0) [0|0] "" Vector__XXX
 SG_ ExitReasonCode_AV29 m1 : 27|5@1+ (1,0) [0|0] "" Vector__XXX
 SG_ ExitReasonCode_AV28 m1 : 27|5@1+ (1,0) [0|0] "" Vector__XXX
 SG_ ExitReasonCode_AV27 m1 : 27|5@1+ (1,0) [0|0] "" Vector__XXX
 SG_ ExitReasonCode_AV26 m1 : 27|5@1+ (1,0) [0|0] "" Vector__XXX
 SG_ ExitReasonCode_AV25 m1 : 27|5@1+ (1,0) [0|0] "" Vector__XXX
 SG_ ExitReasonCode_AV24 m1 : 27|5@1+ (1,0) [0|0] "" Vector__XXX
 SG_ ExitReasonCode_AV23 m1 : 27|5@1+ (1,0) [0|0] "" Vector__XXX
 SG_ ExitReasonCode_AV22 m1 : 27|5@1+ (1,0) [0|0] "" Vector__XXX
 SG_ ExitReasonCode_AV21 m1 : 27|5@1+ (1,0) [0|0] "" Vector__XXX
 SG_ ExitReasonCode_AV20 m1 : 27|5@1+ (1,0) [0|0] "" Vector__XXX
 SG_ ExitReasonCode_AV19 m1 : 27|5@1+ (1,0) [0|0] "" Vector__XXX
 SG_ ExitReasonCode_AV18 m1 : 27|5@1+ (1,0) [0|0] "" Vector__XXX
 SG_ ExitReasonCode_AV17 m1 : 27|5@1+ (1,0) [0|0] "" Vector__XXX
 SG_ ExitReasonCode_AV16 m1 : 27|5@1+ (1,0) [0|0] "" Vector__XXX
 SG_ ExitReasonCode_AV15 m1 : 27|5@1+ (1,0) [0|0] "" Vector__XXX
 SG_ ExitReasonCode_AV14 m1 : 27|5@1+ (1,0) [0|0] "" Vector__XXX
 SG_ ExitReasonCode_AV13 m1 : 27|5@1+ (1,0) [0|0] "" Vector__XXX
 SG_ ExitReasonCode_AV12 m1 : 27|5@1+ (1,0) [0|0] "" Vector__XXX
 SG_ ExitReasonCode_AV11 m1 : 27|5@1+ (1,0) [0|0] "" Vector__XXX
 SG_ ExitReasonCode_AV10 m1 : 27|5@1+ (1,0) [0|0] "" Vector__XXX
 SG_ ExitReasonCode_AV09 m1 : 27|5@1+ (1,0) [0|0] "" Vector__XXX
 SG_ ExitReasonCode_AV08 m1 : 27|5@1+ (1,0) [0|0] "" Vector__XXX
 SG_ ExitReasonCode_AV07 m1 : 27|5@1+ (1,0) [0|0] "" Vector__XXX
 SG_ ExitReasonCode_AV06 m1 : 27|5@1+ (1,0) [0|0] "" Vector__XXX
 SG_ ExitReasonCode_AV05 m1 : 27|5@1+ (1,0) [0|0] "" Vector__XXX
 SG_ ExitReasonCode_AV04 m1 : 27|5@1+ (1,0) [0|0] "" Vector__XXX
 SG_ ExitReasonCode_AV03 m1 : 27|5@1+ (1,0) [0|0] "" Vector__XXX
 SG_ ExitReasonCode_AV02 m1 : 27|5@1+ (1,0) [0|0] "" Vector__XXX
 SG_ AutomationStatus_AV04 m1 : 16|4@1+ (1,0) [0|0] "" Vector__XXX
 SG_ AutomationStatus_AV03 m1 : 16|4@1+ (1,0) [0|0] "" Vector__XXX
 SG_ AutomationStatus_AV02 m1 : 16|4@1+ (1,0) [0|0] "" Vector__XXX
 SG_ AutomationStatus_AV01 m1 : 16|4@1+ (1,0) [0|0] "" Vector__XXX
 SG_ AutomationStatus_EG m1 : 16|4@1+ (1,0) [0|0] "" Vector__XXX
 SG_ AutomationStatus_VS m1 : 16|4@1+ (1,0) [0|0] "" Vector__XXX
 SG_ AutomationStatus_RH m1 : 16|4@1+ (1,0) [0|0] "" Vector__XXX
 SG_ AutomationStatus_FH m1 : 16|4@1+ (1,0) [0|0] "" Vector__XXX
 SG_ AutomationStatus_RPTO m1 : 16|4@1+ (1,0) [0|0] "" Vector__XXX
 SG_ AutomationStatus_FPTO m1 : 16|4@1+ (1,0) [0|0] "" Vector__XXX
 SG_ AutomationStatus_AV32 m1 : 16|4@1+ (1,0) [0|0] "" Vector__XXX
 SG_ AutomationStatus_AV31 m1 : 16|4@1+ (1,0) [0|0] "" Vector__XXX
 SG_ AutomationStatus_AV30 m1 : 16|4@1+ (1,0) [0|0] "" Vector__XXX
 SG_ AutomationStatus_AV29 m1 : 16|4@1+ (1,0) [0|0] "" Vector__XXX
 SG_ AutomationStatus_AV28 m1 : 16|4@1+ (1,0) [0|0] "" Vector__XXX
 SG_ AutomationStatus_AV27 m1 : 16|4@1+ (1,0) [0|0] "" Vector__XXX
 SG_ AutomationStatus_AV26 m1 : 16|4@1+ (1,0) [0|0] "" Vector__XXX
 SG_ AutomationStatus_AV25 m1 : 16|4@1+ (1,0) [0|0] "" Vector__XXX
 SG_ AutomationStatus_AV24 m1 : 16|4@1+ (1,0) [0|0] "" Vector__XXX
 SG_ AutomationStatus_AV23 m1 : 16|4@1+ (1,0) [0|0] "" Vector__XXX
 SG_ AutomationStatus_AV22 m1 : 16|4@1+ (1,0) [0|0] "" Vector__XXX
 SG_ AutomationStatus_AV21 m1 : 16|4@1+ (1,0) [0|0] "" Vector__XXX
 SG_ AutomationStatus_AV20 m1 : 16|4@1+ (1,0) [0|0] "" Vector__XXX
 SG_ AutomationStatus_AV19 m1 : 16|4@1+ (1,0) [0|0] "" Vector__XXX
 SG_ AutomationStatus_AV18 m1 : 16|4@1+ (1,0) [0|0] "" Vector__XXX
 SG_ AutomationStatus_AV17 m1 : 16|4@1+ (1,0) [0|0] "" Vector__XXX
 SG_ AutomationStatus_AV16 m1 : 16|4@1+ (1,0) [0|0] "" Vector__XXX
 SG_ AutomationStatus_AV15 m1 : 16|4@1+ (1,0) [0|0] "" Vector__XXX
 SG_ AutomationStatus_AV14 m1 : 16|4@1+ (1,0) [0|0] "" Vector__XXX
 SG_ AutomationStatus_AV13 m1 : 16|4@1+ (1,0) [0|0] "" Vector__XXX
 SG_ AutomationStatus_AV12 m1 : 16|4@1+ (1,0) [0|0] "" Vector__XXX
 SG_ AutomationStatus_AV11 m1 : 16|4@1+ (1,0) [0|0] "" Vector__XXX
 SG_ AutomationStatus_AV10 m1 : 16|4@1+ (1,0) [0|0] "" Vector__XXX
 SG_ AutomationStatus_AV09 m1 : 16|4@1+ (1,0) [0|0] "" Vector__XXX
 SG_ AutomationStatus_AV08 m1 : 16|4@1+ (1,0) [0|0] "" Vector__XXX
 SG_ AutomationStatus_AV07 m1 : 16|4@1+ (1,0) [0|0] "" Vector__XXX
 SG_ AutomationStatus_AV06 m1 : 16|4@1+ (1,0) [0|0] "" Vector__XXX
 SG_ AutomationStatus_AV05 m1 : 16|4@1+ (1,0) [0|0] "" Vector__XXX
 SG_ Curvature_EG m17 : 32|16@1+ (0.25,-8032) [-8032|8031.75] "1/km" Vector__XXX
 SG_ ExitReasonCode_EG m1 : 27|5@1+ (1,0) [0|0] "" Vector__XXX
 SG_ VehicleSpeed_VS m17 : 32|16@1+ (0.001,-32.128) [-32.127|32.127] "m/s" Vector__XXX
 SG_ ExitReasonCode_VS m1 : 27|5@1+ (1,0) [0|0] "" Vector__XXX
 SG_ Position_FH m17 : 32|16@1+ (0.01,0) [0|100] "%" Vector__XXX
 SG_ ExitReasonCode_FH m1 : 27|5@1+ (1,0) [0|0] "" Vector__XXX
 SG_ Speed_FPTO m17 : 32|16@1+ (0.125,-4016) [0|0] "1/min" Vector__XXX
 SG_ ExitReasonCode_FPTO m1 : 27|5@1+ (1,0) [0|0] "" Vector__XXX
 SG_ Flow_AV01 m17 : 32|16@1+ (0.004,-128.512) [0|0] "%" Vector__XXX
 SG_ ExitReasonCode_AV01 m1 : 27|5@1+ (1,0) [0|0] "" Vector__XXX
 SG_ TIMFunctionID M : 0|8@1+ (1,0) [0|255] "" Vector__XXX

BO_ 2624585470 AUTH21: 16 Vector__XXX
 SG_ SecurityTag m18 : 56|8@1+ (1,0) [0|255] "" Vector__XXX
 SG_ FullFreshnessValueTx m18 : 16|32@1+ (1,0) [0|4294967295] "" Vector__XXX
 SG_ SignedChallengeDataLength m7 : 40|16@1+ (1,0) [0|0] "" Vector__XXX
 SG_ RandomChallengeDataLength m5 : 40|16@1+ (1,0) [0|0] "" Vector__XXX
 SG_ SignedChallengeData m7 : 56|128@1+ (1,0) [0|0] "" Vector__XXX
 SG_ ClientCertType m3 : 32|8@1+ (1,0) [0|0] "" Vector__XXX
 SG_ ClientCertificateFormat m3 : 24|8@1+ (1,0) [0|0] "" Vector__XXX
 SG_ ImplementedAuthVersion m247 : 16|8@1+ (1,0) [0|255] "" Vector__XXX
 SG_ MinimumAuthVersion m247 : 24|8@1+ (1,0) [0|255] "" Vector__XXX
 SG_ ImplementedAuthConnectionVersion m250 : 48|8@1+ (1,0) [0|0] "" Vector__XXX
 SG_ MinimumAuthConnectionVersion m250 : 56|8@1+ (1,0) [0|0] "" Vector__XXX
 SG_ NumberOfAuthenticatedServers m9 : 8|8@1+ (1,0) [0|255] "" Vector__XXX
 SG_ LwAPossible m250 : 30|1@1+ (1,0) [0|0] "" Vector__XXX
 SG_ TestlabCertIsValid m250 : 29|1@1+ (1,0) [0|0] "" Vector__XXX
 SG_ ReStartAuth m250 : 31|1@1+ (1,0) [0|0] "" Vector__XXX
 SG_ ManufactSeriesCertIsValid m250 : 27|1@1+ (1,0) [0|0] "" Vector__XXX
 SG_ ManufactCertIsValid m250 : 28|1@1+ (1,0) [0|0] "" Vector__XXX
 SG_ DeviceCertIsValid m250 : 26|1@1+ (1,0) [0|0] "" Vector__XXX
 SG_ ChallengeSigned m250 : 25|1@1+ (1,0) [0|0] "" Vector__XXX
 SG_ AuthenticationStatus m250 : 16|4@1+ (1,0) [0|0] "" Vector__XXX
 SG_ RandomChallengeData m5 : 56|256@1+ (1,0) [0|0] "" Vector__XXX
 SG_ CertificateData m3 : 40|16@1+ (1,0) [0|0] "" Vector__XXX
 SG_ ErrorCode m3 : 8|8@1+ (1,0) [0|0] "" Vector__XXX
 SG_ ServerCertType m2 : 32|8@1+ (1,0) [0|0] "" Vector__XXX
 SG_ ServerCertificateFormat m2 : 24|8@1+ (1,0) [0|0] "" Vector__XXX
 SG_ AuthenticationType m2 : 20|4@1+ (1,0) [0|0] "" Vector__XXX
 SG_ MessageCode M : 0|8@1+ (1,0) [0|0] "" Vector__XXX

BO_ 2624651006 AUTH12: 16 Vector__XXX
 SG_ SecurityTag m17 : 56|8@1+ (1,0) [0|255] "" Vector__XXX
 SG_ FullFreshnessValueTx m17 : 16|32@1+ (1,0) [0|4294967295] "" Vector__XXX
 SG_ SignedChallengeDataLength m6 : 40|16@1+ (1,0) [0|0] "" Vector__XXX
 SG_ RandomChallengeDataLength m4 : 40|16@1+ (1,0) [0|0] "" Vector__XXX
 SG_ SignedChallengeData m6 : 56|128@1+ (1,0) [0|0] "" Vector__XXX
 SG_ ClientCertType m3 : 32|8@1+ (1,0) [0|0] "" Vector__XXX
 SG_ ClientCertificateFormat m3 : 24|8@1+ (1,0) [0|0] "" Vector__XXX
 SG_ ImplementedAuthVersion m248 : 16|8@1+ (1,0) [0|255] "" Vector__XXX
 SG_ MinimumAuthVersion m248 : 24|8@1+ (1,0) [0|255] "" Vector__XXX
 SG_ AuthConnectionVersion m249 : 56|8@1+ (1,0) [0|0] "" Vector__XXX
 SG_ NumberOfAuthenticatedClients m8 : 8|8@1+ (1,0) [0|255] "" Vector__XXX
 SG_ AuthenticationStatus m249 : 16|4@1+ (1,0) [0|0] "" Vector__XXX
 SG_ ChallengeSigned m249 : 25|1@1+ (1,0) [0|0] "" Vector__XXX
 SG_ DeviceCertIsValid m249 : 26|1@1+ (1,0) [0|0] "" Vector__XXX
 SG_ ManufactSeriesCertIsValid m249 : 27|1@1+ (1,0) [0|0] "" Vector__XXX
 SG_ ManufactCertIsValid m249 : 28|1@1+ (1,0) [0|0] "" Vector__XXX
 SG_ TestlabCertIsValid m249 : 29|1@1+ (1,0) [0|0] "" Vector__XXX
 SG_ LwAPossible m249 : 30|1@1+ (1,0) [0|0] "" Vector__XXX
 SG_ ReStartAuth m249 : 31|1@1+ (1,0) [0|0] "" Vector__XXX
 SG_ RandomChallengeData m4 : 56|256@1+ (1,0) [0|0] "" Vector__XXX
 SG_ CertificateData m2 : 40|16@1+ (1,0) [0|0] "" Vector__XXX
 SG_ ServerCertType m2 : 32|8@1+ (1,0) [0|0] "" Vector__XXX
 SG_ ServerCertificateFormat m2 : 24|8@1+ (1,0) [0|0] "" Vector__XXX
 SG_ AuthenticationType m2 : 20|4@1+ (1,0) [0|0] "" Vector__XXX
 SG_ MessageCode M : 0|8@1+ (1,0) [0|0] "" Vector__XXX
 SG_ ErrorCode m2 : 8|8@1+ (1,0) [0|0] "" Vector__XXX

CM_ BO_ 2621243134 "TIM server to TIM client (control status, v.2 and higher)";
CM_ SG_ 2621243134 State_RH "Front Hitch State";
CM_ SG_ 2621243134 State_RTL "Front Hitch State";
CM_ SG_ 2621243134 State_FTL "Front Hitch State";
CM_ SG_ 2621243134 State_FH "Front Hitch State";
CM_ BO_ 2624585470 "TIM message: Authentication client to Authentication server";
CM_ BO_ 2624651006 "TIM message: Authentication server to Authentication client";
BA_DEF_ SG_  "DDI" INT 0 65535;
BA_DEF_ BO_  "SingleFrame" INT 0 1;
BA_DEF_ BO_  "VFrameFormat" ENUM  "StandardCAN","ExtendedCAN","reserved","J1939PG","vector_leerstring";
BA_DEF_ BO_  "GenMsgSendType" ENUM  "cyclic","NotUsed","IfActive","NotUsed","NotUsed","NotUsed","NotUsed","NotUsed","noMsgSendType","vector_leerstring";
BA_DEF_ BO_  "GenMsgCycleTime" INT 0 3600000;
BA_DEF_ BO_  "GenMsgRequestable" INT 0 1;
BA_DEF_ BO_  "GenMsgNrOfRepetition" INT 0 1000000;
BA_DEF_ BO_  "GenMsgCycleTimeFast" INT 0 3600000;
BA_DEF_ SG_  "GenSigInactiveValue" INT 0 0;
BA_DEF_ BO_  "GenMsgFastOnStart" INT 0 100000;
BA_DEF_ BO_  "GenMsgStartDelayTime" INT 0 100000;
BA_DEF_ BO_  "GenMsgILSupport" ENUM  "No","Yes";
BA_DEF_ BO_  "GenMsgDelayTime" INT 0 1000;
BA_DEF_ SG_  "SPN" INT 0 524287;
BA_DEF_ SG_  "GenSigSendType" ENUM  "Cyclic","OnWrite","OnWriteWithRepetition","OnChange","OnChangeWithRepetition","IfActive","IfActiveWithRepetition","NoSigSendType";
BA_DEF_ SG_  "SigType" ENUM  "Default","Range","RangeSigned","ASCII","Discrete","Control","ReferencePGN","DTC","StringDelimiter","StringLength","StringLengthControl","MessageCounter","MessageChecksum";
BA_DEF_ SG_  "GenSigStartValue" INT -2147483648 2147483647;
BA_DEF_ SG_  "GenSigILSupport" ENUM  "No","Yes";
BA_DEF_DEF_  "DDI" 0;
BA_DEF_DEF_  "SingleFrame" 1;
BA_DEF_DEF_  "VFrameFormat" "J1939PG";
BA_DEF_DEF_  "GenMsgSendType" "noMsgSendType";
BA_DEF_DEF_  "GenMsgCycleTime" 0;
BA_DEF_DEF_  "GenMsgRequestable" 1;
BA_DEF_DEF_  "GenMsgNrOfRepetition" 0;
BA_DEF_DEF_  "GenMsgCycleTimeFast" 0;
BA_DEF_DEF_  "GenSigInactiveValue" 0;
BA_DEF_DEF_  "GenMsgFastOnStart" 0;
BA_DEF_DEF_  "GenMsgStartDelayTime" 0;
BA_DEF_DEF_  "GenMsgILSupport" "Yes";
BA_DEF_DEF_  "GenMsgDelayTime" 0;
BA_DEF_DEF_  "SPN" 0;
BA_DEF_DEF_  "GenSigSendType" "NoSigSendType";
BA_DEF_DEF_  "SigType" "Default";
BA_DEF_DEF_  "GenSigStartValue" 0;
BA_DEF_DEF_  "GenSigILSupport" "Yes";
BA_ "GenSigStartValue" SG_ 2621243134 FlowMaxIncAggressiveness_AV32 32128;
BA_ "SigType" SG_ 2621243134 FlowMaxIncAggressiveness_AV32 1;
BA_ "SPN" SG_ 2621243134 FlowMaxIncAggressiveness_AV32 8665;
BA_ "GenSigStartValue" SG_ 2621243134 FlowMaxIncAggressiveness_AV31 32128;
BA_ "SigType" SG_ 2621243134 FlowMaxIncAggressiveness_AV31 1;
BA_ "SPN" SG_ 2621243134 FlowMaxIncAggressiveness_AV31 8665;
BA_ "GenSigStartValue" SG_ 2621243134 FlowMaxIncAggressiveness_AV30 32128;
BA_ "SigType" SG_ 2621243134 FlowMaxIncAggressiveness_AV30 1;
BA_ "SPN" SG_ 2621243134 FlowMaxIncAggressiveness_AV30 8665;
BA_ "GenSigStartValue" SG_ 2621243134 FlowMaxIncAggressiveness_AV29 32128;
BA_ "SigType" SG_ 2621243134 FlowMaxIncAggressiveness_AV29 1;
BA_ "SPN" SG_ 2621243134 FlowMaxIncAggressiveness_AV29 8665;
BA_ "GenSigStartValue" SG_ 2621243134 FlowMaxIncAggressiveness_AV28 32128;
BA_ "SigType" SG_ 2621243134 FlowMaxIncAggressiveness_AV28 1;
BA_ "SPN" SG_ 2621243134 FlowMaxIncAggressiveness_AV28 8665;
BA_ "GenSigStartValue" SG_ 2621243134 FlowMaxIncAggressiveness_AV27 32128;
BA_ "SigType" SG_ 2621243134 FlowMaxIncAggressiveness_AV27 1;
BA_ "SPN" SG_ 2621243134 FlowMaxIncAggressiveness_AV27 8665;
BA_ "GenSigStartValue" SG_ 2621243134 FlowMaxIncAggressiveness_AV26 32128;
BA_ "SigType" SG_ 2621243134 FlowMaxIncAggressiveness_AV26 1;
BA_ "SPN" SG_ 2621243134 FlowMaxIncAggressiveness_AV26 8665;
BA_ "GenSigStartValue" SG_ 2621243134 FlowMaxIncAggressiveness_AV25 32128;
BA_ "SigType" SG_ 2621243134 FlowMaxIncAggressiveness_AV25 1;
BA_ "SPN" SG_ 2621243134 FlowMaxIncAggressiveness_AV25 8665;
BA_ "GenSigStartValue" SG_ 2621243134 FlowMaxIncAggressiveness_AV24 32128;
BA_ "SigType" SG_ 2621243134 FlowMaxIncAggressiveness_AV24 1;
BA_ "SPN" SG_ 2621243134 FlowMaxIncAggressiveness_AV24 8665;
BA_ "GenSigStartValue" SG_ 2621243134 FlowMaxIncAggressiveness_AV23 32128;
BA_ "SigType" SG_ 2621243134 FlowMaxIncAggressiveness_AV23 1;
BA_ "SPN" SG_ 2621243134 FlowMaxIncAggressiveness_AV23 8665;
BA_ "GenSigStartValue" SG_ 2621243134 FlowMaxIncAggressiveness_AV22 32128;
BA_ "SigType" SG_ 2621243134 FlowMaxIncAggressiveness_AV22 1;
BA_ "SPN" SG_ 2621243134 FlowMaxIncAggressiveness_AV22 8665;
BA_ "GenSigStartValue" SG_ 2621243134 FlowMaxIncAggressiveness_AV21 32128;
BA_ "SigType" SG_ 2621243134 FlowMaxIncAggressiveness_AV21 1;
BA_ "SPN" SG_ 2621243134 FlowMaxIncAggressiveness_AV21 8665;
BA_ "GenSigStartValue" SG_ 2621243134 FlowMaxIncAggressiveness_AV20 32128;
BA_ "SigType" SG_ 2621243134 FlowMaxIncAggressiveness_AV20 1;
BA_ "SPN" SG_ 2621243134 FlowMaxIncAggressiveness_AV20 8665;
BA_ "GenSigStartValue" SG_ 2621243134 FlowMaxIncAggressiveness_AV19 32128;
BA_ "SigType" SG_ 2621243134 FlowMaxIncAggressiveness_AV19 1;
BA_ "SPN" SG_ 2621243134 FlowMaxIncAggressiveness_AV19 8665;
BA_ "GenSigStartValue" SG_ 2621243134 FlowMaxIncAggressiveness_AV18 32128;
BA_ "SigType" SG_ 2621243134 FlowMaxIncAggressiveness_AV18 1;
BA_ "SPN" SG_ 2621243134 FlowMaxIncAggressiveness_AV18 8665;
BA_ "GenSigStartValue" SG_ 2621243134 FlowMaxIncAggressiveness_AV17 32128;
BA_ "SigType" SG_ 2621243134 FlowMaxIncAggressiveness_AV17 1;
BA_ "SPN" SG_ 2621243134 FlowMaxIncAggressiveness_AV17 8665;
BA_ "GenSigStartValue" SG_ 2621243134 FlowMaxIncAggressiveness_AV16 32128;
BA_ "SigType" SG_ 2621243134 FlowMaxIncAggressiveness_AV16 1;
BA_ "SPN" SG_ 2621243134 FlowMaxIncAggressiveness_AV16 8665;
BA_ "GenSigStartValue" SG_ 2621243134 FlowMaxIncAggressiveness_AV15 32128;
BA_ "SigType" SG_ 2621243134 FlowMaxIncAggressiveness_AV15 1;
BA_ "SPN" SG_ 2621243134 FlowMaxIncAggressiveness_AV15 8665;
BA_ "GenSigStartValue" SG_ 2621243134 FlowMaxIncAggressiveness_AV14 32128;
BA_ "SigType" SG_ 2621243134 FlowMaxIncAggressiveness_AV14 1;
BA_ "SPN" SG_ 2621243134 FlowMaxIncAggressiveness_AV14 8665;
BA_ "GenSigStartValue" SG_ 2621243134 FlowMaxIncAggressiveness_AV13 32128;
BA_ "SigType" SG_ 2621243134 FlowMaxIncAggressiveness_AV13 1;
BA_ "SPN" SG_ 2621243134 FlowMaxIncAggressiveness_AV13 8665;
BA_ "GenSigStartValue" SG_ 2621243134 FlowMaxIncAggressiveness_AV12 32128;
BA_ "SigType" SG_ 2621243134 FlowMaxIncAggressiveness_AV12 1;
BA_ "SPN" SG_ 2621243134 FlowMaxIncAggressiveness_AV12 8665;
BA_ "GenSigStartValue" SG_ 2621243134 FlowMaxIncAggressiveness_AV11 32128;
BA_ "SigType" SG_ 2621243134 FlowMaxIncAggressiveness_AV11 1;
BA_ "SPN" SG_ 2621243134 FlowMaxIncAggressiveness_AV11 8665;
BA_ "GenSigStartValue" SG_ 2621243134 FlowMaxIncAggressiveness_AV10 32128;
BA_ "SigType" SG_ 2621243134 FlowMaxIncAggressiveness_AV10 1;
BA_ "SPN" SG_ 2621243134 FlowMaxIncAggressiveness_AV10 8665;
BA_ "GenSigStartValue" SG_ 2621243134 FlowMaxIncAggressiveness_AV09 32128;
BA_ "SigType" SG_ 2621243134 FlowMaxIncAggressiveness_AV09 1;
BA_ "SPN" SG_ 2621243134 FlowMaxIncAggressiveness_AV09 8665;
BA_ "GenSigStartValue" SG_ 2621243134 FlowMaxIncAggressiveness_AV08 32128;
BA_ "SigType" SG_ 2621243134 FlowMaxIncAggressiveness_AV08 1;
BA_ "SPN" SG_ 2621243134 FlowMaxIncAggressiveness_AV08 8665;
BA_ "GenSigStartValue" SG_ 2621243134 FlowMaxIncAggressiveness_AV07 32128;
BA_ "SigType" SG_ 2621243134 FlowMaxIncAggressiveness_AV07 1;
BA_ "SPN" SG_ 2621243134 FlowMaxIncAggressiveness_AV07 8665;
BA_ "GenSigStartValue" SG_ 2621243134 FlowMaxIncAggressiveness_AV06 32128;
BA_ "SigType" SG_ 2621243134 FlowMaxIncAggressiveness_AV06 1;
BA_ "SPN" SG_ 2621243134 FlowMaxIncAggressiveness_AV06 8665;
BA_ "GenSigStartValue" SG_ 2621243134 FlowMaxIncAggressiveness_AV05 32128;
BA_ "SigType" SG_ 2621243134 FlowMaxIncAggressiveness_AV05 1;
BA_ "SPN" SG_ 2621243134 FlowMaxIncAggressiveness_AV05 8665;
BA_ "GenSigStartValue" SG_ 2621243134 FlowMaxIncAggressiveness_AV04 32128;
BA_ "SigType" SG_ 2621243134 FlowMaxIncAggressiveness_AV04 1;
BA_ "SPN" SG_ 2621243134 FlowMaxIncAggressiveness_AV04 8665;
BA_ "GenSigStartValue" SG_ 2621243134 FlowMaxIncAggressiveness_AV03 32128;
BA_ "SigType" SG_ 2621243134 FlowMaxIncAggressiveness_AV03 1;
BA_ "SPN" SG_ 2621243134 FlowMaxIncAggressiveness_AV03 8665;
BA_ "GenSigStartValue" SG_ 2621243134 FlowMaxIncAggressiveness_AV02 32128;
BA_ "SigType" SG_ 2621243134 FlowMaxIncAggressiveness_AV02 1;
BA_ "SPN" SG_ 2621243134 FlowMaxIncAggressiveness_AV02 8665;
BA_ "SPN" SG_ 2621243134 FlowMaxIncAggressiveness_AV01 8665;
BA_ "SigType" SG_ 2621243134 FlowMaxIncAggressiveness_AV01 1;
BA_ "GenSigStartValue" SG_ 2621243134 FlowMaxDecAggressiveness_AV32 32128;
BA_ "SigType" SG_ 2621243134 FlowMaxDecAggressiveness_AV32 1;
BA_ "SPN" SG_ 2621243134 FlowMaxDecAggressiveness_AV32 8665;
BA_ "GenSigStartValue" SG_ 2621243134 FlowMaxDecAggressiveness_AV31 32128;
BA_ "SigType" SG_ 2621243134 FlowMaxDecAggressiveness_AV31 1;
BA_ "SPN" SG_ 2621243134 FlowMaxDecAggressiveness_AV31 8665;
BA_ "GenSigStartValue" SG_ 2621243134 FlowMaxDecAggressiveness_AV30 32128;
BA_ "SigType" SG_ 2621243134 FlowMaxDecAggressiveness_AV30 1;
BA_ "SPN" SG_ 2621243134 FlowMaxDecAggressiveness_AV30 8665;
BA_ "GenSigStartValue" SG_ 2621243134 FlowMaxDecAggressiveness_AV29 32128;
BA_ "SigType" SG_ 2621243134 FlowMaxDecAggressiveness_AV29 1;
BA_ "SPN" SG_ 2621243134 FlowMaxDecAggressiveness_AV29 8665;
BA_ "GenSigStartValue" SG_ 2621243134 FlowMaxDecAggressiveness_AV28 32128;
BA_ "SigType" SG_ 2621243134 FlowMaxDecAggressiveness_AV28 1;
BA_ "SPN" SG_ 2621243134 FlowMaxDecAggressiveness_AV28 8665;
BA_ "GenSigStartValue" SG_ 2621243134 FlowMaxDecAggressiveness_AV27 32128;
BA_ "SigType" SG_ 2621243134 FlowMaxDecAggressiveness_AV27 1;
BA_ "SPN" SG_ 2621243134 FlowMaxDecAggressiveness_AV27 8665;
BA_ "GenSigStartValue" SG_ 2621243134 FlowMaxDecAggressiveness_AV26 32128;
BA_ "SigType" SG_ 2621243134 FlowMaxDecAggressiveness_AV26 1;
BA_ "SPN" SG_ 2621243134 FlowMaxDecAggressiveness_AV26 8665;
BA_ "GenSigStartValue" SG_ 2621243134 FlowMaxDecAggressiveness_AV25 32128;
BA_ "SigType" SG_ 2621243134 FlowMaxDecAggressiveness_AV25 1;
BA_ "SPN" SG_ 2621243134 FlowMaxDecAggressiveness_AV25 8665;
BA_ "GenSigStartValue" SG_ 2621243134 FlowMaxDecAggressiveness_AV24 32128;
BA_ "SigType" SG_ 2621243134 FlowMaxDecAggressiveness_AV24 1;
BA_ "SPN" SG_ 2621243134 FlowMaxDecAggressiveness_AV24 8665;
BA_ "GenSigStartValue" SG_ 2621243134 FlowMaxDecAggressiveness_AV23 32128;
BA_ "SigType" SG_ 2621243134 FlowMaxDecAggressiveness_AV23 1;
BA_ "SPN" SG_ 2621243134 FlowMaxDecAggressiveness_AV23 8665;
BA_ "GenSigStartValue" SG_ 2621243134 FlowMaxDecAggressiveness_AV22 32128;
BA_ "SigType" SG_ 2621243134 FlowMaxDecAggressiveness_AV22 1;
BA_ "SPN" SG_ 2621243134 FlowMaxDecAggressiveness_AV22 8665;
BA_ "GenSigStartValue" SG_ 2621243134 FlowMaxDecAggressiveness_AV21 32128;
BA_ "SigType" SG_ 2621243134 FlowMaxDecAggressiveness_AV21 1;
BA_ "SPN" SG_ 2621243134 FlowMaxDecAggressiveness_AV21 8665;
BA_ "GenSigStartValue" SG_ 2621243134 FlowMaxDecAggressiveness_AV20 32128;
BA_ "SigType" SG_ 2621243134 FlowMaxDecAggressiveness_AV20 1;
BA_ "SPN" SG_ 2621243134 FlowMaxDecAggressiveness_AV20 8665;
BA_ "GenSigStartValue" SG_ 2621243134 FlowMaxDecAggressiveness_AV19 32128;
BA_ "SigType" SG_ 2621243134 FlowMaxDecAggressiveness_AV19 1;
BA_ "SPN" SG_ 2621243134 FlowMaxDecAggressiveness_AV19 8665;
BA_ "GenSigStartValue" SG_ 2621243134 FlowMaxDecAggressiveness_AV18 32128;
BA_ "SigType" SG_ 2621243134 FlowMaxDecAggressiveness_AV18 1;
BA_ "SPN" SG_ 2621243134 FlowMaxDecAggressiveness_AV18 8665;
BA_ "GenSigStartValue" SG_ 2621243134 FlowMaxDecAggressiveness_AV17 32128;
BA_ "SigType" SG_ 2621243134 FlowMaxDecAggressiveness_AV17 1;
BA_ "SPN" SG_ 2621243134 FlowMaxDecAggressiveness_AV17 8665;
BA_ "GenSigStartValue" SG_ 2621243134 FlowMaxDecAggressiveness_AV16 32128;
BA_ "SigType" SG_ 2621243134 FlowMaxDecAggressiveness_AV16 1;
BA_ "SPN" SG_ 2621243134 FlowMaxDecAggressiveness_AV16 8665;
BA_ "GenSigStartValue" SG_ 2621243134 FlowMaxDecAggressiveness_AV15 32128;
BA_ "SigType" SG_ 2621243134 FlowMaxDecAggressiveness_AV15 1;
BA_ "SPN" SG_ 2621243134 FlowMaxDecAggressiveness_AV15 8665;
BA_ "GenSigStartValue" SG_ 2621243134 FlowMaxDecAggressiveness_AV14 32128;
BA_ "SigType" SG_ 2621243134 FlowMaxDecAggressiveness_AV14 1;
BA_ "SPN" SG_ 2621243134 FlowMaxDecAggressiveness_AV14 8665;
BA_ "GenSigStartValue" SG_ 2621243134 FlowMaxDecAggressiveness_AV13 32128;
BA_ "SigType" SG_ 2621243134 FlowMaxDecAggressiveness_AV13 1;
BA_ "SPN" SG_ 2621243134 FlowMaxDecAggressiveness_AV13 8665;
BA_ "GenSigStartValue" SG_ 2621243134 FlowMaxDecAggressiveness_AV12 32128;
BA_ "SigType" SG_ 2621243134 FlowMaxDecAggressiveness_AV12 1;
BA_ "SPN" SG_ 2621243134 FlowMaxDecAggressiveness_AV12 8665;
BA_ "GenSigStartValue" SG_ 2621243134 FlowMaxDecAggressiveness_AV11 32128;
BA_ "SigType" SG_ 2621243134 FlowMaxDecAggressiveness_AV11 1;
BA_ "SPN" SG_ 2621243134 FlowMaxDecAggressiveness_AV11 8665;
BA_ "GenSigStartValue" SG_ 2621243134 FlowMaxDecAggressiveness_AV10 32128;
BA_ "SigType" SG_ 2621243134 FlowMaxDecAggressiveness_AV10 1;
BA_ "SPN" SG_ 2621243134 FlowMaxDecAggressiveness_AV10 8665;
BA_ "GenSigStartValue" SG_ 2621243134 FlowMaxDecAggressiveness_AV09 32128;
BA_ "SigType" SG_ 2621243134 FlowMaxDecAggressiveness_AV09 1;
BA_ "SPN" SG_ 2621243134 FlowMaxDecAggressiveness_AV09 8665;
BA_ "GenSigStartValue" SG_ 2621243134 FlowMaxDecAggressiveness_AV08 32128;
BA_ "SigType" SG_ 2621243134 FlowMaxDecAggressiveness_AV08 1;
BA_ "SPN" SG_ 2621243134 FlowMaxDecAggressiveness_AV08 8665;
BA_ "GenSigStartValue" SG_ 2621243134 FlowMaxDecAggressiveness_AV07 32128;
BA_ "SigType" SG_ 2621243134 FlowMaxDecAggressiveness_AV07 1;
BA_ "SPN" SG_ 2621243134 FlowMaxDecAggressiveness_AV07 8665;
BA_ "GenSigStartValue" SG_ 2621243134 FlowMaxDecAggressiveness_AV06 32128;
BA_ "SigType" SG_ 2621243134 FlowMaxDecAggressiveness_AV06 1;
BA_ "SPN" SG_ 2621243134 FlowMaxDecAggressiveness_AV06 8665;
BA_ "GenSigStartValue" SG_ 2621243134 FlowMaxDecAggressiveness_AV05 32128;
BA_ "SigType" SG_ 2621243134 FlowMaxDecAggressiveness_AV05 1;
BA_ "SPN" SG_ 2621243134 FlowMaxDecAggressiveness_AV05 8665;
BA_ "GenSigStartValue" SG_ 2621243134 FlowMaxDecAggressiveness_AV04 32128;
BA_ "SigType" SG_ 2621243134 FlowMaxDecAggressiveness_AV04 1;
BA_ "SPN" SG_ 2621243134 FlowMaxDecAggressiveness_AV04 8665;
BA_ "GenSigStartValue" SG_ 2621243134 FlowMaxDecAggressiveness_AV03 32128;
BA_ "SigType" SG_ 2621243134 FlowMaxDecAggressiveness_AV03 1;
BA_ "SPN" SG_ 2621243134 FlowMaxDecAggressiveness_AV03 8665;
BA_ "GenSigStartValue" SG_ 2621243134 FlowMaxDecAggressiveness_AV02 32128;
BA_ "SigType" SG_ 2621243134 FlowMaxDecAggressiveness_AV02 1;
BA_ "SPN" SG_ 2621243134 FlowMaxDecAggressiveness_AV02 8665;
BA_ "GenSigStartValue" SG_ 2621243134 FlowMaxDecAggressiveness_AV01 32128;
BA_ "SigType" SG_ 2621243134 FlowMaxDecAggressiveness_AV01 1;
BA_ "SPN" SG_ 2621243134 FlowMaxDecAggressiveness_AV01 8665;
BA_ "GenSigStartValue" SG_ 2621243134 CurvatureMaxAggressiveness_EG 1;
BA_ "SigType" SG_ 2621243134 CurvatureMaxAggressiveness_EG 1;
BA_ "SPN" SG_ 2621243134 CurvatureMaxAggressiveness_EG 8665;
BA_ "GenSigStartValue" SG_ 2621243134 VSpeedMaxDecAggressiveness_VS 1;
BA_ "SigType" SG_ 2621243134 VSpeedMaxDecAggressiveness_VS 1;
BA_ "SPN" SG_ 2621243134 VSpeedMaxDecAggressiveness_VS 8665;
BA_ "GenSigStartValue" SG_ 2621243134 VSpeedMaxIncAggressiveness_VS 1;
BA_ "SigType" SG_ 2621243134 VSpeedMaxIncAggressiveness_VS 1;
BA_ "SPN" SG_ 2621243134 VSpeedMaxIncAggressiveness_VS 8665;
BA_ "GenSigStartValue" SG_ 2621243134 PositonMaxIncAggressiveness_RTL 1;
BA_ "SigType" SG_ 2621243134 PositonMaxIncAggressiveness_RTL 1;
BA_ "SPN" SG_ 2621243134 PositonMaxIncAggressiveness_RTL 8665;
BA_ "GenSigStartValue" SG_ 2621243134 PositonMaxIncAggressiveness_FTL 1;
BA_ "SigType" SG_ 2621243134 PositonMaxIncAggressiveness_FTL 1;
BA_ "SPN" SG_ 2621243134 PositonMaxIncAggressiveness_FTL 8665;
BA_ "GenSigStartValue" SG_ 2621243134 PositonMaxDecAggressiveness_RTL 1;
BA_ "SigType" SG_ 2621243134 PositonMaxDecAggressiveness_RTL 1;
BA_ "SPN" SG_ 2621243134 PositonMaxDecAggressiveness_RTL 8665;
BA_ "GenSigStartValue" SG_ 2621243134 PositonMaxDecAggressiveness_FTL 1;
BA_ "SigType" SG_ 2621243134 PositonMaxDecAggressiveness_FTL 1;
BA_ "SPN" SG_ 2621243134 PositonMaxDecAggressiveness_FTL 8665;
BA_ "GenSigStartValue" SG_ 2621243134 PositonMaxIncAggressiveness_RH 1;
BA_ "SigType" SG_ 2621243134 PositonMaxIncAggressiveness_RH 1;
BA_ "SPN" SG_ 2621243134 PositonMaxIncAggressiveness_RH 8665;
BA_ "GenSigStartValue" SG_ 2621243134 PositonMaxIncAggressiveness_FH 1;
BA_ "SigType" SG_ 2621243134 PositonMaxIncAggressiveness_FH 1;
BA_ "SPN" SG_ 2621243134 PositonMaxIncAggressiveness_FH 8665;
BA_ "GenSigStartValue" SG_ 2621243134 PositonMaxDecAggressiveness_RH 1;
BA_ "SigType" SG_ 2621243134 PositonMaxDecAggressiveness_RH 1;
BA_ "SPN" SG_ 2621243134 PositonMaxDecAggressiveness_RH 8665;
BA_ "GenSigStartValue" SG_ 2621243134 PositonMaxDecAggressiveness_FH 1;
BA_ "SigType" SG_ 2621243134 PositonMaxDecAggressiveness_FH 1;
BA_ "SPN" SG_ 2621243134 PositonMaxDecAggressiveness_FH 8665;
BA_ "GenSigStartValue" SG_ 2621243134 SpeedMaxDecAggressiveness_RPTO 1;
BA_ "SigType" SG_ 2621243134 SpeedMaxDecAggressiveness_RPTO 1;
BA_ "SPN" SG_ 2621243134 SpeedMaxDecAggressiveness_RPTO 8665;
BA_ "GenSigStartValue" SG_ 2621243134 SpeedMaxDecAggressiveness_FPTO 1;
BA_ "SigType" SG_ 2621243134 SpeedMaxDecAggressiveness_FPTO 1;
BA_ "SPN" SG_ 2621243134 SpeedMaxDecAggressiveness_FPTO 8665;
BA_ "GenSigStartValue" SG_ 2621243134 SpeedMaxIncAggressiveness_RPTO 1;
BA_ "SigType" SG_ 2621243134 SpeedMaxIncAggressiveness_RPTO 1;
BA_ "SPN" SG_ 2621243134 SpeedMaxIncAggressiveness_RPTO 8665;
BA_ "GenSigStartValue" SG_ 2621243134 SpeedMaxIncAggressiveness_FPTO 1;
BA_ "SigType" SG_ 2621243134 SpeedMaxIncAggressiveness_FPTO 1;
BA_ "SPN" SG_ 2621243134 SpeedMaxIncAggressiveness_FPTO 8665;
BA_ "SPN" SG_ 2621243134 State_RH 23869;
BA_ "SPN" SG_ 2621243134 State_RTL 23871;
BA_ "SPN" SG_ 2621243134 State_FTL 23870;
BA_ "SPN" SG_ 2621243134 State_FH 23868;
BA_ "GenSigStartValue" SG_ 2621243134 MinimumSpeedBackward_CM1GP_VS 32128;
BA_ "GenSigStartValue" SG_ 2621243134 MaximumSpeedBackward_CM1GP_VS 32128;
BA_ "GenSigStartValue" SG_ 2621243134 MinimumSpeedForward_CM1GP_VS 32128;
BA_ "GenSigStartValue" SG_ 2621243134 MaximumSpeedForward_CM1GP_VS 32128;
BA_ "SPN" SG_ 2621243134 ControlMode1_RTL 23578;
BA_ "SPN" SG_ 2621243134 NumOfControlModes_RTL 23872;
BA_ "SPN" SG_ 2621243134 NumOfBytes_CM1_RTL 23873;
BA_ "SPN" SG_ 2621243134 Position_RTL 23584;
BA_ "SPN" SG_ 2621243134 Position_FTL 23583;
BA_ "SPN" SG_ 2621243134 ExitReasonCode_RTL 23588;
BA_ "SPN" SG_ 2621243134 ExitReasonCode_FTL 23587;
BA_ "SPN" SG_ 2621243134 AutomationStatus_RTL 23586;
BA_ "SPN" SG_ 2621243134 AutomationStatus_FTL 23585;
BA_ "SPN" SG_ 2621243134 ControlMode1_FTL 23578;
BA_ "SPN" SG_ 2621243134 NumOfBytes_CM1_FTL 23873;
BA_ "SPN" SG_ 2621243134 NumOfControlModes_FTL 23872;
BA_ "SPN" SG_ 2621243134 NumOfBytes_CM1_VS 23873;
BA_ "SPN" SG_ 2621243134 ControlMode1_VS 23578;
BA_ "SPN" SG_ 2621243134 NumOfControlModes_VS 23872;
BA_ "SPN" SG_ 2621243134 Position_RH 8768;
BA_ "SigType" SG_ 2621243134 Position_RH 1;
BA_ "SPN" SG_ 2621243134 Speed_RPTO 8762;
BA_ "GenSigStartValue" SG_ 2621243134 Speed_RPTO 32128;
BA_ "SigType" SG_ 2621243134 Speed_RPTO 1;
BA_ "GenSigStartValue" SG_ 2621243134 Flow_AV32 32128;
BA_ "SigType" SG_ 2621243134 Flow_AV32 1;
BA_ "SPN" SG_ 2621243134 Flow_AV32 8696;
BA_ "GenSigStartValue" SG_ 2621243134 Flow_AV31 32128;
BA_ "SigType" SG_ 2621243134 Flow_AV31 1;
BA_ "SPN" SG_ 2621243134 Flow_AV31 8695;
BA_ "GenSigStartValue" SG_ 2621243134 Flow_AV30 32128;
BA_ "SigType" SG_ 2621243134 Flow_AV30 1;
BA_ "SPN" SG_ 2621243134 Flow_AV30 8694;
BA_ "GenSigStartValue" SG_ 2621243134 Flow_AV29 32128;
BA_ "SigType" SG_ 2621243134 Flow_AV29 1;
BA_ "SPN" SG_ 2621243134 Flow_AV29 8693;
BA_ "GenSigStartValue" SG_ 2621243134 Flow_AV28 32128;
BA_ "SigType" SG_ 2621243134 Flow_AV28 1;
BA_ "SPN" SG_ 2621243134 Flow_AV28 8692;
BA_ "GenSigStartValue" SG_ 2621243134 Flow_AV27 32128;
BA_ "SigType" SG_ 2621243134 Flow_AV27 1;
BA_ "SPN" SG_ 2621243134 Flow_AV27 8691;
BA_ "GenSigStartValue" SG_ 2621243134 Flow_AV26 32128;
BA_ "SigType" SG_ 2621243134 Flow_AV26 1;
BA_ "SPN" SG_ 2621243134 Flow_AV26 8690;
BA_ "GenSigStartValue" SG_ 2621243134 Flow_AV25 32128;
BA_ "SigType" SG_ 2621243134 Flow_AV25 1;
BA_ "SPN" SG_ 2621243134 Flow_AV25 8689;
BA_ "GenSigStartValue" SG_ 2621243134 Flow_AV24 32128;
BA_ "SigType" SG_ 2621243134 Flow_AV24 1;
BA_ "SPN" SG_ 2621243134 Flow_AV24 8688;
BA_ "GenSigStartValue" SG_ 2621243134 Flow_AV23 32128;
BA_ "SigType" SG_ 2621243134 Flow_AV23 1;
BA_ "SPN" SG_ 2621243134 Flow_AV23 8687;
BA_ "GenSigStartValue" SG_ 2621243134 Flow_AV22 32128;
BA_ "SigType" SG_ 2621243134 Flow_AV22 1;
BA_ "SPN" SG_ 2621243134 Flow_AV22 8686;
BA_ "GenSigStartValue" SG_ 2621243134 Flow_AV21 32128;
BA_ "SigType" SG_ 2621243134 Flow_AV21 1;
BA_ "SPN" SG_ 2621243134 Flow_AV21 8685;
BA_ "GenSigStartValue" SG_ 2621243134 Flow_AV20 32128;
BA_ "SigType" SG_ 2621243134 Flow_AV20 1;
BA_ "SPN" SG_ 2621243134 Flow_AV20 8684;
BA_ "GenSigStartValue" SG_ 2621243134 Flow_AV19 32128;
BA_ "SigType" SG_ 2621243134 Flow_AV19 1;
BA_ "SPN" SG_ 2621243134 Flow_AV19 8683;
BA_ "GenSigStartValue" SG_ 2621243134 Flow_AV18 32128;
BA_ "SigType" SG_ 2621243134 Flow_AV18 1;
BA_ "SPN" SG_ 2621243134 Flow_AV18 8682;
BA_ "GenSigStartValue" SG_ 2621243134 Flow_AV17 32128;
BA_ "SigType" SG_ 2621243134 Flow_AV17 1;
BA_ "SPN" SG_ 2621243134 Flow_AV17 8681;
BA_ "GenSigStartValue" SG_ 2621243134 Flow_AV16 32128;
BA_ "SigType" SG_ 2621243134 Flow_AV16 1;
BA_ "SPN" SG_ 2621243134 Flow_AV16 8680;
BA_ "GenSigStartValue" SG_ 2621243134 Flow_AV15 32128;
BA_ "SigType" SG_ 2621243134 Flow_AV15 1;
BA_ "SPN" SG_ 2621243134 Flow_AV15 8679;
BA_ "GenSigStartValue" SG_ 2621243134 Flow_AV14 32128;
BA_ "SigType" SG_ 2621243134 Flow_AV14 1;
BA_ "SPN" SG_ 2621243134 Flow_AV14 8678;
BA_ "GenSigStartValue" SG_ 2621243134 Flow_AV13 32128;
BA_ "SigType" SG_ 2621243134 Flow_AV13 1;
BA_ "SPN" SG_ 2621243134 Flow_AV13 8677;
BA_ "GenSigStartValue" SG_ 2621243134 Flow_AV12 32128;
BA_ "SigType" SG_ 2621243134 Flow_AV12 1;
BA_ "SPN" SG_ 2621243134 Flow_AV12 8676;
BA_ "GenSigStartValue" SG_ 2621243134 Flow_AV11 32128;
BA_ "SigType" SG_ 2621243134 Flow_AV11 1;
BA_ "SPN" SG_ 2621243134 Flow_AV11 8675;
BA_ "GenSigStartValue" SG_ 2621243134 Flow_AV10 32128;
BA_ "SigType" SG_ 2621243134 Flow_AV10 1;
BA_ "SPN" SG_ 2621243134 Flow_AV10 8674;
BA_ "GenSigStartValue" SG_ 2621243134 Flow_AV09 32128;
BA_ "SigType" SG_ 2621243134 Flow_AV09 1;
BA_ "SPN" SG_ 2621243134 Flow_AV09 8673;
BA_ "GenSigStartValue" SG_ 2621243134 Flow_AV08 32128;
BA_ "SigType" SG_ 2621243134 Flow_AV08 1;
BA_ "SPN" SG_ 2621243134 Flow_AV08 8672;
BA_ "GenSigStartValue" SG_ 2621243134 Flow_AV07 32128;
BA_ "SigType" SG_ 2621243134 Flow_AV07 1;
BA_ "SPN" SG_ 2621243134 Flow_AV07 8671;
BA_ "GenSigStartValue" SG_ 2621243134 Flow_AV06 32128;
BA_ "SigType" SG_ 2621243134 Flow_AV06 1;
BA_ "SPN" SG_ 2621243134 Flow_AV06 8670;
BA_ "GenSigStartValue" SG_ 2621243134 Flow_AV05 32128;
BA_ "SigType" SG_ 2621243134 Flow_AV05 1;
BA_ "SPN" SG_ 2621243134 Flow_AV05 8669;
BA_ "GenSigStartValue" SG_ 2621243134 Flow_AV04 32128;
BA_ "SigType" SG_ 2621243134 Flow_AV04 1;
BA_ "SPN" SG_ 2621243134 Flow_AV04 8668;
BA_ "GenSigStartValue" SG_ 2621243134 Flow_AV03 32128;
BA_ "SigType" SG_ 2621243134 Flow_AV03 1;
BA_ "SPN" SG_ 2621243134 Flow_AV03 8667;
BA_ "GenSigStartValue" SG_ 2621243134 Flow_AV02 32128;
BA_ "SigType" SG_ 2621243134 Flow_AV02 1;
BA_ "SPN" SG_ 2621243134 Flow_AV02 8666;
BA_ "SPN" SG_ 2621243134 FlowType_AV32 13282;
BA_ "SPN" SG_ 2621243134 FlowType_AV31 13281;
BA_ "SPN" SG_ 2621243134 FlowType_AV30 13280;
BA_ "SPN" SG_ 2621243134 FlowType_AV29 13279;
BA_ "SPN" SG_ 2621243134 FlowType_AV28 13278;
BA_ "SPN" SG_ 2621243134 FlowType_AV27 13277;
BA_ "SPN" SG_ 2621243134 FlowType_AV26 13276;
BA_ "SPN" SG_ 2621243134 FlowType_AV25 13275;
BA_ "SPN" SG_ 2621243134 FlowType_AV24 13274;
BA_ "SPN" SG_ 2621243134 FlowType_AV23 13273;
BA_ "SPN" SG_ 2621243134 FlowType_AV22 13272;
BA_ "SPN" SG_ 2621243134 FlowType_AV21 13271;
BA_ "SPN" SG_ 2621243134 FlowType_AV20 13270;
BA_ "SPN" SG_ 2621243134 FlowType_AV19 13269;
BA_ "SPN" SG_ 2621243134 FlowType_AV18 13268;
BA_ "SPN" SG_ 2621243134 FlowType_AV17 13267;
BA_ "SPN" SG_ 2621243134 FlowType_AV16 13266;
BA_ "SPN" SG_ 2621243134 FlowType_AV15 13265;
BA_ "SPN" SG_ 2621243134 FlowType_AV14 13264;
BA_ "SPN" SG_ 2621243134 FlowType_AV13 13263;
BA_ "SPN" SG_ 2621243134 FlowType_AV12 13262;
BA_ "SPN" SG_ 2621243134 FlowType_AV11 13261;
BA_ "SPN" SG_ 2621243134 FlowType_AV10 13260;
BA_ "SPN" SG_ 2621243134 FlowType_AV09 13259;
BA_ "SPN" SG_ 2621243134 FlowType_AV08 13258;
BA_ "SPN" SG_ 2621243134 FlowType_AV07 13257;
BA_ "SPN" SG_ 2621243134 FlowType_AV06 13256;
BA_ "SPN" SG_ 2621243134 FlowType_AV05 13255;
BA_ "SPN" SG_ 2621243134 FlowType_AV04 13254;
BA_ "SPN" SG_ 2621243134 FlowType_AV03 13253;
BA_ "SPN" SG_ 2621243134 FlowType_AV02 13252;
BA_ "SPN" SG_ 2621243134 FlowType_AV01 13251;
BA_ "SPN" SG_ 2621243134 ExitReasonCode_RPTO 8766;
BA_ "SPN" SG_ 2621243134 ExitReasonCode_RH 8772;
BA_ "SPN" SG_ 2621243134 ExitReasonCode_AV32 8760;
BA_ "SPN" SG_ 2621243134 ExitReasonCode_AV31 8759;
BA_ "SPN" SG_ 2621243134 ExitReasonCode_AV30 8758;
BA_ "SPN" SG_ 2621243134 ExitReasonCode_AV29 8757;
BA_ "SPN" SG_ 2621243134 ExitReasonCode_AV28 8756;
BA_ "SPN" SG_ 2621243134 ExitReasonCode_AV27 8755;
BA_ "SPN" SG_ 2621243134 ExitReasonCode_AV26 8754;
BA_ "SPN" SG_ 2621243134 ExitReasonCode_AV25 8753;
BA_ "SPN" SG_ 2621243134 ExitReasonCode_AV24 8752;
BA_ "SPN" SG_ 2621243134 ExitReasonCode_AV23 8751;
BA_ "SPN" SG_ 2621243134 ExitReasonCode_AV22 8750;
BA_ "SPN" SG_ 2621243134 ExitReasonCode_AV21 8749;
BA_ "SPN" SG_ 2621243134 ExitReasonCode_AV20 8748;
BA_ "SPN" SG_ 2621243134 ExitReasonCode_AV19 8747;
BA_ "SPN" SG_ 2621243134 ExitReasonCode_AV18 8746;
BA_ "SPN" SG_ 2621243134 ExitReasonCode_AV17 8745;
BA_ "SPN" SG_ 2621243134 ExitReasonCode_AV16 8744;
BA_ "SPN" SG_ 2621243134 ExitReasonCode_AV15 8743;
BA_ "SPN" SG_ 2621243134 ExitReasonCode_AV14 8742;
BA_ "SPN" SG_ 2621243134 ExitReasonCode_AV13 8741;
BA_ "SPN" SG_ 2621243134 ExitReasonCode_AV12 8740;
BA_ "SPN" SG_ 2621243134 ExitReasonCode_AV11 8739;
BA_ "SPN" SG_ 2621243134 ExitReasonCode_AV10 8738;
BA_ "SPN" SG_ 2621243134 ExitReasonCode_AV09 8737;
BA_ "SPN" SG_ 2621243134 ExitReasonCode_AV08 8736;
BA_ "SPN" SG_ 2621243134 ExitReasonCode_AV07 8735;
BA_ "SPN" SG_ 2621243134 ExitReasonCode_AV06 8734;
BA_ "SPN" SG_ 2621243134 ExitReasonCode_AV05 8733;
BA_ "SPN" SG_ 2621243134 ExitReasonCode_AV04 8732;
BA_ "SPN" SG_ 2621243134 ExitReasonCode_AV03 8731;
BA_ "SPN" SG_ 2621243134 ExitReasonCode_AV02 8730;
BA_ "SPN" SG_ 2621243134 AutomationStatus_AV04 8700;
BA_ "SPN" SG_ 2621243134 AutomationStatus_AV03 8699;
BA_ "SPN" SG_ 2621243134 AutomationStatus_AV02 8698;
BA_ "SPN" SG_ 2621243134 AutomationStatus_AV01 8697;
BA_ "SPN" SG_ 2621243134 AutomationStatus_EG 8777;
BA_ "SPN" SG_ 2621243134 AutomationStatus_VS 8774;
BA_ "SPN" SG_ 2621243134 AutomationStatus_RH 8770;
BA_ "SPN" SG_ 2621243134 AutomationStatus_FH 8769;
BA_ "SPN" SG_ 2621243134 AutomationStatus_RPTO 8764;
BA_ "SPN" SG_ 2621243134 AutomationStatus_FPTO 8763;
BA_ "SPN" SG_ 2621243134 AutomationStatus_AV32 8728;
BA_ "SPN" SG_ 2621243134 AutomationStatus_AV31 8727;
BA_ "SPN" SG_ 2621243134 AutomationStatus_AV30 8726;
BA_ "SPN" SG_ 2621243134 AutomationStatus_AV29 8725;
BA_ "SPN" SG_ 2621243134 AutomationStatus_AV28 8724;
BA_ "SPN" SG_ 2621243134 AutomationStatus_AV27 8723;
BA_ "SPN" SG_ 2621243134 AutomationStatus_AV26 8722;
BA_ "SPN" SG_ 2621243134 AutomationStatus_AV25 8721;
BA_ "SPN" SG_ 2621243134 AutomationStatus_AV24 8720;
BA_ "SPN" SG_ 2621243134 AutomationStatus_AV23 8719;
BA_ "SPN" SG_ 2621243134 AutomationStatus_AV22 8718;
BA_ "SPN" SG_ 2621243134 AutomationStatus_AV21 8717;
BA_ "SPN" SG_ 2621243134 AutomationStatus_AV20 8716;
BA_ "SPN" SG_ 2621243134 AutomationStatus_AV19 8715;
BA_ "SPN" SG_ 2621243134 AutomationStatus_AV18 8714;
BA_ "SPN" SG_ 2621243134 AutomationStatus_AV17 8713;
BA_ "SPN" SG_ 2621243134 AutomationStatus_AV16 8712;
BA_ "SPN" SG_ 2621243134 AutomationStatus_AV15 8711;
BA_ "SPN" SG_ 2621243134 AutomationStatus_AV14 8710;
BA_ "SPN" SG_ 2621243134 AutomationStatus_AV13 8709;
BA_ "SPN" SG_ 2621243134 AutomationStatus_AV12 8708;
BA_ "SPN" SG_ 2621243134 AutomationStatus_AV11 8707;
BA_ "SPN" SG_ 2621243134 AutomationStatus_AV10 8706;
BA_ "SPN" SG_ 2621243134 AutomationStatus_AV09 8705;
BA_ "SPN" SG_ 2621243134 AutomationStatus_AV08 8704;
BA_ "SPN" SG_ 2621243134 AutomationStatus_AV07 8703;
BA_ "SPN" SG_ 2621243134 AutomationStatus_AV06 8702;
BA_ "SPN" SG_ 2621243134 AutomationStatus_AV05 8701;
BA_ "SPN" SG_ 2621243134 Curvature_EG 8776;
BA_ "SigType" SG_ 2621243134 Curvature_EG 1;
BA_ "GenSigStartValue" SG_ 2621243134 Curvature_EG 32128;
BA_ "SPN" SG_ 2621243134 ExitReasonCode_EG 8778;
BA_ "SPN" SG_ 2621243134 VehicleSpeed_VS 8773;
BA_ "SigType" SG_ 2621243134 VehicleSpeed_VS 1;
BA_ "GenSigStartValue" SG_ 2621243134 VehicleSpeed_VS 32128;
BA_ "SPN" SG_ 2621243134 ExitReasonCode_VS 8775;
BA_ "SPN" SG_ 2621243134 Position_FH 8767;
BA_ "SigType" SG_ 2621243134 Position_FH 1;
BA_ "SPN" SG_ 2621243134 ExitReasonCode_FH 8771;
BA_ "SPN" SG_ 2621243134 Speed_FPTO 8761;
BA_ "SigType" SG_ 2621243134 Speed_FPTO 1;
BA_ "GenSigStartValue" SG_ 2621243134 Speed_FPTO 32128;
BA_ "SPN" SG_ 2621243134 ExitReasonCode_FPTO 8765;
BA_ "SPN" SG_ 2621243134 Flow_AV01 8665;
BA_ "SigType" SG_ 2621243134 Flow_AV01 1;
BA_ "GenSigStartValue" SG_ 2621243134 Flow_AV01 32128;
BA_ "SPN" SG_ 2621243134 ExitReasonCode_AV01 8729;
BA_ "SPN" SG_ 2621243134 TIMFunctionID 23577;
BA_ "SPN" SG_ 2624585470 SignedChallengeData 13304;
BA_ "SigType" SG_ 2624585470 SignedChallengeData 3;
BA_ "SPN" SG_ 2624585470 ClientCertType 13307;
BA_ "SPN" SG_ 2624585470 ClientCertificateFormat 13306;
BA_ "GenSigStartValue" SG_ 2624585470 ImplementedAuthVersion 1;
BA_ "GenSigStartValue" SG_ 2624585470 MinimumAuthVersion 1;
BA_ "SPN" SG_ 2624585470 NumberOfAuthenticatedServers 13319;
BA_ "SPN" SG_ 2624585470 AuthenticationStatus 13293;
BA_ "SPN" SG_ 2624585470 RandomChallengeData 13301;
BA_ "SigType" SG_ 2624585470 RandomChallengeData 3;
BA_ "SPN" SG_ 2624585470 CertificateData 13308;
BA_ "SigType" SG_ 2624585470 CertificateData 9;
BA_ "SPN" SG_ 2624585470 ErrorCode 13291;
BA_ "SPN" SG_ 2624585470 ServerCertType 13296;
BA_ "SPN" SG_ 2624585470 ServerCertificateFormat 13295;
BA_ "SPN" SG_ 2624651006 SignedChallengeData 13243;
BA_ "SigType" SG_ 2624651006 SignedChallengeData 3;
BA_ "SPN" SG_ 2624651006 ClientCertType 13233;
BA_ "SPN" SG_ 2624651006 ClientCertificateFormat 13232;
BA_ "GenSigStartValue" SG_ 2624651006 ImplementedAuthVersion 1;
BA_ "GenSigStartValue" SG_ 2624651006 MinimumAuthVersion 1;
BA_ "SPN" SG_ 2624651006 NumberOfAuthenticatedClients 13283;
BA_ "SPN" SG_ 2624651006 AuthenticationStatus 13225;
BA_ "SPN" SG_ 2624651006 RandomChallengeData 13237;
BA_ "SigType" SG_ 2624651006 RandomChallengeData 3;
BA_ "SPN" SG_ 2624651006 CertificateData 13230;
BA_ "SigType" SG_ 2624651006 CertificateData 9;
BA_ "SPN" SG_ 2624651006 ServerCertType 13229;
BA_ "SPN" SG_ 2624651006 ServerCertificateFormat 13228;
BA_ "SPN" SG_ 2624651006 ErrorCode 13224;
VAL_ 2621243134 FlowMaxIncAggressiveness_AV32 65279 "Error" 65535 "NotAvailable" 0 "InvalidValue" ;
VAL_ 2621243134 FlowMaxIncAggressiveness_AV31 65279 "Error" 65535 "NotAvailable" 0 "InvalidValue" ;
VAL_ 2621243134 FlowMaxIncAggressiveness_AV30 65279 "Error" 65535 "NotAvailable" 0 "InvalidValue" ;
VAL_ 2621243134 FlowMaxIncAggressiveness_AV29 65279 "Error" 65535 "NotAvailable" 0 "InvalidValue" ;
VAL_ 2621243134 FlowMaxIncAggressiveness_AV28 65279 "Error" 65535 "NotAvailable" 0 "InvalidValue" ;
VAL_ 2621243134 FlowMaxIncAggressiveness_AV27 65279 "Error" 65535 "NotAvailable" 0 "InvalidValue" ;
VAL_ 2621243134 FlowMaxIncAggressiveness_AV26 65279 "Error" 65535 "NotAvailable" 0 "InvalidValue" ;
VAL_ 2621243134 FlowMaxIncAggressiveness_AV25 65279 "Error" 65535 "NotAvailable" 0 "InvalidValue" ;
VAL_ 2621243134 FlowMaxIncAggressiveness_AV24 65279 "Error" 65535 "NotAvailable" 0 "InvalidValue" ;
VAL_ 2621243134 FlowMaxIncAggressiveness_AV23 65279 "Error" 65535 "NotAvailable" 0 "InvalidValue" ;
VAL_ 2621243134 FlowMaxIncAggressiveness_AV22 65279 "Error" 65535 "NotAvailable" 0 "InvalidValue" ;
VAL_ 2621243134 FlowMaxIncAggressiveness_AV21 65279 "Error" 65535 "NotAvailable" 0 "InvalidValue" ;
VAL_ 2621243134 FlowMaxIncAggressiveness_AV20 65279 "Error" 65535 "NotAvailable" 0 "InvalidValue" ;
VAL_ 2621243134 FlowMaxIncAggressiveness_AV19 65279 "Error" 65535 "NotAvailable" 0 "InvalidValue" ;
VAL_ 2621243134 FlowMaxIncAggressiveness_AV18 65279 "Error" 65535 "NotAvailable" 0 "InvalidValue" ;
VAL_ 2621243134 FlowMaxIncAggressiveness_AV17 65279 "Error" 65535 "NotAvailable" 0 "InvalidValue" ;
VAL_ 2621243134 FlowMaxIncAggressiveness_AV16 65279 "Error" 65535 "NotAvailable" 0 "InvalidValue" ;
VAL_ 2621243134 FlowMaxIncAggressiveness_AV15 65279 "Error" 65535 "NotAvailable" 0 "InvalidValue" ;
VAL_ 2621243134 FlowMaxIncAggressiveness_AV14 65279 "Error" 65535 "NotAvailable" 0 "InvalidValue" ;
VAL_ 2621243134 FlowMaxIncAggressiveness_AV13 65279 "Error" 65535 "NotAvailable" 0 "InvalidValue" ;
VAL_ 2621243134 FlowMaxIncAggressiveness_AV12 65279 "Error" 65535 "NotAvailable" 0 "InvalidValue" ;
VAL_ 2621243134 FlowMaxIncAggressiveness_AV11 65279 "Error" 65535 "NotAvailable" 0 "InvalidValue" ;
VAL_ 2621243134 FlowMaxIncAggressiveness_AV10 65279 "Error" 65535 "NotAvailable" 0 "InvalidValue" ;
VAL_ 2621243134 FlowMaxIncAggressiveness_AV09 65279 "Error" 65535 "NotAvailable" 0 "InvalidValue" ;
VAL_ 2621243134 FlowMaxIncAggressiveness_AV08 65279 "Error" 65535 "NotAvailable" 0 "InvalidValue" ;
VAL_ 2621243134 FlowMaxIncAggressiveness_AV07 65279 "Error" 65535 "NotAvailable" 0 "InvalidValue" ;
VAL_ 2621243134 FlowMaxIncAggressiveness_AV06 65279 "Error" 65535 "NotAvailable" 0 "InvalidValue" ;
VAL_ 2621243134 FlowMaxIncAggressiveness_AV05 65279 "Error" 65535 "NotAvailable" 0 "InvalidValue" ;
VAL_ 2621243134 FlowMaxIncAggressiveness_AV04 65279 "Error" 65535 "NotAvailable" 0 "InvalidValue" ;
VAL_ 2621243134 FlowMaxIncAggressiveness_AV03 65279 "Error" 65535 "NotAvailable" 0 "InvalidValue" ;
VAL_ 2621243134 FlowMaxIncAggressiveness_AV02 65279 "Error" 65535 "NotAvailable" 0 "InvalidValue" ;
VAL_ 2621243134 FlowMaxIncAggressiveness_AV01 65279 "Error" 65535 "NotAvailable" 0 "InvalidValue" ;
VAL_ 2621243134 FlowMaxDecAggressiveness_AV32 65279 "Error" 65535 "NotAvailable" 0 "InvalidValue" ;
VAL_ 2621243134 FlowMaxDecAggressiveness_AV31 65279 "Error" 65535 "NotAvailable" 0 "InvalidValue" ;
VAL_ 2621243134 FlowMaxDecAggressiveness_AV30 65279 "Error" 65535 "NotAvailable" 0 "InvalidValue" ;
VAL_ 2621243134 FlowMaxDecAggressiveness_AV29 65279 "Error" 65535 "NotAvailable" 0 "InvalidValue" ;
VAL_ 2621243134 FlowMaxDecAggressiveness_AV28 65279 "Error" 65535 "NotAvailable" 0 "InvalidValue" ;
VAL_ 2621243134 FlowMaxDecAggressiveness_AV27 65279 "Error" 65535 "NotAvailable" 0 "InvalidValue" ;
VAL_ 2621243134 FlowMaxDecAggressiveness_AV26 65279 "Error" 65535 "NotAvailable" 0 "InvalidValue" ;
VAL_ 2621243134 FlowMaxDecAggressiveness_AV25 65279 "Error" 65535 "NotAvailable" 0 "InvalidValue" ;
VAL_ 2621243134 FlowMaxDecAggressiveness_AV24 65279 "Error" 65535 "NotAvailable" 0 "InvalidValue" ;
VAL_ 2621243134 FlowMaxDecAggressiveness_AV23 65279 "Error" 65535 "NotAvailable" 0 "InvalidValue" ;
VAL_ 2621243134 FlowMaxDecAggressiveness_AV22 65279 "Error" 65535 "NotAvailable" 0 "InvalidValue" ;
VAL_ 2621243134 FlowMaxDecAggressiveness_AV21 65279 "Error" 65535 "NotAvailable" 0 "InvalidValue" ;
VAL_ 2621243134 FlowMaxDecAggressiveness_AV20 65279 "Error" 65535 "NotAvailable" 0 "InvalidValue" ;
VAL_ 2621243134 FlowMaxDecAggressiveness_AV19 65279 "Error" 65535 "NotAvailable" 0 "InvalidValue" ;
VAL_ 2621243134 FlowMaxDecAggressiveness_AV18 65279 "Error" 65535 "NotAvailable" 0 "InvalidValue" ;
VAL_ 2621243134 FlowMaxDecAggressiveness_AV17 65279 "Error" 65535 "NotAvailable" 0 "InvalidValue" ;
VAL_ 2621243134 FlowMaxDecAggressiveness_AV16 65279 "Error" 65535 "NotAvailable" 0 "InvalidValue" ;
VAL_ 2621243134 FlowMaxDecAggressiveness_AV15 65279 "Error" 65535 "NotAvailable" 0 "InvalidValue" ;
VAL_ 2621243134 FlowMaxDecAggressiveness_AV14 65279 "Error" 65535 "NotAvailable" 0 "InvalidValue" ;
VAL_ 2621243134 FlowMaxDecAggressiveness_AV13 65279 "Error" 65535 "NotAvailable" 0 "InvalidValue" ;
VAL_ 2621243134 FlowMaxDecAggressiveness_AV12 65279 "Error" 65535 "NotAvailable" 0 "InvalidValue" ;
VAL_ 2621243134 FlowMaxDecAggressiveness_AV11 65279 "Error" 65535 "NotAvailable" 0 "InvalidValue" ;
VAL_ 2621243134 FlowMaxDecAggressiveness_AV10 65279 "Error" 65535 "NotAvailable" 0 "InvalidValue" ;
VAL_ 2621243134 FlowMaxDecAggressiveness_AV09 65279 "Error" 65535 "NotAvailable" 0 "InvalidValue" ;
VAL_ 2621243134 FlowMaxDecAggressiveness_AV08 65279 "Error" 65535 "NotAvailable" 0 "InvalidValue" ;
VAL_ 2621243134 FlowMaxDecAggressiveness_AV07 65279 "Error" 65535 "NotAvailable" 0 "InvalidValue" ;
VAL_ 2621243134 FlowMaxDecAggressiveness_AV06 65279 "Error" 65535 "NotAvailable" 0 "InvalidValue" ;
VAL_ 2621243134 FlowMaxDecAggressiveness_AV05 65279 "Error" 65535 "NotAvailable" 0 "InvalidValue" ;
VAL_ 2621243134 FlowMaxDecAggressiveness_AV04 65279 "Error" 65535 "NotAvailable" 0 "InvalidValue" ;
VAL_ 2621243134 FlowMaxDecAggressiveness_AV03 65279 "Error" 65535 "NotAvailable" 0 "InvalidValue" ;
VAL_ 2621243134 FlowMaxDecAggressiveness_AV02 65279 "Error" 65535 "NotAvailable" 0 "InvalidValue" ;
VAL_ 2621243134 FlowMaxDecAggressiveness_AV01 65279 "Error" 65535 "NotAvailable" 0 "InvalidValue" ;
VAL_ 2621243134 CurvatureMaxAggressiveness_EG 65279 "Error" 65535 "NotAvailable" 0 "InvalidValue" ;
VAL_ 2621243134 VSpeedMaxDecAggressiveness_VS 65279 "Error" 65535 "NotAvailable" 0 "InvalidValue" ;
VAL_ 2621243134 VSpeedMaxIncAggressiveness_VS 65279 "Error" 65535 "NotAvailable" 0 "InvalidValue" ;
VAL_ 2621243134 PositonMaxIncAggressiveness_RTL 65279 "Error" 65535 "NotAvailable" 0 "InvalidValue" ;
VAL_ 2621243134 PositonMaxIncAggressiveness_FTL 65279 "Error" 65535 "NotAvailable" 0 "InvalidValue" ;
VAL_ 2621243134 PositonMaxDecAggressiveness_RTL 65279 "Error" 65535 "NotAvailable" 0 "InvalidValue" ;
VAL_ 2621243134 PositonMaxDecAggressiveness_FTL 65279 "Error" 65535 "NotAvailable" 0 "InvalidValue" ;
VAL_ 2621243134 PositonMaxIncAggressiveness_RH 65279 "Error" 65535 "NotAvailable" 0 "InvalidValue" ;
VAL_ 2621243134 PositonMaxIncAggressiveness_FH 65279 "Error" 65535 "NotAvailable" 0 "InvalidValue" ;
VAL_ 2621243134 PositonMaxDecAggressiveness_RH 65279 "Error" 65535 "NotAvailable" 0 "InvalidValue" ;
VAL_ 2621243134 PositonMaxDecAggressiveness_FH 65279 "Error" 65535 "NotAvailable" 0 "InvalidValue" ;
VAL_ 2621243134 SpeedMaxDecAggressiveness_RPTO 65279 "Error" 65535 "NotAvailable" 0 "InvalidValue" ;
VAL_ 2621243134 SpeedMaxDecAggressiveness_FPTO 65279 "Error" 65535 "NotAvailable" 0 "InvalidValue" ;
VAL_ 2621243134 SpeedMaxIncAggressiveness_RPTO 65279 "Error" 65535 "NotAvailable" 0 "InvalidValue" ;
VAL_ 2621243134 SpeedMaxIncAggressiveness_FPTO 65279 "Error" 65535 "NotAvailable" 0 "InvalidValue" ;
VAL_ 2621243134 SecurityByte_VS 17 "LinearMotion_Request" 0 "Parametrization_Request" ;
VAL_ 2621243134 SecurityByte_RTL 17 "PercentagePosition_Request" 0 "Parametrization_Request" ;
VAL_ 2621243134 SecurityByte_RPTO 17 "RotationalSpeed_Request" ;
VAL_ 2621243134 SecurityByte_RH 17 "PercentagePosition_Request" ;
VAL_ 2621243134 SecurityByte_FTL 17 "PercentagePosition_Request" 0 "Parametrization_Request" ;
VAL_ 2621243134 SecurityByte_FPTO 17 "RotationalSpeed_Request" ;
VAL_ 2621243134 SecurityByte_FH 17 "PercentagePosition_Request" ;
VAL_ 2621243134 SecurityByte_EG 17 "Curvature_Request" ;
VAL_ 2621243134 SecurityByte_AV32 17 "PercentageFlow_Request" ;
VAL_ 2621243134 SecurityByte_AV31 17 "PercentageFlow_Request" ;
VAL_ 2621243134 SecurityByte_AV30 17 "PercentageFlow_Request" ;
VAL_ 2621243134 SecurityByte_AV29 17 "PercentageFlow_Request" ;
VAL_ 2621243134 SecurityByte_AV28 17 "PercentageFlow_Request" ;
VAL_ 2621243134 SecurityByte_AV27 17 "PercentageFlow_Request" ;
VAL_ 2621243134 SecurityByte_AV26 17 "PercentageFlow_Request" ;
VAL_ 2621243134 SecurityByte_AV25 17 "PercentageFlow_Request" ;
VAL_ 2621243134 SecurityByte_AV24 17 "PercentageFlow_Request" ;
VAL_ 2621243134 SecurityByte_AV23 17 "PercentageFlow_Request" ;
VAL_ 2621243134 SecurityByte_AV22 17 "PercentageFlow_Request" ;
VAL_ 2621243134 SecurityByte_AV21 17 "PercentageFlow_Request" ;
VAL_ 2621243134 SecurityByte_AV20 17 "PercentageFlow_Request" ;
VAL_ 2621243134 SecurityByte_AV19 17 "PercentageFlow_Request" ;
VAL_ 2621243134 SecurityByte_AV18 17 "PercentageFlow_Request" ;
VAL_ 2621243134 SecurityByte_AV17 17 "PercentageFlow_Request" ;
VAL_ 2621243134 SecurityByte_AV16 17 "PercentageFlow_Request" ;
VAL_ 2621243134 SecurityByte_AV15 17 "PercentageFlow_Request" ;
VAL_ 2621243134 SecurityByte_AV14 17 "PercentageFlow_Request" ;
VAL_ 2621243134 SecurityByte_AV13 17 "PercentageFlow_Request" ;
VAL_ 2621243134 SecurityByte_AV12 17 "PercentageFlow_Request" ;
VAL_ 2621243134 SecurityByte_AV11 17 "PercentageFlow_Request" ;
VAL_ 2621243134 SecurityByte_AV10 17 "PercentageFlow_Request" ;
VAL_ 2621243134 SecurityByte_AV09 17 "PercentageFlow_Request" ;
VAL_ 2621243134 SecurityByte_AV08 17 "PercentageFlow_Request" ;
VAL_ 2621243134 SecurityByte_AV07 17 "PercentageFlow_Request" ;
VAL_ 2621243134 SecurityByte_AV06 17 "PercentageFlow_Request" ;
VAL_ 2621243134 SecurityByte_AV05 17 "PercentageFlow_Request" ;
VAL_ 2621243134 SecurityByte_AV04 17 "PercentageFlow_Request" ;
VAL_ 2621243134 SecurityByte_AV03 17 "PercentageFlow_Request" ;
VAL_ 2621243134 SecurityByte_AV02 17 "PercentageFlow_Request" ;
VAL_ 2621243134 SecurityByte_AV01 17 "PercentageFlow_Request" ;
VAL_ 2621243134 State_RH 15 "NotAvailable" 14 "Error" 3 "Raising" 2 "Lowering" 1 "Stop" 0 "Float" ;
VAL_ 2621243134 State_RTL 15 "NotAvailable" 14 "Error" 3 "Extending" 2 "Retracting" 1 "Stop" 0 "Float" ;
VAL_ 2621243134 State_FTL 15 "NotAvailable" 14 "Error" 3 "Extending" 2 "Retracting" 1 "Stop" 0 "Float" ;
VAL_ 2621243134 State_FH 15 "NotAvailable" 14 "Error" 3 "Raising" 2 "Lowering" 1 "Stop" 0 "Float" ;
VAL_ 2621243134 StrokeLength_CM1GP_RTL 65535 "NotAvailable" 65534 "Error" ;
VAL_ 2621243134 BaseLength_CM1GP_RTL 65535 "NotAvailable" 65534 "Error" ;
VAL_ 2621243134 StrokeLength_CM1GP_FTL 65535 "NotAvailable" 65534 "Error" ;
VAL_ 2621243134 BaseLength_CM1GP_FTL 65535 "NotAvailable" 65534 "Error" ;
VAL_ 2621243134 MinimumSpeedBackward_CM1GP_VS 65535 "NotAvailable" ;
VAL_ 2621243134 MaximumSpeedBackward_CM1GP_VS 65535 "NotAvailable" ;
VAL_ 2621243134 MinimumSpeedForward_CM1GP_VS 65535 "NotAvailable" ;
VAL_ 2621243134 MaximumSpeedForward_CM1GP_VS 65535 "NotAvailable" ;
VAL_ 2621243134 TransmissionType_CM1GP_VS 255 "NotAvailable" 1 "ContinuouslyVariableTransmission" 0 "SteppedTransmission" ;
VAL_ 2621243134 ControlMode1_RTL 0 "GeneralParametrization" ;
VAL_ 2621243134 Position_RTL 65535 "NotAvailable" 65534 "Error" ;
VAL_ 2621243134 Position_FTL 65535 "NotAvailable" 65534 "Error" ;
VAL_ 2621243134 ExitReasonCode_RTL 31 "NotAvailable" 30 "Error" 16 "ValveLockedOut_TransportLock" 15 "HydraulicOilLevelLow" 10 "ControlLoopSecurityFault" 9 "FunctionFault" 8 "OperatorControlFault" 5 "RemoteCommandTimeout" 4 "OperatorControlNotInValidPosition" 3 "OperatorOverrideOfFunction" 2 "ImplementReleasedControlOfFunction" 7 "FunctionNotCalibrated" 6 "RemoteCommandOutOfRange_Invalid" 1 "RequiredLevelOfOperatorPresence_AwarenessNotDetected" 0 "NoReason_AllClear" ;
VAL_ 2621243134 ExitReasonCode_FTL 31 "NotAvailable" 30 "Error" 16 "ValveLockedOut_TransportLock" 15 "HydraulicOilLevelLow" 10 "ControlLoopSecurityFault" 9 "FunctionFault" 8 "OperatorControlFault" 5 "RemoteCommandTimeout" 4 "OperatorControlNotInValidPosition" 3 "OperatorOverrideOfFunction" 2 "ImplementReleasedControlOfFunction" 7 "FunctionNotCalibrated" 6 "RemoteCommandOutOfRange_Invalid" 1 "RequiredLevelOfOperatorPresence_AwarenessNotDetected" 0 "NoReason_AllClear" ;
VAL_ 2621243134 AutomationStatus_RTL 13 "AutomationFault" 7 "ActiveLimitedLow" 6 "ActiveLimitedHigh" 5 "ActiveNotLimited" 0 "AutomationUnavailable" 1 "AutomationNotReady" 2 "AutomationReadyToEnable" 3 "AutomationEnabled" 4 "AutomationPending" 14 "NonRecoverableFault" 15 "NotAvailable" ;
VAL_ 2621243134 AutomationStatus_FTL 13 "AutomationFault" 7 "ActiveLimitedLow" 6 "ActiveLimitedHigh" 5 "ActiveNotLimited" 0 "AutomationUnavailable" 1 "AutomationNotReady" 2 "AutomationReadyToEnable" 3 "AutomationEnabled" 4 "AutomationPending" 14 "NonRecoverableFault" 15 "NotAvailable" ;
VAL_ 2621243134 ControlMode1_FTL 0 "GeneralParametrization" ;
VAL_ 2621243134 MsgType_RTL 65 "PercentagePosition_AggressivenessStatus" 17 "PercentagePosition_Status" 1 "PercentagePosition_AutomationStatus" 0 "Parametrization_Response" ;
VAL_ 2621243134 MsgType_FTL 65 "PercentagePosition_AggressivenessStatus" 17 "PercentagePosition_Status" 1 "PercentagePosition_AutomationStatus" 0 "Parametrization_Response" ;
VAL_ 2621243134 MsgType_EG 65 "Curvature_AggressivenessStatus" 17 "Curvature_Status" 1 "Curvature_AutomationStatus" ;
VAL_ 2621243134 ControlMode1_VS 0 "GeneralParametrization" ;
VAL_ 2621243134 MsgType_VS 65 "LinearMotion_AggressivenessStatus" 17 "LinearMotion_Status" 1 "LinearMotion_AutomationStatus" 0 "Parametrization_Response" ;
VAL_ 2621243134 MsgType_RH 65 "PercentagePosition_AggressivenessStatus" 17 "PercentagePosition_Status" 1 "PercentagePosition_AutomationStatus" ;
VAL_ 2621243134 MsgType_FH 65 "PercentagePosition_AggressivenessStatus" 17 "PercentagePosition_Status" 1 "PercentagePosition_AutomationStatus" ;
VAL_ 2621243134 MsgType_RPTO 65 "RotationalSpeed_AggressivenessStatus" 17 "RotationalSpeed_Status" 1 "RotationalSpeed_AutomationStatus" ;
VAL_ 2621243134 MsgType_FPTO 65 "RotationalSpeed_AggressivenessStatus" 17 "RotationalSpeed_Status" 1 "RotationalSpeed_AutomationStatus" ;
VAL_ 2621243134 MsgType_AV32 65 "PercentageFlow_AggressivenessStatus" 17 "PercentageFlow_Status" 1 "PercentageFlow_AutomationStatus" ;
VAL_ 2621243134 MsgType_AV31 65 "PercentageFlow_AggressivenessStatus" 17 "PercentageFlow_Status" 1 "PercentageFlow_AutomationStatus" ;
VAL_ 2621243134 MsgType_AV30 65 "PercentageFlow_AggressivenessStatus" 17 "PercentageFlow_Status" 1 "PercentageFlow_AutomationStatus" ;
VAL_ 2621243134 MsgType_AV29 65 "PercentageFlow_AggressivenessStatus" 17 "PercentageFlow_Status" 1 "PercentageFlow_AutomationStatus" ;
VAL_ 2621243134 MsgType_AV28 65 "PercentageFlow_AggressivenessStatus" 17 "PercentageFlow_Status" 1 "PercentageFlow_AutomationStatus" ;
VAL_ 2621243134 MsgType_AV27 65 "PercentageFlow_AggressivenessStatus" 17 "PercentageFlow_Status" 1 "PercentageFlow_AutomationStatus" ;
VAL_ 2621243134 MsgType_AV26 65 "PercentageFlow_AggressivenessStatus" 17 "PercentageFlow_Status" 1 "PercentageFlow_AutomationStatus" ;
VAL_ 2621243134 MsgType_AV25 65 "PercentageFlow_AggressivenessStatus" 17 "PercentageFlow_Status" 1 "PercentageFlow_AutomationStatus" ;
VAL_ 2621243134 MsgType_AV24 65 "PercentageFlow_AggressivenessStatus" 17 "PercentageFlow_Status" 1 "PercentageFlow_AutomationStatus" ;
VAL_ 2621243134 MsgType_AV23 65 "PercentageFlow_AggressivenessStatus" 17 "PercentageFlow_Status" 1 "PercentageFlow_AutomationStatus" ;
VAL_ 2621243134 MsgType_AV22 65 "PercentageFlow_AggressivenessStatus" 17 "PercentageFlow_Status" 1 "PercentageFlow_AutomationStatus" ;
VAL_ 2621243134 MsgType_AV21 65 "PercentageFlow_AggressivenessStatus" 17 "PercentageFlow_Status" 1 "PercentageFlow_AutomationStatus" ;
VAL_ 2621243134 MsgType_AV20 65 "PercentageFlow_AggressivenessStatus" 17 "PercentageFlow_Status" 1 "PercentageFlow_AutomationStatus" ;
VAL_ 2621243134 MsgType_AV19 65 "PercentageFlow_AggressivenessStatus" 17 "PercentageFlow_Status" 1 "PercentageFlow_AutomationStatus" ;
VAL_ 2621243134 MsgType_AV18 65 "PercentageFlow_AggressivenessStatus" 17 "PercentageFlow_Status" 1 "PercentageFlow_AutomationStatus" ;
VAL_ 2621243134 MsgType_AV17 65 "PercentageFlow_AggressivenessStatus" 17 "PercentageFlow_Status" 1 "PercentageFlow_AutomationStatus" ;
VAL_ 2621243134 MsgType_AV16 65 "PercentageFlow_AggressivenessStatus" 17 "PercentageFlow_Status" 1 "PercentageFlow_AutomationStatus" ;
VAL_ 2621243134 MsgType_AV15 65 "PercentageFlow_AggressivenessStatus" 17 "PercentageFlow_Status" 1 "PercentageFlow_AutomationStatus" ;
VAL_ 2621243134 MsgType_AV14 65 "PercentageFlow_AggressivenessStatus" 17 "PercentageFlow_Status" 1 "PercentageFlow_AutomationStatus" ;
VAL_ 2621243134 MsgType_AV13 65 "PercentageFlow_AggressivenessStatus" 17 "PercentageFlow_Status" 1 "PercentageFlow_AutomationStatus" ;
VAL_ 2621243134 MsgType_AV12 65 "PercentageFlow_AggressivenessStatus" 17 "PercentageFlow_Status" 1 "PercentageFlow_AutomationStatus" ;
VAL_ 2621243134 MsgType_AV11 65 "PercentageFlow_AggressivenessStatus" 17 "PercentageFlow_Status" 1 "PercentageFlow_AutomationStatus" ;
VAL_ 2621243134 MsgType_AV10 65 "PercentageFlow_AggressivenessStatus" 17 "PercentageFlow_Status" 1 "PercentageFlow_AutomationStatus" ;
VAL_ 2621243134 MsgType_AV09 65 "PercentageFlow_AggressivenessStatus" 17 "PercentageFlow_Status" 1 "PercentageFlow_AutomationStatus" ;
VAL_ 2621243134 MsgType_AV08 65 "PercentageFlow_AggressivenessStatus" 17 "PercentageFlow_Status" 1 "PercentageFlow_AutomationStatus" ;
VAL_ 2621243134 MsgType_AV07 65 "PercentageFlow_AggressivenessStatus" 17 "PercentageFlow_Status" 1 "PercentageFlow_AutomationStatus" ;
VAL_ 2621243134 MsgType_AV06 65 "PercentageFlow_AggressivenessStatus" 17 "PercentageFlow_Status" 1 "PercentageFlow_AutomationStatus" ;
VAL_ 2621243134 MsgType_AV05 65 "PercentageFlow_AggressivenessStatus" 17 "PercentageFlow_Status" 1 "PercentageFlow_AutomationStatus" ;
VAL_ 2621243134 MsgType_AV04 65 "PercentageFlow_AggressivenessStatus" 17 "PercentageFlow_Status" 1 "PercentageFlow_AutomationStatus" ;
VAL_ 2621243134 MsgType_AV03 65 "PercentageFlow_AggressivenessStatus" 17 "PercentageFlow_Status" 1 "PercentageFlow_AutomationStatus" ;
VAL_ 2621243134 MsgType_AV02 65 "PercentageFlow_AggressivenessStatus" 17 "PercentageFlow_Status" 1 "PercentageFlow_AutomationStatus" ;
VAL_ 2621243134 MsgType_AV01 65 "PercentageFlow_AggressivenessStatus" 17 "PercentageFlow_Status" 1 "PercentageFlow_AutomationStatus" ;
VAL_ 2621243134 Position_RH 65535 "NotAvailable" 65534 "Error" ;
VAL_ 2621243134 Speed_RPTO 65535 "NotAvailable" 65534 "Error" ;
VAL_ 2621243134 Flow_AV32 65535 "NotAvailable" 65534 "Error" 64257 "Float" 64256 "ValveFullyOpened_Retract" 32128 "NoFlow_Block" 0 "ValveFullyOpened_Extend" ;
VAL_ 2621243134 Flow_AV31 65535 "NotAvailable" 65534 "Error" 64257 "Float" 64256 "ValveFullyOpened_Retract" 32128 "NoFlow_Block" 0 "ValveFullyOpened_Extend" ;
VAL_ 2621243134 Flow_AV30 65535 "NotAvailable" 65534 "Error" 64257 "Float" 64256 "ValveFullyOpened_Retract" 32128 "NoFlow_Block" 0 "ValveFullyOpened_Extend" ;
VAL_ 2621243134 Flow_AV29 65535 "NotAvailable" 65534 "Error" 64257 "Float" 64256 "ValveFullyOpened_Retract" 32128 "NoFlow_Block" 0 "ValveFullyOpened_Extend" ;
VAL_ 2621243134 Flow_AV28 65535 "NotAvailable" 65534 "Error" 64257 "Float" 64256 "ValveFullyOpened_Retract" 32128 "NoFlow_Block" 0 "ValveFullyOpened_Extend" ;
VAL_ 2621243134 Flow_AV27 65535 "NotAvailable" 65534 "Error" 64257 "Float" 64256 "ValveFullyOpened_Retract" 32128 "NoFlow_Block" 0 "ValveFullyOpened_Extend" ;
VAL_ 2621243134 Flow_AV26 65535 "NotAvailable" 65534 "Error" 64257 "Float" 64256 "ValveFullyOpened_Retract" 32128 "NoFlow_Block" 0 "ValveFullyOpened_Extend" ;
VAL_ 2621243134 Flow_AV25 65535 "NotAvailable" 65534 "Error" 64257 "Float" 64256 "ValveFullyOpened_Retract" 32128 "NoFlow_Block" 0 "ValveFullyOpened_Extend" ;
VAL_ 2621243134 Flow_AV24 65535 "NotAvailable" 65534 "Error" 64257 "Float" 64256 "ValveFullyOpened_Retract" 32128 "NoFlow_Block" 0 "ValveFullyOpened_Extend" ;
VAL_ 2621243134 Flow_AV23 65535 "NotAvailable" 65534 "Error" 64257 "Float" 64256 "ValveFullyOpened_Retract" 32128 "NoFlow_Block" 0 "ValveFullyOpened_Extend" ;
VAL_ 2621243134 Flow_AV22 65535 "NotAvailable" 65534 "Error" 64257 "Float" 64256 "ValveFullyOpened_Retract" 32128 "NoFlow_Block" 0 "ValveFullyOpened_Extend" ;
VAL_ 2621243134 Flow_AV21 65535 "NotAvailable" 65534 "Error" 64257 "Float" 64256 "ValveFullyOpened_Retract" 32128 "NoFlow_Block" 0 "ValveFullyOpened_Extend" ;
VAL_ 2621243134 Flow_AV20 65535 "NotAvailable" 65534 "Error" 64257 "Float" 64256 "ValveFullyOpened_Retract" 32128 "NoFlow_Block" 0 "ValveFullyOpened_Extend" ;
VAL_ 2621243134 Flow_AV19 65535 "NotAvailable" 65534 "Error" 64257 "Float" 64256 "ValveFullyOpened_Retract" 32128 "NoFlow_Block" 0 "ValveFullyOpened_Extend" ;
VAL_ 2621243134 Flow_AV18 65535 "NotAvailable" 65534 "Error" 64257 "Float" 64256 "ValveFullyOpened_Retract" 32128 "NoFlow_Block" 0 "ValveFullyOpened_Extend" ;
VAL_ 2621243134 Flow_AV17 65535 "NotAvailable" 65534 "Error" 64257 "Float" 64256 "ValveFullyOpened_Retract" 32128 "NoFlow_Block" 0 "ValveFullyOpened_Extend" ;
VAL_ 2621243134 Flow_AV16 65535 "NotAvailable" 65534 "Error" 64257 "Float" 64256 "ValveFullyOpened_Retract" 32128 "NoFlow_Block" 0 "ValveFullyOpened_Extend" ;
VAL_ 2621243134 Flow_AV15 65535 "NotAvailable" 65534 "Error" 64257 "Float" 64256 "ValveFullyOpened_Retract" 32128 "NoFlow_Block" 0 "ValveFullyOpened_Extend" ;
VAL_ 2621243134 Flow_AV14 65535 "NotAvailable" 65534 "Error" 64257 "Float" 64256 "ValveFullyOpened_Retract" 32128 "NoFlow_Block" 0 "ValveFullyOpened_Extend" ;
VAL_ 2621243134 Flow_AV13 65535 "NotAvailable" 65534 "Error" 64257 "Float" 64256 "ValveFullyOpened_Retract" 32128 "NoFlow_Block" 0 "ValveFullyOpened_Extend" ;
VAL_ 2621243134 Flow_AV12 65535 "NotAvailable" 65534 "Error" 64257 "Float" 64256 "ValveFullyOpened_Retract" 32128 "NoFlow_Block" 0 "ValveFullyOpened_Extend" ;
VAL_ 2621243134 Flow_AV11 65535 "NotAvailable" 65534 "Error" 64257 "Float" 64256 "ValveFullyOpened_Retract" 32128 "NoFlow_Block" 0 "ValveFullyOpened_Extend" ;
VAL_ 2621243134 Flow_AV10 65535 "NotAvailable" 65534 "Error" 64257 "Float" 64256 "ValveFullyOpened_Retract" 32128 "NoFlow_Block" 0 "ValveFullyOpened_Extend" ;
VAL_ 2621243134 Flow_AV09 65535 "NotAvailable" 65534 "Error" 64257 "Float" 64256 "ValveFullyOpened_Retract" 32128 "NoFlow_Block" 0 "ValveFullyOpened_Extend" ;
VAL_ 2621243134 Flow_AV08 65535 "NotAvailable" 65534 "Error" 64257 "Float" 64256 "ValveFullyOpened_Retract" 32128 "NoFlow_Block" 0 "ValveFullyOpened_Extend" ;
VAL_ 2621243134 Flow_AV07 65535 "NotAvailable" 65534 "Error" 64257 "Float" 64256 "ValveFullyOpened_Retract" 32128 "NoFlow_Block" 0 "ValveFullyOpened_Extend" ;
VAL_ 2621243134 Flow_AV06 65535 "NotAvailable" 65534 "Error" 64257 "Float" 64256 "ValveFullyOpened_Retract" 32128 "NoFlow_Block" 0 "ValveFullyOpened_Extend" ;
VAL_ 2621243134 Flow_AV05 65535 "NotAvailable" 65534 "Error" 64257 "Float" 64256 "ValveFullyOpened_Retract" 32128 "NoFlow_Block" 0 "ValveFullyOpened_Extend" ;
VAL_ 2621243134 Flow_AV04 65535 "NotAvailable" 65534 "Error" 64257 "Float" 64256 "ValveFullyOpened_Retract" 32128 "NoFlow_Block" 0 "ValveFullyOpened_Extend" ;
VAL_ 2621243134 Flow_AV03 65535 "NotAvailable" 65534 "Error" 64257 "Float" 64256 "ValveFullyOpened_Retract" 32128 "NoFlow_Block" 0 "ValveFullyOpened_Extend" ;
VAL_ 2621243134 Flow_AV02 65535 "NotAvailable" 65534 "Error" 64257 "Float" 64256 "ValveFullyOpened_Retract" 32128 "NoFlow_Block" 0 "ValveFullyOpened_Extend" ;
VAL_ 2621243134 FlowType_AV32 3 "NotAvailable" 2 "Error" 1 "Measured" 0 "Estimated" ;
VAL_ 2621243134 FlowType_AV31 3 "NotAvailable" 2 "Error" 1 "Measured" 0 "Estimated" ;
VAL_ 2621243134 FlowType_AV30 3 "NotAvailable" 2 "Error" 1 "Measured" 0 "Estimated" ;
VAL_ 2621243134 FlowType_AV29 3 "NotAvailable" 2 "Error" 1 "Measured" 0 "Estimated" ;
VAL_ 2621243134 FlowType_AV28 3 "NotAvailable" 2 "Error" 1 "Measured" 0 "Estimated" ;
VAL_ 2621243134 FlowType_AV27 3 "NotAvailable" 2 "Error" 1 "Measured" 0 "Estimated" ;
VAL_ 2621243134 FlowType_AV26 3 "NotAvailable" 2 "Error" 1 "Measured" 0 "Estimated" ;
VAL_ 2621243134 FlowType_AV25 3 "NotAvailable" 2 "Error" 1 "Measured" 0 "Estimated" ;
VAL_ 2621243134 FlowType_AV24 3 "NotAvailable" 2 "Error" 1 "Measured" 0 "Estimated" ;
VAL_ 2621243134 FlowType_AV23 3 "NotAvailable" 2 "Error" 1 "Measured" 0 "Estimated" ;
VAL_ 2621243134 FlowType_AV22 3 "NotAvailable" 2 "Error" 1 "Measured" 0 "Estimated" ;
VAL_ 2621243134 FlowType_AV21 3 "NotAvailable" 2 "Error" 1 "Measured" 0 "Estimated" ;
VAL_ 2621243134 FlowType_AV20 3 "NotAvailable" 2 "Error" 1 "Measured" 0 "Estimated" ;
VAL_ 2621243134 FlowType_AV19 3 "NotAvailable" 2 "Error" 1 "Measured" 0 "Estimated" ;
VAL_ 2621243134 FlowType_AV18 3 "NotAvailable" 2 "Error" 1 "Measured" 0 "Estimated" ;
VAL_ 2621243134 FlowType_AV17 3 "NotAvailable" 2 "Error" 1 "Measured" 0 "Estimated" ;
VAL_ 2621243134 FlowType_AV16 3 "NotAvailable" 2 "Error" 1 "Measured" 0 "Estimated" ;
VAL_ 2621243134 FlowType_AV15 3 "NotAvailable" 2 "Error" 1 "Measured" 0 "Estimated" ;
VAL_ 2621243134 FlowType_AV14 3 "NotAvailable" 2 "Error" 1 "Measured" 0 "Estimated" ;
VAL_ 2621243134 FlowType_AV13 3 "NotAvailable" 2 "Error" 1 "Measured" 0 "Estimated" ;
VAL_ 2621243134 FlowType_AV12 3 "NotAvailable" 2 "Error" 1 "Measured" 0 "Estimated" ;
VAL_ 2621243134 FlowType_AV11 3 "NotAvailable" 2 "Error" 1 "Measured" 0 "Estimated" ;
VAL_ 2621243134 FlowType_AV10 3 "NotAvailable" 2 "Error" 1 "Measured" 0 "Estimated" ;
VAL_ 2621243134 FlowType_AV09 3 "NotAvailable" 2 "Error" 1 "Measured" 0 "Estimated" ;
VAL_ 2621243134 FlowType_AV08 3 "NotAvailable" 2 "Error" 1 "Measured" 0 "Estimated" ;
VAL_ 2621243134 FlowType_AV07 3 "NotAvailable" 2 "Error" 1 "Measured" 0 "Estimated" ;
VAL_ 2621243134 FlowType_AV06 3 "NotAvailable" 2 "Error" 1 "Measured" 0 "Estimated" ;
VAL_ 2621243134 FlowType_AV05 3 "NotAvailable" 2 "Error" 1 "Measured" 0 "Estimated" ;
VAL_ 2621243134 FlowType_AV04 3 "NotAvailable" 2 "Error" 1 "Measured" 0 "Estimated" ;
VAL_ 2621243134 FlowType_AV03 3 "NotAvailable" 2 "Error" 1 "Measured" 0 "Estimated" ;
VAL_ 2621243134 FlowType_AV02 3 "NotAvailable" 2 "Error" 1 "Measured" 0 "Estimated" ;
VAL_ 2621243134 FlowType_AV01 3 "NotAvailable" 2 "Error" 1 "Measured" 0 "Estimated" ;
VAL_ 2621243134 ExitReasonCode_RPTO 31 "NotAvailable" 30 "Error" 15 "InvalidPtoGear" 10 "ControlLoopSecurityFault" 9 "FunctionFault" 8 "OperatorControlFault" 5 "RemoteCommandTimeout" 4 "OperatorControlNotInValidPosition" 3 "OperatorOverrideOfFunction" 2 "ImplementReleasedControlOfFunction" 7 "FunctionNotCalibrated" 6 "RemoteCommandOutOfRange_Invalid" 1 "RequiredLevelOfOperatorPresence_AwarenessNotDetected" 0 "NoReason_AllClear" ;
VAL_ 2621243134 ExitReasonCode_RH 16 "HitchLockedOut" 31 "NotAvailable" 30 "Error" 15 "HydraulicOilLevelLow" 10 "ControlLoopSecurityFault" 9 "FunctionFault" 8 "OperatorControlFault" 5 "RemoteCommandTimeout" 4 "OperatorControlNotInValidPosition" 3 "OperatorOverrideOfFunction" 2 "ImplementReleasedControlOfFunction" 7 "FunctionNotCalibrated" 6 "RemoteCommandOutOfRangeOrInvalid" 1 "RequiredLevelOfOperatorPresence_AwarenessNotDetected" 0 "NoReason_AllClear" ;
VAL_ 2621243134 ExitReasonCode_AV32 31 "NotAvailable" 30 "Error" 16 "ValveLockedOut_TransportLock" 15 "HydraulicOilLevelLow" 10 "ControlLoopSecurityFault" 9 "FunctionFault" 8 "OperatorControlFault" 5 "RemoteCommandTimeout" 4 "OperatorControlNotInValidPosition" 3 "OperatorOverrideOfFunction" 2 "ImplementReleasedControlOfFunction" 7 "FunctionNotCalibrated" 6 "RemoteCommandOutOfRange_Invalid" 1 "RequiredLevelOfOperatorPresence_AwarenessNotDetected" 0 "NoReason_AllClear" ;
VAL_ 2621243134 ExitReasonCode_AV31 31 "NotAvailable" 30 "Error" 16 "ValveLockedOut_TransportLock" 15 "HydraulicOilLevelLow" 10 "ControlLoopSecurityFault" 9 "FunctionFault" 8 "OperatorControlFault" 5 "RemoteCommandTimeout" 4 "OperatorControlNotInValidPosition" 3 "OperatorOverrideOfFunction" 2 "ImplementReleasedControlOfFunction" 7 "FunctionNotCalibrated" 6 "RemoteCommandOutOfRange_Invalid" 1 "RequiredLevelOfOperatorPresence_AwarenessNotDetected" 0 "NoReason_AllClear" ;
VAL_ 2621243134 ExitReasonCode_AV30 31 "NotAvailable" 30 "Error" 16 "ValveLockedOut_TransportLock" 15 "HydraulicOilLevelLow" 10 "ControlLoopSecurityFault" 9 "FunctionFault" 8 "OperatorControlFault" 5 "RemoteCommandTimeout" 4 "OperatorControlNotInValidPosition" 3 "OperatorOverrideOfFunction" 2 "ImplementReleasedControlOfFunction" 7 "FunctionNotCalibrated" 6 "RemoteCommandOutOfRange_Invalid" 1 "RequiredLevelOfOperatorPresence_AwarenessNotDetected" 0 "NoReason_AllClear" ;
VAL_ 2621243134 ExitReasonCode_AV29 31 "NotAvailable" 30 "Error" 16 "ValveLockedOut_TransportLock" 15 "HydraulicOilLevelLow" 10 "ControlLoopSecurityFault" 9 "FunctionFault" 8 "OperatorControlFault" 5 "RemoteCommandTimeout" 4 "OperatorControlNotInValidPosition" 3 "OperatorOverrideOfFunction" 2 "ImplementReleasedControlOfFunction" 7 "FunctionNotCalibrated" 6 "RemoteCommandOutOfRange_Invalid" 1 "RequiredLevelOfOperatorPresence_AwarenessNotDetected" 0 "NoReason_AllClear" ;
VAL_ 2621243134 ExitReasonCode_AV28 31 "NotAvailable" 30 "Error" 16 "ValveLockedOut_TransportLock" 15 "HydraulicOilLevelLow" 10 "ControlLoopSecurityFault" 9 "FunctionFault" 8 "OperatorControlFault" 5 "RemoteCommandTimeout" 4 "OperatorControlNotInValidPosition" 3 "OperatorOverrideOfFunction" 2 "ImplementReleasedControlOfFunction" 7 "FunctionNotCalibrated" 6 "RemoteCommandOutOfRange_Invalid" 1 "RequiredLevelOfOperatorPresence_AwarenessNotDetected" 0 "NoReason_AllClear" ;
VAL_ 2621243134 ExitReasonCode_AV27 31 "NotAvailable" 30 "Error" 16 "ValveLockedOut_TransportLock" 15 "HydraulicOilLevelLow" 10 "ControlLoopSecurityFault" 9 "FunctionFault" 8 "OperatorControlFault" 5 "RemoteCommandTimeout" 4 "OperatorControlNotInValidPosition" 3 "OperatorOverrideOfFunction" 2 "ImplementReleasedControlOfFunction" 7 "FunctionNotCalibrated" 6 "RemoteCommandOutOfRange_Invalid" 1 "RequiredLevelOfOperatorPresence_AwarenessNotDetected" 0 "NoReason_AllClear" ;
VAL_ 2621243134 ExitReasonCode_AV26 31 "NotAvailable" 30 "Error" 16 "ValveLockedOut_TransportLock" 15 "HydraulicOilLevelLow" 10 "ControlLoopSecurityFault" 9 "FunctionFault" 8 "OperatorControlFault" 5 "RemoteCommandTimeout" 4 "OperatorControlNotInValidPosition" 3 "OperatorOverrideOfFunction" 2 "ImplementReleasedControlOfFunction" 7 "FunctionNotCalibrated" 6 "RemoteCommandOutOfRange_Invalid" 1 "RequiredLevelOfOperatorPresence_AwarenessNotDetected" 0 "NoReason_AllClear" ;
VAL_ 2621243134 ExitReasonCode_AV25 31 "NotAvailable" 30 "Error" 16 "ValveLockedOut_TransportLock" 15 "HydraulicOilLevelLow" 10 "ControlLoopSecurityFault" 9 "FunctionFault" 8 "OperatorControlFault" 5 "RemoteCommandTimeout" 4 "OperatorControlNotInValidPosition" 3 "OperatorOverrideOfFunction" 2 "ImplementReleasedControlOfFunction" 7 "FunctionNotCalibrated" 6 "RemoteCommandOutOfRange_Invalid" 1 "RequiredLevelOfOperatorPresence_AwarenessNotDetected" 0 "NoReason_AllClear" ;
VAL_ 2621243134 ExitReasonCode_AV24 31 "NotAvailable" 30 "Error" 16 "ValveLockedOut_TransportLock" 15 "HydraulicOilLevelLow" 10 "ControlLoopSecurityFault" 9 "FunctionFault" 8 "OperatorControlFault" 5 "RemoteCommandTimeout" 4 "OperatorControlNotInValidPosition" 3 "OperatorOverrideOfFunction" 2 "ImplementReleasedControlOfFunction" 7 "FunctionNotCalibrated" 6 "RemoteCommandOutOfRange_Invalid" 1 "RequiredLevelOfOperatorPresence_AwarenessNotDetected" 0 "NoReason_AllClear" ;
VAL_ 2621243134 ExitReasonCode_AV23 31 "NotAvailable" 30 "Error" 16 "ValveLockedOut_TransportLock" 15 "HydraulicOilLevelLow" 10 "ControlLoopSecurityFault" 9 "FunctionFault" 8 "OperatorControlFault" 5 "RemoteCommandTimeout" 4 "OperatorControlNotInValidPosition" 3 "OperatorOverrideOfFunction" 2 "ImplementReleasedControlOfFunction" 7 "FunctionNotCalibrated" 6 "RemoteCommandOutOfRange_Invalid" 1 "RequiredLevelOfOperatorPresence_AwarenessNotDetected" 0 "NoReason_AllClear" ;
VAL_ 2621243134 ExitReasonCode_AV22 31 "NotAvailable" 30 "Error" 16 "ValveLockedOut_TransportLock" 15 "HydraulicOilLevelLow" 10 "ControlLoopSecurityFault" 9 "FunctionFault" 8 "OperatorControlFault" 5 "RemoteCommandTimeout" 4 "OperatorControlNotInValidPosition" 3 "OperatorOverrideOfFunction" 2 "ImplementReleasedControlOfFunction" 7 "FunctionNotCalibrated" 6 "RemoteCommandOutOfRange_Invalid" 1 "RequiredLevelOfOperatorPresence_AwarenessNotDetected" 0 "NoReason_AllClear" ;
VAL_ 2621243134 ExitReasonCode_AV21 31 "NotAvailable" 30 "Error" 16 "ValveLockedOut_TransportLock" 15 "HydraulicOilLevelLow" 10 "ControlLoopSecurityFault" 9 "FunctionFault" 8 "OperatorControlFault" 5 "RemoteCommandTimeout" 4 "OperatorControlNotInValidPosition" 3 "OperatorOverrideOfFunction" 2 "ImplementReleasedControlOfFunction" 7 "FunctionNotCalibrated" 6 "RemoteCommandOutOfRange_Invalid" 1 "RequiredLevelOfOperatorPresence_AwarenessNotDetected" 0 "NoReason_AllClear" ;
VAL_ 2621243134 ExitReasonCode_AV20 31 "NotAvailable" 30 "Error" 16 "ValveLockedOut_TransportLock" 15 "HydraulicOilLevelLow" 10 "ControlLoopSecurityFault" 9 "FunctionFault" 8 "OperatorControlFault" 5 "RemoteCommandTimeout" 4 "OperatorControlNotInValidPosition" 3 "OperatorOverrideOfFunction" 2 "ImplementReleasedControlOfFunction" 7 "FunctionNotCalibrated" 6 "RemoteCommandOutOfRange_Invalid" 1 "RequiredLevelOfOperatorPresence_AwarenessNotDetected" 0 "NoReason_AllClear" ;
VAL_ 2621243134 ExitReasonCode_AV19 31 "NotAvailable" 30 "Error" 16 "ValveLockedOut_TransportLock" 15 "HydraulicOilLevelLow" 10 "ControlLoopSecurityFault" 9 "FunctionFault" 8 "OperatorControlFault" 5 "RemoteCommandTimeout" 4 "OperatorControlNotInValidPosition" 3 "OperatorOverrideOfFunction" 2 "ImplementReleasedControlOfFunction" 7 "FunctionNotCalibrated" 6 "RemoteCommandOutOfRange_Invalid" 1 "RequiredLevelOfOperatorPresence_AwarenessNotDetected" 0 "NoReason_AllClear" ;
VAL_ 2621243134 ExitReasonCode_AV18 31 "NotAvailable" 30 "Error" 16 "ValveLockedOut_TransportLock" 15 "HydraulicOilLevelLow" 10 "ControlLoopSecurityFault" 9 "FunctionFault" 8 "OperatorControlFault" 5 "RemoteCommandTimeout" 4 "OperatorControlNotInValidPosition" 3 "OperatorOverrideOfFunction" 2 "ImplementReleasedControlOfFunction" 7 "FunctionNotCalibrated" 6 "RemoteCommandOutOfRange_Invalid" 1 "RequiredLevelOfOperatorPresence_AwarenessNotDetected" 0 "NoReason_AllClear" ;
VAL_ 2621243134 ExitReasonCode_AV17 31 "NotAvailable" 30 "Error" 16 "ValveLockedOut_TransportLock" 15 "HydraulicOilLevelLow" 10 "ControlLoopSecurityFault" 9 "FunctionFault" 8 "OperatorControlFault" 5 "RemoteCommandTimeout" 4 "OperatorControlNotInValidPosition" 3 "OperatorOverrideOfFunction" 2 "ImplementReleasedControlOfFunction" 7 "FunctionNotCalibrated" 6 "RemoteCommandOutOfRange_Invalid" 1 "RequiredLevelOfOperatorPresence_AwarenessNotDetected" 0 "NoReason_AllClear" ;
VAL_ 2621243134 ExitReasonCode_AV16 31 "NotAvailable" 30 "Error" 16 "ValveLockedOut_TransportLock" 15 "HydraulicOilLevelLow" 10 "ControlLoopSecurityFault" 9 "FunctionFault" 8 "OperatorControlFault" 5 "RemoteCommandTimeout" 4 "OperatorControlNotInValidPosition" 3 "OperatorOverrideOfFunction" 2 "ImplementReleasedControlOfFunction" 7 "FunctionNotCalibrated" 6 "RemoteCommandOutOfRange_Invalid" 1 "RequiredLevelOfOperatorPresence_AwarenessNotDetected" 0 "NoReason_AllClear" ;
VAL_ 2621243134 ExitReasonCode_AV15 31 "NotAvailable" 30 "Error" 16 "ValveLockedOut_TransportLock" 15 "HydraulicOilLevelLow" 10 "ControlLoopSecurityFault" 9 "FunctionFault" 8 "OperatorControlFault" 5 "RemoteCommandTimeout" 4 "OperatorControlNotInValidPosition" 3 "OperatorOverrideOfFunction" 2 "ImplementReleasedControlOfFunction" 7 "FunctionNotCalibrated" 6 "RemoteCommandOutOfRange_Invalid" 1 "RequiredLevelOfOperatorPresence_AwarenessNotDetected" 0 "NoReason_AllClear" ;
VAL_ 2621243134 ExitReasonCode_AV14 31 "NotAvailable" 30 "Error" 16 "ValveLockedOut_TransportLock" 15 "HydraulicOilLevelLow" 10 "ControlLoopSecurityFault" 9 "FunctionFault" 8 "OperatorControlFault" 5 "RemoteCommandTimeout" 4 "OperatorControlNotInValidPosition" 3 "OperatorOverrideOfFunction" 2 "ImplementReleasedControlOfFunction" 7 "FunctionNotCalibrated" 6 "RemoteCommandOutOfRange_Invalid" 1 "RequiredLevelOfOperatorPresence_AwarenessNotDetected" 0 "NoReason_AllClear" ;
VAL_ 2621243134 ExitReasonCode_AV13 31 "NotAvailable" 30 "Error" 16 "ValveLockedOut_TransportLock" 15 "HydraulicOilLevelLow" 10 "ControlLoopSecurityFault" 9 "FunctionFault" 8 "OperatorControlFault" 5 "RemoteCommandTimeout" 4 "OperatorControlNotInValidPosition" 3 "OperatorOverrideOfFunction" 2 "ImplementReleasedControlOfFunction" 7 "FunctionNotCalibrated" 6 "RemoteCommandOutOfRange_Invalid" 1 "RequiredLevelOfOperatorPresence_AwarenessNotDetected" 0 "NoReason_AllClear" ;
VAL_ 2621243134 ExitReasonCode_AV12 31 "NotAvailable" 30 "Error" 16 "ValveLockedOut_TransportLock" 15 "HydraulicOilLevelLow" 10 "ControlLoopSecurityFault" 9 "FunctionFault" 8 "OperatorControlFault" 5 "RemoteCommandTimeout" 4 "OperatorControlNotInValidPosition" 3 "OperatorOverrideOfFunction" 2 "ImplementReleasedControlOfFunction" 7 "FunctionNotCalibrated" 6 "RemoteCommandOutOfRange_Invalid" 1 "RequiredLevelOfOperatorPresence_AwarenessNotDetected" 0 "NoReason_AllClear" ;
VAL_ 2621243134 ExitReasonCode_AV11 31 "NotAvailable" 30 "Error" 16 "ValveLockedOut_TransportLock" 15 "HydraulicOilLevelLow" 10 "ControlLoopSecurityFault" 9 "FunctionFault" 8 "OperatorControlFault" 5 "RemoteCommandTimeout" 4 "OperatorControlNotInValidPosition" 3 "OperatorOverrideOfFunction" 2 "ImplementReleasedControlOfFunction" 7 "FunctionNotCalibrated" 6 "RemoteCommandOutOfRange_Invalid" 1 "RequiredLevelOfOperatorPresence_AwarenessNotDetected" 0 "NoReason_AllClear" ;
VAL_ 2621243134 ExitReasonCode_AV10 31 "NotAvailable" 30 "Error" 16 "ValveLockedOut_TransportLock" 15 "HydraulicOilLevelLow" 10 "ControlLoopSecurityFault" 9 "FunctionFault" 8 "OperatorControlFault" 5 "RemoteCommandTimeout" 4 "OperatorControlNotInValidPosition" 3 "OperatorOverrideOfFunction" 2 "ImplementReleasedControlOfFunction" 7 "FunctionNotCalibrated" 6 "RemoteCommandOutOfRange_Invalid" 1 "RequiredLevelOfOperatorPresence_AwarenessNotDetected" 0 "NoReason_AllClear" ;
VAL_ 2621243134 ExitReasonCode_AV09 31 "NotAvailable" 30 "Error" 16 "ValveLockedOut_TransportLock" 15 "HydraulicOilLevelLow" 10 "ControlLoopSecurityFault" 9 "FunctionFault" 8 "OperatorControlFault" 5 "RemoteCommandTimeout" 4 "OperatorControlNotInValidPosition" 3 "OperatorOverrideOfFunction" 2 "ImplementReleasedControlOfFunction" 7 "FunctionNotCalibrated" 6 "RemoteCommandOutOfRange_Invalid" 1 "RequiredLevelOfOperatorPresence_AwarenessNotDetected" 0 "NoReason_AllClear" ;
VAL_ 2621243134 ExitReasonCode_AV08 31 "NotAvailable" 30 "Error" 16 "ValveLockedOut_TransportLock" 15 "HydraulicOilLevelLow" 10 "ControlLoopSecurityFault" 9 "FunctionFault" 8 "OperatorControlFault" 5 "RemoteCommandTimeout" 4 "OperatorControlNotInValidPosition" 3 "OperatorOverrideOfFunction" 2 "ImplementReleasedControlOfFunction" 7 "FunctionNotCalibrated" 6 "RemoteCommandOutOfRange_Invalid" 1 "RequiredLevelOfOperatorPresence_AwarenessNotDetected" 0 "NoReason_AllClear" ;
VAL_ 2621243134 ExitReasonCode_AV07 31 "NotAvailable" 30 "Error" 16 "ValveLockedOut_TransportLock" 15 "HydraulicOilLevelLow" 10 "ControlLoopSecurityFault" 9 "FunctionFault" 8 "OperatorControlFault" 5 "RemoteCommandTimeout" 4 "OperatorControlNotInValidPosition" 3 "OperatorOverrideOfFunction" 2 "ImplementReleasedControlOfFunction" 7 "FunctionNotCalibrated" 6 "RemoteCommandOutOfRange_Invalid" 1 "RequiredLevelOfOperatorPresence_AwarenessNotDetected" 0 "NoReason_AllClear" ;
VAL_ 2621243134 ExitReasonCode_AV06 31 "NotAvailable" 30 "Error" 16 "ValveLockedOut_TransportLock" 15 "HydraulicOilLevelLow" 10 "ControlLoopSecurityFault" 9 "FunctionFault" 8 "OperatorControlFault" 5 "RemoteCommandTimeout" 4 "OperatorControlNotInValidPosition" 3 "OperatorOverrideOfFunction" 2 "ImplementReleasedControlOfFunction" 7 "FunctionNotCalibrated" 6 "RemoteCommandOutOfRange_Invalid" 1 "RequiredLevelOfOperatorPresence_AwarenessNotDetected" 0 "NoReason_AllClear" ;
VAL_ 2621243134 ExitReasonCode_AV05 31 "NotAvailable" 30 "Error" 16 "ValveLockedOut_TransportLock" 15 "HydraulicOilLevelLow" 10 "ControlLoopSecurityFault" 9 "FunctionFault" 8 "OperatorControlFault" 5 "RemoteCommandTimeout" 4 "OperatorControlNotInValidPosition" 3 "OperatorOverrideOfFunction" 2 "ImplementReleasedControlOfFunction" 7 "FunctionNotCalibrated" 6 "RemoteCommandOutOfRange_Invalid" 1 "RequiredLevelOfOperatorPresence_AwarenessNotDetected" 0 "NoReason_AllClear" ;
VAL_ 2621243134 ExitReasonCode_AV04 31 "NotAvailable" 30 "Error" 16 "ValveLockedOut_TransportLock" 15 "HydraulicOilLevelLow" 10 "ControlLoopSecurityFault" 9 "FunctionFault" 8 "OperatorControlFault" 5 "RemoteCommandTimeout" 4 "OperatorControlNotInValidPosition" 3 "OperatorOverrideOfFunction" 2 "ImplementReleasedControlOfFunction" 7 "FunctionNotCalibrated" 6 "RemoteCommandOutOfRange_Invalid" 1 "RequiredLevelOfOperatorPresence_AwarenessNotDetected" 0 "NoReason_AllClear" ;
VAL_ 2621243134 ExitReasonCode_AV03 31 "NotAvailable" 30 "Error" 16 "ValveLockedOut_TransportLock" 15 "HydraulicOilLevelLow" 10 "ControlLoopSecurityFault" 9 "FunctionFault" 8 "OperatorControlFault" 5 "RemoteCommandTimeout" 4 "OperatorControlNotInValidPosition" 3 "OperatorOverrideOfFunction" 2 "ImplementReleasedControlOfFunction" 7 "FunctionNotCalibrated" 6 "RemoteCommandOutOfRange_Invalid" 1 "RequiredLevelOfOperatorPresence_AwarenessNotDetected" 0 "NoReason_AllClear" ;
VAL_ 2621243134 ExitReasonCode_AV02 31 "NotAvailable" 30 "Error" 16 "ValveLockedOut_TransportLock" 15 "HydraulicOilLevelLow" 10 "ControlLoopSecurityFault" 9 "FunctionFault" 8 "OperatorControlFault" 5 "RemoteCommandTimeout" 4 "OperatorControlNotInValidPosition" 3 "OperatorOverrideOfFunction" 2 "ImplementReleasedControlOfFunction" 7 "FunctionNotCalibrated" 6 "RemoteCommandOutOfRange_Invalid" 1 "RequiredLevelOfOperatorPresence_AwarenessNotDetected" 0 "NoReason_AllClear" ;
VAL_ 2621243134 AutomationStatus_AV04 13 "AutomationFault" 7 "ActiveLimitedLow" 6 "ActiveLimitedHigh" 5 "ActiveNotLimited" 0 "AutomationUnavailable" 1 "AutomationNotReady" 2 "AutomationReadyToEnable" 3 "AutomationEnabled" 4 "AutomationPending" 14 "NonRecoverableFault" 15 "NotAvailable" ;
VAL_ 2621243134 AutomationStatus_AV03 13 "AutomationFault" 7 "ActiveLimitedLow" 6 "ActiveLimitedHigh" 5 "ActiveNotLimited" 0 "AutomationUnavailable" 1 "AutomationNotReady" 2 "AutomationReadyToEnable" 3 "AutomationEnabled" 4 "AutomationPending" 14 "NonRecoverableFault" 15 "NotAvailable" ;
VAL_ 2621243134 AutomationStatus_AV02 13 "AutomationFault" 7 "ActiveLimitedLow" 6 "ActiveLimitedHigh" 5 "ActiveNotLimited" 0 "AutomationUnavailable" 1 "AutomationNotReady" 2 "AutomationReadyToEnable" 3 "AutomationEnabled" 4 "AutomationPending" 14 "NonRecoverableFault" 15 "NotAvailable" ;
VAL_ 2621243134 AutomationStatus_AV01 13 "AutomationFault" 7 "ActiveLimitedLow" 6 "ActiveLimitedHigh" 5 "ActiveNotLimited" 0 "AutomationUnavailable" 1 "AutomationNotReady" 2 "AutomationReadyToEnable" 3 "AutomationEnabled" 4 "AutomationPending" 14 "NonRecoverableFault" 15 "NotAvailable" ;
VAL_ 2621243134 AutomationStatus_EG 13 "AutomationFault" 7 "ActiveLimitedLow" 6 "ActiveLimitedHigh" 5 "ActiveNotLimited" 0 "AutomationUnavailable" 1 "AutomationNotReady" 2 "AutomationReadyToEnable" 3 "AutomationEnabled" 4 "AutomationPending" 14 "NonRecoverableFault" 15 "NotAvailable" ;
VAL_ 2621243134 AutomationStatus_VS 13 "AutomationFault" 7 "ActiveLimitedLow" 6 "ActiveLimitedHigh" 5 "ActiveNotLimited" 0 "AutomationUnavailable" 1 "AutomationNotReady" 2 "AutomationReadyToEnable" 3 "AutomationEnabled" 4 "AutomationPending" 14 "NonRecoverableFault" 15 "NotAvailable" ;
VAL_ 2621243134 AutomationStatus_RH 13 "AutomationFault" 7 "ActiveLimitedLow" 6 "ActiveLimitedHigh" 5 "ActiveNotLimited" 0 "AutomationUnavailable" 1 "AutomationNotReady" 2 "AutomationReadyToEnable" 3 "AutomationEnabled" 4 "AutomationPending" 14 "NonRecoverableFault" 15 "NotAvailable" ;
VAL_ 2621243134 AutomationStatus_FH 13 "AutomationFault" 7 "ActiveLimitedLow" 6 "ActiveLimitedHigh" 5 "ActiveNotLimited" 0 "AutomationUnavailable" 1 "AutomationNotReady" 2 "AutomationReadyToEnable" 3 "AutomationEnabled" 4 "AutomationPending" 14 "NonRecoverableFault" 15 "NotAvailable" ;
VAL_ 2621243134 AutomationStatus_RPTO 13 "AutomationFault" 7 "ActiveLimitedLow" 6 "ActiveLimitedHigh" 5 "ActiveNotLimited" 0 "AutomationUnavailable" 1 "AutomationNotReady" 2 "AutomationReadyToEnable" 3 "AutomationEnabled" 4 "AutomationPending" 14 "NonRecoverableFault" 15 "NotAvailable" ;
VAL_ 2621243134 AutomationStatus_FPTO 13 "AutomationFault" 7 "ActiveLimitedLow" 6 "ActiveLimitedHigh" 5 "ActiveNotLimited" 0 "AutomationUnavailable" 1 "AutomationNotReady" 2 "AutomationReadyToEnable" 3 "AutomationEnabled" 4 "AutomationPending" 14 "NonRecoverableFault" 15 "NotAvailable" ;
VAL_ 2621243134 AutomationStatus_AV32 13 "AutomationFault" 7 "ActiveLimitedLow" 6 "ActiveLimitedHigh" 5 "ActiveNotLimited" 0 "AutomationUnavailable" 1 "AutomationNotReady" 2 "AutomationReadyToEnable" 3 "AutomationEnabled" 4 "AutomationPending" 14 "NonRecoverableFault" 15 "NotAvailable" ;
VAL_ 2621243134 AutomationStatus_AV31 13 "AutomationFault" 7 "ActiveLimitedLow" 6 "ActiveLimitedHigh" 5 "ActiveNotLimited" 0 "AutomationUnavailable" 1 "AutomationNotReady" 2 "AutomationReadyToEnable" 3 "AutomationEnabled" 4 "AutomationPending" 14 "NonRecoverableFault" 15 "NotAvailable" ;
VAL_ 2621243134 AutomationStatus_AV30 13 "AutomationFault" 7 "ActiveLimitedLow" 6 "ActiveLimitedHigh" 5 "ActiveNotLimited" 0 "AutomationUnavailable" 1 "AutomationNotReady" 2 "AutomationReadyToEnable" 3 "AutomationEnabled" 4 "AutomationPending" 14 "NonRecoverableFault" 15 "NotAvailable" ;
VAL_ 2621243134 AutomationStatus_AV29 13 "AutomationFault" 7 "ActiveLimitedLow" 6 "ActiveLimitedHigh" 5 "ActiveNotLimited" 0 "AutomationUnavailable" 1 "AutomationNotReady" 2 "AutomationReadyToEnable" 3 "AutomationEnabled" 4 "AutomationPending" 14 "NonRecoverableFault" 15 "NotAvailable" ;
VAL_ 2621243134 AutomationStatus_AV28 13 "AutomationFault" 7 "ActiveLimitedLow" 6 "ActiveLimitedHigh" 5 "ActiveNotLimited" 0 "AutomationUnavailable" 1 "AutomationNotReady" 2 "AutomationReadyToEnable" 3 "AutomationEnabled" 4 "AutomationPending" 14 "NonRecoverableFault" 15 "NotAvailable" ;
VAL_ 2621243134 AutomationStatus_AV27 13 "AutomationFault" 7 "ActiveLimitedLow" 6 "ActiveLimitedHigh" 5 "ActiveNotLimited" 0 "AutomationUnavailable" 1 "AutomationNotReady" 2 "AutomationReadyToEnable" 3 "AutomationEnabled" 4 "AutomationPending" 14 "NonRecoverableFault" 15 "NotAvailable" ;
VAL_ 2621243134 AutomationStatus_AV26 13 "AutomationFault" 7 "ActiveLimitedLow" 6 "ActiveLimitedHigh" 5 "ActiveNotLimited" 0 "AutomationUnavailable" 1 "AutomationNotReady" 2 "AutomationReadyToEnable" 3 "AutomationEnabled" 4 "AutomationPending" 14 "NonRecoverableFault" 15 "NotAvailable" ;
VAL_ 2621243134 AutomationStatus_AV25 13 "AutomationFault" 7 "ActiveLimitedLow" 6 "ActiveLimitedHigh" 5 "ActiveNotLimited" 0 "AutomationUnavailable" 1 "AutomationNotReady" 2 "AutomationReadyToEnable" 3 "AutomationEnabled" 4 "AutomationPending" 14 "NonRecoverableFault" 15 "NotAvailable" ;
VAL_ 2621243134 AutomationStatus_AV24 13 "AutomationFault" 7 "ActiveLimitedLow" 6 "ActiveLimitedHigh" 5 "ActiveNotLimited" 0 "AutomationUnavailable" 1 "AutomationNotReady" 2 "AutomationReadyToEnable" 3 "AutomationEnabled" 4 "AutomationPending" 14 "NonRecoverableFault" 15 "NotAvailable" ;
VAL_ 2621243134 AutomationStatus_AV23 13 "AutomationFault" 7 "ActiveLimitedLow" 6 "ActiveLimitedHigh" 5 "ActiveNotLimited" 0 "AutomationUnavailable" 1 "AutomationNotReady" 2 "AutomationReadyToEnable" 3 "AutomationEnabled" 4 "AutomationPending" 14 "NonRecoverableFault" 15 "NotAvailable" ;
VAL_ 2621243134 AutomationStatus_AV22 13 "AutomationFault" 7 "ActiveLimitedLow" 6 "ActiveLimitedHigh" 5 "ActiveNotLimited" 0 "AutomationUnavailable" 1 "AutomationNotReady" 2 "AutomationReadyToEnable" 3 "AutomationEnabled" 4 "AutomationPending" 14 "NonRecoverableFault" 15 "NotAvailable" ;
VAL_ 2621243134 AutomationStatus_AV21 13 "AutomationFault" 7 "ActiveLimitedLow" 6 "ActiveLimitedHigh" 5 "ActiveNotLimited" 0 "AutomationUnavailable" 1 "AutomationNotReady" 2 "AutomationReadyToEnable" 3 "AutomationEnabled" 4 "AutomationPending" 14 "NonRecoverableFault" 15 "NotAvailable" ;
VAL_ 2621243134 AutomationStatus_AV20 13 "AutomationFault" 7 "ActiveLimitedLow" 6 "ActiveLimitedHigh" 5 "ActiveNotLimited" 0 "AutomationUnavailable" 1 "AutomationNotReady" 2 "AutomationReadyToEnable" 3 "AutomationEnabled" 4 "AutomationPending" 14 "NonRecoverableFault" 15 "NotAvailable" ;
VAL_ 2621243134 AutomationStatus_AV19 13 "AutomationFault" 7 "ActiveLimitedLow" 6 "ActiveLimitedHigh" 5 "ActiveNotLimited" 0 "AutomationUnavailable" 1 "AutomationNotReady" 2 "AutomationReadyToEnable" 3 "AutomationEnabled" 4 "AutomationPending" 14 "NonRecoverableFault" 15 "NotAvailable" ;
VAL_ 2621243134 AutomationStatus_AV18 13 "AutomationFault" 7 "ActiveLimitedLow" 6 "ActiveLimitedHigh" 5 "ActiveNotLimited" 0 "AutomationUnavailable" 1 "AutomationNotReady" 2 "AutomationReadyToEnable" 3 "AutomationEnabled" 4 "AutomationPending" 14 "NonRecoverableFault" 15 "NotAvailable" ;
VAL_ 2621243134 AutomationStatus_AV17 13 "AutomationFault" 7 "ActiveLimitedLow" 6 "ActiveLimitedHigh" 5 "ActiveNotLimited" 0 "AutomationUnavailable" 1 "AutomationNotReady" 2 "AutomationReadyToEnable" 3 "AutomationEnabled" 4 "AutomationPending" 14 "NonRecoverableFault" 15 "NotAvailable" ;
VAL_ 2621243134 AutomationStatus_AV16 13 "AutomationFault" 7 "ActiveLimitedLow" 6 "ActiveLimitedHigh" 5 "ActiveNotLimited" 0 "AutomationUnavailable" 1 "AutomationNotReady" 2 "AutomationReadyToEnable" 3 "AutomationEnabled" 4 "AutomationPending" 14 "NonRecoverableFault" 15 "NotAvailable" ;
VAL_ 2621243134 AutomationStatus_AV15 13 "AutomationFault" 7 "ActiveLimitedLow" 6 "ActiveLimitedHigh" 5 "ActiveNotLimited" 0 "AutomationUnavailable" 1 "AutomationNotReady" 2 "AutomationReadyToEnable" 3 "AutomationEnabled" 4 "AutomationPending" 14 "NonRecoverableFault" 15 "NotAvailable" ;
VAL_ 2621243134 AutomationStatus_AV14 13 "AutomationFault" 7 "ActiveLimitedLow" 6 "ActiveLimitedHigh" 5 "ActiveNotLimited" 0 "AutomationUnavailable" 1 "AutomationNotReady" 2 "AutomationReadyToEnable" 3 "AutomationEnabled" 4 "AutomationPending" 14 "NonRecoverableFault" 15 "NotAvailable" ;
VAL_ 2621243134 AutomationStatus_AV13 13 "AutomationFault" 7 "ActiveLimitedLow" 6 "ActiveLimitedHigh" 5 "ActiveNotLimited" 0 "AutomationUnavailable" 1 "AutomationNotReady" 2 "AutomationReadyToEnable" 3 "AutomationEnabled" 4 "AutomationPending" 14 "NonRecoverableFault" 15 "NotAvailable" ;
VAL_ 2621243134 AutomationStatus_AV12 13 "AutomationFault" 7 "ActiveLimitedLow" 6 "ActiveLimitedHigh" 5 "ActiveNotLimited" 0 "AutomationUnavailable" 1 "AutomationNotReady" 2 "AutomationReadyToEnable" 3 "AutomationEnabled" 4 "AutomationPending" 14 "NonRecoverableFault" 15 "NotAvailable" ;
VAL_ 2621243134 AutomationStatus_AV11 13 "AutomationFault" 7 "ActiveLimitedLow" 6 "ActiveLimitedHigh" 5 "ActiveNotLimited" 0 "AutomationUnavailable" 1 "AutomationNotReady" 2 "AutomationReadyToEnable" 3 "AutomationEnabled" 4 "AutomationPending" 14 "NonRecoverableFault" 15 "NotAvailable" ;
VAL_ 2621243134 AutomationStatus_AV10 13 "AutomationFault" 7 "ActiveLimitedLow" 6 "ActiveLimitedHigh" 5 "ActiveNotLimited" 0 "AutomationUnavailable" 1 "AutomationNotReady" 2 "AutomationReadyToEnable" 3 "AutomationEnabled" 4 "AutomationPending" 14 "NonRecoverableFault" 15 "NotAvailable" ;
VAL_ 2621243134 AutomationStatus_AV09 13 "AutomationFault" 7 "ActiveLimitedLow" 6 "ActiveLimitedHigh" 5 "ActiveNotLimited" 0 "AutomationUnavailable" 1 "AutomationNotReady" 2 "AutomationReadyToEnable" 3 "AutomationEnabled" 4 "AutomationPending" 14 "NonRecoverableFault" 15 "NotAvailable" ;
VAL_ 2621243134 AutomationStatus_AV08 13 "AutomationFault" 7 "ActiveLimitedLow" 6 "ActiveLimitedHigh" 5 "ActiveNotLimited" 0 "AutomationUnavailable" 1 "AutomationNotReady" 2 "AutomationReadyToEnable" 3 "AutomationEnabled" 4 "AutomationPending" 14 "NonRecoverableFault" 15 "NotAvailable" ;
VAL_ 2621243134 AutomationStatus_AV07 13 "AutomationFault" 7 "ActiveLimitedLow" 6 "ActiveLimitedHigh" 5 "ActiveNotLimited" 0 "AutomationUnavailable" 1 "AutomationNotReady" 2 "AutomationReadyToEnable" 3 "AutomationEnabled" 4 "AutomationPending" 14 "NonRecoverableFault" 15 "NotAvailable" ;
VAL_ 2621243134 AutomationStatus_AV06 13 "AutomationFault" 7 "ActiveLimitedLow" 6 "ActiveLimitedHigh" 5 "ActiveNotLimited" 0 "AutomationUnavailable" 1 "AutomationNotReady" 2 "AutomationReadyToEnable" 3 "AutomationEnabled" 4 "AutomationPending" 14 "NonRecoverableFault" 15 "NotAvailable" ;
VAL_ 2621243134 AutomationStatus_AV05 13 "AutomationFault" 7 "ActiveLimitedLow" 6 "ActiveLimitedHigh" 5 "ActiveNotLimited" 0 "AutomationUnavailable" 1 "AutomationNotReady" 2 "AutomationReadyToEnable" 3 "AutomationEnabled" 4 "AutomationPending" 14 "NonRecoverableFault" 15 "NotAvailable" ;
VAL_ 2621243134 Curvature_EG 65535 "NotAvailable" 65534 "Error" 32128 "Straight" ;
VAL_ 2621243134 ExitReasonCode_EG 21 "HydraulicOilLevelTooLow" 20 "HydraulicOilTemperatureTooLow" 19 "VehicleTransmissionGearDoesntAllowRemoteCommands" 18 "VehicleSpeedTooLow" 17 "VehicleSpeedTooHigh" 16 "AlternateGuidanceSystemActive" 31 "NotAvailable" 30 "Error" 15 "ControlUnitInDiagnosticMode" 10 "ControlLoopSecurityFault" 9 "FunctionFault" 8 "OperatorControlFault" 5 "RemoteCommandTimeout" 4 "OperatorControlNotInValidPosition" 3 "OperatorOverrideOfFunction" 2 "ImplementReleasedControlOfFunction" 7 "FunctionNotCalibrated" 6 "RemoteCommandOutOfRangeOrInvalid" 1 "RequiredLevelOfOperatorPresence_AwarenessNotDetected" 0 "NoReason_AllClear" ;
VAL_ 2621243134 VehicleSpeed_VS 65535 "NotAvailable" 65534 "Error" ;
VAL_ 2621243134 ExitReasonCode_VS 31 "NotAvailable" 30 "Error" 15 "VehicleTransmissionGearDoesntAllowRemoteCommands " 10 "ControlLoopSecurityFault" 9 "FunctionFault" 8 "OperatorControlFault" 5 "RemoteCommandTimeout" 4 "OperatorControlNotInValidPosition" 3 "OperatorOverrideOfFunction" 2 "ImplementReleasedControlOfFunction" 7 "FunctionNotCalibrated" 6 "RemoteCommandOutOfRangeOrInvalid" 1 "RequiredLevelOfOperatorPresence_AwarenessNotDetected" 0 "NoReason_AllClear" ;
VAL_ 2621243134 Position_FH 65535 "NotAvailable" 65534 "Error" ;
VAL_ 2621243134 ExitReasonCode_FH 16 "HitchLockedOut" 31 "NotAvailable" 30 "Error" 15 "HydraulicOilLevelLow" 10 "ControlLoopSecurityFault" 9 "FunctionFault" 8 "OperatorControlFault" 5 "RemoteCommandTimeout" 4 "OperatorControlNotInValidPosition" 3 "OperatorOverrideOfFunction" 2 "ImplementReleasedControlOfFunction" 7 "FunctionNotCalibrated" 6 "RemoteCommandOutOfRangeOrInvalid" 1 "RequiredLevelOfOperatorPresence_AwarenessNotDetected" 0 "NoReason_AllClear" ;
VAL_ 2621243134 Speed_FPTO 65535 "NotAvailable" 65534 "Error" ;
VAL_ 2621243134 ExitReasonCode_FPTO 31 "NotAvailable" 30 "Error" 15 "InvalidPtoGear" 10 "ControlLoopSecurityFault" 9 "FunctionFault" 8 "OperatorControlFault" 5 "RemoteCommandTimeout" 4 "OperatorControlNotInValidPosition" 3 "OperatorOverrideOfFunction" 2 "ImplementReleasedControlOfFunction" 7 "FunctionNotCalibrated" 6 "RemoteCommandOutOfRange_Invalid" 1 "RequiredLevelOfOperatorPresence_AwarenessNotDetected" 0 "NoReason_AllClear" ;
VAL_ 2621243134 Flow_AV01 65535 "NotAvailable" 65534 "Error" 64257 "Float" 64256 "ValveFullyOpened_Retract" 32128 "NoFlow_Block" 0 "ValveFullyOpened_Extend" ;
VAL_ 2621243134 ExitReasonCode_AV01 31 "NotAvailable" 30 "Error" 16 "ValveLockedOut_TransportLock" 15 "HydraulicOilLevelLow" 10 "ControlLoopSecurityFault" 9 "FunctionFault" 8 "OperatorControlFault" 5 "RemoteCommandTimeout" 4 "OperatorControlNotInValidPosition" 3 "OperatorOverrideOfFunction" 2 "ImplementReleasedControlOfFunction" 7 "FunctionNotCalibrated" 6 "RemoteCommandOutOfRange_Invalid" 1 "RequiredLevelOfOperatorPresence_AwarenessNotDetected" 0 "NoReason_AllClear" ;
VAL_ 2621243134 TIMFunctionID 72 "RearTopLinkage" 71 "FrontTopLinkage" 32 "TIM_AuxValve32" 70 "ExternalGuidance" 68 "VehicleSpeed" 67 "RearHitch" 66 "FrontHitch" 65 "RearPTO" 64 "FrontPTO" 31 "TIM_AuxValve31" 30 "TIM_AuxValve30" 29 "TIM_AuxValve29" 28 "TIM_AuxValve28" 27 "TIM_AuxValve27" 26 "TIM_AuxValve26" 25 "TIM_AuxValve25" 24 "TIM_AuxValve24" 23 "TIM_AuxValve23" 22 "TIM_AuxValve22" 21 "TIM_AuxValve21" 20 "TIM_AuxValve20" 19 "TIM_AuxValve19" 18 "TIM_AuxValve18" 17 "TIM_AuxValve17" 16 "TIM_AuxValve16" 15 "TIM_AuxValve15" 14 "TIM_AuxValve14" 13 "TIM_AuxValve13" 12 "TIM_AuxValve12" 11 "TIM_AuxValve11" 10 "TIM_AuxValve10" 9 "TIM_AuxValve9" 8 "TIM_AuxValve8" 7 "TIM_AuxValve7" 6 "TIM_AuxValve6" 5 "TIM_AuxValve5" 4 "TIM_AuxValve4" 3 "TIM_AuxValve3" 2 "TIM_AuxValve2" 1 "TIM_AuxValve1" ;
VAL_ 2624585470 ClientCertType 255 "NotAvailable" 6 "CRLCertificate" 5 "CRLSigningCertificate" 4 "DeviceCertificate" 3 "ManufacturerSeriesCertificate" 2 "ManufacturerCertificate" 1 "TestlabCertificate" 0 "AEFRootCertificate" ;
VAL_ 2624585470 ClientCertificateFormat 255 "NotAvailable" 0 "DER_BinaryInASN_1" ;
VAL_ 2624585470 ImplementedAuthVersion 255 "AuthVersionNotSupported" ;
VAL_ 2624585470 MinimumAuthVersion 255 "AuthVersionNotSupported" ;
VAL_ 2624585470 ImplementedAuthConnectionVersion 255 "NoAuthVersionSupport" 254 "Reserved" 253 "AuthVersionIncompatible" 252 "Reserved" 251 "Reserved" 0 "Reserved" ;
VAL_ 2624585470 MinimumAuthConnectionVersion 255 "NoAuthVersionSupport" 254 "Reserved" 253 "AuthVersionIncompatible" 252 "Reserved" 251 "Reserved" 0 "Reserved" ;
VAL_ 2624585470 LwAPossible 1 "SetOrTrue" 0 "UnsetOrFalse" ;
VAL_ 2624585470 TestlabCertIsValid 1 "SetOrTrue" 0 "UnsetOrFalse" ;
VAL_ 2624585470 ReStartAuth 1 "SetOrTrue" 0 "UnsetOrFalse" ;
VAL_ 2624585470 ManufactSeriesCertIsValid 1 "SetOrTrue" 0 "UnsetOrFalse" ;
VAL_ 2624585470 ManufactCertIsValid 1 "SetOrTrue" 0 "UnsetOrFalse" ;
VAL_ 2624585470 DeviceCertIsValid 1 "SetOrTrue" 0 "UnsetOrFalse" ;
VAL_ 2624585470 ChallengeSigned 1 "SetOrTrue" 0 "UnsetOrFalse" ;
VAL_ 2624585470 AuthenticationStatus 15 "NotAvailable" 14 "Error" 1 "Authenticated" 0 "NotAuthenticated" ;
VAL_ 2624585470 ErrorCode 40 "AuthVersionIncompatible" 39 "LwAPossibleBitMismatch" 38 "AuthenticationAbortedDueToGeneralPeerError" 37 "AuthenticationAbortedByPeerDueToError" 36 "ChallengeDataCorrupt" 35 "InvalidChallengeLength" 34 "FunctionFacilityNotCertified" 33 "RequestNotAllowed" 32 "Reserved_0x20" 31 "AuthenticationTimeout" 30 "CertificateTypeInvalid" 29 "DeviceCertificateRevoked" 28 "ManufacturerSeriesCertificateRevoked" 27 "ManufacturerCertificateRevoked" 26 "LabCertificateRevoked" 25 "RootCertificateRevoked" 24 "CertificateTypeMismatch" 23 "CertificateChainInvalid" 22 "ECU_CCID_Mismatch" 21 "NAME_Mismatch" 20 "ECC_PublicKeyValidationFailed" 19 "UnexpectedRestartAuthenticationBitSet" 18 "AuthenticationStatusInvalid" 17 "AuthenticationTypeNotSupported" 16 "AuthenticationStatusLost" 15 "DeviceCertificateDataCorrupt" 14 "ManufacturerSeriesCertificateDataCorrupt" 13 "ManufacturerCertificateDataCorrupt" 12 "TestLabCertificateDataCorrupt" 11 "RootCertificateDataCorrupt" 10 "InternalError" 9 "ChallengesDontMatch" 8 "DeviceCertificateSignatureInvalid" 7 "ManufacturerSeriesCertificateSignatureInvalid" 6 "ManufacturerCertificateSignatureInvalid" 5 "LabCertificateSignatureInvalid" 4 "RootCertificateSignatureInvalid" 3 "NotAuthenticationServerOrClient" 2 "CertificateFormatNotSupported" 1 "ParticipantBusy" 0 "NoError" ;
VAL_ 2624585470 ServerCertType 255 "NotAvailable" 6 "CRLCertificate" 5 "CRLSigningCertificate" 4 "DeviceCertificate" 3 "ManufacturerSeriesCertificate" 2 "ManufacturerCertificate" 1 "TestlabCertificate" 0 "AEFRootCertificate" ;
VAL_ 2624585470 ServerCertificateFormat 255 "NotAvailable" 0 "DER_BinaryInASN_1" ;
VAL_ 2624585470 AuthenticationType 15 "NotAvailable" 14 "Error" 0 "TIM_Authentication" ;
VAL_ 2624585470 MessageCode 18 "Client Full FV Sync Response" 17 "Server Full FV Sync Request" 248 "AuthServerVersionRequest" 247 "AuthClientVersionResponse" 9 "ClientAuthenticationInfoResponse" 8 "ServerAuthenticationInfoRequest" 250 "ClientAuthenticationStatus" 7 "ClientSignedChallengeResponse" 6 "ServerSignedChallengeRequest" 5 "ClientRandomChallengeResponse" 4 "ServerRandomChallengeRequest" 3 "ClientCertificateResponse" 2 "ServerCertificateRequest" ;
VAL_ 2624651006 ClientCertType 255 "NotAvailable" 6 "CRLCertificate" 5 "CRLSigningCertificate" 4 "DeviceCertificate" 3 "ManufacturerSeriesCertificate" 2 "ManufacturerCertificate" 1 "TestlabCertificate" 0 "AEFRootCertificate" ;
VAL_ 2624651006 ClientCertificateFormat 255 "NotAvailable" 0 "DER_BinaryInASN1" ;
VAL_ 2624651006 ImplementedAuthVersion 255 "AuthVersionNotSupported" ;
VAL_ 2624651006 MinimumAuthVersion 255 "AuthVersionNotSupported" ;
VAL_ 2624651006 AuthConnectionVersion 255 "NoAuthVersionSupport" 254 "Reserved" 253 "AuthVersionIncompatible" 252 "Reserved" 251 "Reserved" 0 "Reserved" ;
VAL_ 2624651006 AuthenticationStatus 15 "NotAvailable" 14 "Error" 1 "Authenticated" 0 "NotAuthenticated" ;
VAL_ 2624651006 ChallengeSigned 1 "SetOrTrue" 0 "UnsetOrFalse" ;
VAL_ 2624651006 DeviceCertIsValid 1 "SetOrTrue" 0 "UnsetOrFalse" ;
VAL_ 2624651006 ManufactSeriesCertIsValid 1 "SetOrTrue" 0 "UnsetOrFalse" ;
VAL_ 2624651006 ManufactCertIsValid 1 "SetOrTrue" 0 "UnsetOrFalse" ;
VAL_ 2624651006 TestlabCertIsValid 1 "SetOrTrue" 0 "UnsetOrFalse" ;
VAL_ 2624651006 LwAPossible 1 "SetOrTrue" 0 "UnsetOrFalse" ;
VAL_ 2624651006 ReStartAuth 1 "SetOrTrue" 0 "UnsetOrFalse" ;
VAL_ 2624651006 ServerCertType 255 "NotAvailable" 6 "CRLCertificate" 5 "CRLSigningCertificate" 4 "DeviceCertificate" 3 "ManufacturerSeriesCertificate" 2 "ManufacturerCertificate" 1 "TestlabCertificate" 0 "AEFRootCertificate" ;
VAL_ 2624651006 ServerCertificateFormat 255 "NotAvailable" 0 "DER_BinaryInASN1" ;
VAL_ 2624651006 AuthenticationType 15 "NotAvailable" 14 "Error" 0 "TIM_Authentication" ;
VAL_ 2624651006 MessageCode 18 "Client Full FV Sync Request" 17 "Server Full FV Sync Response" 248 "AuthServerVersionResponse" 247 "AuthClientVersionRequest" 9 "ClientAuthenticationInfoRequest" 8 "ServerAuthenticationInfoResponse" 249 "ServerAuthenticationStatus" 7 "ClientSignedChallengeRequest" 6 "ServerSignedChallengeResponse" 5 "ClientRandomChallengeRequest" 4 "ServerRandomChallengeResponse" 3 "ClientCertificateRequest" 2 "ServerCertificateResponse" ;
VAL_ 2624651006 ErrorCode 40 "AuthVersionIncompatible" 39 "LwAPossibleBitMismatch" 38 "AuthenticationAbortedDueToGeneralPeerError" 37 "AuthenticationAbortedByPeerDueToError" 36 "ChallengeDataCorrupt" 35 "InvalidChallengeLength" 34 "FunctionFacilityNotCertified" 33 "RequestNotAllowed" 32 "Reserved_0x20" 31 "AuthenticationTimeout" 30 "CertificateTypeInvalid" 29 "DeviceCertificateRevoked" 28 "ManufacturerSeriesCertificateRevoked" 27 "ManufacturerCertificateRevoked" 26 "LabCertificateRevoked" 25 "RootCertificateRevoked" 24 "CertificateTypeMismatch" 23 "CertificateChainInvalid" 22 "ECU_CCID_Mismatch" 21 "NAME_Mismatch" 20 "ECC_PublicKeyValidationFailed" 19 "UnexpectedRestartAuthenticationBitSet" 18 "AuthenticationStatusInvalid" 17 "AuthenticationTypeNotSupported" 16 "AuthenticationStatusLost" 15 "DeviceCertificateDataCorrupt" 14 "ManufacturerSeriesCertificateDataCorrupt" 13 "ManufacturerCertificateDataCorrupt" 12 "TestLabCertificateDataCorrupt" 11 "RootCertificateDataCorrupt" 10 "InternalError" 9 "ChallengesDontMatch" 8 "DeviceCertificateSignatureInvalid" 7 "ManufacturerSeriesCertificateSignatureInvalid" 6 "ManufacturerCertificateSignatureInvalid" 5 "LabCertificateSignatureInvalid" 4 "RootCertificateSignatureInvalid" 3 "NotAuthenticationServerOrClient" 2 "CertificateFormatNotSupported" 1 "ParticipantBusy" 0 "NoError" ;
SG_MUL_VAL_ 2621243134 FlowMaxIncAggressiveness_AV32 MsgType_AV32 65-65;
SG_MUL_VAL_ 2621243134 FlowMaxIncAggressiveness_AV31 MsgType_AV31 65-65;
SG_MUL_VAL_ 2621243134 FlowMaxIncAggressiveness_AV30 MsgType_AV30 65-65;
SG_MUL_VAL_ 2621243134 FlowMaxIncAggressiveness_AV29 MsgType_AV29 65-65;
SG_MUL_VAL_ 2621243134 FlowMaxIncAggressiveness_AV28 MsgType_AV28 65-65;
SG_MUL_VAL_ 2621243134 FlowMaxIncAggressiveness_AV27 MsgType_AV27 65-65;
SG_MUL_VAL_ 2621243134 FlowMaxIncAggressiveness_AV26 MsgType_AV26 65-65;
SG_MUL_VAL_ 2621243134 FlowMaxIncAggressiveness_AV25 MsgType_AV25 65-65;
SG_MUL_VAL_ 2621243134 FlowMaxIncAggressiveness_AV24 MsgType_AV24 65-65;
SG_MUL_VAL_ 2621243134 FlowMaxIncAggressiveness_AV23 MsgType_AV23 65-65;
SG_MUL_VAL_ 2621243134 FlowMaxIncAggressiveness_AV22 MsgType_AV22 65-65;
SG_MUL_VAL_ 2621243134 FlowMaxIncAggressiveness_AV21 MsgType_AV21 65-65;
SG_MUL_VAL_ 2621243134 FlowMaxIncAggressiveness_AV20 MsgType_AV20 65-65;
SG_MUL_VAL_ 2621243134 FlowMaxIncAggressiveness_AV19 MsgType_AV19 65-65;
SG_MUL_VAL_ 2621243134 FlowMaxIncAggressiveness_AV18 MsgType_AV18 65-65;
SG_MUL_VAL_ 2621243134 FlowMaxIncAggressiveness_AV17 MsgType_AV17 65-65;
SG_MUL_VAL_ 2621243134 FlowMaxIncAggressiveness_AV16 MsgType_AV16 65-65;
SG_MUL_VAL_ 2621243134 FlowMaxIncAggressiveness_AV15 MsgType_AV15 65-65;
SG_MUL_VAL_ 2621243134 FlowMaxIncAggressiveness_AV14 MsgType_AV14 65-65;
SG_MUL_VAL_ 2621243134 FlowMaxIncAggressiveness_AV13 MsgType_AV13 65-65;
SG_MUL_VAL_ 2621243134 FlowMaxIncAggressiveness_AV12 MsgType_AV12 65-65;
SG_MUL_VAL_ 2621243134 FlowMaxIncAggressiveness_AV11 MsgType_AV11 65-65;
SG_MUL_VAL_ 2621243134 FlowMaxIncAggressiveness_AV10 MsgType_AV10 65-65;
SG_MUL_VAL_ 2621243134 FlowMaxIncAggressiveness_AV09 MsgType_AV09 65-65;
SG_MUL_VAL_ 2621243134 FlowMaxIncAggressiveness_AV08 MsgType_AV08 65-65;
SG_MUL_VAL_ 2621243134 FlowMaxIncAggressiveness_AV07 MsgType_AV07 65-65;
SG_MUL_VAL_ 2621243134 FlowMaxIncAggressiveness_AV06 MsgType_AV06 65-65;
SG_MUL_VAL_ 2621243134 FlowMaxIncAggressiveness_AV05 MsgType_AV05 65-65;
SG_MUL_VAL_ 2621243134 FlowMaxIncAggressiveness_AV04 MsgType_AV04 65-65;
SG_MUL_VAL_ 2621243134 FlowMaxIncAggressiveness_AV03 MsgType_AV03 65-65;
SG_MUL_VAL_ 2621243134 FlowMaxIncAggressiveness_AV02 MsgType_AV02 65-65;
SG_MUL_VAL_ 2621243134 FlowMaxIncAggressiveness_AV01 MsgType_AV01 65-65;
SG_MUL_VAL_ 2621243134 FlowMaxDecAggressiveness_AV32 MsgType_AV32 65-65;
SG_MUL_VAL_ 2621243134 FlowMaxDecAggressiveness_AV31 MsgType_AV31 65-65;
SG_MUL_VAL_ 2621243134 FlowMaxDecAggressiveness_AV30 MsgType_AV30 65-65;
SG_MUL_VAL_ 2621243134 FlowMaxDecAggressiveness_AV29 MsgType_AV29 65-65;
SG_MUL_VAL_ 2621243134 FlowMaxDecAggressiveness_AV28 MsgType_AV28 65-65;
SG_MUL_VAL_ 2621243134 FlowMaxDecAggressiveness_AV27 MsgType_AV27 65-65;
SG_MUL_VAL_ 2621243134 FlowMaxDecAggressiveness_AV26 MsgType_AV26 65-65;
SG_MUL_VAL_ 2621243134 FlowMaxDecAggressiveness_AV25 MsgType_AV25 65-65;
SG_MUL_VAL_ 2621243134 FlowMaxDecAggressiveness_AV24 MsgType_AV24 65-65;
SG_MUL_VAL_ 2621243134 FlowMaxDecAggressiveness_AV23 MsgType_AV23 65-65;
SG_MUL_VAL_ 2621243134 FlowMaxDecAggressiveness_AV22 MsgType_AV22 65-65;
SG_MUL_VAL_ 2621243134 FlowMaxDecAggressiveness_AV21 MsgType_AV21 65-65;
SG_MUL_VAL_ 2621243134 FlowMaxDecAggressiveness_AV20 MsgType_AV20 65-65;
SG_MUL_VAL_ 2621243134 FlowMaxDecAggressiveness_AV19 MsgType_AV19 65-65;
SG_MUL_VAL_ 2621243134 FlowMaxDecAggressiveness_AV18 MsgType_AV18 65-65;
SG_MUL_VAL_ 2621243134 FlowMaxDecAggressiveness_AV17 MsgType_AV17 65-65;
SG_MUL_VAL_ 2621243134 FlowMaxDecAggressiveness_AV16 MsgType_AV16 65-65;
SG_MUL_VAL_ 2621243134 FlowMaxDecAggressiveness_AV15 MsgType_AV15 65-65;
SG_MUL_VAL_ 2621243134 FlowMaxDecAggressiveness_AV14 MsgType_AV14 65-65;
SG_MUL_VAL_ 2621243134 FlowMaxDecAggressiveness_AV13 MsgType_AV13 65-65;
SG_MUL_VAL_ 2621243134 FlowMaxDecAggressiveness_AV12 MsgType_AV12 65-65;
SG_MUL_VAL_ 2621243134 FlowMaxDecAggressiveness_AV11 MsgType_AV11 65-65;
SG_MUL_VAL_ 2621243134 FlowMaxDecAggressiveness_AV10 MsgType_AV10 65-65;
SG_MUL_VAL_ 2621243134 FlowMaxDecAggressiveness_AV09 MsgType_AV09 65-65;
SG_MUL_VAL_ 2621243134 FlowMaxDecAggressiveness_AV08 MsgType_AV08 65-65;
SG_MUL_VAL_ 2621243134 FlowMaxDecAggressiveness_AV07 MsgType_AV07 65-65;
SG_MUL_VAL_ 2621243134 FlowMaxDecAggressiveness_AV06 MsgType_AV06 65-65;
SG_MUL_VAL_ 2621243134 FlowMaxDecAggressiveness_AV05 MsgType_AV05 65-65;
SG_MUL_VAL_ 2621243134 FlowMaxDecAggressiveness_AV04 MsgType_AV04 65-65;
SG_MUL_VAL_ 2621243134 FlowMaxDecAggressiveness_AV03 MsgType_AV03 65-65;
SG_MUL_VAL_ 2621243134 FlowMaxDecAggressiveness_AV02 MsgType_AV02 65-65;
SG_MUL_VAL_ 2621243134 FlowMaxDecAggressiveness_AV01 MsgType_AV01 65-65;
SG_MUL_VAL_ 2621243134 CurvatureMaxAggressiveness_EG MsgType_EG 65-65;
SG_MUL_VAL_ 2621243134 VSpeedMaxDecAggressiveness_VS MsgType_VS 65-65;
SG_MUL_VAL_ 2621243134 VSpeedMaxIncAggressiveness_VS MsgType_VS 65-65;
SG_MUL_VAL_ 2621243134 PositonMaxIncAggressiveness_RTL MsgType_RTL 65-65;
SG_MUL_VAL_ 2621243134 PositonMaxIncAggressiveness_FTL MsgType_FTL 65-65;
SG_MUL_VAL_ 2621243134 PositonMaxDecAggressiveness_RTL MsgType_RTL 65-65;
SG_MUL_VAL_ 2621243134 PositonMaxDecAggressiveness_FTL MsgType_FTL 65-65;
SG_MUL_VAL_ 2621243134 PositonMaxIncAggressiveness_RH MsgType_RH 65-65;
SG_MUL_VAL_ 2621243134 PositonMaxIncAggressiveness_FH MsgType_FH 65-65;
SG_MUL_VAL_ 2621243134 PositonMaxDecAggressiveness_RH MsgType_RH 65-65;
SG_MUL_VAL_ 2621243134 PositonMaxDecAggressiveness_FH MsgType_FH 65-65;
SG_MUL_VAL_ 2621243134 SpeedMaxDecAggressiveness_RPTO MsgType_RPTO 65-65;
SG_MUL_VAL_ 2621243134 SpeedMaxDecAggressiveness_FPTO MsgType_FPTO 65-65;
SG_MUL_VAL_ 2621243134 SpeedMaxIncAggressiveness_RPTO MsgType_RPTO 65-65;
SG_MUL_VAL_ 2621243134 SpeedMaxIncAggressiveness_FPTO MsgType_FPTO 65-65;
SG_MUL_VAL_ 2621243134 SecurityByte_VS MsgType_VS 1-1, 17-17;
SG_MUL_VAL_ 2621243134 SecurityByte_RTL Position_RTL 1-1, 17-17;
SG_MUL_VAL_ 2621243134 SecurityByte_RPTO MsgType_RPTO 1-1, 17-17;
SG_MUL_VAL_ 2621243134 SecurityByte_RH MsgType_RH 1-1, 17-17;
SG_MUL_VAL_ 2621243134 SecurityByte_FTL MsgType_FTL 1-1, 17-17;
SG_MUL_VAL_ 2621243134 SecurityByte_FPTO MsgType_FPTO 1-1, 17-17;
SG_MUL_VAL_ 2621243134 SecurityByte_FH MsgType_FH 1-1, 17-17;
SG_MUL_VAL_ 2621243134 SecurityByte_EG MsgType_EG 1-1, 17-17;
SG_MUL_VAL_ 2621243134 SecurityByte_AV32 MsgType_AV32 1-1, 17-17;
SG_MUL_VAL_ 2621243134 SecurityByte_AV31 MsgType_AV31 1-1, 17-17;
SG_MUL_VAL_ 2621243134 SecurityByte_AV30 MsgType_AV30 1-1, 17-17;
SG_MUL_VAL_ 2621243134 SecurityByte_AV29 MsgType_AV29 1-1, 17-17;
SG_MUL_VAL_ 2621243134 SecurityByte_AV28 MsgType_AV28 1-1, 17-17;
SG_MUL_VAL_ 2621243134 SecurityByte_AV27 MsgType_AV27 1-1, 17-17;
SG_MUL_VAL_ 2621243134 SecurityByte_AV26 MsgType_AV26 1-1, 17-17;
SG_MUL_VAL_ 2621243134 SecurityByte_AV25 MsgType_AV25 1-1, 17-17;
SG_MUL_VAL_ 2621243134 SecurityByte_AV24 MsgType_AV24 1-1, 17-17;
SG_MUL_VAL_ 2621243134 SecurityByte_AV23 MsgType_AV23 1-1, 17-17;
SG_MUL_VAL_ 2621243134 SecurityByte_AV22 MsgType_AV22 1-1, 17-17;
SG_MUL_VAL_ 2621243134 SecurityByte_AV21 MsgType_AV21 1-1, 17-17;
SG_MUL_VAL_ 2621243134 SecurityByte_AV20 MsgType_AV20 1-1, 17-17;
SG_MUL_VAL_ 2621243134 SecurityByte_AV19 MsgType_AV19 1-1, 17-17;
SG_MUL_VAL_ 2621243134 SecurityByte_AV18 MsgType_AV18 1-1, 17-17;
SG_MUL_VAL_ 2621243134 SecurityByte_AV17 MsgType_AV17 1-1, 17-17;
SG_MUL_VAL_ 2621243134 SecurityByte_AV16 MsgType_AV16 1-1, 17-17;
SG_MUL_VAL_ 2621243134 SecurityByte_AV15 MsgType_AV15 1-1, 17-17;
SG_MUL_VAL_ 2621243134 SecurityByte_AV14 MsgType_AV14 1-1, 17-17;
SG_MUL_VAL_ 2621243134 SecurityByte_AV13 MsgType_AV13 1-1, 17-17;
SG_MUL_VAL_ 2621243134 SecurityByte_AV12 MsgType_AV12 1-1, 17-17;
SG_MUL_VAL_ 2621243134 SecurityByte_AV11 MsgType_AV11 1-1, 17-17;
SG_MUL_VAL_ 2621243134 SecurityByte_AV10 MsgType_AV10 1-1, 17-17;
SG_MUL_VAL_ 2621243134 SecurityByte_AV09 MsgType_AV09 1-1, 17-17;
SG_MUL_VAL_ 2621243134 SecurityByte_AV08 MsgType_AV08 1-1, 17-17;
SG_MUL_VAL_ 2621243134 SecurityByte_AV07 MsgType_AV07 1-1, 17-17;
SG_MUL_VAL_ 2621243134 SecurityByte_AV06 MsgType_AV06 1-1, 17-17;
SG_MUL_VAL_ 2621243134 SecurityByte_AV05 MsgType_AV05 1-1, 17-17;
SG_MUL_VAL_ 2621243134 SecurityByte_AV04 MsgType_AV04 1-1, 17-17;
SG_MUL_VAL_ 2621243134 SecurityByte_AV03 MsgType_AV03 1-1, 17-17;
SG_MUL_VAL_ 2621243134 SecurityByte_AV02 MsgType_AV02 1-1, 17-17;
SG_MUL_VAL_ 2621243134 SecurityByte_AV01 MsgType_AV01 1-1, 17-17;
SG_MUL_VAL_ 2621243134 State_RH MsgType_RH 17-17;
SG_MUL_VAL_ 2621243134 State_RTL MsgType_RTL 17-17;
SG_MUL_VAL_ 2621243134 State_FTL MsgType_FTL 17-17;
SG_MUL_VAL_ 2621243134 State_FH MsgType_FH 17-17;
SG_MUL_VAL_ 2621243134 StrokeLength_CM1GP_RTL ControlMode1_RTL 0-0;
SG_MUL_VAL_ 2621243134 BaseLength_CM1GP_RTL ControlMode1_RTL 0-0;
SG_MUL_VAL_ 2621243134 StrokeLength_CM1GP_FTL ControlMode1_FTL 0-0;
SG_MUL_VAL_ 2621243134 BaseLength_CM1GP_FTL ControlMode1_FTL 0-0;
SG_MUL_VAL_ 2621243134 MinimumSpeedBackward_CM1GP_VS ControlMode1_VS 0-0;
SG_MUL_VAL_ 2621243134 MaximumSpeedBackward_CM1GP_VS ControlMode1_VS 0-0;
SG_MUL_VAL_ 2621243134 MinimumSpeedForward_CM1GP_VS ControlMode1_VS 0-0;
SG_MUL_VAL_ 2621243134 MaximumSpeedForward_CM1GP_VS ControlMode1_VS 0-0;
SG_MUL_VAL_ 2621243134 TransmissionType_CM1GP_VS ControlMode1_VS 0-0;
SG_MUL_VAL_ 2621243134 ControlMode1_RTL MsgType_RTL 0-0;
SG_MUL_VAL_ 2621243134 NumOfControlModes_RTL MsgType_RTL 0-0;
SG_MUL_VAL_ 2621243134 NumOfBytes_CM1_RTL MsgType_RTL 0-0;
SG_MUL_VAL_ 2621243134 Position_RTL MsgType_RTL 17-17;
SG_MUL_VAL_ 2621243134 Position_FTL MsgType_FTL 17-17;
SG_MUL_VAL_ 2621243134 ExitReasonCode_RTL MsgType_RTL 1-1;
SG_MUL_VAL_ 2621243134 ExitReasonCode_FTL MsgType_FTL 1-1;
SG_MUL_VAL_ 2621243134 AutomationStatus_RTL MsgType_RTL 1-1;
SG_MUL_VAL_ 2621243134 AutomationStatus_FTL MsgType_FTL 1-1;
SG_MUL_VAL_ 2621243134 ControlMode1_FTL MsgType_FTL 0-0;
SG_MUL_VAL_ 2621243134 NumOfBytes_CM1_FTL MsgType_FTL 0-0;
SG_MUL_VAL_ 2621243134 NumOfControlModes_FTL MsgType_FTL 0-0;
SG_MUL_VAL_ 2621243134 MsgType_RTL TIMFunctionID 72-72;
SG_MUL_VAL_ 2621243134 MsgType_FTL TIMFunctionID 71-71;
SG_MUL_VAL_ 2621243134 MsgType_EG TIMFunctionID 70-70;
SG_MUL_VAL_ 2621243134 NumOfBytes_CM1_VS MsgType_VS 0-0;
SG_MUL_VAL_ 2621243134 ControlMode1_VS MsgType_VS 0-0;
SG_MUL_VAL_ 2621243134 NumOfControlModes_VS MsgType_VS 0-0;
SG_MUL_VAL_ 2621243134 MsgType_VS TIMFunctionID 68-68;
SG_MUL_VAL_ 2621243134 MsgType_RH TIMFunctionID 67-67;
SG_MUL_VAL_ 2621243134 MsgType_FH TIMFunctionID 66-66;
SG_MUL_VAL_ 2621243134 MsgType_RPTO TIMFunctionID 65-65;
SG_MUL_VAL_ 2621243134 MsgType_FPTO TIMFunctionID 64-64;
SG_MUL_VAL_ 2621243134 MsgType_AV32 TIMFunctionID 32-32;
SG_MUL_VAL_ 2621243134 MsgType_AV31 TIMFunctionID 31-31;
SG_MUL_VAL_ 2621243134 MsgType_AV30 TIMFunctionID 30-30;
SG_MUL_VAL_ 2621243134 MsgType_AV29 TIMFunctionID 29-29;
SG_MUL_VAL_ 2621243134 MsgType_AV28 TIMFunctionID 28-28;
SG_MUL_VAL_ 2621243134 MsgType_AV27 TIMFunctionID 27-27;
SG_MUL_VAL_ 2621243134 MsgType_AV26 TIMFunctionID 26-26;
SG_MUL_VAL_ 2621243134 MsgType_AV25 TIMFunctionID 25-25;
SG_MUL_VAL_ 2621243134 MsgType_AV24 TIMFunctionID 24-24;
SG_MUL_VAL_ 2621243134 MsgType_AV23 TIMFunctionID 23-23;
SG_MUL_VAL_ 2621243134 MsgType_AV22 TIMFunctionID 22-22;
SG_MUL_VAL_ 2621243134 MsgType_AV21 TIMFunctionID 21-21;
SG_MUL_VAL_ 2621243134 MsgType_AV20 TIMFunctionID 20-20;
SG_MUL_VAL_ 2621243134 MsgType_AV19 TIMFunctionID 19-19;
SG_MUL_VAL_ 2621243134 MsgType_AV18 TIMFunctionID 18-18;
SG_MUL_VAL_ 2621243134 MsgType_AV17 TIMFunctionID 17-17;
SG_MUL_VAL_ 2621243134 MsgType_AV16 TIMFunctionID 16-16;
SG_MUL_VAL_ 2621243134 MsgType_AV15 TIMFunctionID 15-15;
SG_MUL_VAL_ 2621243134 MsgType_AV14 TIMFunctionID 14-14;
SG_MUL_VAL_ 2621243134 MsgType_AV13 TIMFunctionID 13-13;
SG_MUL_VAL_ 2621243134 MsgType_AV12 TIMFunctionID 12-12;
SG_MUL_VAL_ 2621243134 MsgType_AV11 TIMFunctionID 11-11;
SG_MUL_VAL_ 2621243134 MsgType_AV10 TIMFunctionID 10-10;
SG_MUL_VAL_ 2621243134 MsgType_AV09 TIMFunctionID 9-9;
SG_MUL_VAL_ 2621243134 MsgType_AV08 TIMFunctionID 8-8;
SG_MUL_VAL_ 2621243134 MsgType_AV07 TIMFunctionID 7-7;
SG_MUL_VAL_ 2621243134 MsgType_AV06 TIMFunctionID 6-6;
SG_MUL_VAL_ 2621243134 MsgType_AV05 TIMFunctionID 5-5;
SG_MUL_VAL_ 2621243134 MsgType_AV04 TIMFunctionID 4-4;
SG_MUL_VAL_ 2621243134 MsgType_AV03 TIMFunctionID 3-3;
SG_MUL_VAL_ 2621243134 MsgType_AV02 TIMFunctionID 2-2;
SG_MUL_VAL_ 2621243134 MsgType_AV01 TIMFunctionID 1-1;
SG_MUL_VAL_ 2621243134 Position_RH MsgType_RH 17-17;
SG_MUL_VAL_ 2621243134 Speed_RPTO MsgType_RPTO 17-17;
SG_MUL_VAL_ 2621243134 Flow_AV32 MsgType_AV32 17-17;
SG_MUL_VAL_ 2621243134 Flow_AV31 MsgType_AV31 17-17;
SG_MUL_VAL_ 2621243134 Flow_AV30 MsgType_AV30 17-17;
SG_MUL_VAL_ 2621243134 Flow_AV29 MsgType_AV29 17-17;
SG_MUL_VAL_ 2621243134 Flow_AV28 MsgType_AV28 17-17;
SG_MUL_VAL_ 2621243134 Flow_AV27 MsgType_AV27 17-17;
SG_MUL_VAL_ 2621243134 Flow_AV26 MsgType_AV26 17-17;
SG_MUL_VAL_ 2621243134 Flow_AV25 MsgType_AV25 17-17;
SG_MUL_VAL_ 2621243134 Flow_AV24 MsgType_AV24 17-17;
SG_MUL_VAL_ 2621243134 Flow_AV23 MsgType_AV23 17-17;
SG_MUL_VAL_ 2621243134 Flow_AV22 MsgType_AV22 17-17;
SG_MUL_VAL_ 2621243134 Flow_AV21 MsgType_AV21 17-17;
SG_MUL_VAL_ 2621243134 Flow_AV20 MsgType_AV20 17-17;
SG_MUL_VAL_ 2621243134 Flow_AV19 MsgType_AV19 17-17;
SG_MUL_VAL_ 2621243134 Flow_AV18 MsgType_AV18 17-17;
SG_MUL_VAL_ 2621243134 Flow_AV17 MsgType_AV17 17-17;
SG_MUL_VAL_ 2621243134 Flow_AV16 MsgType_AV16 17-17;
SG_MUL_VAL_ 2621243134 Flow_AV15 MsgType_AV15 17-17;
SG_MUL_VAL_ 2621243134 Flow_AV14 MsgType_AV14 17-17;
SG_MUL_VAL_ 2621243134 Flow_AV13 MsgType_AV13 17-17;
SG_MUL_VAL_ 2621243134 Flow_AV12 MsgType_AV12 17-17;
SG_MUL_VAL_ 2621243134 Flow_AV11 MsgType_AV11 17-17;
SG_MUL_VAL_ 2621243134 Flow_AV10 MsgType_AV10 17-17;
SG_MUL_VAL_ 2621243134 Flow_AV09 MsgType_AV09 17-17;
SG_MUL_VAL_ 2621243134 Flow_AV08 MsgType_AV08 17-17;
SG_MUL_VAL_ 2621243134 Flow_AV07 MsgType_AV07 17-17;
SG_MUL_VAL_ 2621243134 Flow_AV06 MsgType_AV06 17-17;
SG_MUL_VAL_ 2621243134 Flow_AV05 MsgType_AV05 17-17;
SG_MUL_VAL_ 2621243134 Flow_AV04 MsgType_AV04 17-17;
SG_MUL_VAL_ 2621243134 Flow_AV03 MsgType_AV03 17-17;
SG_MUL_VAL_ 2621243134 Flow_AV02 MsgType_AV02 17-17;
SG_MUL_VAL_ 2621243134 FlowType_AV32 MsgType_AV32 1-1;
SG_MUL_VAL_ 2621243134 FlowType_AV31 MsgType_AV31 1-1;
SG_MUL_VAL_ 2621243134 FlowType_AV30 MsgType_AV30 1-1;
SG_MUL_VAL_ 2621243134 FlowType_AV29 MsgType_AV29 1-1;
SG_MUL_VAL_ 2621243134 FlowType_AV28 MsgType_AV28 1-1;
SG_MUL_VAL_ 2621243134 FlowType_AV27 MsgType_AV27 1-1;
SG_MUL_VAL_ 2621243134 FlowType_AV26 MsgType_AV26 1-1;
SG_MUL_VAL_ 2621243134 FlowType_AV25 MsgType_AV25 1-1;
SG_MUL_VAL_ 2621243134 FlowType_AV24 MsgType_AV24 1-1;
SG_MUL_VAL_ 2621243134 FlowType_AV23 MsgType_AV23 1-1;
SG_MUL_VAL_ 2621243134 FlowType_AV22 MsgType_AV22 1-1;
SG_MUL_VAL_ 2621243134 FlowType_AV21 MsgType_AV21 1-1;
SG_MUL_VAL_ 2621243134 FlowType_AV20 MsgType_AV20 1-1;
SG_MUL_VAL_ 2621243134 FlowType_AV19 MsgType_AV19 1-1;
SG_MUL_VAL_ 2621243134 FlowType_AV18 MsgType_AV18 1-1;
SG_MUL_VAL_ 2621243134 FlowType_AV17 MsgType_AV17 1-1;
SG_MUL_VAL_ 2621243134 FlowType_AV16 MsgType_AV16 1-1;
SG_MUL_VAL_ 2621243134 FlowType_AV15 MsgType_AV15 1-1;
SG_MUL_VAL_ 2621243134 FlowType_AV14 MsgType_AV14 1-1;
SG_MUL_VAL_ 2621243134 FlowType_AV13 MsgType_AV13 1-1;
SG_MUL_VAL_ 2621243134 FlowType_AV12 MsgType_AV12 1-1;
SG_MUL_VAL_ 2621243134 FlowType_AV11 MsgType_AV11 1-1;
SG_MUL_VAL_ 2621243134 FlowType_AV10 MsgType_AV10 1-1;
SG_MUL_VAL_ 2621243134 FlowType_AV09 MsgType_AV09 1-1;
SG_MUL_VAL_ 2621243134 FlowType_AV08 MsgType_AV08 1-1;
SG_MUL_VAL_ 2621243134 FlowType_AV07 MsgType_AV07 1-1;
SG_MUL_VAL_ 2621243134 FlowType_AV06 MsgType_AV06 1-1;
SG_MUL_VAL_ 2621243134 FlowType_AV05 MsgType_AV05 1-1;
SG_MUL_VAL_ 2621243134 FlowType_AV04 MsgType_AV04 1-1;
SG_MUL_VAL_ 2621243134 FlowType_AV03 MsgType_AV03 1-1;
SG_MUL_VAL_ 2621243134 FlowType_AV02 MsgType_AV02 1-1;
SG_MUL_VAL_ 2621243134 FlowType_AV01 MsgType_AV01 1-1;
SG_MUL_VAL_ 2621243134 ExitReasonCode_RPTO MsgType_RPTO 1-1;
SG_MUL_VAL_ 2621243134 ExitReasonCode_RH MsgType_RH 1-1;
SG_MUL_VAL_ 2621243134 ExitReasonCode_AV32 MsgType_AV32 1-1;
SG_MUL_VAL_ 2621243134 ExitReasonCode_AV31 MsgType_AV31 1-1;
SG_MUL_VAL_ 2621243134 ExitReasonCode_AV30 MsgType_AV30 1-1;
SG_MUL_VAL_ 2621243134 ExitReasonCode_AV29 MsgType_AV29 1-1;
SG_MUL_VAL_ 2621243134 ExitReasonCode_AV28 MsgType_AV28 1-1;
SG_MUL_VAL_ 2621243134 ExitReasonCode_AV27 MsgType_AV27 1-1;
SG_MUL_VAL_ 2621243134 ExitReasonCode_AV26 MsgType_AV26 1-1;
SG_MUL_VAL_ 2621243134 ExitReasonCode_AV25 MsgType_AV25 1-1;
SG_MUL_VAL_ 2621243134 ExitReasonCode_AV24 MsgType_AV24 1-1;
SG_MUL_VAL_ 2621243134 ExitReasonCode_AV23 MsgType_AV23 1-1;
SG_MUL_VAL_ 2621243134 ExitReasonCode_AV22 MsgType_AV22 1-1;
SG_MUL_VAL_ 2621243134 ExitReasonCode_AV21 MsgType_AV21 1-1;
SG_MUL_VAL_ 2621243134 ExitReasonCode_AV20 MsgType_AV20 1-1;
SG_MUL_VAL_ 2621243134 ExitReasonCode_AV19 MsgType_AV19 1-1;
SG_MUL_VAL_ 2621243134 ExitReasonCode_AV18 MsgType_AV18 1-1;
SG_MUL_VAL_ 2621243134 ExitReasonCode_AV17 MsgType_AV17 1-1;
SG_MUL_VAL_ 2621243134 ExitReasonCode_AV16 MsgType_AV16 1-1;
SG_MUL_VAL_ 2621243134 ExitReasonCode_AV15 MsgType_AV15 1-1;
SG_MUL_VAL_ 2621243134 ExitReasonCode_AV14 MsgType_AV14 1-1;
SG_MUL_VAL_ 2621243134 ExitReasonCode_AV13 MsgType_AV13 1-1;
SG_MUL_VAL_ 2621243134 ExitReasonCode_AV12 MsgType_AV12 1-1;
SG_MUL_VAL_ 2621243134 ExitReasonCode_AV11 MsgType_AV11 1-1;
SG_MUL_VAL_ 2621243134 ExitReasonCode_AV10 MsgType_AV10 1-1;
SG_MUL_VAL_ 2621243134 ExitReasonCode_AV09 MsgType_AV09 1-1;
SG_MUL_VAL_ 2621243134 ExitReasonCode_AV08 MsgType_AV08 1-1;
SG_MUL_VAL_ 2621243134 ExitReasonCode_AV07 MsgType_AV07 1-1;
SG_MUL_VAL_ 2621243134 ExitReasonCode_AV06 MsgType_AV06 1-1;
SG_MUL_VAL_ 2621243134 ExitReasonCode_AV05 MsgType_AV05 1-1;
SG_MUL_VAL_ 2621243134 ExitReasonCode_AV04 MsgType_AV04 1-1;
SG_MUL_VAL_ 2621243134 ExitReasonCode_AV03 MsgType_AV03 1-1;
SG_MUL_VAL_ 2621243134 ExitReasonCode_AV02 MsgType_AV02 1-1;
SG_MUL_VAL_ 2621243134 AutomationStatus_AV04 MsgType_AV04 1-1;
SG_MUL_VAL_ 2621243134 AutomationStatus_AV03 MsgType_AV03 1-1;
SG_MUL_VAL_ 2621243134 AutomationStatus_AV02 MsgType_AV02 1-1;
SG_MUL_VAL_ 2621243134 AutomationStatus_AV01 MsgType_AV01 1-1;
SG_MUL_VAL_ 2621243134 AutomationStatus_EG MsgType_EG 1-1;
SG_MUL_VAL_ 2621243134 AutomationStatus_VS MsgType_VS 1-1;
SG_MUL_VAL_ 2621243134 AutomationStatus_RH MsgType_RH 1-1;
SG_MUL_VAL_ 2621243134 AutomationStatus_FH MsgType_FH 1-1;
SG_MUL_VAL_ 2621243134 AutomationStatus_RPTO MsgType_RPTO 1-1;
SG_MUL_VAL_ 2621243134 AutomationStatus_FPTO MsgType_FPTO 1-1;
SG_MUL_VAL_ 2621243134 AutomationStatus_AV32 MsgType_AV32 1-1;
SG_MUL_VAL_ 2621243134 AutomationStatus_AV31 MsgType_AV31 1-1;
SG_MUL_VAL_ 2621243134 AutomationStatus_AV30 MsgType_AV30 1-1;
SG_MUL_VAL_ 2621243134 AutomationStatus_AV29 MsgType_AV29 1-1;
SG_MUL_VAL_ 2621243134 AutomationStatus_AV28 MsgType_AV28 1-1;
SG_MUL_VAL_ 2621243134 AutomationStatus_AV27 MsgType_AV27 1-1;
SG_MUL_VAL_ 2621243134 AutomationStatus_AV26 MsgType_AV26 1-1;
SG_MUL_VAL_ 2621243134 AutomationStatus_AV25 MsgType_AV25 1-1;
SG_MUL_VAL_ 2621243134 AutomationStatus_AV24 MsgType_AV24 1-1;
SG_MUL_VAL_ 2621243134 AutomationStatus_AV23 MsgType_AV23 1-1;
SG_MUL_VAL_ 2621243134 AutomationStatus_AV22 MsgType_AV22 1-1;
SG_MUL_VAL_ 2621243134 AutomationStatus_AV21 MsgType_AV21 1-1;
SG_MUL_VAL_ 2621243134 AutomationStatus_AV20 MsgType_AV20 1-1;
SG_MUL_VAL_ 2621243134 AutomationStatus_AV19 MsgType_AV19 1-1;
SG_MUL_VAL_ 2621243134 AutomationStatus_AV18 MsgType_AV18 1-1;
SG_MUL_VAL_ 2621243134 AutomationStatus_AV17 MsgType_AV17 1-1;
SG_MUL_VAL_ 2621243134 AutomationStatus_AV16 MsgType_AV16 1-1;
SG_MUL_VAL_ 2621243134 AutomationStatus_AV15 MsgType_AV15 1-1;
SG_MUL_VAL_ 2621243134 AutomationStatus_AV14 MsgType_AV14 1-1;
SG_MUL_VAL_ 2621243134 AutomationStatus_AV13 MsgType_AV13 1-1;
SG_MUL_VAL_ 2621243134 AutomationStatus_AV12 MsgType_AV12 1-1;
SG_MUL_VAL_ 2621243134 AutomationStatus_AV11 MsgType_AV11 1-1;
SG_MUL_VAL_ 2621243134 AutomationStatus_AV10 MsgType_AV10 1-1;
SG_MUL_VAL_ 2621243134 AutomationStatus_AV09 MsgType_AV09 1-1;
SG_MUL_VAL_ 2621243134 AutomationStatus_AV08 MsgType_AV08 1-1;
SG_MUL_VAL_ 2621243134 AutomationStatus_AV07 MsgType_AV07 1-1;
SG_MUL_VAL_ 2621243134 AutomationStatus_AV06 MsgType_AV06 1-1;
SG_MUL_VAL_ 2621243134 AutomationStatus_AV05 MsgType_AV05 1-1;
SG_MUL_VAL_ 2621243134 Curvature_EG MsgType_EG 17-17;
SG_MUL_VAL_ 2621243134 ExitReasonCode_EG MsgType_EG 1-1;
SG_MUL_VAL_ 2621243134 VehicleSpeed_VS MsgType_VS 17-17;
SG_MUL_VAL_ 2621243134 ExitReasonCode_VS MsgType_VS 1-1;
SG_MUL_VAL_ 2621243134 Position_FH MsgType_FH 17-17;
SG_MUL_VAL_ 2621243134 ExitReasonCode_FH MsgType_FH 1-1;
SG_MUL_VAL_ 2621243134 Speed_FPTO MsgType_FPTO 17-17;
SG_MUL_VAL_ 2621243134 ExitReasonCode_FPTO MsgType_FPTO 1-1;
SG_MUL_VAL_ 2621243134 Flow_AV01 MsgType_AV01 17-17;
SG_MUL_VAL_ 2621243134 ExitReasonCode_AV01 MsgType_AV01 1-1;
SG_MUL_VAL_ 2624585470 ErrorCode MessageCode 3-3, 5-5, 7-7, 250-250;
SG_MUL_VAL_ 2624585470 AuthenticationType MessageCode 2-8, 250-250;
SG_MUL_VAL_ 2624651006 AuthenticationType MessageCode 2-7, 9-9, 249-249;
SG_MUL_VAL_ 2624651006 ErrorCode MessageCode 2-2, 4-4, 6-6, 249-249;
