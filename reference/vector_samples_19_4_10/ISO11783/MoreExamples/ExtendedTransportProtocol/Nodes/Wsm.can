/*@!Encoding:1252*/
variables
{
  //
  // Working set master for the loader
  //
  // (c) 2001-2020 Vector Informatik GmbH
  //

  //
  // Global variables for the 
  //
  int gLoaderPos = 0;     // Position of the loader
  int gLoaderInc = 10;    // Increase/decrease loader position by this value
  int gBucketPos = 0;     // Position of the bucket
  int gBucketInc = 10;    // Increase/decrease bucket position by this value

  //
  // Global variables for communication
  //
  msTimer gChangeLocationTimer;    // Timer to change object location
  dword   gMoveCounter;            // Counter for the move operations      
}

on preStart
{
  ecuInit(); // initialize global variables
}

on start
{
  ecuStartUp();
}

//
// Initiaialize all global variables in this function.
//
void ecuInit()
{ 
  // reset counter
  gMoveCounter = 0;
}

//
// Call this function to connect the node to the bus
//
void ecuStartUp()
{
  Iso11783IL_ControlStart();
  Iso11783IL_OPSetProperty( "Version", 4 );
  
  // load and activate object pool
  if (Iso11783IL_OPLoad("ObjectPools\\ISOBusMask.iop" ) != 0) 
  {
    writeDbgLevel( 1, "Error while loading Object Pool 'ISOBusMask.iop'" );
    stop();
  }
  Iso11783IL_OPActivate(0x00);
}

on timer gChangeLocationTimer
{
  if (gMoveCounter < 30) 
  {
    Iso11783IL_OPChangeChildLocation( 10, 11,  1, 0 );
    Iso11783IL_OPChangeChildLocation( 10, 12, -1, 0 );
  }
  else 
  {
    Iso11783IL_OPChangeChildLocation( 10, 11, -1, 0 );
    Iso11783IL_OPChangeChildLocation( 10, 12,  1, 0 ); 
  }  
  
  gMoveCounter = gMoveCounter + 1;
  if (gMoveCounter >= 60) 
  {
    gMoveCounter = 0;
  }
  setTimer( gChangeLocationTimer, 150 );
}

void Iso11783IL_OPOnStateChange( dword state )
{
  if (state == 5) // active
  {
    setTimer( gChangeLocationTimer, 150 );  
  }
}

