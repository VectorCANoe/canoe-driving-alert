/*@!Encoding:1252*/
variables
{
  //
  // Version 2.2
  //
  // Copyright 2002-2020 Vector Informatik GmbH
  //
  // This is a experimantal implement for use with tractor ECU
  //  
  //  History
  //  2.2  Replace environment variables by system variables
  //       Use ISO11783 Interaction Layer instead of ISO11783 Node Layer
  //

  int  gECUState     = 0;             // 0=Offline, 1=Online 2=ShutingDown
  char gECULabel[32] = "Experimental";// label for output to write window
  int  gPosition     = 1;             // Position of the implement

  // msTimer for cyclic PGs
  msTimer TimerShutDown; /* shut down timer */

  int gMaintainTimerECU_PWR = 10000; // time in ms
  const kShutDownTime       = 1500;

  double gGroundBasedSpeed  = 0.0;   // ground based speed received from tractor ECU

  // Definition of debugging constants
  const int kDbgInfo    = 10;
  const int kDbgWarning = 5;
  const int kDbgError   = 1;
  const int kDbgQuiet   = 0;

  // General global variables
  int gDbgLevel         = kDbgInfo; // Set debug level for output to write window
}

on start
{
}

on sysvar ISO11783::ECU_PWR
{
  float ecu_pwr;
  ecu_pwr = @this;

  if ((ecu_pwr > 10) && ((Iso11783IL_GetState() == 0) || (Iso11783IL_GetState() == 3)))
  {
    PowerStartUp();
  }
  else if ((ecu_pwr < 10) && (Iso11783IL_GetState() == 2))
  {
    PowerShutDown();
  }
}



/* CALLBACK function */
void Iso11783IL_OnChangedState( LONG state )
{
  switch(state) {
    case 1: // Claiming
      break;
    case 2: // Active
      gECUState = 1; /* ecu is online */
      break;
    case 3: // Stopped
      break;
    case 4: // Suspended
      break;
  }
}

/* CALLBACK function */
void Iso11783IL_OnError(long errorCode, long param)
{
  writeDbgLevel( kDbgInfo, "<%s> Error %d, parameter %d", gECULabel, errorCode, param );
}

/* CALLBACK function */
long Iso11783IL_OnRxMessage( pg * rxPG )
{
  switch(rxPG.pgn)
  {
    case 0xFE0f: // Language command
      RxIndLanguageCommand((pg LC)rxPG);
      return 0;
    case 0xFE48: // WheelBasedSpeedAndDistance
      RxIndWheelBasesSpeedAndDistance((pg WBSD)rxPG);
      return 0;
    case 0xFE49: // GroundBasedSpeedAndDistance
      RxIndGroundBasedSpeedAndDistance((pg GBSD)rxPG);
      return 0;
    case 0xFE45: // PrimaryOrRearHitchStatus
      RxIndPrimaryOrRearHitchStatus((pg RHS)rxPG);
      return 0;
    case 0xFE43: // PrimaryOrRearPTOOutShaft
      RxIndPrimaryOrRearPTOOutShaft((pg RPTO)rxPG);
      return 0;
    default:
      return 2; // send NACK
  }
}



/*
  This function is called, if EvECU_PWR is 1
*/
PowerStartUp()
{
  if (gECUState == 0) 
  {
    Iso11783IL_ControlStart();
    writeDbgLevel( kDbgError, "<%s> power start up", gECULabel );
  }
}

/*
  This function is called, if the key switch is disabled and no implement
	maintain PWR or ECU_PWR.
*/
PowerShutDown()
{
  Iso11783IL_ControlStop();
	gECUState  = 0;
	write( "<%s> power shut down", gECULabel );
}

/*
*/
on timer TimerShutDown
{
  gMaintainTimerECU_PWR -= kShutDownTime;
  if (gMaintainTimerECU_PWR > 0) 
  {
    setTimer( TimerShutDown, kShutDownTime );
	  TransmitMaintainPower();
  }
}



on stopMeasurement
{
  PowerShutDown();
}

TransmitMaintainPower ()
{
  pg MP mntPwr;

  mntPwr.SA = Iso11783IL_GetAddress();
  mntPwr.DWORD(0) = mntPwr.DWORD(1) = 0xffffffff;

	mntPwr.MaintainECUPower = 1;

	output( mntPwr );
}

/*
  Langauge command is received.
*/
void RxIndLanguageCommand(pg LC pgLC)
{
}

/*
  WheelBasesSpeedAndDistance is received.
*/
void RxIndWheelBasesSpeedAndDistance(pg WBSD rxPG)
{
  if ((rxPG.KeySwitchState == 0) && (gECUState == 1)) 
  {
    gMaintainTimerECU_PWR = @Implement::MaintainTime * 1000;
    gECUState             = 2; // shut down state
		
    if (gMaintainTimerECU_PWR > 0) 
    {
      TransmitMaintainPower();
      setTimer( TimerShutDown, kShutDownTime );
    }
  }

  @Implement::WheelBasedSpeed = rxPG.WheelBasedMachineSpeed.phys;
}

/*
  GroundBasedSpeedAndDistance is received.
*/
void RxIndGroundBasedSpeedAndDistance(pg GBSD rxPG )
{
  @Implement::GroundBasedSpeed = rxPG.GroundBasedMachineSpeed.phys;

  gGroundBasedSpeed = rxPG.GroundBasedMachineSpeed.phys;
}

/*
  PrimaryOrRearHitchStatus is received.
*/
void RxIndPrimaryOrRearHitchStatus(pg RHS rxPG )
{
  @Implement::RearHitchPosition = rxPG.RearHitchPosition.phys;
  @TECU::RearHitchDraft[gPosition] =  @Implement::RearHitchDraft;
}

/*
  PrimaryOrRearPTOOutShaft is received.
*/
void RxIndPrimaryOrRearPTOOutShaft(pg RPTO rxPG )
{
  @Implement::RearPTOShaftSpeed = rxPG.RearPTOOutputShaftSpeed.phys;
}

on sysvar Implement::CurrentTakeoffECU_PWR
{
  double current;
  current = @this;

  if (@ISO11783::ECU_PWR > 10.0) 
  {
    @TECU::ECU_PWRCurrent[gPosition] = current;
  }
  else 
  {
    @TECU::ECU_PWRCurrent[gPosition] = 0.0;
  }
}
