/*@!Encoding:1252*/
variables
{
  const int gNumOfTracePoints = 20000;
  float gDirections[gNumOfTracePoints], gLatitudes[gNumOfTracePoints], gLongitudes[gNumOfTracePoints];
}

/*
*/
float ImplPos_GetDirection(int posInRouteContainer_Dezimeter)
{
  if(posInRouteContainer_Dezimeter >= gNumOfTracePoints || posInRouteContainer_Dezimeter < 0)
  {
    return 0;
  }
  else
  {
    return gDirections[posInRouteContainer_Dezimeter];
  }
}

/*
*/
float ImplPos_GetLatitude(int posInRouteContainer_Dezimeter)
{
  if(posInRouteContainer_Dezimeter >= gNumOfTracePoints || posInRouteContainer_Dezimeter < 0)
  {
    return 0;
  }
  else
  {
    return gLatitudes[posInRouteContainer_Dezimeter];
  }
}

/*
*/
float ImplPos_GetLongitude(int posInRouteContainer_Dezimeter)
{
  if(posInRouteContainer_Dezimeter >= gNumOfTracePoints || posInRouteContainer_Dezimeter < 0)
  {
    return 0;
  }
  else
  {
    return gLongitudes[posInRouteContainer_Dezimeter];
  }
}

/*
*/
void ImplPos_InitRouteContainer()
{
  long pos;
  for(pos = 0; pos < 1000; pos++)
  {
    gLongitudes[pos] = gLonRef;
    gLatitudes[pos] = gLatRef;
    gDirections[pos] = 0;
  }
}

/*
*/
void ImplPos_FillGapInCources(long roundedLastDistance_dezimeter, long roundedCurDistance_dezimeter)
{
  long stepNum;
  float stepLatitude, stepLongitude, stepDirection, curDirection;
  if(roundedCurDistance_dezimeter == roundedLastDistance_dezimeter ||
    roundedLastDistance_dezimeter - (roundedCurDistance_dezimeter - roundedLastDistance_dezimeter) >= gNumOfTracePoints ) return;
  curDirection = @GPS::GPS1.Direction;
  if(curDirection >= 359)
  {
    curDirection = curDirection - 360;
  }
  
  stepLatitude = (@GPS::GPS1.Latitude - gLatitudes[roundedLastDistance_dezimeter])  /    
                      (roundedCurDistance_dezimeter - roundedLastDistance_dezimeter);
  stepLongitude = (@GPS::GPS1.Longitude - gLongitudes[roundedLastDistance_dezimeter])  / 
                      (roundedCurDistance_dezimeter - roundedLastDistance_dezimeter);
  stepDirection = (curDirection - gDirections[roundedLastDistance_dezimeter]) / (roundedCurDistance_dezimeter - roundedLastDistance_dezimeter);
  for(stepNum = 1; stepNum <= roundedCurDistance_dezimeter - roundedLastDistance_dezimeter; stepNum++)
  {
    gLatitudes[roundedLastDistance_dezimeter + stepNum] = gLatitudes[roundedLastDistance_dezimeter] + stepLatitude * stepNum;
    gLongitudes[roundedLastDistance_dezimeter + stepNum] = gLongitudes[roundedLastDistance_dezimeter] + stepLongitude * stepNum;
    gDirections[roundedLastDistance_dezimeter + stepNum] = gDirections[roundedLastDistance_dezimeter] + stepDirection * stepNum;
  }
}

