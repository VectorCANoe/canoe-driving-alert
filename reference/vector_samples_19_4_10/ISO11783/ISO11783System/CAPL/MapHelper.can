/*@!Encoding:1252*/
includes
{
  #include "HelperFunctions.cin"
  #include "GeometricData.cin"
}

variables
{
  float gLonMeter;// has to be computed for the current ref point. In Stuttgart Weilimdorf: 0.000013660729;
  float gLatMeter;// has to be computed for the current ref point. In Stuttgart Weilimdorf: 0.000008993215;
  //Colors
  long gGray, gYellow, gRed, gGreen, gLightGreen, gLightViolett;
}

on preStart
{
  gGray        = makeRGB(0xE0, 0xE0, 0xE0);
  gYellow      = makeRGB(0xFF, 0xFF, 0x00);
  gRed         = makeRGB(0xFF, 0x00, 0x00);
  gGreen       = makeRGB(0x00, 0xFF, 0x00);
  gLightGreen  = MakeARGB(0x80, 0x90, 0xFF, 0x90);
  gLightViolett     = MakeARGB(0x30, 0xAF, 0x42, 0xFC);
}

on start
{
  //Lower rectangle
  InitLine( gBottomLeftLat1, gLeftLon, gUpperLeftLat1, gLeftLon); // Left
  InitLine( gUpperLeftLat1, gLeftLon, gUpperRightLat1, gRightLon); // up
  InitLine( gUpperRightLat1, gRightLon, gBottomRightLat1, gRightLon); // Right
  InitLine( gBottomRightLat1, gRightLon, gBottomLeftLat1, gLeftLon); // Bottom
  
  //Middle rectangle
  InitLine( gBottomLeftLat2, gLeftLon, gUpperLeftLat2, gLeftLon); // Left
  InitLine( gUpperLeftLat2, gLeftLon, gUpperRightLat2, gRightLon); // up
  InitLine( gUpperRightLat2, gRightLon, gBottomRightLat2, gRightLon); // Right
  InitLine( gBottomRightLat2, gRightLon, gBottomLeftLat2, gLeftLon); // Bottom
  
  //Upper rectangle
  InitLine( gBottomLeftLat3, gLeftLon, gUpperLeftLat3, gLeftLon); // Left
  InitLine( gUpperLeftLat3, gLeftLon, gUpperRightLat3, gRightLon); // up
  InitLine( gUpperRightLat3, gRightLon, gBottomRightLat3, gRightLon); // Right
  InitLine( gBottomRightLat3, gRightLon, gBottomLeftLat3, gLeftLon); // Bottom
}

/*
*/
long InitLine(float latitude1, float longitude1, float latitude2, float longitude2)
{
  long handle;
  handle = CreateMapObject(6);
  SetMapObjectPosition  (handle, latitude1, longitude1, latitude2, longitude2);
  SetMapObjectLineColor (handle, gYellow);
  SetMapObjectPenWidth  (handle, 3);
  DrawMapObject         (handle);
  return handle;
}




