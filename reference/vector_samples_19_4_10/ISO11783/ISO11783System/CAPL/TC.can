/*@!Encoding:1252*/
includes
{
  #include "HelperFunctions.cin"
  #include "ImplementPosition.cin"
  #include "GeometricData.cin"
}

variables
{
  const float gSectionWidth = 3; // in meter
  const int   gNumOfSections = 11;
  
  float gLonMeter;// has to be computed for the current ref point. In Stuttgart Weilimdorf: 0.000013660729;
  float gLatMeter;// has to be computed for the current ref point. In Stuttgart Weilimdorf: 0.000008993215;

  const int gCoverageSizeX = 270;
  const int gCoverageSizeY = 270;
  const int gOffset = 40;
  int gPreviousCellX_Setpoint[gNumOfSections], gPreviousCellY_Setpoint[gNumOfSections];
  long gCoverage_Setpoint[gCoverageSizeX][gCoverageSizeY];
  int gStateInCurrentCell_Setpoint[gNumOfSections];

  int gPreviousCellX_Actual[gNumOfSections], gPreviousCellY_Actual[gNumOfSections];
  long gCoverage_Actual[gCoverageSizeX][gCoverageSizeY];
  int gStateInCurrentCell_Actual[gNumOfSections];
  
  dword gLastSetpointCondencedWorkState;
  int gLastWorkingZone;
  
  
  long gSprayerHandle;
  double gDistance; //meter
  float gSpeed;   // meter/second
  long gLastTime; // millisecond
  long gSections[gNumOfSections];
  
  
  //Colors
  long gGray, gYellow, gRed, gGreen, gLightGreen, gLightViolett;
  
  const word gSprayerAddress = 0x80;
  
  msTimer tmrStartTask;
//  msTimer tmrAdjustMap; // auto follow for map window
  
  int gTaskIsActive;
}

/*
*/
on sysvar GPS::GPS1
{
  long curTimeMs;
  float lastDistance, curDistance;
  long roundedCurDistance_dezimeter, roundedLastDistance_dezimeter;
  
  curTimeMs = timeNow() / 100;
  if(curTimeMs == gLastTime)    return;
  
  lastDistance = gDistance;
  roundedLastDistance_dezimeter = gDistance * 10;
  curDistance = gDistance + @GPS::GPS1.Speed * (curTimeMs - gLastTime) / 1000.0;
  roundedCurDistance_dezimeter = curDistance * 10;
  if(roundedCurDistance_dezimeter == roundedLastDistance_dezimeter || roundedCurDistance_dezimeter >= gNumOfTracePoints)  
  {
    return;
  }
  gDistance = curDistance;
  gLastTime = curTimeMs;

  ImplPos_FillGapInCources(roundedLastDistance_dezimeter, roundedCurDistance_dezimeter);
  
  // Redraw Sections, send necessary PD messages
  UpdateSetpointVariablesAndRedrawSectionsAndCoverage(roundedCurDistance_dezimeter - 50);
  RedrawActualCoverage(roundedCurDistance_dezimeter - 50);
}

/*
*/
void RedrawActualCoverage(long curPosInRouteContainer_dezimeter)
{
  int secNum;
  long curCondencedWorkState;
  float longitude, latitude, direction, directionInRadian;
  
  longitude = ImplPos_GetLongitude(curPosInRouteContainer_dezimeter);
  latitude = ImplPos_GetLatitude(curPosInRouteContainer_dezimeter);
  direction = ImplPos_GetDirection(curPosInRouteContainer_dezimeter);
  directionInRadian = direction * pi / 180;

  for(secNum = 0; secNum < gNumOfSections; secNum++)
  {
    float distanceFromRef, longitudeOfSection, latitudeOfSection;
    int cellX, cellY;
    long sectionHandle_Actual;
    dword sectionState_Actual;
    int workingZone;
    
    distanceFromRef = (secNum - ((int)(gNumOfSections / 2))) * gSectionWidth;
    longitudeOfSection = longitude + distanceFromRef * gLonMeter * cos(directionInRadian) - gLonMeter * sin(directionInRadian);
    latitudeOfSection = latitude - distanceFromRef * gLatMeter * sin(directionInRadian) - gLatMeter * cos(directionInRadian);
    sectionState_Actual = 0;
    cellY = (latitudeOfSection - gBottomLeftLat1) / gLatMeter + gOffset;
    cellX = (longitudeOfSection - gLeftLon) / gLonMeter + gOffset;

    // Obtain current section state
    TCIL_GetSectionState(gSprayerAddress, 0xA1, 2, secNum+1, sectionState_Actual);
    //Check if the same state is already drawed
    if(gPreviousCellX_Actual[secNum] == cellX && gPreviousCellY_Actual[secNum] == cellY)
    {
      // this the same cell as the last time. 
      if(sectionState_Actual == gStateInCurrentCell_Actual[secNum])
      {
        // the state is also the same, there is nothing to draw
        continue;
      }
    }
    // Check if section has to be active or not
    // Draw processed area (based on Actual Condensed Work State)

    if(cellX < 0 || cellX >= gCoverageSizeX || cellY < 0 || cellY >= gCoverageSizeY)
    {
      continue;
    }

    if(sectionState_Actual == 1)
    {
      //Check if coverage already created
      if(gCoverage_Actual[cellX][cellY] == 0)
      {
        long handleCover;
        handleCover = ExtendUpperCoverageToCurrentCell(gCoverage_Actual, cellX, cellY, 1); // try to continue in the same working zone from top to bottom
        if(handleCover == 0)
        {
          handleCover = ExtendBottomCoverageToCurrentCell(gCoverage_Actual, cellX, cellY, 1); // try to continue in the same working zone from bottom to top
        }
        if(handleCover == 0)  // new working zone entered
        {
          // Display coverage
          long greenAsAppRate;
          greenAsAppRate = makeARGB(0x80, 0x00, 0xFF, 0x00);
          handleCover = InitRectangle(gBottomLeftLat1 + (cellY - gOffset) * gLatMeter,  
                                      gLeftLon + (cellX + 1 - gOffset) * gLonMeter, 
                                      1, 1, greenAsAppRate, greenAsAppRate);
        }
        gCoverage_Actual[cellX][cellY] = handleCover;
      }
    }
    gPreviousCellX_Actual[secNum] = cellX;
    gPreviousCellY_Actual[secNum] = cellY;
    gStateInCurrentCell_Actual[secNum] = sectionState_Actual;
  }
}

/*
*/
void UpdateSetpointVariablesAndRedrawSectionsAndCoverage(long curPosInRouteContainer_dezimeter)
{
  int secNum;
  long curCondencedWorkState;
  float longitude, latitude, direction, directionInRadian;
  
  longitude = ImplPos_GetLongitude(curPosInRouteContainer_dezimeter);
  latitude = ImplPos_GetLatitude(curPosInRouteContainer_dezimeter);
  direction = ImplPos_GetDirection(curPosInRouteContainer_dezimeter);
  directionInRadian = direction * pi / 180;

  TCIL_SetValueRaw(gSprayerAddress, 0x122, 2, 0xFFFFFFFF);
  for(secNum = 0; secNum < gNumOfSections; secNum++)
  {
    float distanceFromRef, longitudeOfSection, latitudeOfSection;
    int cellX, cellY;
    long sectionHandle_Setpoint, sectionIsActive_Setpoint;
    int workingZone;
    
    distanceFromRef = (secNum - ((int)(gNumOfSections / 2))) * gSectionWidth;
    longitudeOfSection = longitude + distanceFromRef * gLonMeter * cos(directionInRadian) - gLonMeter * sin(directionInRadian);
    latitudeOfSection = latitude - distanceFromRef * gLatMeter * sin(directionInRadian) - gLatMeter * cos(directionInRadian);
    workingZone = PointIsInsideWorkzone(latitudeOfSection, longitudeOfSection);
    sectionIsActive_Setpoint = 0;
    cellY = (latitudeOfSection - gBottomLeftLat1) / gLatMeter + gOffset;
    cellX = (longitudeOfSection - gLeftLon) / gLonMeter + gOffset;

    // If necessary, set new "Setpoint App Rate"
    if(gLastWorkingZone != workingZone && secNum == 5)
    {
      if(workingZone == 0)
      {
        TCIL_ValueCommandPhysical(gSprayerAddress, 0x06, 2, 0);
      }
      else
      {
        double newAppRate;
        switch(workingZone)
        {
          case 1: newAppRate = 7000; break;
          case 2: newAppRate = 9000; break;
          case 3: newAppRate = 6000; break;
        }
        TCIL_ValueCommandPhysical(gSprayerAddress, 0x06, 2, newAppRate);
      }
      gLastWorkingZone = workingZone;
    }

    // Check if section has to be active or not
    // Draw processed area (based on Setpoint Condensed Work State)
    if(workingZone > 0)
    {

      if(gPreviousCellX_Setpoint[secNum] == cellX && gPreviousCellY_Setpoint[secNum] == cellY)
      {
        // this the same cell as the last time. Therefore the state is also the same
        sectionIsActive_Setpoint = gStateInCurrentCell_Setpoint[secNum];
      }
      else
      {
        //Check if coverage already created
        if(gCoverage_Setpoint[cellX][cellY] == 0)
        {
          long handleCover;
          //May be the current section overlaps the already sprayed trace, 
          //but the last cell in the working zone has not been covered (it was the first cell when spraying in the opposite direction)
          // Therefore we check if the next cell is outside the working zone
          //In this case, the current section is  not active
          dword sectionState;
          TCIL_GetSectionState(gSprayerAddress, 0xA1, 2, secNum+1, sectionState);
          if(sectionState == 0)
          {
            int workingZoneInTheNextCell;
            workingZoneInTheNextCell = -1;
            if(direction > 170 && direction < 190)
            {
              //top->down
              workingZoneInTheNextCell = PointIsInsideWorkzone(latitudeOfSection - gLatMeter, longitudeOfSection);
            }
            else if(direction > 350 || direction < 10)
            {
              //bottom->up
              workingZoneInTheNextCell = PointIsInsideWorkzone(latitudeOfSection + gLatMeter, longitudeOfSection);
            }
            if(workingZoneInTheNextCell != 0)
            {
              sectionIsActive_Setpoint =  1;
            }
          }
          else
          {
            sectionIsActive_Setpoint = 1;
          }
          if(sectionIsActive_Setpoint == 1)
          {
            handleCover = ExtendUpperCoverageToCurrentCell(gCoverage_Setpoint, cellX, cellY, 1); // try to continue in the same working zone from top to bottom
            if(handleCover == 0) 
            {
              handleCover = ExtendBottomCoverageToCurrentCell(gCoverage_Setpoint, cellX, cellY, 1); // try to continue in the same working zone from bottom to top
            }
            if(handleCover == 0)  // Is it the new working zone?
            {
              // Display coverage
              long violettAsAppRate;
              int transparency;
              switch(workingZone)
              {
                case 1: transparency = 0x20; break;
                case 2: transparency = 0x60; break;
                case 3: transparency = 0x40; break;
                default:transparency = 0x0; break;    
              }
              
              violettAsAppRate = makeARGB(transparency, 0xFF, 0x00, 0x00);
              handleCover = InitRectangle(gBottomLeftLat1 + (cellY - gOffset) * gLatMeter,  
                                          gLeftLon + (cellX + 1 - gOffset) * gLonMeter, 
                                          1, 1, gLightViolett, violettAsAppRate);
            }
            gCoverage_Setpoint[cellX][cellY] = handleCover;
          }
        }
        else
        {
          // Current cell is being entered, but it is already processed.
          // This means that it has already been processed in a previous pass.
          // Therefore the corresponding section should be deactivated
          sectionIsActive_Setpoint = 0;
        }
        gStateInCurrentCell_Setpoint[secNum] = sectionIsActive_Setpoint;
      }
    }
    gPreviousCellX_Setpoint[secNum] = cellX;
    gPreviousCellY_Setpoint[secNum] = cellY;
    

    // Redraw section with Section State
    sectionHandle_Setpoint = gSections[secNum];
    SetMapObjectPosition(sectionHandle_Setpoint, latitudeOfSection, longitudeOfSection);
    If(sectionIsActive_Setpoint)
    {
      SetMapObjectFillColor(sectionHandle_Setpoint, gGreen); 
      SetMapObjectLineColor(sectionHandle_Setpoint, gRed); 
    }
    else
    {
      SetMapObjectFillColor(sectionHandle_Setpoint, gYellow);
      SetMapObjectLineColor(sectionHandle_Setpoint, gRed);
    }
    SetMapObjectHeading(sectionHandle_Setpoint, direction);
    DrawMapObject(sectionHandle_Setpoint);
    
    TCIL_SetSectionState(gSprayerAddress, 0x122, 2, secNum+1, (sectionIsActive_Setpoint>0));
  }
  TCIL_GetValueRaw(gSprayerAddress, 0x122, 2, curCondencedWorkState);
  if(curCondencedWorkState != gLastSetpointCondencedWorkState)
  {
    TCIL_ValueCommand(gSprayerAddress, 0x122, 2);
    gLastSetpointCondencedWorkState = curCondencedWorkState;
  }
}

/*
Coverage lines are directed vertical, from top to bottom
*/
long ExtendUpperCoverageToCurrentCell (long coverage[][], int cellX, int cellY, int weight)
{
  long handle;
  int gap;
  //From top to bottom, try to bridge the possible gap
  for(gap = 0; gap < 1; gap++)
  {
    handle = coverage[cellX][cellY + 1 + gap];
    if(handle != 0)
    {
      break;
    }
  }
  if(handle > 0)
  {
    //obtain the current length of the line
    int length;
    for(length = 1 + gap; cellY + gap + length < gCoverageSizeY; length++)
    {
      if(coverage[cellX][cellY + length] == 0)
      {
        break;
      }
    }
    //Adjust the size
    SetMapObjectPosition(handle, gBottomLeftLat1 + (cellY - gOffset) * gLatMeter + (length - 1) * gLatMeter / 2.0,  gLeftLon + (cellX + 1 - gOffset) * gLonMeter);
    SetMapObjectSize(handle, weight, length);
    DrawMapObject(handle);
  }
  return handle;
}

/*
Coverage lines are directed vertical, from bottom to top
*/
long ExtendBottomCoverageToCurrentCell (long coverage[][], int cellX, int cellY, int weight)
{
  long handle;
  int gap;
  //from bottom to top
  for(gap = 0; gap < 1; gap++)
  {
    handle = coverage[cellX][cellY - 1 - gap];
    if(handle != 0)
    {
      break;
    }
  }
  if(handle > 0)
  {
    //obtain the current length of the line
    int length;
    for(length = 1 + gap; cellY - length >= 0; length++)
    {
      if(coverage[cellX][cellY - length] == 0)
      {
        break;
      }
    }
    //Compute the start position
    SetMapObjectPosition(handle, gBottomLeftLat1 + (cellY - gOffset) * gLatMeter - (length - 1) * gLatMeter / 2.0,  gLeftLon + (cellX + 1 - gOffset) * gLonMeter);
    SetMapObjectSize(handle, weight, length);
    DrawMapObject(handle);
  }
  return handle;
}

on start
{
  gLatMeter = Helper_GetLatitudeMeter(gLatRef, gLonRef);
  gLonMeter = Helper_GetLongitudeMeter(gLatRef, gLonRef);

  //Init Section Silhouette
  InitSections(gLatRef, gLonRef, gSectionWidth - 0.2, 3);
  
  ImplPos_InitRouteContainer();
  gDistance = 5;
  gLastTime = 0;
  gLastWorkingZone = 0;
  
  InitCoverage();
//  setTimerCyclic(tmrAdjustMap, 300);
  
  if(@Control::svAutoPlay == 1)
  {
    setTimer(tmrStartTask, 10000);
  }
  gTaskIsActive = 0;
}

on timer tmrStartTask
{
  TCIL_SetValueRaw(gSprayerAddress, 0xA1, 2, 0);
  TCIL_StartTask();
}

on pg PD_TC
{
  if(this.Command == PD_TC.Command::TaskControllerStatus)
  {
    if(this.StatusTotalsActive > 0 && gTaskIsActive == 0)
    {
      gTaskIsActive = 1;
      if(@Control::svAutoPlay == 0)
      {
        TCIL_SetValueRaw(gSprayerAddress, 0xA1, 2, 0);
      }
    }
    else if(this.StatusTotalsActive == 0 && gTaskIsActive == 1)
    {
      gTaskIsActive = 1;
    }
  }
}

//on timer tmrAdjustMap
//{
//  SetMapPosition(@GPS::GPS1.Latitude, @GPS::GPS1.Longitude);
//}

on preStart
{
  gGray        = makeRGB(0xE0, 0xE0, 0xE0);
  gYellow      = makeRGB(0xFF, 0xFF, 0x00);
  gRed         = makeRGB(0xFF, 0x00, 0x00);
  gGreen       = makeRGB(0x00, 0xFF, 0x00);
  gLightGreen  = MakeARGB(0x80, 0x90, 0xFF, 0x90);
  gLightViolett     = MakeARGB(0x30, 0xAF, 0x42, 0xFC);
  gLastSetpointCondencedWorkState = 0xFFFFFFFF;
  
  InitPreviousCells();
}

void InitPreviousCells()
{
  int pos;
  for(pos = 0; pos < gNumOfSections; pos++)
  {
    gPreviousCellX_Setpoint[pos] = -1;
    gPreviousCellY_Setpoint[pos] = -1;
    gStateInCurrentCell_Setpoint[pos] = -1;

    gPreviousCellX_Actual[pos] = -1;
    gPreviousCellY_Actual[pos] = -1;
    gStateInCurrentCell_Actual[pos] = -1;
  }
}

void InitCoverage()
{
  int posX, posY;
  for(posX = 0; posX < gCoverageSizeX; posX++)
  {
    for(posY = 0; posY < gCoverageSizeY; posY ++)
    {
      gCoverage_Setpoint[posX][posY] = 0;
      gCoverage_Actual[posX][posY] = 0;
    }
  }
}

/*
*/
long InitRectangle(float latitude, float longitude, float width, float height, long lineColor, long fillColor)
{
  long handle;

  handle = CreateMapObject(2);
  SetMapObjectPosition  (handle, latitude, longitude);
  SetMapObjectSize      (handle, width, height);
  SetMapObjectLineColor (handle, lineColor);
  SetMapObjectFillColor (handle, fillColor);
  SetMapObjectPenWidth  (handle, 1);
  DrawMapObject         (handle);
  
  return handle;
}

/*
Check if the point is inside of one of both rectangles
gBottomLeftLat1 
gUpperLeftLat1  
gBottomRightLat1
gUpperRightLat1 

gLeftLon 
gRightLon
*/
int PointIsInsideWorkzone(float latitude, float longitude)
{
  if(longitude  < gLeftLon || longitude > gRightLon)
  {
    //left of the leftmost or right of the rightmost
    return 0; 
  }
  // Check the lower rectangle
  if( Helper_PointIsAboveLine(latitude, longitude, gBottomLeftLat1, gLeftLon, gBottomRightLat1, gRightLon) &&
     !Helper_PointIsAboveLine(latitude, longitude, gUpperLeftLat1, gLeftLon, gUpperRightLat1, gRightLon))
  {
    return 1;
  }
  // Check the middle rectangle
  if( Helper_PointIsAboveLine(latitude, longitude, gBottomLeftLat2, gLeftLon, gBottomRightLat2, gRightLon) &&
     !Helper_PointIsAboveLine(latitude, longitude, gUpperLeftLat2, gLeftLon, gUpperRightLat2, gRightLon))
  {
    return 2;
  }
  // Check the upper rectangle
  if( Helper_PointIsAboveLine(latitude, longitude, gBottomLeftLat3, gLeftLon, gBottomRightLat3, gRightLon) &&
     !Helper_PointIsAboveLine(latitude, longitude, gUpperLeftLat3, gLeftLon, gUpperRightLat3, gRightLon))
  {
    return 3;
  }
  return 0;
}

/*
Section indices from left to right. Each section has a width of gSectionWidth in meter.
The latitude and longitude define the middle of the whole sprayer implement.
The following values are the offsets from the reference point:
Longitude:
  Section0: -15 m
  Section1: -12 m
  Section2:  -9 m
  Section3:  -6 m
  Section4:  -3 m
  Section5:   0 m
  Section6:   3 m
  Section7:   6 m
  Section8:   9 m
  Section9:  12 m
  Section10: 15 m
Latitude:
  1 m
*/
void InitSections(float latitude, float longitude, float width, float height)
{
  long handle;
  float longitudeShiftInMeter;
  int sectionPos;
  float sectionLongitude;
  latitude = latitude - gLatMeter*0.5;

  for(sectionPos = 0; sectionPos < gNumOfSections; sectionPos++)
  {
    longitudeShiftInMeter = (sectionPos - ((int)(gNumOfSections / 2))) * gSectionWidth;
    sectionLongitude = longitude + longitudeShiftInMeter * gLonMeter;
    
    handle = InitRectangle(latitude, sectionLongitude, width, height, gYellow, gYellow);
    SetMapObjectLineColor (handle, gRed);
    DrawMapObject         (handle);
    gSections[sectionPos] = handle;
  }
}

