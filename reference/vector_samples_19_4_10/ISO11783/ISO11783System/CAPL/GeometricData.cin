/*@!Encoding:1252*/
variables
{
  const float gLatRef = 48.827450; // Stuttgart Weilimdorf
  const float gLonRef = 9.0905;   // Stuttgart Weilimdorf
  
  //Bottom rectangle
  const float gBottomLeftLat1   = 48.8275721;
  const float gUpperLeftLat1    = 48.8276012;
  const float gBottomRightLat1  = 48.8277305;
  const float gUpperRightLat1   = 48.8282495;

  //Middle rectangle
  const float gBottomLeftLat2   = 48.8277031;
  const float gUpperLeftLat2    = 48.8280000;
  const float gBottomRightLat2  = 48.8283549;
  const float gUpperRightLat2   = 48.8284358;

  //Upper rectangle
  const float gBottomLeftLat3   = 48.8281031;
  const float gUpperLeftLat3    = 48.8284286;
  const float gBottomRightLat3  = 48.8285549;
  const float gUpperRightLat3   = 48.8287358;

  const float gLeftLon   = 9.0903100;
  const float gRightLon  = 9.0925000;
}