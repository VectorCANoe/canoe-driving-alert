/*@!Encoding:1252*/
includes
{
  #include "HelperFunctions.cin"
}

variables
{
  msTimer tmrTurnSignal;
  float latMiddle = 48.82795;
  long gTurnDirection; // -1: left; +1: right
}

on start
{
//  setTimerCyclic(tmrWheel, 100);
  @Tractor::svWheelDirection = 6;
  gTurnDirection = 0;
  @Tractor::svSpeed = 0;
}

on preStop
{
  enableControl("Control", "AutoPlayKey", 1);
}

on sysvar GNSS_Calculations::svSteeringWheelPos
{
  // The calculations are done in the GNSS IL (GnssReceiver.can). 
  // We set the steering position here since the Tractor ECU would be the correct 
  // place if this wasn't a simulated route by the GNSS_IL.
  @Tractor::svWheelDirection = @GNSS_Calculations::svSteeringWheelPos;
}

on sysvar GNSS_Calculations::svTurnSignalDirection
{
  // The calculations are done in the GNSS IL (GnssReceiver.can). 
  // We set the turn signals here since the Tractor ECU would be the correct place 
  // if this wasn't a simulated route by the GNSS_IL.
  gTurnDirection = @GNSS_Calculations::svTurnSignalDirection;
  if(gTurnDirection == 0 && tmrTurnSignal.isRunning())
  {
    tmrTurnSignal.cancel();
    @Tractor::svTurnRight = 0;
    @Tractor::svTurnLeft = 0;
  }
  else if(!tmrTurnSignal.isRunning())
  {
    tmrTurnSignal.setCyclic(500);
  }
}

on timer tmrTurnSignal
{
//  writeEx(-3, 3, "gTurnDirection: %d", gTurnDirection);
  if(gTurnDirection == -1)
  {
    if(@Tractor::svTurnLeft == 0)
    {
     @Tractor::svTurnLeft = 1;
    }
    else
    {
     @Tractor::svTurnLeft = 0;
    }
  }
  else if(gTurnDirection == 1)
  {
    if(@Tractor::svTurnRight == 0)
    {
     @Tractor::svTurnRight = 1;
    }
    else
    {
     @Tractor::svTurnRight = 0;
    }
  }
}