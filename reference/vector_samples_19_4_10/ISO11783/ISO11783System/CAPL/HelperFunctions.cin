/*@!Encoding:1252*/
float Helper_CalcDistance(float latPos1, float lonPos1, float latPos2, float lonPos2)
{
  float radiusEarth = 6371.0008; // km
  
  float lat1InRadian;
  float lon1InRadian;
  float lat2InRadian;
  float lon2InRadian;
  float dLat;
  float dLon;
  float a;
  float c;
  
  lat1InRadian = (latPos1 * pi)/180;
  lon1InRadian = (lonPos1 * pi)/180;
  lat2InRadian = (latPos2 * pi)/180;
  lon2InRadian = (lonPos2 * pi)/180;
  
  dLat = (lat2InRadian - lat1InRadian);
  dLon = (lon2InRadian - lon1InRadian);
  
  a = ((sin(dLat/2) * sin(dLat/2)) + (cos(lat1InRadian) * cos(lat2InRadian) * sin(dLon/2) * sin(dLon/2)));
  c = 2 * (arcsin(sqrt(a)));
  
  return radiusEarth * c * 1000;
}

/*
Calculates the longitude difference in degrees, which corresponds to one meter
*/
float Helper_GetLongitudeMeter(float latPos, float lonPos)
{
  float lonMeter;
  float lonBase = 0.01;
  lonMeter = lonBase / Helper_CalcDistance(latPos, lonPos, latPos, lonPos + lonBase);
  return lonMeter;
}

/*
Calculates the latitude difference in degrees, which corresponds to one meter
*/
float Helper_GetLatitudeMeter(float latPos, float lonPos)
{
  float latMeter;
  float latBase = 0.01;
  latMeter = latBase / Helper_CalcDistance(latPos, lonPos, latPos + latBase, lonPos);
  return latMeter;
}

/*
term: y = ax + c
a = (y2 - y1) / (x2 - x1)
c = y2 - a * x2
*/
int Helper_PointIsAboveLine(float pointLat,     float pointLon, 
                        float lineLeftLat, float lineLeftLon, 
                        float lineRightLat,   float lineRightLon)
{
  float aVal, cVal, latValOnLine;
  if(lineLeftLat == lineRightLat || lineLeftLon == lineRightLon)
  {
    return 0;
  }
  if(pointLon < lineLeftLon || pointLon > lineRightLon)
  {
    return 0;
  }
  //compute term
  aVal = (lineRightLat - lineLeftLat) / (lineRightLon - lineLeftLon);
  cVal = lineRightLat - aVal * lineRightLon;
  //check if latitude on line is smaller as latitude of point
  latValOnLine = aVal * pointLon + cVal;
  if(latValOnLine < pointLat)
  {
    return 1;
  }
  
  return 0;
}

