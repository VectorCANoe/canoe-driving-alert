VERSION ""

NS_ :

BS_:

BU_: GNSSReceiver VT TECU TC Sprayer
VAL_TABLE_ TIM_AuthErrorCode 39 "LwAPossibleBitMismatch" 38 "AuthenticationAbortedDueToGeneralPeerError" 37 "AuthenticationAbortedByPeerDueToError" 36 "ChallengeDataCorrupt" 35 "InvalidChallengeLength" 34 "FunctionFacilityNotCertified" 33 "RequestNotAllowed" 32 "Reserved_0x20" 31 "AuthenticationTimeout" 30 "CertificateTypeInvalid" 29 "DeviceCertificateRevoked" 28 "ManufacturerSeriesCertificateRevoked" 27 "ManufacturerCertificateRevoked" 26 "LabCertificateRevoked" 25 "RootCertificateRevoked" 24 "CertificateTypeMismatch" 23 "CertificateChainInvalid" 22 "ECU_CCID_Mismatch" 21 "NAME_Mismatch" 20 "ECC_PublicKeyValidationFailed" 19 "UnexpectedRestartAuthenticationBitSet" 18 "AuthenticationStatusInvalid" 17 "AuthenticationTypeNotSupported" 16 "AuthenticationStatusLost" 15 "DeviceCertificateDataCorrupt" 14 "ManufacturerSeriesCertificateDataCorrupt" 13 "ManufacturerCertificateDataCorrupt" 12 "TestLabCertificateDataCorrupt" 11 "RootCertificateDataCorrupt" 10 "InternalError" 9 "ChallengesDontMatch" 8 "DeviceCertificateSignatureInvalid" 7 "ManufacturerSeriesCertificateSignatureInvalid" 6 "ManufacturerCertificateSignatureInvalid" 5 "LabCertificateSignatureInvalid" 4 "RootCertificateSignatureInvalid" 3 "NotAuthenticationServerOrClient" 2 "CertificateFormatNotSupported" 1 "ParticipantBusy" 0 "NoError" ;
VAL_TABLE_ TIM_CertificateType 255 "NotAvailable" 6 "CRLCertificate" 5 "CRLSigningCertificate" 4 "DeviceCertificate" 3 "ManufacturerSeriesCertificate" 2 "ManufacturerCertificate" 1 "TestlabCertificate" 0 "AEFRootCertificate" ;
VAL_TABLE_ NetworkInterconnUnitParametrics 16 "NetworkInterconnectionUnitType" 15 "NumberOfPorts" 14 "UptimeSinceLastPowerOnReset " 13 "AverageNumOfMsgsFilteredPerSec" 12 "AverageNumOfMsgsForwardedPerSec" 11 "AverageNumOfMsgsReceivedPerSec" 10 "NumOfMsgsWithExcessTransitDelayTime " 9 "NumOfMsgsLostDueToBufferOverflow " 8 "AverageTransitDelayTime" 7 "MaxTransitDelayTime" 6 "MaxNumOfMsgsFilteredPerSec" 5 "MaxNumOfMsgsForwardedPerSec" 4 "MaxNumOfMsgsReceivedPerSec" 3 "NumberOfFilterDatabaseEntries" 2 "MaxFilterDatabaseSize" 1 "BufferSize" 0 "RequestAllParameters" ;
VAL_TABLE_ FMI 0 "Above normal (most severe)" 1 "Below normal (most severe)" 2 "Data erratic" 3 "Voltage above normal" 4 "Voltage below normal" 5 "Current below normal" 6 "Current above normal" 7 "Mechanical system not responding" 8 "Abnormal frequency" 9 "Abnormal update rate" 10 "Abnormal rate of change" 11 "Root cause not known" 12 "Bad intelligent device" 13 "Out of calibration" 14 "Special intstructions" 15 "Above normal (least severe)" 16 "Above normal (moderately severe)" 17 "Below normal (least severe)" 18 "Below normal (moderately severe)" 19 "Received network data in error" 31 "Condition exists" 20 "Data drifted high" 21 "Data drifted low" ;

BO_ 3221225472 VECTOR__INDEPENDENT_SIG_MSG: 0 Vector__XXX
 SG_ ClientAuthenticationSubStatus : 0|8@1- (1,0) [0|255] "" Vector__XXX
 SG_ ServerAuthenticationSubStatus : 0|8@1- (1,0) [0|255] "" Vector__XXX

BO_ 2362179319 PD_TC: 14 TC
 SG_ ActualCanopyHeight m520 : 32|32@1+ (1,0) [0|2147483647] "mm" Vector__XXX
 SG_ GNSSInstallationType m521 : 32|32@1+ (1,0) [0|100] "" Vector__XXX
 SG_ LastBaleLifetimeCount m519 : 32|32@1+ (1,0) [0|2147483647] "" Vector__XXX
 SG_ ActualTramlineCondensedWorkState m518 : 32|32@1+ (1,0) [0|4294967295] "" Vector__XXX
 SG_ SetpointTramlineCondensedWorkSta m517 : 32|32@1+ (1,0) [0|4294967295] "" Vector__XXX
 SG_ TramlineOverdosingRate m516 : 32|32@1+ (1,0) [0|2147483647] "ppm" Vector__XXX
 SG_ TramlineControlState m515 : 32|32@1+ (1,0) [0|3] "" Vector__XXX
 SG_ GNSSQuality m514 : 32|32@1+ (1,0) [0|2147483647] "" Vector__XXX
 SG_ GuidanceLineDeviation m513 : 32|32@1- (1,0) [-2147483648|2147483647] "mm" Vector__XXX
 SG_ GuidanceLineSwathWidth m512 : 32|32@1+ (1,0) [0|2147483647] "mm" Vector__XXX
 SG_ TrackNumberToLeft m511 : 32|32@1- (1,0) [-2147483648|2147483647] "" Vector__XXX
 SG_ TrackNumberToRight m510 : 32|32@1- (1,0) [-2147483648|2147483647] "" Vector__XXX
 SG_ ActualTrackNumber m509 : 32|32@1- (1,0) [-2147483648|2147483647] "" Vector__XXX
 SG_ UniqueABGuidanceReferenceLineID m508 : 32|32@1+ (1,0) [0|2147483647] "" Vector__XXX
 SG_ TramlineSequenceNumber m507 : 32|32@1+ (1,0) [0|2147483647] "" Vector__XXX
 SG_ SetpointTramlineControlLevel m506 : 32|32@1+ (1,0) [0|3] "" Vector__XXX
 SG_ TramlineControlLevel m505 : 32|32@1+ (1,0) [0|7] "" Vector__XXX
 SG_ MaxEngineTorque m504 : 32|32@1+ (0.001,0) [0|2147483.647] "%" Vector__XXX
 SG_ MinEngineTorque m503 : 32|32@1+ (0.001,0) [0|2147483.647] "%" Vector__XXX
 SG_ ActualEngineTorque m502 : 32|32@1+ (0.001,0) [0|2147483.647] "%" Vector__XXX
 SG_ SetpointEngineTorque m501 : 32|32@1+ (0.001,0) [0|2147483.647] "%" Vector__XXX
 SG_ LastEventPartnerIDDeviceClass m500 : 32|32@1+ (1,0) [0|0] "" Vector__XXX
 SG_ LastEventPartnerIDManufacturerID m499 : 32|32@1+ (1,0) [0|0] "" Vector__XXX
 SG_ LastEventPartnerIdType m498 : 32|32@1+ (1,0) [0|0] "" Vector__XXX
 SG_ LastEventPartnerID_Byte13to16 m497 : 32|32@1+ (1,0) [0|0] "" Vector__XXX
 SG_ LastEventPartnerID_Byte9to12 m496 : 32|32@1+ (1,0) [0|0] "" Vector__XXX
 SG_ LastEventPartnerID_Byte5to8 m495 : 32|32@1+ (1,0) [0|0] "" Vector__XXX
 SG_ LastEventPartnerID_Byte1to4 m494 : 32|32@1+ (1,0) [0|0] "" Vector__XXX
 SG_ LifetimeEngineHours m493 : 32|32@1+ (0.1,0) [0|214748364.7] "h" Vector__XXX
 SG_ TotalEngineHours m492 : 32|32@1+ (0.05,0) [0|210554060.75] "h" Vector__XXX
 SG_ FuelPercentageLevel m491 : 32|32@1- (0.01,0) [0|21474836.47] "%" Vector__XXX
 SG_ MaxFuelTankContent m490 : 32|32@1+ (1,0) [0|2147483647] "ml" Vector__XXX
 SG_ MaxDieselExhaustFluidTankContent m489 : 32|32@1+ (1,0) [0|2147483647] "ml" Vector__XXX
 SG_ DieselExhaustFluidTankPercentage m488 : 32|32@1+ (0.01,0) [0|100] "%" Vector__XXX
 SG_ MaxEngineSpeed m486 : 32|32@1- (0.0001,0) [0|214748.3647] "r/min" Vector__XXX
 SG_ MinEngineSpeed m485 : 32|32@1- (0.0001,0) [0|214748.3647] "r/min" Vector__XXX
 SG_ ActualEngineSpeed m484 : 32|32@1- (0.0001,0) [0|214748.3647] "r/min" Vector__XXX
 SG_ SetpointEngineSpeed m483 : 32|32@1- (0.0001,0) [0|214748.3647] "r/min" Vector__XXX
 SG_ LastBaleNumberOfSubbales m482 : 32|32@1+ (1,0) [0|2147483647] "" Vector__XXX
 SG_ SetpointNumberOfSubbales m481 : 32|32@1+ (1,0) [0|2147483647] "" Vector__XXX
 SG_ MaxFlakeSize m480 : 32|32@1- (1,0) [0|1000] "mm" Vector__XXX
 SG_ MinFlakeSize m479 : 32|32@1- (1,0) [0|1000] "mm" Vector__XXX
 SG_ SetpointFlakeSize m478 : 32|32@1- (1,0) [0|1000] "mm" Vector__XXX
 SG_ MaxBaleHydraulicPressure m477 : 32|32@1+ (1,0) [0|2147483647] "Pa" Vector__XXX
 SG_ MinBaleHydraulicPressure m476 : 32|32@1+ (1,0) [0|2147483647] "Pa" Vector__XXX
 SG_ SetpointBaleHydraulicPressure m475 : 32|32@1+ (1,0) [0|2147483647] "Pa" Vector__XXX
 SG_ MaxLengthOfCut m474 : 32|32@1+ (0.001,0) [0|2147483.647] "mm" Vector__XXX
 SG_ MinLengthOfCut m473 : 32|32@1+ (0.001,0) [0|2147483.647] "mm" Vector__XXX
 SG_ SetpointLengthOfCut m472 : 32|32@1+ (0.001,0) [0|2147483.647] "mm" Vector__XXX
 SG_ ActualPercentageContent m467 : 32|32@1+ (0.01,0) [0|100] "%" Vector__XXX
 SG_ ActualRelativeConnectorAngle m466 : 32|32@1- (0.001,0) [-180|180] "°" Vector__XXX
 SG_ LifetimeHaulCounter m465 : 32|32@1+ (1,0) [0|2147483647] "" Vector__XXX
 SG_ HaulCounter m464 : 32|32@1+ (1,0) [0|2147483647] "" Vector__XXX
 SG_ LastUnloadedCount m463 : 32|32@1+ (1,0) [0|2147483647] "" Vector__XXX
 SG_ LastLoadedCount m462 : 32|32@1+ (1,0) [0|2147483647] "" Vector__XXX
 SG_ LifetimeUnloadedTotalCount m461 : 32|32@1+ (1,0) [0|2147483647] "" Vector__XXX
 SG_ LifetimeLoadedTotalCount m460 : 32|32@1+ (1,0) [0|2147483647] "" Vector__XXX
 SG_ UnloadedTotalCount m459 : 32|32@1+ (1,0) [0|2147483647] "" Vector__XXX
 SG_ LoadedTotalCount m458 : 32|32@1+ (1,0) [0|2147483647] "" Vector__XXX
 SG_ LastUnloadedVolume m457 : 32|32@1+ (1,0) [0|2147483647] "ml" Vector__XXX
 SG_ LastLoadedVolume m456 : 32|32@1+ (1,0) [0|2147483647] "ml" Vector__XXX
 SG_ LifetimeUnloadedTotalVolume m455 : 32|32@1+ (1,0) [0|2147483647] "L" Vector__XXX
 SG_ LifetimeLoadedTotalVolume m454 : 32|32@1+ (1,0) [0|2147483647] "L" Vector__XXX
 SG_ UnloadedTotalVolume m453 : 32|32@1+ (1,0) [0|2147483647] "ml" Vector__XXX
 SG_ LoadedTotalVolume m452 : 32|32@1+ (1,0) [0|2147483647] "ml" Vector__XXX
 SG_ MaxAppRateOfDryMatter m451 : 32|32@1+ (1,0) [0|2147483647] "ppm" Vector__XXX
 SG_ MinAppRateOfDryMatter m450 : 32|32@1+ (1,0) [0|2147483647] "ppm" Vector__XXX
 SG_ ActualAppRateOfDryMatter m449 : 32|32@1+ (1,0) [0|2147483647] "ppm" Vector__XXX
 SG_ SetpointAppRateOfDryMatter m448 : 32|32@1+ (1,0) [0|2147483647] "ppm" Vector__XXX
 SG_ MaxAppRateOfPotassium m447 : 32|32@1+ (1,0) [0|4294967295] "mg/m²" Vector__XXX
 SG_ MinAppRateOfPotassium m446 : 32|32@1+ (1,0) [0|4294967295] "mg/m²" Vector__XXX
 SG_ ActualAppRateOfPotassium m445 : 32|32@1+ (1,0) [0|4294967295] "mg/m²" Vector__XXX
 SG_ SetpointAppRateOfPotassium m444 : 32|32@1+ (1,0) [0|4294967295] "mg/m²" Vector__XXX
 SG_ MaxAppRateOfPhosphor m443 : 32|32@1+ (1,0) [0|4294967295] "mg/m²" Vector__XXX
 SG_ MinAppRateOfPhosphor m442 : 32|32@1+ (1,0) [0|4294967295] "mg/m²" Vector__XXX
 SG_ ActualAppRateOfPhosphor m441 : 32|32@1+ (1,0) [0|4294967295] "mg/m²" Vector__XXX
 SG_ SetpointAppRateOfPhosphor m440 : 32|32@1+ (1,0) [0|4294967295] "mg/m²" Vector__XXX
 SG_ MaxAppRateOfAmmonium m439 : 32|32@1+ (1,0) [0|4294967295] "mg/m²" Vector__XXX
 SG_ MinAppRateOfAmmonium m438 : 32|32@1+ (1,0) [0|4294967295] "mg/m²" Vector__XXX
 SG_ ActualAppRateOfAmmonium m437 : 32|32@1+ (1,0) [0|4294967295] "mg/m²" Vector__XXX
 SG_ SetpointAppRateOfAmmonium m436 : 32|32@1+ (1,0) [0|4294967295] "mg/m²" Vector__XXX
 SG_ MaxAppRateOfNitrogen m435 : 32|32@1+ (1,0) [0|4294967295] "mg/m²" Vector__XXX
 SG_ MinAppRateOfNitrogen m434 : 32|32@1+ (1,0) [0|4294967295] "mg/m²" Vector__XXX
 SG_ ActualAppRateOfNitrogen m433 : 32|32@1+ (1,0) [0|4294967295] "mg/m²" Vector__XXX
 SG_ SetpointAppRateOfNitrogen m432 : 32|32@1+ (1,0) [0|4294967295] "mg/m²" Vector__XXX
 SG_ LifetimeUnloadedTotalMass m431 : 32|32@1+ (1,0) [0|2147483647] "kg" Vector__XXX
 SG_ LifetimeLoadedTotalMass m430 : 32|32@1+ (1,0) [0|2147483647] "kg" Vector__XXX
 SG_ UnloadedTotalMass m429 : 32|32@1+ (1,0) [0|2147483647] "kg" Vector__XXX
 SG_ LoadedTotalMass m428 : 32|32@1+ (1,0) [0|2147483647] "kg" Vector__XXX
 SG_ ActualDownforceAsForce m427 : 32|32@1- (1,0) [-2147483648|2147483647] "N" Vector__XXX
 SG_ SetpointDownforceAsForce m426 : 32|32@1- (1,0) [-2147483648|2147483647] "N" Vector__XXX
 SG_ SetpointMaxAllowedSeedSpacingDev m425 : 32|32@1+ (1,0) [0|2147483647] "mm" Vector__XXX
 SG_ AvgCoeffOfVariationOfSeedSpacing m424 : 32|32@1+ (1,0) [0|1000000] "ppm" Vector__XXX
 SG_ ActCoeffOfVariationOfSeedSpacing m423 : 32|32@1+ (1,0) [0|1000000] "ppm" Vector__XXX
 SG_ AverageSeedSpacingDeviation_Copy m422 : 32|32@1+ (1,0) [0|2147483647] "mm" Vector__XXX
 SG_ ActualSeedSpacingDeviation m421 : 32|32@1+ (1,0) [0|2147483647] "mm" Vector__XXX
 SG_ AverageSeedMultiplePercentage m420 : 32|32@1+ (1,0) [0|1000000] "ppm" Vector__XXX
 SG_ ActualSeedMultiplePercentage m419 : 32|32@1+ (1,0) [0|1000000] "ppm" Vector__XXX
 SG_ AverageSeedSkipPercentage m418 : 32|32@1+ (1,0) [0|1000000] "ppm" Vector__XXX
 SG_ ActualSeedSkipPercentage m417 : 32|32@1+ (1,0) [0|1000000] "ppm" Vector__XXX
 SG_ AverageSeedSingulationPercentage m416 : 32|32@1+ (1,0) [0|1000000] "ppm" Vector__XXX
 SG_ ActualSeedSingulationPercentage m415 : 32|32@1+ (1,0) [0|1000000] "ppm" Vector__XXX
 SG_ LifetimeAvgDieselExhFluidConsump m414 : 32|32@1+ (1,0) [0|2147483647] "mm³/m²" Vector__XXX
 SG_ LifetimeAvgDieselExhFluidCo_0000 m413 : 32|32@1+ (1,0) [0|2147483647] "mm³/s" Vector__XXX
 SG_ LifetimeDieselExhaustFluidConsum m412 : 32|32@1+ (0.5,0) [0|1073741823.5] "L" Vector__XXX
 SG_ InstantDieselExhaustFluidConsump m411 : 32|32@1+ (1,0) [0|2147483647] "mm³/m²" Vector__XXX
 SG_ InstantDieselExhaustFluidCo_0000 m410 : 32|32@1+ (1,0) [0|2147483647] "mm³/s" Vector__XXX
 SG_ TotalDieselExhaustFluidConsumpti m409 : 32|32@1+ (1,0) [0|2147483647] "ml" Vector__XXX
 SG_ AverageCropContamination m408 : 32|32@1+ (1,0) [0|2147483647] "ppm" Vector__XXX
 SG_ AverageProteinContent m407 : 32|32@1+ (1,0) [0|2147483647] "ppm" Vector__XXX
 SG_ ActualProteinContent m406 : 32|32@1+ (1,0) [0|2147483647] "ppm" Vector__XXX
 SG_ ActualApplicationOfDryMatter m405 : 32|32@1+ (1,0) [0|2147483647] "mg/l" Vector__XXX
 SG_ ActualApplicationOfPotassium m404 : 32|32@1+ (1,0) [0|2147483647] "mg/l" Vector__XXX
 SG_ ActualApplicationOfPhosphor m403 : 32|32@1+ (1,0) [0|2147483647] "mg/l" Vector__XXX
 SG_ ActualApplicationOfAmmonium m402 : 32|32@1+ (1,0) [0|2147483647] "mg/l" Vector__XXX
 SG_ ActualApplicationOfNitrogen m401 : 32|32@1+ (1,0) [0|2147483647] "mg/l" Vector__XXX
 SG_ SpeedSource m400 : 32|32@1- (1,0) [0|100] "" Vector__XXX
 SG_ MaximumSpeed m399 : 32|32@1- (1,0) [-2147483648|2147483647] "mm/s" Vector__XXX
 SG_ MinimumSpeed m398 : 32|32@1- (1,0) [-2147483648|2147483647] "mm/s" Vector__XXX
 SG_ ActualSpeed m397 : 32|32@1- (1,0) [-2147483648|2147483647] "mm/s" Vector__XXX
 SG_ SetpointSpeed m396 : 32|32@1- (1,0) [-2147483648|2147483647] "mm/s" Vector__XXX
 SG_ ActualDieselExhaustFluidTankCont m395 : 32|32@1+ (1,0) [0|4294967295] "ml" Vector__XXX
 SG_ ActualFuelTankContent m394 : 32|32@1+ (1,0) [0|2147483647] "ml" Vector__XXX
 SG_ MaximumRevolutionsPerTime m393 : 32|32@1- (0.0001,0) [-214748.3648|214748.3647] "r/min" Vector__XXX
 SG_ MinimumRevolutionsPerTime m392 : 32|32@1- (0.0001,0) [-214748.3648|214748.3647] "r/min" Vector__XXX
 SG_ DefaultRevolutionsPerTime m391 : 32|32@1- (0.0001,0) [-214748.3647|214748.3647] "r/min" Vector__XXX
 SG_ ActualRevolutionsPerTime m390 : 32|32@1- (0.0001,0) [-214748.3648|214748.3647] "r/min" Vector__XXX
 SG_ SetpointRevolutionsAsCountPerTim m389 : 32|32@1- (0.0001,0) [-214748.3647|214748.3647] "r/min" Vector__XXX
 SG_ TotalRevolutionsInCompleteRevolu m388 : 32|32@1- (0.0001,0) [-214748.3648|214748.3647] "" Vector__XXX
 SG_ TotalRevolutionsInFractionalRevo m387 : 32|32@1- (0.0001,0) [-214748.3648|214748.3647] "" Vector__XXX
 SG_ ActualAtmosphericPressure m386 : 32|32@1+ (0.1,0) [0|200000] "Pa" Vector__XXX
 SG_ MSLAtmosphericPressure m385 : 32|32@1+ (0.1,0) [0|200000] "Pa" Vector__XXX
 SG_ ApparentWindSpeed m384 : 32|32@1+ (1,0) [0|100000000] "mm/s" Vector__XXX
 SG_ ApparentWindDirection m383 : 32|32@1+ (1,0) [0|359] "°" Vector__XXX
 SG_ CondensedSectionOverrideState241 m382 : 32|32@1+ (1,0) [0|4294967295] "" Vector__XXX
 SG_ CondensedSectionOverrideState225 m381 : 32|32@1+ (1,0) [0|4294967295] "" Vector__XXX
 SG_ CondensedSectionOverrideState209 m380 : 32|32@1+ (1,0) [0|4294967295] "" Vector__XXX
 SG_ CondensedSectionOverrideState193 m379 : 32|32@1+ (1,0) [0|4294967295] "" Vector__XXX
 SG_ CondensedSectionOverrideState177 m378 : 32|32@1+ (1,0) [0|4294967295] "" Vector__XXX
 SG_ CondensedSectionOverrideState161 m377 : 32|32@1+ (1,0) [0|4294967295] "" Vector__XXX
 SG_ CondensedSectionOverrideState145 m376 : 32|32@1+ (1,0) [0|4294967295] "" Vector__XXX
 SG_ CondensedSectionOverrideState129 m375 : 32|32@1+ (1,0) [0|4294967295] "" Vector__XXX
 SG_ CondensedSectionOverrideState113 m374 : 32|32@1+ (1,0) [0|4294967295] "" Vector__XXX
 SG_ CondensedSectionOverrideState97t m373 : 32|32@1+ (1,0) [0|4294967295] "" Vector__XXX
 SG_ CondensedSectionOverrideState81t m372 : 32|32@1+ (1,0) [0|4294967295] "" Vector__XXX
 SG_ CondensedSectionOverrideState65t m371 : 32|32@1+ (1,0) [0|4294967295] "" Vector__XXX
 SG_ CondensedSectionOverrideState49t m370 : 32|32@1+ (1,0) [0|4294967295] "" Vector__XXX
 SG_ CondensedSectionOverrideState33t m369 : 32|32@1+ (1,0) [0|4294967295] "" Vector__XXX
 SG_ CondensedSectionOverrideState17t m368 : 32|32@1+ (1,0) [0|4294967295] "" Vector__XXX
 SG_ CondensedSectionOverrideState01t m367 : 32|32@1+ (1,0) [0|4294967295] "" Vector__XXX
 SG_ ActualDownforcePressure m366 : 32|32@1- (1,0) [-2147483648|2147483647] "Pa" Vector__XXX
 SG_ SetpointDownforcePressure m365 : 32|32@1- (1,0) [-2147483648|2147483647] "Pa" Vector__XXX
 SG_ ActualFlakeSize m364 : 32|32@1+ (1,0) [0|1000] "mm" Vector__XXX
 SG_ LastBaleDryMass m363 : 32|32@1+ (1,0) [0|2147483647] "g" Vector__XXX
 SG_ TotalBaleLength m362 : 32|32@1+ (1,0) [0|2147483647] "mm" Vector__XXX
 SG_ LastBaleDensity m361 : 32|32@1+ (1,0) [0|2147483647] "mg/l" Vector__XXX
 SG_ LastBaleSize m360 : 32|32@1+ (1,0) [0|2147483647] "mm" Vector__XXX
 SG_ AverageDryYieldMassPerArea m359 : 32|32@1+ (1,0) [0|2147483647] "mg/m²" Vector__XXX
 SG_ AverageDryYieldMassPerTime m358 : 32|32@1+ (1,0) [0|2147483647] "mg/s" Vector__XXX
 SG_ TotalApplicationOfDryMatter m357 : 32|32@1+ (1,0) [0|2147483647] "kg" Vector__XXX
 SG_ TotalApplicationOfPotassium m356 : 32|32@1+ (1,0) [0|2147483647] "g" Vector__XXX
 SG_ TotalApplicationOfPhosphor m355 : 32|32@1+ (1,0) [0|2147483647] "g" Vector__XXX
 SG_ TotalApplicationOfAmmonium m354 : 32|32@1+ (1,0) [0|2147483647] "g" Vector__XXX
 SG_ TotalApplicationofNitrogen m353 : 32|32@1+ (1,0) [0|2147483647] "g" Vector__XXX
 SG_ ApplicationTotalMass m352 : 32|32@1- (1,0) [0|2147483647] "g" Vector__XXX
 SG_ ApplicationTotalVolume m351 : 32|32@1- (1,0) [0|2147483647] "ml" Vector__XXX
 SG_ FunctionType m350 : 32|32@1- (1,0) [0|2147483647] "" Vector__XXX
 SG_ NozzleDriftReduction m349 : 32|32@1- (1,0) [0|100] "ppm" Vector__XXX
 SG_ MaximumSwathingWidth m348 : 32|32@1- (1,0) [0|2147483647] "mm" Vector__XXX
 SG_ MinimumSwathingWidth m347 : 32|32@1- (1,0) [0|2147483647] "mm" Vector__XXX
 SG_ ActualSwathingWidth m346 : 32|32@1- (1,0) [0|2147483647] "mm" Vector__XXX
 SG_ SetpointSwathingWidth m345 : 32|32@1- (1,0) [0|2147483647] "mm" Vector__XXX
 SG_ MaximumGrainKernelCrackerGap m344 : 32|32@1- (0.001,0) [0|2147483.647] "mm" Vector__XXX
 SG_ MinimumGrainKernelCrackerGap m343 : 32|32@1- (0.001,0) [0|2147483.647] "mm" Vector__XXX
 SG_ ActualGrainKernelCrackerGap m342 : 32|32@1- (0.001,0) [-0|2147483.647] "mm" Vector__XXX
 SG_ SetpointGrainKernelCrackerGap m341 : 32|32@1- (0.001,0) [-0|2147483.647] "mm" Vector__XXX
 SG_ EffectiveUnloadingTime m340 : 32|32@1- (1,0) [-0|2147483647] "s" Vector__XXX
 SG_ EffectiveLoadingTime m339 : 32|32@1- (1,0) [0|2147483647] "s" Vector__XXX
 SG_ LiftimeRearPTOHours m338 : 32|32@1- (0.1,0) [0|214748364.7] "h" Vector__XXX
 SG_ LifetimeFrontPTOHours m337 : 32|32@1- (0.1,0) [0|214748364.7] "h" Vector__XXX
 SG_ RearPTOHours m336 : 32|32@1- (1,0) [0|2147480000] "s" Vector__XXX
 SG_ FrontPTOHours m335 : 32|32@1- (1,0) [0|2147483647] "s" Vector__XXX
 SG_ OperatingHoursSinceLastSharpenin m334 : 32|32@1- (1,0) [0|2147483647] "s" Vector__XXX
 SG_ MaximumCuttingDrumSpeed m333 : 32|32@1- (0.001,0) [0|2147483.647] "1/s" Vector__XXX
 SG_ ActualCuttingDrumSpeed m331 : 32|32@1- (0.001,0) [0|2147483.647] "1/s" Vector__XXX
 SG_ SetpointCuttingDrumSpeed m330 : 32|32@1- (0.001,0) [0|2147483.647] "1/s" Vector__XXX
 SG_ MaximumHeaderSpeed m329 : 32|32@1- (0.001,0) [0|2147483.647] "1/s" Vector__XXX
 SG_ MinimumHeaderSpeed m328 : 32|32@1- (0.001,0) [0|2147483.647] "1/s" Vector__XXX
 SG_ ActualHeaderSpeed m327 : 32|32@1- (0.001,0) [0|2147483.647] "1/s" Vector__XXX
 SG_ SetpointHeaderSpeed m326 : 32|32@1- (0.001,0) [0|2147483.647] "1/s" Vector__XXX
 SG_ LifetimeApplicationTotalVolume m325 : 32|32@1+ (1,0) [0|2147483647] "L" Vector__XXX
 SG_ ChopperEngagementTotalTime m324 : 32|32@1+ (1,0) [0|2147483647] "s" Vector__XXX
 SG_ UnloadIdentificationNumber m323 : 32|32@1+ (1,0) [0|2147483647] "" Vector__XXX
 SG_ LoadIdentificationNumber m322 : 32|32@1+ (1,0) [0|4294967296] "" Vector__XXX
 SG_ ArbitraryAddressCapable m0 : 111|1@1+ (1,0) [0|1] "" Vector__XXX
 SG_ IndustryGroup m0 : 108|3@1+ (1,0) [0|7] "" Vector__XXX
 SG_ VehicleSystemInstance m0 : 104|4@1+ (1,0) [0|15] "" Vector__XXX
 SG_ VehicleSystem2 m0 : 97|7@1+ (1,0) [0|127] "" Vector__XXX
 SG_ Function m0 : 88|8@1+ (1,0) [0|255] "" Vector__XXX
 SG_ FunctionInstance m0 : 83|5@1+ (1,0) [0|31] "" Vector__XXX
 SG_ ECUInstance m0 : 80|3@1+ (1,0) [0|7] "" Vector__XXX
 SG_ ManufacturerCode m0 : 69|11@1+ (1,0) [0|2047] "" Vector__XXX
 SG_ TemperatureUnits m2 : 54|2@1+ (1,0) [0|3] "" Vector__XXX
 SG_ PressureUnits m2 : 52|2@1+ (1,0) [0|3] "" Vector__XXX
 SG_ ErrorCodeObjPool4 m9 : 51|1@1+ (1,0) [0|0] "" Vector__XXX
 SG_ ErrorCodeObjPool3 m9 : 50|1@1+ (1,0) [0|0] "" Vector__XXX
 SG_ ForceUnits m2 : 50|2@1+ (1,0) [0|3] "" Vector__XXX
 SG_ ErrorCodeObjPool2 m9 : 49|1@1+ (1,0) [0|0] "" Vector__XXX
 SG_ IdentityNumber m0 : 48|21@1+ (1,0) [0|2097152] "" Vector__XXX
 SG_ NumberOfSection m1 : 48|8@1+ (1,0) [0|255] "" Vector__XXX
 SG_ ExecutedCommand m14 : 48|8@1+ (1,0) [0|65535] "" Vector__XXX
 SG_ UnitsSystem m2 : 48|2@1+ (1,0) [0|3] "" Vector__XXX
 SG_ ErrorCodeObjPool1 m9 : 48|1@1+ (1,0) [0|0] "" Vector__XXX
 SG_ DistanceUnitCmd m2 : 46|2@1+ (1,0) [0|3] "" Vector__XXX
 SG_ AreaUnitCmd m2 : 44|2@1+ (1,0) [0|3] "" Vector__XXX
 SG_ VolumeUnitCmd m2 : 42|2@1+ (1,0) [0|3] "" Vector__XXX
 SG_ SourceAddressWSM m14 : 40|8@1+ (1,0) [0|65535] "" Vector__XXX
 SG_ MassUnitCmd m2 : 40|2@1+ (1,0) [0|3] "" Vector__XXX
 SG_ NumberOfBooms m1 : 40|8@1+ (1,0) [0|255] "" Vector__XXX
 SG_ OriginCommand m13 : 40|4@1+ (1,0) [0|15] "" Vector__XXX
 SG_ ErrorCodeProcessData8 m13 : 39|1@1+ (1,0) [0|1] "" Vector__XXX
 SG_ ErrorCodeProcessData7 m13 : 38|1@1+ (1,0) [0|1] "" Vector__XXX
 SG_ ErrorCodeProcessData6 m13 : 37|1@1+ (1,0) [0|1] "" Vector__XXX
 SG_ DestinationElementNumber m3 : 36|12@1+ (1,0) [0|4095] "" Vector__XXX
 SG_ ErrorCodeProcessData5 m13 : 36|1@1+ (1,0) [0|1] "" Vector__XXX
 SG_ ErrorCodeProcessData4 m13 : 35|1@1+ (1,0) [0|1] "" Vector__XXX
 SG_ StatusBusyExecuting m14 : 35|1@1+ (1,0) [0|1] "" Vector__XXX
 SG_ ErrorCodeProcessData3 m13 : 34|1@1+ (1,0) [0|1] "" Vector__XXX
 SG_ StatusBusyReading m14 : 34|1@1+ (1,0) [0|1] "" Vector__XXX
 SG_ ErrorCodeProcessData2 m13 : 33|1@1+ (1,0) [0|1] "" Vector__XXX
 SG_ StatusBusySaving m14 : 33|1@1+ (1,0) [0|1] "" Vector__XXX
 SG_ DataLogTimeInterval m4 : 32|32@1- (1,0) [0|60000] "ms" Vector__XXX
 SG_ DataLogDistanceInterval m5 : 32|32@1- (1,0) [0|1000000] "mm" Vector__XXX
 SG_ AppRateVolumePerArea_Set m1 : 32|32@1- (0.01,0) [0|21474836.47] "mm³/m²" Vector__XXX
 SG_ AppRateVolumePerArea_Act m2 : 32|32@1- (0.01,0) [0|21474836.47] "mm³/m²" Vector__XXX
 SG_ AppRateVolumePerArea_Def m3 : 32|32@1- (0.01,0) [0|21474836.47] "mm³/m²" Vector__XXX
 SG_ AppRateVolumePerArea_Min m4 : 32|32@1- (0.01,0) [0|21474836.47] "mm³/m²" Vector__XXX
 SG_ AppRateVolumePerArea_Max m5 : 32|32@1- (0.01,0) [0|21474836.47] "mm³/m²" Vector__XXX
 SG_ AppRateMassPerArea_Set m6 : 32|32@1- (1,0) [0|2147483647] "mg/m²" Vector__XXX
 SG_ AppRateMassPerArea_Act m7 : 32|32@1- (1,0) [0|2147483647] "mg/m²" Vector__XXX
 SG_ AppRateMassPerArea_Def m8 : 32|32@1- (1,0) [0|2147483647] "mg/m²" Vector__XXX
 SG_ AppRateMassPerArea_Min m9 : 32|32@1- (1,0) [0|2147483647] "mg/m²" Vector__XXX
 SG_ AppRateMassPerArea_Max m10 : 32|32@1- (1,0) [0|2147483647] "mg/m²" Vector__XXX
 SG_ AppRateCountPerArea_Set m11 : 32|32@1- (0.001,0) [0|2147483.647] "1/m²" Vector__XXX
 SG_ AppRateCountPerArea_Act m12 : 32|32@1- (0.001,0) [0|2147483.647] "1/m²" Vector__XXX
 SG_ AppRateCountPerArea_Def m13 : 32|32@1- (0.001,0) [0|2147483.647] "1/m²" Vector__XXX
 SG_ AppRateCountPerArea_Min m14 : 32|32@1- (0.001,0) [0|2147483.647] "1/m²" Vector__XXX
 SG_ AppRateCountPerArea_Max m15 : 32|32@1- (0.001,0) [0|2147483.647] "1/m²" Vector__XXX
 SG_ SetAppRateDistance_Set m16 : 32|32@1- (1,0) [0|2147483647] "mm" Vector__XXX
 SG_ AppRateDistance_Act m17 : 32|32@1- (1,0) [0|2147483647] "mm" Vector__XXX
 SG_ AppRateDistance_Def m18 : 32|32@1- (1,0) [0|2147483647] "mm" Vector__XXX
 SG_ AppRateDistance_Min m19 : 32|32@1- (1,0) [0|2147483647] "mm" Vector__XXX
 SG_ AppRateDistance_Max m20 : 32|32@1- (1,0) [0|2147483647] "mm" Vector__XXX
 SG_ AppRateVolumePerVolume_Set m21 : 32|32@1- (1,0) [0|2147483647] "mm³/m³" Vector__XXX
 SG_ AppRateVolumePerVolume_Act m22 : 32|32@1- (1,0) [0|2147483647] "mm³/m³" Vector__XXX
 SG_ AppRateVolumePerVolume_Def m23 : 32|32@1- (1,0) [0|2147483647] "mm³/m³" Vector__XXX
 SG_ AppRateVolumePerVolume_Min m24 : 32|32@1- (1,0) [0|2147483647] "mm³/m³" Vector__XXX
 SG_ AppRateVolumePerVolume_Max m25 : 32|32@1- (1,0) [0|2147483647] "mm³/m³" Vector__XXX
 SG_ AppRateMassPerMass_Set m26 : 32|32@1- (1,0) [0|2147483647] "mg/kg" Vector__XXX
 SG_ AppRateMassPerMass_Act m27 : 32|32@1- (1,0) [0|2147483647] "mg/kg" Vector__XXX
 SG_ AppRateMassPerMass_Def m28 : 32|32@1- (1,0) [0|2147483647] "mg/kg" Vector__XXX
 SG_ AppRateMassPerMass_Min m29 : 32|32@1- (1,0) [0|2147483647] "mg/kg" Vector__XXX
 SG_ AppRateMassPerMass_Max m30 : 32|32@1- (1,0) [0|2147483647] "mg/kg" Vector__XXX
 SG_ AppRateVolumePerMass_Set m31 : 32|32@1- (1,0) [0|2147483647] "mm³/kg" Vector__XXX
 SG_ AppRateVolumePerMass_Act m32 : 32|32@1- (1,0) [0|2147483647] "mm³/kg" Vector__XXX
 SG_ AppRateVolumePerMass_Def m33 : 32|32@1- (1,0) [0|2147483647] "mm³/kg" Vector__XXX
 SG_ AppRateVolumePerMass_Min m34 : 32|32@1- (1,0) [0|2147483647] "mm³/kg" Vector__XXX
 SG_ AppRateVolumePerMass_Max m35 : 32|32@1- (1,0) [0|2147483647] "mm³/kg" Vector__XXX
 SG_ AppRateVolumePerTime_Set m36 : 32|32@1- (1,0) [0|2147483647] "mm³/s" Vector__XXX
 SG_ AppRateVolumePerTime_Act m37 : 32|32@1- (1,0) [0|2147483647] "mm³/s" Vector__XXX
 SG_ AppRateVolumePerTime_Def m38 : 32|32@1- (1,0) [0|2147483647] "mm³/s" Vector__XXX
 SG_ AppRateVolumePerTime_Min m39 : 32|32@1- (1,0) [0|2147483647] "mm³/s" Vector__XXX
 SG_ AppRateVolumePerTime_Max m40 : 32|32@1- (1,0) [0|2147483647] "mm³/s" Vector__XXX
 SG_ AppRateMassPerTime_Set m41 : 32|32@1- (1,0) [0|2147483647] "mg/s" Vector__XXX
 SG_ AppRateMassPerTime_Act m42 : 32|32@1- (1,0) [0|2147483647] "mg/s" Vector__XXX
 SG_ AppRateMassPerTime_Def m43 : 32|32@1- (1,0) [0|2147483647] "mg/s" Vector__XXX
 SG_ AppRateMassPerTime_Min m44 : 32|32@1- (1,0) [0|2147483647] "mg/s" Vector__XXX
 SG_ AppRateMassPerTime_Max m45 : 32|32@1- (1,0) [0|2147483647] "mg/s" Vector__XXX
 SG_ AppRateCountPerTime_Set m46 : 32|32@1- (0.001,0) [0|2147483.647] "1/s" Vector__XXX
 SG_ AppRateCountPerTime_Act m47 : 32|32@1- (0.001,0) [0|2147483.647] "1/s" Vector__XXX
 SG_ AppRateCountPerTime_Def m48 : 32|32@1- (0.001,0) [0|2147483.647] "1/s" Vector__XXX
 SG_ AppRateCountPerTime_Min m49 : 32|32@1- (0.001,0) [0|2147483.647] "1/s" Vector__XXX
 SG_ AppRateCountPerTime_Max m50 : 32|32@1- (0.001,0) [0|2147483.647] "1/s" Vector__XXX
 SG_ SetTillageDepth_Set m51 : 32|32@1- (1,0) [0|2147483647] "mm" Vector__XXX
 SG_ TillageDepth_Act m52 : 32|32@1- (1,0) [0|2147483647] "mm" Vector__XXX
 SG_ TillageDepth_Def m53 : 32|32@1- (1,0) [0|2147483647] "mm" Vector__XXX
 SG_ TillageDepth_Min m54 : 32|32@1- (1,0) [0|2147483647] "mm" Vector__XXX
 SG_ TillageDepth_Max m55 : 32|32@1- (1,0) [0|2147483647] "mm" Vector__XXX
 SG_ SeedingDeph_Set m56 : 32|32@1- (1,0) [0|2147483647] "mm" Vector__XXX
 SG_ SeedingDeph_Act m57 : 32|32@1- (1,0) [0|2147483647] "mm" Vector__XXX
 SG_ SeedingDeph_Def m58 : 32|32@1- (1,0) [0|2147483647] "mm" Vector__XXX
 SG_ SeedingDeph_Min m59 : 32|32@1- (1,0) [0|2147483647] "mm" Vector__XXX
 SG_ SeedingDeph_Max m60 : 32|32@1- (1,0) [0|2147483647] "mm" Vector__XXX
 SG_ WorkingHeight_Set m61 : 32|32@1- (1,0) [0|2147483647] "mm" Vector__XXX
 SG_ WorkingHeight_Act m62 : 32|32@1- (1,0) [0|2147483647] "mm" Vector__XXX
 SG_ WorkingHeight_Def m63 : 32|32@1- (1,0) [0|2147483647] "mm" Vector__XXX
 SG_ WorkingHeight_Min m64 : 32|32@1- (1,0) [0|2147483647] "mm" Vector__XXX
 SG_ WorkingHeight_Max m65 : 32|32@1- (1,0) [0|2147483647] "mm" Vector__XXX
 SG_ WorkingWidth_Set m66 : 32|32@1- (1,0) [0|2147483647] "mm" Vector__XXX
 SG_ WorkingWidth_Act m67 : 32|32@1- (1,0) [0|2147483647] "mm" Vector__XXX
 SG_ WorkingWidth_Def m68 : 32|32@1- (1,0) [0|2147483647] "mm" Vector__XXX
 SG_ WorkingWidth_Min m69 : 32|32@1- (1,0) [0|2147483647] "mm" Vector__XXX
 SG_ WorkingWidth_Max m70 : 32|32@1- (1,0) [0|2147483647] "mm" Vector__XXX
 SG_ ContentAsVolume_Set m71 : 32|32@1- (1,0) [0|2147483647] "ml" Vector__XXX
 SG_ ContentAsVolume_Act m72 : 32|32@1- (1,0) [0|2147483647] "ml" Vector__XXX
 SG_ ContentAsVolume_Max m73 : 32|32@1- (1,0) [0|2147483647] "ml" Vector__XXX
 SG_ ContentAsMass_Set m74 : 32|32@1- (1,0) [0|2147483647] "g" Vector__XXX
 SG_ ContentAsMass_Act m75 : 32|32@1- (1,0) [0|2147483647] "g" Vector__XXX
 SG_ ContentAsMass_Max m76 : 32|32@1- (1,0) [0|2147483647] "g" Vector__XXX
 SG_ ContentAsCount_Set m77 : 32|32@1- (1,0) [0|2147483647] "" Vector__XXX
 SG_ ContentAsCount_Act m78 : 32|32@1- (1,0) [0|2147483647] "" Vector__XXX
 SG_ ContentAsCount_Max m79 : 32|32@1- (1,0) [0|2147483647] "" Vector__XXX
 SG_ AccumulatedAppAsVolume m80 : 32|32@1- (1,0) [0|2147483647] "l" Vector__XXX
 SG_ AccumulatedAppAsMass m81 : 32|32@1- (1,0) [0|2147483647] "kg" Vector__XXX
 SG_ AccumulatedAppAsCount m82 : 32|32@1- (1,0) [0|2147483647] "" Vector__XXX
 SG_ YieldVolumePerArea m83 : 32|32@1- (1,0) [0|2147483647] "ml/m²" Vector__XXX
 SG_ YieldMassPerArea m84 : 32|32@1- (1,0) [0|2147483647] "mg/m²" Vector__XXX
 SG_ YieldCountPerArea m85 : 32|32@1- (0.001,0) [0|2147483.647] "1/m²" Vector__XXX
 SG_ YieldVolumePerTime m86 : 32|32@1- (1,0) [0|2147483647] "ml/s" Vector__XXX
 SG_ YieldMassPerTime m87 : 32|32@1- (1,0) [0|2147483647] "mg/s" Vector__XXX
 SG_ YieldCountPerTime m88 : 32|32@1- (0.001,0) [0|2147483.647] "1/s" Vector__XXX
 SG_ AccumulatedYieldAsVolume m89 : 32|32@1- (1,0) [0|2147483647] "ml" Vector__XXX
 SG_ AccumulatedYieldAsMass m90 : 32|32@1- (1,0) [0|2147483647] "g" Vector__XXX
 SG_ AccumulatedYieldAsCount m91 : 32|32@1- (1,0) [0|2147483647] "" Vector__XXX
 SG_ CropYieldLossVolumePerArea m92 : 32|32@1- (1,0) [0|2147483647] "ml/m²" Vector__XXX
 SG_ CropYieldLossMassPerArea m93 : 32|32@1- (1,0) [0|2147483647] "mg/m²" Vector__XXX
 SG_ CropYieldLossCountPerArea m94 : 32|32@1- (0.001,0) [0|2147483.647] "1/m²" Vector__XXX
 SG_ CropYieldLossVolumePerTime m95 : 32|32@1- (1,0) [0|2147483647] "ml/s" Vector__XXX
 SG_ CropYieldLossMassPerTime m96 : 32|32@1- (1,0) [0|2147483647] "mg/s" Vector__XXX
 SG_ CropYieldLossCountPerTime m97 : 32|32@1- (0.001,0) [0|2147483.647] "1/s" Vector__XXX
 SG_ CropYieldLoss m98 : 32|32@1- (1,0) [0|2147483647] "ppm" Vector__XXX
 SG_ MoistureInCropYield m99 : 32|32@1- (1,0) [0|2147483647] "ppm" Vector__XXX
 SG_ DirtMaterialInCropYield m100 : 32|32@1- (1,0) [0|2147483647] "ppm" Vector__XXX
 SG_ BaleWidth_Set m101 : 32|32@1- (1,0) [0|2147483647] "mm" Vector__XXX
 SG_ BaleWidth_Act m102 : 32|32@1- (1,0) [0|2147483647] "mm" Vector__XXX
 SG_ BaleWidth_Def m103 : 32|32@1- (1,0) [0|2147483647] "mm" Vector__XXX
 SG_ BaleWidth_Min m104 : 32|32@1- (1,0) [0|2147483647] "mm" Vector__XXX
 SG_ BaleWidth_Max m105 : 32|32@1- (1,0) [0|2147483647] "mm" Vector__XXX
 SG_ BaleHeight_Set m106 : 32|32@1- (1,0) [0|2147483647] "mm" Vector__XXX
 SG_ BaleHeight_Act m107 : 32|32@1- (1,0) [0|2147483647] "mm" Vector__XXX
 SG_ BaleHeight_Def m108 : 32|32@1- (1,0) [0|2147483647] "mm" Vector__XXX
 SG_ BaleHeight_Min m109 : 32|32@1- (1,0) [0|2147483647] "mm" Vector__XXX
 SG_ BaleHeight_Max m110 : 32|32@1- (1,0) [0|2147483647] "mm" Vector__XXX
 SG_ BaleSize_Set m111 : 32|32@1- (1,0) [0|2147483647] "mm" Vector__XXX
 SG_ BaleSize_Act m112 : 32|32@1- (1,0) [0|2147483647] "mm" Vector__XXX
 SG_ BaleSize_Def m113 : 32|32@1- (1,0) [0|2147483647] "mm" Vector__XXX
 SG_ BaleSize_Min m114 : 32|32@1- (1,0) [0|2147483647] "mm" Vector__XXX
 SG_ BaleSize_Max m115 : 32|32@1- (1,0) [0|2147483647] "mm" Vector__XXX
 SG_ AccumulatedArea m116 : 32|32@1- (1,0) [0|2147483647] "m²" Vector__XXX
 SG_ AccumulatedDistanceInWork m117 : 32|32@1- (1,0) [0|2147483647] "mm" Vector__XXX
 SG_ AccumulatedDistanceOutWork m118 : 32|32@1- (1,0) [0|2147483647] "mm" Vector__XXX
 SG_ AccumulatedTimeInWork m119 : 32|32@1- (1,0) [0|2147483647] "s" Vector__XXX
 SG_ AccumulatedTimeOutWork m120 : 32|32@1- (1,0) [0|2147483647] "s" Vector__XXX
 SG_ PrdoucDensityMassPerArea m121 : 32|32@1- (1,0) [0|2147483647] "g/l" Vector__XXX
 SG_ PrdoucDensityMassPerCount m122 : 32|32@1- (1,0) [0|2147483647] "mg/1000" Vector__XXX
 SG_ PrdoucDensityVolumePerCount m123 : 32|32@1- (1,0) [0|2147483647] "ml/1000" Vector__XXX
 SG_ AuxiliaryValveScalingExtend m124 : 32|32@1- (0.1,0) [-214748367.9|214748367.9] "%" Vector__XXX
 SG_ AuxiliaryValveScalingRetract m125 : 32|32@1- (0.1,0) [-214748367.9|214748367.9] "%" Vector__XXX
 SG_ AuxiliaryRampExtendUp m126 : 32|32@1- (1,0) [-2147483647|2147483647] "ms" Vector__XXX
 SG_ AuxiliaryValveRampExtendDown m127 : 32|32@1- (1,0) [-2147483647|2147483647] "ms" Vector__XXX
 SG_ AuxiliaryValveRampRetractUp m128 : 32|32@1- (1,0) [-2147483647|2147483647] "ms" Vector__XXX
 SG_ AuxiliaryValveRampRetractDown m129 : 32|32@1- (1,0) [-2147483647|2147483647] "ms" Vector__XXX
 SG_ AuxiliaryValveFloatThreshold m130 : 32|32@1- (0.1,0) [-214748367.9|214748367.9] "%" Vector__XXX
 SG_ AuxiliaryValveProgressivExtend m131 : 32|32@1- (1,0) [-2147483647|2147483647] "" Vector__XXX
 SG_ AuxiliaryValveProgressivRetract m132 : 32|32@1- (1,0) [-2147480000|2147480000] "" Vector__XXX
 SG_ AuxiliaryValveInvertPorts m133 : 32|32@1- (1,0) [-2147480000|2147480000] "" Vector__XXX
 SG_ DeviceElementOffsetX m134 : 32|32@1- (1,0) [-2147483647|2147483647] "mm" Vector__XXX
 SG_ DeviceElementOffsetY m135 : 32|32@1- (1,0) [-2147483647|2147483647] "mm" Vector__XXX
 SG_ DeviceElementOffsetZ m136 : 32|32@1- (1,0) [-2147483647|2147483647] "mm" Vector__XXX
 SG_ DeviceVolumeCapacity m137 : 32|32@1- (1,0) [0|2147483647] "ml" Vector__XXX
 SG_ DeviceMassCapacity m138 : 32|32@1- (1,0) [0|2147483647] "g" Vector__XXX
 SG_ DeviceCountCapacity m139 : 32|32@1- (1,0) [0|2147483647] "" Vector__XXX
 SG_ PercentageAppRateSetpoint m140 : 32|32@1- (1,0) [0|2147483647] "ppm" Vector__XXX
 SG_ WorkState m141 : 32|32@1- (1,0) [0|3] "" Vector__XXX
 SG_ SetpointTimeLatency m142 : 32|32@1- (1,0) [-2147483647|2147483647] "ms" Vector__XXX
 SG_ ActualValueTimeLatency m143 : 32|32@1- (1,0) [-2147483647|2147483647] "ms" Vector__XXX
 SG_ YawAngle m144 : 32|32@1- (0.001,0) [-180|180] "°" Vector__XXX
 SG_ RollAngle m145 : 32|32@1- (0.001,0) [-180|180] "°" Vector__XXX
 SG_ PitchAngle m146 : 32|32@1- (0.001,0) [-180|180] "°" Vector__XXX
 SG_ LogCount m147 : 32|32@1- (1,0) [0|2147483647] "" Vector__XXX
 SG_ TotalFuelConsumption m148 : 32|32@1- (1,0) [0|2147483647] "ml" Vector__XXX
 SG_ FuelConsumptionPerTime m149 : 32|32@1- (1,0) [0|2147483647] "mm³/s" Vector__XXX
 SG_ FuelConsumptionPerArea m150 : 32|32@1- (1,0) [0|2147483647] "mm³/ m²" Vector__XXX
 SG_ AreaPerTimeCapacity m151 : 32|32@1- (1,0) [0|2147483647] "mm²/s" Vector__XXX
 SG_ MinMassPerAreaAppRate m152 : 32|32@1- (0.01,0) [0|2147480000] "mm³/m³" Vector__XXX
 SG_ NDVI m153 : 32|32@1- (1,0) [-1|1] "" Vector__XXX
 SG_ PhysicalObjectLength m154 : 32|32@1- (1,0) [0|2147483647] "mm" Vector__XXX
 SG_ PhysicalObjectWidth m155 : 32|32@1- (1,0) [0|2147483647] "mm" Vector__XXX
 SG_ PhysicalObjectHeight m156 : 32|32@1- (1,0) [0|2147483647] "mm" Vector__XXX
 SG_ ConnectorType m157 : 32|32@1- (1,0) [0|7] "" Vector__XXX
 SG_ PrescriptionControlState m158 : 32|32@1- (1,0) [0|3] "" Vector__XXX
 SG_ NumberOfSubUnitsPerSection m159 : 32|32@1- (1,0) [0|2147483647] "Amount/Count" Vector__XXX
 SG_ SectionControlState m160 : 32|32@1- (1,0) [0|3] "" Vector__XXX
 SG_ CondensedWorkState1to16 m161 : 32|32@1- (1,0) [-2147483648|2147483647] "" Vector__XXX
 SG_ CondensedWorkState17to32 m162 : 32|32@1- (1,0) [-2147483648|2147483647] "" Vector__XXX
 SG_ CondensedWorkState33to48 m163 : 32|32@1- (1,0) [-2147483648|2147483647] "" Vector__XXX
 SG_ PeerControlCommand m9M : 32|4@1+ (1,0) [0|5] "" Vector__XXX
 SG_ DDI m2M : 16|16@1+ (1,0) [0|65535] "" Vector__XXX
 SG_ TechnicalDataMsgType m0M : 4|4@1+ (1,0) [0|15] "" Vector__XXX
 SG_ DeviceDescriptionMsgType m1M : 4|4@1+ (1,0) [0|15] "" Vector__XXX
 SG_ Command M : 0|4@1+ (1,0) [0|15] "" Vector__XXX

CM_ BU_ GNSSReceiver "GNSS Receiver";
CM_ BU_ VT "Virtual Terminal";
CM_ BU_ TECU "Tractor ECU";
CM_ BU_ TC "Task Controller";
CM_ BU_ Sprayer "Sprayer Implement";
CM_ BO_ 3221225472 "This is a message for not used signals, created by Vector CANdb++ DBC OLE DB Provider.";
CM_ SG_ 3221225472 ClientAuthenticationSubStatus "Sub-status of message Auth_ClientAuthenticationStatus (not mapped to AUTH21 because signals for every bit are used)";
CM_ SG_ 3221225472 ServerAuthenticationSubStatus "Sub-status of message Auth_ServerAuthenticationStatus (not mapped to AUTH12 because signals for every bit are used)";
CM_ BO_ 2362179319 "The Process Data message is used for the transmission of device description data, 
measured data and or set point commands to one or more controllers.";
CM_ SG_ 2362179319 ActualCanopyHeight "Actual height of the canopy above ground.";
CM_ SG_ 2362179319 GNSSInstallationType "Provide additional information about the type and location of the GPS receiver 
with reference to the overall system.";
CM_ SG_ 2362179319 LastBaleLifetimeCount "The Lifetime Bale Count of the bale that leaves the machine.
The value shall be equal to the Lifetime Bale Count that was reported
when this bale is knotted.";
CM_ SG_ 2362179319 ActualTramlineCondensedWorkState "Combination of the Actual States of individual Tramline Valves number 1 to 16 
into a single Actual Tramline State of their parent DeviceElement.";
CM_ SG_ 2362179319 SetpointTramlineCondensedWorkSta "Combination of the Setpoint Tramline Valve Work States 
of individual Tramline Valves number 1 to 16 
into a single Setpoint Tramline Condensed Work State of their parent DeviceElement.";
CM_ SG_ 2362179319 TramlineOverdosingRate "Overdosing Rate for the rows adjacent to the Tramline Track.";
CM_ SG_ 2362179319 TramlineControlState "Specifies the actual state of Tramline Control.";
CM_ SG_ 2362179319 GNSSQuality "GNSS Quality Identifier to inform the implement about the used Position Status.";
CM_ SG_ 2362179319 GuidanceLineDeviation "Deviation of the Device-Reference-Point (DRP) to the actual
guidance line, in driving direction.";
CM_ SG_ 2362179319 GuidanceLineSwathWidth "The Swath Width is the Distance between two adjacent Guidance 
Lines in a Guidance Pattern.";
CM_ SG_ 2362179319 TrackNumberToLeft "This DDI defines a unique number of the Guidance Track to left
hand side in direction of Implement orientation.";
CM_ SG_ 2362179319 TrackNumberToRight "This DDI defines a unique number of the Guidance Track to right
hand side in direction of Implement orientation.";
CM_ SG_ 2362179319 ActualTrackNumber "This DDI defines a unique number of the Guidance Track the
Implement is currently located on.";
CM_ SG_ 2362179319 UniqueABGuidanceReferenceLineID "This DDI defines a unique ID to identify which Guidance Reference
Line is the base for the Tramline calculation.";
CM_ SG_ 2362179319 TramlineSequenceNumber "This DDI defines a group of DDIs which belong together.";
CM_ SG_ 2362179319 SetpointTramlineControlLevel "This DDI defines the Tramline Control capability of the Task
Controller that is used with the appropriate Implement.";
CM_ SG_ 2362179319 TramlineControlLevel "This DDI defines the Tramline Control capability of the Implement.";
CM_ SG_ 2362179319 MaxEngineTorque "The maximum value of the engine torque.";
CM_ SG_ 2362179319 MinEngineTorque "The minimum value of the engine torque.";
CM_ SG_ 2362179319 ActualEngineTorque "The current torque of the engine.";
CM_ SG_ 2362179319 SetpointEngineTorque "The setpoint of the engine torque.";
CM_ SG_ 2362179319 LastEventPartnerIDDeviceClass "This DDI should tell the Device Class of the “Partner” Device.";
CM_ SG_ 2362179319 LastEventPartnerIDManufacturerID "The Partner ID has to tell its Manufacturer, and the Manufacturer
Numbers from SAE J1939 / ISO 11783 shall be used. ";
CM_ SG_ 2362179319 LastEventPartnerIdType "Defines The Type of the Partner ID Device.";
CM_ SG_ 2362179319 LastEventPartnerID_Byte13to16 "Last Event Partner ID as a decimal number of 128bit length.
This DDI should include the Byte 13-16 of the Last Event Partner ID. ";
CM_ SG_ 2362179319 LastEventPartnerID_Byte9to12 "Last Event Partner ID as a decimal number of 128bit length.
This DDI should include the Byte 9-12 of the Last Event Partner ID. ";
CM_ SG_ 2362179319 LastEventPartnerID_Byte5to8 "Last Event Partner ID as a decimal number of 128bit length.
This DDI should include the Byte 5-8 of the Last Event Partner ID. ";
CM_ SG_ 2362179319 LastEventPartnerID_Byte1to4 "Last Event Partner ID as a decimal number of 128bit length.
This DDI should include the Byte 1-4 of the Last Event Partner ID. ";
CM_ SG_ 2362179319 LifetimeEngineHours "The total time, when the engine was running over the whole lifetime of the machine.";
CM_ SG_ 2362179319 TotalEngineHours "The total time the engine was running when the task was active.";
CM_ SG_ 2362179319 FuelPercentageLevel "The actual level of the machine fuel tank in percent.";
CM_ SG_ 2362179319 MaxFuelTankContent "This value describes the maximum ammount of fuel that can be filled into the machines Fuel tank. ";
CM_ SG_ 2362179319 MaxDieselExhaustFluidTankContent "This value describes the maximum ammount of Diesel Exhaust fluid,
that can be filled into the tank of the machine";
CM_ SG_ 2362179319 DieselExhaustFluidTankPercentage "The actual level of the Diesel Exhaust Fluid Tank in percent.";
CM_ SG_ 2362179319 MaxEngineSpeed "The maximum of the rotational speed of the engine.";
CM_ SG_ 2362179319 MinEngineSpeed "The minimum of the rotational speed of the engine.";
CM_ SG_ 2362179319 ActualEngineSpeed "Actual rotational speed of the engine.";
CM_ SG_ 2362179319 SetpointEngineSpeed "The setpoint of the rotational speed of the engine.";
CM_ SG_ 2362179319 LastBaleNumberOfSubbales "Number of smaller bales included in the latest produced bale.";
CM_ SG_ 2362179319 SetpointNumberOfSubbales "Number of smaller bales that shall be included in one bigger bale.";
CM_ SG_ 2362179319 MaxFlakeSize "Maximum size of the flake that can be produced by the chamber.";
CM_ SG_ 2362179319 MinFlakeSize "Minimum size of the flake that can be produced by the chamber.";
CM_ SG_ 2362179319 SetpointFlakeSize "Setpoint size of the flake to be produced by the chamber.";
CM_ SG_ 2362179319 MaxBaleHydraulicPressure "The maximum value of the hydraulic pressure applied to the sides of
the bale in the bale compression chamber.";
CM_ SG_ 2362179319 MinBaleHydraulicPressure "The minimum value of the hydraulic pressure applied to the sides of
the bale in the bale compression chamber.";
CM_ SG_ 2362179319 SetpointBaleHydraulicPressure "The setpoint value of the hydraulic pressure applied to the sides of
the bale in the bale compression chamber.";
CM_ SG_ 2362179319 MaxLengthOfCut "Maximum length of cut for harvested material, e.g. Forage Harvester or Tree Harvester.";
CM_ SG_ 2362179319 MinLengthOfCut "Minimum length of cut for harvested material, e.g. Forage Harvester or Tree Harvester.";
CM_ SG_ 2362179319 SetpointLengthOfCut "Setpoint length of cut for harvested material, e.g. Forage Harvester or Tree Harvester.";
CM_ SG_ 2362179319 ActualPercentageContent "Actual Device Element Content specified as percent.";
CM_ SG_ 2362179319 ActualRelativeConnectorAngle "The value describes the actual angle of the longitudinal axis of the
implement relative to the longitudinal axis of the tractor.";
CM_ SG_ 2362179319 LifetimeHaulCounter "The number of haul cycles done by a machine over its entire lifetime.";
CM_ SG_ 2362179319 HaulCounter "Each Time a Device Element is filled and emptied this is called a haul cycle. 
This counter counts the cycles.";
CM_ SG_ 2362179319 LastUnloadedCount "Last unloaded Count value specified as count";
CM_ SG_ 2362179319 LastLoadedCount "Last loaded Count value specified as count";
CM_ SG_ 2362179319 LifetimeUnloadedTotalCount "Entire Unloaded Total Count of the device lifetime.";
CM_ SG_ 2362179319 LifetimeLoadedTotalCount "Entire Loaded Total Count of the device lifetime.";
CM_ SG_ 2362179319 UnloadedTotalCount "Accumulated Unloaded specified as count";
CM_ SG_ 2362179319 LoadedTotalCount "Accumulated Loads specified as count";
CM_ SG_ 2362179319 LastUnloadedVolume "Last unloaded Volume value specified as volume";
CM_ SG_ 2362179319 LastLoadedVolume "Last loaded Volume value specified as volume";
CM_ SG_ 2362179319 LifetimeUnloadedTotalVolume "Entire unloaded Volume of the device lifetime.";
CM_ SG_ 2362179319 LifetimeLoadedTotalVolume "Entire loaded Volume of the device lifetime.";
CM_ SG_ 2362179319 UnloadedTotalVolume "Accumulated Unloaded Volume specified as volume";
CM_ SG_ 2362179319 LoadedTotalVolume "Accumulated Loaded Volume specified as volume";
CM_ SG_ 2362179319 MaxAppRateOfDryMatter "Maximum application rate of dry matter expressed as percentage";
CM_ SG_ 2362179319 MinAppRateOfDryMatter "Minimum application rate of dry matter expressed as percentage";
CM_ SG_ 2362179319 ActualAppRateOfDryMatter "Actual application rate of dry matter expressed as percentage";
CM_ SG_ 2362179319 SetpointAppRateOfDryMatter "Setpoint application rate of dry matter expressed as percentage";
CM_ SG_ 2362179319 MaxAppRateOfPotassium "Maximum application rate of potassium specified as a mass per area";
CM_ SG_ 2362179319 MinAppRateOfPotassium "Minimum application rate of potassium specified as a mass per area";
CM_ SG_ 2362179319 ActualAppRateOfPotassium "Actual application rate of potassium specified as a mass per area";
CM_ SG_ 2362179319 SetpointAppRateOfPotassium "Setpoint application rate of potassium specified as a mass per area";
CM_ SG_ 2362179319 MaxAppRateOfPhosphor "Maximum application rate of phosphor specified as a mass per area";
CM_ SG_ 2362179319 MinAppRateOfPhosphor "Minimum application rate of phosphor specified as a mass per area";
CM_ SG_ 2362179319 ActualAppRateOfPhosphor "Actual application rate of phosphor specified as a mass per area";
CM_ SG_ 2362179319 SetpointAppRateOfPhosphor "Setpoint application rate of phosphor specified as a mass per area";
CM_ SG_ 2362179319 MaxAppRateOfAmmonium "Maximum application rate of Ammonium specified as a mass per area";
CM_ SG_ 2362179319 MinAppRateOfAmmonium "Minimum application rate of Ammonium specified as a mass per area";
CM_ SG_ 2362179319 ActualAppRateOfAmmonium "Actual application rate of Ammonium specified as a mass per area";
CM_ SG_ 2362179319 SetpointAppRateOfAmmonium "Setpoint application rate of Ammonium specified as a mass per area";
CM_ SG_ 2362179319 MaxAppRateOfNitrogen "Maximum application rate of nitrogen specified as a mass per area";
CM_ SG_ 2362179319 MinAppRateOfNitrogen "Minimum application rate of nitrogen specified as a mass per area";
CM_ SG_ 2362179319 ActualAppRateOfNitrogen "Actual application rate of nitrogen specified as a mass per area";
CM_ SG_ 2362179319 SetpointAppRateOfNitrogen "Setpoint application rate of nitrogen specified as a mass per area";
CM_ SG_ 2362179319 LifetimeUnloadedTotalMass "Entire Unloaded Total Mass of the device lifetime.";
CM_ SG_ 2362179319 LifetimeLoadedTotalMass "Entire Yield Total Mass of the device lifetime.";
CM_ SG_ 2362179319 UnloadedTotalMass "Accumulated Unloads specified as mass, not corrected for the
reference moisture percentage DDI 184";
CM_ SG_ 2362179319 LoadedTotalMass "Accumulated Loads specified as mass, not corrected for the
reference moisture percentage DDI 184.";
CM_ SG_ 2362179319 ActualDownforceAsForce "This value represents the actual downforce to produce the downforce
(or upforce) for an operation messured in newton.";
CM_ SG_ 2362179319 SetpointDownforceAsForce "This value represents the system pressure to produce the downforce
(or upforce) for an operation messured in newton;";
CM_ SG_ 2362179319 SetpointMaxAllowedSeedSpacingDev "Setpoint Maximum Allowed Seed Spacing Deviation";
CM_ SG_ 2362179319 AvgCoeffOfVariationOfSeedSpacing "Average Coefficient of Variation of Seed Spacing Percentage
calculated from measured seed spacing using ISO 7256-1 algorithm.
The value is the average for a Task.";
CM_ SG_ 2362179319 ActCoeffOfVariationOfSeedSpacing "Actual Coefficient of Variation of Seed Spacing Percentage
calculated from measured seed spacing using ISO 7256-1 algorithm";
CM_ SG_ 2362179319 AverageSeedSpacingDeviation_Copy "Average Seed Spacing Deviation from setpoint seed spacing.
The value is the average for a Task.";
CM_ SG_ 2362179319 ActualSeedSpacingDeviation "Actual Seed Spacing Deviation from setpoint seed spacing.";
CM_ SG_ 2362179319 AverageSeedMultiplePercentage "Average Seed Multiple Percentage calculated from measured seed
spacing using ISO 7256-1 'Multiples Index' algorithm. 
The value is the average for a Task.";
CM_ SG_ 2362179319 ActualSeedMultiplePercentage "Actual Seed Multiple Percentage calculated from measured seed
spacing using ISO 7256-1 'Multiples Index' algorithm.";
CM_ SG_ 2362179319 AverageSeedSkipPercentage "Average Seed Skip Percentage calculated from measured seed
spacing using ISO 7256-1 'Miss Index' algorithm. 
The value is the average for a Task.";
CM_ SG_ 2362179319 ActualSeedSkipPercentage "Actual Seed Skip Percentage calculated from measured seed 
spacing using ISO 7256-1 'Miss Index' algorithm";
CM_ SG_ 2362179319 AverageSeedSingulationPercentage "Average Seed Singulation Percentage calculated from measured
seed spacing using ISO 7256-1 'Quality of Feed Index' algorithm.
The value is the average for a Task.";
CM_ SG_ 2362179319 ActualSeedSingulationPercentage "Actual Seed Singulation Percentage calculated from measured seed
spacing using ISO 7256-1 'Quality of Feed Index' algorithm";
CM_ SG_ 2362179319 LifetimeAvgDieselExhFluidConsump "Average Diesel Exhaust Fluid Consumption per Area over the entire lifetime of the device.";
CM_ SG_ 2362179319 LifetimeAvgDieselExhFluidCo_0000 "Average Diesel Exhaust Fluid Consumption per Time over the entire lifetime of the device.";
CM_ SG_ 2362179319 LifetimeDieselExhaustFluidConsum "Accumulated Diesel Exhaust Fluid Consumption over the entire lifetime of the device.";
CM_ SG_ 2362179319 InstantDieselExhaustFluidConsump "Diesel Exhaust Fluid consumption per area.";
CM_ SG_ 2362179319 InstantDieselExhaustFluidCo_0000 "Diesel Exhaust Fluid consumption per time.";
CM_ SG_ 2362179319 TotalDieselExhaustFluidConsumpti "Accumulated Diesel Exhaust Fluid Consumption as a Task Total.";
CM_ SG_ 2362179319 AverageCropContamination "Average amount of dirt or foreign  in a harvested crop (Parts per million).";
CM_ SG_ 2362179319 AverageProteinContent "Average Protein content of a harvested crops (Parts per million).";
CM_ SG_ 2362179319 ActualProteinContent "Actual Protein content of a harvested crops (Parts per million).";
CM_ SG_ 2362179319 ActualApplicationOfDryMatter "Actual application of Dry Matter in kilogram [kg]. Dry matter measured at Zero percent of moisture.";
CM_ SG_ 2362179319 ActualApplicationOfPotassium "Actual application of Potassium [K2] specified as gram [g]";
CM_ SG_ 2362179319 ActualApplicationOfPhosphor "Actual application of Phosphor [P2O5] specified as milligram per liter [mg/l]";
CM_ SG_ 2362179319 ActualApplicationOfAmmonium "Actual application of Ammonium [NH4] specified as milligram per liter [mg/l]";
CM_ SG_ 2362179319 ActualApplicationOfNitrogen "Actual application of Nitrogen [N2] specified as milligram per liter [mg/l]";
CM_ SG_ 2362179319 SpeedSource "The Speed Source that the device uses to report actual speed and to
process the setpoint, minimum and maximum speeds.";
CM_ SG_ 2362179319 ActualDieselExhaustFluidTankCont "The actualcontent of the diesel exhaust fluid tank";
CM_ SG_ 2362179319 ActualFuelTankContent "The actual content of the fuel tank.
This value can be used to see the refilling of the fuel tank or the theft of fuel.";
CM_ SG_ 2362179319 MaximumRevolutionsPerTime "Maximum Revolutions specified as count per time";
CM_ SG_ 2362179319 MinimumRevolutionsPerTime "Minimum Revolutions specified as count per time";
CM_ SG_ 2362179319 DefaultRevolutionsPerTime "Default Revolutions specified as count per time";
CM_ SG_ 2362179319 ActualRevolutionsPerTime "Actual Revolutions specified as count per time";
CM_ SG_ 2362179319 SetpointRevolutionsAsCountPerTim "Setpoint Revolutions specified as count per time";
CM_ SG_ 2362179319 TotalRevolutionsInCompleteRevolu "Accumulated Revolutions specified as completed integer revolutions";
CM_ SG_ 2362179319 TotalRevolutionsInFractionalRevo "Accumulated Revolutions specified with fractional revolutions";
CM_ SG_ 2362179319 ActualAtmosphericPressure "The Actual Atmospheric Pressure is the air pressure currently measured by the weather station.";
CM_ SG_ 2362179319 MSLAtmosphericPressure "The atmospheric pressure MSL (Mean Sea Level) is the air pressure related to mean sea level.";
CM_ SG_ 2362179319 ApparentWindSpeed "The apparent wind is the wind which is measured on a moving vehicle.
It is the result of two motions: the actual true wind and the motion of the vehicle.";
CM_ SG_ 2362179319 ApparentWindDirection "The apparent wind is the wind which is measured on a moving vehicle. 
It is the result of two motions: the actual true wind and the motion of the vehicle. ";
CM_ SG_ 2362179319 CondensedSectionOverrideState241 "Each child device elements override state is represented by 2 bits and defined as:
00 = section is not overridden,
01 = section is overridden,
10 = reserved,
11 = undefined / not installed.";
CM_ SG_ 2362179319 CondensedSectionOverrideState225 "Each child device elements override state is represented by 2 bits and defined as:
00 = section is not overridden,
01 = section is overridden,
10 = reserved,
11 = undefined / not installed.";
CM_ SG_ 2362179319 CondensedSectionOverrideState209 "Each child device elements override state is represented by 2 bits and defined as:
00 = section is not overridden,
01 = section is overridden,
10 = reserved,
11 = undefined / not installed.";
CM_ SG_ 2362179319 CondensedSectionOverrideState193 "Each child device elements override state is represented by 2 bits and defined as:
00 = section is not overridden,
01 = section is overridden,
10 = reserved,
11 = undefined / not installed.";
CM_ SG_ 2362179319 CondensedSectionOverrideState177 "Each child device elements override state is represented by 2 bits and defined as:
00 = section is not overridden,
01 = section is overridden,
10 = reserved,
11 = undefined / not installed.";
CM_ SG_ 2362179319 CondensedSectionOverrideState161 "Each child device elements override state is represented by 2 bits and defined as:
00 = section is not overridden,
01 = section is overridden,
10 = reserved,
11 = undefined / not installed.";
CM_ SG_ 2362179319 CondensedSectionOverrideState145 "Each child device elements override state is represented by 2 bits and defined as:
00 = section is not overridden,
01 = section is overridden,
10 = reserved,
11 = undefined / not installed.";
CM_ SG_ 2362179319 CondensedSectionOverrideState129 "Each child device elements override state is represented by 2 bits and defined as:
00 = section is not overridden,
01 = section is overridden,
10 = reserved,
11 = undefined / not installed.";
CM_ SG_ 2362179319 CondensedSectionOverrideState113 "Each child device elements override state is represented by 2 bits and defined as:
00 = section is not overridden,
01 = section is overridden,
10 = reserved,
11 = undefined / not installed.";
CM_ SG_ 2362179319 CondensedSectionOverrideState97t "Each child device elements override state is represented by 2 bits and defined as:
00 = section is not overridden,
01 = section is overridden,
10 = reserved,
11 = undefined / not installed.";
CM_ SG_ 2362179319 CondensedSectionOverrideState81t "Each child device elements override state is represented by 2 bits and defined as:
00 = section is not overridden,
01 = section is overridden,
10 = reserved,
11 = undefined / not installed.";
CM_ SG_ 2362179319 CondensedSectionOverrideState65t "Each child device elements override state is represented by 2 bits and defined as:
00 = section is not overridden,
01 = section is overridden,
10 = reserved,
11 = undefined / not installed.";
CM_ SG_ 2362179319 CondensedSectionOverrideState49t "Each child device elements override state is represented by 2 bits and defined as:
00 = section is not overridden,
01 = section is overridden,
10 = reserved,
11 = undefined / not installed.";
CM_ SG_ 2362179319 CondensedSectionOverrideState33t "Each child device elements override state is represented by 2 bits and defined as:
00 = section is not overridden,
01 = section is overridden,
10 = reserved,
11 = undefined / not installed.";
CM_ SG_ 2362179319 CondensedSectionOverrideState17t "Each child device elements override state is represented by 2 bits and defined as:
00 = section is not overridden,
01 = section is overridden,
10 = reserved,
11 = undefined / not installed.";
CM_ SG_ 2362179319 CondensedSectionOverrideState01t "Each child device elements override state is represented by 2 bits and defined as:
00 = section is not overridden,
01 = section is overridden,
10 = reserved,
11 = undefined / not installed.";
CM_ SG_ 2362179319 ActualDownforcePressure "This value represents the actual system pressure to produce the
downforce (or upforce) for an operation messured in Pa (Pascal);
In case of an negative value the system pressure would  produce Upforce.";
CM_ SG_ 2362179319 SetpointDownforcePressure "This value represents the system pressure to produce the downforce
(or upforce) for an operation messured in Pa (Pascal);
In case of an negative value the system pressure would  produce Upforce.";
CM_ SG_ 2362179319 ActualFlakeSize "Actual size of the flake that is currently produced by the chamber.";
CM_ SG_ 2362179319 LastBaleDryMass "The dry mass of the bale that has most recently been produced.
This is the bale mass corrected for the average moisture of this bale (DDI 212).";
CM_ SG_ 2362179319 TotalBaleLength "Gives the total baled meters during a task.
This is calculated as the sum of the lengths of all knotted bales (square baler).";
CM_ SG_ 2362179319 LastBaleDensity "The bale density of the most recently produced bale.";
CM_ SG_ 2362179319 LastBaleSize "The bale size of the most recently produced bale.
Bale Size as length for a square baler or diameter for a round baler.";
CM_ SG_ 2362179319 AverageDryYieldMassPerArea "Average Yield expressed as mass per unit area, corrected for the reference moisture percentage DDI 184.
This value is the average for a Task and may be reported as a total.";
CM_ SG_ 2362179319 AverageDryYieldMassPerTime "Average Yield expressed as mass per unit time, corrected for the reference moisture percentage DDI 184.
This value is the average for a Task and may be reported as a total.";
CM_ SG_ 2362179319 TotalApplicationOfDryMatter "Accumulated application of dry matter  in kilogram [kg]. 
Dry matter measured at zero percent of moisture].
This total is a counter of a device element";
CM_ SG_ 2362179319 TotalApplicationOfPotassium "Accumulated application of potassium (K2) specified as gram [g].
This total is a counter of a device element";
CM_ SG_ 2362179319 TotalApplicationOfPhosphor "Accumulated application of phosphor (P2O5) specified as gram [g].
This total is a counter of a device element";
CM_ SG_ 2362179319 TotalApplicationOfAmmonium "Accumulated application of ammonium [NH4]  specified as gram [g].
This total is a counter of a device element";
CM_ SG_ 2362179319 TotalApplicationofNitrogen "Accumulated application of nitrogen [N2] specified as gram [g].
This total is a counter of a device element";
CM_ SG_ 2362179319 ApplicationTotalMass "Accumulated Application specified as mass in gram [g]
.
Comment: is a counter of a device elemen.";
CM_ SG_ 2362179319 ApplicationTotalVolume "Accumulated Application specified as volume in milliliter [ml]
.
Comment: is a counter of a device element.";
CM_ SG_ 2362179319 FunctionType "The Function Type DDE can be used to define the operation or functionality performed 
by the device element of type Function defined within the DDOP. 
The values to be used are defined in the attached document.";
CM_ SG_ 2362179319 NozzleDriftReduction "The Nozzle Drift Reduction classification value of the spraying equipment as percentage.";
CM_ SG_ 2362179319 MaximumSwathingWidth "This is the maximum with of the swath the raker can create.";
CM_ SG_ 2362179319 MinimumSwathingWidth "This is the minimum swath width the raker can create.";
CM_ SG_ 2362179319 ActualSwathingWidth "This is the width of the swath currently created by a raker.";
CM_ SG_ 2362179319 SetpointSwathingWidth "This is the setpoint swathing width of the swath created by a raker.";
CM_ SG_ 2362179319 MaximumGrainKernelCrackerGap "The maximum gap (distance) of the grain kernel cracker drums in a chopper.";
CM_ SG_ 2362179319 MinimumGrainKernelCrackerGap "The minimum gap (distance) of the grain kernel cracker drums in a chopper.";
CM_ SG_ 2362179319 ActualGrainKernelCrackerGap "The actual gap (distance) of the grain kernel cracker drums in a chopper";
CM_ SG_ 2362179319 SetpointGrainKernelCrackerGap "The setpoint gap (distance) of the grain kernel cracker drums in a chopper.";
CM_ SG_ 2362179319 EffectiveUnloadingTime "The total time needed in the current task to unload a product crop.";
CM_ SG_ 2362179319 EffectiveLoadingTime "The total time needed in the current task to load a product such as crop.";
CM_ SG_ 2362179319 LiftimeRearPTOHours "The hours the Rear PTO of the machine was running for the lifetime of the machine";
CM_ SG_ 2362179319 LifetimeFrontPTOHours "The hours the Front PTO of the machine was running for the lifetime of the machine.";
CM_ SG_ 2362179319 RearPTOHours "The hours the Rear PTO of the machine was running for the current Task";
CM_ SG_ 2362179319 FrontPTOHours "The hours the Front PTO of the machine was running for the current Task";
CM_ SG_ 2362179319 OperatingHoursSinceLastSharpenin "This value describes the working hours since the last sharpening of the cutting device.";
CM_ SG_ 2362179319 MaximumCuttingDrumSpeed "The maximum speed of the cutting drum of a chopper.

Comment: This is a value recommented by the manufacturer of the machine as the maximum speed the machine is able to offer.";
CM_ SG_ 2362179319 ActualCuttingDrumSpeed "The actual speed of the cutting drum of a chopper";
CM_ SG_ 2362179319 SetpointCuttingDrumSpeed "The setpoint speed of the cutting drum of a chopper.";
CM_ SG_ 2362179319 MaximumHeaderSpeed "The maximum rotational speed of the header attachment of a chopper, mower or combine.

Comment: 
This is a value recommented by the manufacturer of the machine as the maximum speed the machine is able to offer";
CM_ SG_ 2362179319 MinimumHeaderSpeed "The minimum rotational speed of the header attachment of a chopper, mower or combine";
CM_ SG_ 2362179319 ActualHeaderSpeed "The actual rotational speed of the header attachment of a chopper, mower or combine";
CM_ SG_ 2362179319 SetpointHeaderSpeed "The setpoint rotational speed of the header attachment of a chopper, mower or combine";
CM_ SG_ 2362179319 NumberOfSection "Number of sections across all booms for section control";
CM_ SG_ 2362179319 NumberOfBooms "Number of booms for section control";
CM_ SG_ 2362179319 OriginCommand "Process Data Command that this PDACK message is transmitted for";
CM_ SG_ 2362179319 DestinationElementNumber "Device Element Number";
CM_ SG_ 2362179319 DataLogTimeInterval "Time interval for data log in ms, 0 stops measurement, 100 ms is minimum time interval.";
CM_ SG_ 2362179319 DataLogDistanceInterval "Distance interval for data log in mm, 0 stops measurement.";
CM_ SG_ 2362179319 AppRateVolumePerArea_Set "Setpoint Application Rate specified as volume per area";
CM_ SG_ 2362179319 AppRateVolumePerArea_Act "Actual Application Rate specified as volume per area";
CM_ SG_ 2362179319 AppRateVolumePerArea_Def "Default Application Rate specified as volume per area";
CM_ SG_ 2362179319 AppRateVolumePerArea_Min "Minimum Application Rate specified as volume per area";
CM_ SG_ 2362179319 AppRateVolumePerArea_Max "Maximum Application Rate specified as volume per area";
CM_ SG_ 2362179319 AppRateMassPerArea_Set "Setpoint Application Rate specified as mass per area";
CM_ SG_ 2362179319 AppRateMassPerArea_Act "Actual Application Rate specified as mass per area";
CM_ SG_ 2362179319 AppRateMassPerArea_Def "Default Application Rate specified as mass per area";
CM_ SG_ 2362179319 AppRateMassPerArea_Min "Minimum Application Rate specified as mass per area";
CM_ SG_ 2362179319 AppRateMassPerArea_Max "Maximum Application Rate specified as mass per area";
CM_ SG_ 2362179319 AppRateCountPerArea_Set "Setpoint Application Rate specified as count per area";
CM_ SG_ 2362179319 AppRateCountPerArea_Act "Actual Application Rate specified as count per area";
CM_ SG_ 2362179319 AppRateCountPerArea_Def "Default Application Rate specified as count per area";
CM_ SG_ 2362179319 AppRateCountPerArea_Min "Minimum Application Rate specified as count per area";
CM_ SG_ 2362179319 AppRateCountPerArea_Max "Maximum Application Rate specified as count per area";
CM_ SG_ 2362179319 SetAppRateDistance_Set "Setpoint Application Rate specified as distance";
CM_ SG_ 2362179319 AppRateDistance_Act "Actual Application Rate specified as distance";
CM_ SG_ 2362179319 AppRateDistance_Def "Default Application Rate specified as distance";
CM_ SG_ 2362179319 AppRateDistance_Min "Minimum Application Rate specified as distance";
CM_ SG_ 2362179319 AppRateDistance_Max "Maximum Application Rate specified as distance";
CM_ SG_ 2362179319 AppRateVolumePerVolume_Set "Setpoint Application Rate specified as volume per volume";
CM_ SG_ 2362179319 AppRateVolumePerVolume_Act "Actual Application Rate specified as volume per volume";
CM_ SG_ 2362179319 AppRateVolumePerVolume_Def "Default Application Rate specified as volume per volume";
CM_ SG_ 2362179319 AppRateVolumePerVolume_Min "Minimum Application Rate specified as volume per volume";
CM_ SG_ 2362179319 AppRateVolumePerVolume_Max "Maximum Application Rate specified as volume per volume";
CM_ SG_ 2362179319 AppRateMassPerMass_Set "Setpoint Application Rate specified as mass per mass";
CM_ SG_ 2362179319 AppRateMassPerMass_Act "Actual Application Rate specified as mass per mass";
CM_ SG_ 2362179319 AppRateMassPerMass_Def "Default Application Rate specified as mass per mass";
CM_ SG_ 2362179319 AppRateMassPerMass_Min "Minimum Application Rate specified as mass per mass";
CM_ SG_ 2362179319 AppRateMassPerMass_Max "Maximum Application Rate specified as mass per mass";
CM_ SG_ 2362179319 AppRateVolumePerMass_Set "Setpoint Application Rate specified as volume per mass";
CM_ SG_ 2362179319 AppRateVolumePerMass_Act "Actual Application Rate specified as volume per mass";
CM_ SG_ 2362179319 AppRateVolumePerMass_Def "Default Application Rate specified as volume per mass";
CM_ SG_ 2362179319 AppRateVolumePerMass_Min "Minimum Application Rate specified as volume per mass";
CM_ SG_ 2362179319 AppRateVolumePerMass_Max "Maximum Application Rate specified as volume per mass";
CM_ SG_ 2362179319 AppRateVolumePerTime_Set "Setpoint Application Rate specified as volume per time";
CM_ SG_ 2362179319 AppRateVolumePerTime_Act "Actual Application Rate specified as volume per time";
CM_ SG_ 2362179319 AppRateVolumePerTime_Def "Default Application Rate specified as volume per time";
CM_ SG_ 2362179319 AppRateVolumePerTime_Min "Minimum Application Rate specified as volume per time";
CM_ SG_ 2362179319 AppRateVolumePerTime_Max "Maximum Application Rate specified as volume per time";
CM_ SG_ 2362179319 AppRateMassPerTime_Set "Setpoint Application Rate specified as mass per time";
CM_ SG_ 2362179319 AppRateMassPerTime_Act "Actual Application Rate specified as mass per time";
CM_ SG_ 2362179319 AppRateMassPerTime_Def "Defaut Application Rate specified as mass per time";
CM_ SG_ 2362179319 AppRateMassPerTime_Min "Minimum Application Rate specified as mass per time";
CM_ SG_ 2362179319 AppRateMassPerTime_Max "Maximum Application Rate specified as mass per time";
CM_ SG_ 2362179319 AppRateCountPerTime_Set "Setpoint Application Rate specified as count per time";
CM_ SG_ 2362179319 AppRateCountPerTime_Act "Actual Application Rate specified as count per time";
CM_ SG_ 2362179319 AppRateCountPerTime_Def "Default Application Rate specified as count per time";
CM_ SG_ 2362179319 AppRateCountPerTime_Min "Minimum Application Rate specified as count per time";
CM_ SG_ 2362179319 AppRateCountPerTime_Max "Maximum Application Rate specified as count per time";
CM_ SG_ 2362179319 SetTillageDepth_Set "Setpoint Tillage Depth of Machine Element below soil surface, value increases with depth";
CM_ SG_ 2362179319 TillageDepth_Act "Actual Tillage Depth of Machine Element below soil surface, value increases with depth";
CM_ SG_ 2362179319 TillageDepth_Def "Default Tillage Depth of Machine Element below soil surface, value increases with depth";
CM_ SG_ 2362179319 TillageDepth_Min "Minimum Tillage Depth of Machine Element below soil surface, value increases with depth";
CM_ SG_ 2362179319 TillageDepth_Max "Maximum Tillage Depth of Machine Element below soil surface, value increases with depth";
CM_ SG_ 2362179319 SeedingDeph_Set "Setpoint Seeding Depth of Machine Element below soil surface, value increases with depth";
CM_ SG_ 2362179319 SeedingDeph_Act "Setpoint Seeding Depth of Machine Element below soil surface, value increases with depth";
CM_ SG_ 2362179319 SeedingDeph_Def "Setpoint Seeding Depth of Machine Element below soil surface, value increases with depth";
CM_ SG_ 2362179319 SeedingDeph_Min "Setpoint Seeding Depth of Machine Element below soil surface, value increases with depth";
CM_ SG_ 2362179319 SeedingDeph_Max "Setpoint Seeding Depth of Machine Element below soil surface, value increases with depth";
CM_ SG_ 2362179319 WorkingHeight_Set "Setpoint Working Height of Machine Element above crop or soil";
CM_ SG_ 2362179319 WorkingHeight_Act "Actual Working Height of Machine Element above crop or soil";
CM_ SG_ 2362179319 WorkingHeight_Def "Default Working Height of Machine Element above crop or soil";
CM_ SG_ 2362179319 WorkingHeight_Min "Minimum Working Height of Machine Element above crop or soil";
CM_ SG_ 2362179319 WorkingHeight_Max "Maximum Working Height of Machine Element above crop or soil";
CM_ SG_ 2362179319 WorkingWidth_Set "Setpoint Working Width of Machine Element";
CM_ SG_ 2362179319 WorkingWidth_Act "Actual Working Width of Machine Element";
CM_ SG_ 2362179319 WorkingWidth_Def "Default Working Width of Machine Element";
CM_ SG_ 2362179319 WorkingWidth_Min "Minimum Working Width of Machine Element";
CM_ SG_ 2362179319 WorkingWidth_Max "Maximum Working Width of Machine Element";
CM_ SG_ 2362179319 ContentAsVolume_Set "Setpoint Machine Element Content specified as volume";
CM_ SG_ 2362179319 ContentAsVolume_Act "Actual Machine Element Content specified as volume";
CM_ SG_ 2362179319 ContentAsVolume_Max "Maximum Machine Element Content specified as volume";
CM_ SG_ 2362179319 ContentAsMass_Set "Setpoint Machine Element Content specified as mass";
CM_ SG_ 2362179319 ContentAsMass_Act "Actual Machine Element Content specified as mass";
CM_ SG_ 2362179319 ContentAsMass_Max "Maximum Machine Element Content specified as mass";
CM_ SG_ 2362179319 ContentAsCount_Set "Setpoint Machine Element Content specified as count";
CM_ SG_ 2362179319 ContentAsCount_Act "Actual Machine Element Content specified as count";
CM_ SG_ 2362179319 ContentAsCount_Max "Maximum Machine Element Content specified as count";
CM_ SG_ 2362179319 AccumulatedAppAsVolume "Accumulated Application specified as volume";
CM_ SG_ 2362179319 AccumulatedAppAsMass "Accumulated Application specified as mass";
CM_ SG_ 2362179319 AccumulatedAppAsCount "Accumulated Application specified as count";
CM_ SG_ 2362179319 YieldVolumePerArea "Yield as volume per area";
CM_ SG_ 2362179319 YieldMassPerArea "Yield as mass per area";
CM_ SG_ 2362179319 YieldCountPerArea "Yield as count per area";
CM_ SG_ 2362179319 YieldVolumePerTime "Yield as volume per time";
CM_ SG_ 2362179319 YieldMassPerTime "Yield as mass per time";
CM_ SG_ 2362179319 YieldCountPerTime "Yield as count per time";
CM_ SG_ 2362179319 AccumulatedYieldAsVolume "Accumulated Yield specified as volume";
CM_ SG_ 2362179319 AccumulatedYieldAsMass "Accumulated Yield specified as mass";
CM_ SG_ 2362179319 AccumulatedYieldAsCount "Accumulated Yield specified as count";
CM_ SG_ 2362179319 CropYieldLossVolumePerArea "Crop yield loss as volume per area";
CM_ SG_ 2362179319 CropYieldLossMassPerArea "Crop yield loss as mass per area";
CM_ SG_ 2362179319 CropYieldLossCountPerArea "Crop yield loss as count per area";
CM_ SG_ 2362179319 CropYieldLossVolumePerTime "Crop yield loss as volume per time";
CM_ SG_ 2362179319 CropYieldLossMassPerTime "Crop yield loss as mass per time";
CM_ SG_ 2362179319 CropYieldLossCountPerTime "Crop yield loss as count per time";
CM_ SG_ 2362179319 CropYieldLoss "Crop yield loss";
CM_ SG_ 2362179319 MoistureInCropYield "Moisture in crop yield";
CM_ SG_ 2362179319 DirtMaterialInCropYield "Dirt or foreign material in crop yield";
CM_ SG_ 2362179319 BaleWidth_Set "Setpoint Bale Width for square baler or round baler";
CM_ SG_ 2362179319 BaleWidth_Act "Actual Bale Width for square baler or round baler";
CM_ SG_ 2362179319 BaleWidth_Def "Default Bale Width for square baler or round baler";
CM_ SG_ 2362179319 BaleWidth_Min "Minimum Bale Width for square baler or round baler";
CM_ SG_ 2362179319 BaleWidth_Max "Maximum Bale Width for square baler or round baler";
CM_ SG_ 2362179319 BaleHeight_Set "Setpoint Bale Height is only applicable to square baler";
CM_ SG_ 2362179319 BaleHeight_Act "Actual Bale Height is only applicable to square baler";
CM_ SG_ 2362179319 BaleHeight_Def "Default Bale Height is only applicable to square baler";
CM_ SG_ 2362179319 BaleHeight_Min "Minimum Bale Height is only applicable to square baler";
CM_ SG_ 2362179319 BaleHeight_Max "Maximum Bale Height is only applicable to square baler";
CM_ SG_ 2362179319 BaleSize_Set "Setpoint Bale Size as length for a square baler or diameter for a round baler";
CM_ SG_ 2362179319 BaleSize_Act "Actual Bale Size as length for a square baler or diameter for a round baler";
CM_ SG_ 2362179319 BaleSize_Def "Default Bale Size as length for a square baler or diameter for a round baler";
CM_ SG_ 2362179319 BaleSize_Min "Minimum Bale Size as length for a square baler or diameter for a round baler";
CM_ SG_ 2362179319 BaleSize_Max "Maximum Bale Size as length for a square baler or diameter for a round baler";
CM_ SG_ 2362179319 AccumulatedArea "Accumulated Area";
CM_ SG_ 2362179319 AccumulatedDistanceInWork "Accumulated Distance in working position";
CM_ SG_ 2362179319 AccumulatedDistanceOutWork "Accumulated Distance out of working position";
CM_ SG_ 2362179319 AccumulatedTimeInWork "Accumulated Time in working position";
CM_ SG_ 2362179319 AccumulatedTimeOutWork "Accumulated Time out of working position";
CM_ SG_ 2362179319 PrdoucDensityMassPerArea "Product Density as mass per volume";
CM_ SG_ 2362179319 PrdoucDensityMassPerCount "Product Density as mass per count";
CM_ SG_ 2362179319 PrdoucDensityVolumePerCount "Product Density as volume per count";
CM_ SG_ 2362179319 AuxiliaryValveScalingExtend "Factor to apply to AuxValveCommand PortFlowCommand.";
CM_ SG_ 2362179319 AuxiliaryValveScalingRetract "Factor to apply to AuxValveCommand PortFlowCommand.";
CM_ SG_ 2362179319 AuxiliaryRampExtendUp "The valve will apply a ramp to the Auxiliary ValveCommand
PortFlowCommand, to limit the acceleration or deceleration of flow.";
CM_ SG_ 2362179319 AuxiliaryValveRampExtendDown "The valve will apply a ramp to the Auxiliary ValveCommand
PortFlowCommand, to limit the acceleration or deceleration of flow.";
CM_ SG_ 2362179319 AuxiliaryValveRampRetractUp "The valve will apply a ramp to theAuxiliary ValveCommand
PortFlowCommand, to limit the acceleration or deceleration of flow.";
CM_ SG_ 2362179319 AuxiliaryValveRampRetractDown "The valve will apply a ramp to the Auxiliary ValveCommand
PortFlowCommand, to limit the acceleration or deceleration of flow.";
CM_ SG_ 2362179319 AuxiliaryValveFloatThreshold "Safety function. Current output of valve must be above threshold before
float command is allowed.";
CM_ SG_ 2362179319 AuxiliaryValveProgressivExtend "Define non-linear releationship between command and flow by 2nd
degree polynomium.";
CM_ SG_ 2362179319 AuxiliaryValveProgressivRetract "Define non-linear releationship between command and flow by 2nd
degree polynomium.";
CM_ SG_ 2362179319 AuxiliaryValveInvertPorts "Command valve to swap extend and retract ports, easier than redoing
plumbing on valve.";
CM_ SG_ 2362179319 DeviceElementOffsetX "X direction offset of a DeviceElement relative to a Device.";
CM_ SG_ 2362179319 DeviceElementOffsetY "Y direction offset of a DeviceElement relative to  Device.";
CM_ SG_ 2362179319 DeviceElementOffsetZ "Z direction offset of a DeviceElement relative to  Device.";
CM_ SG_ 2362179319 DeviceVolumeCapacity "DeviceElement Volume Capacity, dimension of a DeviceElement.";
CM_ SG_ 2362179319 DeviceMassCapacity "DeviceElement Mass Capacity, dimension of a DeviceElement.";
CM_ SG_ 2362179319 DeviceCountCapacity "DeviceElement Count Capacity, dimension of a DeviceElement";
CM_ SG_ 2362179319 PercentageAppRateSetpoint "Application Rate expressed as percentage";
CM_ SG_ 2362179319 SetpointTimeLatency "Temporal Latency valid for the setpoint values of a Device Element";
CM_ SG_ 2362179319 ActualValueTimeLatency "Temporal Latency valid for the actual value of a Device Element";
CM_ SG_ 2362179319 YawAngle "Pivot / Yaw Angle of a DeviceElement";
CM_ SG_ 2362179319 RollAngle "Roll Angle of a DeviceElement";
CM_ SG_ 2362179319 PitchAngle "Pitch Angle of a DeviceElement";
CM_ SG_ 2362179319 LogCount "Log Counter, may be used to control data log record generation on a
Task Controller";
CM_ SG_ 2362179319 TotalFuelConsumption "Accumulated Fuel Consumption as Counter";
CM_ SG_ 2362179319 FuelConsumptionPerTime "Fuel consumption per time";
CM_ SG_ 2362179319 FuelConsumptionPerArea "Fuel consumption per area";
CM_ SG_ 2362179319 AreaPerTimeCapacity "Area per time capacity";
CM_ SG_ 2362179319 MinMassPerAreaAppRate "Minimum Application Rate specified as mass per area";
CM_ SG_ 2362179319 NDVI "Actual Normalized Difference Vegetative Index (NDVI)";
CM_ SG_ 2362179319 PhysicalObjectLength "Length of device element (dimension along the X-axis)";
CM_ SG_ 2362179319 PhysicalObjectWidth "Width of device element (dimension along the Y-axis)";
CM_ SG_ 2362179319 PhysicalObjectHeight "Height of device element (dimension along the Z-axis)";
CM_ SG_ 2362179319 ConnectorType "Specification of the type of coupler.";
CM_ SG_ 2362179319 PrescriptionControlState "Defines and synchronise the actual state of the prescription system";
CM_ SG_ 2362179319 NumberOfSubUnitsPerSection "Specifies the number of sub-units for a section 
(e.g. number of nozzles per sprayer section 
or number of planter row units per metering device)";
CM_ SG_ 2362179319 SectionControlState "Specifies the actual state of section control";
CM_ SG_ 2362179319 CondensedWorkState1to16 "Combination of the work states of individual sections or units (e.g. nozzles) 
number 1 to 16 into a single work state of their parent device element";
CM_ SG_ 2362179319 CondensedWorkState17to32 "Combination of the work states of individual sections or units (e.g. nozzles) 
number 17 to 32 into a single work state of their parent device element";
CM_ SG_ 2362179319 CondensedWorkState33to48 "Combination of the work states of individual sections or units (e.g. nozzles) 
number 33 to 48 into a single work state of their parent device element";
BA_DEF_  "ISO11783_11_SpecVersion" STRING ;
BA_DEF_  "ISO11783_7_SpecVersion" STRING ;
BA_DEF_  "ISO11783_6_SpecVersion" STRING ;
BA_DEF_ SG_  "DDI" INT 0 65535;
BA_DEF_ BO_  "SingleFrame" INT 0 1;
BA_DEF_ BU_  "NodeLayerModules" STRING ;
BA_DEF_  "ProtocolType" STRING ;
BA_DEF_  "BusType" STRING ;
BA_DEF_  "ISO11783_TIM_SpecVersion" STRING ;
BA_DEF_ BU_  "NmStationAddress" INT 0 255;
BA_DEF_ BU_  "NmJ1939AAC" INT 0 1;
BA_DEF_ BU_  "NmJ1939IndustryGroup" INT 0 7;
BA_DEF_ BU_  "NmJ1939System" INT 0 127;
BA_DEF_ BU_  "NmJ1939SystemInstance" INT 0 15;
BA_DEF_ BU_  "NmJ1939Function" INT 0 255;
BA_DEF_ BU_  "NmJ1939FunctionInstance" INT 0 7;
BA_DEF_ BU_  "NmJ1939ECUInstance" INT 0 7;
BA_DEF_ BU_  "NmJ1939ManufacturerCode" INT 0 2047;
BA_DEF_ BU_  "NmJ1939IdentityNumber" INT 0 2097151;
BA_DEF_ BU_  "ECU" STRING ;
BA_DEF_ BO_  "VFrameFormat" ENUM  "StandardCAN","ExtendedCAN","reserved","J1939PG","vector_leerstring";
BA_DEF_ BO_  "GenMsgSendType" ENUM  "cyclic","NotUsed","IfActive","NotUsed","NotUsed","NotUsed","NotUsed","NotUsed","noMsgSendType","vector_leerstring";
BA_DEF_ BO_  "GenMsgCycleTime" INT 0 3600000;
BA_DEF_ BO_  "GenMsgRequestable" INT 0 1;
BA_DEF_ BO_  "GenMsgCycleTimeFast" INT 0 3600000;
BA_DEF_ BO_  "GenMsgILSupport" ENUM  "No","Yes";
BA_DEF_ SG_  "SPN" INT 0 524287;
BA_DEF_  "DatabaseVersion" STRING ;
BA_DEF_ SG_  "GenSigSendType" ENUM  "Cyclic","OnWrite","OnWriteWithRepetition","OnChange","OnChangeWithRepetition","IfActive","IfActiveWithRepetition","NoSigSendType";
BA_DEF_ SG_  "SigType" ENUM  "Default","Range","RangeSigned","ASCII","Discrete","Control","ReferencePGN","DTC","StringDelimiter","StringLength","StringLengthControl","MessageCounter","MessageChecksum";
BA_DEF_  "ISO11783_12_SpecVersion" STRING ;
BA_DEF_  "ISO11783_13_SpecVersion" STRING ;
BA_DEF_ SG_  "GenSigStartValue" INT -2147483648 2147483647;
BA_DEF_ BU_  "ISO11783IOPFilename" STRING ;
BA_DEF_ BU_  "ISO11783IOPVersion" ENUM  "0","1","2","3","4","5","6";
BA_DEF_ BU_  "ISO11783PDDFilename" STRING ;
BA_DEF_ BU_  "ISO11783PDDVersion" ENUM  "0","1","2","3";
BA_DEF_ SG_  "GenSigILSupport" ENUM  "No","Yes";
BA_DEF_ SG_  "SystemSignalLongSymbol" STRING ;
BA_DEF_DEF_  "ISO11783_11_SpecVersion" "";
BA_DEF_DEF_  "ISO11783_7_SpecVersion" "";
BA_DEF_DEF_  "ISO11783_6_SpecVersion" "";
BA_DEF_DEF_  "DDI" 0;
BA_DEF_DEF_  "SingleFrame" 1;
BA_DEF_DEF_  "NodeLayerModules" "";
BA_DEF_DEF_  "ProtocolType" "";
BA_DEF_DEF_  "BusType" "";
BA_DEF_DEF_  "ISO11783_TIM_SpecVersion" "";
BA_DEF_DEF_  "NmStationAddress" 254;
BA_DEF_DEF_  "NmJ1939AAC" 0;
BA_DEF_DEF_  "NmJ1939IndustryGroup" 0;
BA_DEF_DEF_  "NmJ1939System" 0;
BA_DEF_DEF_  "NmJ1939SystemInstance" 0;
BA_DEF_DEF_  "NmJ1939Function" 0;
BA_DEF_DEF_  "NmJ1939FunctionInstance" 0;
BA_DEF_DEF_  "NmJ1939ECUInstance" 0;
BA_DEF_DEF_  "NmJ1939ManufacturerCode" 0;
BA_DEF_DEF_  "NmJ1939IdentityNumber" 0;
BA_DEF_DEF_  "ECU" "";
BA_DEF_DEF_  "VFrameFormat" "J1939PG";
BA_DEF_DEF_  "GenMsgSendType" "noMsgSendType";
BA_DEF_DEF_  "GenMsgCycleTime" 0;
BA_DEF_DEF_  "GenMsgRequestable" 1;
BA_DEF_DEF_  "GenMsgCycleTimeFast" 0;
BA_DEF_DEF_  "GenMsgILSupport" "Yes";
BA_DEF_DEF_  "SPN" 0;
BA_DEF_DEF_  "DatabaseVersion" "";
BA_DEF_DEF_  "GenSigSendType" "NoSigSendType";
BA_DEF_DEF_  "SigType" "Default";
BA_DEF_DEF_  "ISO11783_12_SpecVersion" "";
BA_DEF_DEF_  "ISO11783_13_SpecVersion" "";
BA_DEF_DEF_  "GenSigStartValue" 0;
BA_DEF_DEF_  "ISO11783IOPFilename" "";
BA_DEF_DEF_  "ISO11783IOPVersion" "5";
BA_DEF_DEF_  "ISO11783PDDFilename" "";
BA_DEF_DEF_  "ISO11783PDDVersion" "3";
BA_DEF_DEF_  "GenSigILSupport" "Yes";
BA_DEF_DEF_  "SystemSignalLongSymbol" "";
BA_ "ISO11783_TIM_SpecVersion" "AEF 023 DIG 0_07 ISOBUS - ISOBUS Automation Principles";
BA_ "ISO11783_13_SpecVersion" "2010-01-29 2007 With Amendments ";
BA_ "BusType" "CAN";
BA_ "ISO11783_11_SpecVersion" "2007-04-01 IS";
BA_ "ISO11783_7_SpecVersion" "2009-01-29 FDIS";
BA_ "ISO11783_6_SpecVersion" "2010-05-11 FDIS";
BA_ "ProtocolType" "ISO11783";
BA_ "DatabaseVersion" "7.5 SP2";
BA_ "ISO11783_12_SpecVersion" "2013-01-29 IS (ISO/TC 23/SC 19)";
BA_ "NmStationAddress" BU_ GNSSReceiver 28;
BA_ "NodeLayerModules" BU_ GNSSReceiver "ISO11783_GNSS_IL.vmodule";
BA_ "NmJ1939Function" BU_ GNSSReceiver 23;
BA_ "NmJ1939ManufacturerCode" BU_ GNSSReceiver 1861;
BA_ "NmJ1939IdentityNumber" BU_ GNSSReceiver 701225;
BA_ "ECU" BU_ VT "VT";
BA_ "NmJ1939IdentityNumber" BU_ VT 2;
BA_ "NmJ1939ManufacturerCode" BU_ VT 1861;
BA_ "NmJ1939Function" BU_ VT 29;
BA_ "NmJ1939System" BU_ VT 1;
BA_ "NmJ1939IndustryGroup" BU_ VT 2;
BA_ "NmJ1939AAC" BU_ VT 1;
BA_ "NmStationAddress" BU_ VT 38;
BA_ "NodeLayerModules" BU_ VT "ISO11783_VT_IL.vmodule";
BA_ "ECU" BU_ TECU "TECU";
BA_ "NmJ1939IdentityNumber" BU_ TECU 701224;
BA_ "NmJ1939ManufacturerCode" BU_ TECU 1861;
BA_ "NmJ1939Function" BU_ TECU 134;
BA_ "NmJ1939IndustryGroup" BU_ TECU 2;
BA_ "NmStationAddress" BU_ TECU 240;
BA_ "NodeLayerModules" BU_ TECU "ISO11783_IL.vmodule";
BA_ "ECU" BU_ TC "TC";
BA_ "NmJ1939IdentityNumber" BU_ TC 1;
BA_ "NmJ1939ManufacturerCode" BU_ TC 1861;
BA_ "NmJ1939Function" BU_ TC 130;
BA_ "NmJ1939IndustryGroup" BU_ TC 2;
BA_ "NmStationAddress" BU_ TC 247;
BA_ "NodeLayerModules" BU_ TC "ISO11783_TC_IL.vmodule";
BA_ "ECU" BU_ Sprayer "Sprayer";
BA_ "NmJ1939IdentityNumber" BU_ Sprayer 702222;
BA_ "NmJ1939ManufacturerCode" BU_ Sprayer 1861;
BA_ "NmJ1939Function" BU_ Sprayer 132;
BA_ "NmJ1939System" BU_ Sprayer 6;
BA_ "NmJ1939IndustryGroup" BU_ Sprayer 2;
BA_ "NmJ1939AAC" BU_ Sprayer 1;
BA_ "NmStationAddress" BU_ Sprayer 128;
BA_ "NodeLayerModules" BU_ Sprayer "ISO11783_IL.vmodule";
BA_ "SPN" SG_ 3221225472 ClientAuthenticationSubStatus 13223;
BA_ "SPN" SG_ 3221225472 ServerAuthenticationSubStatus 13223;
BA_ "DDI" SG_ 2362179319 ActualCanopyHeight 520;
BA_ "DDI" SG_ 2362179319 GNSSInstallationType 521;
BA_ "DDI" SG_ 2362179319 LastBaleLifetimeCount 519;
BA_ "DDI" SG_ 2362179319 ActualTramlineCondensedWorkState 518;
BA_ "SystemSignalLongSymbol" SG_ 2362179319 ActualTramlineCondensedWorkState "ActualTramlineCondensedWorkState1to16";
BA_ "DDI" SG_ 2362179319 SetpointTramlineCondensedWorkSta 517;
BA_ "SystemSignalLongSymbol" SG_ 2362179319 SetpointTramlineCondensedWorkSta "SetpointTramlineCondensedWorkState1to16";
BA_ "DDI" SG_ 2362179319 TramlineOverdosingRate 516;
BA_ "DDI" SG_ 2362179319 TramlineControlState 515;
BA_ "DDI" SG_ 2362179319 GNSSQuality 514;
BA_ "DDI" SG_ 2362179319 GuidanceLineDeviation 513;
BA_ "DDI" SG_ 2362179319 GuidanceLineSwathWidth 512;
BA_ "DDI" SG_ 2362179319 TrackNumberToLeft 511;
BA_ "DDI" SG_ 2362179319 TrackNumberToRight 510;
BA_ "DDI" SG_ 2362179319 ActualTrackNumber 509;
BA_ "DDI" SG_ 2362179319 UniqueABGuidanceReferenceLineID 508;
BA_ "DDI" SG_ 2362179319 TramlineSequenceNumber 507;
BA_ "DDI" SG_ 2362179319 SetpointTramlineControlLevel 506;
BA_ "DDI" SG_ 2362179319 TramlineControlLevel 505;
BA_ "DDI" SG_ 2362179319 MaxEngineTorque 504;
BA_ "DDI" SG_ 2362179319 MinEngineTorque 503;
BA_ "DDI" SG_ 2362179319 ActualEngineTorque 502;
BA_ "DDI" SG_ 2362179319 SetpointEngineTorque 501;
BA_ "DDI" SG_ 2362179319 LastEventPartnerIDDeviceClass 500;
BA_ "DDI" SG_ 2362179319 LastEventPartnerIDManufacturerID 499;
BA_ "SystemSignalLongSymbol" SG_ 2362179319 LastEventPartnerIDManufacturerID "LastEventPartnerIDManufacturerIDCode";
BA_ "DDI" SG_ 2362179319 LastEventPartnerIdType 498;
BA_ "DDI" SG_ 2362179319 LastEventPartnerID_Byte13to16 497;
BA_ "DDI" SG_ 2362179319 LastEventPartnerID_Byte9to12 496;
BA_ "DDI" SG_ 2362179319 LastEventPartnerID_Byte5to8 495;
BA_ "DDI" SG_ 2362179319 LastEventPartnerID_Byte1to4 494;
BA_ "DDI" SG_ 2362179319 LifetimeEngineHours 493;
BA_ "DDI" SG_ 2362179319 TotalEngineHours 492;
BA_ "DDI" SG_ 2362179319 FuelPercentageLevel 491;
BA_ "DDI" SG_ 2362179319 MaxFuelTankContent 490;
BA_ "DDI" SG_ 2362179319 MaxDieselExhaustFluidTankContent 489;
BA_ "DDI" SG_ 2362179319 DieselExhaustFluidTankPercentage 488;
BA_ "SystemSignalLongSymbol" SG_ 2362179319 DieselExhaustFluidTankPercentage "DieselExhaustFluidTankPercentageLevel";
BA_ "DDI" SG_ 2362179319 MaxEngineSpeed 486;
BA_ "DDI" SG_ 2362179319 MinEngineSpeed 485;
BA_ "DDI" SG_ 2362179319 ActualEngineSpeed 484;
BA_ "DDI" SG_ 2362179319 SetpointEngineSpeed 483;
BA_ "DDI" SG_ 2362179319 LastBaleNumberOfSubbales 482;
BA_ "DDI" SG_ 2362179319 SetpointNumberOfSubbales 481;
BA_ "DDI" SG_ 2362179319 MaxFlakeSize 480;
BA_ "DDI" SG_ 2362179319 MinFlakeSize 479;
BA_ "DDI" SG_ 2362179319 SetpointFlakeSize 478;
BA_ "DDI" SG_ 2362179319 MaxBaleHydraulicPressure 477;
BA_ "DDI" SG_ 2362179319 MinBaleHydraulicPressure 476;
BA_ "DDI" SG_ 2362179319 SetpointBaleHydraulicPressure 475;
BA_ "DDI" SG_ 2362179319 MaxLengthOfCut 474;
BA_ "DDI" SG_ 2362179319 MinLengthOfCut 473;
BA_ "DDI" SG_ 2362179319 SetpointLengthOfCut 472;
BA_ "DDI" SG_ 2362179319 ActualPercentageContent 467;
BA_ "DDI" SG_ 2362179319 ActualRelativeConnectorAngle 466;
BA_ "DDI" SG_ 2362179319 LifetimeHaulCounter 465;
BA_ "DDI" SG_ 2362179319 HaulCounter 464;
BA_ "DDI" SG_ 2362179319 LastUnloadedCount 463;
BA_ "DDI" SG_ 2362179319 LastLoadedCount 462;
BA_ "DDI" SG_ 2362179319 LifetimeUnloadedTotalCount 461;
BA_ "DDI" SG_ 2362179319 LifetimeLoadedTotalCount 460;
BA_ "DDI" SG_ 2362179319 UnloadedTotalCount 459;
BA_ "DDI" SG_ 2362179319 LoadedTotalCount 458;
BA_ "DDI" SG_ 2362179319 LastUnloadedVolume 457;
BA_ "DDI" SG_ 2362179319 LastLoadedVolume 456;
BA_ "DDI" SG_ 2362179319 LifetimeUnloadedTotalVolume 455;
BA_ "DDI" SG_ 2362179319 LifetimeLoadedTotalVolume 454;
BA_ "DDI" SG_ 2362179319 UnloadedTotalVolume 453;
BA_ "DDI" SG_ 2362179319 LoadedTotalVolume 452;
BA_ "DDI" SG_ 2362179319 MaxAppRateOfDryMatter 451;
BA_ "DDI" SG_ 2362179319 MinAppRateOfDryMatter 450;
BA_ "DDI" SG_ 2362179319 ActualAppRateOfDryMatter 449;
BA_ "DDI" SG_ 2362179319 SetpointAppRateOfDryMatter 448;
BA_ "DDI" SG_ 2362179319 MaxAppRateOfPotassium 447;
BA_ "DDI" SG_ 2362179319 MinAppRateOfPotassium 446;
BA_ "DDI" SG_ 2362179319 ActualAppRateOfPotassium 445;
BA_ "DDI" SG_ 2362179319 SetpointAppRateOfPotassium 444;
BA_ "DDI" SG_ 2362179319 MaxAppRateOfPhosphor 443;
BA_ "DDI" SG_ 2362179319 MinAppRateOfPhosphor 442;
BA_ "DDI" SG_ 2362179319 ActualAppRateOfPhosphor 441;
BA_ "DDI" SG_ 2362179319 SetpointAppRateOfPhosphor 440;
BA_ "DDI" SG_ 2362179319 MaxAppRateOfAmmonium 439;
BA_ "DDI" SG_ 2362179319 MinAppRateOfAmmonium 438;
BA_ "DDI" SG_ 2362179319 ActualAppRateOfAmmonium 437;
BA_ "DDI" SG_ 2362179319 SetpointAppRateOfAmmonium 436;
BA_ "DDI" SG_ 2362179319 MaxAppRateOfNitrogen 435;
BA_ "DDI" SG_ 2362179319 MinAppRateOfNitrogen 434;
BA_ "DDI" SG_ 2362179319 ActualAppRateOfNitrogen 433;
BA_ "DDI" SG_ 2362179319 SetpointAppRateOfNitrogen 432;
BA_ "DDI" SG_ 2362179319 LifetimeUnloadedTotalMass 431;
BA_ "DDI" SG_ 2362179319 LifetimeLoadedTotalMass 430;
BA_ "DDI" SG_ 2362179319 UnloadedTotalMass 429;
BA_ "DDI" SG_ 2362179319 LoadedTotalMass 428;
BA_ "DDI" SG_ 2362179319 ActualDownforceAsForce 427;
BA_ "DDI" SG_ 2362179319 SetpointDownforceAsForce 426;
BA_ "DDI" SG_ 2362179319 SetpointMaxAllowedSeedSpacingDev 425;
BA_ "SystemSignalLongSymbol" SG_ 2362179319 SetpointMaxAllowedSeedSpacingDev "SetpointMaxAllowedSeedSpacingDeviation";
BA_ "DDI" SG_ 2362179319 AvgCoeffOfVariationOfSeedSpacing 424;
BA_ "SystemSignalLongSymbol" SG_ 2362179319 AvgCoeffOfVariationOfSeedSpacing "AvgCoeffOfVariationOfSeedSpacingPercentage";
BA_ "DDI" SG_ 2362179319 ActCoeffOfVariationOfSeedSpacing 423;
BA_ "SystemSignalLongSymbol" SG_ 2362179319 ActCoeffOfVariationOfSeedSpacing "ActCoeffOfVariationOfSeedSpacingPercentage";
BA_ "DDI" SG_ 2362179319 AverageSeedSpacingDeviation_Copy 422;
BA_ "SystemSignalLongSymbol" SG_ 2362179319 AverageSeedSpacingDeviation_Copy "AverageSeedSpacingDeviation_Copy_1";
BA_ "DDI" SG_ 2362179319 ActualSeedSpacingDeviation 421;
BA_ "DDI" SG_ 2362179319 AverageSeedMultiplePercentage 420;
BA_ "DDI" SG_ 2362179319 ActualSeedMultiplePercentage 419;
BA_ "DDI" SG_ 2362179319 AverageSeedSkipPercentage 418;
BA_ "DDI" SG_ 2362179319 ActualSeedSkipPercentage 417;
BA_ "DDI" SG_ 2362179319 AverageSeedSingulationPercentage 416;
BA_ "DDI" SG_ 2362179319 ActualSeedSingulationPercentage 415;
BA_ "DDI" SG_ 2362179319 LifetimeAvgDieselExhFluidConsump 414;
BA_ "SystemSignalLongSymbol" SG_ 2362179319 LifetimeAvgDieselExhFluidConsump "LifetimeAvgDieselExhFluidConsumpPerArea";
BA_ "DDI" SG_ 2362179319 LifetimeAvgDieselExhFluidCo_0000 413;
BA_ "SystemSignalLongSymbol" SG_ 2362179319 LifetimeAvgDieselExhFluidCo_0000 "LifetimeAvgDieselExhFluidConsumpPerTime";
BA_ "DDI" SG_ 2362179319 LifetimeDieselExhaustFluidConsum 412;
BA_ "SPN" SG_ 2362179319 LifetimeDieselExhaustFluidConsum 5963;
BA_ "SystemSignalLongSymbol" SG_ 2362179319 LifetimeDieselExhaustFluidConsum "LifetimeDieselExhaustFluidConsumption";
BA_ "DDI" SG_ 2362179319 InstantDieselExhaustFluidConsump 411;
BA_ "SystemSignalLongSymbol" SG_ 2362179319 InstantDieselExhaustFluidConsump "InstantDieselExhaustFluidConsumpPerArea";
BA_ "DDI" SG_ 2362179319 InstantDieselExhaustFluidCo_0000 410;
BA_ "SystemSignalLongSymbol" SG_ 2362179319 InstantDieselExhaustFluidCo_0000 "InstantDieselExhaustFluidConsumpPerTime";
BA_ "DDI" SG_ 2362179319 TotalDieselExhaustFluidConsumpti 409;
BA_ "SystemSignalLongSymbol" SG_ 2362179319 TotalDieselExhaustFluidConsumpti "TotalDieselExhaustFluidConsumption";
BA_ "DDI" SG_ 2362179319 AverageCropContamination 408;
BA_ "DDI" SG_ 2362179319 AverageProteinContent 407;
BA_ "DDI" SG_ 2362179319 ActualProteinContent 406;
BA_ "DDI" SG_ 2362179319 ActualApplicationOfDryMatter 405;
BA_ "DDI" SG_ 2362179319 ActualApplicationOfPotassium 404;
BA_ "DDI" SG_ 2362179319 ActualApplicationOfPhosphor 403;
BA_ "DDI" SG_ 2362179319 ActualApplicationOfAmmonium 402;
BA_ "DDI" SG_ 2362179319 ActualApplicationOfNitrogen 401;
BA_ "DDI" SG_ 2362179319 SpeedSource 400;
BA_ "DDI" SG_ 2362179319 MaximumSpeed 399;
BA_ "DDI" SG_ 2362179319 MinimumSpeed 398;
BA_ "DDI" SG_ 2362179319 ActualSpeed 397;
BA_ "DDI" SG_ 2362179319 SetpointSpeed 396;
BA_ "DDI" SG_ 2362179319 ActualDieselExhaustFluidTankCont 395;
BA_ "SystemSignalLongSymbol" SG_ 2362179319 ActualDieselExhaustFluidTankCont "ActualDieselExhaustFluidTankContent";
BA_ "DDI" SG_ 2362179319 ActualFuelTankContent 394;
BA_ "DDI" SG_ 2362179319 MaximumRevolutionsPerTime 393;
BA_ "DDI" SG_ 2362179319 MinimumRevolutionsPerTime 392;
BA_ "DDI" SG_ 2362179319 DefaultRevolutionsPerTime 391;
BA_ "DDI" SG_ 2362179319 ActualRevolutionsPerTime 390;
BA_ "DDI" SG_ 2362179319 SetpointRevolutionsAsCountPerTim 389;
BA_ "SystemSignalLongSymbol" SG_ 2362179319 SetpointRevolutionsAsCountPerTim "SetpointRevolutionsAsCountPerTime";
BA_ "DDI" SG_ 2362179319 TotalRevolutionsInCompleteRevolu 388;
BA_ "SystemSignalLongSymbol" SG_ 2362179319 TotalRevolutionsInCompleteRevolu "TotalRevolutionsInCompleteRevolutions";
BA_ "DDI" SG_ 2362179319 TotalRevolutionsInFractionalRevo 387;
BA_ "SystemSignalLongSymbol" SG_ 2362179319 TotalRevolutionsInFractionalRevo "TotalRevolutionsInFractionalRevolutions";
BA_ "DDI" SG_ 2362179319 ActualAtmosphericPressure 386;
BA_ "DDI" SG_ 2362179319 MSLAtmosphericPressure 385;
BA_ "DDI" SG_ 2362179319 ApparentWindSpeed 384;
BA_ "DDI" SG_ 2362179319 ApparentWindDirection 383;
BA_ "DDI" SG_ 2362179319 CondensedSectionOverrideState241 382;
BA_ "SystemSignalLongSymbol" SG_ 2362179319 CondensedSectionOverrideState241 "CondensedSectionOverrideState241to256";
BA_ "DDI" SG_ 2362179319 CondensedSectionOverrideState225 381;
BA_ "SystemSignalLongSymbol" SG_ 2362179319 CondensedSectionOverrideState225 "CondensedSectionOverrideState225to240";
BA_ "DDI" SG_ 2362179319 CondensedSectionOverrideState209 380;
BA_ "SystemSignalLongSymbol" SG_ 2362179319 CondensedSectionOverrideState209 "CondensedSectionOverrideState209to224";
BA_ "DDI" SG_ 2362179319 CondensedSectionOverrideState193 379;
BA_ "SystemSignalLongSymbol" SG_ 2362179319 CondensedSectionOverrideState193 "CondensedSectionOverrideState193to208";
BA_ "DDI" SG_ 2362179319 CondensedSectionOverrideState177 378;
BA_ "SystemSignalLongSymbol" SG_ 2362179319 CondensedSectionOverrideState177 "CondensedSectionOverrideState177to192";
BA_ "DDI" SG_ 2362179319 CondensedSectionOverrideState161 377;
BA_ "SystemSignalLongSymbol" SG_ 2362179319 CondensedSectionOverrideState161 "CondensedSectionOverrideState161to176";
BA_ "DDI" SG_ 2362179319 CondensedSectionOverrideState145 376;
BA_ "SystemSignalLongSymbol" SG_ 2362179319 CondensedSectionOverrideState145 "CondensedSectionOverrideState145to160";
BA_ "DDI" SG_ 2362179319 CondensedSectionOverrideState129 375;
BA_ "SystemSignalLongSymbol" SG_ 2362179319 CondensedSectionOverrideState129 "CondensedSectionOverrideState129to144";
BA_ "DDI" SG_ 2362179319 CondensedSectionOverrideState113 374;
BA_ "SystemSignalLongSymbol" SG_ 2362179319 CondensedSectionOverrideState113 "CondensedSectionOverrideState113to128";
BA_ "DDI" SG_ 2362179319 CondensedSectionOverrideState97t 373;
BA_ "SystemSignalLongSymbol" SG_ 2362179319 CondensedSectionOverrideState97t "CondensedSectionOverrideState97to112";
BA_ "DDI" SG_ 2362179319 CondensedSectionOverrideState81t 372;
BA_ "SystemSignalLongSymbol" SG_ 2362179319 CondensedSectionOverrideState81t "CondensedSectionOverrideState81to96";
BA_ "DDI" SG_ 2362179319 CondensedSectionOverrideState65t 371;
BA_ "SystemSignalLongSymbol" SG_ 2362179319 CondensedSectionOverrideState65t "CondensedSectionOverrideState65to80";
BA_ "DDI" SG_ 2362179319 CondensedSectionOverrideState49t 370;
BA_ "SystemSignalLongSymbol" SG_ 2362179319 CondensedSectionOverrideState49t "CondensedSectionOverrideState49to64";
BA_ "DDI" SG_ 2362179319 CondensedSectionOverrideState33t 369;
BA_ "SystemSignalLongSymbol" SG_ 2362179319 CondensedSectionOverrideState33t "CondensedSectionOverrideState33to48";
BA_ "DDI" SG_ 2362179319 CondensedSectionOverrideState17t 368;
BA_ "SystemSignalLongSymbol" SG_ 2362179319 CondensedSectionOverrideState17t "CondensedSectionOverrideState17to32";
BA_ "DDI" SG_ 2362179319 CondensedSectionOverrideState01t 367;
BA_ "SystemSignalLongSymbol" SG_ 2362179319 CondensedSectionOverrideState01t "CondensedSectionOverrideState01to16";
BA_ "DDI" SG_ 2362179319 ActualDownforcePressure 366;
BA_ "DDI" SG_ 2362179319 SetpointDownforcePressure 365;
BA_ "DDI" SG_ 2362179319 ActualFlakeSize 364;
BA_ "DDI" SG_ 2362179319 LastBaleDryMass 363;
BA_ "DDI" SG_ 2362179319 TotalBaleLength 362;
BA_ "DDI" SG_ 2362179319 LastBaleDensity 361;
BA_ "DDI" SG_ 2362179319 LastBaleSize 360;
BA_ "DDI" SG_ 2362179319 AverageDryYieldMassPerArea 359;
BA_ "DDI" SG_ 2362179319 AverageDryYieldMassPerTime 358;
BA_ "DDI" SG_ 2362179319 TotalApplicationOfDryMatter 357;
BA_ "DDI" SG_ 2362179319 TotalApplicationOfPotassium 356;
BA_ "DDI" SG_ 2362179319 TotalApplicationOfPhosphor 355;
BA_ "DDI" SG_ 2362179319 TotalApplicationOfAmmonium 354;
BA_ "DDI" SG_ 2362179319 TotalApplicationofNitrogen 353;
BA_ "DDI" SG_ 2362179319 ApplicationTotalMass 352;
BA_ "DDI" SG_ 2362179319 ApplicationTotalVolume 351;
BA_ "DDI" SG_ 2362179319 FunctionType 350;
BA_ "DDI" SG_ 2362179319 NozzleDriftReduction 349;
BA_ "DDI" SG_ 2362179319 MaximumSwathingWidth 348;
BA_ "DDI" SG_ 2362179319 MinimumSwathingWidth 347;
BA_ "DDI" SG_ 2362179319 ActualSwathingWidth 346;
BA_ "DDI" SG_ 2362179319 SetpointSwathingWidth 345;
BA_ "DDI" SG_ 2362179319 MaximumGrainKernelCrackerGap 344;
BA_ "DDI" SG_ 2362179319 MinimumGrainKernelCrackerGap 343;
BA_ "DDI" SG_ 2362179319 ActualGrainKernelCrackerGap 342;
BA_ "DDI" SG_ 2362179319 SetpointGrainKernelCrackerGap 341;
BA_ "DDI" SG_ 2362179319 EffectiveUnloadingTime 340;
BA_ "DDI" SG_ 2362179319 EffectiveLoadingTime 339;
BA_ "DDI" SG_ 2362179319 LiftimeRearPTOHours 338;
BA_ "DDI" SG_ 2362179319 LifetimeFrontPTOHours 337;
BA_ "DDI" SG_ 2362179319 RearPTOHours 336;
BA_ "DDI" SG_ 2362179319 FrontPTOHours 335;
BA_ "DDI" SG_ 2362179319 OperatingHoursSinceLastSharpenin 334;
BA_ "SystemSignalLongSymbol" SG_ 2362179319 OperatingHoursSinceLastSharpenin "OperatingHoursSinceLastSharpening";
BA_ "DDI" SG_ 2362179319 MaximumCuttingDrumSpeed 333;
BA_ "DDI" SG_ 2362179319 ActualCuttingDrumSpeed 331;
BA_ "DDI" SG_ 2362179319 SetpointCuttingDrumSpeed 330;
BA_ "DDI" SG_ 2362179319 MaximumHeaderSpeed 329;
BA_ "DDI" SG_ 2362179319 MinimumHeaderSpeed 328;
BA_ "DDI" SG_ 2362179319 ActualHeaderSpeed 327;
BA_ "DDI" SG_ 2362179319 SetpointHeaderSpeed 326;
BA_ "DDI" SG_ 2362179319 LifetimeApplicationTotalVolume 325;
BA_ "DDI" SG_ 2362179319 ChopperEngagementTotalTime 324;
BA_ "DDI" SG_ 2362179319 UnloadIdentificationNumber 323;
BA_ "DDI" SG_ 2362179319 LoadIdentificationNumber 322;
BA_ "SPN" SG_ 2362179319 ArbitraryAddressCapable 2844;
BA_ "SPN" SG_ 2362179319 IndustryGroup 2846;
BA_ "SPN" SG_ 2362179319 VehicleSystemInstance 2843;
BA_ "SPN" SG_ 2362179319 Function 2841;
BA_ "SPN" SG_ 2362179319 FunctionInstance 2839;
BA_ "SPN" SG_ 2362179319 ECUInstance 2840;
BA_ "SPN" SG_ 2362179319 ManufacturerCode 2838;
BA_ "SigType" SG_ 2362179319 ManufacturerCode 1;
BA_ "SigType" SG_ 2362179319 TemperatureUnits 4;
BA_ "SigType" SG_ 2362179319 PressureUnits 4;
BA_ "SigType" SG_ 2362179319 ForceUnits 4;
BA_ "SPN" SG_ 2362179319 IdentityNumber 2837;
BA_ "SigType" SG_ 2362179319 UnitsSystem 4;
BA_ "SigType" SG_ 2362179319 DistanceUnitCmd 4;
BA_ "SPN" SG_ 2362179319 DistanceUnitCmd 2414;
BA_ "SigType" SG_ 2362179319 AreaUnitCmd 4;
BA_ "SPN" SG_ 2362179319 AreaUnitCmd 2415;
BA_ "SigType" SG_ 2362179319 VolumeUnitCmd 4;
BA_ "SPN" SG_ 2362179319 VolumeUnitCmd 2416;
BA_ "SigType" SG_ 2362179319 MassUnitCmd 4;
BA_ "SPN" SG_ 2362179319 MassUnitCmd 2417;
BA_ "GenSigStartValue" SG_ 2362179319 NumberOfBooms 255;
BA_ "DDI" SG_ 2362179319 AppRateVolumePerArea_Set 1;
BA_ "DDI" SG_ 2362179319 AppRateVolumePerArea_Act 2;
BA_ "DDI" SG_ 2362179319 AppRateVolumePerArea_Def 3;
BA_ "DDI" SG_ 2362179319 AppRateVolumePerArea_Min 4;
BA_ "DDI" SG_ 2362179319 AppRateVolumePerArea_Max 5;
BA_ "DDI" SG_ 2362179319 AppRateMassPerArea_Set 6;
BA_ "DDI" SG_ 2362179319 AppRateMassPerArea_Act 7;
BA_ "DDI" SG_ 2362179319 AppRateMassPerArea_Def 8;
BA_ "DDI" SG_ 2362179319 AppRateMassPerArea_Min 9;
BA_ "DDI" SG_ 2362179319 AppRateMassPerArea_Max 10;
BA_ "DDI" SG_ 2362179319 AppRateCountPerArea_Set 11;
BA_ "DDI" SG_ 2362179319 AppRateCountPerArea_Act 12;
BA_ "DDI" SG_ 2362179319 AppRateCountPerArea_Def 13;
BA_ "DDI" SG_ 2362179319 AppRateCountPerArea_Min 14;
BA_ "DDI" SG_ 2362179319 AppRateCountPerArea_Max 15;
BA_ "DDI" SG_ 2362179319 SetAppRateDistance_Set 16;
BA_ "DDI" SG_ 2362179319 AppRateDistance_Act 17;
BA_ "DDI" SG_ 2362179319 AppRateDistance_Def 18;
BA_ "DDI" SG_ 2362179319 AppRateDistance_Min 19;
BA_ "DDI" SG_ 2362179319 AppRateDistance_Max 20;
BA_ "DDI" SG_ 2362179319 AppRateVolumePerVolume_Set 21;
BA_ "DDI" SG_ 2362179319 AppRateVolumePerVolume_Act 22;
BA_ "DDI" SG_ 2362179319 AppRateVolumePerVolume_Def 23;
BA_ "DDI" SG_ 2362179319 AppRateVolumePerVolume_Min 24;
BA_ "DDI" SG_ 2362179319 AppRateVolumePerVolume_Max 25;
BA_ "DDI" SG_ 2362179319 AppRateMassPerMass_Set 26;
BA_ "DDI" SG_ 2362179319 AppRateMassPerMass_Act 27;
BA_ "DDI" SG_ 2362179319 AppRateMassPerMass_Def 28;
BA_ "DDI" SG_ 2362179319 AppRateMassPerMass_Min 29;
BA_ "DDI" SG_ 2362179319 AppRateMassPerMass_Max 30;
BA_ "DDI" SG_ 2362179319 AppRateVolumePerMass_Set 31;
BA_ "DDI" SG_ 2362179319 AppRateVolumePerMass_Act 32;
BA_ "DDI" SG_ 2362179319 AppRateVolumePerMass_Def 33;
BA_ "DDI" SG_ 2362179319 AppRateVolumePerMass_Min 34;
BA_ "DDI" SG_ 2362179319 AppRateVolumePerMass_Max 35;
BA_ "DDI" SG_ 2362179319 AppRateVolumePerTime_Set 36;
BA_ "DDI" SG_ 2362179319 AppRateVolumePerTime_Act 37;
BA_ "DDI" SG_ 2362179319 AppRateVolumePerTime_Def 38;
BA_ "DDI" SG_ 2362179319 AppRateVolumePerTime_Min 39;
BA_ "DDI" SG_ 2362179319 AppRateVolumePerTime_Max 40;
BA_ "DDI" SG_ 2362179319 AppRateMassPerTime_Set 41;
BA_ "DDI" SG_ 2362179319 AppRateMassPerTime_Act 42;
BA_ "DDI" SG_ 2362179319 AppRateMassPerTime_Def 43;
BA_ "DDI" SG_ 2362179319 AppRateMassPerTime_Min 44;
BA_ "DDI" SG_ 2362179319 AppRateMassPerTime_Max 45;
BA_ "DDI" SG_ 2362179319 AppRateCountPerTime_Set 46;
BA_ "DDI" SG_ 2362179319 AppRateCountPerTime_Act 47;
BA_ "DDI" SG_ 2362179319 AppRateCountPerTime_Def 48;
BA_ "DDI" SG_ 2362179319 AppRateCountPerTime_Min 49;
BA_ "DDI" SG_ 2362179319 AppRateCountPerTime_Max 50;
BA_ "DDI" SG_ 2362179319 SetTillageDepth_Set 51;
BA_ "DDI" SG_ 2362179319 TillageDepth_Act 52;
BA_ "DDI" SG_ 2362179319 TillageDepth_Def 53;
BA_ "DDI" SG_ 2362179319 TillageDepth_Min 54;
BA_ "DDI" SG_ 2362179319 TillageDepth_Max 55;
BA_ "DDI" SG_ 2362179319 SeedingDeph_Set 56;
BA_ "DDI" SG_ 2362179319 SeedingDeph_Act 57;
BA_ "DDI" SG_ 2362179319 SeedingDeph_Def 58;
BA_ "DDI" SG_ 2362179319 SeedingDeph_Min 59;
BA_ "DDI" SG_ 2362179319 SeedingDeph_Max 60;
BA_ "DDI" SG_ 2362179319 WorkingHeight_Set 61;
BA_ "DDI" SG_ 2362179319 WorkingHeight_Act 62;
BA_ "DDI" SG_ 2362179319 WorkingHeight_Def 63;
BA_ "DDI" SG_ 2362179319 WorkingHeight_Min 64;
BA_ "DDI" SG_ 2362179319 WorkingHeight_Max 65;
BA_ "DDI" SG_ 2362179319 WorkingWidth_Set 66;
BA_ "DDI" SG_ 2362179319 WorkingWidth_Act 67;
BA_ "DDI" SG_ 2362179319 WorkingWidth_Def 68;
BA_ "DDI" SG_ 2362179319 WorkingWidth_Min 69;
BA_ "DDI" SG_ 2362179319 WorkingWidth_Max 70;
BA_ "DDI" SG_ 2362179319 ContentAsVolume_Set 71;
BA_ "DDI" SG_ 2362179319 ContentAsVolume_Act 72;
BA_ "DDI" SG_ 2362179319 ContentAsVolume_Max 73;
BA_ "DDI" SG_ 2362179319 ContentAsMass_Set 74;
BA_ "DDI" SG_ 2362179319 ContentAsMass_Act 75;
BA_ "DDI" SG_ 2362179319 ContentAsMass_Max 76;
BA_ "DDI" SG_ 2362179319 ContentAsCount_Set 77;
BA_ "DDI" SG_ 2362179319 ContentAsCount_Act 78;
BA_ "DDI" SG_ 2362179319 ContentAsCount_Max 79;
BA_ "DDI" SG_ 2362179319 AccumulatedAppAsVolume 80;
BA_ "DDI" SG_ 2362179319 AccumulatedAppAsMass 81;
BA_ "DDI" SG_ 2362179319 AccumulatedAppAsCount 82;
BA_ "DDI" SG_ 2362179319 YieldVolumePerArea 83;
BA_ "DDI" SG_ 2362179319 YieldMassPerArea 84;
BA_ "DDI" SG_ 2362179319 YieldCountPerArea 85;
BA_ "DDI" SG_ 2362179319 YieldVolumePerTime 86;
BA_ "DDI" SG_ 2362179319 YieldMassPerTime 87;
BA_ "DDI" SG_ 2362179319 YieldCountPerTime 88;
BA_ "DDI" SG_ 2362179319 AccumulatedYieldAsVolume 89;
BA_ "DDI" SG_ 2362179319 AccumulatedYieldAsMass 90;
BA_ "DDI" SG_ 2362179319 AccumulatedYieldAsCount 91;
BA_ "DDI" SG_ 2362179319 CropYieldLossVolumePerArea 92;
BA_ "DDI" SG_ 2362179319 CropYieldLossMassPerArea 93;
BA_ "DDI" SG_ 2362179319 CropYieldLossCountPerArea 94;
BA_ "DDI" SG_ 2362179319 CropYieldLossVolumePerTime 95;
BA_ "DDI" SG_ 2362179319 CropYieldLossMassPerTime 96;
BA_ "DDI" SG_ 2362179319 CropYieldLossCountPerTime 97;
BA_ "DDI" SG_ 2362179319 CropYieldLoss 98;
BA_ "DDI" SG_ 2362179319 MoistureInCropYield 99;
BA_ "DDI" SG_ 2362179319 DirtMaterialInCropYield 100;
BA_ "DDI" SG_ 2362179319 BaleWidth_Set 101;
BA_ "DDI" SG_ 2362179319 BaleWidth_Act 102;
BA_ "DDI" SG_ 2362179319 BaleWidth_Def 103;
BA_ "DDI" SG_ 2362179319 BaleWidth_Min 104;
BA_ "DDI" SG_ 2362179319 BaleWidth_Max 105;
BA_ "DDI" SG_ 2362179319 BaleHeight_Set 106;
BA_ "DDI" SG_ 2362179319 BaleHeight_Act 107;
BA_ "DDI" SG_ 2362179319 BaleHeight_Def 108;
BA_ "DDI" SG_ 2362179319 BaleHeight_Min 109;
BA_ "DDI" SG_ 2362179319 BaleHeight_Max 110;
BA_ "DDI" SG_ 2362179319 BaleSize_Set 111;
BA_ "DDI" SG_ 2362179319 BaleSize_Act 112;
BA_ "DDI" SG_ 2362179319 BaleSize_Def 113;
BA_ "DDI" SG_ 2362179319 BaleSize_Min 114;
BA_ "DDI" SG_ 2362179319 BaleSize_Max 115;
BA_ "DDI" SG_ 2362179319 AccumulatedArea 116;
BA_ "DDI" SG_ 2362179319 AccumulatedDistanceInWork 117;
BA_ "DDI" SG_ 2362179319 AccumulatedDistanceOutWork 118;
BA_ "DDI" SG_ 2362179319 AccumulatedTimeInWork 119;
BA_ "DDI" SG_ 2362179319 AccumulatedTimeOutWork 120;
BA_ "DDI" SG_ 2362179319 PrdoucDensityMassPerArea 121;
BA_ "DDI" SG_ 2362179319 PrdoucDensityMassPerCount 122;
BA_ "DDI" SG_ 2362179319 PrdoucDensityVolumePerCount 123;
BA_ "DDI" SG_ 2362179319 AuxiliaryValveScalingExtend 124;
BA_ "DDI" SG_ 2362179319 AuxiliaryValveScalingRetract 125;
BA_ "DDI" SG_ 2362179319 AuxiliaryRampExtendUp 126;
BA_ "DDI" SG_ 2362179319 AuxiliaryValveRampExtendDown 127;
BA_ "DDI" SG_ 2362179319 AuxiliaryValveRampRetractUp 128;
BA_ "DDI" SG_ 2362179319 AuxiliaryValveRampRetractDown 129;
BA_ "DDI" SG_ 2362179319 AuxiliaryValveFloatThreshold 130;
BA_ "DDI" SG_ 2362179319 AuxiliaryValveProgressivExtend 131;
BA_ "DDI" SG_ 2362179319 AuxiliaryValveProgressivRetract 132;
BA_ "DDI" SG_ 2362179319 AuxiliaryValveInvertPorts 133;
BA_ "DDI" SG_ 2362179319 DeviceElementOffsetX 134;
BA_ "DDI" SG_ 2362179319 DeviceElementOffsetY 135;
BA_ "DDI" SG_ 2362179319 DeviceElementOffsetZ 136;
BA_ "DDI" SG_ 2362179319 DeviceVolumeCapacity 137;
BA_ "DDI" SG_ 2362179319 DeviceMassCapacity 138;
BA_ "DDI" SG_ 2362179319 DeviceCountCapacity 139;
BA_ "DDI" SG_ 2362179319 PercentageAppRateSetpoint 140;
BA_ "DDI" SG_ 2362179319 WorkState 141;
BA_ "DDI" SG_ 2362179319 SetpointTimeLatency 142;
BA_ "DDI" SG_ 2362179319 ActualValueTimeLatency 143;
BA_ "DDI" SG_ 2362179319 YawAngle 144;
BA_ "DDI" SG_ 2362179319 RollAngle 145;
BA_ "DDI" SG_ 2362179319 PitchAngle 146;
BA_ "DDI" SG_ 2362179319 LogCount 147;
BA_ "DDI" SG_ 2362179319 TotalFuelConsumption 148;
BA_ "DDI" SG_ 2362179319 FuelConsumptionPerTime 149;
BA_ "DDI" SG_ 2362179319 FuelConsumptionPerArea 150;
BA_ "DDI" SG_ 2362179319 AreaPerTimeCapacity 151;
BA_ "DDI" SG_ 2362179319 MinMassPerAreaAppRate 152;
BA_ "DDI" SG_ 2362179319 NDVI 153;
BA_ "DDI" SG_ 2362179319 PhysicalObjectLength 154;
BA_ "DDI" SG_ 2362179319 PhysicalObjectWidth 155;
BA_ "DDI" SG_ 2362179319 PhysicalObjectHeight 156;
BA_ "DDI" SG_ 2362179319 ConnectorType 157;
BA_ "DDI" SG_ 2362179319 PrescriptionControlState 158;
BA_ "DDI" SG_ 2362179319 NumberOfSubUnitsPerSection 159;
BA_ "DDI" SG_ 2362179319 SectionControlState 160;
BA_ "DDI" SG_ 2362179319 CondensedWorkState1to16 161;
BA_ "DDI" SG_ 2362179319 CondensedWorkState17to32 162;
BA_ "DDI" SG_ 2362179319 CondensedWorkState33to48 163;
VAL_ 2362179319 GNSSInstallationType 5 "Display integrated antenna" 4 "Second Implement antenna" 3 "First Implement antenna" 2 "Tractor universal antenna (removable)" 1 "Tractor integrated antenna" 0 "Unknown " ;
VAL_ 2362179319 TramlineControlState 3 "undefined/not supported" 2 "error" 1 "automatic/on" 0 "manual/off" ;
VAL_ 2362179319 LastEventPartnerIDDeviceClass 26 "Feeder / Mixer" 25 "Slurry Applicators" 24 "Utility Vehicles" 23 "Mulchers" 22 "Timber Processing Machines" 21 "Timber loaders" 20 "Forwarders" 19 "Timber Harvesters" 17 "Sensor System" 16 "Skidder" 15 "Municipal Work / Earth Work" 14 "Special Crops" 13 "Powered Auxilary Units" 12 "Farmyard Work / Farm Yard Operations" 11 "Transport / Trailers (including Truck Trailers and Trucks)" 10 "Irrigation" 9 "Forage Harvester" 8 "Root Harvester" 7 "Harvesters (= Combine)" 6 "Sprayers" 5 "Fertilizer" 4 "Planters /Seeders" 3 "Secondary Soil Tillage" 2 "Primary Soil Tillage" 1 "Tractor" 0 "Non-specific System" ;
VAL_ 2362179319 LastEventPartnerIdType 1013 "13,56 MHz NFC according ISO 15693" 1012 "2,45 GHz RFID according ISO 18000-4" 1011 "868 MHz RFID according ISO 18000-6" 1010 "433 MHz RFID according ISO 18000-7" 1009 "13,56 MHz NFC according ISO 22536" 1008 "13,56 MHz RFID according ISO 18000-3" 1007 "135 kHz RFID according ISO 18000-2" 1006 "2,4 GHz Google URIBeacon" 1005 "2,4 GHz Radius Networks AltBeacon" 1004 "2,4 GHz Google Eddystone Beacon" 1003 "2,4 GHz Apple iBeacon" 1002 "Manually User Input" 1001 "Manufacturer Proprietary Solution" 1 "ISO 11783 Standardized Identification Device" 0 "Not Available" ;
VAL_ 2362179319 SpeedSource 7 "Machine measured speed" 6 "Machine Selected speed" 5 "Simulated speed" 4 "Blended speed" 3 "Navigation-based speed" 2 "Ground-based speed" 1 "Wheel-based speed" 0 "Unknown" ;
VAL_ 2362179319 IndustryGroup 7 "NotAvailable" 5 "Reserved" 4 "Marine" 3 "Construction" 2 "AgriculturalAndForestry" 1 "OnHighway" 0 "Global" ;
VAL_ 2362179319 VehicleSystem2 0 "NonSpecificSystem" 127 "Not Available" 1 "Tractor" 2 "Tillage" 3 "Secondary Tillage" 4 "Planters/Seeders" 5 "Fertilizers" 6 "Sprayers" 7 "Harvesters" 8 "Root Harvesters" 9 "Forage" 10 "Irrigation" 11 "Transport/Trailer" 12 "Farm Yard Operations" 13 "Powered Auxiliary Device" 14 "Special Crops" 15 "Earth Work" 16 "Skidder" 17 "Sensor Systems" 19 "Timber Harvesters" 20 "Forwarders" 21 "Timber loaders" 22 "Timber Processing Machines" 23 "Mulchers" 24 "Utility Vehicles" 25 "Slurry Applicators" ;
VAL_ 2362179319 Function 43 "Transmission Display" 44 "Exhaust Emission Control" 45 "Vehicle Dynamic Stability Control" 46 "Oil Sensor Unit" 47 "Information System Controller" 48 "Ramp Control" 49 "Clutch/Converter Control" 50 "Auxiliary Heater" 51 "Forward-Looking Collision Warning System" 52 "Chassis Controller" 53 "Alternator/Charging System" 54 "Communications Unit, Cellular" 55 "Communications Unit, Satellite" 56 "Communications Unit, Radio" 57 "Steering Column Unit" 58 "Fan Drive Control" 59 "Starter" 60 "Cab Display" 61 "File Server/Printer" 62 "On-Board Diagnostic Unit" 63 "Engine Valve Controller" 64 "Endurance Braking" 65 "Gas Flow Measurement" 66 "I/O Controller" 67 "Electrical System Controller" 68 "Aftertreatment system gas measurement" 69 "Engine Emission Aftertreatement System" 70 "Auxiliary Regeneration Device" 71 "Transfer Case Control" 72 "Coolant Valve Controller" 73 "Rollover Detection Control" 74 "Lubrication System" 75 "Supplemental Fan" 76 "Temperature Sensor" 77 "Fuel Properties Sensor" 78 "Fire Suppression System" 79 "Power Systems Manager" 80 "Electric Powertrain" 81 "Hydraulic Powertrain" 82 "File Server" 83 "Printer" 84 "Start Aid Device" 85 "Engine Injection Control Module" 86 "Reserved" 87 "Reserved" 88 "Reserved" 89 "Reserved" 90 "Reserved" 91 "Reserved" 92 "Reserved" 93 "Reserved" 94 "Reserved" 95 "Reserved" 96 "Reserved" 97 "Reserved" 98 "Reserved" 99 "Reserved" 100 "Reserved" 0 "Engine" 1 "Auxiliary Power Unit (APU)" 2 "Electric Propulsion Control" 3 "Transmission" 4 "Battery Pack Monitor" 5 "Shift Control/Console" 6 "Power TakeOff - (Main or Rear)" 7 "Axle - Steering" 8 "Axle - Drive" 9 "Brakes - System Controller" 10 "Brakes - Steer Axle" 11 "Brakes - Drive Axle" 12 "Retarder - Engine" 13 "Retarder - Driveline" 14 "Cruise Control" 15 "Fuel System" 16 "Steering Controller" 17 "Suspension - Steer Axle" 18 "Suspension - Drive Axle" 19 "Instrument Cluster" 20 "Trip Recorder" 21 "Cab Climate Control" 22 "Aerodynamic Control" 23 "Vehicle Navigation" 24 "Vehicle Security" 25 "Network Interconnect ECU" 26 "Body Controller" 27 "Power TakeOff (Secondary or Front)" 28 "Off Vehicle Gateway" 29 "Virtual Terminal (in cab)" 30 "Management Computer" 31 "Propulsion Battery Charger" 32 "Headway Controller" 33 "System Monitor" 34 "Hydraulic Pump Controller" 35 "Suspension - System Controller" 36 "Pneumatic - System Controller" 37 "Cab Controller" 38 "Tire Pressure Control" 39 "Ignition Control Module" 40 "Seat Control" 41 "Lighting - Operator Controls" 42 "Water Pump Control" 101 "Reserved" 102 "Reserved" 103 "Reserved" 104 "Reserved" 105 "Reserved" 106 "Reserved" 107 "Reserved" 108 "Reserved" 109 "Reserved" 110 "Reserved" 111 "Reserved" 112 "Reserved" 113 "Reserved" 114 "Reserved" 115 "Reserved" 116 "Reserved" 117 "Reserved" 118 "Reserved" 119 "Reserved" 120 "Reserved" 121 "Reserved" 122 "Reserved" 123 "Reserved" 124 "Reserved" 125 "Reserved" 126 "Reserved" 127 "Reserved" 255 "Not Available" ;
VAL_ 2362179319 ManufacturerCode 1077 "Ymer Technology" 1076 "DOGA S.A." 1075 "Uniden America Corporation" 1074 "Kindhelm / Navigs Oy" 1073 "Manitou Equipment America LLC" 1072 "La Marche Manufacturing Company" 1071 "MACH SYSTEMS s.r.o." 1070 "Quick-teck Electronics Ltd" 1069 "Lithionics Battery LLC" 1068 "Zapi S.p.A." 1067 "Tecomec S.r.l." 1066 "Spot Zero Water" 1065 "CALYPSO Instruments" 1064 "Omnitech Robotics Inc." 1063 "SolSteer" 1062 "Marol Co Ltd" 1061 "Volvo Construction Equipment" 1060 "Scale-Tec" 1059 "Boatrax" 1058 "Bondioli & Pavesi SpA" 1057 "EquipmentShare" 1056 "Lithium Pros" 1055 "EXA Computing GmbH" 1054 "Schmotzer Hacktechnik GmbH & Co. KG" 1053 "Vetus Maxwell, Inc." 1052 "Pfreundt" 1051 "ProNav AS" 1050 "Spacenus GmbH" 1049 "S&S Cycle" 1048 "Agrivation UG" 1047 "Sonic Corporation" 1046 "Praxidyn" 1045 "CMR Group" 1044 "Xee" 1043 "Hyva" 1042 "engcon group" 1041 "EZ Lynk" 1040 "BPE Electronics Srl" 1039 "Liugong Dressta Machinery" 1038 "EMIT Technologies, Inc." 1037 "Dragonfly Energy Corp." 1036 "Bender GmbH & Co. KG" 1035 "Agres" 1034 "Siren Marine" 1033 "ECCO Safety Group" 1032 "SIMOL S.p.A." 1031 "Flintec UK Ltd." 1030 "Tume-Agri Oy" 1029 "The Marine Guardian LLC" 1028 "Autel Intelligent Technology Corp., Ltd" 1027 "Goldacres PTY LTD" 1026 "ZTR Control Systems, LLC" 1025 "eze System, Inc." 1024 "Inventus Power" 1023 "PEAK-System Technik GmbH" 1022 "ITC Inc" 1021 "Entratech Systems LLC" 1020 "Onyx Marine Automation s.r.l." 1019 "Codek Foundries" 1018 "Flex TTS" 1017 "Caldaro AB" 1016 "Röhren- und Pumpenwerk BAUER GmbH" 1015 "SECURITAG SAS" 1014 "Briri Maschinenbau GmbH" 1013 "Allochis E-Tec" 1012 "Rhodan Marine Systems of Florida LLC" 1011 "Soundmax Electronics Ltd" 1010 "Agricultural Industry Electronics Foundation e.V." 1009 "TouchTronics, Inc." 1008 "Lintest Systems LLC" 1007 "Maschinenfabrik Meyer-Lohne GmbH" 1006 "Proterra" 1005 "TSE Brakes, Inc." 1004 "Ultraflex SpA" 1003 "technotrans SE" 1002 "Kussmaul Electronics Co." 1001 "Cleral Inc." 1000 "Landmaschinen Wienhoff GmbH" 1569 "621 Technologies Inc." 999 "TerraTroniq B.V." 998 "Transcell Technology Inc" 997 "Xenta Systems Srl" 996 "Eniquest Pty Ltd" 995 "Circuitlink Pty Ltd." 994 "Morris Industries Ltd." 993 "Alelion Energy Systems AB" 992 "MarineIOT LLC" 991 "Deutronic Elektronik GmbH" 990 "SAMSUNG SDI Co., Ltd." 989 "Flux-Geräte GmbH" 988 "Voith Turbo" 987 "Baltic Car Equipment" 986 "AAMP Global" 985 "NLR, LLC" 984 "E-T-A Elektrotechnische Apparate GmbH" 983 "Dezwaef NV" 982 "Briggs & Stratton Corporation" 981 "Kobelt Manufacturing Co. Ltd" 980 "Gussi Italia S.R.L." 979 "McHale" 978 "Canfield Connector" 977 "Emerson Electric Co." 976 "Derive Systems, Inc." 975 "Siemens AG" 974 "Pico Technology Limited" 973 "Zasso GmbH" 972 "Axion AG" 971 "B+B Smartworx" 970 "Jaboni Power Products, LLC" 969 "Blue Sea Systems" 968 "Cox Powertrain Limited" 967 "Moteck Electric Corp." 966 "VisibleFarm" 965 "Ro-Sys Software" 964 "AgroVIR Kft" 963 "Thomason Jones Company, LLC" 962 "Timbolier Industries, Inc." 961 "POK SAS" 960 "Vemcon GmbH" 959 "Cascade Corporation" 958 "NHK MEC Corporation" 957 "Sierra Wireless Inc" 956 "Piher Sensors & Controls S.A." 955 "Hottinger Baldwin (Suzhou) Electronic Measurement Technology Co., Ltd." 954 "Setec Pty Ltd" 953 "Curtiss-Wright" 952 "Tan Delta Systems Ltd" 951 "Exor International S.p.A." 950 "RE:Lab s.r.l." 949 "Škoda Electric a.s." 948 "Donix" 947 "Gerd Bär GmbH" 946 "Hydac Tecnologia Ltda" 945 "Equalizer AG" 944 "ZONTISA Marine SL" 943 "FISCHER AG Präzisionspindeln" 942 "Vogelsang GmbH & Co. KG" 941 "Navya" 940 "Dometal Oy" 939 "Warn Industries, Inc." 938 "LEVEL Systems" 937 "Precision Circuits Inc" 936 "Hi-tech Millennium" 935 "Meels GmbH & Co. KG" 934 "Farmobile, Inc." 933 "Delta Mobile Systems, Inc." 932 "Discover Battery" 931 "Enertec Marine Ltd" 930 "Ecotronix Corp." 929 "Jl Marine Systems, Inc." 928 "EAO Automotive GmbH & Co. KG" 927 "Saicon" 926 "Buhler Industries Inc." 925 "GW Lisk Company" 924 "PAS Peschak Autonome Systeme GmbH" 923 "ELTEK S.p.A." 922 "Terberg Benschop B.V." 921 "ROPA Fahrzeug- und Maschinenbau GmbH" 920 "MTD Consumer Group Inc." 919 "Furrion LLC" 918 "AMW Machine Control, Inc" 917 "Sentinel d.o.o." 916 "Turck Inc." 915 "Dosificacion y sistemas electronicos S.L. (DSE)" 914 "ZETOR TRACTORS a.s." 913 "Toyota Motor Corporation" 912 "Steyr Motors GmbH" 911 "Nautic-On" 910 "Hermann Paus Maschinenfabrik GmbH" 909 "Marines Co., Ltd." 908 "Chonbuk National University Department of Electronics" 907 "strautmann" 906 "MOBA AG" 905 "ASA Electronics" 904 "Equipment Safety Systems Pty. Ltd. (EQSS)" 903 "InMotion" 902 "Bucher Hydraulics" 901 "Zivan Srl" 900 "OSB AG" 899 "Lippert Components, Inc" 898 "Josef Kotte Landtechnik GmbH & Co. KG" 897 "Dot Technology Corp." 896 "NextFour Solutions Ltd" 895 "Peloton Technology" 894 "Rhodan Marine Systems of Florida LLC" 893 "KlinkTechnics Ltd." 892 "Mectronx Corp" 891 "CarrierWeb" 890 "L3 Technologies, Inc." 889 "SANY America Inc" 888 "Carma Systems Inc" 887 "Hyperdrive Innovation Limited" 886 "Hitachi Zosen Corporation" 885 "SICK Stegmann GmbH" 884 "Sure Grip Controls Inc." 883 "Swift Navigation, Inc." 882 "BHTronik GmbH & Co. KG" 881 "Sovema" 880 "Revision Military" 879 "PG Trionic, Inc." 878 "FOTON" 877 "SICK ATech GmbH" 876 "SUCO Robert Scheuffele GmbH & Co. KG" 875 "Salvarani S.r.l." 874 "MTA S.p.A." 873 "Garnet Instruments Ltd." 872 "Kählig Antriebstechnik GmbH" 871 "Superior Tech Inc" 870 "Textron Fleet Management" 869 "Intercomp" 868 "Data Panel Corp" 867 "Skeleton Technologies" 866 "Netradyne, Inc." 865 "MyEasyFarm" 864 "Streamline Transportation Technologies Inc." 863 "SMAG" 862 "Prospec Electronics" 861 "Adel System S.r.l." 860 "Michelin" 859 "Valor" 858 "Littelfuse" 857 "Zoomlion Heavy Industry NA, Inc" 856 "FarmFacts GmbH" 855 "Toshiba Infrastructure Systems & Solutions Corporation" 854 "GEMAC Chemnitz GmbH" 853 "Teledyne RESON B.V." 852 "Velvac Inc" 851 "Novotechnik Messwertaufnehmer OHG" 850 "Geoprospectors GmbH" 849 "MTS Maschinentechnik Schrode AG" 848 "ningupex" 847 "Oceanvolt" 846 "L3 Magnet-Motor" 845 "GMB Güstrower Maschinenbau GmbH" 844 "FELL AS" 843 "Hendrickson Truck Commercial Vehicle Systems" 842 "DigiDevice Srl" 841 "Agra-GPS" 840 "E.S.T.E. Srl" 839 "Indexator Rotator Systems AB" 838 "Teamsurv Ltd" 837 "Famic Technologies Inc." 836 "Signature4" 835 "PetTrack Ltd." 834 "Pioneer Microsystems, Inc." 833 "Electrum Automation AB" 832 "Heizomat Gerätebau-Energiesysteme GmbH" 831 "DOK-ING Ltd." 830 "Ultra Motion LLC" 829 "Drov Technologies, Inc." 828 "AgriBrink Inc." 827 "INmatix Technology Group Ltd" 826 "Lewmar Marine Inc" 825 "BPW Hungária" 824 "Undheim Systems AS" 823 "ACEINNA, Inc (formerly MEMSIC, Inc)" 822 "Bren-Tronics, Inc." 821 "Thorsen Teknik A/S" 820 "DIaLOGIKa Gesellschaft fuer angewandte Informatik mbH" 819 "Preco Electronics" 818 "HGNSS" 817 "TE Connectivity Sensor Solutions" 816 "UniStrong" 815 "FLIR Systems, Inc." 814 "Kronotech Srl (formerly Soltec Soluzioni Tecnologiche Srl)" 813 "Thales Suisse SA" 812 "Torch Technologies" 811 "Blue Water Desalination" 810 "Dutch Power Company" 809 "HMS Industrial Networks AB" 808 "RIMEX Supply Ltd." 807 "Schneider-Electric" 806 "Charge Automotive Ltd" 805 "Gundersen & Løken AS" 804 "ASA Electronics" 803 "Gill Sensors & Controls Limited" 802 "SPBI (Bj Technologie)" 801 "LOR Manufacturing Company Inc." 800 "Delta-Q Technologies" 799 "Stillwater Designs and Audio, Inc. - KICKER" 798 "Lumishore Ltd" 797 "Tides Marine" 796 "Canadian Automotive Industries Ltd" 795 "Broyda Enterprises Pty Ltd" 794 "Shihlin Electric & Engineering Corporation" 793 "James Fisher Prolec" 792 "Kostal Mexicana" 791 "AUTEC" 790 "VACALL" 789 "GRADALL" 788 "MoTeC Pty Ltd" 787 "Abertax Technologies Limited" 1863 "Thomas G. Faria Co." 1862 "Sanshin" 1861 "Vector North America" 1860 "MMP" 1859 "Kvasar AB" 1858 "Litton" 1857 "Simrad" 1856 "Trimble" 1855 "Furuno USA" 1854 "Northstar Technologies" 1853 "Japan Radio Co" 1852 "Navionics" 1851 "RayMarine" 1850 "Seastar Solutions (formerly Teleflex)" 786 "Johnson Matthey Battery Systems" 785 "Fischer Panda GmbH" 784 "CM Automotive Systems, Inc." 783 "Loup Electronics Inc." 782 "AVR bv (formerly AVR bvba)" 781 "Poly-Planar LLC" 780 "AVID Technology Ltd" 779 "RLC Electronic Systems" 778 "Seakeeper Inc." 777 "Ocean Signal Ltd" 776 "HMI Systems LLC" 775 "ZIEHL-ABEGG Automotive GmbH" 774 "Taisho Corporation" 773 "Clarion Corporation of America" 772 "Blink Marine" 771 "Shaw Development, LLC" 770 "MONOSEM" 769 "Trombetta" 768 "Flores Automation, LLC" 767 "Alliance Wireless Technologies Inc." 766 "Epec Oy" 765 "GIGAVAC" 764 "Bednar FMT s.r.o." 763 "AT-Systems BVBA" 762 "ROJ s.r.l." 761 "MITA OLEODINAMICA S.p.A." 760 "Bernecker + Rainer Industrie Elektronik GmbH" 759 "Hydro-Gear" 758 "Banner Engineering Corp." 757 "IMPCO Technologies" 756 "Maschio Gaspardo S.P.A." 755 "Firefly Integrations" 754 "Parker Hannifin Corp., Automation Group" 753 "AIROD Technologies" 752 "Deep Sea Electronics Plc" 751 "Pacific Track" 750 "Joskin SA" 749 "Chart Inc." 748 "ISOTTA" 747 "Agratronix" 746 "SureFire Ag Systems, Inc." 745 "Cidra Corporate Services Inc." 744 "Woosung Engineering Co., Ltd." 743 "Daemyung Elevator Co., Ltd." 742 "EROAD" 741 "Carling Technologies" 740 "e-Traction" 739 "LXNAV d.o.o." 738 "Blue Ink Technologies" 737 "Balluff GmbH" 736 "Terex Aerial Work Platforms - Genie" 735 "AEM Performance Electronics" 734 "REAPsystems" 733 "Intendia S.L." 732 "Gefran S.p.A." 731 "Modine Manufacturing Company" 730 "BERTHOUD AGRICOLE" 729 "Liebherr" 728 "Streumaster (formerly Streumaster / Panien)" 727 "Dhoot Transmission Pvt Ltd." 726 "MIDORI PRECISIONS" 725 "Hitachi Construction Machinery Co., Ltd." 724 "Electronic Applications, Inc." 723 "Jabil Inc." 722 "Contelec AG" 721 "Hypro" 720 "WITZ Corporation" 719 "Cojali S. L." 718 "Micronet Inc" 717 "Yacht Devices Ltd" 716 "Eaton Control & Power Conversion Division (CPCD)" 715 "Autonnic Research Ltd" 714 "Kobashi Kogyo Co., Ltd." 713 "US Hybrid Corporation" 712 "LOR Manufacturing Company Inc." 711 "DAS Co., LTD" 710 "Greentronics Ltd." 709 "Marquardt GmbH" 708 "Lars Thrane A/S" 707 "Rochester Gauges Inc" 706 "Shanghai Diesel Engine Corporation Limited" 705 "SVAB Hydraulik AB" 704 "JL Audio, Inc." 703 "Hydro Tab Marine Engineering" 702 "Weichai Power Co., Ltd." 701 "BigRoad Inc." 700 "K-Tec Earthmovers Inc." 699 "Harman International Industries" 698 "Scorpion Technologies Ltd." 697 "Ålö AB" 696 "DRS Network & Imaging Systems, LLC (DRS Technologies)" 695 "Weldon Technologies" 694 "GasTOPS Ltd." 693 "Agility Fuel Solutions (formerly Agility Fuel Systems)" 692 "Tanhay Corporation" 691 "Digitroll Agricultural Electronics" 690 "LINAK A/S" 689 "Aarcomm Systems Inc" 688 "Rockford Corp" 687 "Flight Systems, Inc." 686 "Taigene Electric Machinery Corp." 685 "ANEDO (formerly ANEDO Ltd.)" 684 "KEB" 683 "Fosen Elektro" 682 "Eckelmann AG" 681 "BEDIA Motorentechnik GmbH & Co. KG" 680 "AMVAC Chemical Corporation" 679 "Cimco Marine AB" 678 "KeepTruckin, Inc." 677 "DSA Daten- und Systemtechnik GmbH" 676 "Danfoss IXA A/S" 675 "Kawasaki Motors Corp., USA" 674 "Yara International ASA" 673 "Caruelle Nicolas" 672 "OPTIMA Concept" 671 "Innovative Controls Inc." 670 "STEMCO LP" 669 "Quantum Fuel Systems Technologies Worldwide, Inc" 668 "MacDon Industries Ltd." 667 "Bartec" 666 "Schaeffler Technologies AG & Co., KG" 665 "Gebr. Bode GmbH & Co. KG" 664 "Level Developments Ltd" 663 "Delta Systems, Inc" 662 "Kissling Elektrotechnik GmbH" 661 "SPAL Automotive S.r.l." 660 "Auto-Gaz Centrum" 659 "Data Panel Corp." 658 "Shenzhen Jiuzhou Himunication Technology Co., Ltd" 657 "Terzo Power Systems" 656 "PRO SOLUS do Brasil" 655 "Genge & Thoma AG" 654 "Kohler Power Systems, Detroit Engine Development Center (DEDC)" 653 "AEV, spol. s r. o." 652 "MicroControl GmbH & Co. KG" 651 "Takakita Co, Ltd." 650 "Seiko Epson Corp." 649 "Control-Q B.V." 648 "OJSC Ekran" 647 "Siloking" 646 "Veenhuis Machines B.V." 645 "esd electronic system design gmbh" 644 "KUS USA" 643 "Bogballe A/S" 642 "Moog / Aspen Motion Technologies" 641 "Diverse Yacht Services" 640 "Power Solutions International" 639 "Startec s.r.l." 638 "KVH Industries, Inc." 637 "Bavaria Yachtbau GmbH" 636 "Divelbiss Corporation" 635 "Argo Tractors S.p.A." 634 "Rocky Research" 633 "TORC Robotics" 632 "Pepperl+Fuchs GmbH" 631 "Reltima" 630 "SmartDrive Systems Inc." 629 "Agri Info Design, Ltd." 524 "Vomax Instrumentation Pty. Ltd." 523 "Reggio Emilia Innovazione" 522 "Nebraska Tractor Test Laboratory" 521 "Clever Devices Ltd." 520 "Trapeze" 519 "Peeters Landbouwmachines b.v." 518 "Transas USA Inc." 517 "Noland Engineering" 516 "AVAT Automation GmbH" 515 "GINAF Trucks Nederland B.V." 514 "DISTek Integration, Inc." 513 "Precision Technology (Formerly FarmscanAg)" 512 "Inpower LLC" 511 "Sulky" 510 "Marinesoft Co. Ltd" 509 "MOTORTECH GmbH" 508 "Transtech Innovations" 507 "ISOBUS Test Center" 506 "IHI STAR Machinery Corporation" 505 "Yetter Farm Equipment" 504 "Vesper Marine" 503 "Naviop S.R.L." 502 "Attwood Corporation" 501 "Agrotronix S.A." 500 "Oxbo International Corporation" 499 "LCJ Capteurs" 498 "Innovative Design Solutions, Inc." 497 "SENTRON Sistemas Embarcados" 496 "W. Gessmann GmbH" 495 "HOLMER Maschinenbau GmbH" 494 "Synerject" 493 "Watcheye" 492 "Inergy Automotive Systems" 491 "Penny and Giles Ltd" 490 "QuikQ" 489 "Appareo Systems, LLC" 488 "The Charles Machine Works, Inc." 487 "DSE Test Solutions A/S" 486 "Westport Innovations Inc." 485 "MATT automotive" 484 "Headsight Inc." 483 "Valeo" 482 "Tricon Electronics" 481 "Chetco Digital Instruments" 480 "EnerDel, Inc." 479 "Vapor Bus International" 478 "OceanSat B.V." 477 "OilQuick AB" 476 "Hummingbird Marine Electronics" 475 "GME" 474 "Persen Technologies Inc." 473 "Boss Industries, Inc." 472 "Tenneco Inc." 471 "Sea Cross Marine AB" 628 "Falck Schmidt Defence Systems" 627 "Radio Ocean" 626 "AVL DiTEST GmbH" 625 "Global MRV Inc." 624 "Blackbox Machine Control Pty Ltd" 623 "Xirgo Technologies" 622 "Floyd Bell Inc" 621 "Hagie Manufacturing Company" 620 "Sevcon Ltd." 619 "Right Weigh Load Scales" 618 "Evrard SA" 617 "Zero Emission Vehicles" 616 "SMART-TEC s.r.o." 615 "Networkfleet, Verizon Telematics" 614 "ARLT Technologies GmbH" 613 "HKS Co., Ltd." 612 "Samwon IT" 611 "Esterline" 610 "Trail Tech" 609 "Walvoil S.p.A." 608 "Gale Banks Engineering" 607 "Knappco/Civacon" 606 "Intellian Technologies" 605 "Aventics GmbH" 604 "Indexator Rototilt Systems AB" 603 "Kereval" 602 "Nomad Digital Ltd." 601 "Navitas Systems" 600 "Aquatic AV" 599 "Spudnik Equipment Co, LLC" 598 "ABB Turbo Systems Ltd" 597 "Hydac Filter Systems GmbH" 596 "Brunelco Electronic Innovators B.V." 595 "CustomWare" 594 "Kongsberg Automotive" 593 "Sensata Technologies" 592 "tecsis GmbH" 591 "United States Coast Guard" 590 "ARGO-HYTOS GMBH" 589 "MICO, Inc." 588 "Vignal Systems" 587 "JCA Electronics" 586 "Suzuki Motor Corp" 585 "Industrial Electronic Controls" 584 "CarMedialab GmbH" 583 "Yachtcontrol" 582 "Innovative Software Engineering" 581 "Väderstad - Verken AB" 580 "San Jose Technology, Inc." 579 "KVH Industries, Inc." 578 "advanSea" 577 "Denchi Power Ltd  (formerly ABSL Power Solutions Limited)" 576 "Vectia" 575 "Lytx" 574 "Vishay Precision Group" 573 "Orolia Ltd" 572 "Fasse Valves" 571 "Marinecraft Co., Ltd." 570 "frenzel + berg electronic GmbH & Co. KG" 569 "LORD MicroStrain Sensing Systems" 568 "Makersan Ltd. Co." 567 "Lithiumstart LLC" 566 "Geode Technology, Inc." 565 "Micro-Trak Systems, Inc." 564 "Auto Power Electronic" 563 "LOHR Sistemas Eletronicos LTDA" 562 "Bombardier Transportation GmbH" 561 "b-plus GmbH" 560 "Iowa State University, Agricultural and Biosystems Engineering" 559 "Four Peaks Navigation" 558 "Davis Instruments Corp." 557 "Rockson Automation GmbH" 556 "Doosan Infracore Norway" 555 "Sasaki Corporation" 554 "iris-GmbH infrared & intelligent sensors" 553 "KIB Electronics" 552 "Matsuyama Plow Mfg Co, Ltd" 551 "Wexler CSD Ltd." 550 "SUN-A Corporation" 549 "ROAD Deutschland GmbH" 548 "TM4 Inc." 547 "Thomson Linear LLC" 546 "Maruyama Mfg Co, Inc." 545 "GS Hydraulics" 544 "Au Group Electronics" 543 "BAUER Maschinen GmbH" 542 "Dinamica Generale s.p.a." 541 "Total Fire Systems, Inc." 540 "Dinex A/S" 539 "Mobileview" 538 "Crop Ventures, Inc." 537 "Schrader Electronics Ltd." 536 "SSI Technologies" 535 "MOTORPAL, a.s." 534 "Webasto Thermo & Comfort SE" 533 "Doran Manufacturing, LLC" 532 "Onwa Marine Electronics Co Ltd." 531 "Genge & Thoma AG" 530 "NMEA" 529 "National Instruments Korea" 528 "Hoganas AB, Electric Drive Systems" 527 "GKN Walterscheid GmbH" 526 "LOFA Industries, Inc" 525 "Rust Sales INC" 470 "SI-TEX Marine Electronics" 469 "RA Consulting GmbH" 468 "Tyco Fire Protection Products" 467 "Lely Industries N.V." 466 "Veethree Electronics and Marine LLC" 465 "Ashcroft Inc" 464 "Leach International Corporation" 463 "PROBOTIQ" 462 "IHI Shibaura Machinery Corporation" 461 "HAWE Hydraulik SE" 460 "San Giorgio S.E.I.N." 459 "Alltek Marine Electronics Corp" 458 "Control Solutions, Inc." 457 "RUSELPROM-ElectricDrive Ltd" 456 "General Kinetics" 455 "ADZ NAGANO GmbH" 454 "NGK Spark Plug Co. Ltd" 453 "Cooper Bussmann" 452 "WIKA Alexander Wiegand SE & Co. KG" 451 "Parker Hannifin Corp" 450 "Dycor Technologies Ltd." 449 "Polaris Industries Inc" 448 "Stanadyne Corporation, Electronics Systems" 447 "Great Plains Mfg." 446 "CertTech, L.L.C." 445 "KAT MECHATRONIC, Electronic Product Division" 444 "ITT Power Solutions" 443 "SignalQuest, Inc." 442 "Horsch Maschinen GmbH" 441 "PTG Reifendruckregelsysteme GmbH" 440 "Cummins Power Generation" 439 "Hyundai Heavy Industries" 438 "Comar Systems Ltd" 437 "Digital Yacht Limited" 436 "Kinze Manufacturing" 435 "Zunhammer GmbH" 434 "Stored Energy Systems" 433 "Rowe Electronics" 432 "S&A Systems, Inc." 431 "Tohatsu Corporation" 430 "Auteq Telematica S.A." 429 "Rota Engineering Ltd." 425 "Methode Electronics Inc, MDI" 424 "Odyne LLC" 423 "BSM Wireless, Inc." 422 "True Heading AB" 421 "Vertex Standard Co, Ltd" 420 "Vermeer Corporation, ACS Group" 419 "Fusion Electronics Ltd" 418 "Intellistick Inc" 417 "KZValve" 416 "Kubota Corporation" 415 "Valid Manufacturing Ltd." 414 "Cattron Group International" 413 "Datapross Nijbroek bv" 412 "WebTech Wireless Inc." 411 "Hy-Drive Technologies Ltd." 410 "COBO S.p.A. Divisione 3B6" 409 "Transfluid S.r.L." 408 "Corvus Energy Ltd." 407 "Comtech Mobile Datacom" 406 "Vecima Networks Inc." 405 "Wema System AS" 404 "Com Nav Marine Ltd" 403 "Trackwell ADS, Inc." 402 "Simma Software, Inc." 401 "Torqeedo GmbH" 400 "Livorsi Marine" 399 "ISEKI & Co., Ltd." 398 "Hilite International" 397 "Sanyo-kiki Co Ltd." 396 "Beyond Measure" 395 "GENTEC S.R.L." 394 "Capi 2 Nederland B.V." 393 "Harvest Tec, Inc" 392 "Tianyuan Technology Co Ltd." 391 "Electronic Design for Industry, Inc" 390 "Partech Inc." 389 "Benchmark Electronics, Minnesota Division" 388 "Innomatix, LLC" 387 "Orscheln Products, LLC" 386 "JLG Automation BVBA" 385 "Johnson Outdoor Marine Electronics" 384 "Camano Light" 383 "MCL Industries" 382 "National Agriculture and Food Research Organization" 381 "B & G" 380 "Suntech International Ltd." 379 "Yamabiko Corporation" 378 "Glendinning Marine Products" 377 "ifm electronic gmbh" 376 "Quake Global" 375 "Williams Controls Inc." 374 "Northern Lights, Inc." 373 "Electronic Design Inc." 372 "Delphi" 371 "Heinzmann GmbH & Co. KG" 370 "Rolls-Royce Marine AS" 369 "Power Torque Engineering Ltd" 368 "HANSENHOF_electronic" 367 "Fliegl Agrartechnik" 366 "Viewnyx Corp." 365 "Digi-Star, LLC" 364 "OEM Controls Inc." 363 "BEI Duncan" 362 "Poettinger Landtechnik GmbH (formerly Alois Poettinger Maschinenfabrik GmbH)" 361 "InMach" 360 "HJS Emission Technology GmbH & Co KG   (formerly HJS Fahrzeugtechnik GmbH & Co KG)" 359 "Ludwig Bergmann GmbH" 358 "Victron Energy B.V." 357 "Hardi International A/S" 356 "Fischer Panda Generators, Inc" 355 "Mastervolt International B.V." 354 "Junkkari OY" 353 "Hegemon Electronics, Inc." 352 "SAME DEUTZ-FAHR GROUP S.p.A." 351 "Thrane & Thrane" 350 "Noris Marine Systems GmbH & Co KG" 349 "Suonentieto" 348 "Amazonen Werke H. Dreyer" 347 "Honeywell" 346 "Control Solutions" 345 "Korean Maritime University" 344 "Parvus Corporation" 343 "Baumer Group" 342 "THOMAS MAGNETE GmbH" 341 "Boning GmbH & Co" 340 "Continental AG" 339 "Competence Center ISOBUS e.V." 338 "GRAF-SYTECO" 337 "Carraro S.p.A." 336 "APE s.r.o." 335 "Evo Electric Ltd" 334 "Takata-Petri AG" 333 "Hadley Products Corporation" 332 "HWH Corporation" 331 "Horton, Inc." 330 "Kidde Aerospace and Defense" 329 "Deif A/S" 328 "Qwerty Electronik AB" 327 "Sonceboz SA" 326 "Akron Brass Company" 325 "ASM Automation Sensorik Messtechnik GmbH" 324 "Snap-on Diagnostics" 323 "Mobileye Vision Technologies Ltd." 322 "MICHENKA s.r.o." 321 "Ultra Electronics, Electrics" 320 "Miedema Landbouwwerktuigenfabriek B.V." 319 "Cadec Global" 318 "SAT Plan" 317 "Navtronics Bvba" 263 "IMMI" 262 "HydraForce, Inc" 261 "Red Dot Corporation" 260 "Reichhardt GmbH Steuerungstechnik" 259 "Jetter AG" 258 "ARAG" 257 "Honda Motor Co., Ltd" 256 "Tyco Electronics AMP" 255 "MEAS France" 254 "GE Sensing" 253 "Mobile Control Systems" 252 "Sensor-Technik Wiedemann GmbH" 251 "German Agricultural Society, Test Center (DLG)" 250 "Kuhn Group" 249 "Schaltbau GmbH" 248 "Cooper Standard Automotive Active Systems Group" 247 "ePULSE" 246 "Class 1, Inc" 245 "Capstan Ag Systems, Inc." 244 "Techno-Matic" 243 "eRide, Inc." 242 "Kokusandenki Co. Ltd" 241 "Schneider Automation SAS" 240 "Vanair Mfg" 239 "May & Scofield Ltd" 238 "ZF Friedrichshafen AG" 237 "Agtron Enterprises Inc" 236 "NORAC Systems International Inc" 235 "SailorMade Marine Telemetry - Tetra Technology Ltd." 234 "Mondial electronic GmbH" 233 "Yacht Monitoring Solutions Inc." 232 "TSD Integrated Controls" 231 "Topcon Positioning Systems, Inc." 230 "Saucon Technologies" 229 "Garmin International Inc." 228 "Unused (formerly ZF Marine Electronics)" 227 "Lykketronic A/S" 226 "Monaco Coach Corporation" 225 "SKF" 224 "EMMI Network, S.L." 223 "Vaueo Retarder Co., Ltd." 222 "Generac Power Systems, Inc." 221 "SiE" 220 "Beede Electrical Instrument Company, Inc" 219 "Cat OEM Solutions" 218 "Gits Manufacturing Company" 217 "RM Michaelides Software & Elektronik GmbH" 216 "Paneltronics Inc." 215 "Aetna Engineering/Fireboy-Xintex" 214 "MC elettronica Srl" 164 "MTU Friedrichshafen GmbH (formerly DaimlerChrysler Off-Highway)" 163 "BRP Inc." 162 "Axiomatic Technologies" 161 "Offshore Systems (UK) Ltd" 160 "Nido" 159 "NTech Industries Inc" 158 "Firestone Industrial Products Company" 157 "ISSPRO Inc." 156 "ITT Industries - Cannon" 155 "Vetronix Corporation" 154 "Westerbeke Corporation" 153 "Woodward, Industrial Controls Division" 152 "elobau GmbH & Co. KG" 151 "Raven Industries, Inc." 150 "Fleetguard" 149 "Holset" 148 "Blue Water Data, Inc." 147 "Nautibus electronic GmbH" 146 "Maxima Technologies" 145 "MurCal Controls" 144 "Mercury Marine" 143 "W. Gmeiner GmbH & Co." 142 "TRW Automotive (Commercial Steering Systems)" 141 "Thales Navigation Ltd." 140 "Lowrance Electronics, Inc." 139 "Caterpillar Trimble Control Technologies (CTCT), LLC" 138 "Georg Fritzmeier GmbH & Co. KG" 137 "Maretron" 136 "Komatsu Ltd" 135 "Airmar Technology Corporation" 134 "Iris Technology Ltd" 133 "Bucher Schoerling GmbH" 132 "Mulag-Fahrzeugwerk" 131 "ITT Industries" 130 "Nido - Universal Machines B.V." 129 "OMNEX Control Systems Inc." 128 "Gerhard Duecker GmbH & Co. KG" 127 "Holland USA" 126 "Driver Tech" 125 "Nevada Automotive Test Center" 124 "Hydac Electronic" 123 "Basler Electric" 122 "FG Wilson (Engineering) Limited" 121 "HED (Hydro Electronic Devices, Inc.)" 120 "RDS Technology Ltd" 119 "IntegriNautics  " 118 "Intron GmbH" 117 "HUSCO International" 116 "BEELINE Technologies" 115 "NACCO Materials Handling Group, Inc." 114 "EControls, Inc." 113 "Stress-Tek, Inc." 112 "MECALAC" 111 "Bernard Krone Holding SE & Co. KG (formerly Maschinenfabrik Bernard Krone GmbH)" 110 "EPIQ Sensor-Nite" 109 "TeeJet Technologies Denmark (formerly LH Technologies ApS)" 108 "WTK-Elecktronik GmbH" 107 "Grimme Landmaschinen GmbH & Co. KG" 106 "BAE Systems Controls, Inc." 105 "Kiepe Elektrik GmbH & Co. KG" 104 "CLAAS KGaA mbH (formerly CLAAS Selbstfahrende Erntemaschinen GmbH)" 103 "CLAAS E-Systems GmbH (formerly CLAAS E-Systems KGaA mbH & Co. KG)" 102 "AGCO (formerly AGCO GmbH & Co.)" 101 "Sensoria" 100 "VDO Technik AG" 99 "International Transmissions Ltd (ITL)" 98 "Mueller-Elektronik GmbH & Co" 97 "Ag Leader Technology, Inc." 96 "Mech@tronic IT GmbH" 95 "Pacific Insight Electronics Corp." 94 "CNH Industrial N.V. (formerly CNH Global N.V.)" 93 "Perkins Engines Company Ltd." 92 "Ag-Chem Equipment Co., Inc." 91 "BSG Bodensee Steuergeraete GmbH" 90 "Knorr-Bremse SfN GmbH" 89 "Kverneland Group, Electronics Division" 88 "Hemisphere GPS Inc (formerly Satloc Precision GPS)" 87 "J.C. Bamford Excavators Ltd (JCB)" 86 "C. E. Niehoff & Company" 85 "Kohler Co" 84 "New Holland UK Limited" 83 "Bendix VORAD Technologies (formerly Eaton VORAD Technologies)" 82 "Bobcat/Ingersoll-Rand (formerly Melroe/Ingersoll-Rand)" 81 "Fire Research Corp." 80 "Twin Disc, Inc." 79 "Daimler Benz AG - Engine Division (PBM)" 78 "Frank W. Murphy Manufacturing, Inc" 77 "Deere Power Systems Group" 76 "unused (formerly Deere & Co, Construction Division)" 75 "Deere & Co, Agricultural Division" 74 "Eaton Axle-Brake Division" 73 "LeTourneau, Inc." 72 "Sisu Corporation" 71 "Vansco Electronics Ltd." 70 "Flex-coil Limited" 69 "Trimble Navigation" 316 "ITT Flow Control" 315 "Icom Incorporated" 314 "CSM GmbH" 313 "Ilmor Engineering, Inc." 312 "Lectronix, Inc." 311 "Patrick Power Products" 310 "TECNORD srl" 309 "Krauss-Maffei Wegmann GmbH & Co. KG" 308 "Cyntrx" 307 "MAS Technologies" 306 "Sleipner Motor AB" 305 "NovAtel Inc" 304 "EmpirBus AB" 303 "CTS Corporation" 302 "Nissin Kogyo Co., LTD" 301 "Parker Hannifin (UK) Ltd FDE group" 300 "Systron Donner Automotive" 299 "Rauch" 298 "Holley Performance" 297 "Zonar Systems Inc" 296 "micro dynamics GmbH" 295 "BEP Marine" 294 "Grayhill Inc." 293 "Spyder Controls Corp." 292 "IKUSI - Angel Iglesias S.A." 291 "Groeneveld Transport Efficiency BV" 290 "Kuebler GmbH" 289 "Watlow" 288 "Mitsubishi FUSO Truck & Bus Corp." 287 "NTech Industries, Inc" 286 "Coelmo srl" 285 "Sea Recovery Corp" 284 "Mobile Tech Chile" 283 "CWF Hamilton & Co Ltd" 282 "Medallion Instrumentation Systems" 281 "Precision Governors LLC" 280 "Leica Geosystems Pty Ltd" 279 "Geometris LP" 278 "Takata Electronics" 277 "LHP Telematics" 276 "Aqua-Hot Heating Systems" 275 "Navico Egersund AS" 274 "LTW Technology Co., LTD" 273 "Active Research Limited" 272 "Gross Mechanical Laboratories, Inc" 271 "Cole Hersee" 270 "Tennant" 269 "Saft America Inc.,  Space & Defense Division" 268 "Accurate Technologies" 267 "Red Lion Controls, Inc" 266 "International Thermal Research Ltd" 265 "MTS Sensor Technologie GmbH" 264 "Autolync" 213 "CNH Belgium N.V." 212 "Sure Power Industries, Inc" 211 "DNA Group" 210 "Iteris, Inc." 209 "Bell Equip. Co. SA (PTY) LTD" 208 "Drew Technologies, Inc" 207 "Otto Engineering" 206 "port GmbH" 205 "SmarTire Systems Inc" 204 "The Morey Corporation" 203 "MILtronik GmbH" 202 "Curtis Instruments, Inc" 201 "Disenos y Tecnologia S.A." 200 "MGM Brakes" 199 "ACTIA Group (formerly Actia Corp)" 198 "Mystic Valley Communications" 197 "Mechron Power Systems" 196 "LEMKEN GmbH & Co KG" 195 "General Engine Products" 194 "TriMark Corporation" 193 "Jeppesen Marine" 192 "Floscan" 191 "XRS Corporation (formerly XATA Corporation)" 190 "Hella KGaA Hueck & Co" 189 "QUALCOMM" 188 "EMP Corp" 187 "Air-Weigh" 186 "Altronic, Inc" 185 "Beede Electrical Instrument Company" 184 "EIA Electronics" 183 "KDS Controls, Inc" 182 "Vehicle Systems Engineering B.V." 181 "Coretronics, Inc." 180 "Smart Power Systems" 179 "TeeJet Technologies Springfield (formerly Midwest Technologies Illinois, LLC)" 178 "Continental Automotive GmbH (formerly Siemens VDO Automotive AG)" 177 "Diagnostic Systems Associates" 176 "Moritz Aerospace" 175 "Veris Technologies, Inc." 174 "AB Volvo Penta" 173 "Ryeso, Inc." 172 "Yanmar Co., Ltd. (formerly Yanmar Marine USA)" 171 "Topcon Electronics GmbH & Co. KG (formerly Wachendorff Elektronik GmbH & Co. KG)" 170 "Computronics Corporation Ltd." 169 "Marlin Technologies Inc." 168 "Xantrex" 167 "JLG Industries Inc" 166 "John Deere Electronic Solutions (formerly Phoenix International)" 165 "CPAC Systems AB" 68 "Scania" 67 "John Deere Coffeyville Works (formerly Funk Manufacturing Company)" 66 "John Deere Construction Equipment Division" 65 "MAN Nutzfahrzeuge AG" 64 "Unused (formerly SpectraPrecision Laserplane, then SpectraPhysics)" 63 "ZF Industries Inc." 62 "Wabco" 61 "Volvo Truck Corp." 60 "Volvo Trucks North America Inc." 59 "VES Inc." 58 "SPX Corporation, OTC Div" 57 "Danfoss  (formerly Sauer Sundstrand Co, then Sauer-Danfoss Co)" 56 "SAIC" 55 "Ryder System Inc." 54 "Meritor Wabco" 53 "Continental Automotive Systems US, Inc. (formerly Rockwell Land Transportation)" 52 "Meritor Automotive, Inc. (formerly Rockwell Automotive)" 51 "Robert Bosch GmbH" 50 "Robert Bosch Corp" 49 "RE America Inc." 48 "Pollak Alphabet" 47 "Phillips Semiconductor" 46 "Noregon Systems, Inc  (formerly Parasoft Computing Solutions)" 45 "PACCAR" 44 "Nippondenso Co. Ltd." 43 "International Truck and Engine Corporation - Vehicle Electronics (formerly Navistar Intl Trans Corp.)" 42 "International Truck and Engine Corporation - Engine Electronics  (formerly Navistar Intl Trans Co., Engine Electronics)" 41 "Motorola Inc." 40 "Motorola AIEG Inc." 39 "Microfirm Inc." 38 "Micro Processor Systems Inc." 37 "Mack Trucks Inc." 36 "Lucas Ind." 35 "Kenworth Truck Co." 34 "Kelsey Hayes Co." 33 "John Deere" 32 "Jacobs Vehicle Systems" 31 "J Pollak Corp" 30 "Isuzu Motors Ltd" 29 "Hino Motors Ltd." 28 "Grote Ind. Inc." 27 "GMC" 26 "General Motors Corp, Service Technology Grp" 25 "Daimler Trucks North America LLC (formerly Freightliner LLC)" 24 "Ford Motor Co., Vehicle Controls" 23 "Ford Motor Co., Heavy Truck" 22 "Ford Motor Co., Electronic Concepts & Systems" 21 "Echlin Inc., Midland Brake Inc." 20 "Eaton Ltd" 19 "Eaton Corp. Trucking Info Services" 18 "Eaton Corp, Transmission Div." 17 "Eaton Corp, Corp Res & Dev" 16 "Eaton Corp" 15 "DICKEY-john Corporation" 14 "Detroit Diesel Corporation" 13 "Delco Electronics" 12 "Deere & Company, Precision Farming" 11 "Dearborn Group Inc." 10 "Cummins Inc (formerly Cummins Engine Co)" 9 "Chrysler Corp." 8 "Caterpillar Inc." 7 "Case Corp." 6 "Berifors Electronics AB" 5 "AMP Inc." 4 "Ametek-Dixson" 3 "Ametek, US Gauge Division" 2 "Allison Transmission, Inc." 1 "Bendix Commercial Vehicle Systems LLC (formerly Allied Signal Inc.)" 0 "Reserved" ;
VAL_ 2362179319 TemperatureUnits 3 "NoAction" 2 "Reserved" 1 "Imperial" 0 "Metric" ;
VAL_ 2362179319 PressureUnits 3 "NoAction" 2 "Reserved" 1 "Imperial" 0 "Metric" ;
VAL_ 2362179319 ErrorCodeObjPool4 0 "NoError" 1 "ObjectPoolWasDeleted" ;
VAL_ 2362179319 ErrorCodeObjPool3 0 "NoError" 1 "GeneralError" ;
VAL_ 2362179319 ForceUnits 3 "NoAction" 2 "Reserved" 1 "Imperial" 0 "Metric" ;
VAL_ 2362179319 ErrorCodeObjPool2 0 "NoError" 1 "UnknownObjectReference" ;
VAL_ 2362179319 UnitsSystem 3 "NoAction" 2 "US" 1 "Imperial" 0 "Metric" ;
VAL_ 2362179319 ErrorCodeObjPool1 0 "NoError" 1 "MethodOrAttributeNotSupported" ;
VAL_ 2362179319 DistanceUnitCmd 3 "NoAction" 1 "Imperial" 0 "Metric" ;
VAL_ 2362179319 AreaUnitCmd 3 "NoAction" 1 "Imperial" 0 "Metric" ;
VAL_ 2362179319 VolumeUnitCmd 3 "NoAction" 2 "US" 1 "Imperial" 0 "Metric" ;
VAL_ 2362179319 MassUnitCmd 3 "NoAction" 2 "TonsPounds" 1 "Imperial" 0 "Metric" ;
VAL_ 2362179319 OriginCommand 15 "NotApplicable" 14 "TaskControllerStatus" 13 "PDACK" 8 "ChangeThreshold" 7 "MaxWithinThreshold" 6 "MinWithinThreshold" 5 "DistanceInterval" 4 "TimeInterval" 3 "ValueCommand" 2 "RequestValue" 1 "DeviceDescription" 0 "TechnicalData" 9 "PeerControlAssignment" 10 "SetValueAndAcknowledge" ;
VAL_ 2362179319 ErrorCodeProcessData8 1 "ProcessDataValueIsOutsideOperationalRange " 0 "NoError" ;
VAL_ 2362179319 ErrorCodeProcessData7 1 "ProcessDataValueNotConformToDDI " 0 "NoError" ;
VAL_ 2362179319 ErrorCodeProcessData6 1 "InvalidIntervalOrThreshold" 0 "NoError" ;
VAL_ 2362179319 ErrorCodeProcessData5 1 "ProcessDataNotSetable" 0 "NoError" ;
VAL_ 2362179319 ErrorCodeProcessData4 1 "TriggerMethodNotSupported" 0 "NoError" ;
VAL_ 2362179319 ErrorCodeProcessData3 1 "DDINotSupportedByElement" 0 "NoError" ;
VAL_ 2362179319 ErrorCodeProcessData2 1 "InvalidElementNumber" 0 "NoError" ;
VAL_ 2362179319 DataLogTimeInterval 0 "Stop measurement" ;
VAL_ 2362179319 DataLogDistanceInterval 0 "Stop measurement" ;

SG_MUL_VAL_ 2362179319 ActualCanopyHeight DDI 520-520;
SG_MUL_VAL_ 2362179319 GNSSInstallationType DDI 521-521;
SG_MUL_VAL_ 2362179319 LastBaleLifetimeCount DDI 519-519;
SG_MUL_VAL_ 2362179319 ActualTramlineCondensedWorkState DDI 518-518;
SG_MUL_VAL_ 2362179319 SetpointTramlineCondensedWorkSta DDI 517-517;
SG_MUL_VAL_ 2362179319 TramlineOverdosingRate DDI 516-516;
SG_MUL_VAL_ 2362179319 TramlineControlState DDI 515-515;
SG_MUL_VAL_ 2362179319 GNSSQuality DDI 514-514;
SG_MUL_VAL_ 2362179319 GuidanceLineDeviation DDI 513-513;
SG_MUL_VAL_ 2362179319 GuidanceLineSwathWidth DDI 512-512;
SG_MUL_VAL_ 2362179319 TrackNumberToLeft DDI 511-511;
SG_MUL_VAL_ 2362179319 TrackNumberToRight DDI 510-510;
SG_MUL_VAL_ 2362179319 ActualTrackNumber DDI 509-509;
SG_MUL_VAL_ 2362179319 UniqueABGuidanceReferenceLineID DDI 508-508;
SG_MUL_VAL_ 2362179319 TramlineSequenceNumber DDI 507-507;
SG_MUL_VAL_ 2362179319 SetpointTramlineControlLevel DDI 506-506;
SG_MUL_VAL_ 2362179319 TramlineControlLevel DDI 505-505;
SG_MUL_VAL_ 2362179319 MaxEngineTorque DDI 504-504;
SG_MUL_VAL_ 2362179319 MinEngineTorque DDI 503-503;
SG_MUL_VAL_ 2362179319 ActualEngineTorque DDI 502-502;
SG_MUL_VAL_ 2362179319 SetpointEngineTorque DDI 501-501;
SG_MUL_VAL_ 2362179319 LastEventPartnerIDDeviceClass DDI 500-500;
SG_MUL_VAL_ 2362179319 LastEventPartnerIDManufacturerID DDI 499-499;
SG_MUL_VAL_ 2362179319 LastEventPartnerIdType DDI 498-498;
SG_MUL_VAL_ 2362179319 LastEventPartnerID_Byte13to16 DDI 497-497;
SG_MUL_VAL_ 2362179319 LastEventPartnerID_Byte9to12 DDI 496-496;
SG_MUL_VAL_ 2362179319 LastEventPartnerID_Byte5to8 DDI 495-495;
SG_MUL_VAL_ 2362179319 LastEventPartnerID_Byte1to4 DDI 494-494;
SG_MUL_VAL_ 2362179319 LifetimeEngineHours DDI 493-493;
SG_MUL_VAL_ 2362179319 TotalEngineHours DDI 492-492;
SG_MUL_VAL_ 2362179319 FuelPercentageLevel DDI 491-491;
SG_MUL_VAL_ 2362179319 MaxFuelTankContent DDI 490-490;
SG_MUL_VAL_ 2362179319 MaxDieselExhaustFluidTankContent DDI 489-489;
SG_MUL_VAL_ 2362179319 DieselExhaustFluidTankPercentage DDI 488-488;
SG_MUL_VAL_ 2362179319 MaxEngineSpeed DDI 486-486;
SG_MUL_VAL_ 2362179319 MinEngineSpeed DDI 485-485;
SG_MUL_VAL_ 2362179319 ActualEngineSpeed DDI 484-484;
SG_MUL_VAL_ 2362179319 SetpointEngineSpeed DDI 483-483;
SG_MUL_VAL_ 2362179319 LastBaleNumberOfSubbales DDI 482-482;
SG_MUL_VAL_ 2362179319 SetpointNumberOfSubbales DDI 481-481;
SG_MUL_VAL_ 2362179319 MaxFlakeSize DDI 480-480;
SG_MUL_VAL_ 2362179319 MinFlakeSize DDI 479-479;
SG_MUL_VAL_ 2362179319 SetpointFlakeSize DDI 478-478;
SG_MUL_VAL_ 2362179319 MaxBaleHydraulicPressure DDI 477-477;
SG_MUL_VAL_ 2362179319 MinBaleHydraulicPressure DDI 476-476;
SG_MUL_VAL_ 2362179319 SetpointBaleHydraulicPressure DDI 475-475;
SG_MUL_VAL_ 2362179319 MaxLengthOfCut DDI 474-474;
SG_MUL_VAL_ 2362179319 MinLengthOfCut DDI 473-473;
SG_MUL_VAL_ 2362179319 SetpointLengthOfCut DDI 472-472;
SG_MUL_VAL_ 2362179319 ActualPercentageContent DDI 467-467;
SG_MUL_VAL_ 2362179319 ActualRelativeConnectorAngle DDI 466-466;
SG_MUL_VAL_ 2362179319 LifetimeHaulCounter DDI 465-465;
SG_MUL_VAL_ 2362179319 HaulCounter DDI 464-464;
SG_MUL_VAL_ 2362179319 LastUnloadedCount DDI 463-463;
SG_MUL_VAL_ 2362179319 LastLoadedCount DDI 462-462;
SG_MUL_VAL_ 2362179319 LifetimeUnloadedTotalCount DDI 461-461;
SG_MUL_VAL_ 2362179319 LifetimeLoadedTotalCount DDI 460-460;
SG_MUL_VAL_ 2362179319 UnloadedTotalCount DDI 459-459;
SG_MUL_VAL_ 2362179319 LoadedTotalCount DDI 458-458;
SG_MUL_VAL_ 2362179319 LastUnloadedVolume DDI 457-457;
SG_MUL_VAL_ 2362179319 LastLoadedVolume DDI 456-456;
SG_MUL_VAL_ 2362179319 LifetimeUnloadedTotalVolume DDI 455-455;
SG_MUL_VAL_ 2362179319 LifetimeLoadedTotalVolume DDI 454-454;
SG_MUL_VAL_ 2362179319 UnloadedTotalVolume DDI 453-453;
SG_MUL_VAL_ 2362179319 LoadedTotalVolume DDI 452-452;
SG_MUL_VAL_ 2362179319 MaxAppRateOfDryMatter DDI 451-451;
SG_MUL_VAL_ 2362179319 MinAppRateOfDryMatter DDI 450-450;
SG_MUL_VAL_ 2362179319 ActualAppRateOfDryMatter DDI 449-449;
SG_MUL_VAL_ 2362179319 SetpointAppRateOfDryMatter DDI 448-448;
SG_MUL_VAL_ 2362179319 MaxAppRateOfPotassium DDI 447-447;
SG_MUL_VAL_ 2362179319 MinAppRateOfPotassium DDI 446-446;
SG_MUL_VAL_ 2362179319 ActualAppRateOfPotassium DDI 445-445;
SG_MUL_VAL_ 2362179319 SetpointAppRateOfPotassium DDI 444-444;
SG_MUL_VAL_ 2362179319 MaxAppRateOfPhosphor DDI 443-443;
SG_MUL_VAL_ 2362179319 MinAppRateOfPhosphor DDI 442-442;
SG_MUL_VAL_ 2362179319 ActualAppRateOfPhosphor DDI 441-441;
SG_MUL_VAL_ 2362179319 SetpointAppRateOfPhosphor DDI 440-440;
SG_MUL_VAL_ 2362179319 MaxAppRateOfAmmonium DDI 439-439;
SG_MUL_VAL_ 2362179319 MinAppRateOfAmmonium DDI 438-438;
SG_MUL_VAL_ 2362179319 ActualAppRateOfAmmonium DDI 437-437;
SG_MUL_VAL_ 2362179319 SetpointAppRateOfAmmonium DDI 436-436;
SG_MUL_VAL_ 2362179319 MaxAppRateOfNitrogen DDI 435-435;
SG_MUL_VAL_ 2362179319 MinAppRateOfNitrogen DDI 434-434;
SG_MUL_VAL_ 2362179319 ActualAppRateOfNitrogen DDI 433-433;
SG_MUL_VAL_ 2362179319 SetpointAppRateOfNitrogen DDI 432-432;
SG_MUL_VAL_ 2362179319 LifetimeUnloadedTotalMass DDI 431-431;
SG_MUL_VAL_ 2362179319 LifetimeLoadedTotalMass DDI 430-430;
SG_MUL_VAL_ 2362179319 UnloadedTotalMass DDI 429-429;
SG_MUL_VAL_ 2362179319 LoadedTotalMass DDI 428-428;
SG_MUL_VAL_ 2362179319 ActualDownforceAsForce DDI 427-427;
SG_MUL_VAL_ 2362179319 SetpointDownforceAsForce DDI 426-426;
SG_MUL_VAL_ 2362179319 SetpointMaxAllowedSeedSpacingDev DDI 425-425;
SG_MUL_VAL_ 2362179319 AvgCoeffOfVariationOfSeedSpacing DDI 424-424;
SG_MUL_VAL_ 2362179319 ActCoeffOfVariationOfSeedSpacing DDI 423-423;
SG_MUL_VAL_ 2362179319 AverageSeedSpacingDeviation_Copy DDI 422-422;
SG_MUL_VAL_ 2362179319 ActualSeedSpacingDeviation DDI 421-421;
SG_MUL_VAL_ 2362179319 AverageSeedMultiplePercentage DDI 420-420;
SG_MUL_VAL_ 2362179319 ActualSeedMultiplePercentage DDI 419-419;
SG_MUL_VAL_ 2362179319 AverageSeedSkipPercentage DDI 418-418;
SG_MUL_VAL_ 2362179319 ActualSeedSkipPercentage DDI 417-417;
SG_MUL_VAL_ 2362179319 AverageSeedSingulationPercentage DDI 416-416;
SG_MUL_VAL_ 2362179319 ActualSeedSingulationPercentage DDI 415-415;
SG_MUL_VAL_ 2362179319 LifetimeAvgDieselExhFluidConsump DDI 414-414;
SG_MUL_VAL_ 2362179319 LifetimeAvgDieselExhFluidCo_0000 DDI 413-413;
SG_MUL_VAL_ 2362179319 LifetimeDieselExhaustFluidConsum DDI 412-412;
SG_MUL_VAL_ 2362179319 InstantDieselExhaustFluidConsump DDI 411-411;
SG_MUL_VAL_ 2362179319 InstantDieselExhaustFluidCo_0000 DDI 410-410;
SG_MUL_VAL_ 2362179319 TotalDieselExhaustFluidConsumpti DDI 409-409;
SG_MUL_VAL_ 2362179319 AverageCropContamination DDI 408-408;
SG_MUL_VAL_ 2362179319 AverageProteinContent DDI 407-407;
SG_MUL_VAL_ 2362179319 ActualProteinContent DDI 406-406;
SG_MUL_VAL_ 2362179319 ActualApplicationOfDryMatter DDI 405-405;
SG_MUL_VAL_ 2362179319 ActualApplicationOfPotassium DDI 404-404;
SG_MUL_VAL_ 2362179319 ActualApplicationOfPhosphor DDI 403-403;
SG_MUL_VAL_ 2362179319 ActualApplicationOfAmmonium DDI 402-402;
SG_MUL_VAL_ 2362179319 ActualApplicationOfNitrogen DDI 401-401;
SG_MUL_VAL_ 2362179319 SpeedSource DDI 400-400;
SG_MUL_VAL_ 2362179319 MaximumSpeed DDI 399-399;
SG_MUL_VAL_ 2362179319 MinimumSpeed DDI 398-398;
SG_MUL_VAL_ 2362179319 ActualSpeed DDI 397-397;
SG_MUL_VAL_ 2362179319 SetpointSpeed DDI 396-396;
SG_MUL_VAL_ 2362179319 ActualDieselExhaustFluidTankCont DDI 395-395;
SG_MUL_VAL_ 2362179319 ActualFuelTankContent DDI 394-394;
SG_MUL_VAL_ 2362179319 MaximumRevolutionsPerTime DDI 393-393;
SG_MUL_VAL_ 2362179319 MinimumRevolutionsPerTime DDI 392-392;
SG_MUL_VAL_ 2362179319 DefaultRevolutionsPerTime DDI 391-391;
SG_MUL_VAL_ 2362179319 ActualRevolutionsPerTime DDI 390-390;
SG_MUL_VAL_ 2362179319 SetpointRevolutionsAsCountPerTim DDI 389-389;
SG_MUL_VAL_ 2362179319 TotalRevolutionsInCompleteRevolu DDI 388-388;
SG_MUL_VAL_ 2362179319 TotalRevolutionsInFractionalRevo DDI 387-387;
SG_MUL_VAL_ 2362179319 ActualAtmosphericPressure DDI 386-386;
SG_MUL_VAL_ 2362179319 MSLAtmosphericPressure DDI 385-385;
SG_MUL_VAL_ 2362179319 ApparentWindSpeed DDI 384-384;
SG_MUL_VAL_ 2362179319 ApparentWindDirection DDI 383-383;
SG_MUL_VAL_ 2362179319 CondensedSectionOverrideState241 DDI 382-382;
SG_MUL_VAL_ 2362179319 CondensedSectionOverrideState225 DDI 381-381;
SG_MUL_VAL_ 2362179319 CondensedSectionOverrideState209 DDI 380-380;
SG_MUL_VAL_ 2362179319 CondensedSectionOverrideState193 DDI 379-379;
SG_MUL_VAL_ 2362179319 CondensedSectionOverrideState177 DDI 378-378;
SG_MUL_VAL_ 2362179319 CondensedSectionOverrideState161 DDI 377-377;
SG_MUL_VAL_ 2362179319 CondensedSectionOverrideState145 DDI 376-376;
SG_MUL_VAL_ 2362179319 CondensedSectionOverrideState129 DDI 375-375;
SG_MUL_VAL_ 2362179319 CondensedSectionOverrideState113 DDI 374-374;
SG_MUL_VAL_ 2362179319 CondensedSectionOverrideState97t DDI 373-373;
SG_MUL_VAL_ 2362179319 CondensedSectionOverrideState81t DDI 372-372;
SG_MUL_VAL_ 2362179319 CondensedSectionOverrideState65t DDI 371-371;
SG_MUL_VAL_ 2362179319 CondensedSectionOverrideState49t DDI 370-370;
SG_MUL_VAL_ 2362179319 CondensedSectionOverrideState33t DDI 369-369;
SG_MUL_VAL_ 2362179319 CondensedSectionOverrideState17t DDI 368-368;
SG_MUL_VAL_ 2362179319 CondensedSectionOverrideState01t DDI 367-367;
SG_MUL_VAL_ 2362179319 ActualDownforcePressure DDI 366-366;
SG_MUL_VAL_ 2362179319 SetpointDownforcePressure DDI 365-365;
SG_MUL_VAL_ 2362179319 ActualFlakeSize DDI 364-364;
SG_MUL_VAL_ 2362179319 LastBaleDryMass DDI 363-363;
SG_MUL_VAL_ 2362179319 TotalBaleLength DDI 362-362;
SG_MUL_VAL_ 2362179319 LastBaleDensity DDI 361-361;
SG_MUL_VAL_ 2362179319 LastBaleSize DDI 360-360;
SG_MUL_VAL_ 2362179319 AverageDryYieldMassPerArea DDI 359-359;
SG_MUL_VAL_ 2362179319 AverageDryYieldMassPerTime DDI 358-358;
SG_MUL_VAL_ 2362179319 TotalApplicationOfDryMatter DDI 357-357;
SG_MUL_VAL_ 2362179319 TotalApplicationOfPotassium DDI 356-356;
SG_MUL_VAL_ 2362179319 TotalApplicationOfPhosphor DDI 355-355;
SG_MUL_VAL_ 2362179319 TotalApplicationOfAmmonium DDI 354-354;
SG_MUL_VAL_ 2362179319 TotalApplicationofNitrogen DDI 353-353;
SG_MUL_VAL_ 2362179319 ApplicationTotalMass DDI 352-352;
SG_MUL_VAL_ 2362179319 ApplicationTotalVolume DDI 351-351;
SG_MUL_VAL_ 2362179319 FunctionType DDI 350-350;
SG_MUL_VAL_ 2362179319 NozzleDriftReduction DDI 349-349;
SG_MUL_VAL_ 2362179319 MaximumSwathingWidth DDI 348-348;
SG_MUL_VAL_ 2362179319 MinimumSwathingWidth DDI 347-347;
SG_MUL_VAL_ 2362179319 ActualSwathingWidth DDI 346-346;
SG_MUL_VAL_ 2362179319 SetpointSwathingWidth DDI 345-345;
SG_MUL_VAL_ 2362179319 MaximumGrainKernelCrackerGap DDI 344-344;
SG_MUL_VAL_ 2362179319 MinimumGrainKernelCrackerGap DDI 343-343;
SG_MUL_VAL_ 2362179319 ActualGrainKernelCrackerGap DDI 342-342;
SG_MUL_VAL_ 2362179319 SetpointGrainKernelCrackerGap DDI 341-341;
SG_MUL_VAL_ 2362179319 EffectiveUnloadingTime DDI 340-340;
SG_MUL_VAL_ 2362179319 EffectiveLoadingTime DDI 339-339;
SG_MUL_VAL_ 2362179319 LiftimeRearPTOHours DDI 338-338;
SG_MUL_VAL_ 2362179319 LifetimeFrontPTOHours DDI 337-337;
SG_MUL_VAL_ 2362179319 RearPTOHours DDI 336-336;
SG_MUL_VAL_ 2362179319 FrontPTOHours DDI 335-335;
SG_MUL_VAL_ 2362179319 OperatingHoursSinceLastSharpenin DDI 334-334;
SG_MUL_VAL_ 2362179319 MaximumCuttingDrumSpeed DDI 333-333;
SG_MUL_VAL_ 2362179319 ActualCuttingDrumSpeed DDI 331-331;
SG_MUL_VAL_ 2362179319 SetpointCuttingDrumSpeed DDI 330-330;
SG_MUL_VAL_ 2362179319 MaximumHeaderSpeed DDI 329-329;
SG_MUL_VAL_ 2362179319 MinimumHeaderSpeed DDI 328-328;
SG_MUL_VAL_ 2362179319 ActualHeaderSpeed DDI 327-327;
SG_MUL_VAL_ 2362179319 SetpointHeaderSpeed DDI 326-326;
SG_MUL_VAL_ 2362179319 LifetimeApplicationTotalVolume DDI 325-325;
SG_MUL_VAL_ 2362179319 ChopperEngagementTotalTime DDI 324-324;
SG_MUL_VAL_ 2362179319 UnloadIdentificationNumber DDI 323-323;
SG_MUL_VAL_ 2362179319 LoadIdentificationNumber DDI 322-322;
SG_MUL_VAL_ 2362179319 ArbitraryAddressCapable PeerControlCommand 0-0, 1-1, 3-3, 4-4, 6-21;
SG_MUL_VAL_ 2362179319 IndustryGroup PeerControlCommand 0-0, 1-1, 3-3, 4-4, 6-21;
SG_MUL_VAL_ 2362179319 VehicleSystemInstance PeerControlCommand 0-0, 1-1, 3-3, 4-4, 6-21;
SG_MUL_VAL_ 2362179319 VehicleSystem2 PeerControlCommand 0-0, 1-1, 3-3, 4-4, 6-21;
SG_MUL_VAL_ 2362179319 Function PeerControlCommand 0-0, 1-1, 3-3, 4-4, 6-21;
SG_MUL_VAL_ 2362179319 FunctionInstance PeerControlCommand 0-0, 1-1, 3-3, 4-4, 6-21;
SG_MUL_VAL_ 2362179319 ECUInstance PeerControlCommand 0-0, 1-1, 3-3, 4-4, 6-21;
SG_MUL_VAL_ 2362179319 ManufacturerCode PeerControlCommand 0-0, 1-1, 3-3, 4-4, 6-21;
SG_MUL_VAL_ 2362179319 TemperatureUnits DeviceDescriptionMsgType 2-2, 3-3;
SG_MUL_VAL_ 2362179319 PressureUnits DeviceDescriptionMsgType 2-2, 3-3;
SG_MUL_VAL_ 2362179319 ErrorCodeObjPool4 DeviceDescriptionMsgType 9-9;
SG_MUL_VAL_ 2362179319 ErrorCodeObjPool3 DeviceDescriptionMsgType 9-9;
SG_MUL_VAL_ 2362179319 ForceUnits DeviceDescriptionMsgType 2-2, 3-3;
SG_MUL_VAL_ 2362179319 ErrorCodeObjPool2 DeviceDescriptionMsgType 9-9;
SG_MUL_VAL_ 2362179319 IdentityNumber PeerControlCommand 0-0, 1-1, 3-3, 4-4, 6-21;
SG_MUL_VAL_ 2362179319 NumberOfSection TechnicalDataMsgType 1-1;
SG_MUL_VAL_ 2362179319 ExecutedCommand Command 14-14;
SG_MUL_VAL_ 2362179319 UnitsSystem DeviceDescriptionMsgType 2-2, 3-3;
SG_MUL_VAL_ 2362179319 ErrorCodeObjPool1 DeviceDescriptionMsgType 9-9;
SG_MUL_VAL_ 2362179319 DistanceUnitCmd DeviceDescriptionMsgType 2-2, 3-3;
SG_MUL_VAL_ 2362179319 AreaUnitCmd DeviceDescriptionMsgType 2-2, 3-3;
SG_MUL_VAL_ 2362179319 VolumeUnitCmd DeviceDescriptionMsgType 2-2, 3-3;
SG_MUL_VAL_ 2362179319 SourceAddressWSM Command 14-14;
SG_MUL_VAL_ 2362179319 MassUnitCmd DeviceDescriptionMsgType 2-2, 3-3;
SG_MUL_VAL_ 2362179319 NumberOfBooms TechnicalDataMsgType 1-1;
SG_MUL_VAL_ 2362179319 OriginCommand Command 13-13;
SG_MUL_VAL_ 2362179319 ErrorCodeProcessData8 Command 13-13;
SG_MUL_VAL_ 2362179319 ErrorCodeProcessData7 Command 13-13;
SG_MUL_VAL_ 2362179319 ErrorCodeProcessData6 Command 13-13;
SG_MUL_VAL_ 2362179319 DestinationElementNumber PeerControlCommand 3-3, 4-4;
SG_MUL_VAL_ 2362179319 ErrorCodeProcessData5 Command 13-13;
SG_MUL_VAL_ 2362179319 ErrorCodeProcessData4 Command 13-13;
SG_MUL_VAL_ 2362179319 StatusBusyExecuting Command 14-14;
SG_MUL_VAL_ 2362179319 ErrorCodeProcessData3 Command 13-13;
SG_MUL_VAL_ 2362179319 StatusBusyReading Command 14-14;
SG_MUL_VAL_ 2362179319 ErrorCodeProcessData2 Command 13-13;
SG_MUL_VAL_ 2362179319 StatusBusySaving Command 14-14;
SG_MUL_VAL_ 2362179319 DataLogTimeInterval Command 4-4;
SG_MUL_VAL_ 2362179319 DataLogDistanceInterval Command 5-5;
SG_MUL_VAL_ 2362179319 AppRateVolumePerArea_Set DDI 1-1;
SG_MUL_VAL_ 2362179319 AppRateVolumePerArea_Act DDI 2-2;
SG_MUL_VAL_ 2362179319 AppRateVolumePerArea_Def DDI 3-3;
SG_MUL_VAL_ 2362179319 AppRateVolumePerArea_Min DDI 4-4;
SG_MUL_VAL_ 2362179319 AppRateVolumePerArea_Max DDI 5-5;
SG_MUL_VAL_ 2362179319 AppRateMassPerArea_Set DDI 6-6;
SG_MUL_VAL_ 2362179319 AppRateMassPerArea_Act DDI 7-7;
SG_MUL_VAL_ 2362179319 AppRateMassPerArea_Def DDI 8-8;
SG_MUL_VAL_ 2362179319 AppRateMassPerArea_Min DDI 9-9;
SG_MUL_VAL_ 2362179319 AppRateMassPerArea_Max DDI 10-10;
SG_MUL_VAL_ 2362179319 AppRateCountPerArea_Set DDI 11-11;
SG_MUL_VAL_ 2362179319 AppRateCountPerArea_Act DDI 12-12;
SG_MUL_VAL_ 2362179319 AppRateCountPerArea_Def DDI 13-13;
SG_MUL_VAL_ 2362179319 AppRateCountPerArea_Min DDI 14-14;
SG_MUL_VAL_ 2362179319 AppRateCountPerArea_Max DDI 15-15;
SG_MUL_VAL_ 2362179319 SetAppRateDistance_Set DDI 16-16;
SG_MUL_VAL_ 2362179319 AppRateDistance_Act DDI 17-17;
SG_MUL_VAL_ 2362179319 AppRateDistance_Def DDI 18-18;
SG_MUL_VAL_ 2362179319 AppRateDistance_Min DDI 19-19;
SG_MUL_VAL_ 2362179319 AppRateDistance_Max DDI 20-20;
SG_MUL_VAL_ 2362179319 AppRateVolumePerVolume_Set DDI 21-21;
SG_MUL_VAL_ 2362179319 AppRateVolumePerVolume_Act DDI 22-22;
SG_MUL_VAL_ 2362179319 AppRateVolumePerVolume_Def DDI 23-23;
SG_MUL_VAL_ 2362179319 AppRateVolumePerVolume_Min DDI 24-24;
SG_MUL_VAL_ 2362179319 AppRateVolumePerVolume_Max DDI 25-25;
SG_MUL_VAL_ 2362179319 AppRateMassPerMass_Set DDI 26-26;
SG_MUL_VAL_ 2362179319 AppRateMassPerMass_Act DDI 27-27;
SG_MUL_VAL_ 2362179319 AppRateMassPerMass_Def DDI 28-28;
SG_MUL_VAL_ 2362179319 AppRateMassPerMass_Min DDI 29-29;
SG_MUL_VAL_ 2362179319 AppRateMassPerMass_Max DDI 30-30;
SG_MUL_VAL_ 2362179319 AppRateVolumePerMass_Set DDI 31-31;
SG_MUL_VAL_ 2362179319 AppRateVolumePerMass_Act DDI 32-32;
SG_MUL_VAL_ 2362179319 AppRateVolumePerMass_Def DDI 33-33;
SG_MUL_VAL_ 2362179319 AppRateVolumePerMass_Min DDI 34-34;
SG_MUL_VAL_ 2362179319 AppRateVolumePerMass_Max DDI 35-35;
SG_MUL_VAL_ 2362179319 AppRateVolumePerTime_Set DDI 36-36;
SG_MUL_VAL_ 2362179319 AppRateVolumePerTime_Act DDI 37-37;
SG_MUL_VAL_ 2362179319 AppRateVolumePerTime_Def DDI 38-38;
SG_MUL_VAL_ 2362179319 AppRateVolumePerTime_Min DDI 39-39;
SG_MUL_VAL_ 2362179319 AppRateVolumePerTime_Max DDI 40-40;
SG_MUL_VAL_ 2362179319 AppRateMassPerTime_Set DDI 41-41;
SG_MUL_VAL_ 2362179319 AppRateMassPerTime_Act DDI 42-42;
SG_MUL_VAL_ 2362179319 AppRateMassPerTime_Def DDI 43-43;
SG_MUL_VAL_ 2362179319 AppRateMassPerTime_Min DDI 44-44;
SG_MUL_VAL_ 2362179319 AppRateMassPerTime_Max DDI 45-45;
SG_MUL_VAL_ 2362179319 AppRateCountPerTime_Set DDI 46-46;
SG_MUL_VAL_ 2362179319 AppRateCountPerTime_Act DDI 47-47;
SG_MUL_VAL_ 2362179319 AppRateCountPerTime_Def DDI 48-48;
SG_MUL_VAL_ 2362179319 AppRateCountPerTime_Min DDI 49-49;
SG_MUL_VAL_ 2362179319 AppRateCountPerTime_Max DDI 50-50;
SG_MUL_VAL_ 2362179319 SetTillageDepth_Set DDI 51-51;
SG_MUL_VAL_ 2362179319 TillageDepth_Act DDI 52-52;
SG_MUL_VAL_ 2362179319 TillageDepth_Def DDI 53-53;
SG_MUL_VAL_ 2362179319 TillageDepth_Min DDI 54-54;
SG_MUL_VAL_ 2362179319 TillageDepth_Max DDI 55-55;
SG_MUL_VAL_ 2362179319 SeedingDeph_Set DDI 56-56;
SG_MUL_VAL_ 2362179319 SeedingDeph_Act DDI 57-57;
SG_MUL_VAL_ 2362179319 SeedingDeph_Def DDI 58-58;
SG_MUL_VAL_ 2362179319 SeedingDeph_Min DDI 59-59;
SG_MUL_VAL_ 2362179319 SeedingDeph_Max DDI 60-60;
SG_MUL_VAL_ 2362179319 WorkingHeight_Set DDI 61-61;
SG_MUL_VAL_ 2362179319 WorkingHeight_Act DDI 62-62;
SG_MUL_VAL_ 2362179319 WorkingHeight_Def DDI 63-63;
SG_MUL_VAL_ 2362179319 WorkingHeight_Min DDI 64-64;
SG_MUL_VAL_ 2362179319 WorkingHeight_Max DDI 65-65;
SG_MUL_VAL_ 2362179319 WorkingWidth_Set DDI 66-66;
SG_MUL_VAL_ 2362179319 WorkingWidth_Act DDI 67-67;
SG_MUL_VAL_ 2362179319 WorkingWidth_Def DDI 68-68;
SG_MUL_VAL_ 2362179319 WorkingWidth_Min DDI 69-69;
SG_MUL_VAL_ 2362179319 WorkingWidth_Max DDI 70-70;
SG_MUL_VAL_ 2362179319 ContentAsVolume_Set DDI 71-71;
SG_MUL_VAL_ 2362179319 ContentAsVolume_Act DDI 72-72;
SG_MUL_VAL_ 2362179319 ContentAsVolume_Max DDI 73-73;
SG_MUL_VAL_ 2362179319 ContentAsMass_Set DDI 74-74;
SG_MUL_VAL_ 2362179319 ContentAsMass_Act DDI 75-75;
SG_MUL_VAL_ 2362179319 ContentAsMass_Max DDI 76-76;
SG_MUL_VAL_ 2362179319 ContentAsCount_Set DDI 77-77;
SG_MUL_VAL_ 2362179319 ContentAsCount_Act DDI 78-78;
SG_MUL_VAL_ 2362179319 ContentAsCount_Max DDI 79-79;
SG_MUL_VAL_ 2362179319 AccumulatedAppAsVolume DDI 80-80;
SG_MUL_VAL_ 2362179319 AccumulatedAppAsMass DDI 81-81;
SG_MUL_VAL_ 2362179319 AccumulatedAppAsCount DDI 82-82;
SG_MUL_VAL_ 2362179319 YieldVolumePerArea DDI 83-83;
SG_MUL_VAL_ 2362179319 YieldMassPerArea DDI 84-84;
SG_MUL_VAL_ 2362179319 YieldCountPerArea DDI 85-85;
SG_MUL_VAL_ 2362179319 YieldVolumePerTime DDI 86-86;
SG_MUL_VAL_ 2362179319 YieldMassPerTime DDI 87-87;
SG_MUL_VAL_ 2362179319 YieldCountPerTime DDI 88-88;
SG_MUL_VAL_ 2362179319 AccumulatedYieldAsVolume DDI 89-89;
SG_MUL_VAL_ 2362179319 AccumulatedYieldAsMass DDI 90-90;
SG_MUL_VAL_ 2362179319 AccumulatedYieldAsCount DDI 91-91;
SG_MUL_VAL_ 2362179319 CropYieldLossVolumePerArea DDI 92-92;
SG_MUL_VAL_ 2362179319 CropYieldLossMassPerArea DDI 93-93;
SG_MUL_VAL_ 2362179319 CropYieldLossCountPerArea DDI 94-94;
SG_MUL_VAL_ 2362179319 CropYieldLossVolumePerTime DDI 95-95;
SG_MUL_VAL_ 2362179319 CropYieldLossMassPerTime DDI 96-96;
SG_MUL_VAL_ 2362179319 CropYieldLossCountPerTime DDI 97-97;
SG_MUL_VAL_ 2362179319 CropYieldLoss DDI 98-98;
SG_MUL_VAL_ 2362179319 MoistureInCropYield DDI 99-99;
SG_MUL_VAL_ 2362179319 DirtMaterialInCropYield DDI 100-100;
SG_MUL_VAL_ 2362179319 BaleWidth_Set DDI 101-101;
SG_MUL_VAL_ 2362179319 BaleWidth_Act DDI 102-102;
SG_MUL_VAL_ 2362179319 BaleWidth_Def DDI 103-103;
SG_MUL_VAL_ 2362179319 BaleWidth_Min DDI 104-104;
SG_MUL_VAL_ 2362179319 BaleWidth_Max DDI 105-105;
SG_MUL_VAL_ 2362179319 BaleHeight_Set DDI 106-106;
SG_MUL_VAL_ 2362179319 BaleHeight_Act DDI 107-107;
SG_MUL_VAL_ 2362179319 BaleHeight_Def DDI 108-108;
SG_MUL_VAL_ 2362179319 BaleHeight_Min DDI 109-109;
SG_MUL_VAL_ 2362179319 BaleHeight_Max DDI 110-110;
SG_MUL_VAL_ 2362179319 BaleSize_Set DDI 111-111;
SG_MUL_VAL_ 2362179319 BaleSize_Act DDI 112-112;
SG_MUL_VAL_ 2362179319 BaleSize_Def DDI 113-113;
SG_MUL_VAL_ 2362179319 BaleSize_Min DDI 114-114;
SG_MUL_VAL_ 2362179319 BaleSize_Max DDI 115-115;
SG_MUL_VAL_ 2362179319 AccumulatedArea DDI 116-116;
SG_MUL_VAL_ 2362179319 AccumulatedDistanceInWork DDI 117-117;
SG_MUL_VAL_ 2362179319 AccumulatedDistanceOutWork DDI 118-118;
SG_MUL_VAL_ 2362179319 AccumulatedTimeInWork DDI 119-119;
SG_MUL_VAL_ 2362179319 AccumulatedTimeOutWork DDI 120-120;
SG_MUL_VAL_ 2362179319 PrdoucDensityMassPerArea DDI 121-121;
SG_MUL_VAL_ 2362179319 PrdoucDensityMassPerCount DDI 122-122;
SG_MUL_VAL_ 2362179319 PrdoucDensityVolumePerCount DDI 123-123;
SG_MUL_VAL_ 2362179319 AuxiliaryValveScalingExtend DDI 124-124;
SG_MUL_VAL_ 2362179319 AuxiliaryValveScalingRetract DDI 125-125;
SG_MUL_VAL_ 2362179319 AuxiliaryRampExtendUp DDI 126-126;
SG_MUL_VAL_ 2362179319 AuxiliaryValveRampExtendDown DDI 127-127;
SG_MUL_VAL_ 2362179319 AuxiliaryValveRampRetractUp DDI 128-128;
SG_MUL_VAL_ 2362179319 AuxiliaryValveRampRetractDown DDI 129-129;
SG_MUL_VAL_ 2362179319 AuxiliaryValveFloatThreshold DDI 130-130;
SG_MUL_VAL_ 2362179319 AuxiliaryValveProgressivExtend DDI 131-131;
SG_MUL_VAL_ 2362179319 AuxiliaryValveProgressivRetract DDI 132-132;
SG_MUL_VAL_ 2362179319 AuxiliaryValveInvertPorts DDI 133-133;
SG_MUL_VAL_ 2362179319 DeviceElementOffsetX DDI 134-134;
SG_MUL_VAL_ 2362179319 DeviceElementOffsetY DDI 135-135;
SG_MUL_VAL_ 2362179319 DeviceElementOffsetZ DDI 136-136;
SG_MUL_VAL_ 2362179319 DeviceVolumeCapacity DDI 137-137;
SG_MUL_VAL_ 2362179319 DeviceMassCapacity DDI 138-138;
SG_MUL_VAL_ 2362179319 DeviceCountCapacity DDI 139-139;
SG_MUL_VAL_ 2362179319 PercentageAppRateSetpoint DDI 140-140;
SG_MUL_VAL_ 2362179319 WorkState DDI 141-141;
SG_MUL_VAL_ 2362179319 SetpointTimeLatency DDI 142-142;
SG_MUL_VAL_ 2362179319 ActualValueTimeLatency DDI 143-143;
SG_MUL_VAL_ 2362179319 YawAngle DDI 144-144;
SG_MUL_VAL_ 2362179319 RollAngle DDI 145-145;
SG_MUL_VAL_ 2362179319 PitchAngle DDI 146-146;
SG_MUL_VAL_ 2362179319 LogCount DDI 147-147;
SG_MUL_VAL_ 2362179319 TotalFuelConsumption DDI 148-148;
SG_MUL_VAL_ 2362179319 FuelConsumptionPerTime DDI 149-149;
SG_MUL_VAL_ 2362179319 FuelConsumptionPerArea DDI 150-150;
SG_MUL_VAL_ 2362179319 AreaPerTimeCapacity DDI 151-151;
SG_MUL_VAL_ 2362179319 MinMassPerAreaAppRate DDI 152-152;
SG_MUL_VAL_ 2362179319 NDVI DDI 153-153;
SG_MUL_VAL_ 2362179319 PhysicalObjectLength DDI 154-154;
SG_MUL_VAL_ 2362179319 PhysicalObjectWidth DDI 155-155;
SG_MUL_VAL_ 2362179319 PhysicalObjectHeight DDI 156-156;
SG_MUL_VAL_ 2362179319 ConnectorType DDI 157-157;
SG_MUL_VAL_ 2362179319 PrescriptionControlState DDI 158-158;
SG_MUL_VAL_ 2362179319 NumberOfSubUnitsPerSection DDI 159-159;
SG_MUL_VAL_ 2362179319 SectionControlState DDI 160-160;
SG_MUL_VAL_ 2362179319 CondensedWorkState1to16 DDI 161-161;
SG_MUL_VAL_ 2362179319 CondensedWorkState17to32 DDI 162-162;
SG_MUL_VAL_ 2362179319 CondensedWorkState33to48 DDI 163-163;
