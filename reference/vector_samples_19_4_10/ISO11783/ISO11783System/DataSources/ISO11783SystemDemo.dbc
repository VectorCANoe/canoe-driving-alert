VERSION ""

NS_ :

BS_:

BU_: GNSSReceiver VT TECU TC Sprayer

BO_ 2362179319 PD_TC: 14 TC
 SG_ CondensedWorkState49to64 m164 : 32|32@1- (1,0) [-2147483648|2147483647] "" Vector__XXX
 SG_ CondensedWorkState65to80 m165 : 32|32@1- (1,0) [-2147483648|2147483647] "" Vector__XXX
 SG_ CondensedWorkState81to96 m166 : 32|32@1- (1,0) [-2147483648|2147483647] "" Vector__XXX
 SG_ CondensedWorkState97to112 m167 : 32|32@1- (1,0) [-2147483648|2147483647] "" Vector__XXX
 SG_ CondensedWorkState113to128 m168 : 32|32@1- (1,0) [-2147483648|2147483647] "" Vector__XXX
 SG_ CondensedWorkState129to144 m169 : 32|32@1- (1,0) [-2147483648|2147483647] "" Vector__XXX
 SG_ CondensedWorkState145to160 m170 : 32|32@1- (1,0) [-2147483648|2147483647] "" Vector__XXX
 SG_ CondensedWorkState161to176 m171 : 32|32@1- (1,0) [-2147483648|2147483647] "" Vector__XXX
 SG_ CondensedWorkState177to192 m172 : 32|32@1- (1,0) [-2147483648|2147483647] "" Vector__XXX
 SG_ CondensedWorkState193to208 m173 : 32|32@1- (1,0) [-2147483648|2147483647] "" Vector__XXX
 SG_ CondensedWorkState209to224 m174 : 32|32@1- (1,0) [-2147483648|2147483647] "" Vector__XXX
 SG_ CondensedWorkState225to240 m175 : 32|32@1- (1,0) [-2147483648|2147483647] "" Vector__XXX
 SG_ CondensedWorkState241to256 m176 : 32|32@1- (1,0) [-2147483648|2147483647] "" Vector__XXX
 SG_ ActualLengthOfCut m177 : 32|32@1- (0.001,0) [0|2147483647] "mm" Vector__XXX
 SG_ ElementTypeInstance m178 : 32|32@1- (1,0) [0|65533] "" Vector__XXX
 SG_ ActualCulturalPractice m179 : 32|32@1- (1,0) [0|2147483647] "" Vector__XXX
 SG_ DRP2GroundDistance m180 : 32|32@1- (1,0) [-2147483648|2147483647] "mm" Vector__XXX
 SG_ DryMassPerAreaYield m181 : 32|32@1- (1,0) [0|2147483647] "mg/m²" Vector__XXX
 SG_ DryMassPerTimeYield m182 : 32|32@1- (1,0) [0|2147483647] "mg/s" Vector__XXX
 SG_ YieldTotalDryMass m183 : 32|32@1- (1,0) [0|2147483647] "kg" Vector__XXX
 SG_ RefMoistureForDryMass m184 : 32|32@1- (1,0) [0|2147483647] "ppm" Vector__XXX
 SG_ SeedCottonMassPerAreaYield m185 : 32|32@1- (1,0) [0|2147483647] "mg/m²" Vector__XXX
 SG_ LintCottonMassPerAreaYield m186 : 32|32@1- (1,0) [0|2147483647] "mg/m²" Vector__XXX
 SG_ SeedCottonMassPerTimeYield m187 : 32|32@1- (1,0) [0|2147483647] "mg/s" Vector__XXX
 SG_ LintCottonMassPerTimeYield m188 : 32|32@1- (1,0) [0|2147483647] "mg/s" Vector__XXX
 SG_ YieldTotalSeedCottonMass m189 : 32|32@1- (1,0) [0|2147483647] "" Vector__XXX
 SG_ YieldTotalLintCottonMass m190 : 32|32@1- (1,0) [0|2147483647] "kg" Vector__XXX
 SG_ LintTurnoutPercentage m191 : 32|32@1- (1,0) [0|2147483647] "ppm" Vector__XXX
 SG_ AmbientTemperature m192 : 32|32@1- (1,0) [0|1000000] "mK" Vector__XXX
 SG_ SetpointProductPressure m193 : 32|32@1- (0.1,0) [-2147483648|2147483647] "Pa" Vector__XXX
 SG_ ActualProductPressure m194 : 32|32@1- (0.1,0) [-2147483648|2147483647] "Pa" Vector__XXX
 SG_ MinimumProductPressure m195 : 32|32@1- (0.1,0) [-2147483648|2147483647] "Pa" Vector__XXX
 SG_ MaximumProductPressure m196 : 32|32@1- (0.1,0) [-2147483648|2147483647] "Pa" Vector__XXX
 SG_ SetpointPumpOutputPressure m197 : 32|32@1- (0.1,0) [-2147483648|2147483647] "Pa" Vector__XXX
 SG_ ActualPumpOutputPressure m198 : 32|32@1- (0.1,0) [-2147483648|2147483647] "Pa" Vector__XXX
 SG_ MinimumPumpOutputPressure m199 : 32|32@1- (0.1,0) [-2147483648|2147483647] "Pa" Vector__XXX
 SG_ MaximumPumpOutputPressure m200 : 32|32@1- (0.1,0) [-2147483648|2147483647] "Pa" Vector__XXX
 SG_ SetpointTankAgitationPressure m201 : 32|32@1- (0.1,0) [-2147483648|2147483647] "Pa" Vector__XXX
 SG_ ActualTankAgitationPressure m202 : 32|32@1- (0.1,0) [-2147483648|2147483647] "Pa" Vector__XXX
 SG_ MinimumTankAgitationPressure m203 : 32|32@1- (0.1,0) [-2147483648|2147483647] "Pa" Vector__XXX
 SG_ MaximumTankAgitationPressure m204 : 32|32@1- (0.1,0) [-2147483648|2147483647] "Pa" Vector__XXX
 SG_ SCTurnOnTime_ m205 : 32|32@1- (1,0) [-2147483648|2147483647] "ms" Vector__XXX
 SG_ SCTurnOffTime m206 : 32|32@1- (1,0) [-2147483648|2147483647] "ms" Vector__XXX
 SG_ WindSpeed m207 : 32|32@1- (1,0) [0|100000000] "mm/s" Vector__XXX
 SG_ WindDirection m208 : 32|32@1- (1,0) [0|359] "°" Vector__XXX
 SG_ AirHumidity m209 : 32|32@1- (1,0) [0|100] "%" Vector__XXX
 SG_ SkyConditions m210 : 32|32@1- (1,0) [-2147483648|2147483647] "" Vector__XXX
 SG_ LastBaleFlakesPerBale m211 : 32|32@1- (1,0) [0|1000] "Amount/Count" Vector__XXX
 SG_ LastBaleAverageMoisture m212 : 32|32@1- (1,0) [0|100000000] "ppm" Vector__XXX
 SG_ LastBaleAverageStrokesPerFlake m213 : 32|32@1- (1,0) [0|1000] "Amount/Count" Vector__XXX
 SG_ LifetimeBaleCount m214 : 32|32@1- (1,0) [0|2147483647] "Amount/Count" Vector__XXX
 SG_ LifetimeWorkingHours m215 : 32|32@1- (0.05,0) [0|2147483647] "h" Vector__XXX
 SG_ ActualBaleHydraulicPressure m216 : 32|32@1- (1,0) [0|2147483647] "Pa" Vector__XXX
 SG_ LastBaleAverageHydraulicPressure m217 : 32|32@1- (1,0) [0|2147483647] "Pa" Vector__XXX
 SG_ SetpointBaleCompressionPlungerLo m218 : 32|32@1- (1,0) [0|2000] "" Vector__XXX
 SG_ ActualBaleCompressionPlungerLoad m219 : 32|32@1- (1,0) [0|2000] "" Vector__XXX
 SG_ LastBaleAverageBaleCompressionPl m220 : 32|32@1- (1,0) [0|2000] "" Vector__XXX
 SG_ LastBaleAppliedPreservative m221 : 32|32@1- (1,0) [0|2147483647] "ml" Vector__XXX
 SG_ LastBaleTagNumber m222 : 32|32@1- (1,0) [0|2147483647] "" Vector__XXX
 SG_ LastBaleMass m223 : 32|32@1- (1,0) [0|2147483647] "g" Vector__XXX
 SG_ DeltaT m224 : 32|32@1- (1,0) [0|1000000] "mK" Vector__XXX
 SG_ SetpointWorkingLength m225 : 32|32@1- (1,0) [-2147483648|2147483647] "mm" Vector__XXX
 SG_ ActualWorkingLength m226 : 32|32@1- (1,0) [-2147483648|2147483647] "mm" Vector__XXX
 SG_ MinimumWorkingLength m227 : 32|32@1- (1,0) [-2147483648|2147483647] "mm" Vector__XXX
 SG_ MaximumWorkingLength m228 : 32|32@1- (1,0) [-2147483648|2147483647] "mm" Vector__XXX
 SG_ ActualNetWeight m229 : 32|32@1- (1,0) [-2147483648|2147483647] "g" Vector__XXX
 SG_ NetWeightState m230 : 32|32@1- (1,0) [0|3] "" Vector__XXX
 SG_ SetpointNetWeight m231 : 32|32@1- (1,0) [-2147483648|2147483647] "g" Vector__XXX
 SG_ ActualGrossWeight m232 : 32|32@1- (1,0) [-2147483648|2147483647] "g" Vector__XXX
 SG_ GrossWeightState m233 : 32|32@1- (1,0) [0|3] "" Vector__XXX
 SG_ MinimumGrossWeight m234 : 32|32@1- (1,0) [-2147483648|2147483647] "g" Vector__XXX
 SG_ MaximumGrossWeight m235 : 32|32@1- (1,0) [-2147483648|2147483647] "g" Vector__XXX
 SG_ ThreshingEngagementTotalTime m236 : 32|32@1- (1,0) [0|2147483647] "s" Vector__XXX
 SG_ ActualHeaderWorkingHeightStatus m237 : 32|32@1- (1,0) [0|3] "" Vector__XXX
 SG_ ActualHeaderRotationalSpeedStatu m238 : 32|32@1- (1,0) [0|3] "" Vector__XXX
 SG_ YieldHoldStatus m239 : 32|32@1- (1,0) [0|3] "" Vector__XXX
 SG_ ActualUnLoadingSystemStatus m240 : 32|32@1- (1,0) [0|771] "" Vector__XXX
 SG_ CropTemperature m241 : 32|32@1- (1,0) [0|1000000] "mK" Vector__XXX
 SG_ SetpointSieveClearance m242 : 32|32@1- (1,0) [0|2147483647] "mm" Vector__XXX
 SG_ ActualSieveClearance m243 : 32|32@1- (1,0) [0|2147483647] "mm" Vector__XXX
 SG_ MinimumSieveClearance m244 : 32|32@1- (1,0) [0|2147483647] "mm" Vector__XXX
 SG_ MaximumSieveClearance m245 : 32|32@1- (1,0) [0|2147483647] "mm" Vector__XXX
 SG_ SetpointChafferClearance m246 : 32|32@1- (1,0) [0|2147483647] "mm" Vector__XXX
 SG_ ActualChafferClearance m247 : 32|32@1- (1,0) [0|2147483647] "mm" Vector__XXX
 SG_ MinimumChafferClearance m248 : 32|32@1- (1,0) [0|2147483647] "mm" Vector__XXX
 SG_ MaximumChafferClearance m249 : 32|32@1- (1,0) [0|2147483647] "mm" Vector__XXX
 SG_ SetpointConcaveClearance m250 : 32|32@1- (1,0) [0|2147483647] "mm" Vector__XXX
 SG_ ActualConcaveClearance m251 : 32|32@1- (1,0) [0|2147483647] "mm" Vector__XXX
 SG_ MinimumConcaveClearance m252 : 32|32@1- (1,0) [0|2147483647] "mm" Vector__XXX
 SG_ MaximumConcaveClearance m253 : 32|32@1- (1,0) [0|2147483647] "mm" Vector__XXX
 SG_ SetpointSeparationFanRotationalS m254 : 32|32@1- (0.001,0) [0|2147483647] "1/s" Vector__XXX
 SG_ ActualSeparationFanRotationalSpe m255 : 32|32@1- (0.001,0) [0|2147483647] "1/s" Vector__XXX
 SG_ MinimumSeparationFanRotationalSp m256 : 32|32@1- (0.001,0) [0|2147483647] "1/s" Vector__XXX
 SG_ MaximumSeparationFanRotationalSp m257 : 32|32@1- (0.001,0) [0|2147483647] "1/s" Vector__XXX
 SG_ HydraulicOilTemperature m258 : 32|32@1- (1,0) [0|2000000] "mK" Vector__XXX
 SG_ YieldLagIgnoreTime m259 : 32|32@1- (1,0) [0|2147483647] "ms" Vector__XXX
 SG_ YieldLeadIgnoreTime m260 : 32|32@1- (1,0) [0|2147483647] "ms" Vector__XXX
 SG_ AverageYieldMassPerTime m261 : 32|32@1- (1,0) [0|2147483647] "mg/s" Vector__XXX
 SG_ AverageCropMoisture m262 : 32|32@1- (1,0) [0|2147483647] "ppm" Vector__XXX
 SG_ AverageYieldMassPerArea m263 : 32|32@1- (1,0) [0|2147483647] "mg/m²" Vector__XXX
 SG_ ConnectorPivotXOffset m264 : 32|32@1- (1,0) [-2147483648|2147483647] "mm" Vector__XXX
 SG_ RemainingArea m265 : 32|32@1- (1,0) [0|2147483647] "m²" Vector__XXX
 SG_ LifetimeApplicationTotalMass m266 : 32|32@1- (1,0) [0|2147483647] "kg" Vector__XXX
 SG_ LifetimeApplicationTotalCount m267 : 32|32@1- (1,0) [0|2147483647] "" Vector__XXX
 SG_ LifetimeYieldTotalVolume m268 : 32|32@1- (1,0) [0|2147483647] "L" Vector__XXX
 SG_ LifetimeYieldTotalMass m269 : 32|32@1- (1,0) [0|2147483647] "kg" Vector__XXX
 SG_ LifetimeYieldTotalCount m270 : 32|32@1- (1,0) [0|2147483647] "" Vector__XXX
 SG_ LifetimeTotalArea m271 : 32|32@1- (1,0) [0|2147483647] "m²" Vector__XXX
 SG_ LifetimeTotalDistance m272 : 32|32@1- (1,0) [0|2147483647] "m" Vector__XXX
 SG_ LifetimeIneffectiveTotalDistance m273 : 32|32@1- (1,0) [0|2147483647] "m" Vector__XXX
 SG_ LifetimeEffectiveTotalTime m274 : 32|32@1- (1,0) [0|2147483647] "s" Vector__XXX
 SG_ LifetimeIneffectiveTotalTime m275 : 32|32@1- (1,0) [0|2147483647] "s" Vector__XXX
 SG_ LifetimeFuelConsumption m276 : 32|32@1- (0.5,0) [0|2147483647] "L" Vector__XXX
 SG_ LifetimeAverageFuelConsumptionPe m277 : 32|32@1- (1,0) [0|2147483647] "mm³/s" Vector__XXX
 SG_ LifetimeAverageFuelConsumpt_0000 m278 : 32|32@1- (1,0) [0|2147483647] "mm³/m²" Vector__XXX
 SG_ LifetimeYieldTotalDryMass m279 : 32|32@1- (1,0) [0|2147483647] "kg" Vector__XXX
 SG_ LifetimeYieldTotalSeedCottonMass m280 : 32|32@1- (1,0) [0|2147483647] "" Vector__XXX
 SG_ LifetimeYieldTotalLintCottonMass m281 : 32|32@1- (1,0) [0|2147483647] "kg" Vector__XXX
 SG_ LifetimeThreshingEngagementTotal m282 : 32|32@1- (1,0) [0|2147483647] "s" Vector__XXX
 SG_ PrecutTotalCount m283 : 32|32@1- (1,0) [0|2147483647] "" Vector__XXX
 SG_ UncutTotalCount m284 : 32|32@1- (1,0) [0|2147483647] "" Vector__XXX
 SG_ LifetimePrecutTotalCount m285 : 32|32@1- (1,0) [0|2147483647] "" Vector__XXX
 SG_ LifetimeUncutTotalCount m286 : 32|32@1- (1,0) [0|2147483647] "" Vector__XXX
 SG_ SetpointWorkState m289 : 32|32@1- (1,0) [0|3] "" Vector__XXX
 SG_ SetpointCondensedWorkState1to16 m290 : 32|32@1+ (1,0) [0|4294967295] "" Vector__XXX
 SG_ SetpointCondensedWorkState17to32 m291 : 32|32@1+ (1,0) [0|4294967295] "" Vector__XXX
 SG_ SetpointCondensedWorkState33to48 m292 : 32|32@1+ (1,0) [0|4294967295] "" Vector__XXX
 SG_ SetpointCondensedWorkState49to64 m293 : 32|32@1+ (1,0) [0|4294967295] "" Vector__XXX
 SG_ SetpointCondensedWorkState65to80 m294 : 32|32@1+ (1,0) [0|4294967295] "" Vector__XXX
 SG_ SetpointCondensedWorkState81to96 m295 : 32|32@1+ (1,0) [0|4294967295] "" Vector__XXX
 SG_ SetpointCondensedWorkState97to11 m296 : 32|32@1+ (1,0) [0|4294967295] "" Vector__XXX
 SG_ SetpointCondensedWorkState113to1 m297 : 32|32@1+ (1,0) [0|4294967295] "" Vector__XXX
 SG_ SetpointCondensedWorkState129to1 m298 : 32|32@1+ (1,0) [0|4294967295] "" Vector__XXX
 SG_ SetpointCondensedWorkState145to1 m299 : 32|32@1+ (1,0) [0|4294967295] "" Vector__XXX
 SG_ SetpointCondensedWorkState161to1 m300 : 32|32@1+ (1,0) [0|4294967295] "" Vector__XXX
 SG_ SetpointCondensedWorkState177to1 m301 : 32|32@1+ (1,0) [0|4294967295] "" Vector__XXX
 SG_ SetpointCondensedWorkState193to2 m302 : 32|32@1+ (1,0) [0|4294967295] "" Vector__XXX
 SG_ SetpointCondensedWorkState209to2 m303 : 32|32@1+ (1,0) [0|4294967295] "" Vector__XXX
 SG_ SetpointCondensedWorkState225to2 m304 : 32|32@1+ (1,0) [0|4294967295] "" Vector__XXX
 SG_ SetpointCondensedWorkState241to2 m305 : 32|32@1+ (1,0) [0|4294967295] "" Vector__XXX
 SG_ TrueRotationPointXOffset m306 : 32|32@1- (1,0) [-2147483648|2147483647] "mm" Vector__XXX
 SG_ TrueRotationPointYOffset m307 : 32|32@1- (1,0) [-2147483648|2147483647] "mm" Vector__XXX
 SG_ ActualPercentageApplicationRate m308 : 32|32@1- (1,0) [0|2147483647] "ppm" Vector__XXX
 SG_ MinimumPercentageApplicationRate m309 : 32|32@1- (1,0) [0|2147483647] "ppm" Vector__XXX
 SG_ MaximumPercentageApplicationRate m310 : 32|32@1- (1,0) [0|2147483647] "ppm" Vector__XXX
 SG_ RelativeYieldPotential m311 : 32|32@1- (1,0) [0|2147483647] "ppm" Vector__XXX
 SG_ MinimumRelativeYieldPotential m312 : 32|32@1- (1,0) [0|2147483647] "ppm" Vector__XXX
 SG_ MaximumRelativeYieldPotential m313 : 32|32@1- (1,0) [0|2147483647] "ppm" Vector__XXX
 SG_ ActualPercentageCropDryMatter m314 : 32|32@1- (1,0) [0|2147483647] "ppm" Vector__XXX
 SG_ AveragePercentageCropDryMatter m315 : 32|32@1- (1,0) [0|2147483647] "ppm" Vector__XXX
 SG_ EffectiveTotalFuelConsumption m316 : 32|32@1- (1,0) [0|2147483647] "ml" Vector__XXX
 SG_ IneffectiveTotalFuelConsumption m317 : 32|32@1- (1,0) [0|2147483647] "ml" Vector__XXX
 SG_ EffectiveTotalDieselExhaustFluid m318 : 32|32@1- (1,0) [0|2147483647] "ml" Vector__XXX
 SG_ IneffectiveTotalDieselExhaustFlu m319 : 32|32@1- (1,0) [0|2147483647] "ml" Vector__XXX
 SG_ LastLoadedWeight m320 : 32|32@1- (1,0) [0|2147483647] "g" Vector__XXX
 SG_ LastUnloadedWeight m321 : 32|32@1- (1,0) [0|2147483647] "g" Vector__XXX
 SG_ PGNBasedData m57342 : 32|32@1- (1,0) [-2147483648|2147483647] "" Vector__XXX
 SG_ RequestDefaultProcessData m57343 : 32|32@1- (1,0) [0|0] "" Vector__XXX
 SG_ ObjectIdOfFaultyObject m9 : 32|16@1+ (1,0) [0|65535] "" Vector__XXX
 SG_ ErrorCodeProcessData1 m13 : 32|1@1+ (1,0) [0|1] "" Vector__XXX
 SG_ StatusTotalsActive m14 : 32|1@1+ (1,0) [0|1] "" Vector__XXX
 SG_ Status_TotalsActive m15 : 32|1@1+ (1,0) [0|1] "" Vector__XXX
 SG_ DateFormatCmd m2 : 32|8@1+ (1,0) [0|255] "" Vector__XXX
 SG_ DataDictionaryVersion m0 : 32|32@1- (1,0) [0|21474800] "" Vector__XXX
 SG_ PeerControlCommand m9M : 32|4@1+ (1,0) [0|5] "" Vector__XXX
 SG_ DecimalSymbolCmd m2 : 30|2@1+ (1,0) [0|3] "" Vector__XXX
 SG_ TimeFormatCmd m2 : 28|2@1+ (1,0) [0|3] "" Vector__XXX
 SG_ ImplementSectionControl m1 : 28|1@1+ (1,0) [0|1] "" Vector__XXX
 SG_ PeerControlAssignment m1 : 27|1@1+ (1,0) [0|1] "" Vector__XXX
 SG_ TC_GEO_DefinitionPositionBasedCo m1 : 26|1@1+ (1,0) [0|1] "" Vector__XXX
 SG_ TimeAndPositionForDataLogging m1 : 25|1@1+ (1,0) [0|1] "" Vector__XXX
 SG_ Documentation m1 : 24|1@1+ (1,0) [0|1] "" Vector__XXX
 SG_ ErrorCodeChangeDesignator m13 : 24|8@1+ (1,0) [0|0] "" Vector__XXX
 SG_ DesignatorLength m12 : 24|8@1+ (1,0) [0|255] "bytes" Vector__XXX
 SG_ ErrorDetailObjectPoolDelete m11 : 16|8@1- (1,0) [0|255] "" Vector__XXX
 SG_ DDI_TI m4 : 16|16@1+ (1,0) [0|65535] "" Vector__XXX
 SG_ DDI_DI m5 : 16|16@1+ (1,0) [0|65535] "" Vector__XXX
 SG_ ErrorDDI m13 : 16|16@1+ (1,0) [0|65535] "" Vector__XXX
 SG_ ParentObjectIdOfFaultyObject m9 : 16|16@1+ (1,0) [0|65535] "" Vector__XXX
 SG_ ReceivedDataSize m7 : 16|32@1+ (1,0) [0|4294967295] "bytes" Vector__XXX
 SG_ DDI m2M : 16|16@1+ (1,0) [0|65535] "" Vector__XXX
 SG_ BootTimeTC m1 : 16|8@1+ (1,0) [0|255] "s" Vector__XXX
 SG_ PeerControlDDI m9 : 16|16@1+ (1,0) [0|65535] "" Vector__XXX
 SG_ ErrorCodeObjPoolActiveResp4 m9 : 11|1@1+ (1,0) [0|0] "" Vector__XXX
 SG_ LanguageCodeCmd m2 : 8|16@1+ (1,0) [0|16383] "" Vector__XXX
 SG_ ErrorCodeObjPoolActiveResp3 m9 : 10|1@1+ (1,0) [0|0] "" Vector__XXX
 SG_ ErrorCodeObjPoolActiveResp2 m9 : 9|1@1+ (1,0) [0|0] "" Vector__XXX
 SG_ StructureLabel m0 : 8|56@1+ (1,0) [0|0] "" Vector__XXX
 SG_ VersionNumberISO11783Part10 m1 : 8|8@1- (1,0) [0|255] "" Vector__XXX
 SG_ RequestTransferDataSize m4 : 8|32@1+ (1,0) [0|4294967295] "bytes" Vector__XXX
 SG_ Status m5 : 8|8@1+ (1,0) [0|1] "" Vector__XXX
 SG_ ErrorCodeObjPoolTransfer m7 : 8|8@1+ (1,0) [0|3] "" Vector__XXX
 SG_ ActivateDeactivateCommand m8 : 8|8@1+ (1,0) [0|255] "" Vector__XXX
 SG_ ErrorCodeObjectPoolDelete m11 : 8|8@1+ (1,0) [0|0] "" Vector__XXX
 SG_ ObjectIdToChange m12 : 8|16@1+ (1,0) [0|65535] "" Vector__XXX
 SG_ ObjectIdChanged m13 : 8|16@1+ (1,0) [0|65535] "" Vector__XXX
 SG_ ErrorCodeObjPoolActiveResp1 m9 : 8|1@1+ (1,0) [0|0] "" Vector__XXX
 SG_ TechnicalDataMsgType m0M : 4|4@1+ (1,0) [0|15] "" Vector__XXX
 SG_ DeviceDescriptionMsgType m1M : 4|4@1+ (1,0) [0|15] "" Vector__XXX
 SG_ ElementNumber m2 : 4|12@1+ (1,0) [0|4095] "" Vector__XXX
 SG_ ErrorElementNumber m13 : 4|12@1+ (1,0) [0|4095] "" Vector__XXX
 SG_ Command M : 0|4@1+ (1,0) [0|15] "" Vector__XXX
 SG_ NumberOfControlChannels m1 : 56|8@1+ (1,0) [0|255] "" Vector__XXX

BO_ 2565799671 AC_TC: 8 TC
 SG_ ReservedBit : 48|1@1+ (1,0) [0|0] "" Vector__XXX
 SG_ ArbitraryAddressCapable : 63|1@1+ (1,0) [0|1] "" Vector__XXX
 SG_ IndustryGroup M : 60|3@1+ (1,0) [0|7] "" Vector__XXX
 SG_ VehicleSystemInstance : 56|4@1+ (1,0) [0|15] "" Vector__XXX
 SG_ VehicleSystem m0 : 49|7@1+ (1,0) [0|127] "" Vector__XXX
 SG_ VehicleSystem5 m5 : 49|7@1+ (1,0) [0|127] "" Vector__XXX
 SG_ VehicleSystem4 m4 : 49|7@1+ (1,0) [0|127] "" Vector__XXX
 SG_ VehicleSystem3 m3 : 49|7@1+ (1,0) [0|127] "" Vector__XXX
 SG_ VehicleSystem2 m2 : 49|7@1+ (1,0) [0|127] "" Vector__XXX
 SG_ VehicleSystem1 m1 : 49|7@1+ (1,0) [0|127] "" Vector__XXX
 SG_ Function : 40|8@1+ (1,0) [0|255] "" Vector__XXX
 SG_ FunctionInstance : 35|5@1+ (1,0) [0|31] "" Vector__XXX
 SG_ ECUInstance : 32|3@1+ (1,0) [0|7] "" Vector__XXX
 SG_ ManufacturerCode : 21|11@1+ (1,0) [0|2047] "" Vector__XXX
 SG_ IdentityNumber : 0|21@1+ (1,0) [0|2097152] "" Vector__XXX

BO_ 2362179200 PD_Sprayer: 14 Sprayer
 SG_ ActualCanopyHeight m520 : 32|32@1+ (1,0) [0|2147483647] "mm" Vector__XXX
 SG_ GNSSInstallationType m521 : 32|32@1+ (1,0) [0|100] "" Vector__XXX
 SG_ LastBaleLifetimeCount m519 : 32|32@1+ (1,0) [0|2147483647] "" Vector__XXX
 SG_ ActualTramlineCondensedWork_0000 m518 : 32|32@1+ (1,0) [0|4294967295] "" Vector__XXX
 SG_ SetpointTramlineCondensedWo_0000 m517 : 32|32@1+ (1,0) [0|4294967295] "" Vector__XXX
 SG_ TramlineOverdosingRate m516 : 32|32@1+ (1,0) [0|2147483647] "ppm" Vector__XXX
 SG_ TramlineControlState m515 : 32|32@1+ (1,0) [0|3] "" Vector__XXX
 SG_ GNSSQuality m514 : 32|32@1+ (1,0) [0|2147483647] "" Vector__XXX
 SG_ GuidanceLineDeviation m513 : 32|32@1- (1,0) [-2147483648|2147483647] "mm" Vector__XXX
 SG_ GuidanceLineSwathWidth m512 : 32|32@1+ (1,0) [0|2147483647] "mm" Vector__XXX
 SG_ TrackNumberToLeft m511 : 32|32@1- (1,0) [-2147483648|2147483647] "" Vector__XXX
 SG_ TrackNumberToRight m510 : 32|32@1- (1,0) [-2147483648|2147483647] "" Vector__XXX
 SG_ ActualTrackNumber m509 : 32|32@1- (1,0) [-2147483648|2147483647] "" Vector__XXX
 SG_ UniqueABGuidanceReferenceLineID m508 : 32|32@1+ (1,0) [0|2147483647] "" Vector__XXX
 SG_ TramlineSequenceNumber m507 : 32|32@1+ (1,0) [0|2147483647] "" Vector__XXX
 SG_ SetpointTramlineControlLevel m506 : 32|32@1+ (1,0) [0|3] "" Vector__XXX
 SG_ TramlineControlLevel m505 : 32|32@1+ (1,0) [0|7] "" Vector__XXX
 SG_ MaxEngineTorque m504 : 32|32@1+ (0.001,0) [0|2147483.647] "%" Vector__XXX
 SG_ MinEngineTorque m503 : 32|32@1+ (0.001,0) [0|2147483.647] "%" Vector__XXX
 SG_ ActualEngineTorque m502 : 32|32@1+ (0.001,0) [0|2147483.647] "%" Vector__XXX
 SG_ SetpointEngineTorque m501 : 32|32@1+ (0.001,0) [0|2147483.647] "%" Vector__XXX
 SG_ LastEventPartnerIDDeviceClass m500 : 32|32@1+ (1,0) [0|0] "" Vector__XXX
 SG_ LastEventPartnerIDManufactu_0000 m499 : 32|32@1+ (1,0) [0|0] "" Vector__XXX
 SG_ LastEventPartnerIdType m498 : 32|32@1+ (1,0) [0|0] "" Vector__XXX
 SG_ LastEventPartnerID_Byte13to16 m497 : 32|32@1+ (1,0) [0|0] "" Vector__XXX
 SG_ LastEventPartnerID_Byte9to12 m496 : 32|32@1+ (1,0) [0|0] "" Vector__XXX
 SG_ LastEventPartnerID_Byte5to8 m495 : 32|32@1+ (1,0) [0|0] "" Vector__XXX
 SG_ LastEventPartnerID_Byte1to4 m494 : 32|32@1+ (1,0) [0|0] "" Vector__XXX
 SG_ LifetimeEngineHours m493 : 32|32@1+ (0.1,0) [0|214748364.7] "h" Vector__XXX
 SG_ TotalEngineHours m492 : 32|32@1+ (0.05,0) [0|210554060.75] "h" Vector__XXX
 SG_ FuelPercentageLevel m491 : 32|32@1- (0.01,0) [0|21474836.47] "%" Vector__XXX
 SG_ MaxFuelTankContent m490 : 32|32@1+ (1,0) [0|2147483647] "ml" Vector__XXX
 SG_ MaxDieselExhaustFluidTankContent m489 : 32|32@1+ (1,0) [0|2147483647] "ml" Vector__XXX
 SG_ DieselExhaustFluidTankPerce_0000 m488 : 32|32@1+ (0.01,0) [0|100] "%" Vector__XXX
 SG_ MaxEngineSpeed m486 : 32|32@1- (0.0001,0) [0|214748.3647] "r/min" Vector__XXX
 SG_ MinEngineSpeed m485 : 32|32@1- (0.0001,0) [0|214748.3647] "r/min" Vector__XXX
 SG_ ActualEngineSpeed m484 : 32|32@1- (0.0001,0) [0|214748.3647] "r/min" Vector__XXX
 SG_ SetpointEngineSpeed m483 : 32|32@1- (0.0001,0) [0|214748.3647] "r/min" Vector__XXX
 SG_ LastBaleNumberOfSubbales m482 : 32|32@1+ (1,0) [0|2147483647] "" Vector__XXX
 SG_ SetpointNumberOfSubbales m481 : 32|32@1+ (1,0) [0|2147483647] "" Vector__XXX
 SG_ MaxFlakeSize m480 : 32|32@1- (1,0) [0|1000] "mm" Vector__XXX
 SG_ MinFlakeSize m479 : 32|32@1- (1,0) [0|1000] "mm" Vector__XXX
 SG_ SetpointFlakeSize m478 : 32|32@1- (1,0) [0|1000] "mm" Vector__XXX
 SG_ MaxBaleHydraulicPressure m477 : 32|32@1+ (1,0) [0|2147483647] "Pa" Vector__XXX
 SG_ MinBaleHydraulicPressure m476 : 32|32@1+ (1,0) [0|2147483647] "Pa" Vector__XXX
 SG_ SetpointBaleHydraulicPressure m475 : 32|32@1+ (1,0) [0|2147483647] "Pa" Vector__XXX
 SG_ MaxLengthOfCut m474 : 32|32@1+ (0.001,0) [0|2147483.647] "mm" Vector__XXX
 SG_ MinLengthOfCut m473 : 32|32@1+ (0.001,0) [0|2147483.647] "mm" Vector__XXX
 SG_ SetpointLengthOfCut m472 : 32|32@1+ (0.001,0) [0|2147483.647] "mm" Vector__XXX
 SG_ ActualPercentageContent m467 : 32|32@1+ (0.01,0) [0|100] "%" Vector__XXX
 SG_ ActualRelativeConnectorAngle m466 : 32|32@1- (0.001,0) [-180|180] "°" Vector__XXX
 SG_ LifetimeHaulCounter m465 : 32|32@1+ (1,0) [0|2147483647] "" Vector__XXX
 SG_ HaulCounter m464 : 32|32@1+ (1,0) [0|2147483647] "" Vector__XXX
 SG_ LastUnloadedCount m463 : 32|32@1+ (1,0) [0|2147483647] "" Vector__XXX
 SG_ LastLoadedCount m462 : 32|32@1+ (1,0) [0|2147483647] "" Vector__XXX
 SG_ LifetimeUnloadedTotalCount m461 : 32|32@1+ (1,0) [0|2147483647] "" Vector__XXX
 SG_ LifetimeLoadedTotalCount m460 : 32|32@1+ (1,0) [0|2147483647] "" Vector__XXX
 SG_ UnloadedTotalCount m459 : 32|32@1+ (1,0) [0|2147483647] "" Vector__XXX
 SG_ LoadedTotalCount m458 : 32|32@1+ (1,0) [0|2147483647] "" Vector__XXX
 SG_ LastUnloadedVolume m457 : 32|32@1+ (1,0) [0|2147483647] "ml" Vector__XXX
 SG_ LastLoadedVolume m456 : 32|32@1+ (1,0) [0|2147483647] "ml" Vector__XXX
 SG_ LifetimeUnloadedTotalVolume m455 : 32|32@1+ (1,0) [0|2147483647] "L" Vector__XXX
 SG_ LifetimeLoadedTotalVolume m454 : 32|32@1+ (1,0) [0|2147483647] "L" Vector__XXX
 SG_ UnloadedTotalVolume m453 : 32|32@1+ (1,0) [0|2147483647] "ml" Vector__XXX
 SG_ LoadedTotalVolume m452 : 32|32@1+ (1,0) [0|2147483647] "ml" Vector__XXX
 SG_ MaxAppRateOfDryMatter m451 : 32|32@1+ (1,0) [0|2147483647] "ppm" Vector__XXX
 SG_ MinAppRateOfDryMatter m450 : 32|32@1+ (1,0) [0|2147483647] "ppm" Vector__XXX
 SG_ ActualAppRateOfDryMatter m449 : 32|32@1+ (1,0) [0|2147483647] "ppm" Vector__XXX
 SG_ SetpointAppRateOfDryMatter m448 : 32|32@1+ (1,0) [0|2147483647] "ppm" Vector__XXX
 SG_ MaxAppRateOfPotassium m447 : 32|32@1+ (1,0) [0|4294967295] "mg/m²" Vector__XXX
 SG_ MinAppRateOfPotassium m446 : 32|32@1+ (1,0) [0|4294967295] "mg/m²" Vector__XXX
 SG_ ActualAppRateOfPotassium m445 : 32|32@1+ (1,0) [0|4294967295] "mg/m²" Vector__XXX
 SG_ SetpointAppRateOfPotassium m444 : 32|32@1+ (1,0) [0|4294967295] "mg/m²" Vector__XXX
 SG_ MaxAppRateOfPhosphor m443 : 32|32@1+ (1,0) [0|4294967295] "mg/m²" Vector__XXX
 SG_ MinAppRateOfPhosphor m442 : 32|32@1+ (1,0) [0|4294967295] "mg/m²" Vector__XXX
 SG_ ActualAppRateOfPhosphor m441 : 32|32@1+ (1,0) [0|4294967295] "mg/m²" Vector__XXX
 SG_ SetpointAppRateOfPhosphor m440 : 32|32@1+ (1,0) [0|4294967295] "mg/m²" Vector__XXX
 SG_ MaxAppRateOfAmmonium m439 : 32|32@1+ (1,0) [0|4294967295] "mg/m²" Vector__XXX
 SG_ MinAppRateOfAmmonium m438 : 32|32@1+ (1,0) [0|4294967295] "mg/m²" Vector__XXX
 SG_ ActualAppRateOfAmmonium m437 : 32|32@1+ (1,0) [0|4294967295] "mg/m²" Vector__XXX
 SG_ SetpointAppRateOfAmmonium m436 : 32|32@1+ (1,0) [0|4294967295] "mg/m²" Vector__XXX
 SG_ MaxAppRateOfNitrogen m435 : 32|32@1+ (1,0) [0|4294967295] "mg/m²" Vector__XXX
 SG_ MinAppRateOfNitrogen m434 : 32|32@1+ (1,0) [0|4294967295] "mg/m²" Vector__XXX
 SG_ ActualAppRateOfNitrogen m433 : 32|32@1+ (1,0) [0|4294967295] "mg/m²" Vector__XXX
 SG_ SetpointAppRateOfNitrogen m432 : 32|32@1+ (1,0) [0|4294967295] "mg/m²" Vector__XXX
 SG_ LifetimeUnloadedTotalMass m431 : 32|32@1+ (1,0) [0|2147483647] "kg" Vector__XXX
 SG_ LifetimeLoadedTotalMass m430 : 32|32@1+ (1,0) [0|2147483647] "kg" Vector__XXX
 SG_ UnloadedTotalMass m429 : 32|32@1+ (1,0) [0|2147483647] "kg" Vector__XXX
 SG_ LoadedTotalMass m428 : 32|32@1+ (1,0) [0|2147483647] "kg" Vector__XXX
 SG_ ActualDownforceAsForce m427 : 32|32@1- (1,0) [-2147483648|2147483647] "N" Vector__XXX
 SG_ SetpointDownforceAsForce m426 : 32|32@1- (1,0) [-2147483648|2147483647] "N" Vector__XXX
 SG_ SetpointMaxAllowedSeedSpaci_0000 m425 : 32|32@1+ (1,0) [0|2147483647] "mm" Vector__XXX
 SG_ AvgCoeffOfVariationOfSeedSp_0000 m424 : 32|32@1+ (1,0) [0|1000000] "ppm" Vector__XXX
 SG_ ActCoeffOfVariationOfSeedSp_0000 m423 : 32|32@1+ (1,0) [0|1000000] "ppm" Vector__XXX
 SG_ AverageSeedSpacingDeviation_0000 m422 : 32|32@1+ (1,0) [0|2147483647] "mm" Vector__XXX
 SG_ ActualSeedSpacingDeviation m421 : 32|32@1+ (1,0) [0|2147483647] "mm" Vector__XXX
 SG_ AverageSeedMultiplePercentage m420 : 32|32@1+ (1,0) [0|1000000] "ppm" Vector__XXX
 SG_ ActualSeedMultiplePercentage m419 : 32|32@1+ (1,0) [0|1000000] "ppm" Vector__XXX
 SG_ AverageSeedSkipPercentage m418 : 32|32@1+ (1,0) [0|1000000] "ppm" Vector__XXX
 SG_ ActualSeedSkipPercentage m417 : 32|32@1+ (1,0) [0|1000000] "ppm" Vector__XXX
 SG_ AverageSeedSingulationPercentage m416 : 32|32@1+ (1,0) [0|1000000] "ppm" Vector__XXX
 SG_ ActualSeedSingulationPercentage m415 : 32|32@1+ (1,0) [0|1000000] "ppm" Vector__XXX
 SG_ LifetimeAvgDieselExhFluidCo_0001 m414 : 32|32@1+ (1,0) [0|2147483647] "mm³/m²" Vector__XXX
 SG_ LifetimeAvgDieselExhFluidCo_0002 m413 : 32|32@1+ (1,0) [0|2147483647] "mm³/s" Vector__XXX
 SG_ LifetimeDieselExhaustFluidC_0000 m412 : 32|32@1+ (0.5,0) [0|1073741823.5] "L" Vector__XXX
 SG_ InstantDieselExhaustFluidCo_0001 m411 : 32|32@1+ (1,0) [0|2147483647] "mm³/m²" Vector__XXX
 SG_ InstantDieselExhaustFluidCo_0002 m410 : 32|32@1+ (1,0) [0|2147483647] "mm³/s" Vector__XXX
 SG_ TotalDieselExhaustFluidCons_0000 m409 : 32|32@1+ (1,0) [0|2147483647] "ml" Vector__XXX
 SG_ AverageCropContamination m408 : 32|32@1+ (1,0) [0|2147483647] "ppm" Vector__XXX
 SG_ AverageProteinContent m407 : 32|32@1+ (1,0) [0|2147483647] "ppm" Vector__XXX
 SG_ ActualProteinContent m406 : 32|32@1+ (1,0) [0|2147483647] "ppm" Vector__XXX
 SG_ ActualApplicationOfDryMatter m405 : 32|32@1+ (1,0) [0|2147483647] "mg/l" Vector__XXX
 SG_ ActualApplicationOfPotassium m404 : 32|32@1+ (1,0) [0|2147483647] "mg/l" Vector__XXX
 SG_ ActualApplicationOfPhosphor m403 : 32|32@1+ (1,0) [0|2147483647] "mg/l" Vector__XXX
 SG_ ActualApplicationOfAmmonium m402 : 32|32@1+ (1,0) [0|2147483647] "mg/l" Vector__XXX
 SG_ ActualApplicationOfNitrogen m401 : 32|32@1+ (1,0) [0|2147483647] "mg/l" Vector__XXX
 SG_ SpeedSource m400 : 32|32@1- (1,0) [0|100] "" Vector__XXX
 SG_ MaximumSpeed m399 : 32|32@1- (1,0) [-2147483648|2147483647] "mm/s" Vector__XXX
 SG_ MinimumSpeed m398 : 32|32@1- (1,0) [-2147483648|2147483647] "mm/s" Vector__XXX
 SG_ ActualSpeed m397 : 32|32@1- (1,0) [-2147483648|2147483647] "mm/s" Vector__XXX
 SG_ SetpointSpeed m396 : 32|32@1- (1,0) [-2147483648|2147483647] "mm/s" Vector__XXX
 SG_ ActualDieselExhaustFluidTan_0000 m395 : 32|32@1+ (1,0) [0|4294967295] "ml" Vector__XXX
 SG_ ActualFuelTankContent m394 : 32|32@1+ (1,0) [0|2147483647] "ml" Vector__XXX
 SG_ MaximumRevolutionsPerTime m393 : 32|32@1- (0.0001,0) [-214748.3648|214748.3647] "r/min" Vector__XXX
 SG_ MinimumRevolutionsPerTime m392 : 32|32@1- (0.0001,0) [-214748.3648|214748.3647] "r/min" Vector__XXX
 SG_ DefaultRevolutionsPerTime m391 : 32|32@1- (0.0001,0) [-214748.3647|214748.3647] "r/min" Vector__XXX
 SG_ ActualRevolutionsPerTime m390 : 32|32@1- (0.0001,0) [-214748.3648|214748.3647] "r/min" Vector__XXX
 SG_ SetpointRevolutionsAsCountP_0000 m389 : 32|32@1- (0.0001,0) [-214748.3647|214748.3647] "r/min" Vector__XXX
 SG_ TotalRevolutionsInCompleteR_0000 m388 : 32|32@1- (0.0001,0) [-214748.3648|214748.3647] "" Vector__XXX
 SG_ TotalRevolutionsInFractiona_0000 m387 : 32|32@1- (0.0001,0) [-214748.3648|214748.3647] "" Vector__XXX
 SG_ ActualAtmosphericPressure m386 : 32|32@1+ (0.1,0) [0|200000] "Pa" Vector__XXX
 SG_ MSLAtmosphericPressure m385 : 32|32@1+ (0.1,0) [0|200000] "Pa" Vector__XXX
 SG_ ApparentWindSpeed m384 : 32|32@1+ (1,0) [0|100000000] "mm/s" Vector__XXX
 SG_ ApparentWindDirection m383 : 32|32@1+ (1,0) [0|359] "°" Vector__XXX
 SG_ CondensedSectionOverrideSta_0000 m382 : 32|32@1+ (1,0) [0|4294967295] "" Vector__XXX
 SG_ CondensedSectionOverrideSta_0001 m381 : 32|32@1+ (1,0) [0|4294967295] "" Vector__XXX
 SG_ CondensedSectionOverrideSta_0002 m380 : 32|32@1+ (1,0) [0|4294967295] "" Vector__XXX
 SG_ DDI m2M : 16|16@1+ (1,0) [0|65535] "" Vector__XXX
 SG_ Command M : 0|4@1+ (1,0) [0|15] "" Vector__XXX

CM_ SG_ 2362179319 CondensedWorkState49to64 "Combination of the work states of individual sections or units (e.g. nozzles) 
number 49 to 64 into a single work state of their parent device element";
CM_ SG_ 2362179319 CondensedWorkState65to80 "Combination of the work states of individual sections or units (e.g. nozzles) 
number 65 to 80 into a single work state of their parent device element";
CM_ SG_ 2362179319 CondensedWorkState81to96 "Combination of the work states of individual sections or units (e.g. nozzles) 
number 81 to 96 into a single work state of their parent device element";
CM_ SG_ 2362179319 CondensedWorkState97to112 "Combination of the work states of individual sections or units (e.g. nozzles) 
number 97 to 112 into a single work state of their parent device element";
CM_ SG_ 2362179319 CondensedWorkState113to128 "Combination of the work states of individual sections or units (e.g. nozzles) 
number 113 to 128 into a single work state of their parent device element";
CM_ SG_ 2362179319 CondensedWorkState129to144 "Combination of the work states of individual sections or units (e.g. nozzles) 
number 129 to 144 into a single work state of their parent device element";
CM_ SG_ 2362179319 CondensedWorkState145to160 "Combination of the work states of individual sections or units (e.g. nozzles) 
number 145 to 160 into a single work state of their parent device element";
CM_ SG_ 2362179319 CondensedWorkState161to176 "Combination of the work states of individual sections or units (e.g. nozzles) 
number 161 to 176 into a single work state of their parent device element";
CM_ SG_ 2362179319 CondensedWorkState177to192 "Combination of the work states of individual sections or units (e.g. nozzles) 
number 177 to 192 into a single work state of their parent device element";
CM_ SG_ 2362179319 CondensedWorkState193to208 "Combination of the work states of individual sections or units (e.g. nozzles) 
number 193 to 208 into a single work state of their parent device element";
CM_ SG_ 2362179319 CondensedWorkState209to224 "Combination of the work states of individual sections or units (e.g. nozzles) 
number 209 to 224 into a single work state of their parent device element";
CM_ SG_ 2362179319 CondensedWorkState225to240 "Combination of the work states of individual sections or units (e.g. nozzles) 
number 225 to 240 into a single work state of their parent device element";
CM_ SG_ 2362179319 CondensedWorkState241to256 "Combination of the work states of individual sections or units (e.g. nozzles) 
number 241 to 256 into a single work state of their parent device element";
CM_ SG_ 2362179319 ActualLengthOfCut "Actual length of cut for harvested material, e.g. Forage Harvester or Tree Harvester";
CM_ SG_ 2362179319 ElementTypeInstance "This DDI is used to enumerate and identify multiple device elements (DET) 
of the same type within one Device Description object pool";
CM_ SG_ 2362179319 ActualCulturalPractice "This DDI is used to define the current cultural practice which is performed 
by an individual device operation. For instance a planter/seeder 
could provide a sowing and a fertilizing operation at the same time.";
CM_ SG_ 2362179319 DRP2GroundDistance "This DDI is used to specify the distance from the Device Reference Point (DRP) 
down to the ground surface. The DRP to Ground DDI shall be attached 
only to the Device Element (DET) with element number zero.";
CM_ SG_ 2362179319 DryMassPerAreaYield "Yield as dry mass per area. The definition of dry mass 
is the mass with a reference moisture specified by DDI 184.";
CM_ SG_ 2362179319 DryMassPerTimeYield "Yield as dry mass per time. The definition of dry mass 
is the mass with a reference moisture specified by DDI 184.";
CM_ SG_ 2362179319 YieldTotalDryMass "Accumulated Yield specified as dry mass. 
The definition of dry mass is the mass 
with a reference moisture specified by DDI 184.";
CM_ SG_ 2362179319 RefMoistureForDryMass "Moisture percentage used for the dry mass DDIs 181, 182 and 183.";
CM_ SG_ 2362179319 SeedCottonMassPerAreaYield "Seed cotton yield as mass per area, not corrected for a possibly included lint percantage.";
CM_ SG_ 2362179319 LintCottonMassPerAreaYield "Lint cotton yield as mass per area.";
CM_ SG_ 2362179319 SeedCottonMassPerTimeYield "Seed cotton yield as mass per time, not corrected for a possibly included lint percantage.";
CM_ SG_ 2362179319 LintCottonMassPerTimeYield "Lint cotton yield as mass per time.";
CM_ SG_ 2362179319 YieldTotalSeedCottonMass "Accumulated yield specified as seed cotton mass, not corrected for a possibly included lint percantage.";
CM_ SG_ 2362179319 YieldTotalLintCottonMass "Accumulated yield specified as lint cotton mass.";
CM_ SG_ 2362179319 LintTurnoutPercentage "Percent of lint in the seed cotton.";
CM_ SG_ 2362179319 AmbientTemperature "Ambient temperature measured by a machine. Unit is milli-Kelvin (mK).";
CM_ SG_ 2362179319 SetpointProductPressure "Setpoint Product Pressure to adjust the pressure of the product flow system at the point of dispensing.";
CM_ SG_ 2362179319 ActualProductPressure "Actual Product Pressure is the measured pressure in the product flow system at the point of dispensing.";
CM_ SG_ 2362179319 MinimumProductPressure "Minimun Product Pressure in the product flow system at the point of dispensing. ";
CM_ SG_ 2362179319 MaximumProductPressure "Maximum Product Pressure in the product flow system at the point of dispensing.";
CM_ SG_ 2362179319 SetpointPumpOutputPressure "Setpoint Pump Output Pressure to adjust the  pressure at the output of the solution pump.";
CM_ SG_ 2362179319 ActualPumpOutputPressure "Actual Pump Output Pressure measured at the output of the solution pump.";
CM_ SG_ 2362179319 MinimumPumpOutputPressure "Minimum Pump Output Pressure for the output pressure of the solution pump.";
CM_ SG_ 2362179319 MaximumPumpOutputPressure "Maximum Pump Output Pressure for the output pressure of the solution pump.";
CM_ SG_ 2362179319 SetpointTankAgitationPressure "Setpoint Tank Agitation Pressure to adjust the pressure for a stir system in a tank.";
CM_ SG_ 2362179319 ActualTankAgitationPressure "Actual Tank Agitation Pressure measured by the tank stir system.";
CM_ SG_ 2362179319 MinimumTankAgitationPressure "Minimun Tank Agitation Pressure for a stir system in a tank.";
CM_ SG_ 2362179319 MaximumTankAgitationPressure "Maximun Tank Agitation Pressure for a stir system in a tank.";
CM_ SG_ 2362179319 SCTurnOnTime_ "The Section Control Turn On Time defines the overall time lapse 
between the moment the TC sends a turn on section command 
to the working set and the moment this section 
is physically turned on and the product is applied.";
CM_ SG_ 2362179319 SCTurnOffTime "The Section Control Turn Off Time defines the overall time lapse 
between the moment the TC sends a turn off section command 
to the working set and the moment this section is physically turned off.";
CM_ SG_ 2362179319 WindSpeed "Wind speed measured in the treated field 
at the beginning of operations 
or on the application implement during operations.";
CM_ SG_ 2362179319 WindDirection "Wind direction measured in the treated field 
at the beginning of operations 
or on the application implement during operations.";
CM_ SG_ 2362179319 AirHumidity "Ambient humidty measured by a weather station 
in a treated field or on the application implement.";
CM_ SG_ 2362179319 SkyConditions "This DDE is used to define the current sky conditions during operation.";
CM_ SG_ 2362179319 LastBaleFlakesPerBale "The number of flakes in the most recently produced bale.";
CM_ SG_ 2362179319 LastBaleAverageMoisture "The average moisture in the most recently produced bale.";
CM_ SG_ 2362179319 LastBaleAverageStrokesPerFlake "The number of baler plunger compression strokes per flake 
that has entered the bale compression chamber. 
This value is the average valid for the most recently produced bale.";
CM_ SG_ 2362179319 LifetimeBaleCount "The number of bales produced by a machine over its entire lifetime.";
CM_ SG_ 2362179319 LifetimeWorkingHours "The number of working hours of a device element over its entire lifetime.";
CM_ SG_ 2362179319 ActualBaleHydraulicPressure "The actual value of the hydraulic pressure applied 
to the sides of the bale in the bale compression chamber.";
CM_ SG_ 2362179319 LastBaleAverageHydraulicPressure "The average actual value of the hydraulic pressure applied 
to the sides of the bale in the bale compression chamber.";
CM_ SG_ 2362179319 SetpointBaleCompressionPlungerLo "The setpoint bale compression plunger load as a unitless number.";
CM_ SG_ 2362179319 ActualBaleCompressionPlungerLoad "The actual bale compression plunger load as a unitless number.";
CM_ SG_ 2362179319 LastBaleAverageBaleCompressionPl "The average bale compression plunger load for the most recently produced bale.";
CM_ SG_ 2362179319 LastBaleAppliedPreservative "The total preservative applied to the most recently produced bale.";
CM_ SG_ 2362179319 LastBaleTagNumber "The Last Bale Tag Number as a decimal number in the range of 0 to 4294967295.";
CM_ SG_ 2362179319 LastBaleMass "The mass of the bale that has most recently been produced.";
CM_ SG_ 2362179319 DeltaT "The difference between dry bulb temperature and wet bulb temperature measured 
by a weather station in a treated field or on the application equipment.";
CM_ SG_ 2362179319 SetpointWorkingLength "This is the desired working length of the device element during operation.";
CM_ SG_ 2362179319 ActualWorkingLength "Actual Working Length of a Device Element.";
CM_ SG_ 2362179319 MinimumWorkingLength "This is the minimum working length of the device element during operation.";
CM_ SG_ 2362179319 MaximumWorkingLength "This is the maximum working length of the device element during operation.";
CM_ SG_ 2362179319 ActualNetWeight "The Actual Net Weight is the current measured mass by a weighing system.";
CM_ SG_ 2362179319 NetWeightState "The Net Weight State indicates whether the current 
Actual Net Weight value is a reliable value or not.";
CM_ SG_ 2362179319 SetpointNetWeight "The Setpoint Net Weight value is used to prompt 
the weighing system to perform a tare procedure.";
CM_ SG_ 2362179319 ActualGrossWeight "The Actual Gross Weight is the overall 
measured mass by a weighing system.";
CM_ SG_ 2362179319 GrossWeightState "The Gross Weight State indicates whether the current 
Actual Gross Weight value is a reliable value or not.";
CM_ SG_ 2362179319 MinimumGrossWeight "The Minimum Gross Weight may represent the minimum value 
of the effective range of the weighing system.";
CM_ SG_ 2362179319 MaximumGrossWeight "Maximum Gross Weight may represent the maximum value 
of the effective range of the weighing system.";
CM_ SG_ 2362179319 ThreshingEngagementTotalTime "Accumulated time while the threshing mechanism is engaged";
CM_ SG_ 2362179319 ActualHeaderWorkingHeightStatus "Actual status of the header being above or below 
the threshold height for the in-work state.";
CM_ SG_ 2362179319 ActualHeaderRotationalSpeedStatu "Actual status of the header rotational speed 
being above or below the threshold for in-work state.";
CM_ SG_ 2362179319 YieldHoldStatus "Status indicator for the yield measurement system. ";
CM_ SG_ 2362179319 ActualUnLoadingSystemStatus "Actual status of the Unloading and/or Loading system.";
CM_ SG_ 2362179319 CropTemperature "Temperature of harvested crop";
CM_ SG_ 2362179319 SetpointSieveClearance "Setpoint separation distance between Sieve elements";
CM_ SG_ 2362179319 ActualSieveClearance "Actual separation distance between Sieve elements";
CM_ SG_ 2362179319 MinimumSieveClearance "Minimal separation distance between Sieve elements";
CM_ SG_ 2362179319 MaximumSieveClearance "Maximum separation distance between Sieve elements.";
CM_ SG_ 2362179319 SetpointChafferClearance "Setpoint separation distance between Chaffer elements.";
CM_ SG_ 2362179319 ActualChafferClearance "Actual separation distance between Chaffer elements.";
CM_ SG_ 2362179319 MinimumChafferClearance "Minimum separation distance between Chaffer elements.";
CM_ SG_ 2362179319 MaximumChafferClearance "Maximum separation distance between Chaffer elements.";
CM_ SG_ 2362179319 SetpointConcaveClearance "Setpoint separation distance between Concave elements.";
CM_ SG_ 2362179319 ActualConcaveClearance "Actual separation distance between Concave elements.";
CM_ SG_ 2362179319 MinimumConcaveClearance "Minimum separation distance between Concave elements.";
CM_ SG_ 2362179319 MaximumConcaveClearance "Maximum separation distance between Concave elements.";
CM_ SG_ 2362179319 SetpointSeparationFanRotationalS "Setpoint rotational speed of the fan used 
for separating product material from non product material.";
CM_ SG_ 2362179319 ActualSeparationFanRotationalSpe "Actual rotational speed of the fan used 
for separating product material from non product material.";
CM_ SG_ 2362179319 MinimumSeparationFanRotationalSp "Minimum rotational speed of the fan used 
for separating product material from non product material.";
CM_ SG_ 2362179319 MaximumSeparationFanRotationalSp "Maximum rotational speed of the fan used 
for separating product material from non product material.";
CM_ SG_ 2362179319 HydraulicOilTemperature "Temperature of fluid in the hydraulic system.";
CM_ SG_ 2362179319 YieldLagIgnoreTime "Amount of time to ignore yield data, 
starting at the transition from the in-work to the out-of-work state. 
During this time, the yield sensor provides 
inconsistent or unreliable crop flow data.";
CM_ SG_ 2362179319 YieldLeadIgnoreTime "Amount of time to ignore yield data, 
starting at the transition from the out-of-work to the in-work state. 
During this time, the yield sensor provides 
inconsistent or unreliable crop flow data.";
CM_ SG_ 2362179319 AverageYieldMassPerTime "Average Yield expressed as mass per unit time, 
not corrected for the reference moisture percentage DDI 184. 
This value is the average for a Task and may be reported as a total.";
CM_ SG_ 2362179319 AverageCropMoisture "Average Moisture of the harvested crop. 
This value is the average for a Task and may be reported as a total.";
CM_ SG_ 2362179319 AverageYieldMassPerArea "This Average Yield Mass Per Area is the mass that includes the average crop moisture (DDI 262) i";
CM_ SG_ 2362179319 ConnectorPivotXOffset "X direction offset of a connector pivot point relative to DRP";
CM_ SG_ 2362179319 RemainingArea "Remaining Area of a field";
CM_ SG_ 2362179319 LifetimeApplicationTotalMass "Entire Application Total Count of the device lifetime";
CM_ SG_ 2362179319 LifetimeApplicationTotalCount "Entire Application Total Count of the device lifetime";
CM_ SG_ 2362179319 LifetimeYieldTotalVolume "Entire Yield Total Volume of the device lifetime";
CM_ SG_ 2362179319 LifetimeYieldTotalMass "Entire Yield Total Mass of the device lifetime";
CM_ SG_ 2362179319 LifetimeYieldTotalCount "Entire Yield Total Count of the device lifetime";
CM_ SG_ 2362179319 LifetimeTotalArea "Entire Total Area of the device lifetime";
CM_ SG_ 2362179319 LifetimeTotalDistance "Entire Total Area of the device lifetime";
CM_ SG_ 2362179319 LifetimeIneffectiveTotalDistance "Entire Ineffective Total Distance of the device lifetime";
CM_ SG_ 2362179319 LifetimeEffectiveTotalTime "Entire Ineffective Total Distance of the device lifetime";
CM_ SG_ 2362179319 LifetimeIneffectiveTotalTime "Entire Ineffective Total Time of the device lifetime";
CM_ SG_ 2362179319 LifetimeFuelConsumption "Entire Fuel Consumption of the device lifetime";
CM_ SG_ 2362179319 LifetimeAverageFuelConsumptionPe "Entire Average Fuel Consumption per Time of the device lifetime";
CM_ SG_ 2362179319 LifetimeAverageFuelConsumpt_0000 "Entire Average Fuel Consumption per Area of the device lifetime";
CM_ SG_ 2362179319 LifetimeYieldTotalDryMass "Entire Yield Total Dry Mass of the device lifetime";
CM_ SG_ 2362179319 LifetimeYieldTotalSeedCottonMass "Entire Yield Total Seed Cotton Mass of the device lifetime";
CM_ SG_ 2362179319 LifetimeYieldTotalLintCottonMass "Entire Yield Total Lint Cotton Mass of the device lifetime";
CM_ SG_ 2362179319 LifetimeThreshingEngagementTotal "Entire Threshing Engagement Total Time of the device lifetime";
CM_ SG_ 2362179319 PrecutTotalCount "The total number of pre-cutted product units produced by a device during an operation";
CM_ SG_ 2362179319 UncutTotalCount "The total number of un-cutted product units produced by a device during an operation";
CM_ SG_ 2362179319 LifetimePrecutTotalCount "Entire Precut Total Count of the device lifetime";
CM_ SG_ 2362179319 LifetimeUncutTotalCount "Entire Uncut Total Count of the device lifetime";
CM_ SG_ 2362179319 SetpointWorkState "The Setpoint Work State DDI is the control command counterparts to the Work State DDI (141)";
CM_ SG_ 2362179319 SetpointCondensedWorkState1to16 "The Setpoint Condensed Work State DDIs are the control command counterparts to the Condensed Work States DDIs (161 – 176)";
CM_ SG_ 2362179319 SetpointCondensedWorkState17to32 "The Setpoint Condensed Work State DDIs are the control command counterparts to the Condensed Work States DDIs (161 – 176)";
CM_ SG_ 2362179319 SetpointCondensedWorkState33to48 "The Setpoint Condensed Work State DDIs are the control command counterparts to the Condensed Work States DDIs (161 – 176)";
CM_ SG_ 2362179319 SetpointCondensedWorkState49to64 "The Setpoint Condensed Work State DDIs are the control command counterparts to the Condensed Work States DDIs (161 – 176)";
CM_ SG_ 2362179319 SetpointCondensedWorkState65to80 "The Setpoint Condensed Work State DDIs are the control command counterparts to the Condensed Work States DDIs (161 – 176)";
CM_ SG_ 2362179319 SetpointCondensedWorkState81to96 "The Setpoint Condensed Work State DDIs are the control command counterparts to the Condensed Work States DDIs (161 – 176)";
CM_ SG_ 2362179319 SetpointCondensedWorkState97to11 "The Setpoint Condensed Work State DDIs are the control command counterparts to the Condensed Work States DDIs (161 – 176)";
CM_ SG_ 2362179319 SetpointCondensedWorkState113to1 "The Setpoint Condensed Work State DDIs are the control command counterparts to the Condensed Work States DDIs (161 – 176)";
CM_ SG_ 2362179319 SetpointCondensedWorkState129to1 "The Setpoint Condensed Work State DDIs are the control command counterparts to the Condensed Work States DDIs (161 – 176)";
CM_ SG_ 2362179319 SetpointCondensedWorkState145to1 "The Setpoint Condensed Work State DDIs are the control command counterparts to the Condensed Work States DDIs (161 – 176)";
CM_ SG_ 2362179319 SetpointCondensedWorkState161to1 "The Setpoint Condensed Work State DDIs are the control command counterparts to the Condensed Work States DDIs (161 – 176)";
CM_ SG_ 2362179319 SetpointCondensedWorkState177to1 "The Setpoint Condensed Work State DDIs are the control command counterparts to the Condensed Work States DDIs (161 – 176)";
CM_ SG_ 2362179319 SetpointCondensedWorkState193to2 "The Setpoint Condensed Work State DDIs are the control command counterparts to the Condensed Work States DDIs (161 – 176)";
CM_ SG_ 2362179319 SetpointCondensedWorkState209to2 "The Setpoint Condensed Work State DDIs are the control command counterparts to the Condensed Work States DDIs (161 – 176)";
CM_ SG_ 2362179319 SetpointCondensedWorkState225to2 "The Setpoint Condensed Work State DDIs are the control command counterparts to the Condensed Work States DDIs (161 – 176)";
CM_ SG_ 2362179319 SetpointCondensedWorkState241to2 "The Setpoint Condensed Work State DDIs are the control command counterparts to the Condensed Work States DDIs (161 – 176)";
CM_ SG_ 2362179319 TrueRotationPointXOffset "X direction offset of the device rotation point relative to the DRP";
CM_ SG_ 2362179319 TrueRotationPointYOffset "Y direction offset of the device rotation point relative to the DRP";
CM_ SG_ 2362179319 ActualPercentageApplicationRate "Actual Application Rate expressed as percentage";
CM_ SG_ 2362179319 MinimumPercentageApplicationRate "Actual Application Rate expressed as percentage";
CM_ SG_ 2362179319 MaximumPercentageApplicationRate "Maximum Application Rate expressed as percentage";
CM_ SG_ 2362179319 RelativeYieldPotential "Relative yield potential provided by a FMIS or a sensor or entered by the operator for a certain task expressed as percentage";
CM_ SG_ 2362179319 MinimumRelativeYieldPotential "Minimum potential yield expressed as percentage";
CM_ SG_ 2362179319 MaximumRelativeYieldPotential "Maximum potential yield expressed as percentage";
CM_ SG_ 2362179319 ActualPercentageCropDryMatter "Actual Percentage Crop Dry Matter expressed as parts per million";
CM_ SG_ 2362179319 AveragePercentageCropDryMatter "Average Percentage Crop Dry Matter expressed as parts per million";
CM_ SG_ 2362179319 EffectiveTotalFuelConsumption "Accumulated total fuel consumption in working position";
CM_ SG_ 2362179319 IneffectiveTotalFuelConsumption "Accumulated total fuel consumption in non working position";
CM_ SG_ 2362179319 EffectiveTotalDieselExhaustFluid "Accumulated total Diesel Exhaust Fluid consumption in working position";
CM_ SG_ 2362179319 IneffectiveTotalDieselExhaustFlu "Accumulated total Diesel Exhaust Fluid consumption in non working position";
CM_ SG_ 2362179319 LastLoadedWeight "Last loaded Weight value specified as mass";
CM_ SG_ 2362179319 LastUnloadedWeight "Last unloaded Weight value specified as mass";
CM_ SG_ 2362179319 PGNBasedData "This DDI is used in the XML files to identify PGN based data";
CM_ SG_ 2362179319 RequestDefaultProcessData "Request Default Process Data.";
CM_ SG_ 2362179319 DataDictionaryVersion "This DDE is used to specify which version of the Data Dictionary is being used.";
CM_ SG_ 2362179319 DDI_TI "Data Dictionary Identifier";
CM_ SG_ 2362179319 DDI_DI "Data Dictionary Identifier";
CM_ SG_ 2362179319 ErrorDDI "Data Dictionary Identifier";
CM_ SG_ 2362179319 DDI "Data Dictionary Identifier";
CM_ SG_ 2362179319 BootTimeTC "Maximum number of seconds from a power cycle to transmission of first Task Controller Status message";
CM_ SG_ 2362179319 PeerControlDDI "Data Dictionary Identifier";
CM_ SG_ 2362179319 ElementNumber "Device Element Number";
CM_ SG_ 2362179319 ErrorElementNumber "Device Element Number";
CM_ SG_ 2362179319 Command "Process Data Command";
CM_ SG_ 2362179319 NumberOfControlChannels "Number of control channels for position based control";
CM_ BO_ 2565799671 "Address Claimed";
CM_ SG_ 2565799671 ReservedBit "The reserved bit shall be set to zero.";
CM_ BO_ 2362179200 "The Process Data message is used for the transmission of device description data, 
measured data and or set point commands to one or more controllers.";
CM_ SG_ 2362179200 ActualCanopyHeight "Actual height of the canopy above ground.";
CM_ SG_ 2362179200 GNSSInstallationType "Provide additional information about the type and location of the GPS receiver 
with reference to the overall system.";
CM_ SG_ 2362179200 LastBaleLifetimeCount "The Lifetime Bale Count of the bale that leaves the machine.
The value shall be equal to the Lifetime Bale Count that was reported
when this bale is knotted.";
CM_ SG_ 2362179200 ActualTramlineCondensedWork_0000 "Combination of the Actual States of individual Tramline Valves number 1 to 16 
into a single Actual Tramline State of their parent DeviceElement.";
CM_ SG_ 2362179200 SetpointTramlineCondensedWo_0000 "Combination of the Setpoint Tramline Valve Work States 
of individual Tramline Valves number 1 to 16 
into a single Setpoint Tramline Condensed Work State of their parent DeviceElement.";
CM_ SG_ 2362179200 TramlineOverdosingRate "Overdosing Rate for the rows adjacent to the Tramline Track.";
CM_ SG_ 2362179200 TramlineControlState "Specifies the actual state of Tramline Control.";
CM_ SG_ 2362179200 GNSSQuality "GNSS Quality Identifier to inform the implement about the used Position Status.";
CM_ SG_ 2362179200 GuidanceLineDeviation "Deviation of the Device-Reference-Point (DRP) to the actual
guidance line, in driving direction.";
CM_ SG_ 2362179200 GuidanceLineSwathWidth "The Swath Width is the Distance between two adjacent Guidance 
Lines in a Guidance Pattern.";
CM_ SG_ 2362179200 TrackNumberToLeft "This DDI defines a unique number of the Guidance Track to left
hand side in direction of Implement orientation.";
CM_ SG_ 2362179200 TrackNumberToRight "This DDI defines a unique number of the Guidance Track to right
hand side in direction of Implement orientation.";
CM_ SG_ 2362179200 ActualTrackNumber "This DDI defines a unique number of the Guidance Track the
Implement is currently located on.";
CM_ SG_ 2362179200 UniqueABGuidanceReferenceLineID "This DDI defines a unique ID to identify which Guidance Reference
Line is the base for the Tramline calculation.";
CM_ SG_ 2362179200 TramlineSequenceNumber "This DDI defines a group of DDIs which belong together.";
CM_ SG_ 2362179200 SetpointTramlineControlLevel "This DDI defines the Tramline Control capability of the Task
Controller that is used with the appropriate Implement.";
CM_ SG_ 2362179200 TramlineControlLevel "This DDI defines the Tramline Control capability of the Implement.";
CM_ SG_ 2362179200 MaxEngineTorque "The maximum value of the engine torque.";
CM_ SG_ 2362179200 MinEngineTorque "The minimum value of the engine torque.";
CM_ SG_ 2362179200 ActualEngineTorque "The current torque of the engine.";
CM_ SG_ 2362179200 SetpointEngineTorque "The setpoint of the engine torque.";
CM_ SG_ 2362179200 LastEventPartnerIDDeviceClass "This DDI should tell the Device Class of the “Partner” Device.";
CM_ SG_ 2362179200 LastEventPartnerIDManufactu_0000 "The Partner ID has to tell its Manufacturer, and the Manufacturer
Numbers from SAE J1939 / ISO 11783 shall be used. ";
CM_ SG_ 2362179200 LastEventPartnerIdType "Defines The Type of the Partner ID Device.";
CM_ SG_ 2362179200 LastEventPartnerID_Byte13to16 "Last Event Partner ID as a decimal number of 128bit length.
This DDI should include the Byte 13-16 of the Last Event Partner ID. ";
CM_ SG_ 2362179200 LastEventPartnerID_Byte9to12 "Last Event Partner ID as a decimal number of 128bit length.
This DDI should include the Byte 9-12 of the Last Event Partner ID. ";
CM_ SG_ 2362179200 LastEventPartnerID_Byte5to8 "Last Event Partner ID as a decimal number of 128bit length.
This DDI should include the Byte 5-8 of the Last Event Partner ID. ";
CM_ SG_ 2362179200 LastEventPartnerID_Byte1to4 "Last Event Partner ID as a decimal number of 128bit length.
This DDI should include the Byte 1-4 of the Last Event Partner ID. ";
CM_ SG_ 2362179200 LifetimeEngineHours "The total time, when the engine was running over the whole lifetime of the machine.";
CM_ SG_ 2362179200 TotalEngineHours "The total time the engine was running when the task was active.";
CM_ SG_ 2362179200 FuelPercentageLevel "The actual level of the machine fuel tank in percent.";
CM_ SG_ 2362179200 MaxFuelTankContent "This value describes the maximum ammount of fuel that can be filled into the machines Fuel tank. ";
CM_ SG_ 2362179200 MaxDieselExhaustFluidTankContent "This value describes the maximum ammount of Diesel Exhaust fluid,
that can be filled into the tank of the machine";
CM_ SG_ 2362179200 DieselExhaustFluidTankPerce_0000 "The actual level of the Diesel Exhaust Fluid Tank in percent.";
CM_ SG_ 2362179200 MaxEngineSpeed "The maximum of the rotational speed of the engine.";
CM_ SG_ 2362179200 MinEngineSpeed "The minimum of the rotational speed of the engine.";
CM_ SG_ 2362179200 ActualEngineSpeed "Actual rotational speed of the engine.";
CM_ SG_ 2362179200 SetpointEngineSpeed "The setpoint of the rotational speed of the engine.";
CM_ SG_ 2362179200 LastBaleNumberOfSubbales "Number of smaller bales included in the latest produced bale.";
CM_ SG_ 2362179200 SetpointNumberOfSubbales "Number of smaller bales that shall be included in one bigger bale.";
CM_ SG_ 2362179200 MaxFlakeSize "Maximum size of the flake that can be produced by the chamber.";
CM_ SG_ 2362179200 MinFlakeSize "Minimum size of the flake that can be produced by the chamber.";
CM_ SG_ 2362179200 SetpointFlakeSize "Setpoint size of the flake to be produced by the chamber.";
CM_ SG_ 2362179200 MaxBaleHydraulicPressure "The maximum value of the hydraulic pressure applied to the sides of
the bale in the bale compression chamber.";
CM_ SG_ 2362179200 MinBaleHydraulicPressure "The minimum value of the hydraulic pressure applied to the sides of
the bale in the bale compression chamber.";
CM_ SG_ 2362179200 SetpointBaleHydraulicPressure "The setpoint value of the hydraulic pressure applied to the sides of
the bale in the bale compression chamber.";
CM_ SG_ 2362179200 MaxLengthOfCut "Maximum length of cut for harvested material, e.g. Forage Harvester or Tree Harvester.";
CM_ SG_ 2362179200 MinLengthOfCut "Minimum length of cut for harvested material, e.g. Forage Harvester or Tree Harvester.";
CM_ SG_ 2362179200 SetpointLengthOfCut "Setpoint length of cut for harvested material, e.g. Forage Harvester or Tree Harvester.";
CM_ SG_ 2362179200 ActualPercentageContent "Actual Device Element Content specified as percent.";
CM_ SG_ 2362179200 ActualRelativeConnectorAngle "The value describes the actual angle of the longitudinal axis of the
implement relative to the longitudinal axis of the tractor.";
CM_ SG_ 2362179200 LifetimeHaulCounter "The number of haul cycles done by a machine over its entire lifetime.";
CM_ SG_ 2362179200 HaulCounter "Each Time a Device Element is filled and emptied this is called a haul cycle. 
This counter counts the cycles.";
CM_ SG_ 2362179200 LastUnloadedCount "Last unloaded Count value specified as count";
CM_ SG_ 2362179200 LastLoadedCount "Last loaded Count value specified as count";
CM_ SG_ 2362179200 LifetimeUnloadedTotalCount "Entire Unloaded Total Count of the device lifetime.";
CM_ SG_ 2362179200 LifetimeLoadedTotalCount "Entire Loaded Total Count of the device lifetime.";
CM_ SG_ 2362179200 UnloadedTotalCount "Accumulated Unloaded specified as count";
CM_ SG_ 2362179200 LoadedTotalCount "Accumulated Loads specified as count";
CM_ SG_ 2362179200 LastUnloadedVolume "Last unloaded Volume value specified as volume";
CM_ SG_ 2362179200 LastLoadedVolume "Last loaded Volume value specified as volume";
CM_ SG_ 2362179200 LifetimeUnloadedTotalVolume "Entire unloaded Volume of the device lifetime.";
CM_ SG_ 2362179200 LifetimeLoadedTotalVolume "Entire loaded Volume of the device lifetime.";
CM_ SG_ 2362179200 UnloadedTotalVolume "Accumulated Unloaded Volume specified as volume";
CM_ SG_ 2362179200 LoadedTotalVolume "Accumulated Loaded Volume specified as volume";
CM_ SG_ 2362179200 MaxAppRateOfDryMatter "Maximum application rate of dry matter expressed as percentage";
CM_ SG_ 2362179200 MinAppRateOfDryMatter "Minimum application rate of dry matter expressed as percentage";
CM_ SG_ 2362179200 ActualAppRateOfDryMatter "Actual application rate of dry matter expressed as percentage";
CM_ SG_ 2362179200 SetpointAppRateOfDryMatter "Setpoint application rate of dry matter expressed as percentage";
CM_ SG_ 2362179200 MaxAppRateOfPotassium "Maximum application rate of potassium specified as a mass per area";
CM_ SG_ 2362179200 MinAppRateOfPotassium "Minimum application rate of potassium specified as a mass per area";
CM_ SG_ 2362179200 ActualAppRateOfPotassium "Actual application rate of potassium specified as a mass per area";
CM_ SG_ 2362179200 SetpointAppRateOfPotassium "Setpoint application rate of potassium specified as a mass per area";
CM_ SG_ 2362179200 MaxAppRateOfPhosphor "Maximum application rate of phosphor specified as a mass per area";
CM_ SG_ 2362179200 MinAppRateOfPhosphor "Minimum application rate of phosphor specified as a mass per area";
CM_ SG_ 2362179200 ActualAppRateOfPhosphor "Actual application rate of phosphor specified as a mass per area";
CM_ SG_ 2362179200 SetpointAppRateOfPhosphor "Setpoint application rate of phosphor specified as a mass per area";
CM_ SG_ 2362179200 MaxAppRateOfAmmonium "Maximum application rate of Ammonium specified as a mass per area";
CM_ SG_ 2362179200 MinAppRateOfAmmonium "Minimum application rate of Ammonium specified as a mass per area";
CM_ SG_ 2362179200 ActualAppRateOfAmmonium "Actual application rate of Ammonium specified as a mass per area";
CM_ SG_ 2362179200 SetpointAppRateOfAmmonium "Setpoint application rate of Ammonium specified as a mass per area";
CM_ SG_ 2362179200 MaxAppRateOfNitrogen "Maximum application rate of nitrogen specified as a mass per area";
CM_ SG_ 2362179200 MinAppRateOfNitrogen "Minimum application rate of nitrogen specified as a mass per area";
CM_ SG_ 2362179200 ActualAppRateOfNitrogen "Actual application rate of nitrogen specified as a mass per area";
CM_ SG_ 2362179200 SetpointAppRateOfNitrogen "Setpoint application rate of nitrogen specified as a mass per area";
CM_ SG_ 2362179200 LifetimeUnloadedTotalMass "Entire Unloaded Total Mass of the device lifetime.";
CM_ SG_ 2362179200 LifetimeLoadedTotalMass "Entire Yield Total Mass of the device lifetime.";
CM_ SG_ 2362179200 UnloadedTotalMass "Accumulated Unloads specified as mass, not corrected for the
reference moisture percentage DDI 184";
CM_ SG_ 2362179200 LoadedTotalMass "Accumulated Loads specified as mass, not corrected for the
reference moisture percentage DDI 184.";
CM_ SG_ 2362179200 ActualDownforceAsForce "This value represents the actual downforce to produce the downforce
(or upforce) for an operation messured in newton.";
CM_ SG_ 2362179200 SetpointDownforceAsForce "This value represents the system pressure to produce the downforce
(or upforce) for an operation messured in newton;";
CM_ SG_ 2362179200 SetpointMaxAllowedSeedSpaci_0000 "Setpoint Maximum Allowed Seed Spacing Deviation";
CM_ SG_ 2362179200 AvgCoeffOfVariationOfSeedSp_0000 "Average Coefficient of Variation of Seed Spacing Percentage
calculated from measured seed spacing using ISO 7256-1 algorithm.
The value is the average for a Task.";
CM_ SG_ 2362179200 ActCoeffOfVariationOfSeedSp_0000 "Actual Coefficient of Variation of Seed Spacing Percentage
calculated from measured seed spacing using ISO 7256-1 algorithm";
CM_ SG_ 2362179200 AverageSeedSpacingDeviation_0000 "Average Seed Spacing Deviation from setpoint seed spacing.
The value is the average for a Task.";
CM_ SG_ 2362179200 ActualSeedSpacingDeviation "Actual Seed Spacing Deviation from setpoint seed spacing.";
CM_ SG_ 2362179200 AverageSeedMultiplePercentage "Average Seed Multiple Percentage calculated from measured seed
spacing using ISO 7256-1 'Multiples Index' algorithm. 
The value is the average for a Task.";
CM_ SG_ 2362179200 ActualSeedMultiplePercentage "Actual Seed Multiple Percentage calculated from measured seed
spacing using ISO 7256-1 'Multiples Index' algorithm.";
CM_ SG_ 2362179200 AverageSeedSkipPercentage "Average Seed Skip Percentage calculated from measured seed
spacing using ISO 7256-1 'Miss Index' algorithm. 
The value is the average for a Task.";
CM_ SG_ 2362179200 ActualSeedSkipPercentage "Actual Seed Skip Percentage calculated from measured seed 
spacing using ISO 7256-1 'Miss Index' algorithm";
CM_ SG_ 2362179200 AverageSeedSingulationPercentage "Average Seed Singulation Percentage calculated from measured
seed spacing using ISO 7256-1 'Quality of Feed Index' algorithm.
The value is the average for a Task.";
CM_ SG_ 2362179200 ActualSeedSingulationPercentage "Actual Seed Singulation Percentage calculated from measured seed
spacing using ISO 7256-1 'Quality of Feed Index' algorithm";
CM_ SG_ 2362179200 LifetimeAvgDieselExhFluidCo_0001 "Average Diesel Exhaust Fluid Consumption per Area over the entire lifetime of the device.";
CM_ SG_ 2362179200 LifetimeAvgDieselExhFluidCo_0002 "Average Diesel Exhaust Fluid Consumption per Time over the entire lifetime of the device.";
CM_ SG_ 2362179200 LifetimeDieselExhaustFluidC_0000 "Accumulated Diesel Exhaust Fluid Consumption over the entire lifetime of the device.";
CM_ SG_ 2362179200 InstantDieselExhaustFluidCo_0001 "Diesel Exhaust Fluid consumption per area.";
CM_ SG_ 2362179200 InstantDieselExhaustFluidCo_0002 "Diesel Exhaust Fluid consumption per time.";
CM_ SG_ 2362179200 TotalDieselExhaustFluidCons_0000 "Accumulated Diesel Exhaust Fluid Consumption as a Task Total.";
CM_ SG_ 2362179200 AverageCropContamination "Average amount of dirt or foreign  in a harvested crop (Parts per million).";
CM_ SG_ 2362179200 AverageProteinContent "Average Protein content of a harvested crops (Parts per million).";
CM_ SG_ 2362179200 ActualProteinContent "Actual Protein content of a harvested crops (Parts per million).";
CM_ SG_ 2362179200 ActualApplicationOfDryMatter "Actual application of Dry Matter in kilogram [kg]. Dry matter measured at Zero percent of moisture.";
CM_ SG_ 2362179200 ActualApplicationOfPotassium "Actual application of Potassium [K2] specified as gram [g]";
CM_ SG_ 2362179200 ActualApplicationOfPhosphor "Actual application of Phosphor [P2O5] specified as milligram per liter [mg/l]";
CM_ SG_ 2362179200 ActualApplicationOfAmmonium "Actual application of Ammonium [NH4] specified as milligram per liter [mg/l]";
CM_ SG_ 2362179200 ActualApplicationOfNitrogen "Actual application of Nitrogen [N2] specified as milligram per liter [mg/l]";
CM_ SG_ 2362179200 SpeedSource "The Speed Source that the device uses to report actual speed and to
process the setpoint, minimum and maximum speeds.";
CM_ SG_ 2362179200 ActualDieselExhaustFluidTan_0000 "The actualcontent of the diesel exhaust fluid tank";
CM_ SG_ 2362179200 ActualFuelTankContent "The actual content of the fuel tank.
This value can be used to see the refilling of the fuel tank or the theft of fuel.";
CM_ SG_ 2362179200 MaximumRevolutionsPerTime "Maximum Revolutions specified as count per time";
CM_ SG_ 2362179200 MinimumRevolutionsPerTime "Minimum Revolutions specified as count per time";
CM_ SG_ 2362179200 DefaultRevolutionsPerTime "Default Revolutions specified as count per time";
CM_ SG_ 2362179200 ActualRevolutionsPerTime "Actual Revolutions specified as count per time";
CM_ SG_ 2362179200 SetpointRevolutionsAsCountP_0000 "Setpoint Revolutions specified as count per time";
CM_ SG_ 2362179200 TotalRevolutionsInCompleteR_0000 "Accumulated Revolutions specified as completed integer revolutions";
CM_ SG_ 2362179200 TotalRevolutionsInFractiona_0000 "Accumulated Revolutions specified with fractional revolutions";
CM_ SG_ 2362179200 ActualAtmosphericPressure "The Actual Atmospheric Pressure is the air pressure currently measured by the weather station.";
CM_ SG_ 2362179200 MSLAtmosphericPressure "The atmospheric pressure MSL (Mean Sea Level) is the air pressure related to mean sea level.";
CM_ SG_ 2362179200 ApparentWindSpeed "The apparent wind is the wind which is measured on a moving vehicle.
It is the result of two motions: the actual true wind and the motion of the vehicle.";
CM_ SG_ 2362179200 ApparentWindDirection "The apparent wind is the wind which is measured on a moving vehicle. 
It is the result of two motions: the actual true wind and the motion of the vehicle. ";
CM_ SG_ 2362179200 CondensedSectionOverrideSta_0000 "Each child device elements override state is represented by 2 bits and defined as:
00 = section is not overridden,
01 = section is overridden,
10 = reserved,
11 = undefined / not installed.";
CM_ SG_ 2362179200 CondensedSectionOverrideSta_0001 "Each child device elements override state is represented by 2 bits and defined as:
00 = section is not overridden,
01 = section is overridden,
10 = reserved,
11 = undefined / not installed.";
CM_ SG_ 2362179200 CondensedSectionOverrideSta_0002 "Each child device elements override state is represented by 2 bits and defined as:
00 = section is not overridden,
01 = section is overridden,
10 = reserved,
11 = undefined / not installed.";
BA_DEF_ SG_  "DDI" INT 0 65535;
BA_DEF_ BO_  "SingleFrame" INT 0 1;
BA_DEF_ BO_  "VFrameFormat" ENUM  "StandardCAN","ExtendedCAN","reserved","J1939PG","vector_leerstring";
BA_DEF_ BO_  "GenMsgSendType" ENUM  "cyclic","NotUsed","IfActive","NotUsed","NotUsed","NotUsed","NotUsed","NotUsed","noMsgSendType","vector_leerstring";
BA_DEF_ BO_  "GenMsgCycleTime" INT 0 3600000;
BA_DEF_ BO_  "GenMsgRequestable" INT 0 1;
BA_DEF_ BO_  "GenMsgCycleTimeFast" INT 0 3600000;
BA_DEF_ BO_  "GenMsgILSupport" ENUM  "No","Yes";
BA_DEF_ SG_  "SPN" INT 0 524287;
BA_DEF_ SG_  "GenSigSendType" ENUM  "Cyclic","OnWrite","OnWriteWithRepetition","OnChange","OnChangeWithRepetition","IfActive","IfActiveWithRepetition","NoSigSendType";
BA_DEF_ SG_  "SigType" ENUM  "Default","Range","RangeSigned","ASCII","Discrete","Control","ReferencePGN","DTC","StringDelimiter","StringLength","StringLengthControl","MessageCounter","MessageChecksum";
BA_DEF_ SG_  "GenSigStartValue" INT -2147483648 2147483647;
BA_DEF_ SG_  "GenSigILSupport" ENUM  "No","Yes";
BA_DEF_ SG_  "SystemSignalLongSymbol" STRING ;
BA_DEF_DEF_  "DDI" 0;
BA_DEF_DEF_  "SingleFrame" 1;
BA_DEF_DEF_  "VFrameFormat" "J1939PG";
BA_DEF_DEF_  "GenMsgSendType" "noMsgSendType";
BA_DEF_DEF_  "GenMsgCycleTime" 0;
BA_DEF_DEF_  "GenMsgRequestable" 1;
BA_DEF_DEF_  "GenMsgCycleTimeFast" 0;
BA_DEF_DEF_  "GenMsgILSupport" "Yes";
BA_DEF_DEF_  "SPN" 0;
BA_DEF_DEF_  "GenSigSendType" "NoSigSendType";
BA_DEF_DEF_  "SigType" "Default";
BA_DEF_DEF_  "GenSigStartValue" 0;
BA_DEF_DEF_  "GenSigILSupport" "Yes";
BA_DEF_DEF_  "SystemSignalLongSymbol" "";
BA_ "DDI" SG_ 2362179319 CondensedWorkState49to64 164;
BA_ "DDI" SG_ 2362179319 CondensedWorkState65to80 165;
BA_ "DDI" SG_ 2362179319 CondensedWorkState81to96 166;
BA_ "DDI" SG_ 2362179319 CondensedWorkState97to112 167;
BA_ "DDI" SG_ 2362179319 CondensedWorkState113to128 168;
BA_ "DDI" SG_ 2362179319 CondensedWorkState129to144 169;
BA_ "DDI" SG_ 2362179319 CondensedWorkState145to160 170;
BA_ "DDI" SG_ 2362179319 CondensedWorkState161to176 171;
BA_ "DDI" SG_ 2362179319 CondensedWorkState177to192 172;
BA_ "DDI" SG_ 2362179319 CondensedWorkState193to208 173;
BA_ "DDI" SG_ 2362179319 CondensedWorkState209to224 174;
BA_ "DDI" SG_ 2362179319 CondensedWorkState225to240 175;
BA_ "DDI" SG_ 2362179319 CondensedWorkState241to256 176;
BA_ "DDI" SG_ 2362179319 ActualLengthOfCut 177;
BA_ "DDI" SG_ 2362179319 ElementTypeInstance 178;
BA_ "DDI" SG_ 2362179319 ActualCulturalPractice 179;
BA_ "DDI" SG_ 2362179319 DRP2GroundDistance 180;
BA_ "DDI" SG_ 2362179319 DryMassPerAreaYield 181;
BA_ "DDI" SG_ 2362179319 DryMassPerTimeYield 182;
BA_ "DDI" SG_ 2362179319 YieldTotalDryMass 183;
BA_ "DDI" SG_ 2362179319 RefMoistureForDryMass 184;
BA_ "DDI" SG_ 2362179319 SeedCottonMassPerAreaYield 185;
BA_ "DDI" SG_ 2362179319 LintCottonMassPerAreaYield 186;
BA_ "DDI" SG_ 2362179319 SeedCottonMassPerTimeYield 187;
BA_ "DDI" SG_ 2362179319 LintCottonMassPerTimeYield 188;
BA_ "DDI" SG_ 2362179319 YieldTotalSeedCottonMass 189;
BA_ "DDI" SG_ 2362179319 YieldTotalLintCottonMass 190;
BA_ "DDI" SG_ 2362179319 LintTurnoutPercentage 191;
BA_ "DDI" SG_ 2362179319 AmbientTemperature 192;
BA_ "DDI" SG_ 2362179319 SetpointProductPressure 193;
BA_ "DDI" SG_ 2362179319 ActualProductPressure 194;
BA_ "DDI" SG_ 2362179319 MinimumProductPressure 195;
BA_ "DDI" SG_ 2362179319 MaximumProductPressure 196;
BA_ "DDI" SG_ 2362179319 SetpointPumpOutputPressure 197;
BA_ "DDI" SG_ 2362179319 ActualPumpOutputPressure 198;
BA_ "DDI" SG_ 2362179319 MinimumPumpOutputPressure 199;
BA_ "DDI" SG_ 2362179319 MaximumPumpOutputPressure 200;
BA_ "DDI" SG_ 2362179319 SetpointTankAgitationPressure 201;
BA_ "DDI" SG_ 2362179319 ActualTankAgitationPressure 202;
BA_ "DDI" SG_ 2362179319 MinimumTankAgitationPressure 203;
BA_ "DDI" SG_ 2362179319 MaximumTankAgitationPressure 204;
BA_ "DDI" SG_ 2362179319 SCTurnOnTime_ 205;
BA_ "DDI" SG_ 2362179319 SCTurnOffTime 206;
BA_ "DDI" SG_ 2362179319 WindSpeed 207;
BA_ "DDI" SG_ 2362179319 WindDirection 208;
BA_ "DDI" SG_ 2362179319 AirHumidity 209;
BA_ "DDI" SG_ 2362179319 SkyConditions 210;
BA_ "DDI" SG_ 2362179319 LastBaleFlakesPerBale 211;
BA_ "DDI" SG_ 2362179319 LastBaleAverageMoisture 212;
BA_ "DDI" SG_ 2362179319 LastBaleAverageStrokesPerFlake 213;
BA_ "DDI" SG_ 2362179319 LifetimeBaleCount 214;
BA_ "DDI" SG_ 2362179319 LifetimeWorkingHours 215;
BA_ "DDI" SG_ 2362179319 ActualBaleHydraulicPressure 216;
BA_ "DDI" SG_ 2362179319 LastBaleAverageHydraulicPressure 217;
BA_ "DDI" SG_ 2362179319 SetpointBaleCompressionPlungerLo 218;
BA_ "SystemSignalLongSymbol" SG_ 2362179319 SetpointBaleCompressionPlungerLo "SetpointBaleCompressionPlungerLoad";
BA_ "DDI" SG_ 2362179319 ActualBaleCompressionPlungerLoad 219;
BA_ "DDI" SG_ 2362179319 LastBaleAverageBaleCompressionPl 220;
BA_ "SystemSignalLongSymbol" SG_ 2362179319 LastBaleAverageBaleCompressionPl "LastBaleAverageBaleCompressionPlungerLoad";
BA_ "DDI" SG_ 2362179319 LastBaleAppliedPreservative 221;
BA_ "DDI" SG_ 2362179319 LastBaleTagNumber 222;
BA_ "DDI" SG_ 2362179319 LastBaleMass 223;
BA_ "DDI" SG_ 2362179319 DeltaT 224;
BA_ "DDI" SG_ 2362179319 SetpointWorkingLength 225;
BA_ "DDI" SG_ 2362179319 ActualWorkingLength 226;
BA_ "DDI" SG_ 2362179319 MinimumWorkingLength 227;
BA_ "DDI" SG_ 2362179319 MaximumWorkingLength 228;
BA_ "DDI" SG_ 2362179319 ActualNetWeight 229;
BA_ "DDI" SG_ 2362179319 NetWeightState 230;
BA_ "DDI" SG_ 2362179319 SetpointNetWeight 231;
BA_ "DDI" SG_ 2362179319 ActualGrossWeight 232;
BA_ "DDI" SG_ 2362179319 GrossWeightState 233;
BA_ "DDI" SG_ 2362179319 MinimumGrossWeight 234;
BA_ "DDI" SG_ 2362179319 MaximumGrossWeight 235;
BA_ "DDI" SG_ 2362179319 ThreshingEngagementTotalTime 236;
BA_ "DDI" SG_ 2362179319 ActualHeaderWorkingHeightStatus 237;
BA_ "DDI" SG_ 2362179319 ActualHeaderRotationalSpeedStatu 238;
BA_ "SystemSignalLongSymbol" SG_ 2362179319 ActualHeaderRotationalSpeedStatu "ActualHeaderRotationalSpeedStatus";
BA_ "DDI" SG_ 2362179319 YieldHoldStatus 239;
BA_ "DDI" SG_ 2362179319 ActualUnLoadingSystemStatus 240;
BA_ "DDI" SG_ 2362179319 CropTemperature 241;
BA_ "DDI" SG_ 2362179319 SetpointSieveClearance 242;
BA_ "DDI" SG_ 2362179319 ActualSieveClearance 243;
BA_ "DDI" SG_ 2362179319 MinimumSieveClearance 244;
BA_ "DDI" SG_ 2362179319 MaximumSieveClearance 245;
BA_ "DDI" SG_ 2362179319 SetpointChafferClearance 246;
BA_ "DDI" SG_ 2362179319 ActualChafferClearance 247;
BA_ "DDI" SG_ 2362179319 MinimumChafferClearance 248;
BA_ "DDI" SG_ 2362179319 MaximumChafferClearance 249;
BA_ "DDI" SG_ 2362179319 SetpointConcaveClearance 250;
BA_ "DDI" SG_ 2362179319 ActualConcaveClearance 251;
BA_ "DDI" SG_ 2362179319 MinimumConcaveClearance 252;
BA_ "DDI" SG_ 2362179319 MaximumConcaveClearance 253;
BA_ "DDI" SG_ 2362179319 SetpointSeparationFanRotationalS 254;
BA_ "SystemSignalLongSymbol" SG_ 2362179319 SetpointSeparationFanRotationalS "SetpointSeparationFanRotationalSpeed";
BA_ "DDI" SG_ 2362179319 ActualSeparationFanRotationalSpe 255;
BA_ "SystemSignalLongSymbol" SG_ 2362179319 ActualSeparationFanRotationalSpe "ActualSeparationFanRotationalSpeed";
BA_ "DDI" SG_ 2362179319 MinimumSeparationFanRotationalSp 256;
BA_ "SystemSignalLongSymbol" SG_ 2362179319 MinimumSeparationFanRotationalSp "MinimumSeparationFanRotationalSpeed";
BA_ "DDI" SG_ 2362179319 MaximumSeparationFanRotationalSp 257;
BA_ "SystemSignalLongSymbol" SG_ 2362179319 MaximumSeparationFanRotationalSp "MaximumSeparationFanRotationalSpeed";
BA_ "DDI" SG_ 2362179319 HydraulicOilTemperature 258;
BA_ "DDI" SG_ 2362179319 YieldLagIgnoreTime 259;
BA_ "DDI" SG_ 2362179319 YieldLeadIgnoreTime 260;
BA_ "DDI" SG_ 2362179319 AverageYieldMassPerTime 261;
BA_ "DDI" SG_ 2362179319 AverageCropMoisture 262;
BA_ "DDI" SG_ 2362179319 AverageYieldMassPerArea 263;
BA_ "DDI" SG_ 2362179319 ConnectorPivotXOffset 264;
BA_ "DDI" SG_ 2362179319 RemainingArea 265;
BA_ "DDI" SG_ 2362179319 LifetimeApplicationTotalMass 266;
BA_ "DDI" SG_ 2362179319 LifetimeApplicationTotalCount 267;
BA_ "DDI" SG_ 2362179319 LifetimeYieldTotalVolume 268;
BA_ "DDI" SG_ 2362179319 LifetimeYieldTotalMass 269;
BA_ "DDI" SG_ 2362179319 LifetimeYieldTotalCount 270;
BA_ "DDI" SG_ 2362179319 LifetimeTotalArea 271;
BA_ "DDI" SG_ 2362179319 LifetimeTotalDistance 272;
BA_ "DDI" SG_ 2362179319 LifetimeIneffectiveTotalDistance 273;
BA_ "DDI" SG_ 2362179319 LifetimeEffectiveTotalTime 274;
BA_ "DDI" SG_ 2362179319 LifetimeIneffectiveTotalTime 275;
BA_ "DDI" SG_ 2362179319 LifetimeFuelConsumption 276;
BA_ "DDI" SG_ 2362179319 LifetimeAverageFuelConsumptionPe 277;
BA_ "SystemSignalLongSymbol" SG_ 2362179319 LifetimeAverageFuelConsumptionPe "LifetimeAverageFuelConsumptionPerTime";
BA_ "DDI" SG_ 2362179319 LifetimeAverageFuelConsumpt_0000 278;
BA_ "SystemSignalLongSymbol" SG_ 2362179319 LifetimeAverageFuelConsumpt_0000 "LifetimeAverageFuelConsumptionPerArea";
BA_ "DDI" SG_ 2362179319 LifetimeYieldTotalDryMass 279;
BA_ "DDI" SG_ 2362179319 LifetimeYieldTotalSeedCottonMass 280;
BA_ "DDI" SG_ 2362179319 LifetimeYieldTotalLintCottonMass 281;
BA_ "DDI" SG_ 2362179319 LifetimeThreshingEngagementTotal 282;
BA_ "SystemSignalLongSymbol" SG_ 2362179319 LifetimeThreshingEngagementTotal "LifetimeThreshingEngagementTotalTime";
BA_ "DDI" SG_ 2362179319 PrecutTotalCount 283;
BA_ "DDI" SG_ 2362179319 UncutTotalCount 284;
BA_ "DDI" SG_ 2362179319 LifetimePrecutTotalCount 285;
BA_ "DDI" SG_ 2362179319 LifetimeUncutTotalCount 286;
BA_ "DDI" SG_ 2362179319 SetpointWorkState 289;
BA_ "DDI" SG_ 2362179319 SetpointCondensedWorkState1to16 290;
BA_ "DDI" SG_ 2362179319 SetpointCondensedWorkState17to32 291;
BA_ "DDI" SG_ 2362179319 SetpointCondensedWorkState33to48 292;
BA_ "DDI" SG_ 2362179319 SetpointCondensedWorkState49to64 293;
BA_ "DDI" SG_ 2362179319 SetpointCondensedWorkState65to80 294;
BA_ "DDI" SG_ 2362179319 SetpointCondensedWorkState81to96 295;
BA_ "DDI" SG_ 2362179319 SetpointCondensedWorkState97to11 296;
BA_ "SystemSignalLongSymbol" SG_ 2362179319 SetpointCondensedWorkState97to11 "SetpointCondensedWorkState97to112";
BA_ "DDI" SG_ 2362179319 SetpointCondensedWorkState113to1 297;
BA_ "SystemSignalLongSymbol" SG_ 2362179319 SetpointCondensedWorkState113to1 "SetpointCondensedWorkState113to128";
BA_ "DDI" SG_ 2362179319 SetpointCondensedWorkState129to1 298;
BA_ "SystemSignalLongSymbol" SG_ 2362179319 SetpointCondensedWorkState129to1 "SetpointCondensedWorkState129to144";
BA_ "DDI" SG_ 2362179319 SetpointCondensedWorkState145to1 299;
BA_ "SystemSignalLongSymbol" SG_ 2362179319 SetpointCondensedWorkState145to1 "SetpointCondensedWorkState145to160";
BA_ "DDI" SG_ 2362179319 SetpointCondensedWorkState161to1 300;
BA_ "SystemSignalLongSymbol" SG_ 2362179319 SetpointCondensedWorkState161to1 "SetpointCondensedWorkState161to176";
BA_ "DDI" SG_ 2362179319 SetpointCondensedWorkState177to1 301;
BA_ "SystemSignalLongSymbol" SG_ 2362179319 SetpointCondensedWorkState177to1 "SetpointCondensedWorkState177to192";
BA_ "DDI" SG_ 2362179319 SetpointCondensedWorkState193to2 302;
BA_ "SystemSignalLongSymbol" SG_ 2362179319 SetpointCondensedWorkState193to2 "SetpointCondensedWorkState193to208";
BA_ "DDI" SG_ 2362179319 SetpointCondensedWorkState209to2 303;
BA_ "SystemSignalLongSymbol" SG_ 2362179319 SetpointCondensedWorkState209to2 "SetpointCondensedWorkState209to224";
BA_ "DDI" SG_ 2362179319 SetpointCondensedWorkState225to2 304;
BA_ "SystemSignalLongSymbol" SG_ 2362179319 SetpointCondensedWorkState225to2 "SetpointCondensedWorkState225to240";
BA_ "DDI" SG_ 2362179319 SetpointCondensedWorkState241to2 305;
BA_ "SystemSignalLongSymbol" SG_ 2362179319 SetpointCondensedWorkState241to2 "SetpointCondensedWorkState241to256";
BA_ "DDI" SG_ 2362179319 TrueRotationPointXOffset 306;
BA_ "DDI" SG_ 2362179319 TrueRotationPointYOffset 307;
BA_ "DDI" SG_ 2362179319 ActualPercentageApplicationRate 308;
BA_ "DDI" SG_ 2362179319 MinimumPercentageApplicationRate 309;
BA_ "DDI" SG_ 2362179319 MaximumPercentageApplicationRate 310;
BA_ "DDI" SG_ 2362179319 RelativeYieldPotential 311;
BA_ "DDI" SG_ 2362179319 MinimumRelativeYieldPotential 312;
BA_ "DDI" SG_ 2362179319 MaximumRelativeYieldPotential 313;
BA_ "DDI" SG_ 2362179319 ActualPercentageCropDryMatter 314;
BA_ "DDI" SG_ 2362179319 AveragePercentageCropDryMatter 315;
BA_ "DDI" SG_ 2362179319 EffectiveTotalFuelConsumption 316;
BA_ "DDI" SG_ 2362179319 IneffectiveTotalFuelConsumption 317;
BA_ "DDI" SG_ 2362179319 EffectiveTotalDieselExhaustFluid 318;
BA_ "SystemSignalLongSymbol" SG_ 2362179319 EffectiveTotalDieselExhaustFluid "EffectiveTotalDieselExhaustFluidConsumption";
BA_ "DDI" SG_ 2362179319 IneffectiveTotalDieselExhaustFlu 319;
BA_ "SystemSignalLongSymbol" SG_ 2362179319 IneffectiveTotalDieselExhaustFlu "IneffectiveTotalDieselExhaustFluidConsumption";
BA_ "DDI" SG_ 2362179319 LastLoadedWeight 320;
BA_ "DDI" SG_ 2362179319 LastUnloadedWeight 321;
BA_ "DDI" SG_ 2362179319 PGNBasedData 57342;
BA_ "DDI" SG_ 2362179319 RequestDefaultProcessData 57343;
BA_ "SigType" SG_ 2362179319 DateFormatCmd 1;
BA_ "SPN" SG_ 2362179319 DateFormatCmd 2412;
BA_ "SigType" SG_ 2362179319 DecimalSymbolCmd 4;
BA_ "SPN" SG_ 2362179319 DecimalSymbolCmd 2411;
BA_ "SigType" SG_ 2362179319 TimeFormatCmd 4;
BA_ "SPN" SG_ 2362179319 TimeFormatCmd 2413;
BA_ "GenSigStartValue" SG_ 2362179319 ImplementSectionControl 1;
BA_ "GenSigStartValue" SG_ 2362179319 PeerControlAssignment 1;
BA_ "GenSigStartValue" SG_ 2362179319 TC_GEO_DefinitionPositionBasedCo 1;
BA_ "SystemSignalLongSymbol" SG_ 2362179319 TC_GEO_DefinitionPositionBasedCo "TC_GEO_DefinitionPositionBasedControl";
BA_ "GenSigStartValue" SG_ 2362179319 TimeAndPositionForDataLogging 1;
BA_ "GenSigStartValue" SG_ 2362179319 Documentation 1;
BA_ "GenSigStartValue" SG_ 2362179319 BootTimeTC 255;
BA_ "SigType" SG_ 2362179319 LanguageCodeCmd 3;
BA_ "SPN" SG_ 2362179319 LanguageCodeCmd 2410;
BA_ "GenSigStartValue" SG_ 2362179319 NumberOfControlChannels 255;
BA_ "SPN" SG_ 2565799671 ArbitraryAddressCapable 2844;
BA_ "SPN" SG_ 2565799671 IndustryGroup 2846;
BA_ "SPN" SG_ 2565799671 VehicleSystemInstance 2843;
BA_ "SPN" SG_ 2565799671 Function 2841;
BA_ "SPN" SG_ 2565799671 FunctionInstance 2839;
BA_ "SPN" SG_ 2565799671 ECUInstance 2840;
BA_ "SPN" SG_ 2565799671 ManufacturerCode 2838;
BA_ "SigType" SG_ 2565799671 ManufacturerCode 1;
BA_ "SPN" SG_ 2565799671 IdentityNumber 2837;
BA_ "DDI" SG_ 2362179200 ActualCanopyHeight 520;
BA_ "DDI" SG_ 2362179200 GNSSInstallationType 521;
BA_ "DDI" SG_ 2362179200 LastBaleLifetimeCount 519;
BA_ "DDI" SG_ 2362179200 ActualTramlineCondensedWork_0000 518;
BA_ "SystemSignalLongSymbol" SG_ 2362179200 ActualTramlineCondensedWork_0000 "ActualTramlineCondensedWorkState1to16";
BA_ "DDI" SG_ 2362179200 SetpointTramlineCondensedWo_0000 517;
BA_ "SystemSignalLongSymbol" SG_ 2362179200 SetpointTramlineCondensedWo_0000 "SetpointTramlineCondensedWorkState1to16";
BA_ "DDI" SG_ 2362179200 TramlineOverdosingRate 516;
BA_ "DDI" SG_ 2362179200 TramlineControlState 515;
BA_ "DDI" SG_ 2362179200 GNSSQuality 514;
BA_ "DDI" SG_ 2362179200 GuidanceLineDeviation 513;
BA_ "DDI" SG_ 2362179200 GuidanceLineSwathWidth 512;
BA_ "DDI" SG_ 2362179200 TrackNumberToLeft 511;
BA_ "DDI" SG_ 2362179200 TrackNumberToRight 510;
BA_ "DDI" SG_ 2362179200 ActualTrackNumber 509;
BA_ "DDI" SG_ 2362179200 UniqueABGuidanceReferenceLineID 508;
BA_ "DDI" SG_ 2362179200 TramlineSequenceNumber 507;
BA_ "DDI" SG_ 2362179200 SetpointTramlineControlLevel 506;
BA_ "DDI" SG_ 2362179200 TramlineControlLevel 505;
BA_ "DDI" SG_ 2362179200 MaxEngineTorque 504;
BA_ "DDI" SG_ 2362179200 MinEngineTorque 503;
BA_ "DDI" SG_ 2362179200 ActualEngineTorque 502;
BA_ "DDI" SG_ 2362179200 SetpointEngineTorque 501;
BA_ "DDI" SG_ 2362179200 LastEventPartnerIDDeviceClass 500;
BA_ "DDI" SG_ 2362179200 LastEventPartnerIDManufactu_0000 499;
BA_ "SystemSignalLongSymbol" SG_ 2362179200 LastEventPartnerIDManufactu_0000 "LastEventPartnerIDManufacturerIDCode";
BA_ "DDI" SG_ 2362179200 LastEventPartnerIdType 498;
BA_ "DDI" SG_ 2362179200 LastEventPartnerID_Byte13to16 497;
BA_ "DDI" SG_ 2362179200 LastEventPartnerID_Byte9to12 496;
BA_ "DDI" SG_ 2362179200 LastEventPartnerID_Byte5to8 495;
BA_ "DDI" SG_ 2362179200 LastEventPartnerID_Byte1to4 494;
BA_ "DDI" SG_ 2362179200 LifetimeEngineHours 493;
BA_ "DDI" SG_ 2362179200 TotalEngineHours 492;
BA_ "DDI" SG_ 2362179200 FuelPercentageLevel 491;
BA_ "DDI" SG_ 2362179200 MaxFuelTankContent 490;
BA_ "DDI" SG_ 2362179200 MaxDieselExhaustFluidTankContent 489;
BA_ "DDI" SG_ 2362179200 DieselExhaustFluidTankPerce_0000 488;
BA_ "SystemSignalLongSymbol" SG_ 2362179200 DieselExhaustFluidTankPerce_0000 "DieselExhaustFluidTankPercentageLevel";
BA_ "DDI" SG_ 2362179200 MaxEngineSpeed 486;
BA_ "DDI" SG_ 2362179200 MinEngineSpeed 485;
BA_ "DDI" SG_ 2362179200 ActualEngineSpeed 484;
BA_ "DDI" SG_ 2362179200 SetpointEngineSpeed 483;
BA_ "DDI" SG_ 2362179200 LastBaleNumberOfSubbales 482;
BA_ "DDI" SG_ 2362179200 SetpointNumberOfSubbales 481;
BA_ "DDI" SG_ 2362179200 MaxFlakeSize 480;
BA_ "DDI" SG_ 2362179200 MinFlakeSize 479;
BA_ "DDI" SG_ 2362179200 SetpointFlakeSize 478;
BA_ "DDI" SG_ 2362179200 MaxBaleHydraulicPressure 477;
BA_ "DDI" SG_ 2362179200 MinBaleHydraulicPressure 476;
BA_ "DDI" SG_ 2362179200 SetpointBaleHydraulicPressure 475;
BA_ "DDI" SG_ 2362179200 MaxLengthOfCut 474;
BA_ "DDI" SG_ 2362179200 MinLengthOfCut 473;
BA_ "DDI" SG_ 2362179200 SetpointLengthOfCut 472;
BA_ "DDI" SG_ 2362179200 ActualPercentageContent 467;
BA_ "DDI" SG_ 2362179200 ActualRelativeConnectorAngle 466;
BA_ "DDI" SG_ 2362179200 LifetimeHaulCounter 465;
BA_ "DDI" SG_ 2362179200 HaulCounter 464;
BA_ "DDI" SG_ 2362179200 LastUnloadedCount 463;
BA_ "DDI" SG_ 2362179200 LastLoadedCount 462;
BA_ "DDI" SG_ 2362179200 LifetimeUnloadedTotalCount 461;
BA_ "DDI" SG_ 2362179200 LifetimeLoadedTotalCount 460;
BA_ "DDI" SG_ 2362179200 UnloadedTotalCount 459;
BA_ "DDI" SG_ 2362179200 LoadedTotalCount 458;
BA_ "DDI" SG_ 2362179200 LastUnloadedVolume 457;
BA_ "DDI" SG_ 2362179200 LastLoadedVolume 456;
BA_ "DDI" SG_ 2362179200 LifetimeUnloadedTotalVolume 455;
BA_ "DDI" SG_ 2362179200 LifetimeLoadedTotalVolume 454;
BA_ "DDI" SG_ 2362179200 UnloadedTotalVolume 453;
BA_ "DDI" SG_ 2362179200 LoadedTotalVolume 452;
BA_ "DDI" SG_ 2362179200 MaxAppRateOfDryMatter 451;
BA_ "DDI" SG_ 2362179200 MinAppRateOfDryMatter 450;
BA_ "DDI" SG_ 2362179200 ActualAppRateOfDryMatter 449;
BA_ "DDI" SG_ 2362179200 SetpointAppRateOfDryMatter 448;
BA_ "DDI" SG_ 2362179200 MaxAppRateOfPotassium 447;
BA_ "DDI" SG_ 2362179200 MinAppRateOfPotassium 446;
BA_ "DDI" SG_ 2362179200 ActualAppRateOfPotassium 445;
BA_ "DDI" SG_ 2362179200 SetpointAppRateOfPotassium 444;
BA_ "DDI" SG_ 2362179200 MaxAppRateOfPhosphor 443;
BA_ "DDI" SG_ 2362179200 MinAppRateOfPhosphor 442;
BA_ "DDI" SG_ 2362179200 ActualAppRateOfPhosphor 441;
BA_ "DDI" SG_ 2362179200 SetpointAppRateOfPhosphor 440;
BA_ "DDI" SG_ 2362179200 MaxAppRateOfAmmonium 439;
BA_ "DDI" SG_ 2362179200 MinAppRateOfAmmonium 438;
BA_ "DDI" SG_ 2362179200 ActualAppRateOfAmmonium 437;
BA_ "DDI" SG_ 2362179200 SetpointAppRateOfAmmonium 436;
BA_ "DDI" SG_ 2362179200 MaxAppRateOfNitrogen 435;
BA_ "DDI" SG_ 2362179200 MinAppRateOfNitrogen 434;
BA_ "DDI" SG_ 2362179200 ActualAppRateOfNitrogen 433;
BA_ "DDI" SG_ 2362179200 SetpointAppRateOfNitrogen 432;
BA_ "DDI" SG_ 2362179200 LifetimeUnloadedTotalMass 431;
BA_ "DDI" SG_ 2362179200 LifetimeLoadedTotalMass 430;
BA_ "DDI" SG_ 2362179200 UnloadedTotalMass 429;
BA_ "DDI" SG_ 2362179200 LoadedTotalMass 428;
BA_ "DDI" SG_ 2362179200 ActualDownforceAsForce 427;
BA_ "DDI" SG_ 2362179200 SetpointDownforceAsForce 426;
BA_ "DDI" SG_ 2362179200 SetpointMaxAllowedSeedSpaci_0000 425;
BA_ "SystemSignalLongSymbol" SG_ 2362179200 SetpointMaxAllowedSeedSpaci_0000 "SetpointMaxAllowedSeedSpacingDeviation";
BA_ "DDI" SG_ 2362179200 AvgCoeffOfVariationOfSeedSp_0000 424;
BA_ "SystemSignalLongSymbol" SG_ 2362179200 AvgCoeffOfVariationOfSeedSp_0000 "AvgCoeffOfVariationOfSeedSpacingPercentage";
BA_ "DDI" SG_ 2362179200 ActCoeffOfVariationOfSeedSp_0000 423;
BA_ "SystemSignalLongSymbol" SG_ 2362179200 ActCoeffOfVariationOfSeedSp_0000 "ActCoeffOfVariationOfSeedSpacingPercentage";
BA_ "DDI" SG_ 2362179200 AverageSeedSpacingDeviation_0000 422;
BA_ "SystemSignalLongSymbol" SG_ 2362179200 AverageSeedSpacingDeviation_0000 "AverageSeedSpacingDeviation_Copy_1";
BA_ "DDI" SG_ 2362179200 ActualSeedSpacingDeviation 421;
BA_ "DDI" SG_ 2362179200 AverageSeedMultiplePercentage 420;
BA_ "DDI" SG_ 2362179200 ActualSeedMultiplePercentage 419;
BA_ "DDI" SG_ 2362179200 AverageSeedSkipPercentage 418;
BA_ "DDI" SG_ 2362179200 ActualSeedSkipPercentage 417;
BA_ "DDI" SG_ 2362179200 AverageSeedSingulationPercentage 416;
BA_ "DDI" SG_ 2362179200 ActualSeedSingulationPercentage 415;
BA_ "DDI" SG_ 2362179200 LifetimeAvgDieselExhFluidCo_0001 414;
BA_ "SystemSignalLongSymbol" SG_ 2362179200 LifetimeAvgDieselExhFluidCo_0001 "LifetimeAvgDieselExhFluidConsumpPerArea";
BA_ "DDI" SG_ 2362179200 LifetimeAvgDieselExhFluidCo_0002 413;
BA_ "SystemSignalLongSymbol" SG_ 2362179200 LifetimeAvgDieselExhFluidCo_0002 "LifetimeAvgDieselExhFluidConsumpPerTime";
BA_ "DDI" SG_ 2362179200 LifetimeDieselExhaustFluidC_0000 412;
BA_ "SPN" SG_ 2362179200 LifetimeDieselExhaustFluidC_0000 5963;
BA_ "SystemSignalLongSymbol" SG_ 2362179200 LifetimeDieselExhaustFluidC_0000 "LifetimeDieselExhaustFluidConsumption";
BA_ "DDI" SG_ 2362179200 InstantDieselExhaustFluidCo_0001 411;
BA_ "SystemSignalLongSymbol" SG_ 2362179200 InstantDieselExhaustFluidCo_0001 "InstantDieselExhaustFluidConsumpPerArea";
BA_ "DDI" SG_ 2362179200 InstantDieselExhaustFluidCo_0002 410;
BA_ "SystemSignalLongSymbol" SG_ 2362179200 InstantDieselExhaustFluidCo_0002 "InstantDieselExhaustFluidConsumpPerTime";
BA_ "DDI" SG_ 2362179200 TotalDieselExhaustFluidCons_0000 409;
BA_ "SystemSignalLongSymbol" SG_ 2362179200 TotalDieselExhaustFluidCons_0000 "TotalDieselExhaustFluidConsumption";
BA_ "DDI" SG_ 2362179200 AverageCropContamination 408;
BA_ "DDI" SG_ 2362179200 AverageProteinContent 407;
BA_ "DDI" SG_ 2362179200 ActualProteinContent 406;
BA_ "DDI" SG_ 2362179200 ActualApplicationOfDryMatter 405;
BA_ "DDI" SG_ 2362179200 ActualApplicationOfPotassium 404;
BA_ "DDI" SG_ 2362179200 ActualApplicationOfPhosphor 403;
BA_ "DDI" SG_ 2362179200 ActualApplicationOfAmmonium 402;
BA_ "DDI" SG_ 2362179200 ActualApplicationOfNitrogen 401;
BA_ "DDI" SG_ 2362179200 SpeedSource 400;
BA_ "DDI" SG_ 2362179200 MaximumSpeed 399;
BA_ "DDI" SG_ 2362179200 MinimumSpeed 398;
BA_ "DDI" SG_ 2362179200 ActualSpeed 397;
BA_ "DDI" SG_ 2362179200 SetpointSpeed 396;
BA_ "DDI" SG_ 2362179200 ActualDieselExhaustFluidTan_0000 395;
BA_ "SystemSignalLongSymbol" SG_ 2362179200 ActualDieselExhaustFluidTan_0000 "ActualDieselExhaustFluidTankContent";
BA_ "DDI" SG_ 2362179200 ActualFuelTankContent 394;
BA_ "DDI" SG_ 2362179200 MaximumRevolutionsPerTime 393;
BA_ "DDI" SG_ 2362179200 MinimumRevolutionsPerTime 392;
BA_ "DDI" SG_ 2362179200 DefaultRevolutionsPerTime 391;
BA_ "DDI" SG_ 2362179200 ActualRevolutionsPerTime 390;
BA_ "DDI" SG_ 2362179200 SetpointRevolutionsAsCountP_0000 389;
BA_ "SystemSignalLongSymbol" SG_ 2362179200 SetpointRevolutionsAsCountP_0000 "SetpointRevolutionsAsCountPerTime";
BA_ "DDI" SG_ 2362179200 TotalRevolutionsInCompleteR_0000 388;
BA_ "SystemSignalLongSymbol" SG_ 2362179200 TotalRevolutionsInCompleteR_0000 "TotalRevolutionsInCompleteRevolutions";
BA_ "DDI" SG_ 2362179200 TotalRevolutionsInFractiona_0000 387;
BA_ "SystemSignalLongSymbol" SG_ 2362179200 TotalRevolutionsInFractiona_0000 "TotalRevolutionsInFractionalRevolutions";
BA_ "DDI" SG_ 2362179200 ActualAtmosphericPressure 386;
BA_ "DDI" SG_ 2362179200 MSLAtmosphericPressure 385;
BA_ "DDI" SG_ 2362179200 ApparentWindSpeed 384;
BA_ "DDI" SG_ 2362179200 ApparentWindDirection 383;
BA_ "DDI" SG_ 2362179200 CondensedSectionOverrideSta_0000 382;
BA_ "SystemSignalLongSymbol" SG_ 2362179200 CondensedSectionOverrideSta_0000 "CondensedSectionOverrideState241to256";
BA_ "DDI" SG_ 2362179200 CondensedSectionOverrideSta_0001 381;
BA_ "SystemSignalLongSymbol" SG_ 2362179200 CondensedSectionOverrideSta_0001 "CondensedSectionOverrideState225to240";
BA_ "DDI" SG_ 2362179200 CondensedSectionOverrideSta_0002 380;
BA_ "SystemSignalLongSymbol" SG_ 2362179200 CondensedSectionOverrideSta_0002 "CondensedSectionOverrideState209to224";
VAL_ 2362179319 ErrorCodeProcessData1 1 "CommandNotSupported" 0 "NoError" ;
VAL_ 2362179319 DateFormatCmd 5 "yyyyddmm" 4 "yyyymmdd" 3 "mmddyyyy" 2 "mmyyyydd" 1 "ddyyyymm" 0 "ddmmyyyy" ;
VAL_ 2362179319 PeerControlCommand 0 "Assign Receiver" 1 "UnassignReceiver" 2 "Receiver Ackowledge" 3 "Assign Transmitter" 4 "UnassignTransmitter" 5 "Transmitter Acknowledge" ;
VAL_ 2362179319 DecimalSymbolCmd 3 "NoAction" 1 "PointIsUsed" 0 "CommaIsUsed" ;
VAL_ 2362179319 TimeFormatCmd 3 "NoAction" 1 "Hour12" 0 "Hour24" ;
VAL_ 2362179319 ImplementSectionControl 0 "NotSupported" 1 "Supported" ;
VAL_ 2362179319 PeerControlAssignment 0 "NotSupported" 1 "Supported" ;
VAL_ 2362179319 TC_GEO_DefinitionPositionBasedCo 0 "NotSupported" 1 "Supported" ;
VAL_ 2362179319 TimeAndPositionForDataLogging 0 "NotSupported" 1 "Supported" ;
VAL_ 2362179319 Documentation 0 "NotSupported" 1 "Supported" ;
VAL_ 2362179319 ErrorCodeChangeDesignator 0 "Success" 1 "Error" ;
VAL_ 2362179319 ErrorDetailObjectPoolDelete 255 "NotAvailable" 1 "ServerCannotCheckObjectPoolRef" 0 "ObjectPoolIsReferencedByTaskData" ;
VAL_ 2362179319 DDI 57343 "RequestDefaultProcessData" 57342 "PGNBasedData" 521 "GNSSInstallationType" 520 "ActualCanopyHeight" 519 "LastBaleLifetimeCount" 518 "ActualTramlineCondensedWorkState1to16" 517 "SetpointTramlineCondensedWorkState1to16" 516 "TramlineOverdosingRate" 515 "TramlineControlState" 514 "GNSSQuality" 513 "GuidanceLineDeviation" 512 "GuidanceLineSwathWidth" 511 "TrackNumberToTheLeft" 510 "TrackNumberToTheRight" 509 "ActualTrackNumber" 508 "UniqueABGuidanceReferenceLineID" 507 "TramlineSequenceNumber" 506 "SetpointTramlineControlLevel" 505 "TramlineControlLevel" 504 "MaximumEngineTorque" 503 "MinimumEngineTorque" 502 "ActualEngineTorque" 501 "SetpointEngineTorque" 500 "LastEventPartnerIDDeviceClass" 499 "LastEventPartnerIDManufacturerIDCode" 498 "LastEventPartnerIDType" 497 "LastEventPartnerID_Byte13to16" 496 "LastEventPartnerID_Byte9to12" 495 "LastEventPartnerID_Byte5to8" 494 "LastEventPartnerID_Byte1to4" 493 "LifetimeEngineHours" 492 "TotalEngineHours" 491 "FuelPercentageLevel" 490 "MaximumFuelTankContent" 489 "MaximumDieselExhaustFluidTankContent" 488 "DieselExhaustFluidTankPercentageLevel" 486 "MaximumEngineSpeed" 485 "MinimumEngineSpeed" 484 "ActualEngineSpeed" 483 "SetpointEngineSpeed" 482 "LastBaleNumberofSubbales" 481 "SetpointNumberofSubbales" 480 "MaximumFlakeSize" 479 "MinimumFlakeSize" 478 "SetpointFlakeSize" 477 "MaximumBaleHydraulicPressure" 476 "MinimumBaleHydraulicPressure" 475 "SetpointBaleHydraulicPressure" 474 "MaximumLengthofCut" 473 "Minimumlengthofcut" 472 "SetpointLengthofCut" 467 "ActualPercentageContent" 466 "Actualrelativeconnectorangle" 465 "LifetimeHaulCounter" 464 "HaulCounter" 463 "LastunloadedCount" 462 "LastloadedCount" 461 "LifetimeUnloadedTotalCount" 460 "LifetimeLoadedTotalCount" 459 "UnloadedTotalCount" 458 "LoadedTotalCount" 457 "LastunloadedVolume" 456 "LastloadedVolume" 455 "LifetimeUnloadedTotalVolume" 454 "LifetimeloadedTotalVolume" 453 "UnloadedTotalVolume" 452 "LoadedTotalVolume" 451 "MaximumApplicationRateofDryMatter" 450 "MinimumApplicationRateofDryMatter" 449 "ActualApplicationRateofDryMatter" 448 "SetpointApplicationRateofDryMatter" 447 "MaximumApplicationRateofPotassium" 446 "MinimumApplicationRateofPotassium" 445 "ActualApplicationRateofPotassium" 444 "SetpointApplicationRateofPotassium" 443 "MaximumApplicationRateofPhosphor" 442 "MinimumApplicationRateofPhosphor" 441 "ActualApplicationRateofPhosphor" 440 "SetpointApplicationRateofPhosphor" 439 "MaximumApplicationRateofAmmonium" 438 "MinimumApplicationRateofAmmonium" 437 "ActualApplicationRateofAmmonium" 436 "SetpointApplicationRateofAmmonium" 435 "MaximumApplicationRateofNitrogen" 434 "MinimumApplicationRateofNitrogen" 433 "ActualApplicationRateofNitrogen" 432 "SetpointApplicationRateofNitrogen" 431 "LifetimeUnloadedTotalMass" 430 "LifetimeLoadedTotalMass" 429 "UnloadedTotalMass" 428 "LoadedTotalMass" 427 "ActualDownforceasForce" 426 "SetpointDownforceasForce" 425 "SetpointMaximumAllowedSeedSpacingDeviation" 424 "AverageCoefficientofVariationofSeedSpacingPercentage" 423 "ActualCoefficientofVariationofSeedSpacingPercentage" 422 "AverageSeedSpacingDeviation" 421 "ActualSeedSpacingDeviation" 420 "AverageSeedMultiplePercentage" 419 "ActualSeedMultiplePercentage" 418 "AverageSeedSkipPercentage" 417 "ActualSeedSkipPercentage" 416 "AverageSeedSingulationPercentage" 415 "ActualSeedSingulationPercentage" 414 "LifetimeAverageDieselExhaustFluidConsumptionperArea" 413 "LifetimeAverageDieselExhaustFluidConsumptionperTime" 412 "LifetimeDieselExhaustFluidConsumption" 411 "InstantaneousDieselExhaustFluidConsumptionperArea" 410 "InstantaneousDieselExhaustFluidConsumptionperTime" 409 "TotalDieselExhaustFluidConsumption" 408 "AverageCropContamination" 407 "AverageProteinContent" 406 "ActualProteinContent" 405 "ActualapplicationofDryMatter" 404 "ActualapplicationofPotassium" 403 "ActualapplicationofPhosphor" 402 "ActualapplicationofAmmonium" 401 "ActualApplicationofNitrogen" 400 "SpeedSource" 399 "MaximumSpeed" 398 "MinimumSpeed" 397 "ActualSpeed" 396 "SetpointSpeed" 395 "ActualDieselExhaustFluidTankContent" 394 "ActualFuelTankContent" 393 "MaximumRevolutionsPerTime" 392 "MinimumRevolutionsPerTime" 391 "DefaultRevolutionsPerTime" 390 "ActualRevolutionsPerTime" 389 "SetpointRevolutionsspecifiedascountpertime" 388 "TotalRevolutionsinCompleteRevolutions" 387 "TotalRevolutionsinFractionalRevolutions" 386 "ActualAtmosphericPressure" 385 "MSLAtmosphericPressure" 384 "ApparentWindSpeed" 383 "ApparentWindDirection" 382 "CondensedSectionOverrideState241to256" 381 "CondensedSectionOverrideState225to240" 380 "CondensedSectionOverrideState209to224" 379 "CondensedSectionOverrideState193to208" 378 "CondensedSectionOverrideState177to192" 377 "CondensedSectionOverrideState161to176" 376 "CondensedSectionOverrideState145to160" 375 "CondensedSectionOverrideState129to144" 374 "CondensedSectionOverrideState113to128" 373 "CondensedSectionOverrideState97to112" 372 "CondensedSectionOverrideState81to96" 371 "CondensedSectionOverrideState65to80" 370 "CondensedSectionOverrideState49to64" 369 "CondensedSectionOverrideState33to48" 368 "CondensedSectionOverrideState17to32" 367 "CondensedSectionOverrideState1to16" 366 "ActualDownforcePressure" 365 "SetpointDownforcePressure" 364 "ActualFlakeSize" 363 "LastBaleDryMass" 362 "TotalBaleLength" 361 "LastBaleDensity" 360 "LastBaleSize" 359 "AverageDryYieldMassPerArea" 358 "AverageDryYieldMassPerTime" 357 "TotalApplicationofDryMatter" 356 "TotalApplicationofPotassium" 355 "TotalApplicationofPhosphor" 354 "TotalApplicationofAmmonium" 353 "TotalApplicationofNitrogen" 352 "ApplicationTotalMassingram[g]" 351 "ApplicationTotalVolumein[ml]" 350 "FunctionorOperationTechnique" 349 "NozzleDriftReduction" 348 "MaximumSwathingWidth" 347 "MinimumSwathingWidth" 346 "ActualSwathingWidth" 345 "SetpointSwathingWidth" 344 "MaximumGrainKernelCrackerGap" 343 "MinimumGrainKernelCrackerGap" 342 "ActualGrainKernelCrackerGap" 341 "SetpointGrainKernelCrackerGap" 340 "EffectiveTotalUnloadingTime" 339 "EffectiveTotalLoadingTime" 338 "LifetimeRearPTOHours" 337 "LifetimeFrontPTOhours" 336 "RearPTOhours" 335 "FrontPTOhours" 334 "OperatingHoursSinceLastSharpening" 333 "MaximumCuttingdrumspeed" 332 "MinimumCuttingdrumspeed" 331 "ActualCuttingdrumspeed" 330 "SetpointCuttingdrumspeed" 329 "MaximumHeaderSpeed" 328 "MinimumHeaderSpeed" 327 "ActualHeaderSpeed" 326 "SetpointHeaderSpeed" 325 "LifetimeApplicationTotalVolume" 324 "ChopperEngagementTotalTime" 323 "UnloadIdentificationNumber" 322 "LoadIdentificationNumber" 321 "LastunloadedWeight" 320 "LastloadedWeight" 319 "IneffectiveTotalDieselExhaustFluidConsumption" 318 "EffectiveTotalDieselExhaustFluidConsumption" 317 "IneffectiveTotalFuelConsumption" 316 "EffectiveTotalFuelConsumption" 315 "AveragePercentageCropDryMatter" 314 "ActualPercentageCropDryMatter" 313 "MaximumRelativeYieldPotential" 312 "MinimumRelativeYieldPotential" 311 "RelativeYieldPotential" 310 "MaximumPercentageApplicationRate" 309 "MinimumPercentageApplicationRate" 308 "ActualPercentageApplicationRate" 307 "TrueRotationPointYtoOffset" 306 "TrueRotationPointXtoOffset" 305 "SetpointCondensedWorkState241to256" 304 "SetpointCondensedWorkState225to240" 303 "SetpointCondensedWorkState209to224" 302 "SetpointCondensedWorkState193to208" 301 "SetpointCondensedWorkState177to192" 300 "SetpointCondensedWorkState161to176" 299 "SetpointCondensedWorkState145to160" 298 "SetpointCondensedWorkState129to144" 297 "SetpointCondensedWorkState113to128" 296 "SetpointCondensedWorkState97to112" 295 "SetpointCondensedWorkState81to96" 294 "SetpointCondensedWorkState65to80" 293 "SetpointCondensedWorkState49to64" 292 "SetpointCondensedWorkState33to48" 291 "SetpointCondensedWorkState17to32" 290 "SetpointCondensedWorkState1to16" 289 "SetpointWorkState" 288 "ActualPrescriptionMode" 287 "SetpointPrescriptionMode" 286 "LifetimeUncutTotalCount" 285 "LifetimePrecutTotalCount" 284 "UncutTotalCount" 283 "PrecutTotalCount" 282 "LifetimeThreshingEngagementTotalTime" 281 "LifetimeYieldTotalLintCottonMass" 280 "LifetimeYieldTotalSeedCottonMass" 279 "LifetimeYieldTotalDryMass" 278 "LifetimeAverageFuelConsumptionperArea" 277 "LifetimeAverageFuelConsumptionperTime" 276 "LifetimeFuelConsumption" 275 "LifetimeIneffectiveTotalTime" 274 "LifetimeEffectiveTotalTime" 273 "LifetimeIneffectiveTotalDistance" 272 "LifetimeEffectiveTotalDistance" 271 "LifetimeTotalArea" 270 "LifetimeYieldTotalCount" 269 "LifetimeYieldTotalMass" 268 "LifetimeYieldTotalVolume" 267 "LifetimeApplicationTotalCount" 266 "LifetimeApplicationTotalMass" 265 "RemainingArea" 264 "ConnectorPivotXtoOffset" 263 "AverageYieldMassPerArea" 262 "AverageCropMoisture" 261 "AverageYieldMassPerTime" 260 "YieldLeadIgnoreTime" 259 "YieldLagIgnoreTime" 258 "HydraulicOilTemperature" 257 "MaximumSeparationFanRotationalSpeed" 256 "MinimumSeparationFanRotationalSpeed" 255 "ActualSeparationFanRotationalSpeed" 254 "SetpointSeparationFanRotationalSpeed" 253 "MaximumConcaveClearance" 252 "MinimumConcaveClearance" 251 "ActualConcaveClearance" 250 "SetpointConcaveClearance" 249 "MaximumChafferClearance" 248 "MinimumChafferClearance" 247 "ActualChafferClearance" 246 "SetpointChafferClearance" 245 "MaximumSieveClearance" 244 "MinimumSieveClearance" 243 "ActualSieveClearance" 242 "SetpointSieveClearance" 241 "CropTemperature" 240 "ActualUnLoadingSystemStatus" 239 "YieldHoldStatus" 238 "ActualHeaderRotationalSpeedStatus" 237 "ActualHeaderWorkingHeightStatus" 236 "ThresherEngagementTotalTime" 235 "MaximumGrossWeight" 234 "MinimumGrossWeight" 233 "GrossWeightState" 232 "ActualGrossWeight" 231 "SetpointNetWeight" 230 "NetWeightState" 229 "ActualNetWeight" 228 "MaximumWorkingLength" 227 "MinimumWorkingLength" 226 "ActualWorkingLength" 225 "SetpointWorkingLength" 224 "DeltaT" 223 "LastBaleMass" 222 "LastBaleTagNumber" 221 "LastBaleAppliedPreservative" 220 "LastBaleAverageBaleCompressionPlungerLoad" 219 "ActualBaleCompressionPlungerLoad" 218 "SetpointBaleCompressionPlungerLoad" 217 "LastBaleAverageHydraulicPressure" 216 "ActualBaleHydraulicPressure" 215 "LifetimeWorkingHours" 214 "LifetimeBaleCount" 213 "LastBaleAverageStrokesperFlake" 212 "LastBaleAverageMoisture" 211 "LastBaleFlakesperBale" 210 "Skyconditions" 209 "AirHumidity" 208 "Winddirection" 207 "Windspeed" 206 "SCTurnOffTime" 205 "SCTurnOnTime" 204 "MaximumTankAgitationPressure" 203 "MinimumTankAgitationPressure" 202 "ActualTankAgitationPressure" 201 "SetpointTankAgitationPressure" 200 "MaximumPumpOutputPressure" 199 "MinimumPumpOutputPressure" 198 "ActualPumpOutputPressure" 197 "SetpointPumpOutputPressure" 196 "MaximumProductPressure" 195 "MinimumProductPressure" 194 "ActualProductPressure" 193 "SetpointProductPressure" 192 "Ambienttemperature" 191 "LintTurnoutPercentage" 190 "YieldTotalLintCottonMass" 189 "YieldTotalSeedCottonMass" 188 "LintCottonMassPerTimeYield" 187 "SeedCottonMassPerTimeYield" 186 "LintCottonMassPerAreaYield" 185 "SeedCottonMassPerAreaYield" 184 "ReferenceMoistureForDryMass" 183 "YieldTotalDryMass" 182 "DryMassPerTimeYield" 181 "DryMassPerAreaYield" 180 "DeviceReferencePointDRPtoGrounddistance" 179 "ActualCulturalPractice" 178 "ElementTypeInstance" 177 "Actuallengthofcut" 176 "ActualCondensedWorkState241to256" 175 "ActualCondensedWorkState225to240" 174 "ActualCondensedWorkState209to224" 173 "ActualCondensedWorkState193to208" 172 "ActualCondensedWorkState177to192" 171 "ActualCondensedWorkState161to176" 170 "ActualCondensedWorkState145to160" 169 "ActualCondensedWorkState129to144" 168 "ActualCondensedWorkState113to128" 167 "ActualCondensedWorkState97to112" 166 "ActualCondensedWorkState81to96" 165 "ActualCondensedWorkState65to80" 164 "ActualCondensedWorkState49to64" 163 "ActualCondensedWorkState33to48" 162 "ActualCondensedWorkState17to32" 161 "ActualCondensedWorkState1to16" 160 "SectionControlState" 159 "NumberofSubtoUnitsperSection" 158 "PrescriptionControlState" 157 "ConnectorType" 156 "PhysicalObjectHeight" 155 "PhysicalObjectWidth" 154 "PhysicalObjectLength" 153 "ActualNormalizedDifferenceVegetativeIndexNDVI" 151 "InstantaneousAreaPerTimeCapacity" 150 "InstantaneousFuelConsumptionperArea" 149 "InstantaneousFuelConsumptionperTime" 148 "TotalFuelConsumption" 147 "LogCount" 146 "PitchAngle" 145 "RollAngle" 144 "YawAngle" 143 "PhysicalActualValueTimeLatency" 142 "PhysicalSetpointTimeLatency" 141 "ActualWorkState" 140 "SetpointPercentageApplicationRate" 139 "DeviceCountCapacity" 138 "DeviceMassCapacity" 137 "DeviceVolumeCapacity" 136 "DeviceElementOffsetZ" 135 "DeviceElementOffsetY" 134 "DeviceElementOffsetX" 133 "AuxiliaryValveInvertPorts" 132 "AuxiliaryValveProgressivityRetract" 131 "AuxiliaryValveProgressivityExtend" 130 "AuxiliaryValveFloatThreshold" 129 "AuxiliaryValveRampRetractDown" 128 "AuxiliaryValveRampRetractUp" 127 "AuxiliaryValveRampExtendDown" 126 "AuxiliaryValveRampExtendUp" 125 "AuxiliaryValveScalingRetract" 124 "AuxiliaryValveScalingExtend" 123 "ProductDensityVolumePerCount" 122 "ProductDensityMassPerCount" 121 "ProductDensityMassPerVolume" 120 "IneffectiveTotalTime" 119 "EffectiveTotalTime" 118 "IneffectiveTotalDistance" 117 "EffectiveTotalDistance" 116 "TotalArea" 115 "MaximumBaleSize" 114 "MinimumBaleSize" 113 "DefaultBaleSize" 112 "ActualBaleSize" 111 "SetpointBaleSize" 110 "MaximumBaleHeight" 109 "MinimumBaleHeight" 108 "DefaultBaleHeight" 107 "ActualBaleHeight" 106 "SetpointBaleHeight" 105 "MaximumBaleWidth" 104 "MinimumBaleWidth" 103 "DefaultBaleWidth" 102 "ActualBaleWidth" 101 "SetpointBaleWidth" 100 "CropContamination" 99 "CropMoisture" 98 "PercentageCropLoss" 97 "CountPerTimeCropLoss" 96 "MassPerTimeCropLoss" 95 "VolumePerTimeCropLoss" 94 "CountPerAreaCropLoss" 93 "MassPerAreaCropLoss" 92 "VolumePerAreaCropLoss" 91 "YieldTotalCount" 90 "YieldTotalMass" 89 "YieldTotalVolume" 88 "CountPerTimeYield" 87 "MassPerTimeYield" 86 "VolumePerTimeYield" 85 "CountPerAreaYield" 84 "MassPerAreaYield" 83 "VolumePerAreaYield" 82 "ApplicationTotalCount" 81 "ApplicationTotalMassin[kg]" 80 "ApplicationTotalVolumein[L]" 79 "MaximumCountContent" 78 "ActualCountContent" 77 "SetpointCountContent" 76 "MaximumMassContent" 75 "ActualMassContent" 74 "SetpointMassContent" 73 "MaximumVolumeContent" 72 "ActualVolumeContent" 71 "SetpointVolumeContent" 70 "MaximumWorkingWidth" 69 "MinimumWorkingWidth" 68 "DefaultWorkingWidth" 67 "ActualWorkingWidth" 66 "SetpointWorkingWidth" 65 "MaximumWorkingHeight" 64 "MinimumWorkingHeight" 63 "DefaultWorkingHeight" 62 "ActualWorkingHeight" 61 "SetpointWorkingHeight" 60 "MaximumSeedingDepth" 59 "MinimumSeedingDepth" 58 "DefaultSeedingDepth" 57 "ActualSeedingDepth" 56 "SetpointSeedingDepth" 55 "MaximumTillageDepth" 54 "MinimumTillageDepth" 53 "DefaultTillageDepth" 52 "ActualTillageDepth" 51 "SetpointTillageDepth" 50 "MaximumCountPerTimeApplicationRate" 49 "MinimumCountPerTimeApplicationRate" 48 "DefaultCountPerTimeApplicationRate" 47 "ActualCountPerTimeApplicationRate" 46 "SetpointCountPerTimeApplicationRate" 45 "MaximumMassPerTimeApplicationRate" 44 "MinimumMassPerTimeApplicationRate" 43 "DefaultMassPerTimeApplicationRate" 42 "ActualMassPerTimeApplicationRate" 41 "SetpointMassPerTimeApplicationRate" 40 "MaximumVolumePerTimeApplicationRate" 39 "MinimumVolumePerTimeApplicationRate" 38 "DefaultVolumePerTimeApplicationRate" 37 "ActualVolumePerTimeApplicationRate" 36 "SetpointVolumePerTimeApplicationRate" 35 "MaximumVolumePerMassApplicationRate" 34 "MinimumVolumePerMassApplicationRate" 33 "DefaultVolumePerMassApplicationRate" 32 "ActualVolumePerMassApplicationRate" 31 "SetpointVolumePerMassApplicationRate" 30 "MaximumMassPerMassApplicationRate" 29 "MinimumMassPerMassApplicationRate" 28 "DefaultMassPerMassApplicationRate" 27 "ActualMassPerMassApplicationRate" 26 "SetpointMassPerMassApplicationRate" 25 "MaximumVolumePerVolumeApplicationRate" 24 "MinimumVolumePerVolumeApplicationRate" 23 "DefaultVolumePerVolumeApplicationRate" 22 "ActualVolumePerVolumeApplicationRate" 21 "SetpointVolumePerVolumeApplicationRate" 20 "MaximumSpacingApplicationRate" 19 "MinimumSpacingApplicationRate" 18 "DefaultSpacingApplicationRate" 17 "ActualSpacingApplicationRate" 16 "SetpointSpacingApplicationRate" 15 "MaximumCountPerAreaApplicationRate" 14 "MinimumCountPerAreaApplicationRate" 13 "DefaultCountPerAreaApplicationRate" 12 "ActualCountPerAreaApplicationRate" 11 "SetpointCountPerAreaApplicationRate" 10 "MaximumMassPerAreaApplicationRate" 9 "MinimumMassPerAreaApplicationRate" 8 "DefaultMassPerAreaApplicationRate" 7 "ActualMassPerAreaApplicationRate" 6 "SetpointMassPerAreaApplicationRate" 5 "MaximumVolumePerAreaApplicationRate" 4 "MinimumVolumePerAreaApplicationRate" 3 "DefaultVolumePerAreaApplicationRate" 2 "ActualVolumePerAreaApplicationRate" 1 "SetpointVolumePerAreaApplicationRate" 0 "DataDictionaryVersion" ;
VAL_ 2362179319 ErrorCodeObjPoolActiveResp4 0 "NoError" 1 "DifferentDDOPWithSameLabelExists" ;
VAL_ 2362179319 ErrorCodeObjPoolActiveResp3 0 "NoError" 1 "GeneralError" ;
VAL_ 2362179319 ErrorCodeObjPoolActiveResp2 0 "NoError" 1 "TaskControllerRanOutOfMemory" ;
VAL_ 2362179319 Status 0 "EnoughMemoryAvailable" 1 "NotEnoughMemoryAvailable" ;
VAL_ 2362179319 ErrorCodeObjPoolTransfer 0 "NoError" 1 "TaskControllerRanOutOfMemory" 2 "GeneralError" ;
VAL_ 2362179319 ActivateDeactivateCommand 0 "ObjectPoolDeactivation" 255 "ObjectPoolActivation" ;
VAL_ 2362179319 ErrorCodeObjectPoolDelete 0 "Success" 1 "Error" ;
VAL_ 2362179319 ErrorCodeObjPoolActiveResp1 0 "NoError" 1 "ErrorsInTheObjectPool" ;
VAL_ 2362179319 TechnicalDataMsgType 0 "ParameterRequestVersion" 1 "ParameterVersion" ;
VAL_ 2362179319 DeviceDescriptionMsgType 0 "RequestStructureLabel" 1 "StructureLabel" 2 "RequestLocalizationLabel" 3 "LocalizationLabel" 4 "RequestObjectPoolTransfer" 5 "RequestObjectPoolTransferResp" 6 "ObjectPoolTransfer" 7 "ObjectPoolTransferResponse" 8 "ObjectPoolActivate" 9 "ObjectPoolActivateResponse" 10 "ObjectPoolDelete" 11 "ObjectPoolDeleteResponse" 12 "ChangeDesignator" 13 "ChangeDesignatorResponse" ;
VAL_ 2362179319 Command 15 "ClientTask" 14 "TaskControllerStatus" 13 "PDACK" 8 "ChangeThreshold" 7 "MaxWithinThreshold" 6 "MinWithinThreshold" 5 "DistanceInterval" 4 "TimeInterval" 3 "ValueCommand" 2 "RequestValue" 1 "DeviceDescription" 0 "TechnicalData" 9 "PeerControlAssignment" 10 "SetValueAndAcknowledge" ;
VAL_ 2565799671 IndustryGroup 7 "Reserved for SAE" 5 "IndustrialProcessCtrlStationary" 4 "Marine" 3 "Construction" 2 "AgriculturalAndForestry" 1 "On-Highway" 0 "Global" ;
VAL_ 2565799671 VehicleSystem 127 "Not Available" 0 "NonSpecificSystem" ;
VAL_ 2565799671 VehicleSystem5 0 "Ind. Process Control Stationary" 127 "Not Available" ;
VAL_ 2565799671 VehicleSystem4 0 "NonSpecificSystem" 127 "Not Available" 10 "System Tools" 20 "Safety Systems" 25 "Inter/Intranetwork Device" 30 "Electrical Distribution" 40 "Steering and Control Surfaces" 50 "Propulsion" 60 "Navigation" 70 "Communications" 80 "Instrumentation/General Systems (deprecate)" 90 "Internal Environment" 100 "Deck, Cargo and Fishing Equipment" 35 "Electrical Generation" 75 "Sensor Communication Interface" 85 "External Environment" 120 "Display" 125 "Entertainment" ;
VAL_ 2565799671 VehicleSystem3 0 "NonSpecificSystem" 127 "Not Available" 1 "Skid Steer Loader" 2 "Articulated Dump Truck" 3 "Backhoe" 4 "Crawler" 5 "Excavator" 6 "Forklift" 7 "Four Wheel Drive Loader" 8 "Grader" ;
VAL_ 2565799671 VehicleSystem2 0 "NonSpecificSystem" 127 "Not Available" 1 "Tractor" 2 "Tillage" 3 "Secondary Tillage" 4 "Planters/Seeders" 5 "Fertilizers" 6 "Sprayers" 7 "Harvesters" 8 "Root Harvesters" 9 "Forage" 10 "Irrigation" 11 "Transport/Trailer" 12 "Farm Yard Operations" 13 "Powered Auxiliary Device" 14 "Special Crops" 15 "Earth Work" 16 "Skidder" 17 "Sensor Systems" 19 "Timber Harvesters" 20 "Forwarders" 21 "Timber loaders" 22 "Timber Processing Machines" 23 "Mulchers" 24 "Utility Vehicles" 25 "Slurry Applicators" ;
VAL_ 2565799671 VehicleSystem1 0 "NonSpecificSystem" 127 "Not Available" 1 "Tractor" 2 "Trailer" ;
VAL_ 2565799671 Function 142 "TIMServer" 43 "Transmission Display" 44 "Exhaust Emission Control" 45 "Vehicle Dynamic Stability Control" 46 "Oil Sensor Unit" 47 "Information System Controller" 48 "Ramp Control" 49 "Clutch/Converter Control" 50 "Auxiliary Heater" 51 "Forward-Looking Collision Warning System" 52 "Chassis Controller" 53 "Alternator/Charging System" 54 "Communications Unit, Cellular" 55 "Communications Unit, Satellite" 56 "Communications Unit, Radio" 57 "Steering Column Unit" 58 "Fan Drive Control" 59 "Starter" 60 "Cab Display" 61 "File Server/Printer" 62 "On-Board Diagnostic Unit" 63 "Engine Valve Controller" 64 "Endurance Braking" 65 "Gas Flow Measurement" 66 "I/O Controller" 67 "Electrical System Controller" 68 "Aftertreatment system gas measurement" 69 "Engine Emission Aftertreatement System" 70 "Auxiliary Regeneration Device" 71 "Transfer Case Control" 72 "Coolant Valve Controller" 73 "Rollover Detection Control" 74 "Lubrication System" 75 "Supplemental Fan" 76 "Temperature Sensor" 77 "Fuel Properties Sensor" 78 "Fire Suppression System" 79 "Power Systems Manager" 80 "Electric Powertrain" 81 "Hydraulic Powertrain" 82 "File Server" 83 "Printer" 84 "Start Aid Device" 85 "Engine Injection Control Module" 86 "Reserved" 87 "Reserved" 88 "Reserved" 89 "Reserved" 90 "Reserved" 91 "Reserved" 92 "Reserved" 93 "Reserved" 94 "Reserved" 95 "Reserved" 96 "Reserved" 97 "Reserved" 98 "Reserved" 99 "Reserved" 100 "Reserved" 0 "Engine" 1 "Auxiliary Power Unit (APU)" 2 "Electric Propulsion Control" 3 "Transmission" 4 "Battery Pack Monitor" 5 "Shift Control/Console" 6 "Power TakeOff - (Main or Rear)" 7 "Axle - Steering" 8 "Axle - Drive" 9 "Brakes - System Controller" 10 "Brakes - Steer Axle" 11 "Brakes - Drive Axle" 12 "Retarder - Engine" 13 "Retarder - Driveline" 14 "Cruise Control" 15 "Fuel System" 16 "Steering Controller" 17 "Suspension - Steer Axle" 18 "Suspension - Drive Axle" 19 "Instrument Cluster" 20 "Trip Recorder" 21 "Cab Climate Control" 22 "Aerodynamic Control" 23 "Vehicle Navigation" 24 "Vehicle Security" 25 "Network Interconnect ECU" 26 "Body Controller" 27 "Power TakeOff (Secondary or Front)" 28 "Off Vehicle Gateway" 29 "Virtual Terminal (in cab)" 30 "Management Computer" 31 "Propulsion Battery Charger" 32 "Headway Controller" 33 "System Monitor" 34 "Hydraulic Pump Controller" 35 "Suspension - System Controller" 36 "Pneumatic - System Controller" 37 "Cab Controller" 38 "Tire Pressure Control" 39 "Ignition Control Module" 40 "Seat Control" 41 "Lighting - Operator Controls" 42 "Water Pump Control" 101 "Reserved" 102 "Reserved" 103 "Reserved" 104 "Reserved" 105 "Reserved" 106 "Reserved" 107 "Reserved" 108 "Reserved" 109 "Reserved" 110 "Reserved" 111 "Reserved" 112 "Reserved" 113 "Reserved" 114 "Reserved" 115 "Reserved" 116 "Reserved" 117 "Reserved" 118 "Reserved" 119 "Reserved" 120 "Reserved" 121 "Reserved" 122 "Reserved" 123 "Reserved" 124 "Reserved" 125 "Reserved" 126 "Reserved" 127 "Reserved" 255 "Not Available" ;
VAL_ 2565799671 ManufacturerCode 1077 "Ymer Technology" 1076 "DOGA S.A." 1075 "Uniden America Corporation" 1074 "Kindhelm / Navigs Oy" 1073 "Manitou Equipment America LLC" 1072 "La Marche Manufacturing Company" 1071 "MACH SYSTEMS s.r.o." 1070 "Quick-teck Electronics Ltd" 1069 "Lithionics Battery LLC" 1068 "Zapi S.p.A." 1067 "Tecomec S.r.l." 1066 "Spot Zero Water" 1065 "CALYPSO Instruments" 1064 "Omnitech Robotics Inc." 1063 "SolSteer" 1062 "Marol Co Ltd" 1061 "Volvo Construction Equipment" 1060 "Scale-Tec" 1059 "Boatrax" 1058 "Bondioli & Pavesi SpA" 1057 "EquipmentShare" 1056 "Lithium Pros" 1055 "EXA Computing GmbH" 1054 "Schmotzer Hacktechnik GmbH & Co. KG" 1053 "Vetus Maxwell, Inc." 1052 "Pfreundt" 1051 "ProNav AS" 1050 "Spacenus GmbH" 1049 "S&S Cycle" 1048 "Agrivation UG" 1047 "Sonic Corporation" 1046 "Praxidyn" 1045 "CMR Group" 1044 "Xee" 1043 "Hyva" 1042 "engcon group" 1041 "EZ Lynk" 1040 "BPE Electronics Srl" 1039 "Liugong Dressta Machinery" 1038 "EMIT Technologies, Inc." 1037 "Dragonfly Energy Corp." 1036 "Bender GmbH & Co. KG" 1035 "Agres" 1034 "Siren Marine" 1033 "ECCO Safety Group" 1032 "SIMOL S.p.A." 1031 "Flintec UK Ltd." 1030 "Tume-Agri Oy" 1029 "The Marine Guardian LLC" 1028 "Autel Intelligent Technology Corp., Ltd" 1027 "Goldacres PTY LTD" 1026 "ZTR Control Systems, LLC" 1025 "eze System, Inc." 1024 "Inventus Power" 1023 "PEAK-System Technik GmbH" 1022 "ITC Inc" 1021 "Entratech Systems LLC" 1020 "Onyx Marine Automation s.r.l." 1019 "Codek Foundries" 1018 "Flex TTS" 1017 "Caldaro AB" 1016 "Röhren- und Pumpenwerk BAUER GmbH" 1015 "SECURITAG SAS" 1014 "Briri Maschinenbau GmbH" 1013 "Allochis E-Tec" 1012 "Rhodan Marine Systems of Florida LLC" 1011 "Soundmax Electronics Ltd" 1010 "Agricultural Industry Electronics Foundation e.V." 1009 "TouchTronics, Inc." 1008 "Lintest Systems LLC" 1007 "Maschinenfabrik Meyer-Lohne GmbH" 1006 "Proterra" 1005 "TSE Brakes, Inc." 1004 "Ultraflex SpA" 1003 "technotrans SE" 1002 "Kussmaul Electronics Co." 1001 "Cleral Inc." 1000 "Landmaschinen Wienhoff GmbH" 1569 "621 Technologies Inc." 999 "TerraTroniq B.V." 998 "Transcell Technology Inc" 997 "Xenta Systems Srl" 996 "Eniquest Pty Ltd" 995 "Circuitlink Pty Ltd." 994 "Morris Industries Ltd." 993 "Alelion Energy Systems AB" 992 "MarineIOT LLC" 991 "Deutronic Elektronik GmbH" 990 "SAMSUNG SDI Co., Ltd." 989 "Flux-Geräte GmbH" 988 "Voith Turbo" 987 "Baltic Car Equipment" 986 "AAMP Global" 985 "NLR, LLC" 984 "E-T-A Elektrotechnische Apparate GmbH" 983 "Dezwaef NV" 982 "Briggs & Stratton Corporation" 981 "Kobelt Manufacturing Co. Ltd" 980 "Gussi Italia S.R.L." 979 "McHale" 978 "Canfield Connector" 977 "Emerson Electric Co." 976 "Derive Systems, Inc." 975 "Siemens AG" 974 "Pico Technology Limited" 973 "Zasso GmbH" 972 "Axion AG" 971 "B+B Smartworx" 970 "Jaboni Power Products, LLC" 969 "Blue Sea Systems" 968 "Cox Powertrain Limited" 967 "Moteck Electric Corp." 966 "VisibleFarm" 965 "Ro-Sys Software" 964 "AgroVIR Kft" 963 "Thomason Jones Company, LLC" 962 "Timbolier Industries, Inc." 961 "POK SAS" 960 "Vemcon GmbH" 959 "Cascade Corporation" 958 "NHK MEC Corporation" 957 "Sierra Wireless Inc" 956 "Piher Sensors & Controls S.A." 955 "Hottinger Baldwin (Suzhou) Electronic Measurement Technology Co., Ltd." 954 "Setec Pty Ltd" 953 "Curtiss-Wright" 952 "Tan Delta Systems Ltd" 951 "Exor International S.p.A." 950 "RE:Lab s.r.l." 949 "Škoda Electric a.s." 948 "Donix" 947 "Gerd Bär GmbH" 946 "Hydac Tecnologia Ltda" 945 "Equalizer AG" 944 "ZONTISA Marine SL" 943 "FISCHER AG Präzisionspindeln" 942 "Vogelsang GmbH & Co. KG" 941 "Navya" 940 "Dometal Oy" 939 "Warn Industries, Inc." 938 "LEVEL Systems" 937 "Precision Circuits Inc" 936 "Hi-tech Millennium" 935 "Meels GmbH & Co. KG" 934 "Farmobile, Inc." 933 "Delta Mobile Systems, Inc." 932 "Discover Battery" 931 "Enertec Marine Ltd" 930 "Ecotronix Corp." 929 "Jl Marine Systems, Inc." 928 "EAO Automotive GmbH & Co. KG" 927 "Saicon" 926 "Buhler Industries Inc." 925 "GW Lisk Company" 924 "PAS Peschak Autonome Systeme GmbH" 923 "ELTEK S.p.A." 922 "Terberg Benschop B.V." 921 "ROPA Fahrzeug- und Maschinenbau GmbH" 920 "MTD Consumer Group Inc." 919 "Furrion LLC" 918 "AMW Machine Control, Inc" 917 "Sentinel d.o.o." 916 "Turck Inc." 915 "Dosificacion y sistemas electronicos S.L. (DSE)" 914 "ZETOR TRACTORS a.s." 913 "Toyota Motor Corporation" 912 "Steyr Motors GmbH" 911 "Nautic-On" 910 "Hermann Paus Maschinenfabrik GmbH" 909 "Marines Co., Ltd." 908 "Chonbuk National University Department of Electronics" 907 "strautmann" 906 "MOBA AG" 905 "ASA Electronics" 904 "Equipment Safety Systems Pty. Ltd. (EQSS)" 903 "InMotion" 902 "Bucher Hydraulics" 901 "Zivan Srl" 900 "OSB AG" 899 "Lippert Components, Inc" 898 "Josef Kotte Landtechnik GmbH & Co. KG" 897 "Dot Technology Corp." 896 "NextFour Solutions Ltd" 895 "Peloton Technology" 894 "Rhodan Marine Systems of Florida LLC" 893 "KlinkTechnics Ltd." 892 "Mectronx Corp" 891 "CarrierWeb" 890 "L3 Technologies, Inc." 889 "SANY America Inc" 888 "Carma Systems Inc" 887 "Hyperdrive Innovation Limited" 886 "Hitachi Zosen Corporation" 885 "SICK Stegmann GmbH" 884 "Sure Grip Controls Inc." 883 "Swift Navigation, Inc." 882 "BHTronik GmbH & Co. KG" 881 "Sovema" 880 "Revision Military" 879 "PG Trionic, Inc." 878 "FOTON" 877 "SICK ATech GmbH" 876 "SUCO Robert Scheuffele GmbH & Co. KG" 875 "Salvarani S.r.l." 874 "MTA S.p.A." 873 "Garnet Instruments Ltd." 872 "Kählig Antriebstechnik GmbH" 871 "Superior Tech Inc" 870 "Textron Fleet Management" 869 "Intercomp" 868 "Data Panel Corp" 867 "Skeleton Technologies" 866 "Netradyne, Inc." 865 "MyEasyFarm" 864 "Streamline Transportation Technologies Inc." 863 "SMAG" 862 "Prospec Electronics" 861 "Adel System S.r.l." 860 "Michelin" 859 "Valor" 858 "Littelfuse" 857 "Zoomlion Heavy Industry NA, Inc" 856 "FarmFacts GmbH" 855 "Toshiba Infrastructure Systems & Solutions Corporation" 854 "GEMAC Chemnitz GmbH" 853 "Teledyne RESON B.V." 852 "Velvac Inc" 851 "Novotechnik Messwertaufnehmer OHG" 850 "Geoprospectors GmbH" 849 "MTS Maschinentechnik Schrode AG" 848 "ningupex" 847 "Oceanvolt" 846 "L3 Magnet-Motor" 845 "GMB Güstrower Maschinenbau GmbH" 844 "FELL AS" 843 "Hendrickson Truck Commercial Vehicle Systems" 842 "DigiDevice Srl" 841 "Agra-GPS" 840 "E.S.T.E. Srl" 839 "Indexator Rotator Systems AB" 838 "Teamsurv Ltd" 837 "Famic Technologies Inc." 836 "Signature4" 835 "PetTrack Ltd." 834 "Pioneer Microsystems, Inc." 833 "Electrum Automation AB" 832 "Heizomat Gerätebau-Energiesysteme GmbH" 831 "DOK-ING Ltd." 830 "Ultra Motion LLC" 829 "Drov Technologies, Inc." 828 "AgriBrink Inc." 827 "INmatix Technology Group Ltd" 826 "Lewmar Marine Inc" 825 "BPW Hungária" 824 "Undheim Systems AS" 823 "ACEINNA, Inc (formerly MEMSIC, Inc)" 822 "Bren-Tronics, Inc." 821 "Thorsen Teknik A/S" 820 "DIaLOGIKa Gesellschaft fuer angewandte Informatik mbH" 819 "Preco Electronics" 818 "HGNSS" 817 "TE Connectivity Sensor Solutions" 816 "UniStrong" 815 "FLIR Systems, Inc." 814 "Kronotech Srl (formerly Soltec Soluzioni Tecnologiche Srl)" 813 "Thales Suisse SA" 812 "Torch Technologies" 811 "Blue Water Desalination" 810 "Dutch Power Company" 809 "HMS Industrial Networks AB" 808 "RIMEX Supply Ltd." 807 "Schneider-Electric" 806 "Charge Automotive Ltd" 805 "Gundersen & Løken AS" 804 "ASA Electronics" 803 "Gill Sensors & Controls Limited" 802 "SPBI (Bj Technologie)" 801 "LOR Manufacturing Company Inc." 800 "Delta-Q Technologies" 799 "Stillwater Designs and Audio, Inc. - KICKER" 798 "Lumishore Ltd" 797 "Tides Marine" 796 "Canadian Automotive Industries Ltd" 795 "Broyda Enterprises Pty Ltd" 794 "Shihlin Electric & Engineering Corporation" 793 "James Fisher Prolec" 792 "Kostal Mexicana" 791 "AUTEC" 790 "VACALL" 789 "GRADALL" 788 "MoTeC Pty Ltd" 787 "Abertax Technologies Limited" 1863 "Thomas G. Faria Co." 1862 "Sanshin" 1861 "Vector North America" 1860 "MMP" 1859 "Kvasar AB" 1858 "Litton" 1857 "Simrad" 1856 "Trimble" 1855 "Furuno USA" 1854 "Northstar Technologies" 1853 "Japan Radio Co" 1852 "Navionics" 1851 "RayMarine" 1850 "Seastar Solutions (formerly Teleflex)" 786 "Johnson Matthey Battery Systems" 785 "Fischer Panda GmbH" 784 "CM Automotive Systems, Inc." 783 "Loup Electronics Inc." 782 "AVR bv (formerly AVR bvba)" 781 "Poly-Planar LLC" 780 "AVID Technology Ltd" 779 "RLC Electronic Systems" 778 "Seakeeper Inc." 777 "Ocean Signal Ltd" 776 "HMI Systems LLC" 775 "ZIEHL-ABEGG Automotive GmbH" 774 "Taisho Corporation" 773 "Clarion Corporation of America" 772 "Blink Marine" 771 "Shaw Development, LLC" 770 "MONOSEM" 769 "Trombetta" 768 "Flores Automation, LLC" 767 "Alliance Wireless Technologies Inc." 766 "Epec Oy" 765 "GIGAVAC" 764 "Bednar FMT s.r.o." 763 "AT-Systems BVBA" 762 "ROJ s.r.l." 761 "MITA OLEODINAMICA S.p.A." 760 "Bernecker + Rainer Industrie Elektronik GmbH" 759 "Hydro-Gear" 758 "Banner Engineering Corp." 757 "IMPCO Technologies" 756 "Maschio Gaspardo S.P.A." 755 "Firefly Integrations" 754 "Parker Hannifin Corp., Automation Group" 753 "AIROD Technologies" 752 "Deep Sea Electronics Plc" 751 "Pacific Track" 750 "Joskin SA" 749 "Chart Inc." 748 "ISOTTA" 747 "Agratronix" 746 "SureFire Ag Systems, Inc." 745 "Cidra Corporate Services Inc." 744 "Woosung Engineering Co., Ltd." 743 "Daemyung Elevator Co., Ltd." 742 "EROAD" 741 "Carling Technologies" 740 "e-Traction" 739 "LXNAV d.o.o." 738 "Blue Ink Technologies" 737 "Balluff GmbH" 736 "Terex Aerial Work Platforms - Genie" 735 "AEM Performance Electronics" 734 "REAPsystems" 733 "Intendia S.L." 732 "Gefran S.p.A." 731 "Modine Manufacturing Company" 730 "BERTHOUD AGRICOLE" 729 "Liebherr" 728 "Streumaster (formerly Streumaster / Panien)" 727 "Dhoot Transmission Pvt Ltd." 726 "MIDORI PRECISIONS" 725 "Hitachi Construction Machinery Co., Ltd." 724 "Electronic Applications, Inc." 723 "Jabil Inc." 722 "Contelec AG" 721 "Hypro" 720 "WITZ Corporation" 719 "Cojali S. L." 718 "Micronet Inc" 717 "Yacht Devices Ltd" 716 "Eaton Control & Power Conversion Division (CPCD)" 715 "Autonnic Research Ltd" 714 "Kobashi Kogyo Co., Ltd." 713 "US Hybrid Corporation" 712 "LOR Manufacturing Company Inc." 711 "DAS Co., LTD" 710 "Greentronics Ltd." 709 "Marquardt GmbH" 708 "Lars Thrane A/S" 707 "Rochester Gauges Inc" 706 "Shanghai Diesel Engine Corporation Limited" 705 "SVAB Hydraulik AB" 704 "JL Audio, Inc." 703 "Hydro Tab Marine Engineering" 702 "Weichai Power Co., Ltd." 701 "BigRoad Inc." 700 "K-Tec Earthmovers Inc." 699 "Harman International Industries" 698 "Scorpion Technologies Ltd." 697 "Ålö AB" 696 "DRS Network & Imaging Systems, LLC (DRS Technologies)" 695 "Weldon Technologies" 694 "GasTOPS Ltd." 693 "Agility Fuel Solutions (formerly Agility Fuel Systems)" 692 "Tanhay Corporation" 691 "Digitroll Agricultural Electronics" 690 "LINAK A/S" 689 "Aarcomm Systems Inc" 688 "Rockford Corp" 687 "Flight Systems, Inc." 686 "Taigene Electric Machinery Corp." 685 "ANEDO (formerly ANEDO Ltd.)" 684 "KEB" 683 "Fosen Elektro" 682 "Eckelmann AG" 681 "BEDIA Motorentechnik GmbH & Co. KG" 680 "AMVAC Chemical Corporation" 679 "Cimco Marine AB" 678 "KeepTruckin, Inc." 677 "DSA Daten- und Systemtechnik GmbH" 676 "Danfoss IXA A/S" 675 "Kawasaki Motors Corp., USA" 674 "Yara International ASA" 673 "Caruelle Nicolas" 672 "OPTIMA Concept" 671 "Innovative Controls Inc." 670 "STEMCO LP" 669 "Quantum Fuel Systems Technologies Worldwide, Inc" 668 "MacDon Industries Ltd." 667 "Bartec" 666 "Schaeffler Technologies AG & Co., KG" 665 "Gebr. Bode GmbH & Co. KG" 664 "Level Developments Ltd" 663 "Delta Systems, Inc" 662 "Kissling Elektrotechnik GmbH" 661 "SPAL Automotive S.r.l." 660 "Auto-Gaz Centrum" 659 "Data Panel Corp." 658 "Shenzhen Jiuzhou Himunication Technology Co., Ltd" 657 "Terzo Power Systems" 656 "PRO SOLUS do Brasil" 655 "Genge & Thoma AG" 654 "Kohler Power Systems, Detroit Engine Development Center (DEDC)" 653 "AEV, spol. s r. o." 652 "MicroControl GmbH & Co. KG" 651 "Takakita Co, Ltd." 650 "Seiko Epson Corp." 649 "Control-Q B.V." 648 "OJSC Ekran" 647 "Siloking" 646 "Veenhuis Machines B.V." 645 "esd electronic system design gmbh" 644 "KUS USA" 643 "Bogballe A/S" 642 "Moog / Aspen Motion Technologies" 641 "Diverse Yacht Services" 640 "Power Solutions International" 639 "Startec s.r.l." 638 "KVH Industries, Inc." 637 "Bavaria Yachtbau GmbH" 636 "Divelbiss Corporation" 635 "Argo Tractors S.p.A." 634 "Rocky Research" 633 "TORC Robotics" 632 "Pepperl+Fuchs GmbH" 631 "Reltima" 630 "SmartDrive Systems Inc." 629 "Agri Info Design, Ltd." 524 "Vomax Instrumentation Pty. Ltd." 523 "Reggio Emilia Innovazione" 522 "Nebraska Tractor Test Laboratory" 521 "Clever Devices Ltd." 520 "Trapeze" 519 "Peeters Landbouwmachines b.v." 518 "Transas USA Inc." 517 "Noland Engineering" 516 "AVAT Automation GmbH" 515 "GINAF Trucks Nederland B.V." 514 "DISTek Integration, Inc." 513 "Precision Technology (Formerly FarmscanAg)" 512 "Inpower LLC" 511 "Sulky" 510 "Marinesoft Co. Ltd" 509 "MOTORTECH GmbH" 508 "Transtech Innovations" 507 "ISOBUS Test Center" 506 "IHI STAR Machinery Corporation" 505 "Yetter Farm Equipment" 504 "Vesper Marine" 503 "Naviop S.R.L." 502 "Attwood Corporation" 501 "Agrotronix S.A." 500 "Oxbo International Corporation" 499 "LCJ Capteurs" 498 "Innovative Design Solutions, Inc." 497 "SENTRON Sistemas Embarcados" 496 "W. Gessmann GmbH" 495 "HOLMER Maschinenbau GmbH" 494 "Synerject" 493 "Watcheye" 492 "Inergy Automotive Systems" 491 "Penny and Giles Ltd" 490 "QuikQ" 489 "Appareo Systems, LLC" 488 "The Charles Machine Works, Inc." 487 "DSE Test Solutions A/S" 486 "Westport Innovations Inc." 485 "MATT automotive" 484 "Headsight Inc." 483 "Valeo" 482 "Tricon Electronics" 481 "Chetco Digital Instruments" 480 "EnerDel, Inc." 479 "Vapor Bus International" 478 "OceanSat B.V." 477 "OilQuick AB" 476 "Hummingbird Marine Electronics" 475 "GME" 474 "Persen Technologies Inc." 473 "Boss Industries, Inc." 472 "Tenneco Inc." 471 "Sea Cross Marine AB" 628 "Falck Schmidt Defence Systems" 627 "Radio Ocean" 626 "AVL DiTEST GmbH" 625 "Global MRV Inc." 624 "Blackbox Machine Control Pty Ltd" 623 "Xirgo Technologies" 622 "Floyd Bell Inc" 621 "Hagie Manufacturing Company" 620 "Sevcon Ltd." 619 "Right Weigh Load Scales" 618 "Evrard SA" 617 "Zero Emission Vehicles" 616 "SMART-TEC s.r.o." 615 "Networkfleet, Verizon Telematics" 614 "ARLT Technologies GmbH" 613 "HKS Co., Ltd." 612 "Samwon IT" 611 "Esterline" 610 "Trail Tech" 609 "Walvoil S.p.A." 608 "Gale Banks Engineering" 607 "Knappco/Civacon" 606 "Intellian Technologies" 605 "Aventics GmbH" 604 "Indexator Rototilt Systems AB" 603 "Kereval" 602 "Nomad Digital Ltd." 601 "Navitas Systems" 600 "Aquatic AV" 599 "Spudnik Equipment Co, LLC" 598 "ABB Turbo Systems Ltd" 597 "Hydac Filter Systems GmbH" 596 "Brunelco Electronic Innovators B.V." 595 "CustomWare" 594 "Kongsberg Automotive" 593 "Sensata Technologies" 592 "tecsis GmbH" 591 "United States Coast Guard" 590 "ARGO-HYTOS GMBH" 589 "MICO, Inc." 588 "Vignal Systems" 587 "JCA Electronics" 586 "Suzuki Motor Corp" 585 "Industrial Electronic Controls" 584 "CarMedialab GmbH" 583 "Yachtcontrol" 582 "Innovative Software Engineering" 581 "Väderstad - Verken AB" 580 "San Jose Technology, Inc." 579 "KVH Industries, Inc." 578 "advanSea" 577 "Denchi Power Ltd  (formerly ABSL Power Solutions Limited)" 576 "Vectia" 575 "Lytx" 574 "Vishay Precision Group" 573 "Orolia Ltd" 572 "Fasse Valves" 571 "Marinecraft Co., Ltd." 570 "frenzel + berg electronic GmbH & Co. KG" 569 "LORD MicroStrain Sensing Systems" 568 "Makersan Ltd. Co." 567 "Lithiumstart LLC" 566 "Geode Technology, Inc." 565 "Micro-Trak Systems, Inc." 564 "Auto Power Electronic" 563 "LOHR Sistemas Eletronicos LTDA" 562 "Bombardier Transportation GmbH" 561 "b-plus GmbH" 560 "Iowa State University, Agricultural and Biosystems Engineering" 559 "Four Peaks Navigation" 558 "Davis Instruments Corp." 557 "Rockson Automation GmbH" 556 "Doosan Infracore Norway" 555 "Sasaki Corporation" 554 "iris-GmbH infrared & intelligent sensors" 553 "KIB Electronics" 552 "Matsuyama Plow Mfg Co, Ltd" 551 "Wexler CSD Ltd." 550 "SUN-A Corporation" 549 "ROAD Deutschland GmbH" 548 "TM4 Inc." 547 "Thomson Linear LLC" 546 "Maruyama Mfg Co, Inc." 545 "GS Hydraulics" 544 "Au Group Electronics" 543 "BAUER Maschinen GmbH" 542 "Dinamica Generale s.p.a." 541 "Total Fire Systems, Inc." 540 "Dinex A/S" 539 "Mobileview" 538 "Crop Ventures, Inc." 537 "Schrader Electronics Ltd." 536 "SSI Technologies" 535 "MOTORPAL, a.s." 534 "Webasto Thermo & Comfort SE" 533 "Doran Manufacturing, LLC" 532 "Onwa Marine Electronics Co Ltd." 531 "Genge & Thoma AG" 530 "NMEA" 529 "National Instruments Korea" 528 "Hoganas AB, Electric Drive Systems" 527 "GKN Walterscheid GmbH" 526 "LOFA Industries, Inc" 525 "Rust Sales INC" 470 "SI-TEX Marine Electronics" 469 "RA Consulting GmbH" 468 "Tyco Fire Protection Products" 467 "Lely Industries N.V." 466 "Veethree Electronics and Marine LLC" 465 "Ashcroft Inc" 464 "Leach International Corporation" 463 "PROBOTIQ" 462 "IHI Shibaura Machinery Corporation" 461 "HAWE Hydraulik SE" 460 "San Giorgio S.E.I.N." 459 "Alltek Marine Electronics Corp" 458 "Control Solutions, Inc." 457 "RUSELPROM-ElectricDrive Ltd" 456 "General Kinetics" 455 "ADZ NAGANO GmbH" 454 "NGK Spark Plug Co. Ltd" 453 "Cooper Bussmann" 452 "WIKA Alexander Wiegand SE & Co. KG" 451 "Parker Hannifin Corp" 450 "Dycor Technologies Ltd." 449 "Polaris Industries Inc" 448 "Stanadyne Corporation, Electronics Systems" 447 "Great Plains Mfg." 446 "CertTech, L.L.C." 445 "KAT MECHATRONIC, Electronic Product Division" 444 "ITT Power Solutions" 443 "SignalQuest, Inc." 442 "Horsch Maschinen GmbH" 441 "PTG Reifendruckregelsysteme GmbH" 440 "Cummins Power Generation" 439 "Hyundai Heavy Industries" 438 "Comar Systems Ltd" 437 "Digital Yacht Limited" 436 "Kinze Manufacturing" 435 "Zunhammer GmbH" 434 "Stored Energy Systems" 433 "Rowe Electronics" 432 "S&A Systems, Inc." 431 "Tohatsu Corporation" 430 "Auteq Telematica S.A." 429 "Rota Engineering Ltd." 425 "Methode Electronics Inc, MDI" 424 "Odyne LLC" 423 "BSM Wireless, Inc." 422 "True Heading AB" 421 "Vertex Standard Co, Ltd" 420 "Vermeer Corporation, ACS Group" 419 "Fusion Electronics Ltd" 418 "Intellistick Inc" 417 "KZValve" 416 "Kubota Corporation" 415 "Valid Manufacturing Ltd." 414 "Cattron Group International" 413 "Datapross Nijbroek bv" 412 "WebTech Wireless Inc." 411 "Hy-Drive Technologies Ltd." 410 "COBO S.p.A. Divisione 3B6" 409 "Transfluid S.r.L." 408 "Corvus Energy Ltd." 407 "Comtech Mobile Datacom" 406 "Vecima Networks Inc." 405 "Wema System AS" 404 "Com Nav Marine Ltd" 403 "Trackwell ADS, Inc." 402 "Simma Software, Inc." 401 "Torqeedo GmbH" 400 "Livorsi Marine" 399 "ISEKI & Co., Ltd." 398 "Hilite International" 397 "Sanyo-kiki Co Ltd." 396 "Beyond Measure" 395 "GENTEC S.R.L." 394 "Capi 2 Nederland B.V." 393 "Harvest Tec, Inc" 392 "Tianyuan Technology Co Ltd." 391 "Electronic Design for Industry, Inc" 390 "Partech Inc." 389 "Benchmark Electronics, Minnesota Division" 388 "Innomatix, LLC" 387 "Orscheln Products, LLC" 386 "JLG Automation BVBA" 385 "Johnson Outdoor Marine Electronics" 384 "Camano Light" 383 "MCL Industries" 382 "National Agriculture and Food Research Organization" 381 "B & G" 380 "Suntech International Ltd." 379 "Yamabiko Corporation" 378 "Glendinning Marine Products" 377 "ifm electronic gmbh" 376 "Quake Global" 375 "Williams Controls Inc." 374 "Northern Lights, Inc." 373 "Electronic Design Inc." 372 "Delphi" 371 "Heinzmann GmbH & Co. KG" 370 "Rolls-Royce Marine AS" 369 "Power Torque Engineering Ltd" 368 "HANSENHOF_electronic" 367 "Fliegl Agrartechnik" 366 "Viewnyx Corp." 365 "Digi-Star, LLC" 364 "OEM Controls Inc." 363 "BEI Duncan" 362 "Poettinger Landtechnik GmbH (formerly Alois Poettinger Maschinenfabrik GmbH)" 361 "InMach" 360 "HJS Emission Technology GmbH & Co KG   (formerly HJS Fahrzeugtechnik GmbH & Co KG)" 359 "Ludwig Bergmann GmbH" 358 "Victron Energy B.V." 357 "Hardi International A/S" 356 "Fischer Panda Generators, Inc" 355 "Mastervolt International B.V." 354 "Junkkari OY" 353 "Hegemon Electronics, Inc." 352 "SAME DEUTZ-FAHR GROUP S.p.A." 351 "Thrane & Thrane" 350 "Noris Marine Systems GmbH & Co KG" 349 "Suonentieto" 348 "Amazonen Werke H. Dreyer" 347 "Honeywell" 346 "Control Solutions" 345 "Korean Maritime University" 344 "Parvus Corporation" 343 "Baumer Group" 342 "THOMAS MAGNETE GmbH" 341 "Boning GmbH & Co" 340 "Continental AG" 339 "Competence Center ISOBUS e.V." 338 "GRAF-SYTECO" 337 "Carraro S.p.A." 336 "APE s.r.o." 335 "Evo Electric Ltd" 334 "Takata-Petri AG" 333 "Hadley Products Corporation" 332 "HWH Corporation" 331 "Horton, Inc." 330 "Kidde Aerospace and Defense" 329 "Deif A/S" 328 "Qwerty Electronik AB" 327 "Sonceboz SA" 326 "Akron Brass Company" 325 "ASM Automation Sensorik Messtechnik GmbH" 324 "Snap-on Diagnostics" 323 "Mobileye Vision Technologies Ltd." 322 "MICHENKA s.r.o." 321 "Ultra Electronics, Electrics" 320 "Miedema Landbouwwerktuigenfabriek B.V." 319 "Cadec Global" 318 "SAT Plan" 317 "Navtronics Bvba" 263 "IMMI" 262 "HydraForce, Inc" 261 "Red Dot Corporation" 260 "Reichhardt GmbH Steuerungstechnik" 259 "Jetter AG" 258 "ARAG" 257 "Honda Motor Co., Ltd" 256 "Tyco Electronics AMP" 255 "MEAS France" 254 "GE Sensing" 253 "Mobile Control Systems" 252 "Sensor-Technik Wiedemann GmbH" 251 "German Agricultural Society, Test Center (DLG)" 250 "Kuhn Group" 249 "Schaltbau GmbH" 248 "Cooper Standard Automotive Active Systems Group" 247 "ePULSE" 246 "Class 1, Inc" 245 "Capstan Ag Systems, Inc." 244 "Techno-Matic" 243 "eRide, Inc." 242 "Kokusandenki Co. Ltd" 241 "Schneider Automation SAS" 240 "Vanair Mfg" 239 "May & Scofield Ltd" 238 "ZF Friedrichshafen AG" 237 "Agtron Enterprises Inc" 236 "NORAC Systems International Inc" 235 "SailorMade Marine Telemetry - Tetra Technology Ltd." 234 "Mondial electronic GmbH" 233 "Yacht Monitoring Solutions Inc." 232 "TSD Integrated Controls" 231 "Topcon Positioning Systems, Inc." 230 "Saucon Technologies" 229 "Garmin International Inc." 228 "Unused (formerly ZF Marine Electronics)" 227 "Lykketronic A/S" 226 "Monaco Coach Corporation" 225 "SKF" 224 "EMMI Network, S.L." 223 "Vaueo Retarder Co., Ltd." 222 "Generac Power Systems, Inc." 221 "SiE" 220 "Beede Electrical Instrument Company, Inc" 219 "Cat OEM Solutions" 218 "Gits Manufacturing Company" 217 "RM Michaelides Software & Elektronik GmbH" 216 "Paneltronics Inc." 215 "Aetna Engineering/Fireboy-Xintex" 214 "MC elettronica Srl" 164 "MTU Friedrichshafen GmbH (formerly DaimlerChrysler Off-Highway)" 163 "BRP Inc." 162 "Axiomatic Technologies" 161 "Offshore Systems (UK) Ltd" 160 "Nido" 159 "NTech Industries Inc" 158 "Firestone Industrial Products Company" 157 "ISSPRO Inc." 156 "ITT Industries - Cannon" 155 "Vetronix Corporation" 154 "Westerbeke Corporation" 153 "Woodward, Industrial Controls Division" 152 "elobau GmbH & Co. KG" 151 "Raven Industries, Inc." 150 "Fleetguard" 149 "Holset" 148 "Blue Water Data, Inc." 147 "Nautibus electronic GmbH" 146 "Maxima Technologies" 145 "MurCal Controls" 144 "Mercury Marine" 143 "W. Gmeiner GmbH & Co." 142 "TRW Automotive (Commercial Steering Systems)" 141 "Thales Navigation Ltd." 140 "Lowrance Electronics, Inc." 139 "Caterpillar Trimble Control Technologies (CTCT), LLC" 138 "Georg Fritzmeier GmbH & Co. KG" 137 "Maretron" 136 "Komatsu Ltd" 135 "Airmar Technology Corporation" 134 "Iris Technology Ltd" 133 "Bucher Schoerling GmbH" 132 "Mulag-Fahrzeugwerk" 131 "ITT Industries" 130 "Nido - Universal Machines B.V." 129 "OMNEX Control Systems Inc." 128 "Gerhard Duecker GmbH & Co. KG" 127 "Holland USA" 126 "Driver Tech" 125 "Nevada Automotive Test Center" 124 "Hydac Electronic" 123 "Basler Electric" 122 "FG Wilson (Engineering) Limited" 121 "HED (Hydro Electronic Devices, Inc.)" 120 "RDS Technology Ltd" 119 "IntegriNautics  " 118 "Intron GmbH" 117 "HUSCO International" 116 "BEELINE Technologies" 115 "NACCO Materials Handling Group, Inc." 114 "EControls, Inc." 113 "Stress-Tek, Inc." 112 "MECALAC" 111 "Bernard Krone Holding SE & Co. KG (formerly Maschinenfabrik Bernard Krone GmbH)" 110 "EPIQ Sensor-Nite" 109 "TeeJet Technologies Denmark (formerly LH Technologies ApS)" 108 "WTK-Elecktronik GmbH" 107 "Grimme Landmaschinen GmbH & Co. KG" 106 "BAE Systems Controls, Inc." 105 "Kiepe Elektrik GmbH & Co. KG" 104 "CLAAS KGaA mbH (formerly CLAAS Selbstfahrende Erntemaschinen GmbH)" 103 "CLAAS E-Systems GmbH (formerly CLAAS E-Systems KGaA mbH & Co. KG)" 102 "AGCO (formerly AGCO GmbH & Co.)" 101 "Sensoria" 100 "VDO Technik AG" 99 "International Transmissions Ltd (ITL)" 98 "Mueller-Elektronik GmbH & Co" 97 "Ag Leader Technology, Inc." 96 "Mech@tronic IT GmbH" 95 "Pacific Insight Electronics Corp." 94 "CNH Industrial N.V. (formerly CNH Global N.V.)" 93 "Perkins Engines Company Ltd." 92 "Ag-Chem Equipment Co., Inc." 91 "BSG Bodensee Steuergeraete GmbH" 90 "Knorr-Bremse SfN GmbH" 89 "Kverneland Group, Electronics Division" 88 "Hemisphere GPS Inc (formerly Satloc Precision GPS)" 87 "J.C. Bamford Excavators Ltd (JCB)" 86 "C. E. Niehoff & Company" 85 "Kohler Co" 84 "New Holland UK Limited" 83 "Bendix VORAD Technologies (formerly Eaton VORAD Technologies)" 82 "Bobcat/Ingersoll-Rand (formerly Melroe/Ingersoll-Rand)" 81 "Fire Research Corp." 80 "Twin Disc, Inc." 79 "Daimler Benz AG - Engine Division (PBM)" 78 "Frank W. Murphy Manufacturing, Inc" 77 "Deere Power Systems Group" 76 "unused (formerly Deere & Co, Construction Division)" 75 "Deere & Co, Agricultural Division" 74 "Eaton Axle-Brake Division" 73 "LeTourneau, Inc." 72 "Sisu Corporation" 71 "Vansco Electronics Ltd." 70 "Flex-coil Limited" 69 "Trimble Navigation" 316 "ITT Flow Control" 315 "Icom Incorporated" 314 "CSM GmbH" 313 "Ilmor Engineering, Inc." 312 "Lectronix, Inc." 311 "Patrick Power Products" 310 "TECNORD srl" 309 "Krauss-Maffei Wegmann GmbH & Co. KG" 308 "Cyntrx" 307 "MAS Technologies" 306 "Sleipner Motor AB" 305 "NovAtel Inc" 304 "EmpirBus AB" 303 "CTS Corporation" 302 "Nissin Kogyo Co., LTD" 301 "Parker Hannifin (UK) Ltd FDE group" 300 "Systron Donner Automotive" 299 "Rauch" 298 "Holley Performance" 297 "Zonar Systems Inc" 296 "micro dynamics GmbH" 295 "BEP Marine" 294 "Grayhill Inc." 293 "Spyder Controls Corp." 292 "IKUSI - Angel Iglesias S.A." 291 "Groeneveld Transport Efficiency BV" 290 "Kuebler GmbH" 289 "Watlow" 288 "Mitsubishi FUSO Truck & Bus Corp." 287 "NTech Industries, Inc" 286 "Coelmo srl" 285 "Sea Recovery Corp" 284 "Mobile Tech Chile" 283 "CWF Hamilton & Co Ltd" 282 "Medallion Instrumentation Systems" 281 "Precision Governors LLC" 280 "Leica Geosystems Pty Ltd" 279 "Geometris LP" 278 "Takata Electronics" 277 "LHP Telematics" 276 "Aqua-Hot Heating Systems" 275 "Navico Egersund AS" 274 "LTW Technology Co., LTD" 273 "Active Research Limited" 272 "Gross Mechanical Laboratories, Inc" 271 "Cole Hersee" 270 "Tennant" 269 "Saft America Inc.,  Space & Defense Division" 268 "Accurate Technologies" 267 "Red Lion Controls, Inc" 266 "International Thermal Research Ltd" 265 "MTS Sensor Technologie GmbH" 264 "Autolync" 213 "CNH Belgium N.V." 212 "Sure Power Industries, Inc" 211 "DNA Group" 210 "Iteris, Inc." 209 "Bell Equip. Co. SA (PTY) LTD" 208 "Drew Technologies, Inc" 207 "Otto Engineering" 206 "port GmbH" 205 "SmarTire Systems Inc" 204 "The Morey Corporation" 203 "MILtronik GmbH" 202 "Curtis Instruments, Inc" 201 "Disenos y Tecnologia S.A." 200 "MGM Brakes" 199 "ACTIA Group (formerly Actia Corp)" 198 "Mystic Valley Communications" 197 "Mechron Power Systems" 196 "LEMKEN GmbH & Co KG" 195 "General Engine Products" 194 "TriMark Corporation" 193 "Jeppesen Marine" 192 "Floscan" 191 "XRS Corporation (formerly XATA Corporation)" 190 "Hella KGaA Hueck & Co" 189 "QUALCOMM" 188 "EMP Corp" 187 "Air-Weigh" 186 "Altronic, Inc" 185 "Beede Electrical Instrument Company" 184 "EIA Electronics" 183 "KDS Controls, Inc" 182 "Vehicle Systems Engineering B.V." 181 "Coretronics, Inc." 180 "Smart Power Systems" 179 "TeeJet Technologies Springfield (formerly Midwest Technologies Illinois, LLC)" 178 "Continental Automotive GmbH (formerly Siemens VDO Automotive AG)" 177 "Diagnostic Systems Associates" 176 "Moritz Aerospace" 175 "Veris Technologies, Inc." 174 "AB Volvo Penta" 173 "Ryeso, Inc." 172 "Yanmar Co., Ltd. (formerly Yanmar Marine USA)" 171 "Topcon Electronics GmbH & Co. KG (formerly Wachendorff Elektronik GmbH & Co. KG)" 170 "Computronics Corporation Ltd." 169 "Marlin Technologies Inc." 168 "Xantrex" 167 "JLG Industries Inc" 166 "John Deere Electronic Solutions (formerly Phoenix International)" 165 "CPAC Systems AB" 68 "Scania" 67 "John Deere Coffeyville Works (formerly Funk Manufacturing Company)" 66 "John Deere Construction Equipment Division" 65 "MAN Nutzfahrzeuge AG" 64 "Unused (formerly SpectraPrecision Laserplane, then SpectraPhysics)" 63 "ZF Industries Inc." 62 "Wabco" 61 "Volvo Truck Corp." 60 "Volvo Trucks North America Inc." 59 "VES Inc." 58 "SPX Corporation, OTC Div" 57 "Danfoss  (formerly Sauer Sundstrand Co, then Sauer-Danfoss Co)" 56 "SAIC" 55 "Ryder System Inc." 54 "Meritor Wabco" 53 "Continental Automotive Systems US, Inc. (formerly Rockwell Land Transportation)" 52 "Meritor Automotive, Inc. (formerly Rockwell Automotive)" 51 "Robert Bosch GmbH" 50 "Robert Bosch Corp" 49 "RE America Inc." 48 "Pollak Alphabet" 47 "Phillips Semiconductor" 46 "Noregon Systems, Inc  (formerly Parasoft Computing Solutions)" 45 "PACCAR" 44 "Nippondenso Co. Ltd." 43 "International Truck and Engine Corporation - Vehicle Electronics (formerly Navistar Intl Trans Corp.)" 42 "International Truck and Engine Corporation - Engine Electronics  (formerly Navistar Intl Trans Co., Engine Electronics)" 41 "Motorola Inc." 40 "Motorola AIEG Inc." 39 "Microfirm Inc." 38 "Micro Processor Systems Inc." 37 "Mack Trucks Inc." 36 "Lucas Ind." 35 "Kenworth Truck Co." 34 "Kelsey Hayes Co." 33 "John Deere" 32 "Jacobs Vehicle Systems" 31 "J Pollak Corp" 30 "Isuzu Motors Ltd" 29 "Hino Motors Ltd." 28 "Grote Ind. Inc." 27 "GMC" 26 "General Motors Corp, Service Technology Grp" 25 "Daimler Trucks North America LLC (formerly Freightliner LLC)" 24 "Ford Motor Co., Vehicle Controls" 23 "Ford Motor Co., Heavy Truck" 22 "Ford Motor Co., Electronic Concepts & Systems" 21 "Echlin Inc., Midland Brake Inc." 20 "Eaton Ltd" 19 "Eaton Corp. Trucking Info Services" 18 "Eaton Corp, Transmission Div." 17 "Eaton Corp, Corp Res & Dev" 16 "Eaton Corp" 15 "DICKEY-john Corporation" 14 "Detroit Diesel Corporation" 13 "Delco Electronics" 12 "Deere & Company, Precision Farming" 11 "Dearborn Group Inc." 10 "Cummins Inc (formerly Cummins Engine Co)" 9 "Chrysler Corp." 8 "Caterpillar Inc." 7 "Case Corp." 6 "Berifors Electronics AB" 5 "AMP Inc." 4 "Ametek-Dixson" 3 "Ametek, US Gauge Division" 2 "Allison Transmission, Inc." 1 "Bendix Commercial Vehicle Systems LLC (formerly Allied Signal Inc.)" 0 "Reserved" ;
VAL_ 2362179200 GNSSInstallationType 5 "Display integrated antenna" 4 "Second Implement antenna" 3 "First Implement antenna" 2 "Tractor universal antenna (removable)" 1 "Tractor integrated antenna" 0 "Unknown " ;
VAL_ 2362179200 TramlineControlState 3 "undefined/not supported" 2 "error" 1 "automatic/on" 0 "manual/off" ;
VAL_ 2362179200 LastEventPartnerIDDeviceClass 26 "Feeder / Mixer" 25 "Slurry Applicators" 24 "Utility Vehicles" 23 "Mulchers" 22 "Timber Processing Machines" 21 "Timber loaders" 20 "Forwarders" 19 "Timber Harvesters" 17 "Sensor System" 16 "Skidder" 15 "Municipal Work / Earth Work" 14 "Special Crops" 13 "Powered Auxilary Units" 12 "Farmyard Work / Farm Yard Operations" 11 "Transport / Trailers (including Truck Trailers and Trucks)" 10 "Irrigation" 9 "Forage Harvester" 8 "Root Harvester" 7 "Harvesters (= Combine)" 6 "Sprayers" 5 "Fertilizer" 4 "Planters /Seeders" 3 "Secondary Soil Tillage" 2 "Primary Soil Tillage" 1 "Tractor" 0 "Non-specific System" ;
VAL_ 2362179200 LastEventPartnerIdType 1013 "13,56 MHz NFC according ISO 15693" 1012 "2,45 GHz RFID according ISO 18000-4" 1011 "868 MHz RFID according ISO 18000-6" 1010 "433 MHz RFID according ISO 18000-7" 1009 "13,56 MHz NFC according ISO 22536" 1008 "13,56 MHz RFID according ISO 18000-3" 1007 "135 kHz RFID according ISO 18000-2" 1006 "2,4 GHz Google URIBeacon" 1005 "2,4 GHz Radius Networks AltBeacon" 1004 "2,4 GHz Google Eddystone Beacon" 1003 "2,4 GHz Apple iBeacon" 1002 "Manually User Input" 1001 "Manufacturer Proprietary Solution" 1 "ISO 11783 Standardized Identification Device" 0 "Not Available" ;
VAL_ 2362179200 SpeedSource 7 "Machine measured speed" 6 "Machine Selected speed" 5 "Simulated speed" 4 "Blended speed" 3 "Navigation-based speed" 2 "Ground-based speed" 1 "Wheel-based speed" 0 "Unknown" ;
SG_MUL_VAL_ 2362179319 CondensedWorkState49to64 DDI 164-164;
SG_MUL_VAL_ 2362179319 CondensedWorkState65to80 DDI 165-165;
SG_MUL_VAL_ 2362179319 CondensedWorkState81to96 DDI 166-166;
SG_MUL_VAL_ 2362179319 CondensedWorkState97to112 DDI 167-167;
SG_MUL_VAL_ 2362179319 CondensedWorkState113to128 DDI 168-168;
SG_MUL_VAL_ 2362179319 CondensedWorkState129to144 DDI 169-169;
SG_MUL_VAL_ 2362179319 CondensedWorkState145to160 DDI 170-170;
SG_MUL_VAL_ 2362179319 CondensedWorkState161to176 DDI 171-171;
SG_MUL_VAL_ 2362179319 CondensedWorkState177to192 DDI 172-172;
SG_MUL_VAL_ 2362179319 CondensedWorkState193to208 DDI 173-173;
SG_MUL_VAL_ 2362179319 CondensedWorkState209to224 DDI 174-174;
SG_MUL_VAL_ 2362179319 CondensedWorkState225to240 DDI 175-175;
SG_MUL_VAL_ 2362179319 CondensedWorkState241to256 DDI 176-176;
SG_MUL_VAL_ 2362179319 ActualLengthOfCut DDI 177-177;
SG_MUL_VAL_ 2362179319 ElementTypeInstance DDI 178-178;
SG_MUL_VAL_ 2362179319 ActualCulturalPractice DDI 179-179;
SG_MUL_VAL_ 2362179319 DRP2GroundDistance DDI 180-180;
SG_MUL_VAL_ 2362179319 DryMassPerAreaYield DDI 181-181;
SG_MUL_VAL_ 2362179319 DryMassPerTimeYield DDI 182-182;
SG_MUL_VAL_ 2362179319 YieldTotalDryMass DDI 183-183;
SG_MUL_VAL_ 2362179319 RefMoistureForDryMass DDI 184-184;
SG_MUL_VAL_ 2362179319 SeedCottonMassPerAreaYield DDI 185-185;
SG_MUL_VAL_ 2362179319 LintCottonMassPerAreaYield DDI 186-186;
SG_MUL_VAL_ 2362179319 SeedCottonMassPerTimeYield DDI 187-187;
SG_MUL_VAL_ 2362179319 LintCottonMassPerTimeYield DDI 188-188;
SG_MUL_VAL_ 2362179319 YieldTotalSeedCottonMass DDI 189-189;
SG_MUL_VAL_ 2362179319 YieldTotalLintCottonMass DDI 190-190;
SG_MUL_VAL_ 2362179319 LintTurnoutPercentage DDI 191-191;
SG_MUL_VAL_ 2362179319 AmbientTemperature DDI 192-192;
SG_MUL_VAL_ 2362179319 SetpointProductPressure DDI 193-193;
SG_MUL_VAL_ 2362179319 ActualProductPressure DDI 194-194;
SG_MUL_VAL_ 2362179319 MinimumProductPressure DDI 195-195;
SG_MUL_VAL_ 2362179319 MaximumProductPressure DDI 196-196;
SG_MUL_VAL_ 2362179319 SetpointPumpOutputPressure DDI 197-197;
SG_MUL_VAL_ 2362179319 ActualPumpOutputPressure DDI 198-198;
SG_MUL_VAL_ 2362179319 MinimumPumpOutputPressure DDI 199-199;
SG_MUL_VAL_ 2362179319 MaximumPumpOutputPressure DDI 200-200;
SG_MUL_VAL_ 2362179319 SetpointTankAgitationPressure DDI 201-201;
SG_MUL_VAL_ 2362179319 ActualTankAgitationPressure DDI 202-202;
SG_MUL_VAL_ 2362179319 MinimumTankAgitationPressure DDI 203-203;
SG_MUL_VAL_ 2362179319 MaximumTankAgitationPressure DDI 204-204;
SG_MUL_VAL_ 2362179319 SCTurnOnTime_ DDI 205-205;
SG_MUL_VAL_ 2362179319 SCTurnOffTime DDI 206-206;
SG_MUL_VAL_ 2362179319 WindSpeed DDI 207-207;
SG_MUL_VAL_ 2362179319 WindDirection DDI 208-208;
SG_MUL_VAL_ 2362179319 AirHumidity DDI 209-209;
SG_MUL_VAL_ 2362179319 SkyConditions DDI 210-210;
SG_MUL_VAL_ 2362179319 LastBaleFlakesPerBale DDI 211-211;
SG_MUL_VAL_ 2362179319 LastBaleAverageMoisture DDI 212-212;
SG_MUL_VAL_ 2362179319 LastBaleAverageStrokesPerFlake DDI 213-213;
SG_MUL_VAL_ 2362179319 LifetimeBaleCount DDI 214-214;
SG_MUL_VAL_ 2362179319 LifetimeWorkingHours DDI 215-215;
SG_MUL_VAL_ 2362179319 ActualBaleHydraulicPressure DDI 216-216;
SG_MUL_VAL_ 2362179319 LastBaleAverageHydraulicPressure DDI 217-217;
SG_MUL_VAL_ 2362179319 SetpointBaleCompressionPlungerLo DDI 218-218;
SG_MUL_VAL_ 2362179319 ActualBaleCompressionPlungerLoad DDI 219-219;
SG_MUL_VAL_ 2362179319 LastBaleAverageBaleCompressionPl DDI 220-220;
SG_MUL_VAL_ 2362179319 LastBaleAppliedPreservative DDI 221-221;
SG_MUL_VAL_ 2362179319 LastBaleTagNumber DDI 222-222;
SG_MUL_VAL_ 2362179319 LastBaleMass DDI 223-223;
SG_MUL_VAL_ 2362179319 DeltaT DDI 224-224;
SG_MUL_VAL_ 2362179319 SetpointWorkingLength DDI 225-225;
SG_MUL_VAL_ 2362179319 ActualWorkingLength DDI 226-226;
SG_MUL_VAL_ 2362179319 MinimumWorkingLength DDI 227-227;
SG_MUL_VAL_ 2362179319 MaximumWorkingLength DDI 228-228;
SG_MUL_VAL_ 2362179319 ActualNetWeight DDI 229-229;
SG_MUL_VAL_ 2362179319 NetWeightState DDI 230-230;
SG_MUL_VAL_ 2362179319 SetpointNetWeight DDI 231-231;
SG_MUL_VAL_ 2362179319 ActualGrossWeight DDI 232-232;
SG_MUL_VAL_ 2362179319 GrossWeightState DDI 233-233;
SG_MUL_VAL_ 2362179319 MinimumGrossWeight DDI 234-234;
SG_MUL_VAL_ 2362179319 MaximumGrossWeight DDI 235-235;
SG_MUL_VAL_ 2362179319 ThreshingEngagementTotalTime DDI 236-236;
SG_MUL_VAL_ 2362179319 ActualHeaderWorkingHeightStatus DDI 237-237;
SG_MUL_VAL_ 2362179319 ActualHeaderRotationalSpeedStatu DDI 238-238;
SG_MUL_VAL_ 2362179319 YieldHoldStatus DDI 239-239;
SG_MUL_VAL_ 2362179319 ActualUnLoadingSystemStatus DDI 240-240;
SG_MUL_VAL_ 2362179319 CropTemperature DDI 241-241;
SG_MUL_VAL_ 2362179319 SetpointSieveClearance DDI 242-242;
SG_MUL_VAL_ 2362179319 ActualSieveClearance DDI 243-243;
SG_MUL_VAL_ 2362179319 MinimumSieveClearance DDI 244-244;
SG_MUL_VAL_ 2362179319 MaximumSieveClearance DDI 245-245;
SG_MUL_VAL_ 2362179319 SetpointChafferClearance DDI 246-246;
SG_MUL_VAL_ 2362179319 ActualChafferClearance DDI 247-247;
SG_MUL_VAL_ 2362179319 MinimumChafferClearance DDI 248-248;
SG_MUL_VAL_ 2362179319 MaximumChafferClearance DDI 249-249;
SG_MUL_VAL_ 2362179319 SetpointConcaveClearance DDI 250-250;
SG_MUL_VAL_ 2362179319 ActualConcaveClearance DDI 251-251;
SG_MUL_VAL_ 2362179319 MinimumConcaveClearance DDI 252-252;
SG_MUL_VAL_ 2362179319 MaximumConcaveClearance DDI 253-253;
SG_MUL_VAL_ 2362179319 SetpointSeparationFanRotationalS DDI 254-254;
SG_MUL_VAL_ 2362179319 ActualSeparationFanRotationalSpe DDI 255-255;
SG_MUL_VAL_ 2362179319 MinimumSeparationFanRotationalSp DDI 256-256;
SG_MUL_VAL_ 2362179319 MaximumSeparationFanRotationalSp DDI 257-257;
SG_MUL_VAL_ 2362179319 HydraulicOilTemperature DDI 258-258;
SG_MUL_VAL_ 2362179319 YieldLagIgnoreTime DDI 259-259;
SG_MUL_VAL_ 2362179319 YieldLeadIgnoreTime DDI 260-260;
SG_MUL_VAL_ 2362179319 AverageYieldMassPerTime DDI 261-261;
SG_MUL_VAL_ 2362179319 AverageCropMoisture DDI 262-262;
SG_MUL_VAL_ 2362179319 AverageYieldMassPerArea DDI 263-263;
SG_MUL_VAL_ 2362179319 ConnectorPivotXOffset DDI 264-264;
SG_MUL_VAL_ 2362179319 RemainingArea DDI 265-265;
SG_MUL_VAL_ 2362179319 LifetimeApplicationTotalMass DDI 266-266;
SG_MUL_VAL_ 2362179319 LifetimeApplicationTotalCount DDI 267-267;
SG_MUL_VAL_ 2362179319 LifetimeYieldTotalVolume DDI 268-268;
SG_MUL_VAL_ 2362179319 LifetimeYieldTotalMass DDI 269-269;
SG_MUL_VAL_ 2362179319 LifetimeYieldTotalCount DDI 270-270;
SG_MUL_VAL_ 2362179319 LifetimeTotalArea DDI 271-271;
SG_MUL_VAL_ 2362179319 LifetimeTotalDistance DDI 272-272;
SG_MUL_VAL_ 2362179319 LifetimeIneffectiveTotalDistance DDI 273-273;
SG_MUL_VAL_ 2362179319 LifetimeEffectiveTotalTime DDI 274-274;
SG_MUL_VAL_ 2362179319 LifetimeIneffectiveTotalTime DDI 275-275;
SG_MUL_VAL_ 2362179319 LifetimeFuelConsumption DDI 276-276;
SG_MUL_VAL_ 2362179319 LifetimeAverageFuelConsumptionPe DDI 277-277;
SG_MUL_VAL_ 2362179319 LifetimeAverageFuelConsumpt_0000 DDI 278-278;
SG_MUL_VAL_ 2362179319 LifetimeYieldTotalDryMass DDI 279-279;
SG_MUL_VAL_ 2362179319 LifetimeYieldTotalSeedCottonMass DDI 280-280;
SG_MUL_VAL_ 2362179319 LifetimeYieldTotalLintCottonMass DDI 281-281;
SG_MUL_VAL_ 2362179319 LifetimeThreshingEngagementTotal DDI 282-282;
SG_MUL_VAL_ 2362179319 PrecutTotalCount DDI 283-283;
SG_MUL_VAL_ 2362179319 UncutTotalCount DDI 284-284;
SG_MUL_VAL_ 2362179319 LifetimePrecutTotalCount DDI 285-285;
SG_MUL_VAL_ 2362179319 LifetimeUncutTotalCount DDI 286-286;
SG_MUL_VAL_ 2362179319 SetpointWorkState DDI 289-289;
SG_MUL_VAL_ 2362179319 SetpointCondensedWorkState1to16 DDI 290-290;
SG_MUL_VAL_ 2362179319 SetpointCondensedWorkState17to32 DDI 291-291;
SG_MUL_VAL_ 2362179319 SetpointCondensedWorkState33to48 DDI 292-292;
SG_MUL_VAL_ 2362179319 SetpointCondensedWorkState49to64 DDI 293-293;
SG_MUL_VAL_ 2362179319 SetpointCondensedWorkState65to80 DDI 294-294;
SG_MUL_VAL_ 2362179319 SetpointCondensedWorkState81to96 DDI 295-295;
SG_MUL_VAL_ 2362179319 SetpointCondensedWorkState97to11 DDI 296-296;
SG_MUL_VAL_ 2362179319 SetpointCondensedWorkState113to1 DDI 297-297;
SG_MUL_VAL_ 2362179319 SetpointCondensedWorkState129to1 DDI 298-298;
SG_MUL_VAL_ 2362179319 SetpointCondensedWorkState145to1 DDI 299-299;
SG_MUL_VAL_ 2362179319 SetpointCondensedWorkState161to1 DDI 300-300;
SG_MUL_VAL_ 2362179319 SetpointCondensedWorkState177to1 DDI 301-301;
SG_MUL_VAL_ 2362179319 SetpointCondensedWorkState193to2 DDI 302-302;
SG_MUL_VAL_ 2362179319 SetpointCondensedWorkState209to2 DDI 303-303;
SG_MUL_VAL_ 2362179319 SetpointCondensedWorkState225to2 DDI 304-304;
SG_MUL_VAL_ 2362179319 SetpointCondensedWorkState241to2 DDI 305-305;
SG_MUL_VAL_ 2362179319 TrueRotationPointXOffset DDI 306-306;
SG_MUL_VAL_ 2362179319 TrueRotationPointYOffset DDI 307-307;
SG_MUL_VAL_ 2362179319 ActualPercentageApplicationRate DDI 308-308;
SG_MUL_VAL_ 2362179319 MinimumPercentageApplicationRate DDI 309-309;
SG_MUL_VAL_ 2362179319 MaximumPercentageApplicationRate DDI 310-310;
SG_MUL_VAL_ 2362179319 RelativeYieldPotential DDI 311-311;
SG_MUL_VAL_ 2362179319 MinimumRelativeYieldPotential DDI 312-312;
SG_MUL_VAL_ 2362179319 MaximumRelativeYieldPotential DDI 313-313;
SG_MUL_VAL_ 2362179319 ActualPercentageCropDryMatter DDI 314-314;
SG_MUL_VAL_ 2362179319 AveragePercentageCropDryMatter DDI 315-315;
SG_MUL_VAL_ 2362179319 EffectiveTotalFuelConsumption DDI 316-316;
SG_MUL_VAL_ 2362179319 IneffectiveTotalFuelConsumption DDI 317-317;
SG_MUL_VAL_ 2362179319 EffectiveTotalDieselExhaustFluid DDI 318-318;
SG_MUL_VAL_ 2362179319 IneffectiveTotalDieselExhaustFlu DDI 319-319;
SG_MUL_VAL_ 2362179319 LastLoadedWeight DDI 320-320;
SG_MUL_VAL_ 2362179319 LastUnloadedWeight DDI 321-321;
SG_MUL_VAL_ 2362179319 PGNBasedData DDI 57342-57342;
SG_MUL_VAL_ 2362179319 RequestDefaultProcessData DDI 57343-57343;
SG_MUL_VAL_ 2362179319 ObjectIdOfFaultyObject DeviceDescriptionMsgType 9-9;
SG_MUL_VAL_ 2362179319 ErrorCodeProcessData1 Command 13-13;
SG_MUL_VAL_ 2362179319 StatusTotalsActive Command 14-14;
SG_MUL_VAL_ 2362179319 Status_TotalsActive Command 15-15;
SG_MUL_VAL_ 2362179319 DateFormatCmd DeviceDescriptionMsgType 2-2, 3-3;
SG_MUL_VAL_ 2362179319 DataDictionaryVersion DDI 0-0;
SG_MUL_VAL_ 2362179319 PeerControlCommand Command 9-9;
SG_MUL_VAL_ 2362179319 DecimalSymbolCmd DeviceDescriptionMsgType 2-2, 3-3;
SG_MUL_VAL_ 2362179319 TimeFormatCmd DeviceDescriptionMsgType 2-2, 3-3;
SG_MUL_VAL_ 2362179319 ImplementSectionControl TechnicalDataMsgType 1-1;
SG_MUL_VAL_ 2362179319 PeerControlAssignment TechnicalDataMsgType 1-1;
SG_MUL_VAL_ 2362179319 TC_GEO_DefinitionPositionBasedCo TechnicalDataMsgType 1-1;
SG_MUL_VAL_ 2362179319 TimeAndPositionForDataLogging TechnicalDataMsgType 1-1;
SG_MUL_VAL_ 2362179319 Documentation TechnicalDataMsgType 1-1;
SG_MUL_VAL_ 2362179319 ErrorCodeChangeDesignator DeviceDescriptionMsgType 13-13;
SG_MUL_VAL_ 2362179319 DesignatorLength DeviceDescriptionMsgType 12-12;
SG_MUL_VAL_ 2362179319 ErrorDetailObjectPoolDelete DeviceDescriptionMsgType 11-11;
SG_MUL_VAL_ 2362179319 DDI_TI Command 4-4;
SG_MUL_VAL_ 2362179319 DDI_DI Command 5-5;
SG_MUL_VAL_ 2362179319 ErrorDDI Command 13-13;
SG_MUL_VAL_ 2362179319 ParentObjectIdOfFaultyObject DeviceDescriptionMsgType 9-9;
SG_MUL_VAL_ 2362179319 ReceivedDataSize DeviceDescriptionMsgType 7-7;
SG_MUL_VAL_ 2362179319 DDI Command 2-2, 3-3, 6-8, 10-10;
SG_MUL_VAL_ 2362179319 BootTimeTC TechnicalDataMsgType 1-1;
SG_MUL_VAL_ 2362179319 PeerControlDDI Command 9-9;
SG_MUL_VAL_ 2362179319 ErrorCodeObjPoolActiveResp4 DeviceDescriptionMsgType 9-9;
SG_MUL_VAL_ 2362179319 LanguageCodeCmd DeviceDescriptionMsgType 2-2, 3-3;
SG_MUL_VAL_ 2362179319 ErrorCodeObjPoolActiveResp3 DeviceDescriptionMsgType 9-9;
SG_MUL_VAL_ 2362179319 ErrorCodeObjPoolActiveResp2 DeviceDescriptionMsgType 9-9;
SG_MUL_VAL_ 2362179319 StructureLabel DeviceDescriptionMsgType 0-0, 1-1;
SG_MUL_VAL_ 2362179319 VersionNumberISO11783Part10 TechnicalDataMsgType 1-1;
SG_MUL_VAL_ 2362179319 RequestTransferDataSize DeviceDescriptionMsgType 4-4;
SG_MUL_VAL_ 2362179319 Status DeviceDescriptionMsgType 5-5;
SG_MUL_VAL_ 2362179319 ErrorCodeObjPoolTransfer DeviceDescriptionMsgType 7-7;
SG_MUL_VAL_ 2362179319 ActivateDeactivateCommand DeviceDescriptionMsgType 8-8;
SG_MUL_VAL_ 2362179319 ErrorCodeObjectPoolDelete DeviceDescriptionMsgType 11-11;
SG_MUL_VAL_ 2362179319 ObjectIdToChange DeviceDescriptionMsgType 12-12;
SG_MUL_VAL_ 2362179319 ObjectIdChanged DeviceDescriptionMsgType 13-13;
SG_MUL_VAL_ 2362179319 ErrorCodeObjPoolActiveResp1 DeviceDescriptionMsgType 9-9;
SG_MUL_VAL_ 2362179319 TechnicalDataMsgType Command 0-0;
SG_MUL_VAL_ 2362179319 DeviceDescriptionMsgType Command 1-1;
SG_MUL_VAL_ 2362179319 ElementNumber Command 2-10;
SG_MUL_VAL_ 2362179319 ErrorElementNumber Command 13-13;
SG_MUL_VAL_ 2362179319 NumberOfControlChannels TechnicalDataMsgType 1-1;
SG_MUL_VAL_ 2362179200 ActualCanopyHeight DDI 520-520;
SG_MUL_VAL_ 2362179200 GNSSInstallationType DDI 521-521;
SG_MUL_VAL_ 2362179200 LastBaleLifetimeCount DDI 519-519;
SG_MUL_VAL_ 2362179200 ActualTramlineCondensedWork_0000 DDI 518-518;
SG_MUL_VAL_ 2362179200 SetpointTramlineCondensedWo_0000 DDI 517-517;
SG_MUL_VAL_ 2362179200 TramlineOverdosingRate DDI 516-516;
SG_MUL_VAL_ 2362179200 TramlineControlState DDI 515-515;
SG_MUL_VAL_ 2362179200 GNSSQuality DDI 514-514;
SG_MUL_VAL_ 2362179200 GuidanceLineDeviation DDI 513-513;
SG_MUL_VAL_ 2362179200 GuidanceLineSwathWidth DDI 512-512;
SG_MUL_VAL_ 2362179200 TrackNumberToLeft DDI 511-511;
SG_MUL_VAL_ 2362179200 TrackNumberToRight DDI 510-510;
SG_MUL_VAL_ 2362179200 ActualTrackNumber DDI 509-509;
SG_MUL_VAL_ 2362179200 UniqueABGuidanceReferenceLineID DDI 508-508;
SG_MUL_VAL_ 2362179200 TramlineSequenceNumber DDI 507-507;
SG_MUL_VAL_ 2362179200 SetpointTramlineControlLevel DDI 506-506;
SG_MUL_VAL_ 2362179200 TramlineControlLevel DDI 505-505;
SG_MUL_VAL_ 2362179200 MaxEngineTorque DDI 504-504;
SG_MUL_VAL_ 2362179200 MinEngineTorque DDI 503-503;
SG_MUL_VAL_ 2362179200 ActualEngineTorque DDI 502-502;
SG_MUL_VAL_ 2362179200 SetpointEngineTorque DDI 501-501;
SG_MUL_VAL_ 2362179200 LastEventPartnerIDDeviceClass DDI 500-500;
SG_MUL_VAL_ 2362179200 LastEventPartnerIDManufactu_0000 DDI 499-499;
SG_MUL_VAL_ 2362179200 LastEventPartnerIdType DDI 498-498;
SG_MUL_VAL_ 2362179200 LastEventPartnerID_Byte13to16 DDI 497-497;
SG_MUL_VAL_ 2362179200 LastEventPartnerID_Byte9to12 DDI 496-496;
SG_MUL_VAL_ 2362179200 LastEventPartnerID_Byte5to8 DDI 495-495;
SG_MUL_VAL_ 2362179200 LastEventPartnerID_Byte1to4 DDI 494-494;
SG_MUL_VAL_ 2362179200 LifetimeEngineHours DDI 493-493;
SG_MUL_VAL_ 2362179200 TotalEngineHours DDI 492-492;
SG_MUL_VAL_ 2362179200 FuelPercentageLevel DDI 491-491;
SG_MUL_VAL_ 2362179200 MaxFuelTankContent DDI 490-490;
SG_MUL_VAL_ 2362179200 MaxDieselExhaustFluidTankContent DDI 489-489;
SG_MUL_VAL_ 2362179200 DieselExhaustFluidTankPerce_0000 DDI 488-488;
SG_MUL_VAL_ 2362179200 MaxEngineSpeed DDI 486-486;
SG_MUL_VAL_ 2362179200 MinEngineSpeed DDI 485-485;
SG_MUL_VAL_ 2362179200 ActualEngineSpeed DDI 484-484;
SG_MUL_VAL_ 2362179200 SetpointEngineSpeed DDI 483-483;
SG_MUL_VAL_ 2362179200 LastBaleNumberOfSubbales DDI 482-482;
SG_MUL_VAL_ 2362179200 SetpointNumberOfSubbales DDI 481-481;
SG_MUL_VAL_ 2362179200 MaxFlakeSize DDI 480-480;
SG_MUL_VAL_ 2362179200 MinFlakeSize DDI 479-479;
SG_MUL_VAL_ 2362179200 SetpointFlakeSize DDI 478-478;
SG_MUL_VAL_ 2362179200 MaxBaleHydraulicPressure DDI 477-477;
SG_MUL_VAL_ 2362179200 MinBaleHydraulicPressure DDI 476-476;
SG_MUL_VAL_ 2362179200 SetpointBaleHydraulicPressure DDI 475-475;
SG_MUL_VAL_ 2362179200 MaxLengthOfCut DDI 474-474;
SG_MUL_VAL_ 2362179200 MinLengthOfCut DDI 473-473;
SG_MUL_VAL_ 2362179200 SetpointLengthOfCut DDI 472-472;
SG_MUL_VAL_ 2362179200 ActualPercentageContent DDI 467-467;
SG_MUL_VAL_ 2362179200 ActualRelativeConnectorAngle DDI 466-466;
SG_MUL_VAL_ 2362179200 LifetimeHaulCounter DDI 465-465;
SG_MUL_VAL_ 2362179200 HaulCounter DDI 464-464;
SG_MUL_VAL_ 2362179200 LastUnloadedCount DDI 463-463;
SG_MUL_VAL_ 2362179200 LastLoadedCount DDI 462-462;
SG_MUL_VAL_ 2362179200 LifetimeUnloadedTotalCount DDI 461-461;
SG_MUL_VAL_ 2362179200 LifetimeLoadedTotalCount DDI 460-460;
SG_MUL_VAL_ 2362179200 UnloadedTotalCount DDI 459-459;
SG_MUL_VAL_ 2362179200 LoadedTotalCount DDI 458-458;
SG_MUL_VAL_ 2362179200 LastUnloadedVolume DDI 457-457;
SG_MUL_VAL_ 2362179200 LastLoadedVolume DDI 456-456;
SG_MUL_VAL_ 2362179200 LifetimeUnloadedTotalVolume DDI 455-455;
SG_MUL_VAL_ 2362179200 LifetimeLoadedTotalVolume DDI 454-454;
SG_MUL_VAL_ 2362179200 UnloadedTotalVolume DDI 453-453;
SG_MUL_VAL_ 2362179200 LoadedTotalVolume DDI 452-452;
SG_MUL_VAL_ 2362179200 MaxAppRateOfDryMatter DDI 451-451;
SG_MUL_VAL_ 2362179200 MinAppRateOfDryMatter DDI 450-450;
SG_MUL_VAL_ 2362179200 ActualAppRateOfDryMatter DDI 449-449;
SG_MUL_VAL_ 2362179200 SetpointAppRateOfDryMatter DDI 448-448;
SG_MUL_VAL_ 2362179200 MaxAppRateOfPotassium DDI 447-447;
SG_MUL_VAL_ 2362179200 MinAppRateOfPotassium DDI 446-446;
SG_MUL_VAL_ 2362179200 ActualAppRateOfPotassium DDI 445-445;
SG_MUL_VAL_ 2362179200 SetpointAppRateOfPotassium DDI 444-444;
SG_MUL_VAL_ 2362179200 MaxAppRateOfPhosphor DDI 443-443;
SG_MUL_VAL_ 2362179200 MinAppRateOfPhosphor DDI 442-442;
SG_MUL_VAL_ 2362179200 ActualAppRateOfPhosphor DDI 441-441;
SG_MUL_VAL_ 2362179200 SetpointAppRateOfPhosphor DDI 440-440;
SG_MUL_VAL_ 2362179200 MaxAppRateOfAmmonium DDI 439-439;
SG_MUL_VAL_ 2362179200 MinAppRateOfAmmonium DDI 438-438;
SG_MUL_VAL_ 2362179200 ActualAppRateOfAmmonium DDI 437-437;
SG_MUL_VAL_ 2362179200 SetpointAppRateOfAmmonium DDI 436-436;
SG_MUL_VAL_ 2362179200 MaxAppRateOfNitrogen DDI 435-435;
SG_MUL_VAL_ 2362179200 MinAppRateOfNitrogen DDI 434-434;
SG_MUL_VAL_ 2362179200 ActualAppRateOfNitrogen DDI 433-433;
SG_MUL_VAL_ 2362179200 SetpointAppRateOfNitrogen DDI 432-432;
SG_MUL_VAL_ 2362179200 LifetimeUnloadedTotalMass DDI 431-431;
SG_MUL_VAL_ 2362179200 LifetimeLoadedTotalMass DDI 430-430;
SG_MUL_VAL_ 2362179200 UnloadedTotalMass DDI 429-429;
SG_MUL_VAL_ 2362179200 LoadedTotalMass DDI 428-428;
SG_MUL_VAL_ 2362179200 ActualDownforceAsForce DDI 427-427;
SG_MUL_VAL_ 2362179200 SetpointDownforceAsForce DDI 426-426;
SG_MUL_VAL_ 2362179200 SetpointMaxAllowedSeedSpaci_0000 DDI 425-425;
SG_MUL_VAL_ 2362179200 AvgCoeffOfVariationOfSeedSp_0000 DDI 424-424;
SG_MUL_VAL_ 2362179200 ActCoeffOfVariationOfSeedSp_0000 DDI 423-423;
SG_MUL_VAL_ 2362179200 AverageSeedSpacingDeviation_0000 DDI 422-422;
SG_MUL_VAL_ 2362179200 ActualSeedSpacingDeviation DDI 421-421;
SG_MUL_VAL_ 2362179200 AverageSeedMultiplePercentage DDI 420-420;
SG_MUL_VAL_ 2362179200 ActualSeedMultiplePercentage DDI 419-419;
SG_MUL_VAL_ 2362179200 AverageSeedSkipPercentage DDI 418-418;
SG_MUL_VAL_ 2362179200 ActualSeedSkipPercentage DDI 417-417;
SG_MUL_VAL_ 2362179200 AverageSeedSingulationPercentage DDI 416-416;
SG_MUL_VAL_ 2362179200 ActualSeedSingulationPercentage DDI 415-415;
SG_MUL_VAL_ 2362179200 LifetimeAvgDieselExhFluidCo_0001 DDI 414-414;
SG_MUL_VAL_ 2362179200 LifetimeAvgDieselExhFluidCo_0002 DDI 413-413;
SG_MUL_VAL_ 2362179200 LifetimeDieselExhaustFluidC_0000 DDI 412-412;
SG_MUL_VAL_ 2362179200 InstantDieselExhaustFluidCo_0001 DDI 411-411;
SG_MUL_VAL_ 2362179200 InstantDieselExhaustFluidCo_0002 DDI 410-410;
SG_MUL_VAL_ 2362179200 TotalDieselExhaustFluidCons_0000 DDI 409-409;
SG_MUL_VAL_ 2362179200 AverageCropContamination DDI 408-408;
SG_MUL_VAL_ 2362179200 AverageProteinContent DDI 407-407;
SG_MUL_VAL_ 2362179200 ActualProteinContent DDI 406-406;
SG_MUL_VAL_ 2362179200 ActualApplicationOfDryMatter DDI 405-405;
SG_MUL_VAL_ 2362179200 ActualApplicationOfPotassium DDI 404-404;
SG_MUL_VAL_ 2362179200 ActualApplicationOfPhosphor DDI 403-403;
SG_MUL_VAL_ 2362179200 ActualApplicationOfAmmonium DDI 402-402;
SG_MUL_VAL_ 2362179200 ActualApplicationOfNitrogen DDI 401-401;
SG_MUL_VAL_ 2362179200 SpeedSource DDI 400-400;
SG_MUL_VAL_ 2362179200 MaximumSpeed DDI 399-399;
SG_MUL_VAL_ 2362179200 MinimumSpeed DDI 398-398;
SG_MUL_VAL_ 2362179200 ActualSpeed DDI 397-397;
SG_MUL_VAL_ 2362179200 SetpointSpeed DDI 396-396;
SG_MUL_VAL_ 2362179200 ActualDieselExhaustFluidTan_0000 DDI 395-395;
SG_MUL_VAL_ 2362179200 ActualFuelTankContent DDI 394-394;
SG_MUL_VAL_ 2362179200 MaximumRevolutionsPerTime DDI 393-393;
SG_MUL_VAL_ 2362179200 MinimumRevolutionsPerTime DDI 392-392;
SG_MUL_VAL_ 2362179200 DefaultRevolutionsPerTime DDI 391-391;
SG_MUL_VAL_ 2362179200 ActualRevolutionsPerTime DDI 390-390;
SG_MUL_VAL_ 2362179200 SetpointRevolutionsAsCountP_0000 DDI 389-389;
SG_MUL_VAL_ 2362179200 TotalRevolutionsInCompleteR_0000 DDI 388-388;
SG_MUL_VAL_ 2362179200 TotalRevolutionsInFractiona_0000 DDI 387-387;
SG_MUL_VAL_ 2362179200 ActualAtmosphericPressure DDI 386-386;
SG_MUL_VAL_ 2362179200 MSLAtmosphericPressure DDI 385-385;
SG_MUL_VAL_ 2362179200 ApparentWindSpeed DDI 384-384;
SG_MUL_VAL_ 2362179200 ApparentWindDirection DDI 383-383;
SG_MUL_VAL_ 2362179200 CondensedSectionOverrideSta_0000 DDI 382-382;
SG_MUL_VAL_ 2362179200 CondensedSectionOverrideSta_0001 DDI 381-381;
SG_MUL_VAL_ 2362179200 CondensedSectionOverrideSta_0002 DDI 380-380;
