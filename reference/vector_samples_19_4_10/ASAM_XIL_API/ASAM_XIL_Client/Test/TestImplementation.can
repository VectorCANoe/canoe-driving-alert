/*@!Encoding:65001*/
includes
{
}

variables
{
  double value;
  double expectedValue;
}

export testcase SimpleTestCaseCapl() 
{
    value = 7.5;
    expectedValue = value + 1.0;

    testStep("", "Setting TestVariableWriteable to %.1f" , value);
    $XILServer::MAPort.TestVariableWriteable = value;

    testWaitForTimeout(200);
    
    
    testStep("", "Checking TestVariableReadable value. Expected: %.1f", expectedValue);
    if($XILServer::MAPort.TestVariableReadable == expectedValue)
    {
      testStepPass("Test passed!");
      return;
    }

    testStep("","Actual: %.1f", $XILServer::MAPort.TestVariableReadable);
    testStepFail("Test failed!");
}
