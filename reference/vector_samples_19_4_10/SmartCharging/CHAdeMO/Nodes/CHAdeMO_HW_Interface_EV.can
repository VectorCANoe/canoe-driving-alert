/*@!Encoding:1252*/
includes
{
  
}

variables
{
  int Switch_S2 = 0, Switch_S2_ = 0;
  long hvSourceOutput = 0;
}

/// <General>
export long HV_source_set_output(long enabled)
{
  hvSourceOutput = enabled;
  return 0;
}

/// <General>
export long HV_source_get_output()
{
  return hvSourceOutput;
}

/// <General>
export double HV_measure_DC_U_Verivolt()
{
  if($EV.ExpectedContactorState == 1)
    return @SampleConfiguration::EV::SysEV_TargetVoltage; //contactors closed
  else
    return HV_measure_DC_U(); //contactors opened
}

/// <General>
export double HV_measure_DC_U()
{  
  return $CHAdeMO::Simulation::EV.ID109.PresentOutputVoltage;
}

/// <General>
export double HV_measure_DC_I()
{
  if($EV.ID200.MaximumDischargeCurrent.impl > 0)
     return (double)$EV.ID208.PresentDischargeCurrent.impl;
  else 
  {
    if($EV.ID118.HighCurrentControl == 1 && $EV.ID110.HighCurrentControl == 1)
      return $EV.ID118.PresentChargingCurrentExtended;
    else
      return $CHAdeMO::Simulation::EV.ID109.PresentChargingCurrent;
  }
}

/// <General>
export long HV_source_set_I_DC(double current)
{
  return 0;
}

/// <General>
export long HV_source_set_U_DC(double voltage)
{
  return 0;
}

/// <General>
ST_Init()
{
  if(@sysvar::SampleConfiguration::EV::Control::SysEV_Schema == @SampleConfiguration::EV::Control::SysEV_Schema::CHAdeMO_30)
  {
    //VT-System Settings for CHAdeMO 3x
    VT_CHAdeMO_2x_Reset(); 
    VT_CHAdeMO_3x_Init();
  }
  else
  {
    //VT-System Settings for CHAdeMO 0.9 - 2.x and BackwardCompatibility
    VT_CHAdeMO_3x_Reset();
    VT_CHAdeMO_2x_Init();
  }
}

/// <General>
ST_Reset()
{
  VT_CHAdeMO_2x_Reset();
  VT_CHAdeMO_3x_Reset();
}

/// <General>
ST_PlugIn()
{
  if(@sysvar::SampleConfiguration::EV::Control::SysEV_Schema == @SampleConfiguration::EV::Control::SysEV_Schema::CHAdeMO_30)
  {
    VT_CHAdeMO_3x_PlugIn();
  }
  else
  {
    VT_CHAdeMO_2x_PlugIn();
    
    if(isSimulated())
     $CHAdeMO::Simulation::EV.CS = 1.5; //simulated plug in for CHAdeMO <= 2.x
  }
  
}

/// <General>
ST_PlugOut()
{
  if(@sysvar::SampleConfiguration::EV::Control::SysEV_Schema == @SampleConfiguration::EV::Control::SysEV_Schema::CHAdeMO_30)
  {
    VT_CHAdeMO_3x_PlugOut();
  }
  else
  {
    VT_CHAdeMO_2x_PlugOut();
    
    if(isSimulated())
      $CHAdeMO::Simulation::EV.CS = 0; //simulated plug out for CHAdeMO <= 2.x
  }
}

/**********************************************************************************************************************
 *  CHAdeMO 2.x
 *********************************************************************************************************************/

/// <CHAdeMO_2>
VT_CHAdeMO_2x_Init()
{
  if(!isSimulated())
  {
    //EV VT2004 Channel 1 (CSS1)
    
    //Bus Bar
    @sysvar::VTS::EV_VT2004_Ch1::RelayBusBar1A = 0;
    @sysvar::VTS::EV_VT2004_Ch1::RelayBusBar1B = 0;
    @sysvar::VTS::EV_VT2004_Ch1::RelayBusBar2A = 0;
    @sysvar::VTS::EV_VT2004_Ch1::RelayBusBar2B = 0;
    
    //Resistor
    sysvar::VTS::EV_VT2004_Ch1.SetStimulationMode(eVTSStimulationModeResistanceGreater);
    sysvar::VTS::EV_VT2004_Ch1.SetCurveType(eVTSCurveTypeConstant);
    @sysvar::VTS::EV_VT2004_Ch1::Resistor = 1000;
    sysvar::VTS::EV_VT2004_Ch1.StartStimulation();
    
    //original sensor
    @sysvar::VTS::EV_VT2004_Ch1::RelayOrgSensor = 0; // CSS1
    
    //EV VT2004 Channel 2 (CSS2)
    
    //Bus Bar
    @sysvar::VTS::EV_VT2004_Ch2::RelayBusBar1A = 0;
    @sysvar::VTS::EV_VT2004_Ch2::RelayBusBar1B = 0;
    @sysvar::VTS::EV_VT2004_Ch2::RelayBusBar2A = 0;
    @sysvar::VTS::EV_VT2004_Ch2::RelayBusBar2B = 0;
    
    //Resistor
    sysvar::VTS::EV_VT2004_Ch2.SetStimulationMode(eVTSStimulationModeResistanceGreater);
    sysvar::VTS::EV_VT2004_Ch2.SetCurveType(eVTSCurveTypeConstant);
    @sysvar::VTS::EV_VT2004_Ch2::Resistor = 1000;
    sysvar::VTS::EV_VT2004_Ch2.StartStimulation();
    
    //original sensor
    @sysvar::VTS::EV_VT2004_Ch2::RelayOrgSensor = 0; // CSS2
    
    //EV VT2004 Channel 3 (VCP)
    
    //Bus Bar
    @sysvar::VTS::EV_VT2004_Ch3::RelayBusBar1A = 0;
    @sysvar::VTS::EV_VT2004_Ch3::RelayBusBar1B = 0;
    @sysvar::VTS::EV_VT2004_Ch3::RelayBusBar2A = 0;
    @sysvar::VTS::EV_VT2004_Ch3::RelayBusBar2B = 0; // k
    
    //Resistor R4
    sysvar::VTS::EV_VT2004_Ch3.SetStimulationMode(eVTSStimulationModeResistanceGreater);
    sysvar::VTS::EV_VT2004_Ch3.SetCurveType(eVTSCurveTypeConstant);
    @sysvar::VTS::EV_VT2004_Ch3::Resistor = 200;
    sysvar::VTS::EV_VT2004_Ch3.StartStimulation();
    
    //original sensor
    @sysvar::VTS::EV_VT2004_Ch3::RelayOrgSensor = 0; // VCP
    
    //EV VT2004 Channel 4 (CPD)
    
    //Bus Bar
    @sysvar::VTS::EV_VT2004_Ch4::RelayBusBar1A = 1;
    @sysvar::VTS::EV_VT2004_Ch4::RelayBusBar1B = 0;
    @sysvar::VTS::EV_VT2004_Ch4::RelayBusBar2A = 0;
    @sysvar::VTS::EV_VT2004_Ch4::RelayBusBar2B = 0;
    
    //Resistor R3
    sysvar::VTS::EV_VT2004_Ch4.SetStimulationMode(eVTSStimulationModeResistanceGreater);
    sysvar::VTS::EV_VT2004_Ch4.SetCurveType(eVTSCurveTypeConstant);
    @sysvar::VTS::EV_VT2004_Ch4::Resistor = 1000;
    sysvar::VTS::EV_VT2004_Ch4.StartStimulation();
    
    //original sensor
    @sysvar::VTS::EV_VT2004_Ch4::RelayOrgSensor = 0; // CPD
  }
  else
  {
    $CHAdeMO::Simulation::EV.CS = 0; //simulated plug out for CHAdeMO <= 2.x
  }
}

/// <CHAdeMO_2>
VT_CHAdeMO_2x_Reset()
{
  if(!isSimulated())
  {
    //EV VT2004 Channel 1 (CSS1)
    
    //Bus Bar
    @sysvar::VTS::EV_VT2004_Ch1::RelayBusBar1A = 0;
    @sysvar::VTS::EV_VT2004_Ch1::RelayBusBar1B = 0;
    @sysvar::VTS::EV_VT2004_Ch1::RelayBusBar2A = 0;
    @sysvar::VTS::EV_VT2004_Ch1::RelayBusBar2B = 0;
    
    //Resistor
    sysvar::VTS::EV_VT2004_Ch1.StopStimulation();
    
    //original sensor
    @sysvar::VTS::EV_VT2004_Ch1::RelayOrgSensor = 0; // CSS1
    
    //EV VT2004 Channel 2 (CSS2)
    
    //Bus Bar
    @sysvar::VTS::EV_VT2004_Ch2::RelayBusBar1A = 0;
    @sysvar::VTS::EV_VT2004_Ch2::RelayBusBar1B = 0;
    @sysvar::VTS::EV_VT2004_Ch2::RelayBusBar2A = 0;
    @sysvar::VTS::EV_VT2004_Ch2::RelayBusBar2B = 0;
    
    //Resistor
    sysvar::VTS::EV_VT2004_Ch2.StopStimulation();
    
    //original sensor
    @sysvar::VTS::EV_VT2004_Ch2::RelayOrgSensor = 0; // CSS2
    
    //EV VT2004 Channel 3 (VCP)
    
    //Bus Bar
    @sysvar::VTS::EV_VT2004_Ch3::RelayBusBar1A = 0;
    @sysvar::VTS::EV_VT2004_Ch3::RelayBusBar1B = 0;
    @sysvar::VTS::EV_VT2004_Ch3::RelayBusBar2A = 0;
    @sysvar::VTS::EV_VT2004_Ch3::RelayBusBar2B = 0; // k
    
    //Resistor R4
    sysvar::VTS::EV_VT2004_Ch3.StopStimulation();
    
    //original sensor
    @sysvar::VTS::EV_VT2004_Ch3::RelayOrgSensor = 0; // VCP
    
    //EV VT2004 Channel 4 (CPD)
    
    //Bus Bar
    @sysvar::VTS::EV_VT2004_Ch4::RelayBusBar1A = 0;
    @sysvar::VTS::EV_VT2004_Ch4::RelayBusBar1B = 0;
    @sysvar::VTS::EV_VT2004_Ch4::RelayBusBar2A = 0;
    @sysvar::VTS::EV_VT2004_Ch4::RelayBusBar2B = 0;
    
    //Resistor R3
    sysvar::VTS::EV_VT2004_Ch4.StopStimulation();
    
    //original sensor
    @sysvar::VTS::EV_VT2004_Ch4::RelayOrgSensor = 0; // CPD
  }
}

/// <CHAdeMO_2>
VT_CHAdeMO_2x_PlugIn()
{
  if(!isSimulated())
  {
    @sysvar::VTS::EV_VT2004_Ch1::RelayOrgSensor = 1; // CSS1
    
    @sysvar::VTS::EV_VT2004_Ch2::RelayOrgSensor = 1; // CSS2
    
    @sysvar::VTS::EV_VT2004_Ch3::RelayOrgSensor = 1; // VCP
    
    @sysvar::VTS::EV_VT2004_Ch4::RelayOrgSensor = 1; // CPD
  }
  else
  {
    $CHAdeMO::Simulation::EV.CS = 1.5; //simulated plug in for CHAdeMO <= 2.x
  }
}

/// <CHAdeMO_2>
VT_CHAdeMO_2x_PlugOut()
{
  if(!isSimulated())
  {
    @sysvar::VTS::EV_VT2004_Ch1::RelayOrgSensor = 0; // CSS1
    
    @sysvar::VTS::EV_VT2004_Ch2::RelayOrgSensor = 0; // CSS2
    
    @sysvar::VTS::EV_VT2004_Ch3::RelayOrgSensor = 0; // VCP
    
    @sysvar::VTS::EV_VT2004_Ch4::RelayOrgSensor = 0; // CPD
  }
  else
  {
    $CHAdeMO::Simulation::EV.CS = 0; //simulated plug out for CHAdeMO <= 2.x
  }
}

/// <CHAdeMO_2>
export long ChangeSwitchPosition_k(int close)
{
  if(!isSimulated())
  {
    @VTS::EV_VT2004_Ch3::RelayBusBar2B = close; //close = apply PE
  }
  
  return 0;
}

/// <CHAdeMO_2>
on sysvar sysvar::VTS::EV_VT2816_Ch1::AvgVoltage // CSS1
{
  $CHAdeMO::Simulation::EV.CP =  @this; // opto-coupler f
}

/// <CHAdeMO_2>
on sysvar sysvar::VTS::EV_VT2816_Ch2::AvgVoltage // CSS2
{
  $CHAdeMO::Simulation::EV.CP2 =  @this; // opto-coupler g
}

/// <CHAdeMO_2>
on sysvar sysvar::VTS::EV_VT2816_Ch5::AvgVoltage // VCP
{
  $CHAdeMO::Simulation::EV.CP3 =  @this; // DP b
}

/// <CHAdeMO_2>
on sysvar sysvar::VTS::EV_VT2816_Ch6::AvgVoltage // CPD
{
  $CHAdeMO::Simulation::EV.CS =  @this;
}

/**********************************************************************************************************************
 *  CHAdeMO 3.x
 *********************************************************************************************************************/

/// <CHAdeMO_3>
VT_CHAdeMO_3x_Init()
{
  if(!isSimulated())
  {
    //EV VT2004_ChaoJi Channel 2 (CC2)
    
    //Bus Bar
    @sysvar::VTS::EV_VT2004_ChaoJi_Ch2::RelayBusBar1A = 1; // U2
    @sysvar::VTS::EV_VT2004_ChaoJi_Ch2::RelayBusBar1B = 0;
    @sysvar::VTS::EV_VT2004_ChaoJi_Ch2::RelayBusBar2A = 0;
    @sysvar::VTS::EV_VT2004_ChaoJi_Ch2::RelayBusBar2B = 0;
    
    //Resistor Rv
    sysvar::VTS::EV_VT2004_ChaoJi_Ch2.SetStimulationMode(eVTSStimulationModeResistanceGreater);
    sysvar::VTS::EV_VT2004_ChaoJi_Ch2.SetCurveType(eVTSCurveTypeConstant);
    @sysvar::VTS::EV_VT2004_ChaoJi_Ch2::Resistor = 1000;
    sysvar::VTS::EV_VT2004_ChaoJi_Ch2.StartStimulation();
    
    //original sensor
    @sysvar::VTS::EV_VT2004_ChaoJi_Ch2::RelayOrgSensor = 0; // CC2 Sv
    
    //EV VT2004_ChaoJi Channel 3 (CC1)
    
    //Bus Bar
    @sysvar::VTS::EV_VT2004_ChaoJi_Ch3::RelayBusBar1A = 0;
    @sysvar::VTS::EV_VT2004_ChaoJi_Ch3::RelayBusBar1B = 0;
    @sysvar::VTS::EV_VT2004_ChaoJi_Ch3::RelayBusBar2A = 0;
    @sysvar::VTS::EV_VT2004_ChaoJi_Ch3::RelayBusBar2B = 1;
    
    //Resistor Rg (S2' = S2 = open)
    sysvar::VTS::EV_VT2004_ChaoJi_Ch3.SetStimulationMode(eVTSStimulationModeResistanceGreater);
    sysvar::VTS::EV_VT2004_ChaoJi_Ch3.SetCurveType(eVTSCurveTypeConstant);
    @sysvar::VTS::EV_VT2004_ChaoJi_Ch3::Resistor = 100000; // Rg
    sysvar::VTS::EV_VT2004_ChaoJi_Ch3.StartStimulation();
    Switch_S2 = Switch_S2_ = 0;
    
    //original sensor
    @sysvar::VTS::EV_VT2004_ChaoJi_Ch3::RelayOrgSensor = 0; // CC1
  }
}

/// <CHAdeMO_3>
VT_CHAdeMO_3x_Reset()
{
  if(!isSimulated())
  {
    //EV VT2004_ChaoJi Channel 2 (CC2)
    
    //Bus Bar
    @sysvar::VTS::EV_VT2004_ChaoJi_Ch2::RelayBusBar1A = 0; // U2
    @sysvar::VTS::EV_VT2004_ChaoJi_Ch2::RelayBusBar1B = 0;
    @sysvar::VTS::EV_VT2004_ChaoJi_Ch2::RelayBusBar2A = 0;
    @sysvar::VTS::EV_VT2004_ChaoJi_Ch2::RelayBusBar2B = 0;
    
    //Resistor Rv
    sysvar::VTS::EV_VT2004_ChaoJi_Ch2.StopStimulation();
    
    //original sensor
    @sysvar::VTS::EV_VT2004_ChaoJi_Ch2::RelayOrgSensor = 0; // CC2 Sv
    
    //EV VT2004_ChaoJi Channel 3 (CC1)
    
    //Bus Bar
    @sysvar::VTS::EV_VT2004_ChaoJi_Ch3::RelayBusBar1A = 0;
    @sysvar::VTS::EV_VT2004_ChaoJi_Ch3::RelayBusBar1B = 0;
    @sysvar::VTS::EV_VT2004_ChaoJi_Ch3::RelayBusBar2A = 0;
    @sysvar::VTS::EV_VT2004_ChaoJi_Ch3::RelayBusBar2B = 0;
    
    //Resistor Rg (S2' = S2 = open)
    sysvar::VTS::EV_VT2004_ChaoJi_Ch3.StopStimulation();
    Switch_S2 = Switch_S2_ = 0;
    
    //original sensor
    @sysvar::VTS::EV_VT2004_ChaoJi_Ch3::RelayOrgSensor = 0; // CC1
  }
}

/// <CHAdeMO_3>
VT_CHAdeMO_3x_PlugIn()
{
  if(!isSimulated())
  {
    @sysvar::VTS::EV_VT2004_ChaoJi_Ch3::RelayOrgSensor = 1; // CC1
  }
}

/// <CHAdeMO_3>
VT_CHAdeMO_3x_PlugOut()
{
  if(!isSimulated())
  {
    @sysvar::VTS::EV_VT2004_ChaoJi_Ch3::RelayOrgSensor = 0; // CC1
  }
}

/// <CHAdeMO_3>
export long ChangeSwitchPosition_S2(int close) //only using position 2 (R4)
{
  if(!isSimulated())
  {
    if(close == 1)
    {
      if(Switch_S2_ == 1)
        @sysvar::VTS::EV_VT2004_ChaoJi_Ch3::Resistor = 873.9774562; // Rg || R4' || R4
      else
        @sysvar::VTS::EV_VT2004_ChaoJi_Ch3::Resistor = 1283.316881; // Rg || R4
    }
    else
    {
      if(Switch_S2_ == 1)
        @sysvar::VTS::EV_VT2004_ChaoJi_Ch3::Resistor = 2666.926222; // Rg || R4'
      else
        @sysvar::VTS::EV_VT2004_ChaoJi_Ch3::Resistor = 100000; // Rg
    }
    
    Switch_S2 = close;
  }
  
  return 0;
}

/// <CHAdeMO_3>
export long ChangeSwitchPosition_S2_(int close)
{
  if(!isSimulated())
  {    
    if(close == 1)
    {
      if(Switch_S2 == 1)
        @sysvar::VTS::EV_VT2004_ChaoJi_Ch3::Resistor = 873.9774562; // Rg || R4' || R4
      else
        @sysvar::VTS::EV_VT2004_ChaoJi_Ch3::Resistor = 2666.926222; // Rg || R4'
    }
    else
    {
      if(Switch_S2 == 1)
        @sysvar::VTS::EV_VT2004_ChaoJi_Ch3::Resistor = 1283.316881; // Rg || R4
      else
        @sysvar::VTS::EV_VT2004_ChaoJi_Ch3::Resistor = 100000; // Rg
    }
    
    Switch_S2_ = close;
  }
  
  return 0;
}

/// <CHAdeMO_3>
export long ChangeSwitchPosition_Sv(int close)
{
  if(!isSimulated())
  {
    @sysvar::VTS::EV_VT2004_ChaoJi_Ch2::RelayOrgSensor = close;
  }
  
  return 0;
}

/// <CHAdeMO_3>
on sysvar sysvar::VTS::EV_VT2816_Ch3::AvgVoltage // CC1
{
  $CHAdeMO::Simulation::EV.CC1 = @this; // DP 2
}

/// <CHAdeMO_3>
on sysvar sysvar::VTS::EV_VT2816_Ch4::AvgVoltage // CC2
{
  $CHAdeMO::Simulation::EV.CC2 =  @this; // DP 3
}