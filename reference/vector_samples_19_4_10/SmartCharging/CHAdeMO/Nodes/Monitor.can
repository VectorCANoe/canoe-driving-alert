/*@!Encoding:1252*/
includes
{ 
}

variables
{
}

/**********************************************************************************************************************
 *  shared file which is used to synchronize the protocol versions of ev and evse
 *********************************************************************************************************************/

on sysvar SampleConfiguration::EV::Control::SysEV_Connected
{
  if(@this == 1)
  {
    if( (@SampleConfiguration::EV::Control::SysEV_Schema == @SampleConfiguration::EV::Control::SysEV_Schema::CHAdeMO_30 ) &&
        (@SampleConfiguration::EVSE::Control::SysEVSE_Schema != @SampleConfiguration::EVSE::Control::SysEVSE_Schema::CHAdeMO_30) )
    {
      writeLineEx(0, 3, "Incompatible protocol version set. Please use 'BackwardCompatibility' instead of CHAdeMO 3.0 to connect with an CHAdeMO 2.x charger'");
    }
    else if( (@SampleConfiguration::EV::Control::SysEV_Schema != @SampleConfiguration::EV::Control::SysEV_Schema::CHAdeMO_30 ) &&
             (@SampleConfiguration::EV::Control::SysEV_Schema != @SampleConfiguration::EV::Control::SysEV_Schema::BackwardCompatibility ) &&
             (@SampleConfiguration::EVSE::Control::SysEVSE_Schema == @SampleConfiguration::EVSE::Control::SysEVSE_Schema::CHAdeMO_30) )
    {
      writeLineEx(0, 3, "Incompatible protocol version set. Please use 'BackwardCompatibility' or CHAdeMO 3.0 to connect with an CHAdeMO 3.0 charger'");
    }
  }
}

/**********************************************************************************************************************
 *  EVSE Sysvar-Mapping
 *********************************************************************************************************************/
on value_change CHAdeMO::Simulation::EV.CP3
{
  if (isSimulated())
  {
    $CHAdeMO::Simulation::EVSE.CP3 = $this;
  }  
}

on value_change CHAdeMO::Simulation::EV.CC1
{
  if (isSimulated())
  {
    $CHAdeMO::Simulation::EVSE.CC1 = $this;
  }  
}

on value_change CHAdeMO::Simulation::EV.CC2
{
  if (isSimulated())
  {
    $CHAdeMO::Simulation::EVSE.CC2 = $this;
  }  
}

on value_change CHAdeMO::Simulation::EV.CS
{
  if (isSimulated())
  {
    $CHAdeMO::Simulation::EVSE.CS = $this;
  }  
}

/**********************************************************************************************************************
 *  EV Sysvar-Mapping
 *********************************************************************************************************************/
on value_change CHAdeMO::Simulation::EVSE.CP
{
  if (isSimulated())
  {
    $CHAdeMO::Simulation::EV.CP = $this;
  }  
}

on value_change CHAdeMO::Simulation::EVSE.CP2
{
  if (isSimulated())
  {
    $CHAdeMO::Simulation::EV.CP2 = $this;
  }  
}

on value_change CHAdeMO::Simulation::EVSE.CC1
{
  if (isSimulated())
  {
    $CHAdeMO::Simulation::EV.CC1 = $this;
  }  
}

on value_change CHAdeMO::Simulation::EVSE.CC2
{
  if (isSimulated())
  {
    $CHAdeMO::Simulation::EV.CC2 = $this;
  }  
}