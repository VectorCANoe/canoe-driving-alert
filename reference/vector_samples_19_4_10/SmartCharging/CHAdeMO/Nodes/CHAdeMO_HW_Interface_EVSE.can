/*@!Encoding:1252*/
includes
{
  
}

variables
{
  long hvSourceOutput = 0;
}

/// <General>
export long ST_Reset()
{
  if(@sysvar::SampleConfiguration::EVSE::Control::SysEVSE_Schema == @SampleConfiguration::EVSE::Control::SysEVSE_Schema::CHAdeMO_30)
  {
    //VT-System Settings for CHAdeMO 3x    
    VT_CHAdeMO_3x_Reset(); 
  }
  else
  {
    //VT-System Settings for CHAdeMO 0.9 - 2.x
    VT_CHAdeMO_2x_Reset();
  }
  
  return 0;
}

/// <General>
export long HV_source_set_I_DC(double current)
{
  $CHAdeMO::Simulation::EVSE.providedIdc = current;
  return 0;
}

/// <General>
export long HV_source_set_U_DC(double voltage)
{
  $CHAdeMO::Simulation::EVSE.providedVdc = voltage;
  if(HV_source_get_output())
    @SampleConfiguration::EVSE::VeriVolt = voltage;
  return 0;
}

/// <General>
export double HV_measure_DC_U()
{  
  return $CHAdeMO::Simulation::EVSE.providedVdc;
}

/// <General>
export double HV_measure_DC_U_VeriVolt()
{
  if($EVSE.ID102.VehicleStatus.IsValid) //CHAdeMO version > 0.9
  {
    //without real HW for voltage measurement, just assume the target battery voltage is applied as soon as the EV closes its contactors
    if($EVSE.ID102.VehicleStatus == _CHAdeMO::DataTypes::parVehicleStatusType::close)
      @SampleConfiguration::EVSE::VeriVolt = $EVSE.ID102.TargetBatteryVoltage;
    else
      @SampleConfiguration::EVSE::VeriVolt = 0;
  }
  else  //using CHAdeMO 0.9
  {
    //within CHadeMO 0.9 there is no flag indicating EV contactor status
    //EV must have contactors closed before requesting current so assume target battery voltage 
    if($EVSE.ID102.ChargingCurrentRequest > 0)
      @SampleConfiguration::EVSE::VeriVolt = $EVSE.ID102.TargetBatteryVoltage;
    else
      @SampleConfiguration::EVSE::VeriVolt = 0;
  }
  
  return @SampleConfiguration::EVSE::VeriVolt;
}

/// <General>
export double HV_measure_DC_I()
{
  return $CHAdeMO::Simulation::EVSE.providedIdc;
}

/// <General>
export long HV_source_set_output(long enabled)
{
  hvSourceOutput = enabled;
  return 0;
}

/// <General>
export long HV_source_get_output()
{
  return hvSourceOutput;
}

/// <General>
export long HV_source_perform_welding()
{
  return 0;
}

/// <General>
export long HV_set_isolation_state(int enable)
{
  return 0;
}

/// <General>
ST_Init()
{
  if(@sysvar::SampleConfiguration::EVSE::Control::SysEVSE_Schema == @SampleConfiguration::EVSE::Control::SysEVSE_Schema::CHAdeMO_30)
  {
    //VT-System Settings for CHAdeMO 3x
    VT_CHAdeMO_2x_Reset();
    VT_CHAdeMO_3x_Init(); 
  }
  else
  {
    //VT-System Settings for CHAdeMO 0.9 - 2.x
    VT_CHAdeMO_3x_Reset();
    VT_CHAdeMO_2x_Init();
  }
  
  ST_PlugIn();
}

/// <General>
ST_PlugIn()
{
  if(@sysvar::SampleConfiguration::EVSE::Control::SysEVSE_Schema == @SampleConfiguration::EVSE::Control::SysEVSE_Schema::CHAdeMO_30)
  {
    //VT-System Settings for CHAdeMO 3x
    VT_CHAdeMO_3x_PlugIn(); 
  }
  else
  {
    //VT-System Settings for CHAdeMO 0.9 - 2.x
    VT_CHAdeMO_2x_PlugIn();
    
    if(isSimulated())
      $CHAdeMO::Simulation::EVSE.CP3 = 12; //simulated plug in CHAdeMO <= 2.x 
  }
}

/// <General>
ST_PlugOut()
{
  if(@sysvar::SampleConfiguration::EVSE::Control::SysEVSE_Schema == @SampleConfiguration::EVSE::Control::SysEVSE_Schema::CHAdeMO_30)
  {
    //VT-System Settings for CHAdeMO 3x
    VT_CHAdeMO_3x_PlugOut(); 
  }
  else
  {
    //VT-System Settings for CHAdeMO 0.9 - 2.x
    VT_CHAdeMO_2x_PlugOut();
    
    if(isSimulated())
      $CHAdeMO::Simulation::EVSE.CP3 = 0; //simulated plug out CHAdeMO <= 2.x 
  }
}

/**********************************************************************************************************************
 *  CHAdeMO 2.x
 *********************************************************************************************************************/

/// <CHAdeMO_2>
VT_CHAdeMO_2x_Init()
{
  if(!isSimulated())
  {        
    //EVSE VT2004 Channel 1
    
    //Bus Bar
    @sysvar::VTS::EVSE_VT2004_Ch1::RelayBusBar1A = 0;
    @sysvar::VTS::EVSE_VT2004_Ch1::RelayBusBar1B = 0;
    @sysvar::VTS::EVSE_VT2004_Ch1::RelayBusBar2A = 0;
    @sysvar::VTS::EVSE_VT2004_Ch1::RelayBusBar2B = 0;
        
    //EVSE VT2004 Channel 2
    
    //Bus Bar
    @sysvar::VTS::EVSE_VT2004_Ch2::RelayBusBar1A = 0;
    @sysvar::VTS::EVSE_VT2004_Ch2::RelayBusBar1B = 0;
    @sysvar::VTS::EVSE_VT2004_Ch2::RelayBusBar2A = 0;
    @sysvar::VTS::EVSE_VT2004_Ch2::RelayBusBar2B = 1;
    
    //Resistor R1
    sysvar::VTS::EVSE_VT2004_Ch2.SetStimulationMode(eVTSStimulationModeResistanceGreater);
    sysvar::VTS::EVSE_VT2004_Ch2.SetCurveType(eVTSCurveTypeConstant);
    @sysvar::VTS::EVSE_VT2004_Ch2::Resistor = 200;
    sysvar::VTS::EVSE_VT2004_Ch2.StartStimulation();
    
    //original sensor
    @sysvar::VTS::EVSE_VT2004_Ch2::RelayOrgSensor = 0; //CPD
    
    //EVSE VT2004 Channel 3
    
    //Bus Bar
    @sysvar::VTS::EVSE_VT2004_Ch3::RelayBusBar1A = 1;
    @sysvar::VTS::EVSE_VT2004_Ch3::RelayBusBar1B = 0;
    @sysvar::VTS::EVSE_VT2004_Ch3::RelayBusBar2A = 0;
    @sysvar::VTS::EVSE_VT2004_Ch3::RelayBusBar2B = 0;    
    
    //Resistor R2
    sysvar::VTS::EVSE_VT2004_Ch3.SetStimulationMode(eVTSStimulationModeResistanceGreater);
    sysvar::VTS::EVSE_VT2004_Ch3.SetCurveType(eVTSCurveTypeConstant);
    @sysvar::VTS::EVSE_VT2004_Ch3::Resistor = 1000;
    sysvar::VTS::EVSE_VT2004_Ch3.StartStimulation();
    
    //original sensor
    @sysvar::VTS::EVSE_VT2004_Ch3::RelayOrgSensor = 0;
  }
}

/// <CHAdeMO_2>
VT_CHAdeMO_2x_Reset()
{
  if(!isSimulated())
  {        
    //EVSE VT2004 Channel 1
    
    //Bus Bar
    @sysvar::VTS::EVSE_VT2004_Ch1::RelayBusBar1A = 0;
    @sysvar::VTS::EVSE_VT2004_Ch1::RelayBusBar1B = 0;
    @sysvar::VTS::EVSE_VT2004_Ch1::RelayBusBar2A = 0;
    @sysvar::VTS::EVSE_VT2004_Ch1::RelayBusBar2B = 0;
        
    //EVSE VT2004 Channel 2
    
    //Bus Bar
    @sysvar::VTS::EVSE_VT2004_Ch2::RelayBusBar1A = 0;
    @sysvar::VTS::EVSE_VT2004_Ch2::RelayBusBar1B = 0;
    @sysvar::VTS::EVSE_VT2004_Ch2::RelayBusBar2A = 0;
    @sysvar::VTS::EVSE_VT2004_Ch2::RelayBusBar2B = 0;
    
    //Resistor R1
    sysvar::VTS::EVSE_VT2004_Ch2.StopStimulation();
    
    //original sensor
    @sysvar::VTS::EVSE_VT2004_Ch2::RelayOrgSensor = 0; //CPD
    
    //EVSE VT2004 Channel 3
    
    //Bus Bar
    @sysvar::VTS::EVSE_VT2004_Ch3::RelayBusBar1A = 0;
    @sysvar::VTS::EVSE_VT2004_Ch3::RelayBusBar1B = 0;
    @sysvar::VTS::EVSE_VT2004_Ch3::RelayBusBar2A = 0;
    @sysvar::VTS::EVSE_VT2004_Ch3::RelayBusBar2B = 0;    
    
    //Resistor R2
    sysvar::VTS::EVSE_VT2004_Ch3.StopStimulation();
    
    //original sensor
    @sysvar::VTS::EVSE_VT2004_Ch3::RelayOrgSensor = 0;
  }
}

/// <CHAdeMO_2>
VT_CHAdeMO_2x_PlugIn()
{
  if(!isSimulated())
  {
    @sysvar::VTS::EVSE_VT2004_Ch2::RelayOrgSensor = 1; //CPD
    
    @sysvar::VTS::EVSE_VT2004_Ch3::RelayOrgSensor = 1; //VCP
  }
}

/// <CHAdeMO_2>
VT_CHAdeMO_2x_PlugOut()
{
  if(!isSimulated())
  {
    @sysvar::VTS::EVSE_VT2004_Ch2::RelayOrgSensor = 0; //CPD
    
    @sysvar::VTS::EVSE_VT2004_Ch3::RelayOrgSensor = 0; //VCP
  }
}

/// <CHAdeMO_2>
export long ChangeSwitchPosition_d1(int close)
{
  if(!isSimulated())
  {
    if(close == 1)
      $CHAdeMO::Simulation::EVSE.CP = 12; //Own voltage is not measured back, assumption of correct value
    else
      $CHAdeMO::Simulation::EVSE.CP = 0;
    
    @VTS::EVSE_VT2004_Ch1::RelayBusBar1A = close; //apply 12V
  }
  
  return 0;
}

/// <CHAdeMO_2>
export long ChangeSwitchPosition_d2(int close)
{
  if(!isSimulated())
  {
    if(close == 1)
      $CHAdeMO::Simulation::EVSE.CP2 = 12; //Own voltage is not measured back, assumption of correct value
    else
      $CHAdeMO::Simulation::EVSE.CP2 = 0;
    
    @VTS::EVSE_VT2004_Ch1::RelayBusBar2B = close; //apply PE
  }
  
  return 0;
}

/// <CHAdeMO_2>
on sysvar sysvar::VTS::EVSE_VT2816_Ch1::AvgVoltage // VCP (DP a)
{  
  $CHAdeMO::Simulation::EVSE.CP3 = @this;
}


/// <CHAdeMO_2>
on sysvar sysvar::VTS::EVSE_VT2816_Ch4::AvgVoltage // CPD
{
  $CHAdeMO::Simulation::EVSE.CS = @this;
}

/**********************************************************************************************************************
 *  CHAdeMO 3.x
 *********************************************************************************************************************/

/// <CHAdeMO_3>
VT_CHAdeMO_3x_Init()
{
  if(!isSimulated())
  {
    //EVSE VT2004_ChaoJi Channel 1
    
    //Bus Bar
    @sysvar::VTS::EVSE_VT2004_ChaoJi_Ch1::RelayBusBar1A = 0;
    @sysvar::VTS::EVSE_VT2004_ChaoJi_Ch1::RelayBusBar1B = 0;
    @sysvar::VTS::EVSE_VT2004_ChaoJi_Ch1::RelayBusBar2A = 0;
    @sysvar::VTS::EVSE_VT2004_ChaoJi_Ch1::RelayBusBar2B = 1;
    
    //Resistor Rc
    sysvar::VTS::EVSE_VT2004_ChaoJi_Ch1.SetStimulationMode(eVTSStimulationModeResistanceGreater);
    sysvar::VTS::EVSE_VT2004_ChaoJi_Ch1.SetCurveType(eVTSCurveTypeConstant);
    @sysvar::VTS::EVSE_VT2004_ChaoJi_Ch1::Resistor = 1000;
    sysvar::VTS::EVSE_VT2004_ChaoJi_Ch1.StartStimulation();
    
    //original sensor
    @sysvar::VTS::EVSE_VT2004_ChaoJi_Ch1::RelayOrgSensor = 0;
    
    //EVSE VT2004_ChaoJi Channel 3
    
    //Bus Bar
    @sysvar::VTS::EVSE_VT2004_ChaoJi_Ch3::RelayBusBar1A = 0;  //S0 open
    @sysvar::VTS::EVSE_VT2004_ChaoJi_Ch3::RelayBusBar1B = 0;
    @sysvar::VTS::EVSE_VT2004_ChaoJi_Ch3::RelayBusBar2A = 0;
    @sysvar::VTS::EVSE_VT2004_ChaoJi_Ch3::RelayBusBar2B = 0;
    
    //Resistor R1 and R1' = S1 open
    sysvar::VTS::EVSE_VT2004_ChaoJi_Ch3.SetStimulationMode(eVTSStimulationModeResistanceGreater);
    sysvar::VTS::EVSE_VT2004_ChaoJi_Ch3.SetCurveType(eVTSCurveTypeConstant);
    @sysvar::VTS::EVSE_VT2004_ChaoJi_Ch3::Resistor = 11000;
    sysvar::VTS::EVSE_VT2004_ChaoJi_Ch3.StartStimulation();
    
    //EVSE VT2004_ChaoJi Channel 4 (optional GBT)
    
    //Bus Bar
    @sysvar::VTS::EVSE_VT2004_ChaoJi_Ch4::RelayBusBar1A = 0;
    @sysvar::VTS::EVSE_VT2004_ChaoJi_Ch4::RelayBusBar1B = 0;
    @sysvar::VTS::EVSE_VT2004_ChaoJi_Ch4::RelayBusBar2A = 0;
    @sysvar::VTS::EVSE_VT2004_ChaoJi_Ch4::RelayBusBar2B = 0;  //S3 open
    
    //Resistor R2
    sysvar::VTS::EVSE_VT2004_ChaoJi_Ch4.SetStimulationMode(eVTSStimulationModeResistanceGreater);
    sysvar::VTS::EVSE_VT2004_ChaoJi_Ch4.SetCurveType(eVTSCurveTypeConstant);
    @sysvar::VTS::EVSE_VT2004_ChaoJi_Ch4::Resistor = 100000;
    sysvar::VTS::EVSE_VT2004_ChaoJi_Ch4.StartStimulation();
    
    //original sensor
    @sysvar::VTS::EVSE_VT2004_ChaoJi_Ch4::RelayOrgSensor = 0;
  }
}

/// <CHAdeMO_3>
VT_CHAdeMO_3x_Reset()
{
  if(!isSimulated())
  {
    //EVSE VT2004_ChaoJi Channel 1
    
    //Bus Bar
    @sysvar::VTS::EVSE_VT2004_ChaoJi_Ch1::RelayBusBar1A = 0;
    @sysvar::VTS::EVSE_VT2004_ChaoJi_Ch1::RelayBusBar1B = 0;
    @sysvar::VTS::EVSE_VT2004_ChaoJi_Ch1::RelayBusBar2A = 0;
    @sysvar::VTS::EVSE_VT2004_ChaoJi_Ch1::RelayBusBar2B = 0;
    
    //Resistor Rc
    sysvar::VTS::EVSE_VT2004_ChaoJi_Ch1.StopStimulation();
    
    //original sensor
    @sysvar::VTS::EVSE_VT2004_ChaoJi_Ch1::RelayOrgSensor = 0;
    
    //EVSE VT2004_ChaoJi Channel 3
    
    //Bus Bar
    @sysvar::VTS::EVSE_VT2004_ChaoJi_Ch3::RelayBusBar1A = 0;  //S0 open
    @sysvar::VTS::EVSE_VT2004_ChaoJi_Ch3::RelayBusBar1B = 0;
    @sysvar::VTS::EVSE_VT2004_ChaoJi_Ch3::RelayBusBar2A = 0;
    @sysvar::VTS::EVSE_VT2004_ChaoJi_Ch3::RelayBusBar2B = 0;
    
    //Resistor R1 and R1' = S1 open
    sysvar::VTS::EVSE_VT2004_ChaoJi_Ch3.StopStimulation();
    
    //EVSE VT2004_ChaoJi Channel 4 (optional GBT)
    
    //Bus Bar
    @sysvar::VTS::EVSE_VT2004_ChaoJi_Ch4::RelayBusBar1A = 0;
    @sysvar::VTS::EVSE_VT2004_ChaoJi_Ch4::RelayBusBar1B = 0;
    @sysvar::VTS::EVSE_VT2004_ChaoJi_Ch4::RelayBusBar2A = 0;
    @sysvar::VTS::EVSE_VT2004_ChaoJi_Ch4::RelayBusBar2B = 0;  //S3 open
    
    //Resistor R2
    sysvar::VTS::EVSE_VT2004_ChaoJi_Ch4.StopStimulation();
    
    //original sensor
    @sysvar::VTS::EVSE_VT2004_ChaoJi_Ch4::RelayOrgSensor = 0;
  }
}

/// <CHAdeMO_3>
VT_CHAdeMO_3x_PlugIn()
{
  if(!isSimulated())
  {
    //original sensor
    @sysvar::VTS::EVSE_VT2004_ChaoJi_Ch1::RelayOrgSensor = 1; //CC1
    
    //original sensor
    @sysvar::VTS::EVSE_VT2004_ChaoJi_Ch4::RelayOrgSensor = 1; //CC2
  }
}

/// <CHAdeMO_3>
VT_CHAdeMO_3x_PlugOut()
{
  if(!isSimulated())
  {
    //original sensor
    @sysvar::VTS::EVSE_VT2004_ChaoJi_Ch1::RelayOrgSensor = 0; //CC1
    
    //original sensor
    @sysvar::VTS::EVSE_VT2004_ChaoJi_Ch4::RelayOrgSensor = 0; //CC2
  }
}

/// <CHAdeMO_3>
export long ChangeSwitchPosition_S1(int close)
{
  if(!isSimulated())
  {
    if(close == 1)
    {
      //Resistor R1 = S1 closed
      sysvar::VTS::EVSE_VT2004_ChaoJi_Ch3.SetStimulationMode(eVTSStimulationModeResistanceGreater);
      sysvar::VTS::EVSE_VT2004_ChaoJi_Ch3.SetCurveType(eVTSCurveTypeConstant);
      @sysvar::VTS::EVSE_VT2004_ChaoJi_Ch3::Resistor = 1000;
      sysvar::VTS::EVSE_VT2004_ChaoJi_Ch3.StartStimulation();
    }
    else
    {
      //Resistor R1 and R1' = S1 open
      sysvar::VTS::EVSE_VT2004_ChaoJi_Ch3.SetStimulationMode(eVTSStimulationModeResistanceGreater);
      sysvar::VTS::EVSE_VT2004_ChaoJi_Ch3.SetCurveType(eVTSCurveTypeConstant);
      @sysvar::VTS::EVSE_VT2004_ChaoJi_Ch3::Resistor = 11000;
      sysvar::VTS::EVSE_VT2004_ChaoJi_Ch3.StartStimulation();
    }
  }
  
  return 0;
}

/// <CHAdeMO_3>
export long ChangeSwitchPosition_S0(int close)
{
  if(!isSimulated())
  {
    @sysvar::VTS::EVSE_VT2004_ChaoJi_Ch3::RelayBusBar1A = close;
  }
  
  return 0;
}

/// <CHAdeMO_3>
on sysvar sysvar::VTS::EVSE_VT2816_Ch2::AvgVoltage // CC1 (DP 1)
{
  $CHAdeMO::Simulation::EVSE.CC1 = @this;
}

/// <CHAdeMO_3>
on sysvar sysvar::VTS::EVSE_VT2816_Ch3::AvgVoltage // CC2 (DP 4)
{
  $CHAdeMO::Simulation::EVSE.CC2 = @this;
}