/*@!Encoding:1252*/
includes
{
  #include "CHAdeMO_HW_Interface_EVSE.can"
}

variables
{
  char gPanelName[5] = "EVSE";
  char btnEVSE_StopCharging[22] = "btn_EVSE_StopCharging";

  msTimer timerIdc_Vdc_Simulation;
  int cCyclicTime = 10;
  
  int cHardwareDelay = 50;
  
  //CHAdeMO 3.0
  float TargetCC1Voltage = 0.0;
  msTimer SetVoltage_CC1;
  
  //CHAdeMO 2.x
  float TargetCPVoltage = 0.0;
  float TargetCP2Voltage = 0.0;
  
  msTimer SetVoltage_CP;
  msTimer SetVoltage_CP2;
  
  msTimer WeldingDetectionFinish;
  
  int isSimulationRunning = 0;
  enum eMode
  {
    Ready = 0,
    Charging = 1,
    Error = 2
  };
  
  enum eMode Mode = Ready;
  msTimer timerReStart;
  const delayRestart = 100;
  int connected = 0;

  const double cMinimumCurrentDuringInsulationTest = 1.5;
  
  msTimer retryOpenHVContactorsAfterChargeLoop;
  msTimer retryCloseHVContactorsForChargeLoop;
  msTimer retryOpenHVContactorsAfterInsulationtest;
  msTimer retryCloseHVContactorsForInsulationtest;
  const cRetryOpenCloseHVContactorsDelay = 100;
  
  msTimer openHVonMeasurementStop;
  const cOpenHVonMeasurementStopDelay = 500;
  msTimer actionsAfterContactorOpen;
  const cActionsAfterContactorOpenDelay = 100;
  
  const cMaximumVoltageOnOutputCircuit = 30;
  const cMaximumCurrentOnOutputCircuit = 5;
  const cVoltageDeviationForClosingContactors = 10;
  
  msTimer tEnableIsolationMonitoring;
}

/**********************************************************************************************************************
 *  ON START/STOP
 *********************************************************************************************************************/
on prestart
{
  CheckCurrentValueValid(sysvar::SampleConfiguration::EVSE::SysEVSE_MaxCurrent);
  if(@SampleConfiguration::EVSE::HighCurrentControl == 1)
    SetAttributeAndCheckReturnValue("CHAdeMOBinding::EVSE::MaximumOutputCurrentExtended", @sysvar::SampleConfiguration::EVSE::SysEVSE_MaxCurrent);
  else
    SetAttributeAndCheckReturnValue("CHAdeMOBinding::EVSE::MaximumOutputCurrent", @sysvar::SampleConfiguration::EVSE::SysEVSE_MaxCurrent);
  
  CheckVoltageValueValid(sysvar::SampleConfiguration::EVSE::SysEVSE_MaxVoltage);
  SetAttributeAndCheckReturnValue("CHAdeMOBinding::EVSE::AvailableOutputVoltage", @sysvar::SampleConfiguration::EVSE::SysEVSE_MaxVoltage);
  
  SetAttributeAndCheckReturnValue("CHAdeMOBinding::DynamicControl", @SampleConfiguration::EVSE::DynamicControl);
  SetAttributeAndCheckReturnValue("CHAdeMOBinding::HighCurrent", @SampleConfiguration::EVSE::HighCurrentControl);
  SetAttributeAndCheckReturnValue("CHAdeMOBinding::HighVoltage", @SampleConfiguration::EVSE::HighVoltageControl);
  SetAttributeAndCheckReturnValue("CHAdeMOBinding::DischargePossible", @SampleConfiguration::EVSE::Discharge);
  
  isSimulationRunning = 0;
}

on start
{
  Set_ProtocolVersion_EVSE(@sysvar::SampleConfiguration::EVSE::Control::SysEVSE_Schema);
  Set_IgnoreConnectorProximityDetection(@SampleConfiguration::EVSE::Control::IgnoreCPDdetection);
  @sysvar::Common::SysProtocolBar = 0;
  HV_source_set_U_DC(0);

  Reset_EVSE_Values();  
  /* disable Stop-Button */
  enableControl(gPanelName, btnEVSE_StopCharging, 0);
  @sysvar::SampleConfiguration::EVSE::SysEVSE_StopCharging = 2;
  ST_Init(); //VT-System Settings
  timerReStart.set(delayRestart);
}

on preStop
{
  if(HV_source_get_output() == 1)
  {
    deferStop(1000);
    setTimer(openHVonMeasurementStop, cOpenHVonMeasurementStopDelay);    
  }
  
  StopReaction();
}

on timer openHVonMeasurementStop
{
  HV_source_set_output(0);
  setTimer(actionsAfterContactorOpen, cActionsAfterContactorOpenDelay);
}

on timer actionsAfterContactorOpen
{
  HV_source_set_U_DC(0);
  ST_Reset();
}

on timer tEnableIsolationMonitoring
{
  HV_set_isolation_state(1);
}

StopReaction()
{
  HV_source_set_I_DC(0);
  
  if(HV_source_get_output() == 1)
    HV_source_set_U_DC(HV_measure_DC_U_VeriVolt());
  else
    HV_source_set_U_DC(0);
  
  ST_Reset();
  Reset_EVSE_Values();
  CancelAllTimer();
  EVSE.ResetSimulation.Call();
  SetChargingStationPicturesVisibility(Ready);
}

CancelAllTimer()
{
  cancelTimer(timerIdc_Vdc_Simulation);
  cancelTimer(SetVoltage_CC1);
  cancelTimer(SetVoltage_CP);
  cancelTimer(SetVoltage_CP2);
  cancelTimer(WeldingDetectionFinish);  
}

/**********************************************************************************************************************
 *  ON SYSVAR
 *********************************************************************************************************************/

on sysvar SampleConfiguration::EVSE::Control::SysEVSE_Schema
{
  if($EVSE.SpecificationState <= _CHAdeMO::DataTypes::SpecificationStateType::State_B)
  {
    ST_Init();
    Set_ProtocolVersion_EVSE(@this);
    Connected(0);
  }
}

on sysvar SampleConfiguration::EVSE::Control::IgnoreCPDdetection
{
  Set_IgnoreConnectorProximityDetection(@this);
}

on sysVar SampleConfiguration::EVSE::Control::SysEVSE_Reset
{
  if(@this == 1 && connected == 0)
  {
    EVSE.ResetSimulation.Call();
    @sysvar::SampleConfiguration::EVSE::SysEVSE_SimState = @SampleConfiguration::EVSE::SysEVSE_SimState::Error;
    SetChargingStationPicturesVisibility(Ready);
    setTimer(timerReStart, delayRestart);
  }
  else if(@this == 1 && connected == 1)
  {
    @SampleConfiguration::EVSE::SysEVSE_StopCharging = 1;
  }
  
  @this = 0;
}

on sysvar SampleConfiguration::EVSE::SysEVSE_Enable
{
  if(@this == 1 && connected == 0)
    timerReStart.set(delayRestart);
}

on timer timerReStart
{
  @SampleConfiguration::EVSE::SysEVSE_Enable = 1;
  ST_Init();
  Connected(1);
  SetChargingStationPicturesVisibility(Ready);
}

Connected(int plugInDetected)
{
  if (plugInDetected == 1)
  {
    // Start Simulation
    EVSE.StartSimulation.Call();
    @sysvar::SampleConfiguration::EVSE::SysEVSE_SimState = @SampleConfiguration::EVSE::SysEVSE_SimState::OK;
    connected = 1;
  }
  else
  {
    ST_PlugOut();
    Reset_EVSE_Values();
    EVSE.ResetSimulation.Call();
    Stop_Idc_Vdc_Simulation();
    @sysvar::SampleConfiguration::EVSE::SysEVSE_SimState = @SampleConfiguration::EVSE::SysEVSE_SimState::Error;
    connected = 0;
    ST_Init(); //VT-System Settings
    @SampleConfiguration::EVSE::SysEVSE_Enable = 0;
  }
}

on sysVar SampleConfiguration::EVSE::SysEVSE_StopCharging
{
  if (@this == 1)
  {
    $CHAdeMO::Simulation::EVSE.ID109.ChargingStopControl = 1;
  }
}

on sysVar SampleConfiguration::EVSE::Control::SysEVSE_ReturnFailed
{  
  if (@this == 1)
  {
    $CHAdeMO::Simulation::EVSE.ID109.ChargerError = 1;
    SetChargingStationPicturesVisibility(Error);
  }
}

on sysVar SampleConfiguration::EVSE::SysEVSE_MaxVoltage
{ 
  CheckVoltageValueValid(this);
  SetAttributeAndCheckReturnValue("CHAdeMOBinding::EVSE::AvailableOutputVoltage", @this);
}

on sysVar SampleConfiguration::EVSE::SysEVSE_MaxCurrent
{
  CheckCurrentValueValid(this);
  
  if(@SampleConfiguration::EVSE::HighCurrentControl == 1)
    SetAttributeAndCheckReturnValue("CHAdeMOBinding::EVSE::MaximumOutputCurrentExtended", @sysvar::SampleConfiguration::EVSE::SysEVSE_MaxCurrent);
  else
    SetAttributeAndCheckReturnValue("CHAdeMOBinding::EVSE::MaximumOutputCurrent", @sysvar::SampleConfiguration::EVSE::SysEVSE_MaxCurrent);
  
  if($CHAdeMO::Simulation::EVSE.SpecificationState == _CHAdeMO::DataTypes::SpecificationStateType::State_E) //during charge loop
  {
    if($EVSE.ID118.DynamicControl != 1) //warning, change may lead to an error
      writeLineEx(0,2, "DynamicControl should be used to adapt MaximumOutputCurrent(-Extended) of charger during charging");
    
    if($EVSE.ID110.DynamicControl != 1) //warning, change may lead to an error
      writeLineEx(0,2, "According to message H'110, DynamicControl is not supported by vehicle");
      
    if($EVSE.ID118.HighCurrentControl == 1 && $EVSE.ID110.HighCurrentControl == 1)
      $EVSE.ID118.AvailableOutputCurrentExtended = @this;
    else
      $EVSE.ID108.AvailableOutputCurrent = @this;    
  }
}

on sysvar SampleConfiguration::EVSE::DynamicControl
{
  SetAttributeAndCheckReturnValue("CHAdeMOBinding::DynamicControl", @this);
}

on sysvar SampleConfiguration::EVSE::HighCurrentControl
{
  SetAttributeAndCheckReturnValue("CHAdeMOBinding::HighCurrent", @this);
}

on sysvar SampleConfiguration::EVSE::HighVoltageControl
{
  SetAttributeAndCheckReturnValue("CHAdeMOBinding::HighVoltage", @this);
  
  //changing high current, set the corresponding attribut for max current
  CheckCurrentValueValid(sysvar::SampleConfiguration::EVSE::SysEVSE_MaxCurrent);
  if(@this == 1)
    SetAttributeAndCheckReturnValue("CHAdeMOBinding::EVSE::MaximumOutputCurrentExtended", @sysvar::SampleConfiguration::EVSE::SysEVSE_MaxCurrent);
  else
    SetAttributeAndCheckReturnValue("CHAdeMOBinding::EVSE::MaximumOutputCurrent", @sysvar::SampleConfiguration::EVSE::SysEVSE_MaxCurrent);
}

on sysvar SampleConfiguration::EVSE::Discharge
{
  SetAttributeAndCheckReturnValue("CHAdeMOBinding::DischargePossible", @this);
}

/**********************************************************************************************************************
 *  ON DATA
 *********************************************************************************************************************/

on value_change CHAdeMO::Simulation::EVSE.ID208.PresentDischargeCurrent
{
  if(($CHAdeMO::Simulation::EVSE.ID208.PresentDischargeCurrent.impl > 0) && (@SampleConfiguration::EVSE::Discharge == 1))
    @sysvar::SampleConfiguration::EVSE::SysEVSE_PresentCurrent = - $this.impl;
}

on value_change CHAdeMO::Simulation::EVSE.ID109.PresentChargingCurrent
{
  if(($this > 0) || (@SampleConfiguration::EVSE::Discharge == 0) || ($CHAdeMO::Simulation::EVSE.ID118.PresentChargingCurrentExtended == 0 && $CHAdeMO::Simulation::EVSE.ID208.PresentDischargeCurrent.impl == 0))
    @sysvar::SampleConfiguration::EVSE::SysEVSE_PresentCurrent = $this;
}

on value_change CHAdeMO::Simulation::EVSE.ID118.PresentChargingCurrentExtended
{
  if($this > 0)
    @sysvar::SampleConfiguration::EVSE::SysEVSE_PresentCurrent = $this;
}
on value_change CHAdeMO::Simulation::EVSE.ExpectedWeldingDetectionState
{
  //Run Welding Detection  
  if($this == 1)
  {
    //$CHAdeMO::Simulation::EVSE.ID109.WeldingCheckStatusFlag = 1;
    setTimer(WeldingDetectionFinish, 1);
  }
}

on timer WeldingDetectionFinish
{
  $CHAdeMO::Simulation::EVSE.ID109.WeldingCheckStatusFlag = 1;
}

on value_change CHAdeMO::Simulation::EVSE.SpecificationState
{
  //before vehicle connection
  if($this == _CHAdeMO::DataTypes::SpecificationStateType::State_A)
  { 
    Connected(0);
    SetChargingStationPicturesVisibility(Ready);
  }

  //vehicle connected
  if($this == _CHAdeMO::DataTypes::SpecificationStateType::State_B)
  {    
    HV_set_isolation_state(1);
    setTimerCyclic(timerIdc_Vdc_Simulation, cCyclicTime);
    SetChargingStationPicturesVisibility(Charging); 
  }
 
  //start of insulation test process
  if($this == _CHAdeMO::DataTypes::SpecificationStateType::State_D) 
  {
    CloseContactorForInsulationTest(); //close contactors if voltage is OK
  }
  
  // The EVSE shall stop the charging session only in the charging loop (State E)
  if ($this == _CHAdeMO::DataTypes::SpecificationStateType::State_E)
  {
    @sysvar::SampleConfiguration::EVSE::SysEVSE_StopCharging = 0;
    enableControl(gPanelName, btnEVSE_StopCharging, 1);
  }
  else
  {
    @sysvar::SampleConfiguration::EVSE::SysEVSE_StopCharging = 2;
    enableControl(gPanelName, btnEVSE_StopCharging, 0);
  }

  //leaving charge loop
  if($this == _CHAdeMO::DataTypes::SpecificationStateType::State_F) 
  {
    Idc_Vdc_Simulation();
  }
  
  //end of communication
  if($this == _CHAdeMO::DataTypes::SpecificationStateType::State_I)
  {
    SetChargingStationPicturesVisibility(Ready);
    
    if(IsCHAdeMO3())
      Connected(0);
  }
}

/**********************************************************************************************************************
 *  HELPER FUNCTIONS
 *********************************************************************************************************************/

void Reset_EVSE_Values()
{
  @sysvar::SampleConfiguration::EVSE::SysEVSE_SimState = @SampleConfiguration::EVSE::SysEVSE_SimState::OK;
  @sysvar::SampleConfiguration::EVSE::SysEVSE_PresentCurrent = 0;
  @sysvar::SampleConfiguration::EVSE::SysEVSE_StopCharging = 0;
  TargetCC1Voltage = 0.0;
  TargetCPVoltage = 0.0;
  TargetCP2Voltage = 0.0;
  connected = 0;
}

void Set_ProtocolVersion_EVSE(dword evseSchema)
{
  SetAttributeAndCheckReturnValue("CHAdeMOBinding::EVSE::ProtocolVersion", evseSchema);
}

void Set_IgnoreConnectorProximityDetection(int ignore)
{
  SetAttributeAndCheckReturnValue("CHAdeMOBinding::IgnoreConnectorProximityDetection", ignore);
}

SetAttributeAndCheckReturnValue(char path[], dword value)
{
  int retValue;
  retValue = setAttribute(CHAdeMO::Simulation::EVSE, path, value);  
  
  if(retValue != 0) //OK
    writeLineEx(0, 3, "Unexpected return value (%d) of setAttribute '%s'", retValue, path);
}

CheckCurrentValueValid(sysvarInt* var)
{
  if(@SampleConfiguration::EVSE::HighCurrentControl == 0 && @var > 200)
  {
    writeLineEx(0,3,"Allowed range for %s 0-200[A]. Use 'HighCurrentControl' for values up to 1023[A]", var.name);
    @var = 200; //set to valid value
  }
  else if(@SampleConfiguration::EVSE::HighCurrentControl == 1 && @var > 1023)
  {
    writeLineEx(0,3,"Using 'HighCurrentControl' allowed range for %s is 0-1023[A]", var.name);
    @var = 1023; //set to valid value
  }
}

CheckVoltageValueValid(sysvarInt* var)
{
  if(@SampleConfiguration::EVSE::HighVoltageControl == 0 && @var > 600)
  {
    writeLineEx(0,3,"Allowed range for %s 0-600[V]. Use 'HighVoltageControl' for values up to 1200[V]", var.name);
    @var = 600; //set to valid value
  }
  else if(@SampleConfiguration::EVSE::HighVoltageControl == 1 && @var > 1200)
  {
    writeLineEx(0,3,"Using 'HighVoltageControl' allowed range for %s is 0-1200[V]", var.name);
    @var = 1200; //set to valid value
  }
}

void SetChargingStationPicturesVisibility(int Mode)
{
  If(Mode == Ready)
  {
   SetControlVisibility(gPanelName, "pictureChargingStationReady", 1);
   SetControlVisibility(gPanelName, "pictureChargingStationCharging", 0);
   SetControlVisibility(gPanelName, "pictureChargingStationError", 0);
  }
  else If(Mode == Charging)
  {
   SetControlVisibility(gPanelName, "pictureChargingStationReady", 0);
   SetControlVisibility(gPanelName, "pictureChargingStationCharging", 1);
   SetControlVisibility(gPanelName, "pictureChargingStationError", 0);
  }
  else If(Mode == Error)
  {
   SetControlVisibility(gPanelName, "pictureChargingStationReady", 0);
   SetControlVisibility(gPanelName, "pictureChargingStationCharging", 0);
   SetControlVisibility(gPanelName, "pictureChargingStationError", 1);
  }
}

/**********************************************************************************************************************
 *  ON TIMER
 *********************************************************************************************************************/

on timer timerIdc_Vdc_Simulation
{
  Idc_Vdc_Simulation();
}

Stop_Idc_Vdc_Simulation()
{
  cancelTimer(timerIdc_Vdc_Simulation);
  HV_source_set_I_DC(0);
  HV_source_set_U_DC(0);
}

on value_change EVSE.TargetOutputVoltage
{
  Idc_Vdc_Simulation();
}

on value_change EVSE.TargetOutputCurrent
{
  Idc_Vdc_Simulation();
}

Stop_Idc_Vdc()
{
  HV_source_set_I_DC(0);
  HV_source_set_U_DC(0);
}

Idc_Vdc_Simulation()
{
  double targetIdc, targetVdc;
  
  targetVdc = $CHAdeMO::Simulation::EVSE.TargetOutputVoltage;
  targetIdc = $CHAdeMO::Simulation::EVSE.TargetOutputCurrent;
  
  
  CheckPowerLimit(targetIdc, targetVdc);
  
   //connector lock and insulation test
  if($EVSE.SpecificationState == _CHAdeMO::DataTypes::SpecificationStateType::State_D)
  {
    if($CHAdeMO::Simulation::EVSE.d2 == 0) 
    {
      if((HV_source_get_output() == 0) && (targetVdc > 0)) //evse contactors open but insulation test shall start
      {
        CloseContactorForInsulationTest(); //close if voltage is OK
      }
      else  //contactor closed, allow mininum current to increase voltage
      {
        if(targetIdc >= cMinimumCurrentDuringInsulationTest)
          HV_source_set_I_DC(targetIdc);
        else
          HV_source_set_I_DC(cMinimumCurrentDuringInsulationTest);
        
        HV_source_set_U_DC(targetVdc);  //apply test voltage
        
        if(targetVdc == 0)  //reducing voltage so test seems to be finished, open contactors as soon as voltage is OK
          OpenContactorAfterInsulationTest();
      }
    }
    else //insulation test process finished, EV closing contactors
    {
      if(HV_source_get_output() == 1) //contactors still closed??
        OpenContactorAfterInsulationTest();
        
      //apply same voltage as in output circuit and limit the current
      HV_source_set_I_DC(cMinimumCurrentDuringInsulationTest);
      HV_source_set_U_DC(HV_measure_DC_U_VeriVolt());
    }
  }
  //charge loop
  else if($EVSE.SpecificationState == _CHAdeMO::DataTypes::SpecificationStateType::State_E)
  {
    if(HV_source_get_output() == 0) //evse contactors open
    {
      //apply same voltage as in output circuit and limit the current
      HV_source_set_I_DC(cMinimumCurrentDuringInsulationTest);
      HV_source_set_U_DC(HV_measure_DC_U_VeriVolt());
      
      //close contactors if voltage is OK
      CloseContactorForChargeLoop();
    }
    else  //evse contactors closed, charging can start apply voltage and current
    {
      HV_source_set_I_DC(targetIdc);
      HV_source_set_U_DC(targetVdc);
    }
  }
  
  //not within insulation test or charging, but evse contactors closed
  else if(HV_source_get_output() == 1)
  {
    HV_source_set_I_DC(0);
    HV_source_set_U_DC(HV_measure_DC_U_VeriVolt());
    OpenContactorsAfterChargeLoop();    
  }
  
  //not within insulation test or charging and evse contactors opened, no current or voltage needed
  else
  {
    HV_source_set_I_DC(0);
    HV_source_set_U_DC(0);
  }
  
  //get value for communication
  if($CHAdeMO::Simulation::EVSE.SpecificationState > _CHAdeMO::DataTypes::SpecificationStateType::State_B)
  {
    $CHAdeMO::Simulation::EVSE.providedVdc = HV_measure_DC_U();
    $CHAdeMO::Simulation::EVSE.providedIdc = HV_measure_DC_I();
  }
}

CheckPowerLimit(double &targetCurrentValue, double targetVoltageValue)
{
  double powerInWatts;
  powerInWatts = @SampleConfiguration::EVSE::SysEVSE_MaxPower * 1000;
  
  if((targetCurrentValue * targetVoltageValue) > powerInWatts)
  {
    targetCurrentValue = powerInWatts / targetVoltageValue;
  }
}

/**********************************************************************************************************************
 *  Signal Line CHAdeMO 3.0
 *********************************************************************************************************************/

on timer SetVoltage_CC1
{
  $CHAdeMO::Simulation::EVSE.CC1 = TargetCC1Voltage;
}

on value_update CHAdeMO::Simulation::EVSE.S0
{
  Update_SignalLine_CC1();
  
  ChangeSwitchPosition_S0($this); //hardware control
}

on value_update CHAdeMO::Simulation::EVSE.S1
{
  Update_SignalLine_CC1();
  
  ChangeSwitchPosition_S1($this); //hardware control
}

Update_SignalLine_CC1()
{
  if(isSimulated())
  {
    if($CHAdeMO::Simulation::EVSE.S0 == 0)
      TargetCC1Voltage = 0;
    
    else if($CHAdeMO::Simulation::EVSE.CC1 == 0)
      TargetCC1Voltage = 10.8; //only S0 closed
      
    else if( $CHAdeMO::Simulation::EVSE.CC1 == 2.34 && $CHAdeMO::Simulation::EVSE.S1 == 1) //currently S0, S2_ closed
      TargetCC1Voltage = 8.73; //S0, S1 and S2_ closed
    
    else if($CHAdeMO::Simulation::EVSE.CC1 == 8.73 && $CHAdeMO::Simulation::EVSE.S1 == 0) //currently S0, S1, S2_ closed
      TargetCC1Voltage = 2.34; //S0 and S2_ closed, S1 opened
    
    else if($CHAdeMO::Simulation::EVSE.CC1 == 5.6 && $CHAdeMO::Simulation::EVSE.S1 == 0) //currently all closed
      TargetCC1Voltage = 0.88; //S0, S2 and S2_ closed, S1 opened
    
    setTimer(SetVoltage_CC1, cHardwareDelay);
  }
}

/**********************************************************************************************************************
 *  Signal Line CHAdeMO 2.x
 *********************************************************************************************************************/

on timer SetVoltage_CP
{
  $CHAdeMO::Simulation::EVSE.CP = TargetCPVoltage;
}

on timer SetVoltage_CP2
{
  $CHAdeMO::Simulation::EVSE.CP2 = TargetCP2Voltage;
}

on value_update CHAdeMO::Simulation::EVSE.d1
{
  if(isSimulated())
  {
    if($this == 1) {
      TargetCPVoltage = 12; // close
    }
    else {
      TargetCPVoltage = 0;  // open
      TargetCP2Voltage = 0;  // open
    }
    setTimer(SetVoltage_CP, cHardwareDelay);
    setTimer(SetVoltage_CP2, cHardwareDelay);
  }
  else{
    ChangeSwitchPosition_d1($this);
  }
}

on value_update CHAdeMO::Simulation::EVSE.d2
{
  if(isSimulated())
  {
    if($this == 1)
    {
      TargetCP2Voltage = 12;  // close
      OpenContactorAfterInsulationTest();
    }
    else
      TargetCP2Voltage = 0; // open
    
    setTimer(SetVoltage_CP2, cHardwareDelay);
  }
  else{
    ChangeSwitchPosition_d2($this);
  }
}

on value_change EVSE.ID102.VehicleStatus
{
  if(($this == 0) && ($CHAdeMO::Simulation::EVSE.d2 == 1) && ($EVSE.ID109.PresentOutputVoltage >= 50))
  {
    //Interruption period of ground fault detection function 
    //For 0.5s from [voltage in the output circuit?50V and H'102.5.3 = 1].
    HV_set_isolation_state(0);
    setTimer(tEnableIsolationMonitoring, 500);
  }
}

on value_change EVSE.ID109.ChargerStatus
{
  if(($this == 0) && ($EVSE.SpecificationState >= _CHAdeMO::DataTypes::SpecificationStateType::State_F) && ($EVSE.ID109.PresentChargingCurrent <= 5))
  {
    cancelTimer(tEnableIsolationMonitoring);
    HV_set_isolation_state(0);
  }
}

/**********************************************************************************************************************
 *  signal protocol type to vehicle
 *********************************************************************************************************************/
on value_update CHAdeMO::Simulation::EVSE.CS
{
  if((!IsCHAdeMO3()) &&
     ($EVSE.SpecificationState >= _CHAdeMO::DataTypes::SpecificationStateType::State_B) &&
     (($EVSE.SpecificationState < _CHAdeMO::DataTypes::SpecificationStateType::State_D) || 
      ($EVSE.SpecificationState > _CHAdeMO::DataTypes::SpecificationStateType::State_G))
    )
  {
    if(($this < 1) && (@SampleConfiguration::EVSE::Control::IgnoreCPDdetection != 1)) //disconnected from vehicle
    {
      writeLineEx(0,2, "As the CS voltage dropped below 1V, a disconnection from the vehicle has been detected. The EVSE simulation will be stopped.");
      Connected(0);
    }
  }
}

on value_update CHAdeMO::Simulation::EVSE.CC2
{
  if(isSimulated())
  {
    if($this > 10) //connected to vehicle
    {
      if(IsCHAdeMO3())
        $this = 6; //CHAdeMO 3
      else
        $this = 2; //CHAdeMO 2.x
    }
  }
}

on key 'n'
{
  if(isSimulationRunning == 0)
  {
    Connected(1);
    isSimulationRunning = 1;
  }
  else
  {
    Connected(0);
    isSimulationRunning = 0;
  }
}

export int IsCHAdeMO3()
{
  if(@sysvar::SampleConfiguration::EVSE::Control::SysEVSE_Schema == sysvar::SampleConfiguration::EVSE::Control::SysEVSE_Schema::CHAdeMO_30)
    return 1;
  else
    return 0;
}

on timer retryCloseHVContactorsForInsulationtest
{
  CloseContactorForInsulationTest();
}

CloseContactorForInsulationTest()
{
  HV_source_set_U_DC(0);
  HV_source_set_I_DC(0);
  
  //do only close contactor if voltage in output circuit is OK
  if(HV_measure_DC_U_VeriVolt() < cMaximumVoltageOnOutputCircuit)
  {
    HV_source_set_output(1);
  }
  else
  {
    ApplyVoltageAndCurrentForContactorsChange_InsulationTest();
    retryCloseHVContactorsForInsulationtest.set(cRetryOpenCloseHVContactorsDelay);
  }
}

on timer retryOpenHVContactorsAfterInsulationtest
{
  OpenContactorAfterInsulationTest();
}

OpenContactorAfterInsulationTest()
{
  //do only open contactor if voltage in output circuit is OK
  if(HV_measure_DC_U_VeriVolt() < cMaximumVoltageOnOutputCircuit)
  {
    HV_source_set_output(0);
  }
  else
  {
    ApplyVoltageAndCurrentForContactorsChange_InsulationTest();
    retryOpenHVContactorsAfterInsulationtest.set(cRetryOpenCloseHVContactorsDelay);
  }
}

on timer retryCloseHVContactorsForChargeLoop
{
  CloseContactorForChargeLoop();
}

CloseContactorForChargeLoop()
{
  //do only close contactor if voltage in output circuit is equal to internal
  if(
      (HV_measure_DC_U() >= (HV_measure_DC_U_VeriVolt() - cVoltageDeviationForClosingContactors)) &&
      (HV_measure_DC_U() <= (HV_measure_DC_U_VeriVolt() + cVoltageDeviationForClosingContactors))
    )
  {
    HV_source_set_output(1);
  }
  else
  {
    ApplyVoltageAndCurrentForContactorsChange_ChargeLoop();
    retryCloseHVContactorsForChargeLoop.set(cRetryOpenCloseHVContactorsDelay);
  }
}

on timer retryOpenHVContactorsAfterChargeLoop
{
  OpenContactorsAfterChargeLoop();
}

OpenContactorsAfterChargeLoop()
{
  //do only open contactor if voltage in output circuit is equal to internal and current is reduced
  if(
      (HV_measure_DC_U() >= (HV_measure_DC_U_VeriVolt() - cVoltageDeviationForClosingContactors)) &&
      (HV_measure_DC_U() <= (HV_measure_DC_U_VeriVolt() + cVoltageDeviationForClosingContactors)) &&
      (HV_measure_DC_I() <= cMaximumCurrentOnOutputCircuit)
    )
  {
    HV_source_set_output(0);
  }
  else
  {
    ApplyVoltageAndCurrentForContactorsChange_ChargeLoop();
    retryOpenHVContactorsAfterChargeLoop.set(cRetryOpenCloseHVContactorsDelay);
  }
}

ApplyVoltageAndCurrentForContactorsChange_InsulationTest()
{
  HV_source_set_U_DC(0);
  HV_source_set_I_DC(0);
}

ApplyVoltageAndCurrentForContactorsChange_ChargeLoop()
{
  HV_source_set_U_DC(HV_measure_DC_U_VeriVolt());
  HV_source_set_I_DC(cMinimumCurrentDuringInsulationTest);
}

void ReportFail(char output[])
{
  writeLineEx(0, 3, output);
}