/*@!Encoding:1252*/
includes
{ 
}

variables
{
}

on message CAN1.*
{
  if(isSimulated())
  {
    message CAN2.* msg;
  
    if(this.dir != rx) return; //important!
  
    msg = this;
    
    output(msg);
  }
}



on message CAN2.*
{
  if(isSimulated())
  {
    message CAN1.* msg;
  
    if(this.dir != rx) return; //important!
    
    msg = this;
    
    output(msg);
  }
}