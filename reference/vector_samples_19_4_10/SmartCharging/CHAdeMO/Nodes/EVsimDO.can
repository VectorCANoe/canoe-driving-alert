/*@!Encoding:1252*/
includes
{ 
  #include "CHAdeMO_HW_Interface_EV.can"
}

variables
{
  mstimer timer_chargeLoop;
  mstimer timer_startChargingCurrentReq;
  mstimer timer_chargingCurrentReq_Change;
  
  char gProtocolPanelName[9] = "Protocol";
  char gPanelName[8] = "EV";
  char gcontrolCharge[20] = "Progress Bar Charge";
  char gcontrolDischarge[23] = "Progress Bar Discharge";
  int progressBarPosition;
  
  int cHardwareDelay = 50;
  
  //CHAdeMO 3.0
  float TargetCC1Voltage = 0.0;
  msTimer SetVoltage_CC1;
  float TargetCC2Voltage = 0.0;
  msTimer SetVoltage_CC2;
  
  //CHAdeMO 2.x
  float TargetCP3Voltage = 0.0;  
  msTimer SetVoltage_CP3;
  
  int backwardCompatibilityMode = 0;
  int switchd1, switchd2, switchS2, switchSv = 0;
  
  int isSimulationRunning = 0;
  const cAllowedVoltageDeviationPercentage = 5; //Allowed deviation between measured voltage and target voltage [%]

  msTimer retryOpenHVContactors;
  msTimer retryCloseHVContactors;
  const cRetryOpenCloseHVContactorsDelay = 100;
  
  msTimer openHVonMeasurementStop;
  const cOpenHVonMeasurementStopDelay = 500;
  msTimer actionsAfterContactorOpen;
  const cActionsAfterContactorOpenDelay = 100;
  
  const cMaximumVoltageOnOutputCircuit = 30;
  const cMaximumCurrentOnOutputCircuit = 5;
  const cVoltageDeviationForClosingContactors = 10;
}

/**********************************************************************************************************************
 *  ON START/STOP
 *********************************************************************************************************************/
on prestart
{
  char sMinCurrent[4];

  /* convert number into string */
  ltoa(@sysvar::SampleConfiguration::EV::SysEV_MinCurrent, sMinCurrent, 10);
  
  CheckCurrentValueValid(sysvar::SampleConfiguration::EV::SysEV_MinCurrent);
  SetAttributeAndCheckReturnValue("CHAdeMOBinding::EV::MinimumChargeCurrent", sMinCurrent);
  
  CheckVoltageValueValid(sysvar::SampleConfiguration::EV::SysEV_MinVoltage);
  SetAttributeAndCheckReturnValue("CHAdeMOBinding::EV::MinimumBatteryVoltage", @sysvar::SampleConfiguration::EV::SysEV_MinVoltage);
  
  CheckVoltageValueValid(sysvar::SampleConfiguration::EV::SysEV_MaxVoltage);
  SetAttributeAndCheckReturnValue("CHAdeMOBinding::EV::MaximumBatteryVoltage", @sysvar::SampleConfiguration::EV::SysEV_MaxVoltage);
  
  CheckVoltageValueValid(sysvar::SampleConfiguration::EV::SysEV_TargetVoltage);
  SetAttributeAndCheckReturnValue("CHAdeMOBinding::EV::TargetChargingVoltage", @sysvar::SampleConfiguration::EV::SysEV_TargetVoltage);
  
  SetAttributeAndCheckReturnValue("CHAdeMOBinding::DynamicControl", @SampleConfiguration::EV::DynamicControl);
  SetAttributeAndCheckReturnValue("CHAdeMOBinding::HighCurrent", @SampleConfiguration::EV::HighCurrentControl);
  SetAttributeAndCheckReturnValue("CHAdeMOBinding::HighVoltage", @SampleConfiguration::EV::HighVoltageControl);  
  SetAttributeAndCheckReturnValue("CHAdeMOBinding::DischargePossible", @SampleConfiguration::EV::Discharge);
  
  isSimulationRunning = 0;
}

on start
{
  /* Set initial SOC to 30 % */
  @sysvar::SampleConfiguration::EV::SysEV_SoC = 30;
  $CHAdeMO::Simulation::EV.ID102.StateOfCharge = 30;
  
  Set_ProtocolVersion_EV(@sysvar::SampleConfiguration::EV::Control::SysEV_Schema);
  @sysvar::Common::SysProtocolBar = 0;

  ResetVariables();
  ST_Init();
  
  if(@sysvar::SampleConfiguration::EV::InitialChargeRequest == 1)
  {
    /* Discharge */
    @SampleConfiguration::EV::Discharge = 1; //must be activated for V2H support
    setControlVisibility(gPanelName, gcontrolCharge, 0);
    setControlVisibility(gPanelName, gcontrolDischarge, 1);
  }
  else
  {
    /* Charge */
    setControlVisibility(gPanelName, gcontrolCharge, 1);
    setControlVisibility(gPanelName, gcontrolDischarge, 0);
  }
}

on preStop
{
  if(HV_source_get_output() == 1)
  {
    deferStop(1000);
    setTimer(openHVonMeasurementStop, cOpenHVonMeasurementStopDelay);    
  }
  
  StopReaction();
}

on timer openHVonMeasurementStop
{
  HV_source_set_output(0);
  setTimer(actionsAfterContactorOpen, cActionsAfterContactorOpenDelay);
}

on timer actionsAfterContactorOpen
{
  HV_source_set_U_DC(0);
  ST_Reset();
}

StopReaction()
{
  HV_source_set_I_DC(0);
  
  if(HV_source_get_output() == 1)
    HV_source_set_U_DC(HV_measure_DC_U_VeriVolt());
  else
    HV_source_set_U_DC(0);
  
  ST_Reset();
  ST_PlugOut();
  ResetVariables();
  CancelAllTimer();
  EV.ResetSimulation.Call();
  @SampleConfiguration::EV::InitialChargeRequest = 0;
  @sysvar::SampleConfiguration::EV::SysEV_SimState = @SampleConfiguration::EV::SysEV_SimState::Error;
}

CancelAllTimer()
{
  cancelTimer(timer_chargeLoop);
  cancelTimer(timer_startChargingCurrentReq);
  cancelTimer(timer_chargingCurrentReq_Change);
  cancelTimer(SetVoltage_CC1);
  cancelTimer(SetVoltage_CC2);
  cancelTimer(SetVoltage_CP3);
}

/**********************************************************************************************************************
 *  ON SYSVAR
 *********************************************************************************************************************/
on sysvar sysvar::SampleConfiguration::EV::Control::SysEV_Schema
{
  ST_Init();
  Set_ProtocolVersion_EV(@this);
}

on sysvar SampleConfiguration::EV::Control::SysEV_Reset
{
  ResetVariables();
  EV.ResetSimulation.Call();
  @sysvar::SampleConfiguration::EV::SysEV_SimState = @SampleConfiguration::EV::SysEV_SimState::Error;
  cancelTimer(timer_chargeLoop);
  cancelTimer(timer_startChargingCurrentReq);
  cancelTimer(timer_chargingCurrentReq_Change);
}

on sysVar SampleConfiguration::EV::Control::SysEV_Connected
{  
  if (@this == 1)
  {
    ST_PlugIn();
    
    if(@SampleConfiguration::EV::Control::SysEV_Schema == @SampleConfiguration::EV::Control::SysEV_Schema::BackwardCompatibility)
      backwardCompatibilityMode = 1;
    
    if( $EV.ID102.NormalStopRequestBeforeCharging.IsValid ) {
      if($CHAdeMO::Simulation::EV.ID102.NormalStopRequestBeforeCharging == 1)
         $CHAdeMO::Simulation::EV.ID102.NormalStopRequestBeforeCharging = 0;
    }
    
    EV.StartSimulation.Call();
    
    /* Set initial SOC to 30 % */
    @sysvar::SampleConfiguration::EV::SysEV_SoC = 30;
    $CHAdeMO::Simulation::EV.ID102.StateOfCharge = 30;
    
    @sysvar::SampleConfiguration::EV::SysEV_SimState = @SampleConfiguration::EV::SysEV_SimState::OK;
  }
  else
  {    
    StopReaction();
  }
}

ResetVariables()
{
  @SampleConfiguration::EV::SysEV_SimState = @SampleConfiguration::EV::SysEV_SimState::OK;
  @SampleConfiguration::EV::Control::SysEV_Connected = 0;
  @SampleConfiguration::EV::SysEV_ChargingCurrentReq = 0;
  backwardCompatibilityMode = 0;
  switchd1 = switchd2 = switchS2 = switchSv = 0;
  TargetCC1Voltage = 0.0;
  TargetCC2Voltage = 0.0;
  TargetCP3Voltage = 0.0;
}

on sysVar SampleConfiguration::EV::Control::SysEV_Stop
{
  if ($CHAdeMO::Simulation::EV.SpecificationState < _CHAdeMO::DataTypes::SpecificationStateType::State_E)
  {
    if( $EV.ID102.NormalStopRequestBeforeCharging.IsValid ) {
      $CHAdeMO::Simulation::EV.ID102.NormalStopRequestBeforeCharging = 1;
    }
  }
  else
  {
    $CHAdeMO::Simulation::EV.ID102.VehicleChargingEnabled = 0;
    // alternative to VehicleChargingEnabled: VehicleShiftPosition = 1;
  }
}

on sysVar SampleConfiguration::EV::Control::SysEV_ClearBattery
{
  $EV.ID102.StateOfCharge = 0;
  @sysvar::SampleConfiguration::EV::SysEV_SoC = 0;
}

on sysVar SampleConfiguration::EV::SysEV_TargetVoltage
{  
  CheckVoltageValueValid(this);
  if(HV_source_get_output() == 1)
    HV_source_set_U_DC(@this);
  SetAttributeAndCheckReturnValue("CHAdeMOBinding::EV::TargetChargingVoltage", @sysvar::SampleConfiguration::EV::SysEV_TargetVoltage);
}

on sysvar SampleConfiguration::EV::SysEV_MinCurrent
{
  char sMinCurrent[4];
  CheckCurrentValueValid(this);
  ltoa(@sysvar::SampleConfiguration::EV::SysEV_MinCurrent, sMinCurrent, 10);
  SetAttributeAndCheckReturnValue("CHAdeMOBinding::EV::MinimumChargeCurrent", sMinCurrent);
}

on sysvar SampleConfiguration::EV::SysEV_MinVoltage
{
  CheckVoltageValueValid(this);
  SetAttributeAndCheckReturnValue("CHAdeMOBinding::EV::MinimumBatteryVoltage", (@sysvar::SampleConfiguration::EV::SysEV_MinVoltage));
}

on sysvar SampleConfiguration::EV::SysEV_MaxVoltage
{
  CheckVoltageValueValid(this);
  SetAttributeAndCheckReturnValue("CHAdeMOBinding::EV::MaximumBatteryVoltage", (@sysvar::SampleConfiguration::EV::SysEV_MaxVoltage));
}

on sysvar SampleConfiguration::EV::DynamicControl
{
  SetAttributeAndCheckReturnValue("CHAdeMOBinding::DynamicControl", @this);
}

on sysvar SampleConfiguration::EV::HighCurrentControl
{
  SetAttributeAndCheckReturnValue("CHAdeMOBinding::HighCurrent", @this);
}

on sysvar SampleConfiguration::EV::HighVoltageControl
{
  SetAttributeAndCheckReturnValue("CHAdeMOBinding::HighVoltage", @this);
}

on sysvar SampleConfiguration::EV::SysEV_ChargingCurrentReq
{
  CheckCurrentValueValid(this);
  if(HV_source_get_output() == 1)
    HV_source_set_I_DC(@this);
  setTimerCyclic(timer_chargingCurrentReq_Change,50);
}

on sysvar SampleConfiguration::EV::Discharge
{
  SetAttributeAndCheckReturnValue("CHAdeMOBinding::DischargePossible", @this);
}

on sysvar SampleConfiguration::EV::InitialChargeRequest
{
  if(@this == 1)
  {
    /* Discharge */
    @SampleConfiguration::EV::Discharge = 1; //must be activated for V2H support
    setControlVisibility(gPanelName, gcontrolCharge, 0);
    setControlVisibility(gPanelName, gcontrolDischarge, 1);
    
    //set ChargingCurrentReq if already within charge loop
    if (($CHAdeMO::Simulation::EV.SpecificationState == _CHAdeMO::DataTypes::SpecificationStateType::State_E) &&
        (@SampleConfiguration::EV::SysEV_ChargingCurrentReq >= 0))
    {
      @SampleConfiguration::EV::SysEV_ChargingCurrentReq = -10;
    }
  }
  else
  {
    /* Charge */
    setControlVisibility(gPanelName, gcontrolCharge, 1);
    setControlVisibility(gPanelName, gcontrolDischarge, 0);
    
    //set ChargingCurrentReq if already within charge loop
    if (($CHAdeMO::Simulation::EV.SpecificationState == _CHAdeMO::DataTypes::SpecificationStateType::State_E) &&
        (@SampleConfiguration::EV::SysEV_ChargingCurrentReq <= 0))
    {
      @SampleConfiguration::EV::SysEV_ChargingCurrentReq = 10;
    }
  }
}

/**********************************************************************************************************************
 *  ON DATA
 *********************************************************************************************************************/

//--------- Trigger of HW changes
on value_change CHAdeMO::Simulation::EV.ExpectedConnectorLatchState
{
  //lock or unlock connector latch
  if($this == 1)
  {
    $CHAdeMO::Simulation::EV.ID102.ConnectorLatchStatus = 1;
  }
  else
  {
    $CHAdeMO::Simulation::EV.ID102.ConnectorLatchStatus = 0;
  }  
}

on value_change CHAdeMO::Simulation::EV.ExpectedContactorState
{
  ChangeContactorPosition();
}

on value_change CHAdeMO::Simulation::EV.ID109.PresentOutputVoltage
{
  ChangeContactorPosition();
}

on value_change CHAdeMO::Simulation::EV.SpecificationState
{
  if ($CHAdeMO::Simulation::EV.SpecificationState == _CHAdeMO::DataTypes::SpecificationStateType::State_E)
  {
    setTimerCyclic(timer_chargeLoop, 2000);
  }
  else
  {
    cancelTimer(timer_chargeLoop);
    cancelTimer(timer_startChargingCurrentReq);
    cancelTimer(timer_chargingCurrentReq_Change);
  }
  
  switch ($CHAdeMO::Simulation::EV.SpecificationState)
  {
    case _CHAdeMO::DataTypes::SpecificationStateType::State_A:
      progressBarPosition = 1;
      break;
      
    case _CHAdeMO::DataTypes::SpecificationStateType::State_B:
      progressBarPosition = 2;
      break;
      
    case _CHAdeMO::DataTypes::SpecificationStateType::State_C:
      progressBarPosition = 3;
      break;
      
    case _CHAdeMO::DataTypes::SpecificationStateType::State_D:
      progressBarPosition = 4;
      break;
      
    case _CHAdeMO::DataTypes::SpecificationStateType::State_E:
      progressBarPosition = 5;
      break;
      
    case _CHAdeMO::DataTypes::SpecificationStateType::State_F:
      progressBarPosition = 6;
      break;
      
    case _CHAdeMO::DataTypes::SpecificationStateType::State_G:
      progressBarPosition = 7;
      break;
      
    case _CHAdeMO::DataTypes::SpecificationStateType::State_H:
      progressBarPosition = 8;
      break;
      
    case _CHAdeMO::DataTypes::SpecificationStateType::State_I:
      progressBarPosition = 9;
      @SampleConfiguration::EV::Control::SysEV_Connected = 0;
      break;
      
    default:
      //Ignore
      break;      
  }
  
  @sysvar::Common::SysProtocolBar = progressBarPosition;
}

on value_change CHAdeMO::Simulation::EV.ID102.VehicleStatus
{
  //start with Charging current request
  //according to specification after 1s timeout for preparation of the charger
  if($this == 0 && !isTimerActive(timer_startChargingCurrentReq))
  {
    setTimer(timer_startChargingCurrentReq, 1000);
  }
}

on value_change CHAdeMO::Simulation::EV.ID108.AvailableOutputCurrent
{
  CheckDynamicControlSupport($this);
}

on value_change CHAdeMO::Simulation::EV.ID118.AvailableOutputCurrentExtended
{
  CheckDynamicControlSupport($this);
}

CheckDynamicControlSupport(long val)
{
  if ($CHAdeMO::Simulation::EV.SpecificationState == _CHAdeMO::DataTypes::SpecificationStateType::State_E) //during charging
  {
    if($EV.ID118.DynamicControl == 1 && $EV.ID110.DynamicControl == 1) //if both support dynamic control, follow AvailableOutputCurrent
    {
      if($EV.ID118.HighCurrentControl == 1 && $EV.ID110.HighCurrentControl == 1) //check if both support high current
        $CHAdeMO::Simulation::EV.ID110.ChargingCurrentRequestExtended = val;
      else
        $CHAdeMO::Simulation::EV.ID102.ChargingCurrentRequest = val;
    }
  }
}

/**********************************************************************************************************************
 *  ON TIMER
 *********************************************************************************************************************/
on timer timer_chargeLoop
{
  double presentChargingCurrent;
  
  if($EV.ID110.ChargingCurrentRequestExtended > 0 || $EV.ID102.ChargingCurrentRequest > 0)
  {
      presentChargingCurrent = HV_measure_DC_I();
    
    //Limit StateOfCharge value to 100%
    if ((@sysvar::SampleConfiguration::EV::SysEV_SoC < 100) && ((@sysvar::SampleConfiguration::EV::SysEV_SoC + (presentChargingCurrent/(double)100)) <= 100))
    {
      @sysvar::SampleConfiguration::EV::SysEV_SoC = @sysvar::SampleConfiguration::EV::SysEV_SoC + (presentChargingCurrent/(double)100);
    }
    else if ((@sysvar::SampleConfiguration::EV::SysEV_SoC < 100) && ((@sysvar::SampleConfiguration::EV::SysEV_SoC + (presentChargingCurrent/(double)100)) > 100))
    {
      @sysvar::SampleConfiguration::EV::SysEV_SoC = 100;
    }
  }
  else if($EV.ID200.MaximumDischargeCurrent.impl > 0)
  {
    presentChargingCurrent = HV_measure_DC_I();
        
    //Limit StateOfCharge value to 0%
    if ((@sysvar::SampleConfiguration::EV::SysEV_SoC > 0) && ((@sysvar::SampleConfiguration::EV::SysEV_SoC - (presentChargingCurrent/(double)100)) >= 0))
    {
      @sysvar::SampleConfiguration::EV::SysEV_SoC = @sysvar::SampleConfiguration::EV::SysEV_SoC - (presentChargingCurrent/(double)100);
    }
    else if ((@sysvar::SampleConfiguration::EV::SysEV_SoC > 0) && ((@sysvar::SampleConfiguration::EV::SysEV_SoC - (presentChargingCurrent/(double)100)) < 0))
    {
      @sysvar::SampleConfiguration::EV::SysEV_SoC = 0;
    }
  }
}

on sysvar SampleConfiguration::EV::SysEV_SoC
{
  $CHAdeMO::Simulation::EV.ID102.StateOfCharge = (int)@this;
}

on timer timer_startChargingCurrentReq
{
  if(@SampleConfiguration::EV::InitialChargeRequest == 1)
    @SampleConfiguration::EV::SysEV_ChargingCurrentReq -= @sysvar::SampleConfiguration::EV::SysEV_MinCurrent;
  else
    @SampleConfiguration::EV::SysEV_ChargingCurrentReq = @sysvar::SampleConfiguration::EV::SysEV_MinCurrent;
}

on timer timer_chargingCurrentReq_Change
{
  if(@SampleConfiguration::EV::SysEV_ChargingCurrentReq >= 0)
  {
    if($EV.ID110.HighCurrentControl == 1 && $EV.ID118.HighCurrentControl == 1)
    {
      if ($EV.ID110.ChargingCurrentRequestExtended < @SampleConfiguration::EV::SysEV_ChargingCurrentReq)
      {
        $EV.ID110.ChargingCurrentRequestExtended++;
        $EV.ID102.ChargingCurrentRequest = 0xFF;
      }
      else if ($EV.ID110.ChargingCurrentRequestExtended > @SampleConfiguration::EV::SysEV_ChargingCurrentReq)
      {
        $EV.ID110.ChargingCurrentRequestExtended--;
        $EV.ID102.ChargingCurrentRequest = 0xFF;
      }
      else
      {
        cancelTimer(timer_chargingCurrentReq_Change);
      }
    }
    else
    {
      if(@SampleConfiguration::EV::HighCurrentControl) //do not change DO if not supported, otherwise will start sending message
        $EV.ID110.ChargingCurrentRequestExtended = 0;
      
      if($EV.ID102.ChargingCurrentRequest < @SampleConfiguration::EV::SysEV_ChargingCurrentReq)
      {        
        $EV.ID102.ChargingCurrentRequest++;
      }
      else if($EV.ID102.ChargingCurrentRequest > @SampleConfiguration::EV::SysEV_ChargingCurrentReq)
      {
        $EV.ID102.ChargingCurrentRequest--;
      }
      else
      {
        cancelTimer(timer_chargingCurrentReq_Change);
      }
    }
    
    if(@SampleConfiguration::EV::Discharge) //do not change DO if not supported, otherwise will start sending message
    {
      @SampleConfiguration::EV::InitialChargeRequest = 0;
      $EV.ID200.MaximumDischargeCurrent.impl = 0;
    }
  }
  else if(@SampleConfiguration::EV::Discharge) //do not change DO if not supported, otherwise will start sending message
  {
    if ($EV.ID110.ChargingCurrentRequestExtended > 0)
    {
      $EV.ID110.ChargingCurrentRequestExtended--;
      
    }
    else if ($EV.ID102.ChargingCurrentRequest > 0)
    {
      $EV.ID102.ChargingCurrentRequest--;
    }
    else if ($EV.ID200.MaximumDischargeCurrent.impl < abs(@SampleConfiguration::EV::SysEV_ChargingCurrentReq))
    {
      $EV.ID200.MaximumDischargeCurrent.impl++;
      @SampleConfiguration::EV::InitialChargeRequest = 1;
      $EV.ID110.ChargingCurrentRequestExtended = 0;
      $EV.ID102.ChargingCurrentRequest = 0;
    }
    else if ($EV.ID200.MaximumDischargeCurrent.impl > abs(@SampleConfiguration::EV::SysEV_ChargingCurrentReq))
    {
      $EV.ID200.MaximumDischargeCurrent.impl--;
      @SampleConfiguration::EV::InitialChargeRequest = 1;
      $EV.ID110.ChargingCurrentRequestExtended = 0;
      $EV.ID102.ChargingCurrentRequest = 0;
    }  
    else
    {
      cancelTimer(timer_chargingCurrentReq_Change);
    }
  }  
}

/**********************************************************************************************************************
 *  HELPER FUNCTIONS
 *********************************************************************************************************************/
ChangeContactorPosition()
{  
  float allowedVoltageDeviation = 0;
  allowedVoltageDeviation = ( $CHAdeMO::Simulation::EV.ID102.TargetBatteryVoltage * cAllowedVoltageDeviationPercentage ) / 100;
  
    if( $EV.ID102.VehicleStatus.IsValid )
    {
      if($CHAdeMO::Simulation::EV.ExpectedContactorState == 1 && $CHAdeMO::Simulation::EV.ID102.VehicleStatus == 1) //check expected value and if already closed
      {
        CloseContactors();
        $CHAdeMO::Simulation::EV.ID102.VehicleStatus = 0; //Contactor closed 
      }
      else if($CHAdeMO::Simulation::EV.ExpectedContactorState == 0 && $CHAdeMO::Simulation::EV.ID102.VehicleStatus == 0) //check expected value and if already opened
      {
        OpenContactors();
        $CHAdeMO::Simulation::EV.ID102.VehicleStatus = 1; //Contactor opened
      }
    }
  else
  {
    //do not change VehicleStatus if CHAdeMO 0.9 is used
    if($CHAdeMO::Simulation::EV.ExpectedContactorState == 1 && !isTimerActive(timer_startChargingCurrentReq))
      setTimer(timer_startChargingCurrentReq, 3000);
  }
}

void Set_ProtocolVersion_EV(dword evSchema)
{
  SetAttributeAndCheckReturnValue("CHAdeMOBinding::EV::ProtocolVersion", evSchema);
}

SetAttributeAndCheckReturnValue(char path[], dword value)
{
  int retValue;
  retValue = setAttribute(CHAdeMO::Simulation::EV, path, value);  
  
  if(retValue != 0)
    writeLineEx(0, 3, "Unexpected return value (%d) of setAttribute '%s'", retValue, path);
}

SetAttributeAndCheckReturnValue(char path[], char value[])
{
  int retValue;
  retValue = setAttribute(CHAdeMO::Simulation::EV, path, value);  
  
  if(retValue != 0)
    writeLineEx(0, 3, "Unexpected return value (%d) of setAttribute '%s'", retValue, path);
}

CheckCurrentValueValid(sysvarInt* var)
{
  if(@var >= 0)
  {
    if(@SampleConfiguration::EV::HighCurrentControl == 0 && @var > 200)
    {
      writeLineEx(0,3,"Allowed range for %s 0-200[A]. Use 'HighCurrentControl' for values up to 1023[A]", var.name);
      @var = 200; //set to valid value
    }
    else if(@SampleConfiguration::EV::HighCurrentControl == 1 && @var > 1023)
    {
      writeLineEx(0,3,"Using 'HighCurrentControl' allowed range for %s is 0-1023[A]", var.name);
      @var = 1023; //set to valid value
    }
  }
  else
  {
    if(@SampleConfiguration::EV::Discharge == 0)
    {
      writeLineEx(0,3,"Use 'discharge' to allow negative charge current values up to -255[A] for %s", var.name);
      @var = 0; //set to valid value
    }
    else if(@var < -255)
    {
      writeLineEx(0,3,"Using 'discharge' negative charge current values up to -255[A] are allowed for %s", var.name);
      @var = -255; //set to valid value
    }
  }  
}

CheckVoltageValueValid(sysvarInt* var)
{
  if(@SampleConfiguration::EV::HighVoltageControl == 0 && @var > 600)
  {
    writeLineEx(0,3,"Allowed range for %s 0-600[V]. Use 'HighVoltageControl' for values up to 1200[V]", var.name);
    @var = 600; //set to valid value
  }
  else if(@SampleConfiguration::EV::HighVoltageControl == 1 && @var > 1200)
  {
    writeLineEx(0,3,"Using 'HighVoltageControl' allowed range for %s is 0-1200[V]", var.name);
    @var = 1200; //set to valid value
  }
}

/**********************************************************************************************************************
 *  Signal Line CHAdeMO 3.0
 *********************************************************************************************************************/

on timer SetVoltage_CC1
{
  $CHAdeMO::Simulation::EV.CC1 = TargetCC1Voltage;
}

on value_update CHAdeMO::Simulation::EV.S2
{
  switchS2 = $this;
  
  if(backwardCompatibilityMode == 1)
  {
    ConnectorAdapter();
    return;
  }
  
  Update_SignalLine_CC1();
  
  ChangeSwitchPosition_S2($this); //Hardware control
}

on value_update CHAdeMO::Simulation::EV.S2_
{
  Update_SignalLine_CC1();
  
  ChangeSwitchPosition_S2_($this); //Hardware control
}

Update_SignalLine_CC1()
{
  if(isSimulated())
  {  
    if($CHAdeMO::Simulation::EV.CC1 == 0)
      return; //do not change value, since switch S0 is opened
      
    else if($CHAdeMO::Simulation::EV.CC1 == 10.8 && $CHAdeMO::Simulation::EV.S2_ == 1 && $CHAdeMO::Simulation::EV.S2 == 0) //currently S0 closed
      TargetCC1Voltage = 2.34; //S0 and S2_ closed
    
    else if($CHAdeMO::Simulation::EV.CC1 == 2.34 && $CHAdeMO::Simulation::EV.S2_ == 0 && $CHAdeMO::Simulation::EV.S2 == 0) //currently S0, S2_ closed
      TargetCC1Voltage = 10.8; //S0 closed, S2_ opened
    
    else if($CHAdeMO::Simulation::EV.CC1 == 8.73 && $CHAdeMO::Simulation::EV.S2_ == 1 && $CHAdeMO::Simulation::EV.S2 == 1 ) //currently S0, S1, S2_ closed
      TargetCC1Voltage = 5.6; //all closed
    
    else if($CHAdeMO::Simulation::EV.CC1 == 5.6 && $CHAdeMO::Simulation::EV.S2_ == 1 && $CHAdeMO::Simulation::EV.S2 == 0) //currently all closed
      TargetCC1Voltage = 8.73; //S0, S1 and S2_ closed, S2 opened
    
    else if($CHAdeMO::Simulation::EV.CC1 == 0.88 && $CHAdeMO::Simulation::EV.S2_ == 1 && $CHAdeMO::Simulation::EV.S2 == 0) //currently S0, S2_, S2 closed
      TargetCC1Voltage = 2.34; //S0 and S2_ closed, S2 opened
    
    else
      TargetCC1Voltage = $CHAdeMO::Simulation::EV.CC1; //keep value
        
    setTimer(SetVoltage_CC1, cHardwareDelay);
  }
}

on timer SetVoltage_CC2
{
  $CHAdeMO::Simulation::EV.CC2 = TargetCC2Voltage;
}

on value_update CHAdeMO::Simulation::EV.Sv
{
  if(isSimulated())
  {  
    switchSv = $this;
    
    if($this == 0)
      TargetCC2Voltage = 0;
    else
      TargetCC2Voltage = 12;
    
    ConnectorAdapter();
    
    setTimer(SetVoltage_CC2, cHardwareDelay);
  }
  else{
    ChangeSwitchPosition_Sv($this); //Hardware control
  }
}

/**********************************************************************************************************************
 *  Signal Line CHAdeMO 2.x
 *********************************************************************************************************************/
on timer SetVoltage_CP3
{
  $CHAdeMO::Simulation::EV.CP3 = TargetCP3Voltage;
}

on value_update CHAdeMO::Simulation::EV.k
{
  if(isSimulated())
  {
    if($this == 1)
      TargetCP3Voltage = 0;
    else
      TargetCP3Voltage = 12;
    
    setTimer(SetVoltage_CP3, cHardwareDelay);
  }
  else{
    ChangeSwitchPosition_k($this);
  }
}

/**********************************************************************************************************************
 *  Signal Line compatibility mode
 *********************************************************************************************************************/
on value_update CHAdeMO::Simulation::EV.CC2
{
  if(!isSimulated() || $this >= 11 || switchSv == 0)
    return;
  
  if(3.9 <= $this && $this <= 8.2)
    backwardCompatibilityMode = 0; //connected to CHAdeMO 3 charger
  else if(1.2 <= $this && $this <= 2.8)
    backwardCompatibilityMode = 1; //connected to CHAdeMO 2.x charger
}

on value_update CHAdeMO::Simulation::EV.CP
{
  if($this >= 6)
    switchd1 = 1;
  else
    switchd1 = 0;
  
  ConnectorAdapter();
}

on value_update CHAdeMO::Simulation::EV.CP2
{
  if(($this > 6) && (switchd1 == 1))
    switchd2 = 1;
  else
    switchd2 = 0;
  
  ConnectorAdapter();
}

ConnectorAdapter()
{
  if (isSimulated())
  {
    if(backwardCompatibilityMode != 1)
      return;
      
    if(switchS2 == 0)
      TargetCC1Voltage = 10.8; //energized through CP3
    else
      TargetCC1Voltage = 0;
    
    if(switchSv == 0)
    {
      if(switchd1 == 0)
      {
        TargetCC2Voltage = 0;
      }
      else if(switchd1 == 1 && switchd2 == 0)
      {
        TargetCC2Voltage = 4;
      }
      else if(switchd1 == 1 && switchd2 == 1)
      {
        TargetCC2Voltage = 2.4;
      }
      
      if(switchS2 == 1)
      {
        TargetCP3Voltage = 0;
      }
      else
      {
        TargetCP3Voltage = 12;
      }
    }
    
    if($CHAdeMO::Simulation::EV.CC1 != TargetCC1Voltage && !isTimerActive(SetVoltage_CC1))
      setTimer(SetVoltage_CC1, cHardwareDelay);
    
    if($CHAdeMO::Simulation::EV.CC2 != TargetCC2Voltage && !isTimerActive(SetVoltage_CC2))
      setTimer(SetVoltage_CC2, cHardwareDelay);
    
    if($CHAdeMO::Simulation::EV.CP3 != TargetCP3Voltage && !isTimerActive(SetVoltage_CP3))
      setTimer(SetVoltage_CP3, cHardwareDelay);
  }
}

on key 'n'
{
  if(isSimulationRunning == 0)
  {
    @SampleConfiguration::EV::Control::SysEV_Connected = 1;
    isSimulationRunning = 1;
  }
  else
  {
    @SampleConfiguration::EV::Control::SysEV_Connected = 0;
    isSimulationRunning = 0;
  }
}

on timer retryCloseHVContactors
{
  CloseContactors();
}

CloseContactors()
{
  //do only close contactor if voltage in output circuit is equal to internal
  if(
      (HV_measure_DC_U() >= (HV_measure_DC_U_VeriVolt() - cVoltageDeviationForClosingContactors)) &&
      (HV_measure_DC_U() <= (HV_measure_DC_U_VeriVolt() + cVoltageDeviationForClosingContactors))
    )
  {
    HV_source_set_U_DC(@SampleConfiguration::EV::SysEV_TargetVoltage);
    HV_source_set_output(1);
  }
  else
  {
    HV_source_set_U_DC(HV_measure_DC_U_VeriVolt());
    HV_source_set_I_DC(1); //minimum current to apply voltage
    retryCloseHVContactors.set(cRetryOpenCloseHVContactorsDelay);
  }
}

on timer retryOpenHVContactors
{
  OpenContactors();
}

OpenContactors()
{
  //do only open contactor if voltage in output circuit is equal to internal and current is reduced
  if(
      (HV_measure_DC_U() >= (HV_measure_DC_U_VeriVolt() - cVoltageDeviationForClosingContactors)) &&
      (HV_measure_DC_U() <= (HV_measure_DC_U_VeriVolt() + cVoltageDeviationForClosingContactors)) &&
      (HV_measure_DC_I() <= cMaximumCurrentOnOutputCircuit)
    )
  {
    HV_source_set_U_DC(0);
    HV_source_set_I_DC(0);
    HV_source_set_output(0);
  }
  else
  {
    HV_source_set_U_DC(HV_measure_DC_U_VeriVolt());
    HV_source_set_I_DC(1); //minimum current to apply voltage
    retryOpenHVContactors.set(cRetryOpenCloseHVContactorsDelay);
  }
}