/*@!Encoding:1252*/

includes
{
  
}

long _StringsEqual(char a[], char b[])
{
  long lengthA;
  long lengthB;
  
  lengthA = strlen(a);
  lengthB = strlen(b);
  
  if( lengthA != lengthB ) return 0;
  
  return 0 == strncmp(a, b, lengthA);
}

long _IsDataOfConfiguredNetwork(char bssid[])
{
  long i;
  long numNetworks;
  struct IoTEnabler::stNetwork network;
  char configuredSSID[256];
  long getLen;
  
  sysGetVariableString(sysvar::IoTEnabler::Monitoring::SysMonitor_SSID, configuredSSID, getLen);
  
  numNetworks = $IoTEnabler::WiFiController.Networks.Length;
  
  // Desired Network?
  for(i = 0; i < numNetworks; i++)
  {
    memcpy(network,  $IoTEnabler::WiFiController.Networks[i]);
    if(_StringsEqual(network.BSSID, bssid))
    {
      if(_StringsEqual(network.SSID, configuredSSID))
      {
        return 1;
      }
      else
      {
        return 0; // BSSID belongs to different SSID 
      }
    } 
  }
  
  return 0;
}

on value_change IoTEnabler::WiFiController.wifi_data
{	
  ethernetPacket txPacket;
  byte buffer[3000];
  
  txPacket.hwPort = ethernetport::CCS_Network_Monitoring::Mapping;

  if( ! _IsDataOfConfiguredNetwork($this.bssid) )
  {
    return; 
  }
  
  if( $this.eth_type == 0x0000 ) return;
  if( elcount($this.payload) == 0 ) return;
  
  txPacket.type = $this.eth_type;
  memcpy(buffer, $this.payload);
  txPacket.SetData(0,  buffer, elCount(buffer));
  txPacket.Length = elCount($this.payload);
  txPacket.source = EthGetMacAddressAsNumber( $this.src );
  txPacket.destination = EthGetMacAddressAsNumber( $this.dst );
  txPacket.CompletePacket();
  output(txPacket);
}