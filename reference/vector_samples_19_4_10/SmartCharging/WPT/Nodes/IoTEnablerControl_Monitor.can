/*@!Encoding:1252*/
includes
{
  #include "IoTEnablerControl_Monitor.cin"
}

variables
{
    
}

on preStart
{
  @sysvar::IoTEnabler::Monitoring::SysWifiFrameMonitoring = sysvar::IoTEnabler::Monitoring::SysWifiFrameMonitoring::Enabled;
}

on value_update IoTEnabler::WiFiController.wifi_beacon
{
  @Common::SysBeaconFrameReceived = 1;
  
  _AddNetwork($this.ssid, $this.src, $this.src_oui);
}

on sysvar_change sysvar::IoTEnabler::Monitoring::SysMonitoredChannel
{
  _ClearNetworks();
}

long _StringsEqual(char a[], char b[])
{
  long lengthA;
  long lengthB;
  
  lengthA = strlen(a);
  lengthB = strlen(b);
  
  if( lengthA != lengthB ) return 0;
  
  return 0 == strncmp(a, b, lengthA);
}

_ClearNetworks()
{
  $IoTEnabler::WiFiController.Networks.Length = 0;
}

_AddNetwork(char ssid[], char src[], char src_oui[])
{
  long i;
  long numNetworks;
  struct IoTEnabler::stNetwork network;
  char bssid[256];
    
  snprintf(bssid, elcount(bssid), "%s %s", src, src_oui);
  
  numNetworks = $IoTEnabler::WiFiController.Networks.Length;
  
  for(i = 0; i < numNetworks; i++)
  {
    // Known Network?
    memcpy(network,  $IoTEnabler::WiFiController.Networks[i]);
    if(_StringsEqual(network.SSID, ssid))
    {
      // BSSID changed?
      if(_StringsEqual(network.BSSID, bssid))
      {
        // Network already listed
        return;
      }
      else
      {
        // Network already listed, but Update required 
        network.BSSID = bssid;
        memcpy($IoTEnabler::WiFiController.Networks[i], network);
        return;
      }
    }
  }
  
  // New Network
  network.SSID  = ssid;
  network.BSSID = bssid;
  
  $IoTEnabler::WiFiController.Networks.Length++;
  memcpy($IoTEnabler::WiFiController.Networks[numNetworks], network);
}
