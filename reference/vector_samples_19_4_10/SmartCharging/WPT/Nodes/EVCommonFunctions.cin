/*@!Encoding:1252*/
variables
{
  int isPassive = 0;
  
  const SystemPageOfWriteWindow = 0;
  const Warning = 2;
  
  const long cBatteryCapacityInWh = 80000;
  const float cTargetSOC = 80.0;
  const float cMinimumSOC = 20.0;
  const int cRationalNumberMaxValue = 32767; // sint16 MaxValue
}

on sysvar Common::SysTLSEnabled
{
  setTLSAttribute();
}

on sysvar Common::SysUserAuthorizationMode
{
  setAuthorizationMode(); 
}

int IsEVRolePassive()
{
  if((@sysVar::Test::SysTestControlledEntity != 1) && (@Test::SysTestApplyControlMode == 1))
    return 1;
  
  return 0;
}

reReadAttributes()
{
  setControlMode();
  setTLSAttribute();
  setAuthorizationMode();
  setCertHandlingAttribute();
  setProcessingLoopAttribute();
  setChargeLoopMessageDelayAttribute();
}

setControlMode()
{
  if (@sysvar::EV_Sim::Control::SysEV_ControlModeDynamic == @sysvar::EV_Sim::Control::SysEV_ControlModeDynamic::Dynamic){
    setAttribute(CCS::Simulation::EV, CCSBinding::EV::ControlMode, CCSBinding::Dynamic);
  }
  else
  {
    setAttribute(CCS::Simulation::EV, CCSBinding::EV::ControlMode, CCSBinding::Scheduled);
  }
}

setAuthorizationMode()
{
  if (@sysvar::Common::SysUserAuthorizationMode == sysvar::Common::SysUserAuthorizationMode::EIM){
    setAttribute(CCS::Simulation::EV, CCSBinding::EV::AuthorizationMode, 0);
  }
  else{
    setAttribute(CCS::Simulation::EV, CCSBinding::EV::AuthorizationMode, 1); //PnC
  }
}

setTLSAttribute()
{  
  if (@sysVar::Common::SysTLSEnabled == @sysvar::Common::SysTLSEnabled::TLSEnabled){
    setAttribute(CCS::Simulation::EV, CCSBinding::TLS, CCSBinding::TLSEnabled); 
  }
  else{
    setAttribute(CCS::Simulation::EV, CCSBinding::TLS, CCSBinding::TLSDisabled); 
  }
}

setCertHandlingAttribute()
{
  if (@sysvar::EV_Sim::Control::SysEV_CertificateInstallation == 1){
    setAttribute(CCS::Simulation::EV, CCSBinding::EV::CertificateHandling, CCSBinding::Installation);
  }
  else{
    setAttribute(CCS::Simulation::EV, CCSBinding::EV::CertificateHandling, CCSBinding::None);
  }
}

setProcessingLoopAttribute()
{
  if (@sysvar::Common::SysUseProcessing == 1){
    setAttribute(CCS::Simulation::EV, CCSBinding::ProcessingLooping, CCSBinding::Enabled);
  }
  else{
    setAttribute(CCS::Simulation::EV, CCSBinding::ProcessingLooping, CCSBinding::Disabled); 
  }
}

setChargeLoopMessageDelayAttribute()
{
  setAttribute(CCS::Simulation::EV, CCSBinding::ChargeLoopMessageDelayMs, @sysvar::EV_Sim::Control::SysEV_ChargeLoopInterval);
}

int GetCorrespondingMessageControlModeForSelectedControlMode()
{
  if (@sysvar::EV_Sim::Control::SysEV_ControlModeDynamic == @sysvar::EV_Sim::Control::SysEV_ControlModeDynamic::Dynamic){
    return 2;
  }
  else{
    return 1;
  }
}

void FUNC_Set_EVWPTLimits_ChargeParameterDiscoveryReq()
{
  // EVPCMaxReceivablePower
  $CCS::Simulation::EV.ISO20.WPT_ChargeParameterDiscovery_Request.EVPCMaxReceivablePower.Exponent = 0;
  $CCS::Simulation::EV.ISO20.WPT_ChargeParameterDiscovery_Request.EVPCMaxReceivablePower.Value = @sysvar::EV_Sim::SysEV_MaxPower;
  
  // GroundClearance
  $CCS::Simulation::EV.ISO20.WPT_ChargeParameterDiscovery_Request.SDMinGroundClearence = @sysvar::EV_Sim::SysEV_MinGroundClearance;
  $CCS::Simulation::EV.ISO20.WPT_ChargeParameterDiscovery_Request.SDMaxGroundClearence = @sysvar::EV_Sim::SysEV_MaxGroundClearance;
  
  // NaturalFrequency
  $CCS::Simulation::EV.ISO20.WPT_ChargeParameterDiscovery_Request.EVPCNaturalFrequency.Exponent = 0;
  $CCS::Simulation::EV.ISO20.WPT_ChargeParameterDiscovery_Request.EVPCNaturalFrequency.Value = @sysvar::EV_Sim::SysEV_Frequency;
}

void FUNC_Set_EVChargeLoopValues()
{
  // EVPCPowerRequest
  $CCS::Simulation::EV.ISO20.WPT_ChargeLoop_Request.EVPCPowerRequest.Exponent = 0;
  $CCS::Simulation::EV.ISO20.WPT_ChargeLoop_Request.EVPCPowerRequest.Value = @sysvar::EV_Sim::SysEV_TargetPower;
  
  // EVPCPowerOutput
  $CCS::Simulation::EV.ISO20.WPT_ChargeLoop_Request.EVPCPowerOutput.Exponent = $CCS::Simulation::EV.ISO20.WPT_ChargeLoop_Response.EVPCPowerRequest.Exponent;
  $CCS::Simulation::EV.ISO20.WPT_ChargeLoop_Request.EVPCPowerOutput.Value = $CCS::Simulation::EV.ISO20.WPT_ChargeLoop_Response.EVPCPowerRequest.Value;
}

void FUNC_Set_RationalNumberValue(struct _CCS::DataTypes::RationalNumber_Type rationalNumber, long valueToBeSet)
{
  int sign;
  int exponent;
  long value;
  
  sign = 1;
  exponent = 0;
  value = valueToBeSet;
  
  // Remember sign
  if(value < 0)
  {
    sign = -1; 
    value = abs(value);
  }
  
  while((value > cRationalNumberMaxValue)
          && (exponent < 3))
  {
    value /= 10;
    exponent++;
  }
  
  if(exponent == 3 && value > cRationalNumberMaxValue)
  {
    writeLineEx(0, 3, "Error: Value '%d' is too big or small and cannot be represented as a RationalNumber element", valueToBeSet);
    exponent = 0;
    value = 0;
  }
  else
  {
    // Apply sign again
    value *= sign;
  }
  
  rationalNumber.Value = value;
  rationalNumber.Exponent = exponent;
}

void FUNC_Set_EVEnergyValues_ScheduleExchangeReq()
{
  stack long PresentSOC = _round(@sysvar::EV_Sim::SysEV_BatteryState);
  
  // float helpers for calculations
  stack float remainingPercentageUntilTargetSOC = (cTargetSOC - PresentSOC) / 100;
  stack float remainingPercentageUntilFull = (100.0 - PresentSOC) / 100;
  stack float remainingPercentageUntilMinSOC = (PresentSOC - cMinimumSOC) / 100;
  
  // values to be set in message
  stack long EVTargetEnergyRequest = _round(cBatteryCapacityInWh * remainingPercentageUntilTargetSOC);
  stack long EVMaximumEnergyRequest = _round(cBatteryCapacityInWh * remainingPercentageUntilFull);
  stack long EVMinimumEnergyRequest = _round(cBatteryCapacityInWh * remainingPercentageUntilMinSOC);
  stack long EVMaximumV2XEnergyRequest = 0;
  stack long EVMinimumV2XEnergyRequest = 0;
  
  // already above target, so we would need to discharge
  if(PresentSOC > cTargetSOC)
  {
    EVTargetEnergyRequest *= -1;
  }
  
  // already above minimum, so we could discharge
  if(PresentSOC > cMinimumSOC)
  {
    EVMinimumEnergyRequest *= -1;
  }
  
  if(@sysvar::EV_Sim::Control::SysEV_ControlModeDynamic == @sysvar::EV_Sim::Control::SysEV_ControlModeDynamic::Dynamic)
  {
    // Common charging values
    $EV.ISO20.ScheduleExchange_Request.SEReqControlModeElementId = _CCS::DataTypes::parISO20SEReqMode::Dynamic_SEReq;
    FUNC_Set_RationalNumberValue($EV.ISO20.ScheduleExchange_Request.SEReqControlMode.Dynamic_SEReqControlMode.EVTargetEnergyRequest, EVTargetEnergyRequest);
    FUNC_Set_RationalNumberValue($EV.ISO20.ScheduleExchange_Request.SEReqControlMode.Dynamic_SEReqControlMode.EVMaximumEnergyRequest, EVMaximumEnergyRequest);
    FUNC_Set_RationalNumberValue($EV.ISO20.ScheduleExchange_Request.SEReqControlMode.Dynamic_SEReqControlMode.EVMinimumEnergyRequest, EVMinimumEnergyRequest);
    $EV.ISO20.ScheduleExchange_Request.SEReqControlMode.Dynamic_SEReqControlMode.MinimumSOC = cMinimumSOC;
    $EV.ISO20.ScheduleExchange_Request.SEReqControlMode.Dynamic_SEReqControlMode.TargetSOC = cTargetSOC;
    FUNC_Set_RationalNumberValue($EV.ISO20.ScheduleExchange_Request.SEReqControlMode.Dynamic_SEReqControlMode.EVMaximumV2XEnergyRequest, EVMaximumV2XEnergyRequest);
    FUNC_Set_RationalNumberValue($EV.ISO20.ScheduleExchange_Request.SEReqControlMode.Dynamic_SEReqControlMode.EVMinimumV2XEnergyRequest, EVMinimumV2XEnergyRequest);
  }
  else
  {
    $EV.ISO20.ScheduleExchange_Request.SEReqControlModeElementId = _CCS::DataTypes::parISO20SEReqMode::Scheduled_SEReq;
    FUNC_Set_RationalNumberValue($EV.ISO20.ScheduleExchange_Request.SEReqControlMode.Scheduled_SEReqControlMode.EVTargetEnergyRequest, EVTargetEnergyRequest);
    FUNC_Set_RationalNumberValue($EV.ISO20.ScheduleExchange_Request.SEReqControlMode.Scheduled_SEReqControlMode.EVMaximumEnergyRequest, EVMaximumEnergyRequest);
    FUNC_Set_RationalNumberValue($EV.ISO20.ScheduleExchange_Request.SEReqControlMode.Scheduled_SEReqControlMode.EVMinimumEnergyRequest, EVMinimumEnergyRequest);        
    $EV.ISO20.ScheduleExchange_Request.SEReqControlMode.Scheduled_SEReqControlMode.EVEnergyOffer.SetInvalid();
    
  }
}