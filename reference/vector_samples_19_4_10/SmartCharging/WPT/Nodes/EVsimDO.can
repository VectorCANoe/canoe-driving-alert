/*@!Encoding:1252*/
includes
{
  #include "EVCommonFunctions.cin"
  #include "EVSendFunctions.cin"
}

variables
{
  char gProtocolPanelName[9] = "Protocol";
  char labelNameOK[50];  
  char labelNameNOK[50];
  const int cStateResultsSize = 14;
  int stateResults[cStateResultsSize];   // stores response codes
  
  char gPanelName[8] = "EV";
  char gcontrolCharge[20] = "Progress Bar Charge";
  char gcontrolDischarge[23] = "Progress Bar Discharge";
  int EVProcessingLoopCounter = 0;
  int ChargeLoopDelay = 0;
  int EnergyRequest = 0;
  const int ChargeLoopDelayValue = 10;
  const int ProcessingLoopRepetitions = 10;
  
  int isSimulationRunning = 0;
  
  msTimer delayedStart;
  const int delayedStartDuration = 30000;
}

/**********************************************************************************************************************
 *  ON START/STOP
 *********************************************************************************************************************/
on prestart
{
  @sysvar::EV_Sim::Control::SysEV_Connected = 0;
  EV.SetAdHocSendingEnabled.Call(0);
  @sysvar::EV_Sim::SysEV_BatteryState = 30;
  isSimulationRunning = 0;
  @Test::SysTestApplyControlMode = 0;
  
  if (isSimulated())
  {
    @sysvar::EV_Sim::SysEV_LinkStatus = 1;
  }
}

on start
{
  int i;
  
  for (i = 0; i < cStateResultsSize; ++i)  
  {
    stateResults[i] = -1;
  }
}

on preStop
{
  // Disconnect EV
  @sysvar::EV_Sim::Control::SysEV_Connected = 0;
  
  if (isSimulated())
  {
    @sysvar::EV_Sim::SysEV_LinkStatus = 0;
  }
}

/**********************************************************************************************************************
 *  ON SYSVAR
 *********************************************************************************************************************/

on sysvar EV_Sim::Control::SysEV_WaitResume
{
  if (@this == 1)
  {
    EV.StopSimulation.Call();
    @sysvar::EV_Sim::SysEV_SimState = 2;
  }
}

on sysvar EV_Sim::Control::SysEV_Reset
{
  EV.ResetSimulation.Call();
  @sysvar::EV_Sim::SysEV_SimState = 2;
}

on sysvar EV_Sim::Control::SysEV_Connected
{
  if (@this == 1)
  {    
    reReadAttributes();
    @sysvar::EV_Sim::Control::SysEV_WaitResume = 0;
    @sysvar::EV_Sim::SysEV_State = 0;    
    @sysvar::EV_Sim::SysEV_Error = 0;
    @sysvar::EV_Sim::SysEV_SimState = 0;

    if (@sysvar::IoTEnabler::SysEV_WifiClient_State == sysvar::IoTEnabler::SysEV_WifiClient_State::Connected || isSimulated())
    {
      EV.StartSimulation.Call();
    }
    else
    {
      write("Wifi Client is not connected yet, EV will start sending as soon as connection is established.");
      setTimer(delayedStart, delayedStartDuration);
    }
  }
  else
  {
    EV.ResetSimulation.Call();
    @sysvar::EV_Sim::SysEV_SimState = 2;
  }
  
  FUNC_EnableSchemaControls(!@this);
}

on timer delayedStart
{
  write("Wifi Client connection timeout, starting EV sending anyway.");
  EV.StartSimulation.Call();
}

on sysvar IoTEnabler::SysEV_WifiClient_State
{
  if (@sysvar::IoTEnabler::SysEV_WifiClient_State == sysvar::IoTEnabler::SysEV_WifiClient_State::Connected
      && @sysvar::EV_Sim::Control::SysEV_Connected
      && isTimerActive(delayedStart))
  {
    cancelTimer(delayedStart);
    EV.StartSimulation.Call();
  }
}

on sysvar EV_Sim::Control::SysEV_TriggerScheduleRenegotiation
{
  EV.ISO20.StartScheduleRenegotiation.Call(); //ScheduleRenegotiation starts as soon as this function is called
}

on sysvar EV_Sim::Control::SysEV_TriggerMeteringConfirmation
{
  if (@this == 1)
  {
    EV.ISO20.RequestMeteringConfirmation.Call(); 
  }
}

on sysvar EV_Sim::Control::SysEV_Stop
{
  CCS::Simulation::EV.StopChargeLoop.Call();
}

on sysvar EV_Sim::Control::SysEV_ClearBattery
{
  @sysvar::EV_Sim::SysEV_BatteryState = 1;
  $EV.ISO20.WPT_ChargeLoop_Request.DisplayParameters.PresentSOC = 1;
}

on sysvar EV_Sim::Control::SysEV_ChargeLoopInterval
{
  setAttribute(CCS::Simulation::EV, CCSBinding::ChargeLoopMessageDelayMs, @this);
}

on sysvar EV_Sim::Control::SysEV_CertificateInstallation
{
  setCertHandlingAttribute();
}

on sysvar EV_Sim::Control::SysEV_ControlModeDynamic
{
  if (@sysvar::EV_Sim::Control::SysEV_ControlModeDynamic == @sysvar::EV_Sim::Control::SysEV_ControlModeDynamic::Dynamic)
  {
    setAttribute(CCS::Simulation::EV, CCSBinding::EV::ControlMode, CCSBinding::Dynamic);
  }
  else
  {
    setAttribute(CCS::Simulation::EV, CCSBinding::EV::ControlMode, CCSBinding::Scheduled);
  }
}


/**********************************************************************************************************************
 *  ON V2G MESSAGE
 *********************************************************************************************************************/
// Manual selection of Service
on value_change EV.ISO20.ServiceDetail_Response
{
  if(IsEVRolePassive())
    return;
}

on value_update CCS::Simulation::EV.ISO20.WPT_ChargeParameterDiscovery_Response
{
  if(IsEVRolePassive())
    return;
  
  FUNC_Set_EVEnergyValues_ScheduleExchangeReq();
}

on value_update CCS::Simulation::EV.ISO20.ServiceSelection_Response
{
  if(IsEVRolePassive())
    return;
  
  FUNC_Set_EVWPTLimits_ChargeParameterDiscoveryReq();
}

on value_update CCS::Simulation::EV.ISO20.WPT_FinePositioningSetup_Request
{
  if(IsEVRolePassive())
    return;

  if (EVProcessingLoopCounter < ProcessingLoopRepetitions)
  {
   EVProcessingLoopCounter++; 
  }
  else
  {
    EVProcessingLoopCounter = 0;
    EV.ISO20.FinishProcessing.Call();
  }
}

on value_update CCS::Simulation::EV.ISO20.WPT_Pairing_Request
{
  if(IsEVRolePassive())
    return;

  if (EVProcessingLoopCounter < ProcessingLoopRepetitions)
  {
    EVProcessingLoopCounter++; 
  }
  else
  {
    EVProcessingLoopCounter = 0;
    EV.ISO20.FinishProcessing.Call();
  }
}
  
on value_update CCS::Simulation::EV.ISO20.WPT_AlignmentCheck_Request
{
  if(IsEVRolePassive())
    return;

  if (EVProcessingLoopCounter < ProcessingLoopRepetitions)
  {
    EVProcessingLoopCounter++; 
  }
  else
  {
    EVProcessingLoopCounter = 0;
    EV.ISO20.FinishProcessing.Call();
  }
}

on value_update CCS::Simulation::EV.ISO20.PowerDelivery_Request
{
  if(IsEVRolePassive())
    return;
  
  if (EVProcessingLoopCounter < ProcessingLoopRepetitions)
  {
   EVProcessingLoopCounter++; 
  }
  else
  {
    EVProcessingLoopCounter = 0;
    EV.ISO20.FinishProcessing.Call();
  }
}

on value_update EV.ISO20.PowerDelivery_Response
{
  if(IsEVRolePassive())
    return;
  
  FUNC_Set_EVChargeLoopValues(); 
}


on value_update EV.ISO20.WPT_ChargeLoop_Response
{
  if(IsEVRolePassive())
    return;
  
  
  if (@sysvar::EV_Sim::SysEV_BatteryState < $EV.ISO20.WPT_ChargeLoop_Request.DisplayParameters.MaximumSOC)
  {
   //charge
    setControlVisibility(gPanelName, gcontrolCharge, 1);
    setControlVisibility(gPanelName, gcontrolDischarge, 0);
    
    // slow down charging
    if (ChargeLoopDelay > ChargeLoopDelayValue)
    {
      @sysvar::EV_Sim::SysEV_BatteryState++;
              
      if (($EV.ISO20.WPT_ChargeLoop_Request.DisplayParameters.TargetSOC > @sysvar::EV_Sim::SysEV_BatteryState))
      {
        $EV.ISO20.WPT_ChargeParameterDiscovery_Request.Header.TimeStamp = $EV.ISO20.WPT_ChargeParameterDiscovery_Request.Header.TimeStamp;
      }
      
      ChargeLoopDelay = 0;
    }
    else
    {
      ChargeLoopDelay++;
    }
    
    if($EV.ISO20.WPT_ChargeLoop_Response.EVSEStatus.IsValid && $EV.ISO20.WPT_ChargeLoop_Response.EVSEStatus.EVSENotification == 3) //ScheduleRenegotiation
    {
      $EV.ScheduleRenegotiation.WPT_ChargeParameterDiscovery_Request.Header.TimeStamp = $EV.ScheduleRenegotiation.WPT_ChargeParameterDiscovery_Request.Header.TimeStamp;
    }
  }
  else
  {
    CCS::Simulation::EV.StopChargeLoop.Call();
  }
  
  $EV.ISO20.WPT_ChargeLoop_Request.DisplayParameters.PresentSOC = @sysvar::EV_Sim::SysEV_BatteryState;
  FUNC_Set_EVChargeLoopValues();
}


/**********************************************************************************************************************
 *  ON METHODE
 *********************************************************************************************************************/
on fct_called EV.OnLastReceivedMessageIdChanged
{
  @Common::LastReceivedMessageId = $EV.OnLastReceivedMessageIdChanged.LatestCall.lastRxMessageId;
	ValidateProtocolPanel($EV.OnLastReceivedMessageIdChanged.LatestCall.lastRxMessageId);
  
  switch ($EV.OnLastReceivedMessageIdChanged.LatestCall.lastRxMessageId)
  {
    
    case _CCS::DataTypes::SECCDiscoveryWirelessRes:
      @sysvar::EV_Sim::SysEV_State = 6;
      break;
      
    // V2G messages
    case _CCS::DataTypes::SupportedAppProtocolRes: 
      @sysvar::EV_Sim::SysEV_State = 7;
      break;
      
    case _CCS::DataTypes::SessionSetupRes:
      @sysvar::EV_Sim::SysEV_State = 8;
      break;
      
    case _CCS::DataTypes::AuthorizationSetupRes:
      @sysvar::EV_Sim::SysEV_State = 9;
      break;
      
    case _CCS::DataTypes::CertificateInstallationRes:
      @sysvar::EV_Sim::SysEV_State = 10;
      break;  
      
    case _CCS::DataTypes::AuthorizationRes:
      @sysvar::EV_Sim::SysEV_State = 11;
      break; 
      
    case _CCS::DataTypes::ServiceDiscoveryRes:    
      @sysvar::EV_Sim::SysEV_State = 12;
      break; 
      
    case _CCS::DataTypes::ServiceDetailRes:
      @sysvar::EV_Sim::SysEV_State = 13;
      break;
      
    case _CCS::DataTypes::ServiceSelectionRes:
      @sysvar::EV_Sim::SysEV_State = 14;
      break;  
     
    case _CCS::DataTypes::WPTChargeParameterDiscoveryRes:
      @sysvar::EV_Sim::SysEV_State = 15;
      break;
      
    case _CCS::DataTypes::ScheduleExchangeRes:
      @sysvar::EV_Sim::SysEV_State = 16;
      break;
      
    case _CCS::DataTypes::PowerDeliveryRes:   
      @sysvar::EV_Sim::SysEV_State = 19;
      break;  
      
    case _CCS::DataTypes::WPTChargeLoopRes:
      @sysvar::EV_Sim::SysEV_State = 20;
      break;  
      
    case _CCS::DataTypes::MeteringConfirmationRes:
      @sysvar::EV_Sim::SysEV_State = 21;
      break; 
      
    case _CCS::DataTypes::SessionStopRes:
      @sysvar::EV_Sim::SysEV_State = 23;
      break;  

    default:
      // Ignore
      break;
  } 
}

/**********************************************************************************************************************
 *  HELPER FUNCTIONS
 *********************************************************************************************************************/


void FUNC_EnableSchemaControls( int enabled)
{
  enableControl(gPanelName, "sw_BPT", enabled);
  enableControl(gPanelName, "sw_ACDC", enabled);
  enableControl(gPanelName, "sw_Dynamic", enabled);
  enableControl(gPanelName, "sw_Scheduled", enabled);
}

ValidateProtocolPanel(int lastRxMessageId)
{
  if (0 <= @sysvar::Common::SysProtocolBar)
  {
    // show/hide result labels
    if (@sysvar::Common::SysProtocolBar::SessionSetup <= @sysvar::Common::SysProtocolBar)
    {          
      // update response code label
      snprintf(labelNameOK, 50, "TResult%iOK", @sysvar::Common::SysProtocolBar); 
      snprintf(labelNameNOK, 50, "TResult%iNOK", @sysvar::Common::SysProtocolBar);
      
      // check if a FAIL was already written, then do not overwrite
      if (stateResults[@sysvar::Common::SysProtocolBar] != 0)
      { 
        if(
            (lastRxMessageId == _CCS::DataTypes::SupportedAppProtocolRes && CheckSAPResponseCode(lastRxMessageId) == 0) || //Check response code for SAP response
            (lastRxMessageId != _CCS::DataTypes::SupportedAppProtocolRes && CheckResponseCode(lastRxMessageId) == 0)       //Check response code for other messages
          )
        {
          // Responscode = OK
          setControlVisibility(gProtocolPanelName, labelNameNOK, 0);
          setControlVisibility(gProtocolPanelName, labelNameOK, 1);     
  
          stateResults[@sysvar::Common::SysProtocolBar] = 1;
        }
        else 
        {
          // Responscode = Failed
          setControlVisibility(gProtocolPanelName, labelNameOK, 0);
          setControlVisibility(gProtocolPanelName, labelNameNOK, 1);       
          
          stateResults[@sysvar::Common::SysProtocolBar] = 0;
        }   
      }
    }
  }
}

int CheckResponseCode(int lastRxMessageId)
{
  if ((GetResponseCode(lastRxMessageId) == _CCS::DataTypes::ISO20ResponseCodeType::OK)
       || (GetResponseCode(lastRxMessageId) == _CCS::DataTypes::ISO20ResponseCodeType::OK_CertificateExpiresSoon)
       || (GetResponseCode(lastRxMessageId) == _CCS::DataTypes::ISO20ResponseCodeType::OK_NewSessionEstablished)
       || (GetResponseCode(lastRxMessageId) == _CCS::DataTypes::ISO20ResponseCodeType::OK_OldSessionJoined)
       || (GetResponseCode(lastRxMessageId) == _CCS::DataTypes::ISO20ResponseCodeType::OK_PowerToleranceConfirmed))
  {
    return 0;
  }
  
  return 1;  
}

int CheckSAPResponseCode(int lastRxMessageId)
{
  if (GetResponseCode(lastRxMessageId) != _CCS::DataTypes::SAPResponseCodeType::FAILED_NoNegotiation)
  {
    return 0;
  }
  
  return 1;  
}

int GetResponseCode(int lastEVRxMessageId)
{  
  int responseCode = 0;
  
  switch (lastEVRxMessageId)
  {
    case _CCS::DataTypes::SupportedAppProtocolRes: 
      responseCode = $EV.SAP.SupportedAppProtocol_Response.ResponseCode;
      break;
      
    case _CCS::DataTypes::SessionSetupRes:
      responseCode = $EV.ISO20.SessionSetup_Response.ResponseCode;
      break;
      
    case _CCS::DataTypes::WPTFinePositioningSetupRes: 
      responseCode = $EV.ISO20.WPT_FinePositioningSetup_Response.ResponseCode;
      break;
      
    case _CCS::DataTypes::WPTFinePositioningRes: 
      responseCode = $EV.ISO20.WPT_FinePositioning_Response.ResponseCode;
      break;
      
    case _CCS::DataTypes::AuthorizationSetupRes: 
      responseCode = $EV.ISO20.AuthorizationSetup_Response.ResponseCode;
      break;
      
    case _CCS::DataTypes::AuthorizationRes:
      responseCode = $EV.ISO20.Authorization_Response.ResponseCode;
      break; 
        
    case _CCS::DataTypes::WPTChargeParameterDiscoveryRes: 
      responseCode = $EV.ISO20.WPT_ChargeParameterDiscovery_Response.ResponseCode;
      break; 
      
    case _CCS::DataTypes::WPTPairingRes:         
      responseCode = $EV.ISO20.WPT_Pairing_Response.ResponseCode;
      break; 
      
    case _CCS::DataTypes::ServiceDiscoveryRes:    
      responseCode = $EV.ISO20.ServiceDiscovery_Response.ResponseCode;
      break;
      
    case _CCS::DataTypes::ServiceDetailRes:
      responseCode = $EV.ISO20.ServiceDetail_Response.ResponseCode;
      break;
      
    case _CCS::DataTypes::ServiceSelectionRes:
      responseCode = $EV.ISO20.ServiceSelection_Response.ResponseCode;
      break;
      
    //Not supported yet
    case _CCS::DataTypes::CertificateInstallationRes:      
      //responseCode = $EV.ISO20.CertificateInstallation_Response.ResponseCode;
      break;        
     
    case _CCS::DataTypes::ScheduleExchangeRes:
      responseCode = $EV.ISO20.ScheduleExchange_Response.ResponseCode;
      break;    
      
    case _CCS::DataTypes::WPTAlignmentCheckRes: 
      responseCode = $EV.ISO20.WPT_AlignmentCheck_Response.ResponseCode;
      break; 
    
    //Not supported yet
    case _CCS::DataTypes::MeteringConfirmationRes:
      //responseCode = $EV.ISO20.MeteringConfirmation_Response.ResponseCode;
      break;        
              
    case _CCS::DataTypes::PowerDeliveryRes:   
      responseCode = $EV.ISO20.PowerDelivery_Response.ResponseCode;
      break;
      
    case _CCS::DataTypes::WPTChargeLoopRes: 
      responseCode = $EV.ISO20.WPT_ChargeLoop_Response.ResponseCode;
      break;
     
    case _CCS::DataTypes::SessionStopRes:
      responseCode = $EV.ISO20.SessionStop_Response.ResponseCode;
      break;    

    default:
      /* Button was pressed during SLAC. Next message with ResponseCode is SupportedAppProtocol */
      responseCode = $EV.SAP.SupportedAppProtocol_Response.ResponseCode;
      break;
  }
  
  return responseCode;
}

on key 'n'
{
  if(isSimulationRunning == 0)
  {
    @sysvar::EV_Sim::Control::SysEV_Connected = 1;
    isSimulationRunning = 1;
  }
  else
  {
    @sysvar::EV_Sim::Control::SysEV_Connected = 0;
    isSimulationRunning = 0;
  }
}