/*@!Encoding:1252*/
includes
{
  #include "EVSE_MsgCallbacks.cin"
  #include "CharIn_HW_InterfaceVTS_EVSE.cin"
  #include "MessageIDs.cin"
  #include "EV_Sendfunctions.cin"
  #include "EVSE_Sendfunctions.cin"
  #include "Sendfunctions_Common.cin"
  #include "Util.cin"
}

variables
{  
  dword writeTab;  // Sink identifier
  
  long lTemp;
  char strBuffer1[100], strBuffer2[100], strBuffer3[100];
  char DCStatusCode[32];
  
  int isDIN = 0;
  int isISO_IS = 0;
  int isPncMode = 0;

  byte SessionId2[8];

  char gPanelName[5] = "EVSE";
  char gProtocolPanelName[12] = "Protocol";
    
  long isSimulationStarted = 0;
  int isPassiveMode = 0;

  char evseConnections[256];
   
  msTimer tProcessingTime;
  msTimer tPreCharge;
  msTimer tMessageTx; 
  msTimer tInvalidMessage;
  msTimer tVerification;
  msTimer tRestartAfterReset;
  msTimer tDelayedStart;
  
  const int processingTimeForContractAuthentication = 3000;
  const int processingTimeForCableCheck = 2500;
  const int processingTimeForChargeParameterDiscovery = 4000;
  const int processingTimeForPowerDelivery = 3000;
  const int processingTimeMaxJitter = 2000;
  
  const cStartAfterEthernetLinkUp = 1000; //[ms]
  
  const int tPreChargeTime = 75;   // [ms]
  float fPreChargeTargetVoltage = 0;
   
  enum eProcessing
  {
    ProcessingNone = 0,
    ProcessingActive = 1,
    ProcessingFinished = 2,
    ProcessingMoving = 3,             // OppCharge pantograph is moving
    ProcessingEndPositionReached = 4  // OppCharge pantograph has reached it'S end position (up or down)
  };
  
  enum eProcessing processing = ProcessingNone;

  int chargeLoopCount = 0;
    
  char errorCode[10] = "FAILED";
  
  long tPantographMovingTime = 8000;
  msTimer tPantographMovingTimer;
  
  enum eMode
  {
    Ready = 0,
    Charging = 1,
    Error = 2
  };
  
  enum eMode Mode = Ready;

  msTimer tDelayed_CP_PP;
  const cCP_PP_Delay = 10000;

  msTimer tOpenContactors;
  const cOpenContactorsDelay = 500;
  const cAdditionMeasurementStopDelay = 100;
}

// ==========================================================================================
//   Initialization
// ==========================================================================================

on preStart
{
  if (@sysVar::Common::SysVerboseWrite)
    SCC_SetVerbosity(5);
  else
    SCC_SetVerbosity(2);

  @sysVar::EVSE_Sim::Control::SysEVSE_WaitResume = 0;
  @sysVar::Test::SysTestApplyControlMode = 0;
  @sysVar::SLAC_Test::SysStartSLACTest = 0;
  
  UpdateSimState();
  
  ST_Init();
}

on preStop
{
  ST_Init();
  Reset_CP_PP();
  SetChargingStationPicturesVisibility(Ready);
  
  if(!isSimulated())
  {
    HV_reduce_VoltageAndCurrent();
    deferStop(cOpenContactorsDelay + cAdditionMeasurementStopDelay);
    setTimer(tOpenContactors, cOpenContactorsDelay);
  }
}

on start
{
  writeTab = WriteCreate("SCC EVSE");    // same name as tab created by nodelayer

  @sysvar::Test::SysErrorIndEVSE = 0;
  
  PrintEthernetSettings("EVSE");
  ReadEVSEStatus();
    
  // Apply test function schema
  enableControl("Send functions EVSE", "BMeteringReceiptDC", @sysVar::Test::SysTestSchema);
  
  if(@EVSE_Sim::SysEVSE_AC_PWM_Activate == 1)
  {
    StartBasicCharging();
  }
  else
  {
    // Apply "chip present" (which is off by default)
    if(isSimulated())
    {
      @sysvar::Common::VT_Access::ChipPresent = 0;
      StartSimulation();      
    }
    else
    {
      @sysvar::Common::VT_Access::ChipPresent = 1;
      setTimer(tDelayedStart, cStartAfterEthernetLinkUp);  //start simulation after "cStartAfterEthernetLinkUp" to ensure ethernet link is up
    }
  }
  
  // Reset power
  @sysVar::EVSE_Sim::SysEVSE_PresentVoltage = 0;
  @sysVar::EVSE_Sim::SysEVSE_PresentCurrent = 0;
}

on timer tDelayedStart
{
  StartSimulation();
}

void StartSimulation()
{  
  SCC_StartSimulation();
  isSimulationStarted = 1;
  
  @sysVar::EVSE_Sim::SysEVSE_LinkStatus = 0;
  
  ApplyMessageDelay();
  
  @sysvar::EVSE_Sim::SysEVSE_Processing = 0;
  SetProcessing(0, 0);

  SetControlForeColor(gPanelName, "TEnabled", MakeRGB(72, 72, 72));  

  strncpy(evseConnections, "", 256);
  SysSetVariableString(sysVar::EVSE_Sim::SysEVSE_Connections, evseConnections);
  
  UpdateSimState();
  
  setTimer(tDelayed_CP_PP, cCP_PP_Delay);

  SetChargingStationPicturesVisibility(Ready);
  
  if(@Common::SysUserChargingMode == @Common::SysUserChargingMode::AC)
    HV_source_set_AC_frequency();

  SCC_SLAC_SetChipPresent(@sysvar::Common::VT_Access::ChipPresent);
}

on sysvar_change Common::SysUserChargingMode
{
  if(@this == @Common::SysUserChargingMode::AC)
    HV_source_set_AC_frequency();
}

// ==========================================================================================
//   Status callbacks from simulation DLL
// ==========================================================================================

// generic host indication for all supported PLCs
/// <Callbacks_general>
void SCC_Generic_VS_HostMessage_Ind( byte sourceMacAddess[], dword hostMessage )
{
  // Device is ready to communicate on power line but may not be a member of an AVLN yet. 
  const byte PLC_READY_TO_JOIN_AVLN = 0x01;
  // Device is ready to communicate on power line but may not be a member of an AVLN yet. 
  const byte PLC_AVLN_JOINED = 0x02;
  // Device is disconnected from  an AVLN and there are no peers available. 
  const byte PLC_AVLN_DISCONNECTED = 0x03;  
  
  if (hostMessage == PLC_AVLN_JOINED)
  {
    @sysVar::EVSE_Sim::SysEVSE_LinkStatus = 1;
    SCC_SLAC_SetLinkStatus(1);
  }
  else
  {
    @sysVar::EVSE_Sim::SysEVSE_LinkStatus = 0;
    SCC_SLAC_SetLinkStatus(0);
  } 

  if((hostMessage == PLC_READY_TO_JOIN_AVLN) && isTimerActive(tDelayed_CP_PP))
  {
    cancelTimer(tDelayed_CP_PP);
    ConnectAndApply_CP_PP();
  }
  
  WriteLineEx(writeTab, 1, "EVSE: Link status changed to %i", @sysVar::EVSE_Sim::SysEVSE_LinkStatus);
}

SCC_ProtocolFinishedInd( byte SessionId[])
{
  WriteLineEx(writeTab, 1, "EVSE: Protocol finished!");
}

SCC_ConnectionTimeoutInd( byte SessionId[])
{  
  WriteLineEx(writeTab, 2, "EVSE: Connection closed due to inactivity");
}

void SCC_MessageRxInd(byte SessionID[], dword MessageID)
{
  SetLastMessageID(MessageID);
  if(MessageID == 101)
    SetChargingStationPicturesVisibility(Charging);
}

SCC_MessageTxInd( byte SessionID[], dword messageId, long error)
{
  /*
  WriteHex(strBuffer, SessionID);
  WriteLineEx(writeTab, 0, "EVSE: Message Tx: Session Id = %s, result = %i", strBuffer1, error);
  */   
  
  @sysvar::EVSE_Sim::SysEVSE_MessageTx = 1;
  setTimer(tMessageTx, 150);
  
  if (error > 0){
    WriteLineEx(writeTab, 2, "EVSE: Message sending of type %0x failed: %i", messageId, error); 
    SetChargingStationPicturesVisibility(Error);
  }
  else
  {
    if(messageId == 34)
     SetChargingStationPicturesVisibility(Ready);
  }
}

SCC_SLACFinishedInd( dword Result )
{
  if (Result)
    WriteLineEx(writeTab, 1, "EVSE: SLAC finished, result : OK");
  else
    WriteLineEx(writeTab, 1, "EVSE: SLAC finished, result : FAILED");
  
  WriteLineEx(writeTab, 1, "EVSE: Waiting for link state = 1");
}

SCC_PreSendInd( byte SessionId[], dword MessageId, char ResponseCode[] )
{
  if (ShallWrite())
    WriteLineEx(writeTab, 0, "Pre Send Ind: Message ID = %i, Response Code = %s", MessageId, ResponseCode);  
  
  sysSetVariableString(sysvar::Common::LastReceivedResponseCode, ResponseCode);
  SetChargingStationPictureError(ResponseCode);
}

SCC_SchemaSelectionInd( char SchemaNamespace[], dword VersionMajor, dword VersionMinor)
{
  int targetConfig = 0;
  
  isDIN = 0;
  isISO_IS = 0;
  
  WriteLineEx(writeTab, 1, "Schema Selected: %s, %i.%i", SchemaNamespace, VersionMajor, VersionMinor);
  
  // There is no session ID assigned yet so we cannot address the connection.
  // Set the schema namespace for all active connections.

  // Switch config dependent on protocol version
  if (strncmp(SchemaNamespace, "urn:iso:15118:2:2013:MsgDef", strlen("urn:iso:15118:2:2013:MsgDef")) == 0
    && VersionMajor == 2)
  {
    targetConfig = 0;
    isISO_IS = 1;
  }
  else //if (strncmp(SchemaNamespace, "urn:din:70121:2012:MsgDef", strlen("urn:din:70121:2012:MsgDef")) == 0)
  {
    targetConfig = 1;
    isDIN = 1;
  }  

  if (SCC_LoadV2GConfig(targetConfig))     // session ID = 0
    WriteLineEx(writeTab, 1, "Switching to config %i", targetConfig);  
}

SCC_TCPConnectInd( dword Port, long isSender)
{
  if (isSender)    // cannot happen here
    WriteLineEx(writeTab, 1, "EVSE: TCP connection established on port %i", Port);
  else
    WriteLineEx(writeTab, 1, "EVSE: TCP client connected to port %i", Port);
}

SCC_TCPShutdownInd( dword Port, long isSender)
{
  if (isSender)
    WriteLineEx(writeTab, 1, "EVSE: TCP connection on port %i closed", Port);
  else
    WriteLineEx(writeTab, 1, "EVSE: TCP connection on port %i was closed by remote station", Port);
  
  HV_reduce_VoltageAndCurrent();
  setTimer(tOpenContactors, cOpenContactorsDelay);
}

SCC_InvalidMessageInd ( long MessageType, long ErrorCode)
{
  @Sysvar::Test::SysErrorIndEVSE = 1;
  setTimer(tInvalidMessage, 3000);    
  
  if (ErrorCode == 0)    
    WriteLineEx(writeTab, 1, "EVSE: Invalid message received - wrong version number or format!");
  else if (ErrorCode == 1)
    WriteLineEx(writeTab, 1, "EVSE: Invalid message received - unknown payload type!");
  else if (ErrorCode == 2)
    WriteLineEx(writeTab, 1, "EVSE: Invalid message received - invalid payload length!");
  else if (ErrorCode == 3)
    WriteLineEx(writeTab, 1, "EVSE: Invalid message received - decoding error");
  
  SetChargingStationPicturesVisibility(Error);
}  

SCC_SignaturePreSendInd( byte SessionID[], dword messageId, byte Signature[], dword& SignatureLength)
{  
  WriteLineEx(writeTab, 1, "EVSE: Signature of length %i created for Message ID = %d", SignatureLength, messageId); 
}

SCC_SignatureVerificationInd( dword MessageID, dword Result)
{
  setControlVisibility(gPanelName, "Verification", 1);
  setTimer(tVerification, 1000);
}

SCC_CertChainVerificationInd( byte SessionId[], char chainName[], dword Result )
{  
  int i;
  char certName[255];
  dword errorCode;
  
  if (Result > 0)
  {
    WriteLineEx(writeTab, 1 /* info */, "%s verified, result: OK", chainName);
  }
  else
  { 
    WriteLineEx(writeTab, 2 /* warning */, "%s verified, result: FAILED", chainName);
    
    for (i = 0; i < SCC_GetCertChainVerificationErrorCount(); ++i)
    {
      SCC_GetCertChainVerificationError(i, certName, errorCode);      
      WriteLineEx(writeTab, 2 /* warning */, "  Error %i was found in certificate %s", errorCode, certName );
    }
  }
}

// ==========================================================================================
//   Helper functions
// ==========================================================================================

void ApplyPaymentOptions()
{
  if (@sysvar::EVSE_Sim::Control::SysEVSE_PaymentOptions == 0)
  {
    SCC_SetExternalPaymentAllowed(1);
    SCC_SetContractPaymentAllowed(0);
  }
  else if (@sysvar::EVSE_Sim::Control::SysEVSE_PaymentOptions == 1)
  {
    SCC_SetExternalPaymentAllowed(0);
    SCC_SetContractPaymentAllowed(1);
  }
  else
  {
    SCC_SetExternalPaymentAllowed(1);
    SCC_SetContractPaymentAllowed(1);
  }
}

void GenerateNMK()
{ 
  byte nmk[16];
  byte nid[7];
  
  SCC_SLAC_GetKeyData(nid, nmk);
  
  WriteHex(strBuffer1, nmk); 
  WriteHex(strBuffer2, nid); 
  
  // read NMK and NID from chip, before new key is set
  WriteLineEx(writeTab, 0, "Generating key, old key is: %s (NID: %s)", strBuffer1, strBuffer2);
  
  SCC_SLAC_GenerateApplyKey();  
  SCC_SLAC_GetKeyData(nid, nmk);
  
  WriteHex(strBuffer1, nmk); 
  WriteHex(strBuffer2, nid); 
  
  // read new NMK and NID from chip
  WriteLineEx(writeTab, 0, "Generated new key: %s (NID: %s)", strBuffer1, strBuffer2);
}

void UpdateSimState()
{
  lTemp = SCC_GetSimulationState();
    
  if (lTemp == 2)
    @sysvar::EVSE_Sim::SysEVSE_SimState = 0;
  else if (lTemp == 3)
    @sysvar::EVSE_Sim::SysEVSE_SimState = 1;
  else
    @sysvar::EVSE_Sim::SysEVSE_SimState = 2;    
}

void UpdateConnections()
{  
  long connectionCount;
  byte sessionIdTemp[8];
  char sessionIdTempChar[17];
  
  // Note: this functions works only in active mode!
  if (@sysvar::Test::SysTestApplyControlMode)
    return;
  
  connectionCount = SCC_GetConnectionCount();
  @sysVar::EVSE_Sim::SysEVSE_ConnectionCount = connectionCount;

  if (connectionCount == 0)
    SetControlForeColor(gPanelName, "TEnabled", MakeRGB(72, 72, 72));
  else
    SetControlForeColor(gPanelName, "TEnabled", MakeRGB(192, 0, 0));

  strncpy(evseConnections, "", 256);
  
  for (lTemp = 0; lTemp < connectionCount; ++lTemp)
  {
    SCC_GetSessionId(lTemp, sessionIdTemp);

    // Remember IDs of current sessions
    //  (store only the newest connections, as sometimes old connections stay open)
    if (lTemp == connectionCount - 2)
      memcpy(SessionId2, sessionIdTemp, 8);      
    else if (lTemp == connectionCount - 1)
      memcpy(SessionId, sessionIdTemp, 8);
    
    WriteHex(sessionIdTempChar, sessionIdTemp);
    sessionIdTempChar[16] = '\0';
    strncat(evseConnections, sessionIdTempChar, 256);

    SysSetVariableString(sysVar::EVSE_Sim::SysEVSE_Connections, evseConnections);
  } 
}

ReadEVSEStatus()
{
  // Print DC status code 
  strncpy(DCStatusCode, "                                 ", 32);
  SCC_GetDCStatusCode(DCStatusCode);
  SysSetVariableString(sysVar::EVSE_Sim::SysEVSE_DCStatusCode, DCStatusCode);
}

void SetProcessing( int startProcessing, int avgTime)
{  
  dword jitterTime;  
  jitterTime = random(processingTimeMaxJitter) - processingTimeMaxJitter/2;
    
  @sysvar::EVSE_Sim::SysEVSE_Processing = startProcessing;
  
  if (startProcessing && processing == ProcessingNone)
  {
    processing = ProcessingActive;
    SCC_SetProcessing(1);
    SetControlForeColor(gPanelName, "TProcessing",  MakeRGB(0, 0, 255)); 
      
    setTimer(tProcessingTime, _max(avgTime + jitterTime, 1)); 
  }  
  else
  { 
    SCC_SetProcessing(0);
    SetControlForeColor(gPanelName, "TProcessing",  MakeRGB(255, 255, 255));  
    
    cancelTimer(tProcessingTime);
  } 
}

void PantographStartMoving()
{
  WriteLineEx(writeTab, 0, "CableCheckReq Pantogrpah started moving" );  
  setTimer( tPantographMovingTimer, tPantographMovingTime);
}

void SetChargingStationPicturesVisibility(int Mode)
{
  SetControlVisibility(gPanelName, "picturePanto", 1);
}

void SetChargingStationPictureError(char ResponseCode[])
{
  if (strncmp(ResponseCode, "OK", 2) != 0)
      SetChargingStationPicturesVisibility(Error);
}
// ==========================================================================================
//   Timers
// ==========================================================================================

on timer tMessageTx
{  
  @sysvar::EVSE_Sim::SysEVSE_MessageTx = 0;
}

on timer tInvalidMessage
{  
  @Sysvar::Test::SysErrorIndEVSE = 0;
}

on timer tVerification
{
  setControlVisibility(gPanelName, "Verification", 0);
}

on timer tPreCharge
{	
  // Adapt voltage until requested voltage is matched
  if (fPreChargeTargetVoltage >= (@sysVar::EVSE_Sim::SysEVSE_PresentVoltage + 5))
    @sysVar::EVSE_Sim::SysEVSE_PresentVoltage += 5;
  else if (fPreChargeTargetVoltage <= (@sysVar::EVSE_Sim::SysEVSE_PresentVoltage - 5))
    @sysVar::EVSE_Sim::SysEVSE_PresentVoltage -= 5;
  
  if (abs(fPreChargeTargetVoltage - @sysVar::EVSE_Sim::SysEVSE_PresentVoltage) >= 5)   // +=5 is not yet applied!
    setTimer(tPreCharge, tPreChargeTime);
}

on timer tProcessingTime
{ 
  processing = ProcessingFinished;
  SetProcessing(0, 0);
}

on timer tRestartAfterReset
{
  if(@EVSE_Sim::SysEVSE_AC_PWM_Activate == 1)
    StartBasicCharging();
  else
    StartSimulation();
 
  @sysVar::EVSE_Sim::Control::SysEVSE_WaitResume = 0;
}

on timer tPantographMovingTimer
{
  processing = ProcessingEndPositionReached;
  WriteLineEx(writeTab, 0, "Pantogrpah stopped moving" );  
}

on timer tOpenContactors
{
  HV_OpenContactors();
}

on timer tDelayed_CP_PP
{
  ConnectAndApply_CP_PP();
}

// ==========================================================================================
//   System variable handlers (simulation <-> GUI)
// ==========================================================================================

on sysvar EVSE_Sim::SysEVSE_StopCharging
{ 
  SCC_SetShutdownRequest(@this);
  
  if (@this == 1)
  {
    SCC_SetDCStatusCode("EVSE_Shutdown");

    if(@sysvar::EVSE_Sim::SysEVSE_AC_PWM_Activate == 1)
    {
      CP_EVSE_set_Dutycycle(0);
    }
  }
}

on sysvar EVSE_Sim::Control::SysEVSE_ReturnFailed
{  
  if (@this == 1)
  {
    SCC_SetResponseCode(errorCode);
    SetChargingStationPicturesVisibility(Error);
  }
}

on sysvar EVSE_Sim::Control::SysEVSE_AbortConnection
{
  if (@this == 1){
    SCC_StopSession(1 /* close TCP */);
    SetChargingStationPicturesVisibility(Error); 
  }
}

on sysvar EVSE_Sim::Control::SysEVSE_NewNMK
{
  if (@this == 1)
  {
    GenerateNMK();
    
    @EVSE_Sim::Control::SysEVSE_NewNMK = 0;
  }
}

on sysvar EVSE_Sim::Control::SysEVSE_WaitResume
{
  if(@this == 0)
    SCC_SimulationResume();
  else
    SCC_SimulationWait();
  
  UpdateSimState();
}

on sysvar EVSE_Sim::SysEVSE_MinVoltage
{
  SCC_SetMinVoltage(@this);
}

on sysvar EVSE_Sim::SysEVSE_MaxVoltage
{
  SCC_SetMaxVoltage(@this);
}

on sysvar EVSE_Sim::SysEVSE_MinCurrent
{
  SCC_SetMinCurrent(@this);
}

on sysvar EVSE_Sim::SysEVSE_MaxCurrent
{
  if(@Common::SysUserChargingMode == @Common::SysUserChargingMode::DC)
    SCC_SetMaxCurrent(@this);
}

on sysvar EVSE_Sim::SysEVSE_MaxCurrent_AC
{
  if(@Common::SysUserChargingMode == @Common::SysUserChargingMode::AC)
    SCC_SetMaxCurrent(@this);
}

on sysvar EVSE_Sim::SysEVSE_MaxPower
{
  SCC_SetMaxPower(@this * 1000);    // variable in [kW]
}

on sysvar EVSE_Sim::SysEVSE_CurrentRegulationTolerance
{
  SCC_SetCurrentRegulationTolerance(@this);
}

on sysvar EVSE_Sim::SysEVSE_PeakCurrentRipple
{
  SCC_SetPeakCurrentRipple(@this);
}

on sysvar EVSE_Sim::SysEVSE_PresentCurrent
{
  SCC_SetPresentCurrent(@this);
}

on sysvar EVSE_Sim::SysEVSE_PresentVoltage
{
  SCC_SetPresentVoltage(@this);
}

on sysvar EVSE_Sim::Control::SysEVSE_Reset
{
  if (@this == 0)
    return;
  
  ResetSimulation();
}

ResetSimulation()
{
  SCC_SimulationReset();
  
  Reset_CP_PP();

  // allow TCP shutdown to take place before restarting and setting new key
  setTimer(tRestartAfterReset, 100);
}

on sysvar EVSE_Sim::Control::SysEVSE_Renegotiate
{
  if (@this == 1)
	  SCC_SetEVSENotification("ReNegotiation");
}

on sysvar EVSE_Sim::Control::SysEVSE_PaymentOptions
{
  ApplyPaymentOptions();
}

on sysVar Test::SysTestApplyControlMode
{
  if (@this == 1)
  {    
    SCC_SimulationReset();
    
    if (@sysVar::Test::SysTestControlledEntity != 0)
    {      
      isPassiveMode = 1;
      SCC_StartPassive();
    }
    else if (@sysvar::EVSE_Sim::SysEVSE_AC_PWM_Activate == 0)
    {
      SCC_StartSimulation();
    }
  
    // apply "chip present" (which is off by default)
    SCC_SLAC_SetChipPresent(@sysvar::Common::VT_Access::ChipPresent);
  }  
}

on sysVar SLAC_Test::SysStartSLACTest
{  
  if (@this == 1)
  {
    SCC_SimulationReset();    
    isPassiveMode = 1;
    SCC_StartPassive(0 /* start with manual SLAC */);    
  }
}

on sysVar Common::SysMessageDelay
{
  ApplyMessageDelay();
}

on sysVar Common::SysMessageDelayJitter
{
  ApplyMessageDelay();
}


on sysvar Common::SysVerboseWrite
{  
  if (@this)
    SCC_SetVerbosity(5);
  else
    SCC_SetVerbosity(2);
}

on sysvar Common::VT_Access::ChipPresent
{
  // toggled from VT_EVSE node to disable simulated attenuation
  SCC_SLAC_SetChipPresent(@this);
}

// Functions to switch sender roles in Test

int IsEVRoleActive()
{
  return @sysvar::Test::SysTestSwitchRoles == 1;
}

int IsEVSERoleActive()
{
  return @sysvar::Test::SysTestSwitchRoles == 0;
}

FUNC_AC_PWM_Calculate_DutyCycle()
{
  /* Implementation according to Table A.8 from IEC 61851-1 */
  double dutyCycle = 0;
  if ((@sysvar::EVSE_Sim::SysEVSE_AC_PWM_MaxCurrent > 1) && (@sysvar::EVSE_Sim::SysEVSE_AC_PWM_MaxCurrent <= 6))
  {
    dutyCycle = 10;
  }
  else if ((@sysvar::EVSE_Sim::SysEVSE_AC_PWM_MaxCurrent > 6) && (@sysvar::EVSE_Sim::SysEVSE_AC_PWM_MaxCurrent <= 51))
  {
    dutyCycle = @sysvar::EVSE_Sim::SysEVSE_AC_PWM_MaxCurrent/0.6;
  }
   else if ((@sysvar::EVSE_Sim::SysEVSE_AC_PWM_MaxCurrent > 51) && (@sysvar::EVSE_Sim::SysEVSE_AC_PWM_MaxCurrent <= 80))
  {
    dutyCycle = (@sysvar::EVSE_Sim::SysEVSE_AC_PWM_MaxCurrent/2.5) + 64;
  }
  else
  {
    dutyCycle = 0;
  }
  
  CP_EVSE_set_Dutycycle(dutyCycle);
}

on sysvar_update EVSE_Sim::SysEVSE_AC_PWM_MaxCurrent
{
  if (@sysvar::EVSE_Sim::SysEVSE_AC_PWM_Activate == 1)
  {
    FUNC_AC_PWM_Calculate_DutyCycle();
  }
}

on sysvar_update EVSE_Sim::SysEVSE_AC_PWM_Activate
{
  ResetSimulation();
}

StartBasicCharging()
{
  ST_Init();
  CP_EVSE_set_open_circuit(1);
  CP_EVSE_set_Voltage(12);
  FUNC_AC_PWM_Calculate_DutyCycle();
  HV_source_set_AC_frequency();
  HV_source_set_U_L1_rms(@EVSE_Sim::SysEVSE_NominalVoltage);
  HV_source_set_U_L2_rms(@EVSE_Sim::SysEVSE_NominalVoltage);
  HV_source_set_U_L3_rms(@EVSE_Sim::SysEVSE_NominalVoltage);
  HV_set_AC_relays(1);
  PP_EVSE_set_resistance(@EVSE_Sim::SysEVSE_PP_resistance);
}

ConnectAndApply_CP_PP()
{
  CP_EVSE_set_open_circuit(1);
  PP_EVSE_set_open_circuit(1);
  
  CP_EVSE_set_Dutycycle(5);
  CP_EVSE_set_Voltage(12);
  CP_EVSE_set_Oscillator(1);
  PP_EVSE_set_resistance(@EVSE_Sim::SysEVSE_PP_resistance);
}

Reset_CP_PP()
{
  CP_EVSE_set_Voltage(0);
  CP_EVSE_set_Oscillator(0);
  CP_EVSE_set_open_circuit(0);
  PP_EVSE_set_open_circuit(0);
  CP_EVSE_set_Dutycycle(0);
  PP_EVSE_set_resistance(0);
}

HV_reduce_VoltageAndCurrent()
{
  HV_source_set_I_DC(0);
  HV_source_set_U_DC(0);
  HV_source_set_U_L1_rms(0);
  HV_source_set_U_L2_rms(0);
  HV_source_set_U_L3_rms(0);
}

HV_OpenContactors()
{
  HV_set_AC_relays(0);
  HV_source_set_output(0);
}