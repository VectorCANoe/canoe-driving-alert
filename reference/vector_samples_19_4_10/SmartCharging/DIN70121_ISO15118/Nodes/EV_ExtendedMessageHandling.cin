/*@!Encoding:1252*/

variables
{   

}

void HandleOfferedInternetService()
{
  // Dummy needed for VDV261
}