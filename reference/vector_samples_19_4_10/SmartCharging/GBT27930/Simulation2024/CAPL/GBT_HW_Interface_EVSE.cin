/*@!Encoding:1252*/

variables
{
  enum Connector
  {
    OPEN = 0,
    CLOSE = 1
  };   
  const float cRes_R1_old = 1000.0;
  const float cRes_R2_old = 1000.0;
  const float cRes_R1_new = 2000.0;
  float gRes_R1_new = 2000.0;
  const float cRes_R2_new = 3000.0;
  float gRes_R2_new = 3000.0;
  const float cRes_R3 = 1000.0;
  const float cAux_voltage = 12.0;
  int gS1State = CLOSE;
  
  msTimer tTimeoutReadyToOpen_K1_K2;
  msTimer tCurrentMonitoring;
  
  // simulated power control
  msTimer timer_outputPowerAdjustmentSim;
  
  const long adjustmentInterval = 5;

  double  presentOutputVoltageSim = 0;
  double  presentOutputCurrentSim = 0;
  double  presentOutputTargetVoltageSim = 0;
  double  presentOutputTargetCurrentSim = 0;

  // mock Precharging process
  msTImer tPreCharging;
}

on timer tCurrentMonitoring
{
  if(_CheckCanBeOpened_K1_K2_() == 1)
  {
    HV_open_close_K1K2(OPEN);
    cancelTimer(tTimeoutReadyToOpen_K1_K2);
    writeLineEx(-3, 3, "Current < 5A measured, opening K1_K2 now");
  }
  
  if(isTimerActive(tTimeoutReadyToOpen_K1_K2))
    tCurrentMonitoring.set(5); //Check again in 5ms
}

on timer tTimeoutReadyToOpen_K1_K2
{
  if( _CheckCanBeOpened_K1_K2_() ) 
    HV_open_close_K1K2(OPEN);
  else  
    writeLineEx(-3, 3, "Current value >= 5A measured (value: %d), K1_K2 could not be opened within timeout.", HV_measure_DC_I());
}

void StartPowerAdjustmentTimer(long intervall)
{
  if( !timer_outputPowerAdjustmentSim.isRunning() )
    timer_outputPowerAdjustmentSim.setCyclic(intervall);
}

void StopPowerAdjustmentTimer()
{
  if( timer_outputPowerAdjustmentSim.isRunning() )
    timer_outputPowerAdjustmentSim.cancel();
}

on timer timer_outputPowerAdjustmentSim
{
  // 2% increment steps of difference
  stack double voltageIncrement = (presentOutputTargetVoltageSim - @sysvar::GBT27930::Control::HV_DC_Voltage) * 0.02;
  stack double currentIncrement = (presentOutputTargetCurrentSim - @sysvar::GBT27930::Control::HV_DC_Current) * 0.02;
  
  @sysvar::GBT27930::Control::HV_DC_Voltage += voltageIncrement;
  @sysvar::GBT27930::Control::HV_DC_Current += currentIncrement;
}

long _CheckCanBeOpened_K1_K2_()
{
  if(abs(HV_measure_DC_I()) < 5.0)
    return 1;
  
  return 0;
}

export void StartTimerReadyToOpen_K1_K2(long timeoutMs)
{
  if(_CheckCanBeOpened_K1_K2_() == 1)
  {
    HV_open_close_K1K2(OPEN);
    writeLineEx(-3, 3, "K1_K2 can be opened immediately");
  }
  else
  {
    if(!isTimerActive(tTimeoutReadyToOpen_K1_K2))
      setTimer(tTimeoutReadyToOpen_K1_K2, timeoutMs);
    setTimer(tCurrentMonitoring, 5);
  }
}

export long ST_Init()
{
  presentOutputTargetVoltageSim = 0;
  presentOutputTargetCurrentSim = 0;
  
  // Init CC1 wiring
  @sysvar::VTS::EVSE_VT2004_Ch3_CC1::RelayOrgSensor = 0;
  @sysvar::VTS::EVSE_VT2004_Ch3_CC1::RelayShortCircuit = 0;
  @sysvar::VTS::EVSE_VT2004_Ch3_CC1::RelayBusBar1A = 1; // U1
  @sysvar::VTS::EVSE_VT2004_Ch3_CC1::RelayBusBar1B = 0;
  @sysvar::VTS::EVSE_VT2004_Ch3_CC1::RelayBusBar2A = 0;
  @sysvar::VTS::EVSE_VT2004_Ch3_CC1::RelayBusBar2B = 0;
  sysvar::VTS::EVSE_VT2004_Ch3_CC1.SetStimulationMode(eVTSStimulationModeResistanceGreater);
  if (@sysvar::GBT27930::Charger::VersionNegotiation::ControlPilotVersion == sysvar::GBT27930::Charger::VersionNegotiation::ControlPilotVersion::NewVersionCPCircuit)
  {
    @sysvar::VTS::EVSE_VT2004_Ch3_CC1::Resistor = cRes_R1_new;
    gRes_R2_new = cRes_R2_new;
  }
  else 
    @sysvar::VTS::EVSE_VT2004_Ch3_CC1::Resistor = cRes_R1_old;

  @sysvar::VTS::EVSE_VT2004_Ch4_CC1_::RelayOrgSensor = 0; // CC1 PlugIn - not connected at init
  @sysvar::VTS::EVSE_VT2004_Ch4_CC1_::RelayShortCircuit = 0;
  @sysvar::VTS::EVSE_VT2004_Ch4_CC1_::RelayBusBar1A = 0;
  @sysvar::VTS::EVSE_VT2004_Ch4_CC1_::RelayBusBar1B = 0;
  @sysvar::VTS::EVSE_VT2004_Ch4_CC1_::RelayBusBar2A = 0;
  sysvar::VTS::EVSE_VT2004_Ch4_CC1_.SetStimulationMode(eVTSStimulationModeResistanceGreater);
  if (@sysvar::GBT27930::Charger::VersionNegotiation::ControlPilotVersion == sysvar::GBT27930::Charger::VersionNegotiation::ControlPilotVersion::NewVersionCPCircuit)
  {
    // @sysvar::VTS::EVSE_VT2004_Ch4_CC1_::Resistor = 0; // no R2 on this card with the new CP version, its relocated to R1
    sysvar::VTS::EVSE_VT2004_Ch4_CC1_.SetStimulationMode(eVTSStimulationModeNone);
    @sysvar::VTS::EVSE_VT2004_Ch4_CC1_::RelayBusBar2B = 0; //no Switch S on this card with the new CP version, its now the same as connecting CC1
    CHA_open_close_S1(CLOSE); // S1 is normally closed
  }
  else
  {
    sysvar::VTS::EVSE_VT2004_Ch4_CC1_.SetStimulationMode(eVTSStimulationModeResistanceGreater);
    @sysvar::VTS::EVSE_VT2004_Ch4_CC1_::Resistor = cRes_R2_old;
    @sysvar::VTS::EVSE_VT2004_Ch4_CC1_::RelayBusBar2B = 1; // Switch S, normally closed
    CHA_open_close_S1(OPEN); // Switch S1 Shorts R2 -> open for old wiring
  }
  
  // Init CC2 wiring
  @sysvar::VTS::EVSE_VT2004_Ch1_CC2::RelayOrgSensor = 0; // CC2 PlugIn - not connected at init
  @sysvar::VTS::EVSE_VT2004_Ch1_CC2::RelayShortCircuit = 0;
  @sysvar::VTS::EVSE_VT2004_Ch1_CC2::RelayBusBar1A = 0;
  @sysvar::VTS::EVSE_VT2004_Ch1_CC2::RelayBusBar1B = 0;
  @sysvar::VTS::EVSE_VT2004_Ch1_CC2::RelayBusBar2A = 0;
  @sysvar::VTS::EVSE_VT2004_Ch1_CC2::RelayBusBar2B = 1; // set PE: CC2 from Cable -> R3 -> PE
  sysvar::VTS::EVSE_VT2004_Ch1_CC2.SetStimulationMode(eVTSStimulationModeResistanceGreater);
  @sysvar::VTS::EVSE_VT2004_Ch1_CC2::Resistor = cRes_R3;
  
  return 0;
}

export long ST_Reset()
{
  @sysvar::VTS::EVSE_VT2004_Ch4_CC1_::RelayOrgSensor = 0; // Reset CC1 PlugIn
  @sysvar::VTS::EVSE_VT2004_Ch1_CC2::RelayOrgSensor = 0; // CC2 PlugIn connects PE and R3: U2 -> R5 -> R3 -> PE
  if (@sysvar::GBT27930::Charger::VersionNegotiation::ControlPilotVersion == sysvar::GBT27930::Charger::VersionNegotiation::ControlPilotVersion::NewVersionCPCircuit)
  {
    @sysvar::VTS::EVSE_VT2004_Ch4_CC1_::RelayBusBar2B = 0; // ensure S is not set
    CHA_open_close_S1(CLOSE); 
    gRes_R1_new = cRes_R1_new;
    @sysvar::VTS::EVSE_VT2004_Ch3_CC1::Resistor = cRes_R1_new;
    gRes_R2_new = cRes_R2_new;
    gS1State = CLOSE;
  } else {
    @sysvar::VTS::EVSE_VT2004_Ch4_CC1_::RelayBusBar2B = 1; // Reset Switch S, normally closed
    CHA_open_close_S1(OPEN); // Switch S1 Shorts R2 -> open for old wiring
    @sysvar::VTS::EVSE_VT2004_Ch3_CC1::Resistor = cRes_R1_old;
    @sysvar::VTS::EVSE_VT2004_Ch4_CC1_::Resistor = cRes_R2_old;
  }
  
  return 0;
}

export void open_close_lock (int openClose)
{
  writelineex(-4,1,"Lock status now: %d",openClose);
}

//--------------------------------------------- functions of the GBT HW interface ----------------------------------------------------------------------
//Connects to the bus bar to provide 12 V; connects R1 to BMS via CC1
export void Connect_CC1()
{
  @sysvar::VTS::EVSE_VT2004_Ch4_CC1_::RelayOrgSensor = 1; // CC1 PlugIn (sets R4 parallel to R2)
}

export void Disconnect_CC1()
{
  @sysvar::VTS::EVSE_VT2004_Ch4_CC1_::RelayOrgSensor = 0; // CC1 PlugOut (removes R4)
}

export void Connect_CC2()
{
  @sysvar::VTS::EVSE_VT2004_Ch1_CC2::RelayOrgSensor = 1; // CC2 PlugIn (connects PE and R3: U2 -> R5 -> R3 -> PE)
}

export void Disconnect_CC2()
{
  @sysvar::VTS::EVSE_VT2004_Ch1_CC2::RelayOrgSensor = 0;
}

export void CHA_set_voltage_CP1(double voltage)
{
  if(isSimulated())
    @sysvar::GBT27930::Control::voltage_CP1 = voltage;
  //else
    // voltage is CP1 is set by Switch S and Connection of CC1 
    // and is updated by sysvar::VTS::EVSE_VT2816_Ch2_CC1_PE::AvgVoltage
} 

export double CHA_measure_voltage_CP1()
{
  return @sysvar::GBT27930::Control::voltage_CP1;
}

on sysvar_update sysvar::VTS::EVSE_VT2816_Ch2_CC1_PE::AvgVoltage
{
  @sysvar::GBT27930::Control::voltage_CP1 = @sysvar::VTS::EVSE_VT2816_Ch2_CC1_PE::AvgVoltage;
}

export void CHA_set_resistance_R1(double resistance)
{
  if (@sysvar::GBT27930::Charger::VersionNegotiation::ControlPilotVersion == sysvar::GBT27930::Charger::VersionNegotiation::ControlPilotVersion::OldVersionCPCircuit)
  {
    if(resistance < 1)
      sysvar::VTS::EVSE_VT2004_Ch3_CC1.SetStimulationMode(eVTSStimulationModeNone);
    else
    {
      sysvar::VTS::EVSE_VT2004_Ch3_CC1.SetStimulationMode(eVTSStimulationModeResistanceGreater);
      @sysvar::VTS::EVSE_VT2004_Ch3_CC1::Resistor = resistance;
    }
  }
  else
  {
    gRes_R1_new = resistance;
    if (gS1State == CLOSE)
      @sysvar::VTS::EVSE_VT2004_Ch3_CC1::Resistor = gRes_R1_new;
    else 
      @sysvar::VTS::EVSE_VT2004_Ch3_CC1::Resistor = gRes_R1_new + gRes_R2_new;
  }
}

export void CHA_set_resistance_R2(double resistance)
{
  if (@sysvar::GBT27930::Charger::VersionNegotiation::ControlPilotVersion == sysvar::GBT27930::Charger::VersionNegotiation::ControlPilotVersion::OldVersionCPCircuit)
  {
    if(resistance < 1)
      sysvar::VTS::EVSE_VT2004_Ch4_CC1_.SetStimulationMode(eVTSStimulationModeNone);
    else
    {
      sysvar::VTS::EVSE_VT2004_Ch4_CC1_.SetStimulationMode(eVTSStimulationModeResistanceGreater);
      @sysvar::VTS::EVSE_VT2004_Ch4_CC1_::Resistor = resistance;
    }
  }
  else
  {
    gRes_R2_new = resistance;
    if (gS1State == OPEN)
      @sysvar::VTS::EVSE_VT2004_Ch3_CC1::Resistor = gRes_R1_new + gRes_R2_new;
  }
}

export void CHA_set_resistance_R3(double resistance)
{
  if(resistance < 1)
    sysvar::VTS::EVSE_VT2004_Ch1_CC2.SetStimulationMode(eVTSStimulationModeNone);
  else
  {
    sysvar::VTS::EVSE_VT2004_Ch1_CC2.SetStimulationMode(eVTSStimulationModeResistanceGreater);
    @sysvar::VTS::EVSE_VT2004_Ch1_CC2::Resistor = resistance;
  }
}
 
export void disconnect_resistances()
{
  sysvar::VTS::EVSE_VT2004_Ch1_CC2.SetStimulationMode(eVTSStimulationModeNone);
  sysvar::VTS::EVSE_VT2004_Ch2.SetStimulationMode(eVTSStimulationModeNone);
  sysvar::VTS::EVSE_VT2004_Ch3_CC1.SetStimulationMode(eVTSStimulationModeNone);
  sysvar::VTS::EVSE_VT2004_Ch4_CC1_.SetStimulationMode(eVTSStimulationModeNone);
}

export void Connect_CAN()
{
  //CAN connection handling is not needed for VT wiring
}

export void Disconnect_CAN()
{
  //CAN connection handling is not needed for VT wiring
}

export void CHA_open_close_S(int openClose)
{
  if (@sysvar::GBT27930::Charger::VersionNegotiation::ControlPilotVersion == sysvar::GBT27930::Charger::VersionNegotiation::ControlPilotVersion::OldVersionCPCircuit)
  {
    if (openClose == CLOSE)
      @sysvar::VTS::EVSE_VT2004_Ch4_CC1_::RelayBusBar2B = 1;
    else if (openClose == OPEN)
      @sysvar::VTS::EVSE_VT2004_Ch4_CC1_::RelayBusBar2B = 0;
  } else if (@sysvar::GBT27930::Charger::VersionNegotiation::ControlPilotVersion == sysvar::GBT27930::Charger::VersionNegotiation::ControlPilotVersion::NewVersionCPCircuit) {
    if (openClose == CLOSE)
      Connect_CC1();
    else if (openClose == OPEN)
      Disconnect_CC1();
  }
}

export void CHA_open_close_S1(int openClose)
{
  if (openClose == CLOSE)
  {
    @sysvar::VTS::EVSE_VT2004_Ch3_CC1::Resistor = gRes_R1_new;
    gS1State = CLOSE;
  }
  else if (openClose == OPEN)
  {
    @sysvar::VTS::EVSE_VT2004_Ch3_CC1::Resistor = gRes_R1_new + gRes_R2_new;
    gS1State = OPEN;
  }
}

export void CHA_open_close_K3K4(int openClose)
{  
  writeEx(-3,3, "Test system: CHA_open_close_K3K4 called, openClose %d", openClose);
}
 
export void CHA_set_auxiliary_voltage(double voltage)
{
  writeEx(-3,3, "Test system: CHA_set_auxiliary_voltage called, voltage %f", voltage);
}
 
//not part of communication tests
export long HV_measure_DC_U()
{
  return presentOutputTargetVoltageSim;
}

//not part of communication tests
export long HV_measure_DC_I()
{
  return presentOutputTargetCurrentSim;
}

//not part of communication tests
export long HV_measure_DC_P()
{
  return HV_measure_DC_U() * HV_measure_DC_I();
}

//not part of communication tests
export long HV_source_set_U_DC(double voltage)
{
  presentOutputTargetVoltageSim = voltage;
  StartPowerAdjustmentTimer(adjustmentInterval);
  return 0;
}

//not part of communication tests
export long HV_source_set_I_DC(double current)
{
  presentOutputTargetCurrentSim = current;
  StartPowerAdjustmentTimer(adjustmentInterval);
  return 0;
}

export void HV_source_reset()
{
  HV_source_set_U_DC(0.0);
  HV_source_set_I_DC(0.0);
  timer_outputPowerAdjustmentSim.cancel();
  ST_Reset();
}


export void HV_open_close_K1K2 (int openClose)
{
  if( @sysvar::GBT27930::Charger::ContactorStatus_K1K2 != openClose ) 
    writeEx(-4,1, "Test system: HV_open_close_K1K2 called, openClose %d", openClose);
  @sysvar::GBT27930::Charger::ContactorStatus_K1K2 = openClose;
}

on timer tPreCharging
{
  @sysvar::GBT27930::Charger::PreChargingComplete = 1;
}

export StartPreChargingProcess()
{
  writeLineEx(-3, 1, "Start PreCharging");
  setTimer(tPreCharging, 200);
}