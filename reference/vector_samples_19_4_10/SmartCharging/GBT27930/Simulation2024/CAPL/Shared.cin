/*@!Encoding:1252*/
includes
{
  
}

variables
{
  struct Version {
  int major;
  int minor;
  int temporary;
  };
  
  enum GBT27930Messages
  {
    kChargerPhaseRequest = 0x01,
    kVehicleAcknowledge = 0x02,
    kChargerEnd = 0x03,
    kVehicleEnd = 0x04,
    kChargerDCSupplyCircuitContactorStatus = 0x05,
    kVehicleChargingCircuitContactorStatus = 0x06,
    kChargerElectronicLockStatus = 0x07,
    kChargerWakeUp = 0x08,
    kVehicleWakeUp = 0x09,
    kChargerSupportFunction = 0x11,
    kVehicleFunctionNegotiationAckResult = 0x12,
    kChargerChargingParameters = 0x21,
    kVehicleChargingParameters = 0x22,
    kChargerChargingAndDischargingParameters = 0x23,
    kVehicleChargingAndDischargingParameters = 0x24,
    kChargerScanAuthenticationParameter = 0x31,
    kVehicleScanAuthenticationWaiting = 0x32,
    kChargerScanAuthenticationResult = 0x33,
    kVehicleEVINAuthenticationParameter = 0x34,
    kChargerEVINAuthenticationResult = 0x35,
    kVehicleEVINReAuthenticationRequest = 0x36,
    kVehicleCloudAuthenticationParameter = 0x37,
    kChargerCloudAuthenticationParameter = 0x38,
    kChargerCloudAuthenticationResult = 0x39,
    kVehicleCloudReAuthenticationRequest = 0x3A,
    kChargerScheduledChargingInformation = 0x41,
    kVehicleScheduledChargingInformation = 0x42,
    kChargerScheduledChargingAcknowledgement = 0x43,
    kVehicleScheduledChargingNegotiation = 0x44,
    kChargerDetectionInformation = 0x51,
    kDetectionAcknowledgement = 0x52,
    kChargerPowerSupplyStatus = 0x61,
    kVehiclePowerSupplyStatus = 0x62,
    kVehiclePowerSupplyDemand = 0x63,
    kChargerDynamicOutputCapability = 0x64,
    kVehiclePowerSupplyCompletion = 0x65,
    kChargerPowerSupplyBasicInformation = 0x66,
    kChargerReadyStatus = 0x71,
    kVehicleReadyStatus = 0x72,
    kVehicleChargingRequest = 0x73,
    kVehicleChargingBasicInformation = 0x74,
    kChargerEnergyTransferDynamicOutputCapability = 0x75,
    kChargerChargingBasicInformation = 0x76,
    kVehicleBatteryBasicInformation = 0x77,
    kChargerPause = 0x78,
    kVehiclePause = 0x79,
    kChargerBidirectionalChargingReadyStatus = 0x81,
    kVehicleBidirectionalChargingReadyStatus = 0x82,
    kChargerDischargeRequest = 0x83,
    kVehicleBidirectionalDynamicOutputCapability = 0x84,
    kVehicleBidirectionalChargingRequest = 0x85,
    kChargerBidirectionalDynamicOutputCapability = 0x86,
    kVehicleBidirectionalChargingInfo = 0x87,
    kChargerBidirectionalChargingInfo = 0x88,
    kVehicleBidirectionalChargingBatteryInfo = 0x89,
    kChargerBidirectionalChargingPause = 0x8A,
    kVehicleBidirectionalChargingPause = 0x8B,
    kVehicleAdhesionDetection = 0x91,
    kChargerAllowsAdhesionDetection = 0x92,
    kChargerStatistics = 0x93,
    kVehicleStatistics = 0x94,
    kCRM = 0x100,
    kBRM = 0x200,
    kBCP = 0x600,
    kCTS = 0x700,
    kCML = 0x800,
    kBRO = 0x900,
    kCRO = 0xA00,
    kBCL = 0x1000,
    kBCS = 0x1100,
    kCCS = 0x1200,
    kBSM = 0x1300,
    kBMV = 0x1500,
    kBMT = 0x1600,
    kBSP = 0x1700,
    kBST = 0x1900,
    kCST = 0x1A00,
    kBSD = 0x1C00,
    kCSD = 0x1D00,
    kBEM = 0x1E00,
    kCEM = 0x1F00,
    kDM1 = 0x2000,
    kDM2 = 0x2100,
    kDM3 = 0x2200,
    kDM4 = 0x2300,
    kDM5 = 0x2400,
    kDM6 = 0x2500,
    kCHM = 0x2600,
    kBHM = 0x2700,
    kTimeout = 0x3000,
    kVehicleVersionNegotiation,
    kChargerVersionNegotiation,
    kSM_RM_Charger,
    kSM_URM_Charger,
    kSM_ACK_Charger,
    kSM_RM_Vehicle,
    kSM_URM_Vehicle,
    kSM_ACK_Vehicle,
    kLM_0_Charger,
    kLM_0_Vehicle,
    kLM_i_Charger,
    kLM_i_Vehicle,
    kLM_ACK_Charger,
    kLM_ACK_Vehicle,
    kLM_NACK_Charger,
    kLM_NACK_Vehicle,
    kLM_EndofACK_Charger,
    kLM_EndofACK_Vehicle
  };
  
  enum NegotiationStates
  {
    kInitialization = 0,
    kNegotiating,
    kAppendixMNegotiationSucceeded,
    kNegotiationSucceeded,
    kNegotiationFailed,
    kExitCharging
  };
  
  enum FunctionModules
  {
    kInitial = 0,
    kVersionNegotiation = 100,
    kFunctionNegotiationPhase,
    kParameterConfigurationPhase,
    kAuthenticationPhase,
    kSchedulingPhase,
    kOutputCircuitDetectionPhase,
    kPowerSupplyModePhase,
    kPreChargingAndEnergyTransferPhase,
    kEndPhase
  };

  // Specific meaning differs for each phase, so only generic names
  enum StatusWithinPhase
  {
    kStatus0 = 0,
    kStatus1,
    kStatus2,
    kStatus3,
    kStatus4,
    kStatus5,
    kStatus6,
    kStatus7,
    kStatus8
  };

  enum PowerSupplyStatus
  {
    kPowerSupplyNotReady = 0,
    kPowerSupplyReady,
    kPowerSupplyCompleted
  };
  
  const int cContactorStatusCycleTimeMs = 1000;
  const int cChargerAuthenticationParameterCycleTimeMs = 250;
  const int cChargerAuthenticationSimulationTimeMs = 1000;
  const int cURMAfterChangeCycleTimeMs = 50;
  const int cOpenContactorsTimeoutMs = 250;
}

void StartTimerIfNotRunning(msTimer myTimer, long timeout)
{
  if(!isTimerActive(myTimer))
    setTimer(myTimer, timeout);
}

void StartCyclicTimerIfNotRunning(msTimer myTimer, long timeout)
{
  if(!isTimerActive(myTimer))
    setTimerCyclic(myTimer, timeout);
}

int isVersionSortedAscending(struct Version versions[], int count)
{
  int i;
  for (i = 0; i < count - 1; i++)
  {
    // Compare main
    if (versions[i].major > versions[i + 1].major)
      return 0;

    // If main is equal, compare minor
    if (versions[i].major == versions[i + 1].major &&
        versions[i].minor > versions[i + 1].minor)
      return 0;

    // If main & minor are equal, compare temporary
    if (versions[i].major == versions[i + 1].major &&
        versions[i].minor == versions[i + 1].minor &&
        versions[i].temporary > versions[i + 1].temporary)
      return 0;
  }

  return 1; // All versions are in ascending order
}