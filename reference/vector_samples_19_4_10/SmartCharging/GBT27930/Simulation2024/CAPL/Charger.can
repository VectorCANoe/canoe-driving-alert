/*@!Encoding:1252*/
includes
{
  #include "GBT_HW_Interface_EVSE.cin"
  #include "Shared.cin"
  #include "VersionList.cin"
}

variables
{
  // Presentation
  char gPanelName[8] = "Charger";
  char gCanvasDisableChargeDischarge[26] = "cv_DisableChargeDischarge";
  enum eMode
  {
    Ready = 0,
    Charging = 1,
    Error = 2
  };
  enum eMode Mode = Ready;
  word msStartOfChargingMS;
  
  // ConnectionControlSequence
  const deferConnectionControlSequence = 200;
  msTimer tmrConnectionControlSequenceOldVersion;
  msTimer tmrConnectionControlSequenceNewVersion;
  enum eConnectionControlSequnece
  {
    T0 = 0,
    T1, 
    T2, 
    T3,
    T4,
    T5,
    T6,
    T19,
    T20,
    T21,
    T22,
    T23,
    T24,
    T25
  };
  word gConnectionControlSequence;
  int gConnectionControlSequenceCounter;
  double cCP1VoltageTolerance = 0.5;
  
  // State Machine
  msTimer stateTransitionTimer;
  word currentChargerPhase;
  msTimer timer_Tout0_Charger;
  msTimer timer_Tout1_Charger;
  msTimer timer_Tout2_Charger;
  const int cOpenK1K2DelayMs = 100;
  int skipAuthentication = 0;
  int skipScheduling = 0;
  int skipPowerSupply = 0;
  int isAbnormalEnd = 0;
  
  // Version Negotiation
  msTimer sendCyclicVersionNegotiationMessage;
  const int cMessageCycleTimeVersionNegotiation = 50; // see Table 8
  word chargerNegotiationState = kInitialization;
  int currentVersionIndex;
  int chargerVersionHasChanged;
  
  // General Messages
  msTimer sendCyclicChargerDCSupplyCircuitContactorStatusMessage;
  msTimer sendChargerDCSupplyCircuitContactorStatusMessageAfterChange;
  int sentDCSupplyContactorStatusAfterChangeCounter;
  msTimer sendCyclicChargerElectronicLockStatusMessage;
  msTimer sendChargerElectronicLockStatusMessageAfterChange;
  int sentChargerLockStatusAfterChangeCounter;
  msTimer timer_CloseElectronicLock;
  const int cCloseElectronicLockDelayMs = 100;
  msTimer sendCyclicWakeUpMessage;
  const int cWakeUpCycleTimeMs = 50;
  
  // Authentication
  msTimer timer_SimulateAuthentication_Charger;
  int isReauthenticationTriggered;
  msTimer sendCyclicChargerAuthenticationParameterMessage;
  
  // Schedule
  timer timer_WaitForScheduledChargingStart;
  const int cGenericChargingStartTimeInMinutes = 2;
  
  // Output Circuit Detection
  msTimer sendCyclicChargerDetectionInformationMessage;
  const int cChargerDetectionInformationCycleTimeMs = 250;
  
  // Power Supply Mode
  msTimer sendCyclicPowerSupplyStatusMessage;
  const int cPowerSupplyStatusCycleTimeMs = 250;
  msTimer timer_MonitorExternalVoltageK1K2;
  const int cMonitorExternalVoltageK1K2Period = 50;
  msTimer sendCyclicChargerDynamicOutputCapabilityAndBasicInformationMessage;
  const int cChargerDynamicOutputCapabilityAndBasicInformationCycleTimeMs = 1000;
  msTimer sendChargerDynamicOutputCapabilityAfterChange;
  int sentChargerDynamicOutputCapabilityAfterChangeCounter;
  
  // Pre Charge & Energy Transfer
  msTimer sendCyclicChargerReadyStatus;
  msTimer sendCyclicChargerBidirectionalChargingReadyStatus;
  const int cChargerReadyStatusCycleTimeMs = 250;
  
  msTimer sendCyclicChargerEnergyTransferDynamicOutputCapacity;
  msTimer sendChargerEnergyTransferDynamicOutputCapacityAfterChange;
  int sentChargerEnergyTransferDynamicOutputCapacityAfterChangeCounter;
  
  msTimer sendCyclicChargerDischargeRequest;
  msTimer sendChargerDischargeRequestAfterChange;
  int sentChargerDischargeRequestAfterChangeCounter;
  const int cChargerDischargeRequestCycleTimeMs = 250;
  
  msTimer sendCyclicChargerBidirectionalOutputCapability;
  msTimer sendChargerBidirectionalOutputCapabilityAfterChange;
  int sentChargerBidirectionalOutputCapabilityAfterChangeCounter;
  const int cChargerOutputCapacityTimeMs = 1000;
  
  msTimer sendCyclicChargerChargingBasicInformation;
  const int cChargerChargingBasicInformationTimeMs = 1000;
  
  msTimer sendCyclicChargerBidirectionalChargingInfo;
  int sentChargerDetectionInformationCounter;
  int counterSendCyclicChargerReadyStatus;
  
  // End Module
  msTimer sendCyclicChargerAllowsAdhesionDetectionMessage;
  const int cCyclicChargerAllowsAdhesionDetectionCycleTimeMs = 250;
}

/////////////////////////////////////////////////////////////////////////////////////
/*--------------------------------------Timer--------------------------------------*/
/////////////////////////////////////////////////////////////////////////////////////

on timer stateTransitionTimer
{
  @sysvar::GBT27930::Charger::CurrentChargerStatus = kStatus0;
  @sysvar::GBT27930::Charger::CurrentChargerFunctionModule = currentChargerPhase;
  writeLineEx(1,1,"Charger: Transitioning to phase %d", currentChargerPhase);
  switch(currentChargerPhase)
  {
    case kFunctionNegotiationPhase:
      setTimerCyclic(sendCyclicChargerDCSupplyCircuitContactorStatusMessage, cContactorStatusCycleTimeMs);
      setTimerCyclic(sendCyclicChargerElectronicLockStatusMessage, cContactorStatusCycleTimeMs);
      StartFunctionNegotiationPhase();
      break;
    case kParameterConfigurationPhase:
      if(@sysvar::GBT27930::Charger::ChargingDischarging::EnergyTransferDirection == @sysvar::GBT27930::Charger::ChargingDischarging::EnergyTransferDirection::Discharging)
      {
        StartParameterConfiguration_ChargingAndDischarging();
      }
      else
      {
        StartParameterConfiguration_OnlyCharging();
      }
      break;
    case kAuthenticationPhase:
      StartAuthentication();
      break;
    case kSchedulingPhase:
      StartScheduling();
      break;
    case kOutputCircuitDetectionPhase:      
      StartOutputCircuitDetection();
      break;
    case kPowerSupplyModePhase:
      StartPowerSupplyMode();
      break;
    case kPreChargingAndEnergyTransferPhase:
      StartPreChargingAndEnergyTransfer();
      break;
    case kEndPhase:
      StartEndPhase();
      break;
  default:
    break;
  }
}

on timer tmrConnectionControlSequenceNewVersion
{
  switch(gConnectionControlSequence)
  {
    case(T0): // coupler not connected, switch S not pressed - Press (open) switch S 
      CHA_open_close_S(OPEN); // Plug-in starting (after T0)
      CHA_set_voltage_CP1(12.0); // Simulation only: Switch S open, but vehicle not connected
      gConnectionControlSequence = T1; 
      break;
    case(T1): // coupler not connected, switch S pressed - Press connect coupler
      gConnectionControlSequence = T2; // no charger HW interaction in this sequence
      break;
    case(T2): // coupler connected, switch S still pressed -  Release (close) switch S 
      gConnectionControlSequenceCounter++;
      CHA_open_close_S(CLOSE);
      // Connect_CC1(); // Already called by CHA_open_close_S PlugIn Cable 
      Connect_CC2(); // PlugIn Cable
      CHA_set_voltage_CP1(4.0); // Simulation only: R1 and R4 are in series, CP1 Voltage should be at 4 V
      if (CompareWithTolerance(CHA_measure_voltage_CP1(), 4.0 /*V*/, cCP1VoltageTolerance))
      {
        StartCommunication();
        gConnectionControlSequence = T3;
        gConnectionControlSequenceCounter = 0;
      }
      else if (gConnectionControlSequenceCounter == 2) // give relay time before reporting
        WriteLineEx(-3,1,"Charger: Vehicle coupler is not fully connected. Once the cable is fully inserted into the vehicle inlet, please release the connector switch S.");
      break;
    case(T3): // wait for the Vehicle to complete version negotiation
    case(T4): // wait for the Vehicle to complete function negotiation and parameter configuration
    case(T5): // wait for the Vehicle to complete authentication and enter scheduling
      // T5''- timer_WaitForScheduledChargingStart: Scheduled starting time reached, send vehicle wake up msg and close K3/K4 
    case(T6): // Scheduling compelte, start output circuit monitoring
      break;
    case(T22): 
      gConnectionControlSequenceCounter++;
      if (gConnectionControlSequenceCounter == 5)
      {
        CHA_open_close_S(OPEN);// user unlocks mechanical locking device
        Disconnect_CC2();
        CHA_set_voltage_CP1(12.0); // Simulation only: voltage becomes 12 V at CP1
      }
      if (CompareWithTolerance(CHA_measure_voltage_CP1(), 12.0 /*V*/, cCP1VoltageTolerance))
      {
        gConnectionControlSequenceCounter = 0;
        gConnectionControlSequence = T25; // T23 & T24 are vehicle only
      }
      break;
    case (T25):
      CHA_open_close_S(OPEN);// user releases mechanical locking device
      Disconnect_CC1(); // CC1 stays disconnected
      break;
    default:
        WriteLineEx(-3,1,"Charger: Reached undefined state in connection control sequence");  
      break;
  }  
}

on timer tmrConnectionControlSequenceOldVersion
{
  switch(gConnectionControlSequence)
  {
    case(T0): // coupler not connected, switch S not pressed - Press (open) switch S 
      gConnectionControlSequenceCounter++;
      CHA_open_close_S(OPEN); // Plug-in starting (after T0)
      CHA_set_voltage_CP1(12.0); // Simulation only: Switch S open, but vehicle not connected
      if (CompareWithTolerance(CHA_measure_voltage_CP1(), 12.0 /*V*/, cCP1VoltageTolerance))
      {
        gConnectionControlSequence = T1;
        gConnectionControlSequenceCounter = 0;
      }
      else if (gConnectionControlSequenceCounter == 2) // give relay time before reporting
        WriteLineEx(-3,1,"Charger: Vehicle coupler is not connected. Press connector switch S and connect plug cable into vehicle inlet.");
      break;
    case(T1): // coupler not connected, switch S pressed - Press connect coupler
      gConnectionControlSequenceCounter++;
      Connect_CC1(); // PlugIn Cable 
      Connect_CC2(); // PlugIn Cable
      CHA_set_voltage_CP1(6.0); // Simulation only: Switch S open and vehicle fully connected
      if (CompareWithTolerance(CHA_measure_voltage_CP1(), 6.0 /*V*/, cCP1VoltageTolerance))
      {
        gConnectionControlSequence = T2;
        gConnectionControlSequenceCounter = 0;
      }
      else if (gConnectionControlSequenceCounter == 2) // give relay time before reporting
        WriteLineEx(-3,1,"Charger: Vehicle coupler is not fully connected. Keep the connector switch S pressed and connect plug cable into vehicle inlet.");
      break;
    case(T2): // coupler connected, switch S still pressed -  Release (close) switch S 
      gConnectionControlSequenceCounter++;
      CHA_open_close_S(CLOSE);
      CHA_set_voltage_CP1(4.0); // Simulation only: Switch S closed and vehicle fully connected
      open_close_lock(CLOSE); //T2' Electronic lock feedback
      @sysvar::GBT27930::Charger::ElectronicLockStatus = sysvar::GBT27930::Charger::ElectronicLockStatus::Locked;
      if (CompareWithTolerance(CHA_measure_voltage_CP1(), 4.0 /*V*/, cCP1VoltageTolerance))
      {
        gConnectionControlSequence = T3;
        gConnectionControlSequenceCounter = 0;
      }
      else if (gConnectionControlSequenceCounter == 2) // give relay time before reporting
        WriteLineEx(-3,1,"Charger: Vehicle coupler is not fully connected. Once the cable is fully inserted into the vehicle inlet, please release the connector switch S.");
      break;
    case(T3):
      CHA_open_close_K3K4(CLOSE); // T3
      gConnectionControlSequence = T4;
      break;
    case(T4):
      /* Initiate data interaction */
      cancelTimer(tmrConnectionControlSequenceOldVersion);      
      msStartOfChargingMS = 0;
      StartCommunication(); // T4  
      CHA_set_auxiliary_voltage(cAux_voltage);
      break;
    case(T19): // press Switch S
    case(T20): // plugOut
      gConnectionControlSequenceCounter++;
      if (CompareWithTolerance(CHA_measure_voltage_CP1(), 6.0 /*V*/, cCP1VoltageTolerance))
      {
        open_close_lock(OPEN); // T18 Electronic lock feedback
        @sysvar::GBT27930::Charger::ElectronicLockStatus = sysvar::GBT27930::Charger::ElectronicLockStatus::Unlocked;
        CHA_open_close_S(OPEN); // Plug-out starting (after T0)
        CHA_set_voltage_CP1(12.0); // Simulation only: Switch S is open but vehicle is still fully connected
        gConnectionControlSequence = T20;
      }
      if (CompareWithTolerance(CHA_measure_voltage_CP1(), 12.0 /*V*/, cCP1VoltageTolerance))
      {
        Disconnect_CC1();
        Disconnect_CC2();
        CHA_set_voltage_CP1(6.0); // Simulation only: Switch S is open and vehicle disconnected
        gConnectionControlSequence = T21;
        gConnectionControlSequenceCounter = 0;
      }
      else if (gConnectionControlSequenceCounter == 4) // give relay time before reporting
        WriteLineEx(-3,1,"Charger: Vehicle coupler is not disconnected yet. Please press the connector switch S and remove cable from vehicle socket.");
      break;
    case(T21):
      gConnectionControlSequenceCounter++;
      if (CompareWithTolerance(CHA_measure_voltage_CP1(), 6.0 /*V*/, cCP1VoltageTolerance))
      {
        cancelTimer(tmrConnectionControlSequenceOldVersion);
        WriteLineEx(-3,1,"Charger: Vehicle coupler is fully disconnected and switch S is detected as released.");
        gConnectionControlSequenceCounter = 0;
      }
      else if (gConnectionControlSequenceCounter == 2) // give relay time before reporting
        WriteLineEx(-3,1,"Charger: Vehicle coupler is not fully disconnected yet. Please release the connector switch S.");
      break;
    case(T5): //Sanity check in case connection state is increased incorrectly
    default:
        WriteLineEx(-3,1,"Charger: Reached undefined state in connection control sequence");  
      break;
  }  
}

on timer sendCyclicVersionNegotiationMessage
{
  if(chargerNegotiationState <= kNegotiating) // periodic sending
  {
    chargerNegotiationState = kNegotiating;
    setTimer(sendCyclicVersionNegotiationMessage, cMessageCycleTimeVersionNegotiation);
  }
  else if (chargerNegotiationState == kAppendixMNegotiationSucceeded || chargerNegotiationState == kNegotiationFailed) // switch to Appendix M (Category A)
  {
    CancelTimers();
    StartGBT27930CategoryACommunication();
  }
  else if (chargerNegotiationState == kNegotiationSucceeded)
  {
    cancelTimer(timer_Tout0_Charger);
    currentChargerPhase = kFunctionNegotiationPhase; // start at 'function negotiation' for possible compatibility with Category A
    StartTimerIfNotRunning(stateTransitionTimer,  @sysvar::GBT27930::Charger::DelayTransition::VersionNegotiation_to_FunctionNegotiation);
  }
  SendChargerVersionNegotiation();
}

on timer timer_Tout0_Charger
{
  switch(currentChargerPhase)
  {
    case kInitial:
      writeLineEx(-3,1,"Logic Error: Tout_0_Charger should not be running while currentChargerPhase is set to kInitial");
      break;
    case kVersionNegotiation:
      StartGBT27930CategoryACommunication();
      @sysvar::GBT27930::Charger::VersionNegotiation::NegotiationResult = 2; // Negotiation Failed 
      writeLineEx(1,1,"Charger: Version Negotiation timeout reached. Fallback to GBT27930 CategoryA communication.");
      CancelTimers();
      break;
    case kFunctionNegotiationPhase:
      if (@sysvar::GBT27930::Charger::CurrentChargerStatus == kStatus1 || @sysvar::GBT27930::Charger::CurrentChargerStatus == kStatus2)
      {
        SendEndMessageAndEnterEndModule(_GBT27930::DataTypes::parEndType::FunctionModuleInformationInteractionTimeout, _GBT27930::DataTypes::FunctionModuleInteractionTimeoutTypeEncoding::function_negotiation_phase_timeout);
      }
      break;
    case kParameterConfigurationPhase:
      SendEndMessageAndEnterEndModule(_GBT27930::DataTypes::parEndType::FunctionModuleInformationInteractionTimeout, _GBT27930::DataTypes::FunctionModuleInteractionTimeoutTypeEncoding::parameter_configuration_phase_timeout);
      @sysvar::GBT27930::Charger::CurrentChargerStatus = kStatus4;
      break;
    case kAuthenticationPhase:
      switch(@sysvar::GBT27930::Charger::CurrentChargerStatus)
      {
        case kStatus1:
        case kStatus2:
          SendEndMessageAndEnterEndModule(_GBT27930::DataTypes::parEndType::FunctionModuleInformationInteractionTimeout, _GBT27930::DataTypes::FunctionModuleInteractionTimeoutTypeEncoding::authentication_phase_timeout);
          switch (@sysvar::GBT27930::Charger::Authentication::AuthenticationType)
          {
            case sysvar::GBT27930::Charger::Authentication::AuthenticationType::Scan:
              @sysvar::GBT27930::Charger::CurrentChargerStatus = kStatus4;
              break;
            case sysvar::GBT27930::Charger::Authentication::AuthenticationType::EVIN:
              @sysvar::GBT27930::Charger::CurrentChargerStatus = kStatus5;
              break;
            case sysvar::GBT27930::Charger::Authentication::AuthenticationType::Cloud:
              @sysvar::GBT27930::Charger::CurrentChargerStatus = kStatus6;
              break;
            default:
              break;
          }
          break;
        default:
          WriteLineEx(-3,1,"Logic Error: Tout_0_Charger should not be running outside of CurrentChargerStatus set to kStatus1 or kStatus2");
          break;
      }
      break;
    case kSchedulingPhase:
      SendEndMessageAndEnterEndModule(_GBT27930::DataTypes::parEndType::FunctionModuleInformationInteractionTimeout, _GBT27930::DataTypes::FunctionModuleInteractionTimeoutTypeEncoding::scheduling_phase_timeout);
      break;
    case kOutputCircuitDetectionPhase:
      switch(@sysvar::GBT27930::Charger::CurrentChargerStatus)
      {
        case kStatus1:
          SendEndMessageAndEnterEndModule(_GBT27930::DataTypes::parEndType::EndCharging, _GBT27930::DataTypes::ChargerEndChargingEncoding::charger_failure_abnormal_vehicle_plug_unlock);
          @sysvar::GBT27930::Charger::CurrentChargerStatus = kStatus5;
          break;
        case kStatus2:
        case kStatus3:
          SendEndMessageAndEnterEndModule(_GBT27930::DataTypes::parEndType::FunctionModuleInformationInteractionTimeout, _GBT27930::DataTypes::FunctionModuleInteractionTimeoutTypeEncoding::output_circuit_detection_phase_timeout);
          @sysvar::GBT27930::Charger::CurrentChargerStatus = kStatus5;
          break;
        default:
          break;
      }
      break;
    case kPowerSupplyModePhase:
      SendEndMessageAndEnterEndModule(_GBT27930::DataTypes::parEndType::FunctionModuleInformationInteractionTimeout, _GBT27930::DataTypes::FunctionModuleInteractionTimeoutTypeEncoding::power_supply_mode_phase_timeout);
      @sysvar::GBT27930::Charger::CurrentChargerStatus = kStatus8;
      break;
    case kPreChargingAndEnergyTransferPhase:
      SendEndMessageAndEnterEndModule(_GBT27930::DataTypes::parEndType::FunctionModuleInformationInteractionTimeout, _GBT27930::DataTypes::FunctionModuleInteractionTimeoutTypeEncoding::precharge_energy_transfer_phase_timeout);
      @sysvar::GBT27930::Charger::CurrentChargerStatus = kStatus6;
      break;
    case kEndPhase:
      SendEndMessageAndEnterEndModule(_GBT27930::DataTypes::parEndType::FunctionModuleInformationInteractionTimeout, _GBT27930::DataTypes::FunctionModuleInteractionTimeoutTypeEncoding::end_phase_timeout);
      CompleteEndPhase();
      break;
    default:
      break;
  }
}

on timer timer_Tout1_Charger
{
  switch(currentChargerPhase)
  {
    case kPowerSupplyModePhase:
      cancelTimer(timer_Tout0_Charger);
      cancelTimer(sendCyclicPowerSupplyStatusMessage); // T1 
      cancelTimer(sendChargerDynamicOutputCapabilityAfterChange); // T2
      @sysvar::GBT27930::Charger::CurrentChargerStatus = kStatus8;
      SendEndMessageAndEnterEndModule(_GBT27930::DataTypes::parEndType::FunctionModuleInformationInteractionTimeout, 0x0663); // Timeout for PGI 0x63 - Vehicle power supply demand
      break;
    case kSchedulingPhase:
      SendEndMessageAndEnterEndModule(_GBT27930::DataTypes::parEndType::FunctionModuleExecutionFailed, _GBT27930::DataTypes::ChargerFunctionModuleExecutionFailTypeEncoding::schedule_execution_wakeup_fail);
      @sysvar::GBT27930::Charger::CurrentChargerStatus = kStatus6;
      cancelTimer(sendCyclicWakeUpMessage);
      break;
    case kPreChargingAndEnergyTransferPhase:
      if (@sysvar::GBT27930::Charger::ChargingDischarging::EnergyTransferDirection == sysvar::GBT27930::Charger::ChargingDischarging::EnergyTransferDirection::Charging 
          && (@sysvar::GBT27930::Charger::CurrentChargerStatus == kStatus3 || @sysvar::GBT27930::Charger::CurrentChargerStatus == kStatus4))
      {
        SendEndMessageAndEnterEndModule(_GBT27930::DataTypes::parEndType::FunctionModuleInformationInteractionTimeout, 0x0773); // charging request message timeout
      }
      break;
    case kEndPhase:
      $Charger.GBT27930_2_2024.ChargerAllowsAdhesionDetection.AllowAdhesionDetection = _GBT27930::DataTypes::parEnableType::NotAllowed;
      StartTimerIfNotRunning(sendCyclicChargerAllowsAdhesionDetectionMessage, cChargerAuthenticationParameterCycleTimeMs);
      StartTimerIfNotRunning(timer_Tout2_Charger, @sysvar::GBT27930::Charger::Timeouts::Tout2_EndPhase_VehicleAdhesionDetectionReceived);
      @sysvar::GBT27930::Charger::CurrentChargerStatus = kStatus2;
      break;
    default:
      break;
  }
}

on timer timer_Tout2_Charger
{
  switch(currentChargerPhase)
  {
    case kPreChargingAndEnergyTransferPhase:
      if (@sysvar::GBT27930::Charger::ChargingDischarging::EnergyTransferDirection == sysvar::GBT27930::Charger::ChargingDischarging::EnergyTransferDirection::Discharging 
          && (@sysvar::GBT27930::Charger::CurrentChargerStatus == kStatus3 || @sysvar::GBT27930::Charger::CurrentChargerStatus == kStatus4))
      {
        SendEndMessageAndEnterEndModule(_GBT27930::DataTypes::parEndType::FunctionModuleInformationInteractionTimeout, 0x0764); // dynamic output capacity message
      }
      break;
    case kEndPhase:
      $Charger.GBT27930_2_2024.ChargerStatistics;
      cancelTimer(sendCyclicChargerAllowsAdhesionDetectionMessage);
      @sysvar::GBT27930::Charger::CurrentChargerStatus = kStatus3;
      break;
    default:
      break;
  }
}

on timer sendCyclicPowerSupplyStatusMessage
{
  switch(@sysvar::GBT27930::Charger::CurrentChargerStatus)
  {
    case kStatus1:
    case kStatus2:
      SendChargerPowerSupplyStatus(_GBT27930::DataTypes::parPowerSupplyStatusType::NotReady);
      break;
    case kStatus3:
      SendChargerPowerSupplyStatus(_GBT27930::DataTypes::parPowerSupplyStatusType::Ready);
      cancelTimer(timer_Tout0_Charger);
      StartTimerIfNotRunning(timer_Tout1_Charger,  @sysvar::GBT27930::Charger::Timeouts::Tout1_PowerSupplyMode_VehiclePowerSupplyDemandReceived);
      break;
    default:
      break;
  }
  
}

on timer sendCyclicChargerDCSupplyCircuitContactorStatusMessage
{
  if (!isTimerActive(sendChargerDCSupplyCircuitContactorStatusMessageAfterChange))
    SendChargerDCSupplyCircuitContactorStatusMessage();
}

// The timing logic of 1 000 ms cycle time and 50 ms cycle time are independent of each other
// when it changes, it is sent continuously for 3 frames with a cycle of 50 ms
on timer sendChargerDCSupplyCircuitContactorStatusMessageAfterChange
{
  if(sentDCSupplyContactorStatusAfterChangeCounter < 1) // send second message
  {
    SendChargerDCSupplyCircuitContactorStatusMessage();
    sentDCSupplyContactorStatusAfterChangeCounter++;
    setTimer(sendChargerDCSupplyCircuitContactorStatusMessageAfterChange, cURMAfterChangeCycleTimeMs);
  }
  else
  {
    SendChargerDCSupplyCircuitContactorStatusMessage();
    sentDCSupplyContactorStatusAfterChangeCounter = 0;
    setTimer(sendCyclicChargerDCSupplyCircuitContactorStatusMessage, cContactorStatusCycleTimeMs);
  }
}

on timer sendCyclicChargerElectronicLockStatusMessage
{
  if (!isTimerActive(sendChargerElectronicLockStatusMessageAfterChange))
    $Charger.GBT27930_2_2024.ChargerElectronicLockStatus;
}

on timer sendCyclicChargerAuthenticationParameterMessage
{
  StartTimerIfNotRunning(sendCyclicChargerAuthenticationParameterMessage, cChargerAuthenticationParameterCycleTimeMs);
  SendScanAuthenticationParameter();
}

on timer sendCyclicChargerReadyStatus
{
  SendChargerReadyStatus();

  if (@sysvar::GBT27930::Charger::CurrentChargerStatus == kStatus3 && counterSendCyclicChargerReadyStatus == 0)
  {
    cancelTimer(timer_Tout0_Charger);
    counterSendCyclicChargerReadyStatus += 1;
    setTimer(timer_Tout1_Charger, @sysvar::GBT27930::Charger::Timeouts::Tout1_PreChargingAndEnergyTransfer);
  }
}

on timer sendCyclicChargerBidirectionalChargingReadyStatus
{
  $Charger.GBT27930_2_2024.ChargerBidirectionalChargingReadyStatus.EnergyTransferDirection = @sysvar::GBT27930::Charger::ChargingDischarging::EnergyTransferDirection;
  if (@sysvar::GBT27930::Charger::ReadyStatus == 0)
  {
    $Charger.GBT27930_2_2024.ChargerBidirectionalChargingReadyStatus.ChargerReadyStatus = _GBT27930::DataTypes::parReadyType::NotReady;
  }
  else if (@sysvar::GBT27930::Charger::ReadyStatus == 1)
  {
    $Charger.GBT27930_2_2024.ChargerBidirectionalChargingReadyStatus.ChargerReadyStatus = _GBT27930::DataTypes::parReadyType::Ready;
    SetChargingStationPicturesVisibility(Charging);
  }
  if (@sysvar::GBT27930::Charger::CurrentChargerStatus == kStatus3 && counterSendCyclicChargerReadyStatus == 0)
  {
    cancelTimer(timer_Tout0_Charger); // cancel cyclic timer
    counterSendCyclicChargerReadyStatus += 1;
    setTimer(timer_Tout1_Charger, @sysvar::GBT27930::Charger::Timeouts::Tout1_PreChargingAndEnergyTransfer);
    setTimer(timer_Tout2_Charger, @sysvar::GBT27930::Charger::Timeouts::Tout2_PreChargingAndEnergyTransfer);
  }
}

on timer sendCyclicChargerEnergyTransferDynamicOutputCapacity
{
  if (!isTimerActive(sendCyclicChargerEnergyTransferDynamicOutputCapacity))
    SendCyclicChargerEnergyTransferDynamicOutputCapacity();
}

on timer sendCyclicChargerChargingBasicInformation
{
  SendChargerChargingBasicInformation();
}

on timer sendCyclicChargerBidirectionalOutputCapability
{
  if (!isTimerActive(sendChargerBidirectionalOutputCapabilityAfterChange))
    SendChargerBidirectionalDynamicOutputCapacity();
}

on timer sendCyclicChargerBidirectionalChargingInfo
{
  $Charger.GBT27930_2_2024.ChargerBidirectionalChargingInfo.OutputVoltage.phys = HV_measure_DC_U();
  switch (@sysvar::GBT27930::Charger::ChargingDischarging::EnergyTransferDirection)
  {
    case sysvar::GBT27930::Charger::ChargingDischarging::EnergyTransferDirection::Charging:
      $Charger.GBT27930_2_2024.ChargerBidirectionalChargingInfo.ChargingOutputCurrent.phys = HV_measure_DC_I();
      $Charger.GBT27930_2_2024.ChargerBidirectionalChargingInfo.DischargingCurrent.phys = 0;
      break;
    case sysvar::GBT27930::Charger::ChargingDischarging::EnergyTransferDirection::Discharging:
      $Charger.GBT27930_2_2024.ChargerBidirectionalChargingInfo.DischargingCurrent.phys = HV_measure_DC_I();
      $Charger.GBT27930_2_2024.ChargerBidirectionalChargingInfo.ChargingOutputCurrent.phys = 0;
  }
  
}

on timer sendCyclicChargerDischargeRequest
{
  if (!isTimerActive(sendChargerDischargeRequestAfterChange)) 
  {
    $Charger.GBT27930_2_2024.ChargerDischargeRequest.CurrentDemand.phys = @sysvar::GBT27930::Charger::ChargingDischarging::DischargeCurrentDemand;
  }
}

on timer sendChargerElectronicLockStatusMessageAfterChange
{
  if(sentChargerLockStatusAfterChangeCounter < 1) // send second message
  {
    $Charger.GBT27930_2_2024.ChargerElectronicLockStatus;
    sentChargerLockStatusAfterChangeCounter++;
    setTimer(sendChargerElectronicLockStatusMessageAfterChange, cURMAfterChangeCycleTimeMs);
  }
  else  // send third message
  {
    $Charger.GBT27930_2_2024.ChargerElectronicLockStatus;
    sentChargerLockStatusAfterChangeCounter = 0;
    // Restart cyclic sending of message, if not in end module
    if(@sysvar::GBT27930::Charger::CurrentChargerFunctionModule != @sysvar::GBT27930::Charger::CurrentChargerFunctionModule::`End)
      setTimerCyclic(sendCyclicChargerElectronicLockStatusMessage, cContactorStatusCycleTimeMs);
  }
}

// When it changes, it is sent continuously for 3 frames with a cycle of 50 ms
on timer sendChargerDischargeRequestAfterChange
{
  if(sentChargerDischargeRequestAfterChangeCounter < 1) // second message
  {
    $Charger.GBT27930_2_2024.ChargerDischargeRequest.CurrentDemand.phys = @sysvar::GBT27930::Charger::ChargingDischarging::DischargeCurrentDemand;
    setTimer(sendChargerDischargeRequestAfterChange, cURMAfterChangeCycleTimeMs);
    sentChargerDischargeRequestAfterChangeCounter++;
  }
  else  // third message
  {
    $Charger.GBT27930_2_2024.ChargerDischargeRequest.CurrentDemand.phys = @sysvar::GBT27930::Charger::ChargingDischarging::DischargeCurrentDemand;
    sentChargerDischargeRequestAfterChangeCounter = 0;
    setTimerCyclic(sendCyclicChargerDischargeRequest, cChargerDischargeRequestCycleTimeMs);
  }
}

// When it changes, it is sent continuously for 3 frames with a cycle of 50 ms
on timer sendChargerDynamicOutputCapabilityAfterChange
{
  if(sentChargerDynamicOutputCapabilityAfterChangeCounter < 1) // second message
  {
    SendChargerDynamicOutputCapability();
    sentChargerDynamicOutputCapabilityAfterChangeCounter++;
    setTimer(sendChargerDynamicOutputCapabilityAfterChange, cURMAfterChangeCycleTimeMs);
  }
  else // third message
  {
    SendChargerDynamicOutputCapability();
    sentChargerDynamicOutputCapabilityAfterChangeCounter = 0;
    setTimerCyclic(sendCyclicChargerDynamicOutputCapabilityAndBasicInformationMessage, cChargerDynamicOutputCapabilityAndBasicInformationCycleTimeMs);
  }
}

on timer sendChargerEnergyTransferDynamicOutputCapacityAfterChange
{
  if(sentChargerEnergyTransferDynamicOutputCapacityAfterChangeCounter < 1) // second message
  {
    SendChargerEnergyTransferDynamicOutputCapacity();
    sentChargerEnergyTransferDynamicOutputCapacityAfterChangeCounter++;
    setTimer(sendChargerEnergyTransferDynamicOutputCapacityAfterChange, cURMAfterChangeCycleTimeMs);
  }
  else // third message
  {
    SendChargerEnergyTransferDynamicOutputCapacity();
    sentChargerEnergyTransferDynamicOutputCapacityAfterChangeCounter = 0;
  }
}

on timer sendChargerBidirectionalOutputCapabilityAfterChange
{
  if(sentChargerBidirectionalOutputCapabilityAfterChangeCounter < 1) // second message
  {
    SendChargerBidirectionalDynamicOutputCapacity();
    sentChargerBidirectionalOutputCapabilityAfterChangeCounter++;
    setTimer(sendChargerBidirectionalOutputCapabilityAfterChange, cURMAfterChangeCycleTimeMs);
  }
  else // third message
  {
    SendChargerEnergyTransferDynamicOutputCapacity();
    sentChargerBidirectionalOutputCapabilityAfterChangeCounter = 0;
  }
}

on timer sendCyclicChargerDetectionInformationMessage
{
  int anyFailureDetected;
  anyFailureDetected = 0;
  // Status shall only be checked once electronic lock status is 'locked'
  if($Charger.GBT27930_2_2024.ChargerElectronicLockStatus.LockStatus == _GBT27930::DataTypes::parLatchingStatusType::Locked)
    UpdateChargerDetectionValueIfNeeded();
  
  $Charger.GBT27930_2_2024.ChargerDetectionInformation.AdhesionDetectionStatus = @sysvar::GBT27930::Charger::Messages::ChargerDetectionInformation::AdhesionDetectionStatus;
  $Charger.GBT27930_2_2024.ChargerDetectionInformation.ShortCircuitDetectionStatus = @sysvar::GBT27930::Charger::Messages::ChargerDetectionInformation::ShortCircuitDetectionStatus;
  $Charger.GBT27930_2_2024.ChargerDetectionInformation.InsulationDetectionStatus = @sysvar::GBT27930::Charger::Messages::ChargerDetectionInformation::InsulationDetectionStatus;
  $Charger.GBT27930_2_2024.ChargerDetectionInformation.DischargeStatus = @sysvar::GBT27930::Charger::Messages::ChargerDetectionInformation::DischargeStatus;

  if($Charger.GBT27930_2_2024.ChargerDetectionInformation.AdhesionDetectionStatus == _GBT27930::DataTypes::parCheckType::DetectionFailed)
  {
    anyFailureDetected = 1;
    SendEndMessageAndEnterEndModule(_GBT27930::DataTypes::parEndType::FunctionModuleExecutionFailed, _GBT27930::DataTypes::ChargerFunctionModuleExecutionFailTypeEncoding::output_circuit_detection_adhesion_detection_fail);
  }
  if($Charger.GBT27930_2_2024.ChargerDetectionInformation.ShortCircuitDetectionStatus == _GBT27930::DataTypes::parCheckType::DetectionFailed)
  {
    anyFailureDetected = 1;
    SendEndMessageAndEnterEndModule(_GBT27930::DataTypes::parEndType::FunctionModuleExecutionFailed, _GBT27930::DataTypes::ChargerFunctionModuleExecutionFailTypeEncoding::output_circuit_detection_short_circuit_detection_fail);
  }
  if($Charger.GBT27930_2_2024.ChargerDetectionInformation.InsulationDetectionStatus == _GBT27930::DataTypes::parCheckType::DetectionFailed)
  {
    anyFailureDetected = 1;
    SendEndMessageAndEnterEndModule(_GBT27930::DataTypes::parEndType::FunctionModuleExecutionFailed, _GBT27930::DataTypes::ChargerFunctionModuleExecutionFailTypeEncoding::output_circuit_detection_insulation_detection_fail);
  }
  if($Charger.GBT27930_2_2024.ChargerDetectionInformation.DischargeStatus == _GBT27930::DataTypes::parDischargeType::DischargeFailed)
  {
    anyFailureDetected = 1;
    SendEndMessageAndEnterEndModule(_GBT27930::DataTypes::parEndType::FunctionModuleExecutionFailed, _GBT27930::DataTypes::ChargerFunctionModuleExecutionFailTypeEncoding::output_circuit_detection_discharge_fail);
  }

  if(anyFailureDetected != 0)
  {
    currentChargerPhase = kEndPhase;
    @sysvar::GBT27930::Charger::CurrentChargerStatus = kStatus5;
    StartTimerIfNotRunning(stateTransitionTimer,  @sysvar::GBT27930::Charger::DelayTransition::AnyMessage_to_End);
    cancelTimer(sendCyclicChargerDetectionInformationMessage);
  }
}

on timer timer_CloseElectronicLock
{
  @sysvar::GBT27930::Charger::ElectronicLockStatus = _GBT27930::DataTypes::parLatchingStatusType::Locked;
  @sysvar::GBT27930::Charger::CurrentChargerStatus = kStatus2;
}

on timer sendCyclicChargerDynamicOutputCapabilityAndBasicInformationMessage
{
  if(!isTimerActive(sendChargerDynamicOutputCapabilityAfterChange))
    SendChargerDynamicOutputCapability();
  SendChargerPowerSupplyBasicInformationMessage();
}

on timer timer_SimulateAuthentication_Charger
{
  // Authentication Completed
  if (@sysvar::GBT27930::Charger::Authentication::AuthenticationType == @sysvar::GBT27930::Charger::Authentication::AuthenticationType::Scan)
  {
    @sysvar::GBT27930::Charger::Authentication::AuthenticationStatus = 0xAA;
    cancelTimer(sendCyclicChargerAuthenticationParameterMessage);
    SendScanAuthenticationParameter();
    $Charger.GBT27930_2_2024.ChargerScanAuthenticationResult.AuthenticationResult = 0xAA;
    $Charger.GBT27930_2_2024.ChargerScanAuthenticationResult.SuccessfulAuthenticationFDC = 1;
    SendChargerPhaseRequest();
    @sysvar::GBT27930::Charger::CurrentChargerStatus = kStatus2;
  }
  else if (@sysvar::GBT27930::Charger::Authentication::AuthenticationType == @sysvar::GBT27930::Charger::Authentication::AuthenticationType::Cloud)
  {
    if (@sysvar::GBT27930::Charger::Authentication::TriggerReAuthentication == 0)
    {
      @sysvar::GBT27930::Charger::Authentication::AuthenticationStatus = 0xAA;
      $Charger.GBT27930_2_2024.ChargerCloudAuthenticationResult.SuccessfulAuthenticationFDC = 3;
      SendChargerPhaseRequest();
      @sysvar::GBT27930::Charger::CurrentChargerStatus = kStatus4;
    } else {
      @sysvar::GBT27930::Charger::Authentication::AuthenticationStatus = 0x00;
      $Charger.GBT27930_2_2024.ChargerCloudAuthenticationResult.SuccessfulAuthenticationFDC = 0;
      @sysvar::GBT27930::Charger::CurrentChargerStatus = kStatus3;
    }
    $Charger.GBT27930_2_2024.ChargerCloudAuthenticationResult.AuthenticationResult = @sysvar::GBT27930::Charger::Authentication::AuthenticationStatus;
  }
}

on timer timer_WaitForScheduledChargingStart
{
  WriteLineEx(-3,1,"Charger: Reached scheduled charging time. Wakeup vehicle");
  if (@sysvar::GBT27930::Charger::VersionNegotiation::ControlPilotVersion == sysvar::GBT27930::Charger::VersionNegotiation::ControlPilotVersion::NewVersionCPCircuit)
  {  
    CHA_open_close_K3K4(CLOSE);
    CHA_set_auxiliary_voltage(cAux_voltage);
  }
  $Charger.GBT27930_2_2024.ChargerWakeUp.WakeUp = _GBT27930::DataTypes::WakeUpTypeEncoding::wake_up;
  setTimerCyclic(sendCyclicWakeUpMessage, cWakeUpCycleTimeMs);
  setTimer(timer_Tout1_Charger, @sysvar::GBT27930::Charger::Timeouts::Tout1_VehicleWakeUpReceived);
}

on timer sendCyclicWakeUpMessage
{
  $Charger.GBT27930_2_2024.ChargerWakeUp.WakeUp = _GBT27930::DataTypes::WakeUpTypeEncoding::wake_up;
}

on timer sendCyclicChargerAllowsAdhesionDetectionMessage
{
  $Charger.GBT27930_2_2024.ChargerAllowsAdhesionDetection;
}

on timer timer_MonitorExternalVoltageK1K2
{
  if (currentChargerPhase == kPowerSupplyModePhase && @sysvar::GBT27930::Charger::CurrentChargerStatus == kStatus2 && HV_measure_DC_U() < 60)
  {
    HV_open_close_K1K2(CLOSE); 
    @sysvar::GBT27930::Charger::CurrentChargerStatus = kStatus3;
  }
}

void CancelTimers()
{
  writeLineEx(-3, 1, "Charger: Cancel all timers");
  cancelTimer(stateTransitionTimer);
  cancelTimer(sendCyclicVersionNegotiationMessage);
  cancelTimer(timer_Tout0_Charger);
  cancelTimer(timer_Tout1_Charger);
  cancelTimer(timer_Tout2_Charger);
  cancelTimer(sendCyclicChargerDCSupplyCircuitContactorStatusMessage);
  cancelTimer(sendChargerDCSupplyCircuitContactorStatusMessageAfterChange);
  cancelTimer(sendCyclicChargerElectronicLockStatusMessage);
  cancelTimer(sendChargerElectronicLockStatusMessageAfterChange);
  cancelTimer(sendChargerDischargeRequestAfterChange);
  cancelTimer(sendChargerDynamicOutputCapabilityAfterChange);
  cancelTimer(timer_SimulateAuthentication_Charger);
  cancelTimer(timer_WaitForScheduledChargingStart);
  cancelTimer(sendCyclicWakeUpMessage);
  cancelTimer(sendCyclicChargerDetectionInformationMessage);
  cancelTimer(timer_CloseElectronicLock);
  cancelTimer(sendCyclicPowerSupplyStatusMessage);
  cancelTimer(sendCyclicChargerDynamicOutputCapabilityAndBasicInformationMessage);
  cancelTimer(sendCyclicChargerAuthenticationParameterMessage);
  cancelTimer(sendCyclicChargerAllowsAdhesionDetectionMessage);
  cancelTimer(sendCyclicChargerEnergyTransferDynamicOutputCapacity);
  cancelTimer(sendCyclicChargerChargingBasicInformation);
  cancelTimer(sendCyclicChargerBidirectionalChargingReadyStatus);
}

/////////////////////////////////////////////////////////////////////////////////////
/*------------------------------------On Event-------------------------------------*/
/////////////////////////////////////////////////////////////////////////////////////

on sysvar_change GBT27930::Charger::ContactorStatus_K1K2
{
  UpdateK1K2StatusText();
  
  if(currentChargerPhase != kInitial)
  {
    sentDCSupplyContactorStatusAfterChangeCounter = 0; // reset counter to 0
    SendChargerDCSupplyCircuitContactorStatusMessage();
    cancelTimer(sendCyclicChargerDCSupplyCircuitContactorStatusMessage);
    setTimer(sendChargerDCSupplyCircuitContactorStatusMessageAfterChange, cURMAfterChangeCycleTimeMs);
  }
  
  if (currentChargerPhase == kPowerSupplyModePhase && @sysvar::GBT27930::Charger::CurrentChargerStatus == kStatus5 && @this == OPEN)
  {
    SendChargerPhaseRequest();
    @sysvar::GBT27930::Charger::CurrentChargerStatus = kStatus6;
  }
  
  if(currentChargerPhase == kEndPhase)
    ReactToOpenK1K2DuringEndPhase();
}

on sysvar_change GBT27930::Charger::CurrentChargerStatus
{
  writeLineEx(1,1,"Charger: Switch to charger state: %d within %d", @this, currentChargerPhase);
}

on sysvar GBT27930::svStart
{
  if(@this == 0) // Plug-In
  {  
    currentChargerPhase = kInitial;
    @sysvar::GBT27930::Charger::CurrentChargerFunctionModule = @sysvar::GBT27930::Charger::CurrentChargerFunctionModule::Initial;
    @sysvar::GBT27930::Charger::CurrentChargerStatus = 0;
    ResetStateVariables();
    ResetSentMessageCounters();
    //Reset / clean start of relays
    Connect_CAN();
    if (@sysvar::GBT27930::Charger::VersionNegotiation::ControlPilotVersion == sysvar::GBT27930::Charger::VersionNegotiation::ControlPilotVersion::NewVersionCPCircuit)
    {
      CHA_open_close_K3K4(OPEN); // ensure K3/K4 is open with new CP version
      gConnectionControlSequence = T0;
      gConnectionControlSequenceCounter = 0;
      setTimerCyclic(tmrConnectionControlSequenceNewVersion, deferConnectionControlSequence);
    } else {
      setTimerCyclic(tmrConnectionControlSequenceOldVersion, deferConnectionControlSequence);
    }
  }
  else  // Plug-Out
  {
    ResetStateVariables();
    ResetSentMessageCounters();
    CancelTimers();
    HV_source_reset();
    CHA_set_auxiliary_voltage(0.0);
    
    Disconnect_CAN();
    StartTimerReadyToOpen_K1_K2(cOpenK1K2DelayMs);
    CHA_open_close_K3K4(OPEN);
    CHA_open_Close_S(OPEN); //Plug-out starting
    Disconnect_CC1();
    Disconnect_CC2();
    CHA_open_close_S(CLOSE); //Plug-out completed
  }
}

on sysvar_change GBT27930::Charger::ElectronicLockStatus
{
  UpdateElectronicLockText();
  $Charger.GBT27930_2_2024.ChargerElectronicLockStatus.LockStatus = @this;
  sentChargerLockStatusAfterChangeCounter = 0;
  cancelTimer(sendCyclicChargerElectronicLockStatusMessage);
  setTimer(sendChargerElectronicLockStatusMessageAfterChange, cURMAfterChangeCycleTimeMs);
}

on sysvar_change GBT27930::Charger::PreChargingComplete
{
  if (@sysvar::GBT27930::Charger::PreChargingComplete == 1)
  {
    writeLineEx(-3, 1, "PreCharging Complete");
    HV_open_close_K1K2(CLOSE);
    writeLineEx(-3, 1, "Closing K1, K2");

    @sysvar::GBT27930::Charger::CurrentChargerStatus = kStatus3;
    @sysvar::GBT27930::Charger::ReadyStatus = 1;
  }
}

on sysvar_change GBT27930::Charger::Control::ManualTriggerChargingStop
{
  if (@sysvar::GBT27930::Charger::Control::ManualTriggerChargingStop == 1 && currentChargerPhase == kPreChargingAndEnergyTransferPhase)
  {
    writeLineEx(-3, 1, "Charger: Triggered abort charging process");
    StopChargingProcedure();
  }
}

on sysvar_change sysvar::GBT27930::Charger::ChargingDischarging::DischargeCurrentDemand
{
  if (@sysvar::GBT27930::Charger::ChargingDischarging::EnergyTransferDirection == sysvar::GBT27930::Charger::ChargingDischarging::EnergyTransferDirection::Discharging
  && currentChargerPhase == kPreChargingAndEnergyTransferPhase && @sysvar::GBT27930::Charger::CurrentChargerStatus == kStatus4)
  {
    $Charger.GBT27930_2_2024.ChargerDischargeRequest.CurrentDemand.phys = @sysvar::GBT27930::Charger::ChargingDischarging::DischargeCurrentDemand;
    StartTimerIfNotRunning(sendChargerDischargeRequestAfterChange, cURMAfterChangeCycleTimeMs);
    sentChargerDischargeRequestAfterChangeCounter = 0;
  }
}

on sysvar_change GBT27930::Charger::ChargingDischarging::MaxCurrent
{
  if (currentChargerPhase == kPowerSupplyModePhase && @sysvar::GBT27930::Charger::CurrentChargerStatus == kStatus4)
  {
    SendChargerDynamicOutputCapability();
    sentChargerDynamicOutputCapabilityAfterChangeCounter = 0;
    setTimer(sendChargerDynamicOutputCapabilityAfterChange, cURMAfterChangeCycleTimeMs);
  } else if (currentChargerPhase == kPreChargingAndEnergyTransferPhase && @sysvar::GBT27930::Charger::CurrentChargerStatus == kStatus4 
            && $Charger.GBT27930_2_2024.VehicleFunctionNegotiationAckResult.PreChargingAndEnergyTransmission == _GBT27930::DataTypes::FDCNegotiationResultType::SupportFDC1) 
  {
    SendChargerEnergyTransferDynamicOutputCapacity();
    sentChargerEnergyTransferDynamicOutputCapacityAfterChangeCounter = 0;
    setTimer(sendChargerEnergyTransferDynamicOutputCapacityAfterChange, cURMAfterChangeCycleTimeMs);
  } else if (currentChargerPhase == kPreChargingAndEnergyTransferPhase && @sysvar::GBT27930::Charger::CurrentChargerStatus == kStatus4
            && $Charger.GBT27930_2_2024.VehicleFunctionNegotiationAckResult.PreChargingAndEnergyTransmission == _GBT27930::DataTypes::FDCNegotiationResultType::SupportFDC2) 
  {
    SendChargerBidirectionalDynamicOutputCapacity();
    sentChargerBidirectionalOutputCapabilityAfterChangeCounter = 0;
    setTimer(sendChargerBidirectionalOutputCapabilityAfterChange, cURMAfterChangeCycleTimeMs);
  }
}

/////////////////////////////////////////////////////////////////////////////////////
/*--------------------------------------Control------------------------------------*/
/////////////////////////////////////////////////////////////////////////////////////
void ResetStateVariables()
{
  int skipAuthentication = 0;
  int skipScheduling = 0;
  int skipPowerSupply = 0;

  @sysvar::GBT27930::Charger::PreChargingComplete = 0;
  @sysvar::GBT27930::Charger::ReadyStatus = 0;
  
  // Reset VehicleVersion sysvars
  @sysvar::GBT27930::Charger::VersionNegotiation::ReceivedVehicleProtocolVersion[0] = 0;
  @sysvar::GBT27930::Charger::VersionNegotiation::ReceivedVehicleProtocolVersion[1] = 0;
  @sysvar::GBT27930::Charger::VersionNegotiation::ReceivedVehicleProtocolVersion[2] = 0;
  @sysvar::GBT27930::Charger::VersionNegotiation::NegotiationResult = 0;
  counterSendCyclicChargerReadyStatus = 0;
  SetChargingStationPicturesVisibility(Ready); 
}

void ResetSentMessageCounters()
{
  sentDCSupplyContactorStatusAfterChangeCounter = 0;
  sentChargerLockStatusAfterChangeCounter = 0;
  sentChargerDischargeRequestAfterChangeCounter = 0;
  sentChargerDynamicOutputCapabilityAfterChangeCounter = 0;
  sentChargerEnergyTransferDynamicOutputCapacityAfterChangeCounter = 0;
  sentChargerBidirectionalOutputCapabilityAfterChangeCounter = 0;
}

on start 
{
  ST_Init();
  ResetSentMessageCounters();
  currentChargerPhase = kInitial;
}

on preStop
{
  deferStop(1000);
  SetChargingStationPicturesVisibility(Ready);
  HV_source_reset();
}

void StartCommunication()
{
  isAbnormalEnd = 0;
  CancelTimers();
  chargerNegotiationState = kInitialization; // set State S0: Initialization
  currentVersionIndex = NUM_CHARGER_VERSIONS-1;
  if (isVersionSortedAscending(chargerVersions, currentVersionIndex) == 0)
  {
    writeLineEx(1,3,"Failed to start Communication: struct chargerVersions is not in ascending order. Please fix struct in 'Charger.can'");
    return;
  }
  SetChargingStationPicturesVisibility(Ready);
  if (@sysvar::GBT27930::Charger::VersionNegotiation::chargerUseVersionStruct == sysvar::GBT27930::Charger::VersionNegotiation::chargerUseVersionStruct::VersionList)
  {
    SetSysvarChargerVersionFromVersionStruct(currentVersionIndex);
  }
  chargerVersionHasChanged = 0;
  isReauthenticationTriggered = 0;
  StartTimerIfNotRunning(sendCyclicVersionNegotiationMessage, @GBT27930::Charger::DelayTransition::svK3K4_to_VersionNegotiation);
  setTimer(timer_Tout0_Charger, @sysvar::GBT27930::Charger::Timeouts::Tout0_VersionNegotiation); // Timeout Version Negotiation after Tout0 expires
}

void ChargerTargetReached(int isBMSsuspending )
{
  SetChargingStationPicturesVisibility(Ready); 
}

void SuspendCharging()
{
  SetChargingStationPicturesVisibility(Error);
}

void EndCommunication()
{
  writeLineEx(1,3,"Charger: Reached end of simulation.");
  cancelTimer(sendCyclicChargerElectronicLockStatusMessage);
  cancelTimer(sendChargerElectronicLockStatusMessageAfterChange);
}

void StartGBT27930CategoryACommunication()
{
  // Not implemented
  writeLineEx(1,3,"Charger: GBT27930 Category A communication is not supported within this Configuration. Please use Sample Configuration 'GB/T 27930 (2023 Category A) Simulation'.");
  EndCommunication();
}

void StartParameterConfiguration_OnlyCharging()
{
  writeLineEx(-3,1,"#### Charger: Enter Parameter Configuration (charging only) ####");
  SendChargerChargingParameters();
  StartTimerIfNotRunning(timer_Tout0_Charger, @sysvar::GBT27930::Charger::Timeouts::Tout0_ParameterConfiguration);
  @sysvar::GBT27930::Charger::CurrentChargerStatus = kStatus1;
}

void CompleteFunctionNegotiationPhase()
{
  int stateTransistionTime = 100;
  if($Charger.GBT27930_2_2024.VehicleAcknowledge.PhaseAck == _GBT27930::DataTypes::PhaseAckTypeEncoding::acknowledgement_succeeded)
  {
    writeLineEx(-3,1,"#### Charger: Complete Function negotiation phase ####");
    currentChargerPhase = kParameterConfigurationPhase;
    stateTransistionTime = @sysvar::GBT27930::Charger::DelayTransition::FunctionNegotiation_to_ParameterConfiguration;
  }
  else // failed / unknown value
  {
    currentChargerPhase = kEndPhase;
    @sysvar::GBT27930::Charger::CurrentChargerStatus = kStatus4;
    SendEndMessageAndEnterEndModule(_GBT27930::DataTypes::parEndType::PhaseAcknowledgementFailed, _GBT27930::DataTypes::PhaseAcknowledgementFailTypeEncoding::phase_acknowledgement_fail);
    stateTransistionTime = @sysvar::GBT27930::Charger::DelayTransition::AnyMessage_to_End;
  }

  @sysvar::GBT27930::Charger::CurrentChargerStatus = kStatus0;
  cancelTimer(timer_Tout0_Charger);
  StartTimerIfNotRunning(stateTransitionTimer, stateTransistionTime);
}

void CompleteParameterConfiguration()
{
  int stateTransistionTime = 100;
  if($Charger.GBT27930_2_2024.VehicleAcknowledge.PhaseAck == _GBT27930::DataTypes::PhaseAckTypeEncoding::acknowledgement_succeeded)
  {
    if (!skipAuthentication)
    {
      currentChargerPhase = kAuthenticationPhase;
      stateTransistionTime = @sysvar::GBT27930::Charger::DelayTransition::ParameterConfiguration_to_Authentication;
    }
    else if (!skipScheduling)
    {
      currentChargerPhase = kSchedulingPhase;
      stateTransistionTime = @sysvar::GBT27930::Charger::DelayTransition::ParameterConfiguration_to_Scheduling;
    }
    else
    {
      currentChargerPhase = kOutputCircuitDetectionPhase;
      stateTransistionTime = @sysvar::GBT27930::Charger::DelayTransition::ParameterConfiguration_to_OutputCircuitDetection;
    }
  } 
  else // failed / unknown value
  {
    currentChargerPhase = kEndPhase;
    SendEndMessageAndEnterEndModule(_GBT27930::DataTypes::parEndType::PhaseAcknowledgementFailed, _GBT27930::DataTypes::PhaseAcknowledgementFailTypeEncoding::phase_acknowledgement_fail);
    stateTransistionTime = @sysvar::GBT27930::Charger::DelayTransition::AnyMessage_to_End;
  }

  @sysvar::GBT27930::Charger::CurrentChargerStatus = kStatus0;
  cancelTimer(timer_Tout0_Charger);
  StartTimerIfNotRunning(stateTransitionTimer, stateTransistionTime);
}

void CompleteAuthenticationPhase()
{
  int stateTransistionTime = 100;
  @sysvar::GBT27930::Charger::CurrentChargerStatus = kStatus0;
  if($Charger.GBT27930_2_2024.VehicleAcknowledge.PhaseAck == _GBT27930::DataTypes::PhaseAckTypeEncoding::acknowledgement_succeeded)
  {
    if (isReauthenticationTriggered == 1)
    {
      writeLineEx(-3,1,"ReAuthentication");
      isReauthenticationTriggered = 0;
      @sysvar::GBT27930::Charger::Authentication::PreferedAuthenticationMethod = $Charger.GBT27930_2_2024.ChargerPhaseRequest.Phase - 0x3001;
      currentChargerPhase = kAuthenticationPhase; 
      stateTransistionTime = @sysvar::GBT27930::Charger::DelayTransition::ReAuthenticationDelay;
    }
    else 
    {
      if (!skipScheduling)
      {
        currentChargerPhase = kSchedulingPhase;
        stateTransistionTime = @sysvar::GBT27930::Charger::DelayTransition::Authentication_to_SchedulingPhase;
      } 
      else 
      {
        currentChargerPhase = kOutputCircuitDetectionPhase;
        stateTransistionTime = @sysvar::GBT27930::Charger::DelayTransition::Authentication_to_OutputCircuitDetection;
      }
    }
  }
  else // failed / unknown value
  {
    currentChargerPhase = kEndPhase;
    stateTransistionTime = @sysvar::GBT27930::Charger::DelayTransition::AnyMessage_to_End;
  }
  cancelTimer(timer_Tout0_Charger);
  cancelTimer(sendCyclicChargerAuthenticationParameterMessage);
  
  StartTimerIfNotRunning(stateTransitionTimer, stateTransistionTime);
}

void StartScheduling()
{
  writeLineEx(-3,1,"#### Charger: Enter Scheduling ####");
  StartTimerIfNotRunning(timer_Tout0_Charger, @sysvar::GBT27930::Charger::Timeouts::Tout0_Scheduling);
  $Charger.GBT27930_2_2024.ChargerScheduledChargingInformation;
  @sysvar::GBT27930::Charger::CurrentChargerStatus = kStatus1;
}

void CompleteSchedulingPhase()
{
  int stateTransistionTime = 100;
  if($Charger.GBT27930_2_2024.VehicleAcknowledge.PhaseAck == _GBT27930::DataTypes::PhaseAckTypeEncoding::acknowledgement_succeeded)
  {
    currentChargerPhase = kOutputCircuitDetectionPhase;
    stateTransistionTime = @sysvar::GBT27930::Charger::DelayTransition::Scheduling_to_OutputCircuitDetection;
  } 
  else // failed / unknown value
  {
    currentChargerPhase = kEndPhase;
    SendEndMessageAndEnterEndModule(_GBT27930::DataTypes::parEndType::PhaseAcknowledgementFailed, _GBT27930::DataTypes::PhaseAcknowledgementFailTypeEncoding::phase_acknowledgement_fail);
    stateTransistionTime = @sysvar::GBT27930::Charger::DelayTransition::AnyMessage_to_End;
  }
  
  @sysvar::GBT27930::Charger::CurrentChargerStatus = kStatus0;
  StartTimerIfNotRunning(stateTransitionTimer,  stateTransistionTime);
}

void StartFunctionNegotiationPhase()
{
  writeLineEx(-3,1,"#### Charger: Enter Function Negotiation ####");
  setTimer(timer_Tout0_Charger, @sysvar::GBT27930::Charger::Timeouts::Tout0_FunctionNegotiation);
  SendChargerSupportFunction();
  @sysvar::GBT27930::Charger::CurrentChargerStatus = kStatus1;
}

void StartParameterConfiguration_ChargingAndDischarging()
{
  writeLineEx(-3,1,"#### Charger: Enter Parameter Configuration (charging and discharging) ####");
  SendChargerChargingAndDischargingParameters();
  StartTimerIfNotRunning(timer_Tout0_Charger, @sysvar::GBT27930::Charger::Timeouts::Tout0_ParameterConfiguration);
  @sysvar::GBT27930::Charger::CurrentChargerStatus = kStatus1;
}

void StartOutputCircuitDetection()
{
  writeLineEx(-3,1,"#### Charger: Enter Output Circuit Detection ####");
  @sysvar::GBT27930::Charger::CurrentChargerStatus = kStatus0;
  StartTimerIfNotRunning(timer_Tout0_Charger, @sysvar::GBT27930::Charger::Timeouts::Tout0_OutputCircuitDetection);
  setTimerCyclic(sendCyclicChargerDetectionInformationMessage, cChargerDetectionInformationCycleTimeMs);
  sentChargerDetectionInformationCounter = 0;
   if (@sysvar::GBT27930::Charger::VersionNegotiation::ControlPilotVersion == sysvar::GBT27930::Charger::VersionNegotiation::ControlPilotVersion::NewVersionCPCircuit)
     gConnectionControlSequence = T6;

  if($Charger.GBT27930_2_2024.ChargerElectronicLockStatus.LockStatus != _GBT27930::DataTypes::parLatchingStatusType::Locked)
  {
    StartTimerIfNotRunning(timer_CloseElectronicLock, cCloseElectronicLockDelayMs);
    @sysvar::GBT27930::Charger::CurrentChargerStatus = kStatus1;
  }
  else
  {
    @sysvar::GBT27930::Charger::CurrentChargerStatus = kStatus2;
  }
}

void CompleteOutputCircuitDetection()
{
  int stateTransistionTime = 100;
  if($Charger.GBT27930_2_2024.VehicleAcknowledge.PhaseAck == _GBT27930::DataTypes::PhaseAckTypeEncoding::acknowledgement_succeeded)
  {
    if (!skipPowerSupply)
    {
      currentChargerPhase = kPowerSupplyModePhase;
      stateTransistionTime = @sysvar::GBT27930::Charger::DelayTransition::OutputCircuitDetection_to_PowerSupplyMode;
    }
    else 
    {
      currentChargerPhase = kPreChargingAndEnergyTransferPhase;
      stateTransistionTime = @sysvar::GBT27930::Charger::DelayTransition::OutputCircuitDetection_to_PreChargingAndEnergyTransfer;
    }
  } 
  else // failed / unknown value
  {
    currentChargerPhase = kEndPhase;
    stateTransistionTime = @sysvar::GBT27930::Charger::DelayTransition::AnyMessage_to_End;
  }

  @sysvar::GBT27930::Charger::CurrentChargerStatus = kStatus0;
  cancelTimer(timer_Tout0_Charger);
  cancelTimer(sendCyclicChargerDetectionInformationMessage);
  StartTimerIfNotRunning(stateTransitionTimer, stateTransistionTime);
}

void StartPowerSupplyMode()
{
  writeLineEx(-3,1,"#### Charger: Enter Power Supply Mode ####");
  @sysvar::GBT27930::Charger::CurrentChargerStatus = kStatus0;
  SendChargerPowerSupplyStatus(_GBT27930::DataTypes::parPowerSupplyStatusType::NotReady);
  setTimerCyclic(sendCyclicPowerSupplyStatusMessage, cPowerSupplyStatusCycleTimeMs); // T1 on (250 ms)
  StartTimerIfNotRunning(timer_Tout0_Charger, @sysvar::GBT27930::Charger::Timeouts::Tout0_PowerSupplyMode); // Tout0 on (30 s)
  @sysvar::GBT27930::Charger::CurrentChargerStatus = kStatus1;  
}

void StartPreChargingAndEnergyTransfer()
{
  writeLineEx(-3,1,"#### Charger: Enter Pre-Charge and EnergyTransfer ####");
  if ($GBT27930::Simulation::Charger.GBT27930_2_2024.VehicleFunctionNegotiationAckResult.PreChargingAndEnergyTransmission == _GBT27930::DataTypes::FDCNegotiationResultType::SupportFDC1)
  {
    StartPreChargingAndEnergyTransfer_FDC1();
  } 
  else if ($GBT27930::Simulation::Charger.GBT27930_2_2024.VehicleFunctionNegotiationAckResult.PreChargingAndEnergyTransmission == _GBT27930::DataTypes::FDCNegotiationResultType::SupportFDC2)
  {
    StartPreChargingAndEnergyTransfer_FDC2();
  }
}

void StartPreChargingAndEnergyTransfer_FDC1()
{
  writeLineEx(1, 1, "Starting PreCharging FDC1");
  setTimerCyclic(sendCyclicChargerReadyStatus, cChargerReadyStatusCycleTimeMs);
  StartTimerIfNotRunning(timer_Tout0_Charger, @sysvar::GBT27930::Charger::Timeouts::Tout0_PreChargingAndEnergyTransfer);
  @sysvar::GBT27930::Charger::CurrentChargerStatus = kStatus1;
}

void StartPreChargingAndEnergyTransfer_FDC2()
{
  writeLineEx(1, 1, "Starting PreCharging FDC2");
  setTimerCyclic(sendCyclicChargerBidirectionalChargingReadyStatus, cChargerReadyStatusCycleTimeMs); // T1 = 250ms
  StartTimerIfNotRunning(timer_Tout0_Charger, @sysvar::GBT27930::Charger::Timeouts::Tout0_PreChargingAndEnergyTransfer);
  @sysvar::GBT27930::Charger::CurrentChargerStatus = kStatus1;
}

void CompletePowerSupplyMode()
{
  int stateTransistionTime = 100;
  if($Charger.GBT27930_2_2024.VehicleAcknowledge.PhaseAck == _GBT27930::DataTypes::PhaseAckTypeEncoding::acknowledgement_succeeded)
  {
    currentChargerPhase = kPreChargingAndEnergyTransferPhase; 
    stateTransistionTime = @sysvar::GBT27930::Charger::DelayTransition::PowerSupplyMode_to_PreChargeAndEnergyTransferPhase;
  }
  else // failed / unknown value
  {
    currentChargerPhase = kEndPhase;
    stateTransistionTime = @sysvar::GBT27930::Charger::DelayTransition::AnyMessage_to_End;
  }

  @sysvar::GBT27930::Charger::CurrentChargerStatus = kStatus0;
  // ensure all timers stopped
  cancelTimer(timer_Tout0_Charger);
  cancelTimer(timer_Tout1_Charger);
  cancelTimer(sendCyclicPowerSupplyStatusMessage);
  cancelTimer(sendCyclicChargerDynamicOutputCapabilityAndBasicInformationMessage);

  StartTimerIfNotRunning(stateTransitionTimer,  stateTransistionTime);
}

void CompletePreChargeAndEnergyTransferPhase()
{
  if($GBT27930::Simulation::Charger.GBT27930_2_2024.VehicleFunctionNegotiationAckResult.PreChargingAndEnergyTransmission == _GBT27930::DataTypes::FDCNegotiationResultType::SupportFDC1)
  {
    currentChargerPhase = kEndPhase;
    StartTimerIfNotRunning(stateTransitionTimer, @sysvar::GBT27930::Charger::DelayTransition::AnyMessage_to_End);
  }
  else if ($GBT27930::Simulation::Charger.GBT27930_2_2024.VehicleFunctionNegotiationAckResult.PreChargingAndEnergyTransmission == _GBT27930::DataTypes::FDCNegotiationResultType::SupportFDC2)
  {
    if (@sysvar::GBT27930::Charger::CurrentChargerStatus == kStatus6)
    {
      if ($Charger.GBT27930_2_2024.VehicleAcknowledge.PhaseAck == 0xAA)
        {
          cancelTimer(timer_Tout0_Charger);
          cancelTimer(timer_Tout1_Charger);
          cancelTimer(timer_Tout2_Charger);
          cancelTimer(sendCyclicChargerBidirectionalChargingReadyStatus); // T1
          cancelTimer(sendCyclicChargerBidirectionalOutputCapability); // T2
          cancelTimer(sendCyclicChargerDischargeRequest); // T3
          cancelTimer(sendCyclicChargerBidirectionalChargingInfo); // T4
          if(@sysvar::GBT27930::Charger::ContactorStatus_K1K2 == @sysvar::GBT27930::Charger::ContactorStatus_K1K2::Close)
          {
            HV_open_close_K1K2(OPEN);
          }
          currentChargerPhase = kEndPhase;
          StartTimerIfNotRunning(stateTransitionTimer, @sysvar::GBT27930::Charger::DelayTransition::AnyMessage_to_End);
        }
      else if ($Charger.GBT27930_2_2024.VehicleAcknowledge.PhaseAck == 0x00)
        {
          cancelTimer(timer_Tout0_Charger);
          cancelTimer(timer_Tout1_Charger);
          cancelTimer(timer_Tout2_Charger);
          cancelTimer(sendCyclicChargerBidirectionalChargingReadyStatus); // T1
          cancelTimer(sendCyclicChargerBidirectionalOutputCapability); // T2
          cancelTimer(sendCyclicChargerDischargeRequest); // T3
          cancelTimer(sendCyclicChargerBidirectionalChargingInfo); // T4

          SendEndMessageAndEnterEndModule(_GBT27930::DataTypes::parEndType::PhaseAcknowledgementFailed, _GBT27930::DataTypes::PhaseAcknowledgementFailTypeEncoding::phase_acknowledgement_fail);
        }
    }
    else if (@sysvar::GBT27930::Charger::ChargingDischarging::EnergyTransferDirection == sysvar::GBT27930::Charger::ChargingDischarging::EnergyTransferDirection::Charging && @sysvar::GBT27930::Charger::CurrentChargerStatus == kStatus5)
    {
      SendEndMessageWithoutChangingModule(_GBT27930::DataTypes::parEndType::EndCharging, _GBT27930::DataTypes::ChargerEndChargingEncoding::ends_normally_manual_end);
      SendChargerPhaseRequest();
    }
  }
}

void StartEndPhase()
{
  writeLineEx(-3,1,"#### Charger: Enter End ####");
  @sysvar::GBT27930::Charger::CurrentChargerFunctionModule = @sysvar::GBT27930::Charger::CurrentChargerFunctionModule::`End;
  setTimer(timer_Tout0_Charger, @sysvar::GBT27930::Charger::Timeouts::Tout0_EndPhase);
  setTimer(timer_Tout1_Charger, @sysvar::GBT27930::Charger::Timeouts::Tout1_EndPhase_ChargingStopAcknowledgeReceived);
  @sysvar::GBT27930::Charger::CurrentChargerStatus = kStatus1;
  if(@sysvar::GBT27930::Charger::ContactorStatus_K1K2 == @sysvar::GBT27930::Charger::ContactorStatus_K1K2::Open)
    ReactToOpenK1K2DuringEndPhase();
  else
    StartTimerReadyToOpen_K1_K2(cOpenK1K2DelayMs);
}

void CompleteEndPhase()
{
  if (@sysvar::GBT27930::Charger::CurrentChargerStatus == kStatus3)
  {
    @sysvar::GBT27930::Charger::CurrentChargerStatus = kStatus4;
    @sysvar::GBT27930::Charger::ElectronicLockStatus = sysvar::GBT27930::Charger::ElectronicLockStatus::Unlocked;
    if (@sysvar::GBT27930::Charger::VersionNegotiation::ControlPilotVersion == sysvar::GBT27930::Charger::VersionNegotiation::ControlPilotVersion::NewVersionCPCircuit)
      gConnectionControlSequence = T22;
    CancelTimers();
    EndCommunication();
  }
}

on fct_called Charger.OnLastReceivedMessageIdChanged
{
  long changedOutputCurrent;
  changedOutputCurrent = 0;

  switch($Charger.OnLastReceivedMessageIdChanged.LatestCall.lastRxMessageId)
  {
    case kVehicleVersionNegotiation:
      if(chargerNegotiationState == kNegotiating)
      {
        if ($Charger.Vehicle_VersionNegotiation.VersionNegotiationResult == 0 && (VehicleVersionHasChanged() || chargerVersionHasChanged)) // Vehicle: Continue negotiation
        {
          chargerVersionHasChanged = 0;
          chargerNegotiationState = ProcessChargerVersionNegotiation();
        }
        else if ($Charger.Vehicle_VersionNegotiation.VersionNegotiationResult == 1 ) // Vehicle: Negotiation succeeded
        {
          if ($Charger.Vehicle_VersionNegotiation.ProtocolVersion.MajorVersionNumber == 1 
           && $Charger.Vehicle_VersionNegotiation.ProtocolVersion.MinorVersionNumber == 1
           && $Charger.Vehicle_VersionNegotiation.ProtocolVersion.TemporaryVersionNumber == 0
           && CheckChargerVersionConsistent() == 1)
          {
            @sysvar::GBT27930::Charger::VersionNegotiation::NegotiationResult = 1; //set charger negotiation succeeded
            chargerNegotiationState = kAppendixMNegotiationSucceeded; // Negotiation succeeded: Use GBT27930 Category A 
          }
          else if ($Charger.Vehicle_VersionNegotiation.ProtocolVersion.MajorVersionNumber >= 2 
           && $Charger.Vehicle_VersionNegotiation.ProtocolVersion.MinorVersionNumber == 0
           && $Charger.Vehicle_VersionNegotiation.ProtocolVersion.TemporaryVersionNumber == 0
           && CheckChargerVersionConsistent() == 1)
          {
            @sysvar::GBT27930::Charger::VersionNegotiation::NegotiationResult = 1; // set charger negotiation succeeded
            chargerNegotiationState = kNegotiationSucceeded; // Negotiation succeeded: Use GBT27930 Category B
          }
        }
        else if ($Charger.Vehicle_VersionNegotiation.VersionNegotiationResult == 2) // Vehicle: Negotiation failed
        {
          @sysvar::GBT27930::Charger::VersionNegotiation::NegotiationResult = 2; // set charger negotiation failed
          chargerNegotiationState = kNegotiationFailed; // Negotiation failed: Use GBT27930 Category A 
        }
      }
      break;
    case kVehicleFunctionNegotiationAckResult:
      if (@sysvar::GBT27930::Charger::CurrentChargerStatus == kStatus1)
        ProcessVehicleFunctionNegotiationAckResult();
      break;
    case kDetectionAcknowledgement:
      if (currentChargerPhase == kOutputCircuitDetectionPhase && @sysvar::GBT27930::Charger::CurrentChargerStatus == kStatus2)
      {
        cancelTimer(sendCyclicChargerDetectionInformationMessage);
        @sysvar::GBT27930::Charger::CurrentChargerStatus = kStatus3;
        SendChargerPhaseRequest();
      }
      break;
    case kVehicleAcknowledge:
      if (@sysvar::GBT27930::Charger::CurrentChargerStatus == kStatus0) 
      {
        break; // consecutive VehicleAcknowledge message received from last state transition, ignore
      }
      switch(currentChargerPhase)
      {
        case kInitial:
        case kVersionNegotiation:
          writeLineEx(-1,3,"Logic error: There is no Phase acknowlegde before Function Negotiation");
          break;
        case kFunctionNegotiationPhase:
          if (@sysvar::GBT27930::Charger::CurrentChargerStatus >= kStatus2) 
          {
            CompleteFunctionNegotiationPhase();
          }
          break;
        case kParameterConfigurationPhase:
          if (@sysvar::GBT27930::Charger::CurrentChargerStatus >= kStatus2) 
          {
            CompleteParameterConfiguration();
          }
          break;
        case kAuthenticationPhase:
          if (!skipAuthentication)
          {
            switch (@sysvar::GBT27930::Charger::Authentication::AuthenticationType)
            {
              case sysvar::GBT27930::Charger::Authentication::AuthenticationType::Scan:
                if (@sysvar::GBT27930::Charger::CurrentChargerStatus >= kStatus2) 
                {
                  CompleteAuthenticationPhase();
                }
                break;
              case sysvar::GBT27930::Charger::Authentication::AuthenticationType::EVIN:
                if (@sysvar::GBT27930::Charger::CurrentChargerStatus >= kStatus3) 
                {
                  CompleteAuthenticationPhase();
                }
                break;
              case sysvar::GBT27930::Charger::Authentication::AuthenticationType::Cloud:
                if (@sysvar::GBT27930::Charger::CurrentChargerStatus >= kStatus4) 
                {
                  CompleteAuthenticationPhase();
                }
                break;
              default:
                break;
            }
          }
          break;
        case kSchedulingPhase:
          if (!skipScheduling && @sysvar::GBT27930::Charger::CurrentChargerStatus >= kStatus4) 
          {
            CompleteSchedulingPhase();
          }
          break;
        case kOutputCircuitDetectionPhase:
          if (@sysvar::GBT27930::Charger::CurrentChargerStatus >= kStatus3) 
          {
            CompleteOutputCircuitDetection();
          }
          break;
        case kPowerSupplyModePhase:
          if (!skipPowerSupply && @sysvar::GBT27930::Charger::CurrentChargerStatus >= kStatus6) 
          {
            CompletePowerSupplyMode();
          }
          break;
        case kPreChargingAndEnergyTransferPhase:
          if (@sysvar::GBT27930::Charger::CurrentChargerStatus >= kStatus5) 
          {
            CompletePreChargeAndEnergyTransferPhase();
          }
          break;
        case kEndPhase:
          if(isAbnormalEnd != 0)
          { // Entered End phase early due to error
            isAbnormalEnd = 0;
            StartEndPhase();
          }
          else
          {  // Normal completion of End phase
            CompleteEndPhase();
          }
          break;
        default:
          break;
      }
      break;
    case kVehicleScanAuthenticationWaiting:
      if ($Charger.GBT27930_2_2024.VehicleScanAuthenticationWaiting.AuthenticationStatus == _GBT27930::DataTypes::parVAuthenStatusType::DisagreeWait)
      {
        //SendAbort_AuthenticationExecution
        SendEndMessageAndEnterEndModule(_GBT27930::DataTypes::parEndType::FunctionModuleExecutionFailed, _GBT27930::DataTypes::ChargerFunctionModuleExecutionFailTypeEncoding::authentication_execution_fail);
      } else if ($Charger.GBT27930_2_2024.VehicleScanAuthenticationWaiting.AuthenticationStatus == _GBT27930::DataTypes::parVAuthenStatusType::ContinueWaiting)
      {
        // keep S1, nothing else to do
      } else {
        writeLineEx(-3,1,"VehicleScanAuthenticationWaiting.AuthenticationStatus unkown: %d", $Charger.GBT27930_2_2024.VehicleScanAuthenticationWaiting.AuthenticationStatus);
      }
      break;
    case kVehicleEVINAuthenticationParameter:
      // Check if EVIN is authorised
      if (@sysvar::GBT27930::Charger::CurrentChargerStatus == kStatus1)
        PerformEVINAuthentication();
      break;
    case kVehicleEVINReAuthenticationRequest:
      if (@sysvar::GBT27930::Charger::CurrentChargerStatus == kStatus2)
      {
        if ($Charger.GBT27930_2_2024.VehicleEVINReAuthenticationRequest.FDC == 1 || $Charger.GBT27930_2_2024.VehicleEVINReAuthenticationRequest.FDC == 3)
        {
          $Charger.GBT27930_2_2024.ChargerPhaseRequest.Phase = 0x3000 + $Charger.GBT27930_2_2024.VehicleEVINReAuthenticationRequest.FDC; // send Phase Request with Scan or Cloud FDC
          @sysvar::GBT27930::Charger::Authentication::PreferedAuthenticationMethod = $Charger.GBT27930_2_2024.VehicleEVINReAuthenticationRequest.FDC;
          @sysvar::GBT27930::Charger::CurrentChargerStatus = kStatus3;
          isReauthenticationTriggered = 1;
        } else { // FDC not supported or FDC has been authenticated already
          SendEndMessageAndEnterEndModule(_GBT27930::DataTypes::parEndType::FunctionModuleExecutionFailed, _GBT27930::DataTypes::ChargerFunctionModuleExecutionFailTypeEncoding::authentication_execution_fail);
          @sysvar::GBT27930::Charger::CurrentChargerStatus = kStatus5;
        }
      }
      break;
    case kVehicleCloudAuthenticationParameter:
      if (@sysvar::GBT27930::Charger::CurrentChargerStatus == kStatus1)
      {
        SendChargerCloudAuthenticationParameter();
        StartTimerIfNotRunning(timer_SimulateAuthentication_Charger, cChargerAuthenticationSimulationTimeMs); 
        @sysvar::GBT27930::Charger::CurrentChargerStatus = kStatus2;
      }
      break;
    case kVehicleCloudReAuthenticationRequest:
      if (@sysvar::GBT27930::Charger::CurrentChargerStatus == kStatus3)
      {
        if ($Charger.GBT27930_2_2024.VehicleCloudReAuthenticationRequest.FDC == 1 || $Charger.GBT27930_2_2024.VehicleCloudReAuthenticationRequest.FDC == 2)
        {
          @sysvar::GBT27930::Charger::Authentication::TriggerReAuthentication = 0; 
          $Charger.GBT27930_2_2024.ChargerPhaseRequest.Phase = 0x3000 + $Charger.GBT27930_2_2024.VehicleCloudReAuthenticationRequest.FDC;
          @sysvar::GBT27930::Charger::Authentication::PreferedAuthenticationMethod = $Charger.GBT27930_2_2024.VehicleEVINReAuthenticationRequest.FDC;
          @sysvar::GBT27930::Charger::CurrentChargerStatus = kStatus4;
          isReauthenticationTriggered = 1;
        } else {
          SendEndMessageAndEnterEndModule(_GBT27930::DataTypes::parEndType::FunctionModuleExecutionFailed, _GBT27930::DataTypes::ChargerFunctionModuleExecutionFailTypeEncoding::authentication_execution_fail);
          @sysvar::GBT27930::Charger::CurrentChargerStatus = kStatus6;
        }
      }
      break;
    case kVehicleChargingParameters:
      ProcessVehicleChargingParameters_ChargingOnly();
      break;
    case kVehicleChargingAndDischargingParameters:
      ProcessVehicleChargingParameters_ChargingAndDischarging();
      break;
    case kVehicleScheduledChargingInformation:
      ProcessVehicleScheduledChargingInformation();
      break;
    case kVehicleScheduledChargingNegotiation:
      ProcessVehicleScheduledChargingNegotiation();
      break;
    case kVehicleWakeUp:
      if($Charger.GBT27930_2_2024.VehicleWakeUp.WakeUp == _GBT27930::DataTypes::WakeUpTypeEncoding::wake_up)
      {
        cancelTimer(timer_Tout1_Charger);
        cancelTimer(sendCyclicWakeUpMessage);
        @sysvar::GBT27930::Charger::CurrentChargerStatus = kStatus4;
        SendChargerPhaseRequest();
      }     
      break;
    case kVehiclePowerSupplyStatus:
      switch(@sysvar::GBT27930::Charger::CurrentChargerStatus)
      {
        case kStatus1:
          if($Charger.GBT27930_2_2024.VehiclePowerSupplyStatus.VehiclePowerSupplyStatus == _GBT27930::DataTypes::parPowerSupplyStatusType::Ready)
          {
            @sysvar::GBT27930::Charger::CurrentChargerStatus = kStatus2;
            StartTimerIfNotRunning(timer_MonitorExternalVoltageK1K2, cMonitorExternalVoltageK1K2Period);
          }  
          break;
        case kStatus2:
        case kStatus3:
          if($Charger.GBT27930_2_2024.VehiclePowerSupplyStatus.VehiclePowerSupplyStatus == _GBT27930::DataTypes::parPowerSupplyStatusType::NotReady)
          {
            SendEndMessageAndEnterEndModule(_GBT27930::DataTypes::parEndType::FunctionModuleExecutionFailed, _GBT27930::DataTypes::ChargerFunctionModuleExecutionFailTypeEncoding::power_supply_mode_vehicle_logic_error);
            @sysvar::GBT27930::Charger::CurrentChargerStatus = kStatus8;
          }
          break;
        case kStatus0:
        default:
          break;
      }
      break;
    case kVehiclePowerSupplyDemand:
      // Reset Tout1 timer
      cancelTimer(timer_Tout1_Charger); 
      setTimer(timer_Tout1_Charger, @sysvar::GBT27930::Charger::Timeouts::Tout1_PowerSupplyMode_VehiclePowerSupplyDemandReceived);
      
      if(@sysvar::GBT27930::Charger::CurrentChargerStatus == kStatus3)
      {
        cancelTimer(sendCyclicPowerSupplyStatusMessage); // T1 off
        setTimerCyclic(sendCyclicChargerDynamicOutputCapabilityAndBasicInformationMessage, cChargerDynamicOutputCapabilityAndBasicInformationCycleTimeMs); // T2 on
        if ($Charger.GBT27930_2_2024.VehiclePowerSupplyDemand.Voltage.phys < @sysvar::GBT27930::Charger::ChargingDischarging::MaxVoltage)
        {
          HV_source_set_U_DC($Charger.GBT27930_2_2024.VehiclePowerSupplyDemand.Voltage.phys);
        }
        else 
        {
          HV_source_set_U_DC(@sysvar::GBT27930::Charger::ChargingDischarging::MaxVoltage);
        }
        
        if ($Charger.GBT27930_2_2024.VehiclePowerSupplyDemand.Current.phys <= @sysvar::GBT27930::Charger::ChargingDischarging::MaxCurrent)
        {
          HV_source_set_I_DC($Charger.GBT27930_2_2024.VehiclePowerSupplyDemand.Current.phys);
        }
        else
        {
          HV_source_set_I_DC(@sysvar::GBT27930::Charger::ChargingDischarging::MaxCurrent);
        }
        @sysvar::GBT27930::Charger::CurrentChargerStatus = kStatus4;
      }
      else if(@sysvar::GBT27930::Charger::CurrentChargerStatus == kStatus4)
      {
        if ($Charger.GBT27930_2_2024.VehiclePowerSupplyDemand.Voltage.phys < @sysvar::GBT27930::Charger::ChargingDischarging::MaxVoltage)
        {
          HV_source_set_U_DC($Charger.GBT27930_2_2024.VehiclePowerSupplyDemand.Voltage.phys);
        }
        else 
        {
          HV_source_set_U_DC(@sysvar::GBT27930::Charger::ChargingDischarging::MaxVoltage);
        }
        
        if ($Charger.GBT27930_2_2024.VehiclePowerSupplyDemand.Current.phys <= @sysvar::GBT27930::Charger::ChargingDischarging::MaxCurrent)
        {
          HV_source_set_I_DC($Charger.GBT27930_2_2024.VehiclePowerSupplyDemand.Current.phys);
        }
        else
        {
          HV_source_set_I_DC(@sysvar::GBT27930::Charger::ChargingDischarging::MaxCurrent);
        }
      }
      break;
    case kVehiclePowerSupplyCompletion:
      if(@sysvar::GBT27930::Charger::CurrentChargerStatus == kStatus4)
      {
        cancelTimer(sendCyclicChargerDynamicOutputCapabilityAndBasicInformationMessage); // T2
        cancelTimer(sendCyclicPowerSupplyStatusMessage); // T1
        cancelTimer(timer_Tout1_Charger);
        @sysvar::GBT27930::Charger::CurrentChargerStatus = kStatus5;
        writeLineEx(1,1,"Charger: Finishing Power Supply Phase - Set current to 0 A");
        writeLineEx(-3,1,"Charger: Finishing Power Supply Phase - Set current to 0 A");
        HV_source_set_I_DC(0);
        StartTimerReadyToOpen_K1_K2(cOpenContactorsTimeoutMs);
      }
      break;
    case kVehicleReadyStatus:
      ProcessVehicleReadyStatus();
      break;
    case kVehicleBidirectionalChargingReadyStatus:
      ProcessVehicleBidirectionalReadyStatus();
      break;
    case kVehicleChargingRequest:
      ProcessVehicleChargingRequest();
      break;
    case kVehicleBidirectionalChargingRequest:
      ProcessVehicleBidirectionalChargingRequest();
      break;
    case kVehicleBidirectionalDynamicOutputCapability:
      ProcessVehicleBidirectionalDynamicOutputCapability();
      break;
    case kVehicleEnd:
      ProcessVehicleEnd();
      break;
    case kVehicleAdhesionDetection:
      ProcessVehicleAdhesionDetection();
      break;
    case kVehicleStatistics:
      CompleteEndPhase();
      break;
    default:
        // Handle for PGN not implemented
        break;
  }
}

/////////////////////////////////////////////////////////////////////////////////////
/*--------------------------------------Helper-------------------------------------*/
/////////////////////////////////////////////////////////////////////////////////////

int CheckChargerVersionConsistent()
{
  if ($Charger.Vehicle_VersionNegotiation.ProtocolVersion.MajorVersionNumber == $Charger.Charger_VersionNegotiation.ProtocolVersion.MajorVersionNumber 
     && $Charger.Vehicle_VersionNegotiation.ProtocolVersion.MinorVersionNumber == $Charger.Charger_VersionNegotiation.ProtocolVersion.MinorVersionNumber 
     && $Charger.Vehicle_VersionNegotiation.ProtocolVersion.TemporaryVersionNumber == $Charger.Charger_VersionNegotiation.ProtocolVersion.TemporaryVersionNumber)
    return 1;
  return 0;
}

int CheckChargerVersionLowerThanVehicle()
{
  // Compare main version number
  if ($Charger.Vehicle_VersionNegotiation.ProtocolVersion.MajorVersionNumber > 
      $Charger.Charger_VersionNegotiation.ProtocolVersion.MajorVersionNumber)
  {
    return 1;
  }
  // If main versions are equal, compare minor version number
  if ($Charger.Vehicle_VersionNegotiation.ProtocolVersion.MajorVersionNumber == 
      $Charger.Charger_VersionNegotiation.ProtocolVersion.MajorVersionNumber 
  &&  $Charger.Vehicle_VersionNegotiation.ProtocolVersion.MinorVersionNumber > 
      $Charger.Charger_VersionNegotiation.ProtocolVersion.MinorVersionNumber)
  {
    return 1;
  }
  // If main and minor versions are equal, compare temporary version number
  if ($Charger.Vehicle_VersionNegotiation.ProtocolVersion.MajorVersionNumber == 
      $Charger.Charger_VersionNegotiation.ProtocolVersion.MajorVersionNumber 
  &&  $Charger.Vehicle_VersionNegotiation.ProtocolVersion.MinorVersionNumber == 
      $Charger.Charger_VersionNegotiation.ProtocolVersion.MinorVersionNumber 
  &&  $Charger.Vehicle_VersionNegotiation.ProtocolVersion.TemporaryVersionNumber > 
      $Charger.Charger_VersionNegotiation.ProtocolVersion.TemporaryVersionNumber)
  {
    return 1;
  }
  // Otherwise, charger version is not lower
  return 0;
}

int ProcessChargerVersionNegotiation()
{
  if (CheckChargerVersionConsistent())
  {
    @sysvar::GBT27930::Charger::VersionNegotiation::NegotiationResult = 1; // set charger negotiation succeeded
  }
  else if (CheckChargerVersionLowerThanVehicle())
  {
    @sysvar::GBT27930::Charger::VersionNegotiation::NegotiationResult = 0; // set charger "continue negotiation"
  }
  // if version not consistent nor vehicle version is lower than charger, try next charger version
  else if (--currentVersionIndex < 0)
  {
    writeLineEx(-3,1,"Charger has reached lowest version");
    @sysvar::GBT27930::Charger::VersionNegotiation::NegotiationResult = 2; // set charger negotiation failed
    return 4; // Reached lowest charger version
  }
  else {
    writeLineEx(-3,1,"Charger try next lower version: %i", currentVersionIndex);
    @sysvar::GBT27930::Charger::VersionNegotiation::NegotiationResult = 0; // set charger "continue negotiation"
    SetSysvarChargerVersionFromVersionStruct(currentVersionIndex); // Try next lower version
    chargerVersionHasChanged = 1;
  }
  return 1;
}

void ProcessVehicleFunctionNegotiationAckResult()
{
  // mandatory Function modules
  if ($GBT27930::Simulation::Charger.GBT27930_2_2024.VehicleFunctionNegotiationAckResult.ParameterConfiguration == 0x00 
  || $GBT27930::Simulation::Charger.GBT27930_2_2024.VehicleFunctionNegotiationAckResult.OutputCircuitDetection == 0x00 
  || $GBT27930::Simulation::Charger.GBT27930_2_2024.VehicleFunctionNegotiationAckResult.PreChargingAndEnergyTransmission == 0x00 
  || $GBT27930::Simulation::Charger.GBT27930_2_2024.VehicleFunctionNegotiationAckResult.EndFunctionModule == 0x00 
  )
  {
    SendEndMessageAndEnterEndModule(_GBT27930::DataTypes::parEndType::FunctionModuleExecutionFailed, _GBT27930::DataTypes::ChargerFunctionModuleExecutionFailTypeEncoding::function_negotiation_execution_mandatory_function_fail);
    @sysvar::GBT27930::Charger::CurrentChargerStatus = kStatus4;
    return;
  }
  
  // optional Function modules
  if ($GBT27930::Simulation::Charger.GBT27930_2_2024.VehicleFunctionNegotiationAckResult.Authentication == 0x00)
  {
    writeLineEx(1, 1, "Charger: Vehicle doesn't support any authentication FDC: Skipping authentication");
    skipAuthentication = 1;
  }
  if ($GBT27930::Simulation::Charger.GBT27930_2_2024.VehicleFunctionNegotiationAckResult.Booking == 0x00)
  {
    writeLineEx(1, 1, "Charger: Vehicle doesn't support any scheduling FDC: Skipping scheduling");
    skipScheduling = 1;
  }
  if ($GBT27930::Simulation::Charger.GBT27930_2_2024.VehicleFunctionNegotiationAckResult.PowerSupplyMode == 0x00)
  {
    writeLineEx(1, 1, "Charger: Vehicle doesn't support any power supply mode FDC: Skipping power supply mode");
    skipPowerSupply = 1;
  }

  @sysvar::GBT27930::Charger::CurrentChargerStatus = kStatus2;
  SendChargerPhaseRequest();
}

void ProcessVehicleChargingParameters_ChargingOnly()
{
  if(@sysvar::GBT27930::Charger::CurrentChargerStatus == kStatus1)
  {
    // Vehicle parameters OK
    if($Charger.GBT27930_2_2024.ChargerChargingParameters.MinOutputVoltage.phys <= $Charger.GBT27930_2_2024.VehicleChargingParameters.MaxChargingVoltage.phys
      && $Charger.GBT27930_2_2024.ChargerChargingParameters.MinOutputCurrent.phys <= $Charger.GBT27930_2_2024.VehicleChargingParameters.MaxChargingCurrent.phys)
    {
      SendChargerPhaseRequest();
      @sysvar::GBT27930::Charger::CurrentChargerStatus = kStatus2;
    }
    else // Vehicle parameters not OK
    {
      SendEndMessageAndEnterEndModule(_GBT27930::DataTypes::parEndType::FunctionModuleExecutionFailed, _GBT27930::DataTypes::ChargerFunctionModuleExecutionFailTypeEncoding::parameter_configuration_parameter_mismatch);
      @sysvar::GBT27930::Charger::CurrentChargerStatus = kStatus4;
    }
  }
}

void ProcessVehicleChargingParameters_ChargingAndDischarging()
{
  if(@sysvar::GBT27930::Charger::CurrentChargerStatus == kStatus1)
  {
    // Vehicle parameters OK
    if($Charger.GBT27930_2_2024.ChargerChargingAndDischargingParameters.MinOutputVoltage.phys <= $Charger.GBT27930_2_2024.VehicleChargingAndDischargingParameters.MaxChargingVoltage.phys
      && $Charger.GBT27930_2_2024.ChargerChargingAndDischargingParameters.MinOutputCurrent.phys <= $Charger.GBT27930_2_2024.VehicleChargingAndDischargingParameters.MaxChargingCurrent.phys)
    {
      SendChargerPhaseRequest();
      @sysvar::GBT27930::Charger::CurrentChargerStatus = kStatus2;
    }
    else // Vehicle parameters not OK
    {
      SendEndMessageAndEnterEndModule(_GBT27930::DataTypes::parEndType::FunctionModuleExecutionFailed, _GBT27930::DataTypes::ChargerFunctionModuleExecutionFailTypeEncoding::parameter_configuration_parameter_mismatch);
      @sysvar::GBT27930::Charger::CurrentChargerStatus = kStatus4;
    }
  }
}

void ProcessVehicleScheduledChargingInformation()
{
  long supportsImmediateChargingValue;
  
  if(@sysvar::GBT27930::Charger::CurrentChargerStatus == kStatus1)
  {
    supportsImmediateChargingValue = _GBT27930::DataTypes::SupportsImmediateChargingTypeEncoding::immediate_charging_not_supported;
    if(@sysvar::GBT27930::Charger::Scheduling::SupportsImmediateCharging == @sysvar::GBT27930::Charger::Scheduling::SupportsImmediateCharging::ImmediateChargingSupported)
      supportsImmediateChargingValue = _GBT27930::DataTypes::SupportsImmediateChargingTypeEncoding::immediate_charging_supported;
    
    if ($Charger.GBT27930_2_2024.VehicleScheduledChargingInformation.ExpectedChargingStartTime == _GBT27930::DataTypes::TimeInMinutesTypeTextualEncoding::invalid_value
      && $Charger.GBT27930_2_2024.VehicleScheduledChargingInformation.ExpectedDepartureTime == _GBT27930::DataTypes::TimeInMinutesTypeTextualEncoding::invalid_value) 
    { // Start and departure time invalid: Scheduling fails
      $Charger.GBT27930_2_2024.ChargerScheduledChargingAcknowledgement.ScheduledChargingAcknowledgement = _GBT27930::DataTypes::ScheduledChargingAcknowledgementTypeEncoding::acknowledgement_failed;
    }
    else if ($Charger.GBT27930_2_2024.VehicleScheduledChargingInformation.ExpectedDepartureTime == _GBT27930::DataTypes::TimeInMinutesTypeTextualEncoding::invalid_value) 
    { // Start time valid, departure time invalid: Start as specified, complete whenever
      $Charger.GBT27930_2_2024.ChargerScheduledChargingAcknowledgement.ScheduledChargingAcknowledgement = _GBT27930::DataTypes::ScheduledChargingAcknowledgementTypeEncoding::acknowledgement_succeeded;
      supportsImmediateChargingValue = _GBT27930::DataTypes::SupportsImmediateChargingTypeEncoding::scheduling_successful;
    }
    else if ($Charger.GBT27930_2_2024.VehicleScheduledChargingInformation.ExpectedChargingStartTime == _GBT27930::DataTypes::TimeInMinutesTypeTextualEncoding::invalid_value) 
    { // Start time invalid, departure time valid: Start whenever, complete within departure time
      $Charger.GBT27930_2_2024.ChargerScheduledChargingAcknowledgement.ScheduledChargingAcknowledgement = _GBT27930::DataTypes::ScheduledChargingAcknowledgementTypeEncoding::acknowledgement_succeeded;
      supportsImmediateChargingValue = _GBT27930::DataTypes::SupportsImmediateChargingTypeEncoding::scheduling_successful;
    }
    else if($Charger.GBT27930_2_2024.VehicleScheduledChargingInformation.ExpectedChargingStartTime > $Charger.GBT27930_2_2024.VehicleScheduledChargingInformation.ExpectedDepartureTime)
    { // Start time > departure time: Scheduling fails
      $Charger.GBT27930_2_2024.ChargerScheduledChargingAcknowledgement.ScheduledChargingAcknowledgement = _GBT27930::DataTypes::ScheduledChargingAcknowledgementTypeEncoding::acknowledgement_failed;
    }
    else
    { // Start and departure time valid: Start as specified, complete within departure time
      $Charger.GBT27930_2_2024.ChargerScheduledChargingAcknowledgement.ScheduledChargingAcknowledgement = _GBT27930::DataTypes::ScheduledChargingAcknowledgementTypeEncoding::acknowledgement_succeeded;
      supportsImmediateChargingValue = _GBT27930::DataTypes::SupportsImmediateChargingTypeEncoding::scheduling_successful;
    }
    
    $Charger.GBT27930_2_2024.ChargerScheduledChargingAcknowledgement.SupportsImmediateCharging = supportsImmediateChargingValue;
    @sysvar::GBT27930::Charger::CurrentChargerStatus = kStatus2;
  }
}

void ProcessVehicleScheduledChargingNegotiation()
{
  if(@sysvar::GBT27930::Charger::CurrentChargerStatus == kStatus2)
  {
    if($Charger.GBT27930_2_2024.VehicleScheduledChargingNegotiation.ScheduleNegotiationResult == _GBT27930::DataTypes::SchedulingNegotiationResultTypeEncoding::negotiation_succeeded)
    { // Negotiation succeeded: Sleep until start time
      CHA_open_close_K3K4(OPEN);
      cancelTimer(timer_Tout0_Charger);
      if($Charger.GBT27930_2_2024.VehicleScheduledChargingInformation.ExpectedChargingStartTime != _GBT27930::DataTypes::TimeInMinutesTypeTextualEncoding::invalid_value)
      {
        WriteLineEx(1,1,"Charger: Waiting for scheduled charging time.");
        setTimer(timer_WaitForScheduledChargingStart, $Charger.GBT27930_2_2024.VehicleScheduledChargingInformation.ExpectedChargingStartTime * 60); // Timeout in seconds
      }
      else
      {
        WriteLineEx(1,1,"Charger: Scheduled charging time not specified, waiting for %d minutes.", cGenericChargingStartTimeInMinutes);
        setTimer(timer_WaitForScheduledChargingStart, cGenericChargingStartTimeInMinutes * 60); // Timeout in seconds
      }
      @sysvar::GBT27930::Charger::CurrentChargerStatus = kStatus3;
    }
    else if ($Charger.GBT27930_2_2024.VehicleScheduledChargingNegotiation.ScheduleNegotiationResult == _GBT27930::DataTypes::SchedulingNegotiationResultTypeEncoding::negotiation_failed
      && $Charger.GBT27930_2_2024.VehicleScheduledChargingNegotiation.ChargeImmediately == _GBT27930::DataTypes::ChargeImmediatelyTypeEncoding::charge_immediately)
    { // Negotiation failed, immediate charging supported: Start charging now
      cancelTimer(timer_Tout0_Charger);
      SendChargerPhaseRequest();
      @sysvar::GBT27930::Charger::CurrentChargerStatus = kStatus4;
    }
    else
    { // Negotiation failed, immediate charging not supported: Abort charging
      cancelTimer(timer_Tout0_Charger);
      SendEndMessageAndEnterEndModule(_GBT27930::DataTypes::parEndType::FunctionModuleExecutionFailed, _GBT27930::DataTypes::ChargerFunctionModuleExecutionFailTypeEncoding::schedule_execution_scheduling_fail);
      @sysvar::GBT27930::Charger::CurrentChargerStatus = kStatus6;
    }
  }
}

void ProcessVehicleReadyStatus()
{
  double preChargeVoltage;
  if(currentChargerPhase == kPreChargingAndEnergyTransferPhase && @sysvar::GBT27930::Charger::CurrentChargerStatus == kStatus1)
  {
    if ($Charger.GBT27930_2_2024.VehicleReadyStatus.ReadyStatus == _GBT27930::DataTypes::parReadyType::Ready)
    {
      if (@sysvar::GBT27930::Charger::PreChargingComplete == 0)
      {
        StartPreChargingProcess(); // Handle Pre Charging in Hardware API (GBT_HW_Interface_EVSE.cin).
                                   // During simulation the state machine waits 200 ms
        if ($Charger.GBT27930_2_2024.VehicleChargingAndDischargingParameters.MaxChargingVoltage.phys <= @sysvar::GBT27930::Charger::ChargingDischarging::MaxVoltage)
          preChargeVoltage = $Charger.GBT27930_2_2024.VehicleChargingAndDischargingParameters.MaxChargingVoltage.phys;
        else 
          preChargeVoltage = @sysvar::GBT27930::Charger::ChargingDischarging::MaxVoltage;
        HV_source_set_U_DC(preChargeVoltage);
      }
      @sysvar::GBT27930::Charger::CurrentChargerStatus = kStatus2;
    }
  }
}

void ProcessVehicleBidirectionalReadyStatus()
{
  double preChargeVoltage;
  if(currentChargerPhase == kPreChargingAndEnergyTransferPhase && @sysvar::GBT27930::Charger::CurrentChargerStatus == kStatus1
  && $Charger.GBT27930_2_2024.VehicleReadyStatus.ReadyStatus == _GBT27930::DataTypes::parReadyType::Ready)
  {
    if (@sysvar::GBT27930::Charger::PreChargingComplete == 0) 
    {
      StartPreChargingProcess(); // Handle Pre Charging in Hardware API (GBT_HW_Interface_EVSE.cin).
                                 // During simulation the state machine waits 200 ms
      if (@sysvar::GBT27930::Charger::ChargingDischarging::EnergyTransferDirection == @sysvar::GBT27930::Charger::ChargingDischarging::EnergyTransferDirection::Charging)
      {
        if ($Charger.GBT27930_2_2024.VehicleChargingAndDischargingParameters.MaxChargingVoltage.phys <= @sysvar::GBT27930::Charger::ChargingDischarging::MaxVoltage)
          preChargeVoltage = $Charger.GBT27930_2_2024.VehicleChargingAndDischargingParameters.MaxChargingVoltage.phys;
        else 
          preChargeVoltage = @sysvar::GBT27930::Charger::ChargingDischarging::MaxVoltage;
      } else // EnergyTransferDirection = Discharging
      {
        if ($Charger.GBT27930_2_2024.VehicleChargingAndDischargingParameters.MinDischargingVoltage.phys >= @sysvar::GBT27930::Charger::ChargingDischarging::MinDischargingVoltage)
          preChargeVoltage = $Charger.GBT27930_2_2024.VehicleChargingAndDischargingParameters.MinDischargingVoltage.phys;
        else 
          preChargeVoltage = @sysvar::GBT27930::Charger::ChargingDischarging::MinDischargingVoltage;
      }
      HV_source_set_U_DC(preChargeVoltage);
    }
    @sysvar::GBT27930::Charger::CurrentChargerStatus = kStatus2;
  }
  else if ((@sysvar::GBT27930::Charger::CurrentChargerStatus == kStatus2 ||  @sysvar::GBT27930::Charger::CurrentChargerStatus == kStatus3) 
          && $Charger.GBT27930_2_2024.VehicleReadyStatus.ReadyStatus == _GBT27930::DataTypes::parReadyType::NotReady)
  {
    SendEndMessageAndEnterEndModule(_GBT27930::DataTypes::FunctionModuleExecutionFailed, _GBT27930::DataTypes::ChargerFunctionModuleExecutionFailTypeEncoding::precharge_energy_transfer_vehicle_logic_error);
    @sysvar::GBT27930::Charger::CurrentChargerStatus = kStatus6;
  }
}

void ProcessVehicleChargingRequest()
{
  if(currentChargerPhase == kPreChargingAndEnergyTransferPhase && (@sysvar::GBT27930::Charger::CurrentChargerStatus == kStatus3 || @sysvar::GBT27930::Charger::CurrentChargerStatus == kStatus4))
  {
    // Turn off T1
    cancelTimer(sendCyclicChargerReadyStatus);

    // reset Tout1 timer
    setTimer(timer_Tout1_Charger, @sysvar::GBT27930::Charger::Timeouts::Tout1_PreChargingAndEnergyTransfer);

    // turn on T2, T3
    StartCyclicTimerIfNotRunning(sendCyclicChargerEnergyTransferDynamicOutputCapacity, cChargerOutputCapacityTimeMs);
    StartCyclicTimerIfNotRunning(sendCyclicChargerChargingBasicInformation, cChargerChargingBasicInformationTimeMs);

    // set charging output values 
    if ($Charger.GBT27930_2_2024.VehicleChargingRequest.VoltageRequest.phys < @sysvar::GBT27930::Charger::ChargingDischarging::MaxVoltage)
    {
      HV_source_set_U_DC($Charger.GBT27930_2_2024.VehicleChargingRequest.VoltageRequest.phys);
    }
    else 
    {
      HV_source_set_U_DC(@sysvar::GBT27930::Charger::ChargingDischarging::MaxVoltage);
    }
    
    if ($Charger.GBT27930_2_2024.VehicleChargingRequest.CurrentRequest.phys <= @sysvar::GBT27930::Charger::ChargingDischarging::MaxCurrent)
    {
      HV_source_set_I_DC($Charger.GBT27930_2_2024.VehicleChargingRequest.CurrentRequest.phys);
    }
    else
    {
      HV_source_set_I_DC(@sysvar::GBT27930::Charger::ChargingDischarging::MaxCurrent);
    }
        
    @sysvar::GBT27930::Charger::CurrentChargerStatus = kStatus4; // Energy transfer state
  }
}

void ProcessVehicleBidirectionalChargingRequest()
{
  if (@sysvar::GBT27930::Charger::ChargingDischarging::EnergyTransferDirection == sysvar::GBT27930::Charger::ChargingDischarging::EnergyTransferDirection::Charging
  && currentChargerPhase == kPreChargingAndEnergyTransferPhase)
  {
    if (@sysvar::GBT27930::Charger::CurrentChargerStatus == kStatus3)
    {
      // Turn off T1
      cancelTimer(sendCyclicChargerBidirectionalChargingReadyStatus);

      // reset Tout1 timer
      setTimer(timer_Tout1_Charger, @sysvar::GBT27930::Charger::Timeouts::Tout1_PreChargingAndEnergyTransfer);

      // turn on T2, T4
      setTimerCyclic(sendCyclicChargerBidirectionalOutputCapability, cChargerOutputCapacityTimeMs); // T2
      setTimerCyclic(sendCyclicChargerBidirectionalChargingInfo, cChargerChargingBasicInformationTimeMs); // T4
      
      // set charging output values 
      if ($Charger.GBT27930_2_2024.VehicleBidirectionalChargingRequest.VoltageRequest.phys < @sysvar::GBT27930::Charger::ChargingDischarging::MaxVoltage)
      {
        HV_source_set_U_DC($Charger.GBT27930_2_2024.VehicleBidirectionalChargingRequest.VoltageRequest.phys);
      }
      else 
      {
        HV_source_set_U_DC(@sysvar::GBT27930::Charger::ChargingDischarging::MaxVoltage);
      }
      
      if ($Charger.GBT27930_2_2024.VehicleBidirectionalChargingRequest.CurrentRequest.phys <= @sysvar::GBT27930::Charger::ChargingDischarging::MaxCurrent)
      {
        HV_source_set_I_DC($Charger.GBT27930_2_2024.VehicleBidirectionalChargingRequest.CurrentRequest.phys);
      }
      else
      {
        HV_source_set_I_DC(@sysvar::GBT27930::Charger::ChargingDischarging::MaxCurrent);
      }
      
      @sysvar::GBT27930::Charger::CurrentChargerStatus = kStatus4; // Energy transfer state
    }
    else if (@sysvar::GBT27930::Charger::CurrentChargerStatus == kStatus4)
    {
      // reset Tout1 timer
      setTimer(timer_Tout1_Charger, @sysvar::GBT27930::Charger::Timeouts::Tout1_PreChargingAndEnergyTransfer);

      // set charging output values 
      if ($Charger.GBT27930_2_2024.VehicleBidirectionalChargingRequest.VoltageRequest.phys < @sysvar::GBT27930::Charger::ChargingDischarging::MaxVoltage)
      {
        HV_source_set_U_DC($Charger.GBT27930_2_2024.VehicleBidirectionalChargingRequest.VoltageRequest.phys);
      }
      else 
      {
        HV_source_set_U_DC(@sysvar::GBT27930::Charger::ChargingDischarging::MaxVoltage);
      }
      
      if ($Charger.GBT27930_2_2024.VehicleBidirectionalChargingRequest.CurrentRequest.phys <= @sysvar::GBT27930::Charger::ChargingDischarging::MaxCurrent)
      {
        HV_source_set_I_DC($Charger.GBT27930_2_2024.VehicleBidirectionalChargingRequest.CurrentRequest.phys);
      }
      else
      {
        HV_source_set_I_DC(@sysvar::GBT27930::Charger::ChargingDischarging::MaxCurrent);
      }
    }
  }
}

void ProcessVehicleBidirectionalDynamicOutputCapability()
{
  if (@sysvar::GBT27930::Charger::ChargingDischarging::EnergyTransferDirection == sysvar::GBT27930::Charger::ChargingDischarging::EnergyTransferDirection::Discharging
  && currentChargerPhase == kPreChargingAndEnergyTransferPhase)
  {
    if (@sysvar::GBT27930::Charger::CurrentChargerStatus == kStatus3)
    {
      // Turn off T1
      cancelTimer(sendCyclicChargerBidirectionalChargingReadyStatus);

      // reset Tout2 timer
      setTimer(timer_Tout2_Charger, @sysvar::GBT27930::Charger::Timeouts::Tout2_PreChargingAndEnergyTransfer);

      // turn on T3, T4
      StartCyclicTimerIfNotRunning(sendCyclicChargerDischargeRequest, cChargerDischargeRequestCycleTimeMs); // T3
      StartCyclicTimerIfNotRunning(sendCyclicChargerBidirectionalChargingInfo, cChargerChargingBasicInformationTimeMs); // T4

      // set discharging output values
      if ($Charger.GBT27930_2_2024.VehicleBidirectionalDynamicOutputCapability.MaxCurrent.phys < @sysvar::GBT27930::Charger::ChargingDischarging::DischargeCurrentDemand)
      {
        writeLineEx(1,1,"Charger: BMS max. current (%f A) is smaller than the requested current (%d A). Reducing target discharge current", $Charger.GBT27930_2_2024.VehicleBidirectionalDynamicOutputCapability.MaxCurrent.phys, @sysvar::GBT27930::Charger::ChargingDischarging::DischargeCurrentDemand);
        @sysvar::GBT27930::Charger::ChargingDischarging::DischargeCurrentDemand = $Charger.GBT27930_2_2024.VehicleBidirectionalDynamicOutputCapability.MaxCurrent.phys;
      }
      
      // send Discharge Request message
      $Charger.GBT27930_2_2024.ChargerDischargeRequest.CurrentDemand.phys = @sysvar::GBT27930::Charger::ChargingDischarging::DischargeCurrentDemand;

      @sysvar::GBT27930::Charger::CurrentChargerStatus = kStatus4; // Energy transfer state
    }
    else if (@sysvar::GBT27930::Charger::CurrentChargerStatus == kStatus4)
    {
      // reset Tout2 timer
      setTimer(timer_Tout2_Charger, @sysvar::GBT27930::Charger::Timeouts::Tout2_PreChargingAndEnergyTransfer);

      // set discharging output values
      if ($Charger.GBT27930_2_2024.VehicleBidirectionalDynamicOutputCapability.MaxCurrent.phys < @sysvar::GBT27930::Charger::ChargingDischarging::DischargeCurrentDemand)
      {
        writeLineEx(1,1,"Charger: BMS max. current (%f A) is smaller than the requested current (%d A). Reducing target discharge current", $Charger.GBT27930_2_2024.VehicleBidirectionalDynamicOutputCapability.MaxCurrent.phys, @sysvar::GBT27930::Charger::ChargingDischarging::DischargeCurrentDemand);
        @sysvar::GBT27930::Charger::ChargingDischarging::DischargeCurrentDemand = $Charger.GBT27930_2_2024.VehicleBidirectionalDynamicOutputCapability.MaxCurrent.phys;
      }
    }
  }
}

void StopChargingProcedure()
{
  // cancel T1 and T2
  cancelTimer(sendCyclicChargerEnergyTransferDynamicOutputCapacity);
  cancelTimer(sendCyclicChargerChargingBasicInformation);

  // Send abort message
  SendEndMessageWithoutChangingModule(_GBT27930::DataTypes::parEndType::EndCharging, _GBT27930::DataTypes::ChargerEndChargingEncoding::ends_normally_manual_end);

  // reduce current (this is Status5)
  @sysvar::GBT27930::Charger::CurrentChargerStatus = kStatus5;
  writeLineEx(-3, 1, "Reduce Current to under 5 A");
  HV_source_set_I_DC(0);

  writeLineEx(-3, 1, "Open contactors K1 and K2");
  HV_open_close_K1K2(OPEN);

  // Before sending Charging Request we need to be sure that BMS receives a CircuitContactorStatusMessage to know the k1, k2 have been open (edge case)
  SendChargerDCSupplyCircuitContactorStatusMessage();

  SendChargerPhaseRequest();
  @sysvar::GBT27930::Charger::CurrentChargerStatus = kStatus6;
}

void ProcessVehicleEnd()
{
  // Cyclic messages that shall be stopped if 'end message' is sent or received
  if(currentChargerPhase == kPreChargingAndEnergyTransferPhase)
  {
    // PreCharge and EnergyTransfer
    cancelTimer(sendCyclicChargerBidirectionalOutputCapability);
    cancelTimer(sendCyclicChargerBidirectionalChargingInfo);  
  }
  
  if(currentChargerPhase == kPreChargingAndEnergyTransferPhase && @sysvar::GBT27930::Charger::CurrentChargerStatus <= kStatus4)
  {
    StopChargingProcedure();
    return;
  }

  // Don't do anything when receiving VehicleEnd when already waiting for PhaseRequest
  if(currentChargerPhase == kPreChargingAndEnergyTransferPhase && @sysvar::GBT27930::Charger::CurrentChargerStatus > kStatus4)
  {
    return;
  }

  // Actual end of communication, do not respond to End message from vehicle to prevent endless loop
  if(currentChargerPhase == kEndPhase && @sysvar::GBT27930::Charger::CurrentChargerStatus == kStatus4)
    return;
    
  if(currentChargerPhase == kEndPhase)
    SendEndMessageWithoutChangingModule(_GBT27930::DataTypes::parEndType::EndCharging, _GBT27930::DataTypes::ChargerEndChargingEncoding::vehicle_actively_ends_end_message);
  else
    SendEndMessageAndEnterEndModule(_GBT27930::DataTypes::parEndType::EndCharging, _GBT27930::DataTypes::ChargerEndChargingEncoding::vehicle_actively_ends_end_message);

}

void ProcessVehicleAdhesionDetection()
{
  if($Charger.GBT27930_2_2024.VehicleAdhesionDetection.VehicleAdhesionDetectionStatus == _GBT27930::DataTypes::AdhesionCheckTypeEncoding::to_be_detected
      || $Charger.GBT27930_2_2024.VehicleAdhesionDetection.VehicleAdhesionDetectionStatus == _GBT27930::DataTypes::AdhesionCheckTypeEncoding::detection_in_progress)
  {
    // Nothing to do, just keep Status2
  }
  else
  {
    if(@sysvar::GBT27930::Charger::CurrentChargerStatus == kStatus2)
    {
      $Charger.GBT27930_2_2024.ChargerStatistics;
      cancelTimer(sendCyclicChargerAllowsAdhesionDetectionMessage);
      cancelTimer(timer_Tout2_Charger);
      @sysvar::GBT27930::Charger::CurrentChargerStatus = kStatus3;
    }
  }
}

void SetSysvarChargerVersionFromVersionStruct(int versionIndex)
{
  if (versionIndex>=0 && versionIndex<NUM_CHARGER_VERSIONS)
  {
    @sysvar::GBT27930::Charger::VersionNegotiation::ProtocolMajor = chargerVersions[versionIndex].major;
    @sysvar::GBT27930::Charger::VersionNegotiation::ProtocolMinor = chargerVersions[versionIndex].minor;
    @sysvar::GBT27930::Charger::VersionNegotiation::ProtocolTemporary = chargerVersions[versionIndex].temporary;
  }
  else
  {
    writeLineEx(1,3,"Charger - Error during VersionNegotiation: VersionIndex %i is invalid", versionIndex);
  }
}

int VehicleVersionHasChanged()
{
  if ($Charger.Vehicle_VersionNegotiation.ProtocolVersion.MajorVersionNumber == @sysvar::GBT27930::Charger::VersionNegotiation::ReceivedVehicleProtocolVersion[0]
     && $Charger.Vehicle_VersionNegotiation.ProtocolVersion.MinorVersionNumber == @sysvar::GBT27930::Charger::VersionNegotiation::ReceivedVehicleProtocolVersion[1]
     && $Charger.Vehicle_VersionNegotiation.ProtocolVersion.TemporaryVersionNumber == @sysvar::GBT27930::Charger::VersionNegotiation::ReceivedVehicleProtocolVersion[2])
  {
    return 0;
  }
  @sysvar::GBT27930::Charger::VersionNegotiation::ReceivedVehicleProtocolVersion[0] = $Charger.Vehicle_VersionNegotiation.ProtocolVersion.MajorVersionNumber;
  @sysvar::GBT27930::Charger::VersionNegotiation::ReceivedVehicleProtocolVersion[1] = $Charger.Vehicle_VersionNegotiation.ProtocolVersion.MinorVersionNumber;
  @sysvar::GBT27930::Charger::VersionNegotiation::ReceivedVehicleProtocolVersion[2] = $Charger.Vehicle_VersionNegotiation.ProtocolVersion.TemporaryVersionNumber;
  return 1;
}

void SendChargerVersionNegotiation()
{
  $Charger.Charger_VersionNegotiation.CANType = @sysvar::GBT27930::Charger::VersionNegotiation::CANType;
  $Charger.Charger_VersionNegotiation.VersionNegotiationResult = @sysvar::GBT27930::Charger::VersionNegotiation::NegotiationResult;
  $Charger.Charger_VersionNegotiation.ProtocolVersion.MajorVersionNumber = @sysvar::GBT27930::Charger::VersionNegotiation::ProtocolMajor;
  $Charger.Charger_VersionNegotiation.ProtocolVersion.MinorVersionNumber = @sysvar::GBT27930::Charger::VersionNegotiation::ProtocolMinor;
  $Charger.Charger_VersionNegotiation.ProtocolVersion.TemporaryVersionNumber = @sysvar::GBT27930::Charger::VersionNegotiation::ProtocolTemporary;
  $Charger.Charger_VersionNegotiation.CPVersion = @sysvar::GBT27930::Charger::VersionNegotiation::ControlPilotVersion;
  $Charger.Charger_VersionNegotiation.TLVersion = @sysvar::GBT27930::Charger::VersionNegotiation::TransportLayerVersion;
}

void SendChargerDynamicOutputCapability()
{
  $Charger.GBT27930_2_2024.ChargerDynamicOutputCapability.MaxCurrent.phys = @sysvar::GBT27930::Charger::ChargingDischarging::MaxCurrent;
  $Charger.GBT27930_2_2024.ChargerDynamicOutputCapability.ChangeInChargerOutputCapacity = @sysvar::GBT27930::Charger::PowerSupplyMode::ReasonForOutputCapacityChange;
}

void SendChargerEnergyTransferDynamicOutputCapacity()
{
  $Charger.GBT27930_2_2024.ChargerEnergyTransferDynamicOutputCapability.MaxCurrent.phys = @sysvar::GBT27930::Charger::ChargingDischarging::MaxCurrent;
  $Charger.GBT27930_2_2024.ChargerEnergyTransferDynamicOutputCapability.ChangeInChargerOutputCapacity = @sysvar::GBT27930::Charger::PowerSupplyMode::ReasonForOutputCapacityChange;
}

void SendChargerChargingBasicInformation()
{
  $Charger.GBT27930_2_2024.ChargerChargingBasicInformation.PresentVoltage.phys = HV_measure_DC_U();
  $Charger.GBT27930_2_2024.ChargerChargingBasicInformation.PresentCurrent.phys = HV_measure_DC_I();
}

void SendChargerBidirectionalDynamicOutputCapacity()
{
  $Charger.GBT27930_2_2024.ChargerBidirectionalDynamicOutputCapability.MaxCurrent.phys = @sysvar::GBT27930::Charger::ChargingDischarging::MaxCurrent;
  $Charger.GBT27930_2_2024.ChargerBidirectionalDynamicOutputCapability.ChangeInChargerOutputCapacity = @sysvar::GBT27930::Charger::PowerSupplyMode::ReasonForOutputCapacityChange;
}

void SendChargerPowerSupplyBasicInformationMessage()
{
  $Charger.GBT27930_2_2024.ChargerPowerSupplyBasicInformation.PresentVoltage.phys = HV_measure_DC_U();
  $Charger.GBT27930_2_2024.ChargerPowerSupplyBasicInformation.PresentCurrent.phys = HV_measure_DC_I();
}

void SendChargerPause()
{
  $Charger.GBT27930_2_2024.ChargerPause.PauseStatus = @sysvar::GBT27930::Charger::ChargingDischarging::PauseCharging;
}

void SendChargerBidirectionalChargingPause()
{
  $Charger.GBT27930_2_2024.ChargerBidirectionalChargingPause.PauseStatus = @sysvar::GBT27930::Charger::ChargingDischarging::PauseCharging;
}

void UpdateChargerDetectionValueIfNeeded()
{
  if(sentChargerDetectionInformationCounter >= 2)
  {
    sentChargerDetectionInformationCounter = 0;
    // Transition values in order through states "WaitingForDetection" > "DetectionInProgress" > "DetectionSuccessful"
    if(@sysvar::GBT27930::Charger::Messages::ChargerDetectionInformation::ShortCircuitDetectionStatus <= @sysvar::GBT27930::Charger::Messages::ChargerDetectionInformation::ShortCircuitDetectionStatus::DetectionInProgress)
    {
      @sysvar::GBT27930::Charger::Messages::ChargerDetectionInformation::ShortCircuitDetectionStatus++;
      writeLineEx(1,1,"Charger: Update ChargerDetectionInformation.ShortCircuitDetectionStatus to state %d.", @sysvar::GBT27930::Charger::Messages::ChargerDetectionInformation::ShortCircuitDetectionStatus);
    }
    else if(@sysvar::GBT27930::Charger::Messages::ChargerDetectionInformation::InsulationDetectionStatus <= @sysvar::GBT27930::Charger::Messages::ChargerDetectionInformation::InsulationDetectionStatus::DetectionInProgress)
    {
      @sysvar::GBT27930::Charger::Messages::ChargerDetectionInformation::InsulationDetectionStatus++;
      writeLineEx(1,1,"Charger: Update ChargerDetectionInformation.InsulationDetectionStatus to state %d.", @sysvar::GBT27930::Charger::Messages::ChargerDetectionInformation::InsulationDetectionStatus);
    }
    else if(@sysvar::GBT27930::Charger::Messages::ChargerDetectionInformation::AdhesionDetectionStatus <= @sysvar::GBT27930::Charger::Messages::ChargerDetectionInformation::AdhesionDetectionStatus::DetectionInProgress)
    {
      @sysvar::GBT27930::Charger::Messages::ChargerDetectionInformation::AdhesionDetectionStatus++;
      writeLineEx(1,1,"Charger: Update ChargerDetectionInformation.AdhesionDetectionStatus to state %d.", @sysvar::GBT27930::Charger::Messages::ChargerDetectionInformation::AdhesionDetectionStatus);      
    }
    else if(@sysvar::GBT27930::Charger::Messages::ChargerDetectionInformation::DischargeStatus <= @sysvar::GBT27930::Charger::Messages::ChargerDetectionInformation::DischargeStatus::DischargingInProgress)
    {
      @sysvar::GBT27930::Charger::Messages::ChargerDetectionInformation::DischargeStatus++;
      writeLineEx(1,1,"Charger: Update ChargerDetectionInformation.DischargeStatus to state %d.", @sysvar::GBT27930::Charger::Messages::ChargerDetectionInformation::DischargeStatus);
    }
  }
  else
  {
    sentChargerDetectionInformationCounter++;
  }
}

void SendChargerSupportFunction()
{
  $Charger.GBT27930_2_2024.ChargerSupportFunction.ParameterConfiguration.FDCSupport1 = 0x01;
  $Charger.GBT27930_2_2024.ChargerSupportFunction.ParameterConfiguration.FDCSupport2 = 0x01;

  $Charger.GBT27930_2_2024.ChargerSupportFunction.Authentication.FDCSupport1 = 0x01;
  $Charger.GBT27930_2_2024.ChargerSupportFunction.Authentication.FDCSupport2 = 0x01;
  $Charger.GBT27930_2_2024.ChargerSupportFunction.Authentication.FDCSupport3 = 0x01;

  $Charger.GBT27930_2_2024.ChargerSupportFunction.Booking.FDCSupport1 = 0x01;

  $Charger.GBT27930_2_2024.ChargerSupportFunction.OutputCircuitDetection.FDCSupport1 = 0x01;

  $Charger.GBT27930_2_2024.ChargerSupportFunction.PowerSupplyMode.FDCSupport1 = 0x01;

  // both modules for precharging FDC1 and FDC2 are per default supported
  $Charger.GBT27930_2_2024.ChargerSupportFunction.PreChargingAndEnergyTransmission.FDCSupport1 = 0x01;
  $Charger.GBT27930_2_2024.ChargerSupportFunction.PreChargingAndEnergyTransmission.FDCSupport2 = 0x01;

  $Charger.GBT27930_2_2024.ChargerSupportFunction.EndMessage.FDCSupport1 = 0x01;
}

void SendChargerPhaseRequest()
{
  switch(currentChargerPhase)
  {
    case kInitial:
    case kVersionNegotiation:
      writeLineEx(-3,1,"Logic Error: There is no PhaseAcknowledge before the function module FunctionNegotiaton");
      break;
    case kFunctionNegotiationPhase:
      $Charger.GBT27930_2_2024.ChargerPhaseRequest.Phase = _GBT27930::DataTypes::PhaseTypeEncoding::parameter_configuration_charging_mode;
      break;
    case kParameterConfigurationPhase:
      if (skipAuthentication && skipScheduling) {$Charger.GBT27930_2_2024.ChargerPhaseRequest.Phase = _GBT27930::DataTypes::PhaseTypeEncoding::output_circuit_detection;}
      else if (skipAuthentication) {$Charger.GBT27930_2_2024.ChargerPhaseRequest.Phase = _GBT27930::DataTypes::PhaseTypeEncoding::scheduling_vehicle_defined_start_time;}
      else 
      {
        switch (@sysvar::GBT27930::Charger::Authentication::PreferedAuthenticationMethod)
        {
          case sysvar::GBT27930::Charger::Authentication::PreferedAuthenticationMethod::Scan:
            $Charger.GBT27930_2_2024.ChargerPhaseRequest.Phase = _GBT27930::DataTypes::PhaseTypeEncoding::authentication_scan_code_swipe_card;
            break;
          case sysvar::GBT27930::Charger::Authentication::PreferedAuthenticationMethod::EVIN:
            $Charger.GBT27930_2_2024.ChargerPhaseRequest.Phase = _GBT27930::DataTypes::PhaseTypeEncoding::authentication_scan_evin_authentication;
            break;
          case sysvar::GBT27930::Charger::Authentication::PreferedAuthenticationMethod::Cloud:
            $Charger.GBT27930_2_2024.ChargerPhaseRequest.Phase = _GBT27930::DataTypes::PhaseTypeEncoding::authentication_scan_cloud_authentication;
            break;
        }
      }
      break;
    case kAuthenticationPhase:
      if (skipScheduling)
      {
        $Charger.GBT27930_2_2024.ChargerPhaseRequest.Phase = _GBT27930::DataTypes::PhaseTypeEncoding::output_circuit_detection;
      }
      else
      {
        $Charger.GBT27930_2_2024.ChargerPhaseRequest.Phase = _GBT27930::DataTypes::PhaseTypeEncoding::scheduling_vehicle_defined_start_time;
      }
      break;
    case kSchedulingPhase:
      $Charger.GBT27930_2_2024.ChargerPhaseRequest.Phase = _GBT27930::DataTypes::PhaseTypeEncoding::output_circuit_detection;
      break;
    case kOutputCircuitDetectionPhase:
      if (skipPowerSupply)
      {
        $Charger.GBT27930_2_2024.ChargerPhaseRequest.Phase = _GBT27930::DataTypes::PhaseTypeEncoding::precharge_and_energy_transfer_charging;
      } else {
        $Charger.GBT27930_2_2024.ChargerPhaseRequest.Phase = _GBT27930::DataTypes::PhaseTypeEncoding::power_supply_mode;
      }
      break;
    case kPowerSupplyModePhase:
      $Charger.GBT27930_2_2024.ChargerPhaseRequest.Phase = _GBT27930::DataTypes::PhaseTypeEncoding::precharge_and_energy_transfer_charging;
      break;
    case kPreChargingAndEnergyTransferPhase:
      $Charger.GBT27930_2_2024.ChargerPhaseRequest.Phase = _GBT27930::DataTypes::PhaseTypeEncoding::end_message;
      break;
    case kEndPhase:
      // this is only triggerd when the Charging process is abnormal
      $Charger.GBT27930_2_2024.ChargerPhaseRequest.Phase = _GBT27930::DataTypes::PhaseTypeEncoding::end_message;
      isAbnormalEnd = 1;
      break;
    default:
      $Charger.GBT27930_2_2024.ChargerPhaseRequest;
      break;
  }
}

SendChargerChargingParameters()
{
  $Charger.GBT27930_2_2024.ChargerChargingParameters.MaxOutputVoltage.phys = @sysvar::GBT27930::Charger::ChargingDischarging::MaxVoltage;
  $Charger.GBT27930_2_2024.ChargerChargingParameters.MinOutputVoltage.phys = @sysvar::GBT27930::Charger::ChargingDischarging::MinVoltage;
  $Charger.GBT27930_2_2024.ChargerChargingParameters.MaxOutputCurrent.phys = @sysvar::GBT27930::Charger::ChargingDischarging::MaxCurrent;
  $Charger.GBT27930_2_2024.ChargerChargingParameters.MinOutputCurrent.phys = @sysvar::GBT27930::Charger::ChargingDischarging::MinCurrent;
  if (@sysvar::GBT27930::Charger::ChargingDischarging::UnlimitedRestarts)
  {
    $Charger.GBT27930_2_2024.ChargerChargingParameters.NumberOfAllowedRestarts = 0xFE; // Unlimited restarts (see Table C.3)
  }
  else 
  {
    $Charger.GBT27930_2_2024.ChargerChargingParameters.NumberOfAllowedRestarts = @sysvar::GBT27930::Charger::ChargingDischarging::MaxRestarts;
  }
}

SendChargerChargingAndDischargingParameters()
{
  $Charger.GBT27930_2_2024.ChargerChargingAndDischargingParameters.MaxOutputVoltage.phys = @sysvar::GBT27930::Charger::ChargingDischarging::MaxVoltage;
  $Charger.GBT27930_2_2024.ChargerChargingAndDischargingParameters.MinOutputVoltage.phys = @sysvar::GBT27930::Charger::ChargingDischarging::MinVoltage;
  $Charger.GBT27930_2_2024.ChargerChargingAndDischargingParameters.MaxOutputCurrent.phys = @sysvar::GBT27930::Charger::ChargingDischarging::MaxCurrent;
  $Charger.GBT27930_2_2024.ChargerChargingAndDischargingParameters.MinOutputCurrent.phys = @sysvar::GBT27930::Charger::ChargingDischarging::MinCurrent;
  $Charger.GBT27930_2_2024.ChargerChargingAndDischargingParameters.MaxDischargingVoltage.phys = @sysvar::GBT27930::Charger::ChargingDischarging::MaxDischargingVoltage;
  $Charger.GBT27930_2_2024.ChargerChargingAndDischargingParameters.MinDischargingVoltage.phys = @sysvar::GBT27930::Charger::ChargingDischarging::MinDischargingVoltage;
  $Charger.GBT27930_2_2024.ChargerChargingAndDischargingParameters.MaxDischargingCurrent.phys = @sysvar::GBT27930::Charger::ChargingDischarging::MaxDischargingCurrent;
  $Charger.GBT27930_2_2024.ChargerChargingAndDischargingParameters.MinDischargingCurrent.phys = @sysvar::GBT27930::Charger::ChargingDischarging::MinDischargingCurrent;
  if (@sysvar::GBT27930::Charger::ChargingDischarging::UnlimitedRestarts)
  {
    $Charger.GBT27930_2_2024.ChargerChargingAndDischargingParameters.NumberOfAllowedRestarts = 0xFE; // Unlimited restarts (see Table C.9)
  }
  else 
  {
    $Charger.GBT27930_2_2024.ChargerChargingAndDischargingParameters.NumberOfAllowedRestarts = @sysvar::GBT27930::Charger::ChargingDischarging::MaxRestarts;
  }
}

SendScanAuthenticationParameter()
{
  $Charger.GBT27930_2_2024.ChargerScanAuthenticationParameter.AuthenticationStatus = @sysvar::GBT27930::Charger::Authentication::AuthenticationStatus;
  $Charger.GBT27930_2_2024.ChargerScanAuthenticationParameter.AuthenticationWaitingTimeInMin = @sysvar::GBT27930::Charger::Timeouts::Tout0_Authentication / (60 * 1000);
}

SendChargerCloudAuthenticationParameter()
{
  $Charger.GBT27930_2_2024.ChargerCloudAuthenticationParameter.ChargingEquipmentID[0] = 0x03;
  $Charger.GBT27930_2_2024.ChargerCloudAuthenticationParameter.ChargingOperatorID[0] = 'V';
  $Charger.GBT27930_2_2024.ChargerCloudAuthenticationParameter.ChargingOperatorID[1] = 'E';
  $Charger.GBT27930_2_2024.ChargerCloudAuthenticationParameter.ChargingOperatorID[2] = 'C';
  $Charger.GBT27930_2_2024.ChargerCloudAuthenticationParameter.ChargingOperatorID[3] = 'T';
}

void SendChargerPowerSupplyStatus(long chargerPowerSupplyStatus)
{
  $Charger.GBT27930_2_2024.ChargerPowerSupplyStatus.ChargerPowerSupplyStatus = chargerPowerSupplyStatus;
}

void SendChargerReadyStatus()
{
  if (@sysvar::GBT27930::Charger::ReadyStatus == 0)
  {
    $Charger.GBT27930_2_2024.ChargerReadyStatus.ReadyStatus = _GBT27930::DataTypes::parReadyType::NotReady;
  }

  if (@sysvar::GBT27930::Charger::ReadyStatus == 1)
  {
    $Charger.GBT27930_2_2024.ChargerReadyStatus.ReadyStatus = _GBT27930::DataTypes::parReadyType::Ready;
  }
}

void SendCyclicChargerEnergyTransferDynamicOutputCapacity()
{
    $Charger.GBT27930_2_2024.ChargerEnergyTransferDynamicOutputCapability.MaxCurrent.phys = @sysvar::GBT27930::Charger::ChargingDischarging::MaxCurrent;
    $Charger.GBT27930_2_2024.ChargerEnergyTransferDynamicOutputCapability.ChangeInChargerOutputCapacity = @sysvar::GBT27930::Charger::PowerSupplyMode::ReasonForOutputCapacityChange;
}

void SendChargerDCSupplyCircuitContactorStatusMessage()
{
  long contactorStatusEncoding;
  if(@sysvar::GBT27930::Charger::ContactorStatus_K1K2 == @sysvar::GBT27930::Charger::ContactorStatus_K1K2::Open)
  {
    contactorStatusEncoding = _GBT27930::DataTypes::parContactorStatusType::OFF;
  }
  else if (@sysvar::GBT27930::Charger::ContactorStatus_K1K2 == @sysvar::GBT27930::Charger::ContactorStatus_K1K2::Close)
  {
    contactorStatusEncoding = _GBT27930::DataTypes::parContactorStatusType::ON;
  }
  else
  {
    contactorStatusEncoding = _GBT27930::DataTypes::parContactorStatusType::Untrusted;
  }

  $Charger.GBT27930_2_2024.ChargerDCSupplyCircuitContactorStatus.StatusK1 = contactorStatusEncoding;
  $Charger.GBT27930_2_2024.ChargerDCSupplyCircuitContactorStatus.StatusK2 = contactorStatusEncoding;
}

void SendEndMessageAndEnterEndModule(long endType, long endReason)
{
  // Cyclic messages that shall be stopped if 'end message' is sent or received
  if(currentChargerPhase == kPreChargingAndEnergyTransferPhase)
  {
    // PreCharge and EnergyTransfer
    cancelTimer(sendCyclicChargerBidirectionalOutputCapability);
    cancelTimer(sendCyclicChargerBidirectionalChargingInfo);  
  }
  
  cancelTimer(timer_Tout0_Charger);
  SendEndMessageWithoutChangingModule(endType, endReason);
  currentChargerPhase = kEndPhase;
  SendChargerPhaseRequest();
}

void SendEndMessageWithoutChangingModule(long endType, long endReason)
{
  $Charger.GBT27930_2_2024.ChargerEnd.EndType = endType;
  switch(endType)
  {
    case _GBT27930::DataTypes::parEndType::EndCharging:
      $Charger.GBT27930_2_2024.ChargerEnd.EndReason.EndCharging = endReason;
      break;
    case _GBT27930::DataTypes::parEndType::FunctionModuleInformationInteractionTimeout:
      $Charger.GBT27930_2_2024.ChargerEnd.EndReason.FunctionModuleInteractionTimeout = endReason;
      break;
    case _GBT27930::DataTypes::parEndType::FunctionModuleExecutionFailed:
      $Charger.GBT27930_2_2024.ChargerEnd.EndReason.FunctionModuleExecutionFail = endReason;
      break;
    case _GBT27930::DataTypes::parEndType::PhaseAcknowledgementFailed:
      $Charger.GBT27930_2_2024.ChargerEnd.EndReason.PhaseAcknowledgementFail = endReason;
      break;
    default:
      $Charger.GBT27930_2_2024.ChargerEnd.EndReason.UnknownEndType = endReason;
      break;
  } 
}

void StartAuthentication()
{
  writeLineEx(-3,1,"#### Charger: Enter Authentication ####");
  switch (@sysvar::GBT27930::Charger::Authentication::PreferedAuthenticationMethod)
  {
    case sysvar::GBT27930::Charger::Authentication::PreferedAuthenticationMethod::EVIN:
      StartEVINAuthentication();
      break;
    case sysvar::GBT27930::Charger::Authentication::PreferedAuthenticationMethod::Cloud:
      StartCloudAuthentication();
      break;
    case sysvar::GBT27930::Charger::Authentication::PreferedAuthenticationMethod::Scan:
    default:
      StartScanAuthentication();
      break;
  }
}

void StartScanAuthentication()
{
  @sysvar::GBT27930::Charger::Authentication::AuthenticationType = @sysvar::GBT27930::Charger::Authentication::AuthenticationType::Scan; 
  StartTimerIfNotRunning(timer_Tout0_Charger, @sysvar::GBT27930::Charger::Timeouts::Tout0_Authentication); // 10 minutes
  // Send charger authentication parameters with "not completed"
  @sysvar::GBT27930::Charger::Authentication::AuthenticationStatus = 0x00;
  SendScanAuthenticationParameter();
  StartTimerIfNotRunning(sendCyclicChargerAuthenticationParameterMessage, cChargerAuthenticationParameterCycleTimeMs); // T1 = 250 ms, which is the cylce time of the URM 
  @sysvar::GBT27930::Charger::CurrentChargerStatus = kStatus1;
  StartTimerIfNotRunning(timer_SimulateAuthentication_Charger, cChargerAuthenticationSimulationTimeMs); 
}

void StartEVINAuthentication()
{
  @sysvar::GBT27930::Charger::Authentication::AuthenticationType = @sysvar::GBT27930::Charger::Authentication::AuthenticationType::EVIN;
  StartTimerIfNotRunning(timer_Tout0_Charger, @sysvar::GBT27930::Charger::Timeouts::Tout0_Authentication); // 10 minutes
  @sysvar::GBT27930::Charger::CurrentChargerStatus = kStatus1;
}

void StartCloudAuthentication()
{
  @sysvar::GBT27930::Charger::Authentication::AuthenticationType = @sysvar::GBT27930::Charger::Authentication::AuthenticationType::Cloud; 
  StartTimerIfNotRunning(timer_Tout0_Charger, @sysvar::GBT27930::Charger::Timeouts::Tout0_Authentication); // 10 minutes
  @sysvar::GBT27930::Charger::CurrentChargerStatus = kStatus1;
}

void PerformEVINAuthentication()
{
  // Set Auth status 
  if (@sysvar::GBT27930::Charger::Authentication::TriggerReAuthentication == 1)
  {
    @sysvar::GBT27930::Charger::Authentication::AuthenticationStatus = 0x00;
    $Charger.GBT27930_2_2024.ChargerEVINAuthenticationResult.AuthenticationResult = 0x00;
  } else {
    @sysvar::GBT27930::Charger::Authentication::AuthenticationStatus = 0xAA;
    $Charger.GBT27930_2_2024.ChargerEVINAuthenticationResult.AuthenticationResult = 0xAA;
  }
  // Check Auth status
  if (@sysvar::GBT27930::Charger::Authentication::AuthenticationStatus == 0xAA) 
  { // EVIN is valid
    $Charger.GBT27930_2_2024.ChargerEVINAuthenticationResult.SuccessfulAuthenticationFDC = 2; 
    SendChargerPhaseRequest();
    @sysvar::GBT27930::Charger::CurrentChargerStatus = kStatus3;
  } else { // EVIN is invalid
    $Charger.GBT27930_2_2024.ChargerEVINAuthenticationResult.SuccessfulAuthenticationFDC = 0;
    @sysvar::GBT27930::Charger::CurrentChargerStatus = kStatus2;
  }
}

void ReactToOpenK1K2DuringEndPhase()
{
  cancelTimer(timer_Tout1_Charger);
  $Charger.GBT27930_2_2024.ChargerAllowsAdhesionDetection.AllowAdhesionDetection = _GBT27930::DataTypes::parEnableType::Allowed;
  setTimerCyclic(sendCyclicChargerAllowsAdhesionDetectionMessage, cChargerAuthenticationParameterCycleTimeMs);
  setTimer(timer_Tout2_Charger, @sysvar::GBT27930::Charger::Timeouts::Tout2_EndPhase_VehicleAdhesionDetectionReceived);
  @sysvar::GBT27930::Charger::CurrentChargerStatus = kStatus2;
}

word CompareWithTolerance(double testValue, double targetValue, double tolerance)
{
  if (testValue > targetValue - tolerance && testValue < targetValue + tolerance)
  {
    return 1;
  }
  return 0;
}

/////////////////////////////////////////////////////////////////////////////////////
/*-----------------------------------Presentation----------------------------------*/
/////////////////////////////////////////////////////////////////////////////////////

void SetChargingStationPicturesVisibility(int Mode)
{
  If(Mode == Ready)
  {
   SetControlVisibility(gPanelName, "pictureChargingStationReady", 1);
   SetControlVisibility(gPanelName, "pictureChargingStationCharging", 0);
   SetControlVisibility(gPanelName, "pictureChargingStationError", 0);
  }
  else If(Mode == Charging)
  {
   SetControlVisibility(gPanelName, "pictureChargingStationReady", 0);
   SetControlVisibility(gPanelName, "pictureChargingStationCharging", 1);
   SetControlVisibility(gPanelName, "pictureChargingStationError", 0);
  }
  else If(Mode == Error)
  {
   SetControlVisibility(gPanelName, "pictureChargingStationReady", 0);
   SetControlVisibility(gPanelName, "pictureChargingStationCharging", 0);
   SetControlVisibility(gPanelName, "pictureChargingStationError", 1);
  }
}

void UpdateElectronicLockText()
{
  If(@sysvar::GBT27930::Charger::ElectronicLockStatus == sysvar::GBT27930::Charger::ElectronicLockStatus::Unlocked)
  {
   SetControlVisibility(gPanelName, "txt_ElectronicLockUnlocked", 1);
   SetControlVisibility(gPanelName, "txt_ElectronicLockLocked", 0);
   SetControlVisibility(gPanelName, "txt_ElectronicLockUntrusted", 0);
   SetControlVisibility(gPanelName, "pictureElectronicLockUnlocked", 1);
   SetControlVisibility(gPanelName, "pictureElectronicLockLocked", 0);
  }
  else If(@sysvar::GBT27930::Charger::ElectronicLockStatus  == sysvar::GBT27930::Charger::ElectronicLockStatus::Locked)
  {
   SetControlVisibility(gPanelName, "txt_ElectronicLockUnlocked", 0);
   SetControlVisibility(gPanelName, "txt_ElectronicLockLocked", 1);
   SetControlVisibility(gPanelName, "txt_ElectronicLockUntrusted", 0);
   SetControlVisibility(gPanelName, "pictureElectronicLockUnlocked", 0);
   SetControlVisibility(gPanelName, "pictureElectronicLockLocked", 1);
  }
  else If(@sysvar::GBT27930::Charger::ElectronicLockStatus == sysvar::GBT27930::Charger::ElectronicLockStatus::Untrusted)
  {
   SetControlVisibility(gPanelName, "txt_ElectronicLockUnlocked", 0);
   SetControlVisibility(gPanelName, "txt_ElectronicLockLocked", 0);
   SetControlVisibility(gPanelName, "txt_ElectronicLockUntrusted", 1);
   SetControlVisibility(gPanelName, "pictureElectronicLockUnlocked", 0);
   SetControlVisibility(gPanelName, "pictureElectronicLockLocked", 0);
  }
}

void UpdateK1K2StatusText()
{
  If(@sysvar::GBT27930::Charger::ContactorStatus_K1K2 == sysvar::GBT27930::Charger::ContactorStatus_K1K2::Close)
  {
   SetControlVisibility(gPanelName, "txt_K1K2Opened", 0);
   SetControlVisibility(gPanelName, "txt_K1K2Closed", 1);
  }
  else If(@sysvar::GBT27930::Charger::ContactorStatus_K1K2  == sysvar::GBT27930::Charger::ContactorStatus_K1K2::Open)
  {
   SetControlVisibility(gPanelName, "txt_K1K2Opened", 1);
   SetControlVisibility(gPanelName, "txt_K1K2Closed", 0);
  }
}

/////////////////////////////////////////////////////////////////////////////////////
/*-----------------------------------Key Inputs------------------------------------*/
/////////////////////////////////////////////////////////////////////////////////////

on key 'n'
{
  @sysvar::GBT27930::Charger::ElectronicLockStatus = 0xFF;
}
