/*@!Encoding:1252*/

variables
{
  enum Connector
  {
    OPEN = 0,
    CLOSE = 1
  };   
  const float cRes_R1 = 1000.0;
  const float cRes_R2 = 1000.0;
  const float cRes_R3 = 1000.0;
  const float cAux_voltage = 12.0;
  
  msTimer tTimeoutReadyToOpen_K1_K2;
  msTimer tCurrentMonitoring;
}

on sysvar_update sysvar::VTS::EVSE_VT2004_Ch3_CC1::CurVoltage
{
  @sysvar::GBT27930::Control::voltage_CP1 = @sysvar::VTS::EVSE_VT2004_Ch3_CC1::CurVoltage;
}

on timer tCurrentMonitoring
{
  if(_CheckCanBeOpened_K1_K2_() == 1)
  {
    HV_open_close_K1K2(OPEN);
    cancelTimer(tTimeoutReadyToOpen_K1_K2);
    writeLineEx(-3, 3, "Current < 5A measured, opening K1_K2 now");
  }
  
  if(isTimerActive(tTimeoutReadyToOpen_K1_K2))
    tCurrentMonitoring.set(5); //Check again in 5ms
}

on timer tTimeoutReadyToOpen_K1_K2
{
  writeLineEx(-3, 3, "Current value >= 5A measured (value: %f), K1_K2 could not be opened within timeout. Opening now", HV_measure_DC_I());
  HV_open_close_K1K2(OPEN);
}

long _CheckCanBeOpened_K1_K2_()
{
  if(HV_measure_DC_I() < 5.0)
    return 1;
  
  return 0;
}

export void StartTimerReadyToOpen_K1_K2(long timeoutMs)
{
  if(_CheckCanBeOpened_K1_K2_() == 1)
  {
    HV_open_close_K1K2(OPEN);
    writeLineEx(-3, 3, "K1_K2 can be opened immediately");
  }
  else
  {
    if(!isTimerActive(tTimeoutReadyToOpen_K1_K2))
      setTimer(tTimeoutReadyToOpen_K1_K2, timeoutMs);
    setTimer(tCurrentMonitoring, 5);
  }
}

//--------------------------------------------- functions of the GBT HW interface ----------------------------------------------------------------------
//Connects to the bus bar to provide 12 V; connects R1 to BMS via CC1
export void Connect_CC1()
{
  @sysvar::VTS::EVSE_VT2004_Ch3_CC1::RelayOrgSensor = 0;
  @sysvar::VTS::EVSE_VT2004_Ch3_CC1::RelayShortCircuit = 0;
  @sysvar::VTS::EVSE_VT2004_Ch3_CC1::RelayBusBar1A = 1;
  @sysvar::VTS::EVSE_VT2004_Ch3_CC1::RelayBusBar1B = 0;
  @sysvar::VTS::EVSE_VT2004_Ch3_CC1::RelayBusBar2A = 0;
  @sysvar::VTS::EVSE_VT2004_Ch3_CC1::RelayBusBar2B = 0;
  sysvar::VTS::EVSE_VT2004_Ch3_CC1.SetStimulationMode(eVTSStimulationModeResistanceGreater);
  @sysvar::VTS::EVSE_VT2004_Ch3_CC1::Resistor = 1000;
  
  @sysvar::VTS::EVSE_VT2004_Ch4_CC1_::RelayOrgSensor = 0;
  @sysvar::VTS::EVSE_VT2004_Ch4_CC1_::RelayShortCircuit = 0;
  @sysvar::VTS::EVSE_VT2004_Ch4_CC1_::RelayBusBar1A = 0;
  @sysvar::VTS::EVSE_VT2004_Ch4_CC1_::RelayBusBar1B = 0;
  @sysvar::VTS::EVSE_VT2004_Ch4_CC1_::RelayBusBar2A = 0;
  @sysvar::VTS::EVSE_VT2004_Ch4_CC1_::RelayBusBar2B = 1;
  sysvar::VTS::EVSE_VT2004_Ch4_CC1_.SetStimulationMode(eVTSStimulationModeResistanceGreater);
  @sysvar::VTS::EVSE_VT2004_Ch4_CC1_::Resistor = 1000;
//  writeEx(-3,3, "Test system: Connect_CC1 called");
}


//Disconnects from the bus bar (no voltage at check point 1)
export void Disconnect_CC1()
{
  @sysvar::VTS::EVSE_VT2004_Ch3_CC1::RelayOrgSensor = 0;
  @sysvar::VTS::EVSE_VT2004_Ch3_CC1::RelayShortCircuit = 0;
  @sysvar::VTS::EVSE_VT2004_Ch3_CC1::RelayBusBar1A = 0;
  @sysvar::VTS::EVSE_VT2004_Ch3_CC1::RelayBusBar1B = 0;
  @sysvar::VTS::EVSE_VT2004_Ch3_CC1::RelayBusBar2A = 0;
  @sysvar::VTS::EVSE_VT2004_Ch3_CC1::RelayBusBar2B = 0;
  
  @sysvar::VTS::EVSE_VT2004_Ch4_CC1_::RelayOrgSensor = 0;
  @sysvar::VTS::EVSE_VT2004_Ch4_CC1_::RelayShortCircuit = 0;
  @sysvar::VTS::EVSE_VT2004_Ch4_CC1_::RelayBusBar1A = 0;
  @sysvar::VTS::EVSE_VT2004_Ch4_CC1_::RelayBusBar1B = 0;
  @sysvar::VTS::EVSE_VT2004_Ch4_CC1_::RelayBusBar2A = 0;
  @sysvar::VTS::EVSE_VT2004_Ch4_CC1_::RelayBusBar2B = 0; 
}

export void Connect_CC2()
{
  @sysvar::VTS::EVSE_VT2004_Ch1_CC2::RelayOrgSensor = 0;
  @sysvar::VTS::EVSE_VT2004_Ch1_CC2::RelayShortCircuit = 0;
  @sysvar::VTS::EVSE_VT2004_Ch1_CC2::RelayBusBar1A = 0;
  @sysvar::VTS::EVSE_VT2004_Ch1_CC2::RelayBusBar1B = 0;
  @sysvar::VTS::EVSE_VT2004_Ch1_CC2::RelayBusBar2A = 0;
  @sysvar::VTS::EVSE_VT2004_Ch1_CC2::RelayBusBar2B = 1;
  sysvar::VTS::EVSE_VT2004_Ch1_CC2.SetStimulationMode(eVTSStimulationModeResistanceGreater);
  @sysvar::VTS::EVSE_VT2004_Ch1_CC2::Resistor = 1000;
//  writeEx(-3,3, "Test system: Connect_CC2 called");
}


//Disconnects from the bus bar (no voltage at check point 1)
export void Disconnect_CC2()
{
  @sysvar::VTS::EVSE_VT2004_Ch1_CC2::RelayOrgSensor = 0;
  @sysvar::VTS::EVSE_VT2004_Ch1_CC2::RelayShortCircuit = 0;
  @sysvar::VTS::EVSE_VT2004_Ch1_CC2::RelayBusBar1A = 0;
  @sysvar::VTS::EVSE_VT2004_Ch1_CC2::RelayBusBar1B = 0;
  @sysvar::VTS::EVSE_VT2004_Ch1_CC2::RelayBusBar2A = 0;
  @sysvar::VTS::EVSE_VT2004_Ch1_CC2::RelayBusBar2B = 0; 
}

export void CHA_set_voltage_CP1(double voltage)
{
  if(isSimulated())
    @sysvar::GBT27930::Control::voltage_CP1 = voltage;
  //else
    //voltage is currently taken from VT power supply and cannot be changed
} 

export double CHA_measure_voltage_CP1()
{
  return @sysvar::GBT27930::Control::voltage_CP1;
}

export void CHA_set_resistance_R1(double resistance)
{
  if(resistance < 1)
    sysvar::VTS::EVSE_VT2004_Ch3_CC1.SetStimulationMode(eVTSStimulationModeNone);
  else
    sysvar::VTS::EVSE_VT2004_Ch3_CC1.SetStimulationMode(eVTSStimulationModeResistanceGreater);
  
  @sysvar::VTS::EVSE_VT2004_Ch3_CC1::Resistor = resistance;
//  writeEx(-3,3, "Test system: CHA_set_resistance_R1 called");
}

export void CHA_set_resistance_R2(double resistance)
{
  if(resistance < 1)
    sysvar::VTS::EVSE_VT2004_Ch4_CC1_.SetStimulationMode(eVTSStimulationModeNone);
  else
    sysvar::VTS::EVSE_VT2004_Ch4_CC1_.SetStimulationMode(eVTSStimulationModeResistanceGreater);
  
  @sysvar::VTS::EVSE_VT2004_Ch4_CC1_::Resistor = resistance;
//  writeEx(-3,3, "Test system: CHA_set_resistance_R2 called");
}

export void CHA_set_resistance_R3(double resistance)
{
  if(resistance < 1)
    sysvar::VTS::EVSE_VT2004_Ch1_CC2.SetStimulationMode(eVTSStimulationModeNone);
  else
    sysvar::VTS::EVSE_VT2004_Ch1_CC2.SetStimulationMode(eVTSStimulationModeResistanceGreater);
  
  @sysvar::VTS::EVSE_VT2004_Ch1_CC2::Resistor = resistance;
//  writeEx(-3,3, "Test system: CHA_set_resistance_R3 called");
}
 
export void disconnect_resistances()
{
  sysvar::VTS::EVSE_VT2004_Ch1_CC2.SetStimulationMode(eVTSStimulationModeNone);
  sysvar::VTS::EVSE_VT2004_Ch2.SetStimulationMode(eVTSStimulationModeNone);
  sysvar::VTS::EVSE_VT2004_Ch3_CC1.SetStimulationMode(eVTSStimulationModeNone);
  sysvar::VTS::EVSE_VT2004_Ch4_CC1_.SetStimulationMode(eVTSStimulationModeNone);
}

export void Connect_CAN()
{
  //CAN connection handling is not needed for VT wiring
}

export void Disconnect_CAN()
{
  //CAN connection handling is not needed for VT wiring
}

export void CHA_open_close_S(int openClose)
{
  @sysvar::VTS::EVSE_VT2004_Ch4_CC1_::RelayOrgSensor = 0;
  @sysvar::VTS::EVSE_VT2004_Ch4_CC1_::RelayShortCircuit = 0;
  @sysvar::VTS::EVSE_VT2004_Ch4_CC1_::RelayBusBar1A = 0;
  @sysvar::VTS::EVSE_VT2004_Ch4_CC1_::RelayBusBar1B = 0;
  @sysvar::VTS::EVSE_VT2004_Ch4_CC1_::RelayBusBar2A = 0;

  if (openClose == CLOSE)
    @sysvar::VTS::EVSE_VT2004_Ch4_CC1_::RelayBusBar2B = 1;
  else if (openClose == OPEN)
    @sysvar::VTS::EVSE_VT2004_Ch4_CC1_::RelayBusBar2B = 0;

//  writeEx(-3,3, "Test system: CHA_open_close_S called, openClose %d", openClose);
}

export void CHA_open_close_K3K4(int openClose)
{  
  writeEx(-3,3, "Test system: CHA_open_close_K3K4 called, openClose %d", openClose);
}
 
export void CHA_set_auxiliary_voltage(double voltage)
{
  writeEx(-3,3, "Test system: CHA_set_auxiliary_voltage called, voltage %d", voltage);
}
 
//not part of communication tests
export long HV_measure_DC_U()
{
  return @sysvar::GBT27930::Control::HV_DC_Voltage;
}

//not part of communication tests
export long HV_measure_DC_I()
{
  return @sysvar::GBT27930::Control::HV_DC_Current;
}

//not part of communication tests
export long HV_measure_DC_P()
{
  return 0;
}

//not part of communication tests
export long HV_source_set_U_DC(double voltage)
{
  return 0;
}

//not part of communication tests
export long HV_source_set_I_DC(double current)
{
  return 0;
}

export void HV_source_reset()
{
  HV_source_set_U_DC(0.0);
  HV_source_set_I_DC(0.0);
}


export void HV_open_close_K1K2 (int openClose)
{
  writeEx(-3,3, "Test system: CHA_open_close_K1K2 called, openClose %d", openClose);
}