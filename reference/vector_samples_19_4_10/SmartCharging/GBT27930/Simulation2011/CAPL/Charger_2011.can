/*@!Encoding:1252*/
includes
{
  #include "GBT_HW_Interface_EVSE.cin"
}

variables
{
  enum DelayTransition
  {
    k3k4_to_chm             = 11,
    bhm_to_crmNotRecognized = 0,
    brm_to_crmRecognized    = 1,
    bcp_to_cml              = 2,
    broReady_to_croNotReady = 3,
    croNotReady_to_croReady = 4,
    bcs_to_ccs              = 5,
    bst_to_cst              = 6,
    bsd_to_csd              = 7,
    csd_to_end              = 8
  };
  
  enum AllowedMissingTime
  {
    brm        = 0,
    bcp        = 1,
    broNotReady= 2,
    broReady   = 3,
    bcl        = 4,
    bcs        = 5,
    bst        = 6,
    bsd        = 7
  };
  
  enum PGN
  {
    kCRM = 0x100,
    kBRM = 0x200,
    kBCP = 0x600,
    kCTS = 0x700,
    kCML = 0x800,
    kBRO = 0x900,
    kCRO = 0xA00,
    kBCL = 0x1000,
    kBCS = 0x1100,
    kCCS = 0x1200,
    kBSM = 0x1300,
    kBMV = 0x1500,
    kBMT = 0x1600,
    kBSP = 0x1700,
    kBST = 0x1900,
    kCST = 0x1A00,
    kBSD = 0x1C00,
    kCSD = 0x1D00,
    kBEM = 0x1E00,
    kCEM = 0x1F00,
    kDM1 = 0x2000,
    kDM2 = 0x2100,
    kDM3 = 0x2200,
    kDM4 = 0x2300,
    kDM5 = 0x2400,
    kDM6 = 0x2500,
    kCHM = 0x2600,
    kBHM = 0x2700
  };
  
  dword msStartOfChargingMS = 0;
  msTimer tmrUpdateStatus;
  msTimer tmrUpdatePanel;
  double outputEnergy;
  word lastChargerStatus;
  char gPanelName[8] = "Charger";
  enum eMode
  {
    Ready = 0,
    Charging = 1,
    Error = 2
  };
  
  enum eMode Mode = Ready;
  msTimer openHVonMeasurementStop;
  const deferStopTime = 500;
}


on start 
{
  long color;
  GBT27930IL_InitAsCharger();
  GBT27930IL_TolerateDeviation(1, 0);
  HV_source_reset();
  CHA_open_close_S(CLOSE);
  CHA_set_auxiliary_voltage(0.0);
  CHA_set_voltage_CP1(6.0);
  HV_open_close_K1K2(OPEN);
  CHA_open_close_K3K4(OPEN);
  lastChargerStatus = 0;

  $CSD::ChargerNo = $CRM::ChargerNumber;
  //GBT27930IL_DisableMsg(CHM);
}

on preStop
{
  SetChargingStationPicturesVisibility(Ready); 
  deferStop(1000);
  setTimer(openHVonMeasurementStop, deferStopTime); // delay to ensure reduce of current and voltage
  HV_source_reset();
}

on timer openHVonMeasurementStop
{
  CHA_set_auxiliary_voltage(0.0);
  CHA_set_voltage_CP1(6.0);
  CHA_open_close_S(CLOSE);
  HV_open_close_K1K2(OPEN);
  CHA_open_close_K3K4(OPEN);
}

on sysvar GBT27930::svStart
{
  if(@this == 1)
  {  
    GBT27930IL_StopChargingSimulation();
    HV_source_reset();
    CHA_set_auxiliary_voltage(0.0);
    Disconnect_CAN();
    HV_open_close_K1K2(OPEN);
    CHA_open_close_K3K4(OPEN);
    CHA_open_Close_S(OPEN); //Plug-out starting
    CHA_set_voltage_CP1(6.0); //T19
    CHA_set_voltage_CP1(12.0); //T20
    CHA_open_close_S(CLOSE); //Plug-out completed
    CHA_set_voltage_CP1(6.0); //T21
    Disconnect_CC1();
    Disconnect_CC2();
    disconnect_resistances();
  }
  else
  {
    //Reset / clean start of relays
    HV_open_close_K1K2(OPEN);
    CHA_open_close_K3K4(OPEN);
    CHA_open_close_S(CLOSE);
        
    CHA_set_voltage_CP1(12.0); //T0
    SetDelayTransition();
    SetMaxAllowedMissingTime();
    GBT27930IL_StartChargingSimulation();
	GBT27930IL_SetCommunicationState(2);
    CHA_open_close_S(OPEN); //Plug-in starting
    CHA_set_voltage_CP1(6.0); //T1
    CHA_open_close_S(CLOSE); //Plug-in completed
    CHA_set_voltage_CP1(4.0); //T2
    
    CHA_set_resistance_R1(cRes_R1);
    CHA_set_resistance_R2(cRes_R2);
    CHA_set_resistance_R3(cRes_R3);
    
    Connect_CC2();
    Connect_CC1();
    
    CHA_open_close_K3K4(CLOSE); //T3
    
    msStartOfChargingMS = 0;
    outputEnergy = $CSD::OutputEnergy.phys = 0;
    setTimer(tmrUpdatePanel, 100);
    ResetAllGroups();
    SetChargingStationPicturesVisibility(Charging);
    CHA_set_auxiliary_voltage(cAux_voltage);
    Connect_CAN();
  }
}


void ResetAllGroups()
{
  setDefaultControlColors("Charger", "groupCHM");
  setDefaultControlColors("Charger", "groupCRM");
  setDefaultControlColors("Charger", "groupCML");
  setDefaultControlColors("Charger", "groupCTS");
  setDefaultControlColors("Charger", "groupCRO");
  setDefaultControlColors("Charger", "groupCCS");
  setDefaultControlColors("Charger", "groupCST");
  setDefaultControlColors("Charger", "groupCEM");
  setDefaultControlColors("Charger", "groupCSD");
}

on timer tmrUpdatePanel
{
  dword chargerStatus;
  long clrInactive, clrActive, clrChanging, clrBackActive;
  clrInactive = MakeRGB(0,0,0);
  clrActive = MakeRGB(0, 128, 0);
  clrChanging = MakeRGB(128, 0, 0);
  clrBackActive = MakeRGB(224, 224, 255);
  
  
  chargerStatus = GBT27930IL_GetCommunicationState();
  if(lastChargerStatus != chargerStatus)
  {
    switch(chargerStatus)
    {
      case 1: //Sending of CHM
        setControlForeColor("Charger", "groupCHM"   , clrActive);
        setControlBackColor("Charger", "groupCHM"   , clrBackActive);        
        break;
        
      case 2: //Sending of CHM; delayed start of CRM (BMS is not recognized) is initiated
        setControlForeColor("Charger", "groupCHM"   , clrChanging);
        setControlBackColor("Charger", "groupCHM"   , clrBackActive);
        break;
        
      case 3: //Sending of CRM (BMS is not recognized)
        setDefaultControlColors("Charger", "groupCHM");

        setControlForeColor("Charger", "groupCRM"   , clrActive);
        setControlBackColor("Charger", "groupCRM"   , clrBackActive);
        HV_open_close_K1K2(CLOSE); //T13
        break;

      case 4: //Sending of CRM (BMS is not recognized); delayed start of CRM (BMS is recognized) is initiated
      case 5: //Sending of CRM (BMS is recognized)
        break;

      case 6: //Sending of CRM (BMS is recognized); delayed start of CML is initiated
        setControlForeColor("Charger", "groupCRM"   , clrChanging);
        setControlBackColor("Charger", "groupCRM"   , clrBackActive);
        break;
        
      case 7: //Sending of CML
        setDefaultControlColors("Charger", "groupCRM");

        setControlForeColor("Charger", "groupCML"   , clrActive);
        setControlBackColor("Charger", "groupCML"   , clrBackActive);
        setControlForeColor("Charger", "groupCTS"   , clrActive);
        setControlBackColor("Charger", "groupCTS"   , clrBackActive);
        break;

      case 8: //Sending of CML; delayed start of CRO (Not ready for charging) is initiated
        setControlForeColor("Charger", "groupCML"   , clrChanging);
        setControlBackColor("Charger", "groupCML"   , clrBackActive);
        setControlForeColor("Charger", "groupCTS"   , clrChanging);
        setControlBackColor("Charger", "groupCTS"   , clrBackActive);
        break;
        
      case 9: //Sending of CRO (Not ready for charging); delayed start of CRO (Ready for charging) is initiated
        setDefaultControlColors("Charger", "groupCML");
        setDefaultControlColors("Charger", "groupCTS");

        setControlForeColor("Charger", "groupCRO"   , clrActive);
        setControlBackColor("Charger", "groupCRO"   , clrBackActive);
        break;
        
      case 10: //Sending of CRO (Ready for charging)
        HV_open_close_K1K2(CLOSE);
        break;
        
      case 11: //Sending of CRO (Ready for charging); delayed start of CCS is initiated
        setControlForeColor("Charger", "groupCRO"   , clrChanging);
        setControlBackColor("Charger", "groupCRO"   , clrBackActive);
        break;

      case 12: //Sending of CCS
        setDefaultControlColors("Charger", "groupCRO");
        
        setControlForeColor("Charger", "groupCCS"   , clrActive);
        setControlBackColor("Charger", "groupCCS"   , clrBackActive);
        break;

      case 13: //Sending of CCS; delayed start of CST is initiated
        setControlForeColor("Charger", "groupCCS"   , clrChanging);
        setControlBackColor("Charger", "groupCCS"   , clrBackActive);
        break;
        
      case 14: //Sending of CST
        setDefaultControlColors("Charger", "groupCCS");

        setControlForeColor("Charger", "groupCST"   , clrActive);
        setControlBackColor("Charger", "groupCST"   , clrBackActive);
        StartTimerReadyToOpen_K1_K2(100);
        break;
        
      case 15: //Sending of CST; delayed start of CSD is initiated
        setControlForeColor("Charger", "groupCST"   , clrChanging);
        setControlBackColor("Charger", "groupCST"   , clrBackActive);
        StartTimerReadyToOpen_K1_K2(100);
        break;
        
      case 16: //Sending of CSD; delayed stop of CSD is initiated 
        setDefaultControlColors("Charger", "groupCST");

        setControlForeColor("Charger", "groupCSD"   , clrActive);
        setControlBackColor("Charger", "groupCSD"   , clrBackActive);
        break;

      case 17: //End of charging
        setDefaultControlColors("Charger", "groupCSD");
        HV_source_reset();
        if(CHA_measure_voltage_CP1() != 4)
          StartTimerReadyToOpen_K1_K2(50);
        else
          StartTimerReadyToOpen_K1_K2(100);
        CHA_open_close_K3K4(OPEN);
        break;
        
      case 50: //Sending of CEM
        ResetAllGroups();
        setControlForeColor("Charger", "groupCEM"   , clrActive);
        setControlBackColor("Charger", "groupCEM"   , clrBackActive);
        break;
    }
    lastChargerStatus = chargerStatus;
  }  
  setTimer(tmrUpdatePanel, 100);
}

SetMaxAllowedMissingTime()
{
  GBT27930IL_SetMaxAllowedMissingTimeForMsg(brm        , @GBT27930::Charger::MaxAllowedMissingTime::svBRM);
  GBT27930IL_SetMaxAllowedMissingTimeForMsg(bcp        , @GBT27930::Charger::MaxAllowedMissingTime::svBCP);
  GBT27930IL_SetMaxAllowedMissingTimeForMsg(broNotReady, @GBT27930::Charger::MaxAllowedMissingTime::svBRO_NotReady);
  GBT27930IL_SetMaxAllowedMissingTimeForMsg(broReady   , @GBT27930::Charger::MaxAllowedMissingTime::svBRO_Ready);
  GBT27930IL_SetMaxAllowedMissingTimeForMsg(bcl        , @GBT27930::Charger::MaxAllowedMissingTime::svBCL);
  GBT27930IL_SetMaxAllowedMissingTimeForMsg(bcs        , @GBT27930::Charger::MaxAllowedMissingTime::svBCS);
  GBT27930IL_SetMaxAllowedMissingTimeForMsg(bst        , @GBT27930::Charger::MaxAllowedMissingTime::svBST);
  GBT27930IL_SetMaxAllowedMissingTimeForMsg(bsd        , @GBT27930::Charger::MaxAllowedMissingTime::svBSD);
}

on sysvar GBT27930::Charger::svSuspendCharging
{
  if(@this == 1)
  {
    GBT27930IL_SuspendCharging();
    SetChargingStationPicturesVisibility(Error);
  }
}

on sysvar GBT27930::Charger::svSuspendCharging2
{
  if(@this == 0)
    return;
  
  //1. Set whole payload to 0x00
  $CST::ConditionReached          = 0;
  $CST::SuspendsArtificially       = 0;
  $CST::FaultSuspension           = 0;
  $CST::BmsActivelySuspends       = 0;
  $CST::ChargerOverTemp           = 0;
  $CST::ChargingConnectorFault    = 0;
  $CST::ChargerIntPartOverTemp    = 0;
  $CST::CannotSupplyReqElQuantity = 0;
  $CST::SuddenStop                = 0;
  $CST::OtherFault                = 0;
  $CST::CurrentMismatchError      = 0;
  $CST::AbnormalVoltageError      = 0;

  //2. Set selected signal to "1"
  switch(@GBT27930::Charger::svCauseOfSuspendingCharging)
  {
    case 1  : $CST::ConditionReached          = 1; break;
    case 2  : $CST::SuspendsArtificially      = 1; break;
    case 3  : $CST::FaultSuspension           = 1; break;
    case 4  : $CST::BmsActivelySuspends       = 1; break;
    case 5  : $CST::ChargerOverTemp           = 1; break;
    case 6  : $CST::ChargingConnectorFault    = 1; break;
    case 7  : $CST::ChargerIntPartOverTemp    = 1; break;
    case 8  : $CST::CannotSupplyReqElQuantity = 1; break;
    case 9  : $CST::SuddenStop                = 1; break;
    case 10 : $CST::OtherFault                = 1; break;
    case 11 : $CST::CurrentMismatchError      = 1; break;
    case 12 : $CST::AbnormalVoltageError      = 1; break;
  }  
  //3. Suspend charging (start sending of CST)
  GBT27930IL_SuspendCharging();
  SetChargingStationPicturesVisibility(Error);
}

on sysvar GBT27930::Charger::svStopChargingWithError
{
  if(@this == 1)
  {
    GBT27930IL_SetCommunicationState(50); //Send Charger Error Message
    SetChargingStationPicturesVisibility(Error);
  }
  else
  {
    GBT27930IL_SetCommunicationState(17); //End of Charging
    SetChargingStationPicturesVisibility(Ready);
  }
  
  HV_source_reset();
}

on sysvar GBT27930::Charger::svStopChargingWithError2
{
  if(@this == 1)
  {  
    //1. Set whole payload to 0x00
    $CEM::Timeout_BRM = 0;
    $CEM::Timeout_BCP = 0;
    $CEM::Timeout_BRO = 0;
    $CEM::Timeout_BCS = 0;
    $CEM::Timeout_BCL = 0;
    $CEM::Timeout_BST = 0;
    $CEM::Timeout_BSD = 0;
    
    //2. Set selected signal to "1"
    switch(@GBT27930::Charger::svTimeoutOfMsg)
    {
      case 1: $CEM::Timeout_BRM = 1; break;
      case 2: $CEM::Timeout_BCP = 1; break;
      case 3: $CEM::Timeout_BRO = 1; break;
      case 4: $CEM::Timeout_BCS = 1; break;
      case 5: $CEM::Timeout_BCL = 1; break;
      case 6: $CEM::Timeout_BST = 1; break;
      case 7: $CEM::Timeout_BSD = 1; break;
    }
    
    //3. Send Charger Error Message
    GBT27930IL_SetCommunicationState(50); 
    SetChargingStationPicturesVisibility(Error);
  }
  else
  {
    GBT27930IL_SetCommunicationState(17); //End of Charging
    SetChargingStationPicturesVisibility(Ready);
  }
  
  HV_source_reset();
}

on sysvar_update GBT27930::Charger::svChargerLocation
{
  char buf[4];
  dword textAsDWord;

  sysGetVariableString(this, buf, elcount(buf));
  textAsDWord = (buf[0] << 0) + (buf[1] << 8) + (buf[2] << 16);
  $CRM::ChargerLocation = textAsDWord;
}

void SetDelayTransition()
{
  GBT27930IL_SetDelayForStateTransition(k3k4_to_chm,               0); // not valid in GB/T 27930-2011
  GBT27930IL_SetDelayForStateTransition(bhm_to_crmNotRecognized,   @GBT27930::Charger::DelayTransition::svK3K4_to_CRM_not_recognized); // Adjust for GB/T 27930-2011
  GBT27930IL_SetDelayForStateTransition(brm_to_crmRecognized,      @GBT27930::Charger::DelayTransition::svBRM_to_CRMrecognized);
  GBT27930IL_SetDelayForStateTransition(bcp_to_cml,                @GBT27930::Charger::DelayTransition::svBCP_to_CML);
  GBT27930IL_SetDelayForStateTransition(broReady_to_croNotReady,   @GBT27930::Charger::DelayTransition::svBRO_ready_to_CRO_not_ready);
  GBT27930IL_SetDelayForStateTransition(croNotReady_to_croReady,   @GBT27930::Charger::DelayTransition::svCRO_not_ready_to_CRO_ready);
  GBT27930IL_SetDelayForStateTransition(bcs_to_ccs,                @GBT27930::Charger::DelayTransition::svBCS_to_CCS);
  GBT27930IL_SetDelayForStateTransition(bst_to_cst,                @GBT27930::Charger::DelayTransition::svBST_to_CST);
  GBT27930IL_SetDelayForStateTransition(bsd_to_csd,                @GBT27930::Charger::DelayTransition::svBSD_to_CSD);
  GBT27930IL_SetDelayForStateTransition(csd_to_end,                @GBT27930::Charger::DelayTransition::svCSD_to_End);
}

///////////////////////////
on timer tmrUpdateStatus
{
  double additionalEnergy;
  SetCCS();
  
  $CSD::CumulativeChargingTime = $CCS::CumulativeChargingTime;
  
  additionalEnergy = abs($CCS::CurrentOutputValue.phys * $CCS::VoltageOutputValue.phys)/3600000.0;
  outputEnergy = outputEnergy + additionalEnergy;
  @GBT27930::Charger::svCalculatedOutputEnergy = @GBT27930::Charger::svCalculatedOutputEnergy + additionalEnergy;
  $CSD::OutputEnergy.phys = outputEnergy;
  
  if(GBT27930IL_GetCommunicationState() == 12) //sending of CCS
    setTimer(tmrUpdateStatus, 1000);
}

on pg *
{
  if(this.PGN == CRM.PGN)
  {
    $CCS::CumulativeChargingTime = 0;
  }
  else if(this.pgn == CCS.PGN && msStartOfChargingMS == 0)
  {
    msStartOfChargingMS = timeNow() / 100;
    SetCCS();
    setTimer(tmrUpdateStatus, 1000);
  }
}

void SetCCS()
{
  double delta ;
  
  $CCS::CumulativeChargingTime = (timeNow() / 100 - msStartOfChargingMS) / 60000;

  delta = getSignal(BCL::VoltageDemand) * (random(100)/ 10000.0 - 0.01);
  $CCS::VoltageOutputValue.phys = (($CCS::VoltageOutputValue.phys + getSignal(BCL::VoltageDemand)) / 2)* (0.995 + random(100)/ 10000.0);
  
  delta = getSignal(BCL::CurrentDemand) * (random(100)/ 10000.0 - 0.01);
  $CCS::CurrentOutputValue.phys = (($CCS::CurrentOutputValue.phys + getSignal(BCL::CurrentDemand)) / 2)* (0.995 + random(100)/ 10000.0);
}

long GBT27930IL_OnRxMessage(pg * rxPG)
{
  if(rxPG.PGN == 0x1E00)//BMS Error message, CEM
  {
    GBT27930IL_SetCommunicationState(17); //End of charging
    SetChargingStationPicturesVisibility(Error);
  }
  return 1;
}

on sysvar GBT27930::Charger::svInterruptCCS
{
  if(@this == 1)
  {
    GBT27930IL_BlockTxMessage(0x1200, 0xFFFFFFFF, 0,0);
  }
  else
  {
    GBT27930IL_ResetBlockedTxMessage(0x1200, 0xFFFFFFFF, 0,0);  
  }
}

on key 'n'
{
  if(@GBT27930::svStart == 0)
  {
    @GBT27930::svStart = 1;
  }
  else
  {
    @GBT27930::svStart = 0;
  }
}

void SetChargingStationPicturesVisibility(int Mode)
{
  If(Mode == Ready)
  {
   SetControlVisibility(gPanelName, "pictureChargingStationReady", 1);
   SetControlVisibility(gPanelName, "pictureChargingStationCharging", 0);
   SetControlVisibility(gPanelName, "pictureChargingStationError", 0);
  }
  else If(Mode == Charging)
  {
   SetControlVisibility(gPanelName, "pictureChargingStationReady", 0);
   SetControlVisibility(gPanelName, "pictureChargingStationCharging", 1);
   SetControlVisibility(gPanelName, "pictureChargingStationError", 0);
  }
  else If(Mode == Error)
  {
   SetControlVisibility(gPanelName, "pictureChargingStationReady", 0);
   SetControlVisibility(gPanelName, "pictureChargingStationCharging", 0);
   SetControlVisibility(gPanelName, "pictureChargingStationError", 1);
  }
}

on pg kBCL
{
  int chargingMode;
  double voltage, current;
  voltage = this.word(0) / 10;          // Data resolution: 0.1V/bit, 0V offset
  current = (this.word(2) / 10.0) - 400;  // Data resolution: 0.1A/bit, -400A offset
  chargingMode = this.byte(4);
  if(chargingMode == 1)                   // Constant Voltage
  {
    HV_source_set_U_DC(voltage);
    HV_source_set_I_DC((double)$Charger::CML::MaxOutputCurrent);
  }
  else if(chargingMode == 2)              // Constant Current
  {
    HV_source_set_I_DC(current);
    HV_source_set_U_DC((double)$Charger::CML::MaxOutputVoltage);
  }
}