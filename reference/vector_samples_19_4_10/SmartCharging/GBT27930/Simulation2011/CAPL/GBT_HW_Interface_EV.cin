/*@!Encoding:1252*/

variables
{
  //for switching relays
  const int OPEN = 0;
  const int CLOSE = 1;
  const float cRes_R4 = 1000.0;
  const float cRes_R5 = 1000.0;
  
  msTimer tTimeoutReadyToOpen_K5_K6;
  msTimer tCurrentMonitoring;
}

on timer tCurrentMonitoring
{
  if(_CheckCanBeOpened_K5_K6_() == 1)
  {
    CHA_open_close_K5K6(OPEN);
    cancelTimer(tTimeoutReadyToOpen_K5_K6);
    writeLineEx(-3, 3, "Current < 5A measured, opening K5_K6 now");
  }
  
  if(isTimerActive(tTimeoutReadyToOpen_K5_K6))
    tCurrentMonitoring.set(5); //Check again in 5ms
}

on timer tTimeoutReadyToOpen_K5_K6
{
  writeLineEx(-3, 3, "Current value >= 5A measured (value: %f), K5_K6 could not be opened within timeout. Opening now", HV_measure_DC_I());
  CHA_open_close_K5K6(OPEN);
}

long _CheckCanBeOpened_K5_K6_()
{
  if(HV_measure_DC_I() < 5.0)
    return 1;
  
  return 0;
}

export void StartTimerReadyToOpen_K5_K6(long timeoutMs)
{
  if(_CheckCanBeOpened_K5_K6_() == 1)
  {
    CHA_open_close_K5K6(OPEN);
    writeLineEx(-3, 3, "K5_K6 can be opened immediately");
  }
  else
  {
    if(!isTimerActive(tTimeoutReadyToOpen_K5_K6))
      setTimer(tTimeoutReadyToOpen_K5_K6, timeoutMs);
    setTimer(tCurrentMonitoring, 5);
  }
}

on sysvar_update sysvar::VTS::EV_VT2004_Ch2_CC2::CurVoltage
{
  @sysvar::GBT27930::Control::voltage_CP2 = @sysvar::VTS::EV_VT2004_Ch2_CC2::CurVoltage;
}

export void VT2004_busBar_default()
{
  // ensure that not bus bar of the VT2004 is swapped
  @sysvar::VTS::EV_VT2004_ChaoJi::RelaySwapBusBar2A = 0;
  @sysvar::VTS::EV_VT2004_ChaoJi::RelaySwapBusBar2B = 0;
  @sysvar::VTS::EV_VT2004_ChaoJi::RelaySwapBusBar1A = 0;
  @sysvar::VTS::EV_VT2004_ChaoJi::RelaySwapBusBar1B = 0;
}

export void disconnect_resistances()
{
  sysvar::VTS::EV_VT2004_Ch1.SetStimulationMode(eVTSStimulationModeNone);
  sysvar::VTS::EV_VT2004_Ch2_CC2.SetStimulationMode(eVTSStimulationModeNone);
  sysvar::VTS::EV_VT2004_Ch3_CC1.SetStimulationMode(eVTSStimulationModeNone);
  sysvar::VTS::EV_VT2004_Ch4.SetStimulationMode(eVTSStimulationModeNone);
}

//--------------------------------------------- functions of the GBT HW interface ----------------------------------------------------------------------

export void Connect_CAN()
{
  //CAN connection handling is not needed for VT wiring
}

export void Disconnect_CAN()
{
  //CAN connection handling is not needed for VT wiring
}

//Connects to the bus bar (PE); connects R4 to Charger via CC1
export void Connect_CC1()
{
  @sysvar::VTS::EV_VT2004_Ch3_CC1::RelayOrgSensor = 0;
  @sysvar::VTS::EV_VT2004_Ch3_CC1::RelayShortCircuit = 0;
  @sysvar::VTS::EV_VT2004_Ch3_CC1::RelayBusBar1A = 0;
  @sysvar::VTS::EV_VT2004_Ch3_CC1::RelayBusBar1B = 0;
  @sysvar::VTS::EV_VT2004_Ch3_CC1::RelayBusBar2A = 0;
  @sysvar::VTS::EV_VT2004_Ch3_CC1::RelayBusBar2B = 1;
  sysvar::VTS::EV_VT2004_Ch3_CC1.SetStimulationMode(eVTSStimulationModeResistanceGreater);
  @sysvar::VTS::EV_VT2004_Ch3_CC1::Resistor = 1000;
}

export void Disconnect_CC1()
{
  @sysvar::VTS::EV_VT2004_Ch3_CC1::RelayOrgSensor = 0;
  @sysvar::VTS::EV_VT2004_Ch3_CC1::RelayShortCircuit = 0;
  @sysvar::VTS::EV_VT2004_Ch3_CC1::RelayBusBar1A = 0;
  @sysvar::VTS::EV_VT2004_Ch3_CC1::RelayBusBar1B = 0;
  @sysvar::VTS::EV_VT2004_Ch3_CC1::RelayBusBar2A = 0;
  @sysvar::VTS::EV_VT2004_Ch3_CC1::RelayBusBar2B = 1;
}

//Connects to the bus bar to provide 12 V; connects R5 to charger via CC2 and sets the resistance
export void Connect_CC2()
{
  @sysvar::VTS::EV_VT2004_Ch2_CC2::RelayOrgSensor = 0;
  @sysvar::VTS::EV_VT2004_Ch2_CC2::RelayShortCircuit = 0;
  @sysvar::VTS::EV_VT2004_Ch2_CC2::RelayBusBar1A = 1;
  @sysvar::VTS::EV_VT2004_Ch2_CC2::RelayBusBar1B = 0;
  @sysvar::VTS::EV_VT2004_Ch2_CC2::RelayBusBar2A = 0;
  @sysvar::VTS::EV_VT2004_Ch2_CC2::RelayBusBar2B = 0;
  sysvar::VTS::EV_VT2004_Ch2_CC2.SetStimulationMode(eVTSStimulationModeResistanceGreater);
  @sysvar::VTS::EV_VT2004_Ch2_CC2::Resistor = 1000;
}


export void Disconnect_CC2()
{
  @sysvar::VTS::EV_VT2004_Ch2_CC2::RelayOrgSensor = 0;
  @sysvar::VTS::EV_VT2004_Ch2_CC2::RelayShortCircuit = 0;
  @sysvar::VTS::EV_VT2004_Ch2_CC2::RelayBusBar1A = 0;
  @sysvar::VTS::EV_VT2004_Ch2_CC2::RelayBusBar1B = 0;
  @sysvar::VTS::EV_VT2004_Ch2_CC2::RelayBusBar2A = 0;
  @sysvar::VTS::EV_VT2004_Ch2_CC2::RelayBusBar2B = 0;
}


export void BMS_set_voltage_CP2(double voltage)
{  
  if(isSimulated())
    @sysvar::GBT27930::Control::voltage_CP2 = voltage;
  //else
    //voltage is currently taken from VT power supply and cannot be changed
}

export double BMS_measure_voltage_CP2()
{
  return @sysvar::GBT27930::Control::voltage_CP2;
}

export void BMS_set_resistance_R4(double resistance)
{
  if(resistance < 1)
    sysvar::VTS::EV_VT2004_Ch3_CC1.SetStimulationMode(eVTSStimulationModeNone);
  else
    sysvar::VTS::EV_VT2004_Ch3_CC1.SetStimulationMode(eVTSStimulationModeResistanceGreater);
  
  @sysvar::VTS::EV_VT2004_Ch3_CC1::Resistor = resistance;  
////  writeEx(-3,3, "Test system: CHA_set_resistance_R4 called: %d Ohms", resistance);
}


export void BMS_set_resistance_R5(double resistance)
{
  if(resistance < 1)
    sysvar::VTS::EV_VT2004_Ch2_CC2.SetStimulationMode(eVTSStimulationModeNone);
  else
    sysvar::VTS::EV_VT2004_Ch2_CC2.SetStimulationMode(eVTSStimulationModeResistanceGreater);
  
  @sysvar::VTS::EV_VT2004_Ch2_CC2::Resistor = resistance;  
////  writeEx(-3,3, "Test system: CHA_set_resistance_R5 called: %d Ohms", resistance);
}


export double BMS_measure_auxiliary_voltage()
{
  //Not part of the VT setup, hence only return variable
  return @sysvar::GBT27930::Control::auxiliary_voltage;
}

//not part of communication tests
export long HV_measure_DC_U()
{
  return @sysvar::GBT27930::Control::HV_DC_Voltage;
}

//not part of communication tests
export long HV_measure_DC_I()
{
  return @sysvar::GBT27930::Control::HV_DC_Current;
}

//not part of communication tests
export double HV_measure_DC_P()
{
  return 0;
}

//not part of communication tests
export long HV_source_set_U_DC(double voltage)
{
  return 0;
}

//not part of communication tests
export long HV_source_set_I_DC(double current)
{
  return 0;
}

export void HV_source_reset()
{
  HV_source_set_U_DC(0);
  HV_source_set_I_DC(0);
}

export void CHA_open_close_K5K6(int openClose)
{  
  writeEx(-3,3, "Test system: CHA_open_close_K5K6 called, openClose %d", openClose);
}