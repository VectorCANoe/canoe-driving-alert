/*@!Encoding:1252*/
includes
{
  #include "GBT_HW_Interface_EV.cin"
}

variables
{
  enum DelayTransition
  {
    chm_to_bhm              = 0,
    crmNotRecognized_to_brm = 1,
    crmRecognized_to_bcp    = 2,
    cml_to_broNotReady      = 3,
    broNotReady_to_broReady = 4,
    croReady_to_bcl         = 5,
    bcl_to_bcl_bcs          = 15,
    ccs_to_bcl_bcs_bsm      = 6, 
    
    cst_to_bsd              = 16,//BMS suspends charging 
    
    cst_to_bst              = 7, //Charger suspends charging
    bst_to_bsd              = 8, //Charger suspends charging
    
    bsd_to_end              = 9
  };
  
  enum AllowedMissingTime
  {
    crm_not_recognized  = 0,
    crm_recognized      = 1,
    cml                 = 2,
    cro_not_ready       = 3,
    cro_ready           = 4,
    ccs                 = 5,
    cst                 = 6,
    csd                 = 7, 
    chm                 = 8
  };

  dword msStartOfChargingMS = 0;
  msTimer tmrUpdateStatus;
  msTimer tmrUpdatePanel;
  double inputEnergy;
  word lastChargerStatus;
}

on start
{
  long color;
  
  GBT27930IL_InitAsBMS();
  GBT27930IL_TolerateDeviation(1, 0);
//  GBT27930IL_DisableMsg(BHM);
  lastChargerStatus = 0;
  CHA_open_close_K5K6(OPEN);
  HV_source_reset();
  BMS_set_voltage_CP2(12.0);
}

on preStop
{
  HV_source_reset(); 
  CHA_open_close_K5K6(OPEN);
  BMS_set_voltage_CP2(12.0);
}

on sysvar GBT27930::svStart
{
  if(@this == 1)
  {
    GBT27930IL_StopChargingSimulation();
    BMS_set_voltage_CP2(12.0);
    Disconnect_CC1();
    Disconnect_CC2();
    Disconnect_CAN();
    disconnect_resistances();
    HV_source_reset();
    CHA_open_close_K5K6(OPEN);
  }
  else
  {
    //Reset / clean start of relays
    CHA_open_close_K5K6(OPEN);
    
    BMS_set_voltage_CP2(6.0);
    
    writeEx(-3, 3, "K3 and K4 are closed");
    SetDelayTransition();
    SetMaxAllowedMissingTime();
    VT2004_busBar_default();
    
    BMS_set_resistance_R4(cRes_R4);
    BMS_set_resistance_R5(cRes_R5);
    GBT27930IL_StartChargingSimulation();
	GBT27930IL_SetCommunicationState(3);
    Connect_CC1();
    Connect_CC2();
    Set_BMS_ManufacturereName();
    setTimer(tmrUpdatePanel, 100);
    ResetAllGroups();
    Connect_CAN();
  }
}

void ResetAllGroups()
{
  setDefaultControlColors("BMS", "groupBHM");
  setDefaultControlColors("BMS", "groupBRM");
  setDefaultControlColors("BMS", "groupBCP");
  setDefaultControlColors("BMS", "groupBRO");
  setDefaultControlColors("BMS", "groupBCL");
  setDefaultControlColors("BMS", "groupBCS");
  setDefaultControlColors("BMS", "groupBSM");
  setDefaultControlColors("BMS", "groupBST");
  setDefaultControlColors("BMS", "groupBSD");
}


on timer tmrUpdatePanel
{
  dword chargerStatus;
  long clrInactive, clrActive, clrChanging, clrBackActive;
  clrInactive = MakeRGB(0,0,0);
  clrActive = MakeRGB(0, 128, 0);
  clrChanging = MakeRGB(128, 0, 0);
  clrBackActive = MakeRGB(224, 224, 255);
  
  
  chargerStatus = GBT27930IL_GetCommunicationState();
  if(lastChargerStatus != chargerStatus)
  {
    switch(chargerStatus)
    {
      case 3: //Sending of BHM
        setControlForeColor("BMS", "groupBHM"   , clrActive);
        setControlBackColor("BMS", "groupBHM"   , clrBackActive);
        break;
        
      case 4: //Sending of BHM; delayed start of BRM is initiated
        setControlForeColor("BMS", "groupBHM"   , clrChanging);
        setControlBackColor("BMS", "groupBHM"   , clrBackActive);
        break;
        
      case 5: //Sending of BRM 
        setDefaultControlColors("BMS", "groupBHM");

        setControlForeColor("BMS", "groupBRM"   , clrActive);
        setControlBackColor("BMS", "groupBRM"   , clrBackActive);
        break;

      case 6: //Sending of BRM; delayed start of BCP is initiated
        setControlForeColor("BMS", "groupBRM"   , clrChanging);
        setControlBackColor("BMS", "groupBRM"   , clrBackActive);
        break;
        
        
      case 7: //Sending of BCP
        setDefaultControlColors("BMS", "groupBRM");

        setControlForeColor("BMS", "groupBCP"   , clrActive);
        setControlBackColor("BMS", "groupBCP"   , clrBackActive);
        break;

      case 8: //Sending of BCP; delayed start of BRO (Not ready) is initiated
        setControlForeColor("BMS", "groupBCP"   , clrChanging);
        setControlBackColor("BMS", "groupBCP"   , clrBackActive);
        break;
        
      case 9: //Sending of BRO (Not Ready for charging); delayed start of BRO (Ready for charging) is initiated
        setDefaultControlColors("BMS", "groupBCP");

        setControlForeColor("BMS", "groupBCP"   , clrActive);
        setControlBackColor("BMS", "groupBCP"   , clrBackActive);
        CHA_open_close_K5K6(CLOSE); //T12
        break;

      case 10: //Sending of BRO(Ready for charging)
        setControlForeColor("BMS", "groupBRO"   , clrActive);
        setControlBackColor("BMS", "groupBRO"   , clrBackActive);
        break;
        
      case 11: //Sending of BRO (Ready for charging); delayed start of BCL is initiated
        setControlForeColor("BMS", "groupBRO"   , clrChanging);
        setControlBackColor("BMS", "groupBRO"   , clrBackActive);
        break;
        
      case 30: //Sending of BCL
        setDefaultControlColors("BMS", "groupBRO");

        setControlForeColor("BMS", "groupBCL"   , clrActive);
        setControlBackColor("BMS", "groupBCL"   , clrBackActive);
        break;        
        
      case 31: //Sending of BCL; delayed start of BCS is initiated
        setDefaultControlColors("BMS", "groupBRO");

        setControlForeColor("BMS", "groupBCL"   , clrActive);
        setControlBackColor("BMS", "groupBCL"   , clrBackActive);
        break;        
        
      case 12: //Sending of BCL und BCS
      case 13: //Sending of BCL und BCS; delayed start of BSM is initiated
        setDefaultControlColors("BMS", "groupBRO");

        setControlForeColor("BMS", "groupBCL"   , clrActive);
        setControlBackColor("BMS", "groupBCL"   , clrBackActive);
        setControlForeColor("BMS", "groupBCS"   , clrActive);
        setControlBackColor("BMS", "groupBCS"   , clrBackActive);
        break;

      case 14: //Sending of BCL, BCS and BSM
        setControlForeColor("BMS", "groupBCL"   , clrActive);
        setControlBackColor("BMS", "groupBCL"   , clrBackActive);
        setControlForeColor("BMS", "groupBCS"   , clrActive);
        setControlBackColor("BMS", "groupBCS"   , clrBackActive);
        setControlForeColor("BMS", "groupBSM"   , clrActive);
        setControlBackColor("BMS", "groupBSM"   , clrBackActive);
        break;

      case 15: //Sending of BCL, BCS and BSM; delayed start of BST is initiated
        setControlForeColor("BMS", "groupBCL"   , clrChanging);
        setControlBackColor("BMS", "groupBCL"   , clrBackActive);
        setControlForeColor("BMS", "groupBCS"   , clrChanging);
        setControlBackColor("BMS", "groupBCS"   , clrBackActive);
        setControlForeColor("BMS", "groupBSM"   , clrChanging);
        setControlBackColor("BMS", "groupBSM"   , clrBackActive);
        break;
        
      case 16: //Sending of BST
        setDefaultControlColors("BMS", "groupBCL");
        setDefaultControlColors("BMS", "groupBCS");
        setDefaultControlColors("BMS", "groupBSM");

        setControlForeColor("BMS", "groupBST"   , clrActive);
        setControlBackColor("BMS", "groupBST"   , clrBackActive);
        StartTimerReadyToOpen_K5_K6(300);
        break;
        
      case 17: //Sending of BST; delayed start of BSD is initiated
        setDefaultControlColors("BMS", "groupBCL");
        setDefaultControlColors("BMS", "groupBCS");
        setDefaultControlColors("BMS", "groupBSM");

        setControlForeColor("BMS", "groupBST"   , clrChanging);
        setControlBackColor("BMS", "groupBST"   , clrBackActive);
        StartTimerReadyToOpen_K5_K6(10000);
        break;
        
      case 18: //Sending of BSD; delayed stop of BSD is initiated 
        setDefaultControlColors("BMS", "groupBCL");
        setDefaultControlColors("BMS", "groupBCS");
        setDefaultControlColors("BMS", "groupBSM");
        setDefaultControlColors("BMS", "groupBST");

        setControlForeColor("BMS", "groupBSD"   , clrActive);
        setControlBackColor("BMS", "groupBSD"   , clrBackActive);
        break;

      case 19: //End of charging
        setDefaultControlColors("BMS", "groupBSD");
        break;
        
      case 50: //Sending of CEM
        ResetAllGroups();
        setControlForeColor("BMS", "groupBEM"   , clrActive);
        setControlBackColor("BMS", "groupBEM"   , clrBackActive);
        break;

    }
    lastChargerStatus = chargerStatus;
  }  
  setTimer(tmrUpdatePanel, 100);
}



SetMaxAllowedMissingTime()
{
  GBT27930IL_SetMaxAllowedMissingTimeForMsg(chm,                0); //// not valid in GB/T 27930-2011
  GBT27930IL_SetMaxAllowedMissingTimeForMsg(crm_not_recognized, @GBT27930::BMS::MaxAllowedMissingTime::svCRM_NotRecognized);
  GBT27930IL_SetMaxAllowedMissingTimeForMsg(crm_recognized,     @GBT27930::BMS::MaxAllowedMissingTime::svCRM_Recognized);
  GBT27930IL_SetMaxAllowedMissingTimeForMsg(cml,                @GBT27930::BMS::MaxAllowedMissingTime::svCML);
  GBT27930IL_SetMaxAllowedMissingTimeForMsg(cro_not_ready,      @GBT27930::BMS::MaxAllowedMissingTime::svCRO_NotReady);
  GBT27930IL_SetMaxAllowedMissingTimeForMsg(cro_ready,          @GBT27930::BMS::MaxAllowedMissingTime::svCRO_Ready);
  GBT27930IL_SetMaxAllowedMissingTimeForMsg(ccs,                @GBT27930::BMS::MaxAllowedMissingTime::svCCS);
  GBT27930IL_SetMaxAllowedMissingTimeForMsg(cst,                @GBT27930::BMS::MaxAllowedMissingTime::svCST);
  GBT27930IL_SetMaxAllowedMissingTimeForMsg(csd,                @GBT27930::BMS::MaxAllowedMissingTime::svCSD);
}

on sysvar_update GBT27930::BMS::svManufacturerName
{
  Set_BMS_ManufacturereName();
}

Set_BMS_ManufacturereName()
{
  char buf[5];
  dword textAsDWord;

  sysGetVariableString(sysvar::GBT27930::BMS::svManufacturerName, buf, elcount(buf));
  textAsDWord = (buf[0] << 0) + (buf[1] << 8) + (buf[2] << 16) + (buf[3] << 24);
  $BRM::ManufacturerName = textAsDWord;
}

long GBT27930IL_OnTxPrepare(pg* pgToSend)
{
  char buf[18];
  int pos;

  if(pgToSend.pgn == BRM.pgn && pgToSend.dlc >= 41)
  {
    sysGetVariableString(sysvar::GBT27930::BMS::svVIN, buf, elcount(buf));
    for(pos = 0; pos < 17; pos++)
    {
      pgToSend.byte(pos + 24) = buf[pos];
    }
  }
  
  return 1;
}

on sysvar GBT27930::BMS::svSuspendCharging
{
  if(@this == 1)    
    GBT27930IL_SuspendCharging();
}

on sysvar GBT27930::BMS::svSuspendCharging2
{
  if(@this == 0)
    return;
  
  //1. Set whole payload to 0x00
  $BST::AbnormalVoltageError        = 0;
  $BST::ExcessiveCurrentError       = 0;
  $BST::OtherFaults                 = 0;
  $BST::BmsConnectorOverTemp        = 0;
  $BST::BatterySetOverTemp          = 0;
  $BST::ChargingConnectorFault      = 0;
  $BST::OutputConnectorOverTemp     = 0;
  $BST::InsulationFault             = 0;
  $BST::SettingValueOfSingleVoltage = 0;
  $BST::SettingValueOfTotalVoltage  = 0;
  $BST::RequiredSocTargetValue      = 0;

  //2. Set selected signal to "1"
  switch(@GBT27930::BMS::svCauseOfSuspendingCharging)
  {
    case 1  : $BST::AbnormalVoltageError        = 1; break;
    case 2  : $BST::ExcessiveCurrentError       = 1; break;
    case 3  : $BST::OtherFaults                 = 1; break;
    case 4  : $BST::BmsConnectorOverTemp        = 1; break;
    case 7  : $BST::BatterySetOverTemp          = 1; break;
    case 8  : $BST::ChargingConnectorFault      = 1; break;
    case 9  : $BST::OutputConnectorOverTemp     = 1; break;
    case 10 : $BST::InsulationFault             = 1; break;
    case 12 : $BST::SettingValueOfSingleVoltage = 1; break;
    case 13 : $BST::SettingValueOfTotalVoltage  = 1; break;
    case 14 : $BST::RequiredSocTargetValue      = 1; break;
  }  
  //3. Suspend charging (start sending of BST)
  GBT27930IL_SuspendCharging();
}

on sysvar GBT27930::BMS::svStopChargingWithError
{
  if(@this == 1)
    GBT27930IL_SetCommunicationState(50); //Send BMS Error Message
  else
    GBT27930IL_SetCommunicationState(19); //End of Charging
}

on sysvar GBT27930::BMS::svStopChargingWithError2
{
  if(@this == 1)
  {  
    //1. Set whole payload to 0x00
    $BEM::Timeout_CRM_NotRecognized = 0;
    $BEM::Timeout_CRM_Recognized    = 0;
    $BEM::Timeout_CTS_CML           = 0;
    $BEM::Timeout_CRO               = 0;
    $BEM::Timeout_CCS               = 0;
    $BEM::Timeout_CST               = 0;
    $BEM::Timeout_CSD               = 0;
    
    //2. Set selected signal to "1"
    switch(@GBT27930::BMS::svTimeoutOfMsg)
    {
      case 1: $BEM::Timeout_CRM_NotRecognized= 1; break;
      case 2: $BEM::Timeout_CRM_Recognized   = 1; break;
      case 3: $BEM::Timeout_CTS_CML          = 1; break;
      case 4: $BEM::Timeout_CRO              = 1; break;
      case 5: $BEM::Timeout_CCS              = 1; break;
      case 6: $BEM::Timeout_CST              = 1; break;
      case 7: $BEM::Timeout_CSD              = 1; break;
    }
    
    //3. Send Charger Error Message
    GBT27930IL_SetCommunicationState(50); 
  }
  else
  {
    GBT27930IL_SetCommunicationState(19); //End of Charging
  }
}



void SetDelayTransition()
{
  GBT27930IL_SetDelayForStateTransition(chm_to_bhm,              0);  // not valid in GB/T 27930-2011
  GBT27930IL_SetDelayForStateTransition(crmNotRecognized_to_brm, @GBT27930::BMS::DelayTransition::svCRM_not_recognized_to_BRM);
  GBT27930IL_SetDelayForStateTransition(crmRecognized_to_bcp,    @GBT27930::BMS::DelayTransition::svCRM_recognized_to_BCP);
  GBT27930IL_SetDelayForStateTransition(cml_to_broNotReady,      @GBT27930::BMS::DelayTransition::svCML_to_BRO_not_ready);
  GBT27930IL_SetDelayForStateTransition(broNotReady_to_broReady, @GBT27930::BMS::DelayTransition::svBRO_not_ready_to_BRO_ready);
  GBT27930IL_SetDelayForStateTransition(croReady_to_bcl,         @GBT27930::BMS::DelayTransition::svCRO_ready_to_BCL);
  GBT27930IL_SetDelayForStateTransition(bcl_to_bcl_bcs,          @GBT27930::BMS::DelayTransition::svBCL_to_BCL_BCS);
  GBT27930IL_SetDelayForStateTransition(ccs_to_bcl_bcs_bsm,      @GBT27930::BMS::DelayTransition::svCCS_to_BSM);
  GBT27930IL_SetDelayForStateTransition(cst_to_bsd,              @GBT27930::BMS::DelayTransition::svCST_to_BSD);
  GBT27930IL_SetDelayForStateTransition(cst_to_bst,              @GBT27930::BMS::DelayTransition::svCST_to_BST);
  GBT27930IL_SetDelayForStateTransition(bst_to_bsd,              @GBT27930::BMS::DelayTransition::svBST_to_BSD);
  GBT27930IL_SetDelayForStateTransition(bsd_to_end,              @GBT27930::BMS::DelayTransition::svBSD_to_End);
}


////////////////////////////////////////////////////
on timer tmrUpdateStatus
{
  int commState;
  SetBCS();  
  $BSD::SuspendStateOfChargeSOC.phys = $BCS::CurrentChargeState.txrq;
  commState = GBT27930IL_GetCommunicationState();
  if(commState >= 12 && commState <= 14) // sending of BCL, BCS and BSM
  {
    setTimer(tmrUpdateStatus, 1000);
  }
}

on pg *
{
  if(this.pgn == BRM.PGN)
  {
    msStartOfChargingMS = 0;
      inputEnergy = 0;
      $BCS::EstimatedRemainingChargingTime.phys = 0;
      $BCS::CurrentChargeState.phys = $BCP::StatusOfCharge.phys;
  }
  else if(this.pgn == BCL.PGN)
  {
    if(msStartOfChargingMS == 0)
    {
      msStartOfChargingMS = timeNow() / 100;
      //inputEnergy = 0;
      //$BCS::EstimatedRemainingChargingTime.phys = 0;
      //$BCS::CurrentChargeState.phys = $BCP::StatusOfCharge.phys;
      setTimer(tmrUpdateStatus, 1000);
      SetBCS();  
    }
  }
}

void SetBCS()
{
  double additionalEnergy, remainingEnergy;
  double chargingTimeMinutes;
  
  $BCS::MeasuredChargingVoltage.phys = getSignal(CCS::VoltageOutputValue) * (0.99 + random(100)/5000.0);
  $BCS::MeasuredChargingCurrent.phys = getSignal(CCS::CurrentOutputValue) * (0.99 + random(100)/5000.0);
  
  additionalEnergy = abs((getSignal(CCS::VoltageOutputValue) * getSignal(CCS::CurrentOutputValue) * @GBT27930::BMS::svEfficiency / 100) / 3600000); //kWh
  inputEnergy = inputEnergy + additionalEnergy;
  $BCS::CurrentChargeState.phys = $BCP::StatusOfCharge.phys + (inputEnergy / $BCP::TotalNominalEnergy.phys) * 100;
  remainingEnergy = $BCP::TotalNominalEnergy.phys * (1.0 - $BCP::StatusOfCharge.phys/100.0) - inputEnergy;
  chargingTimeMinutes = ((timeNow() / 100) - msStartOfChargingMS) / 60000.0;
  if(inputEnergy == 0 || chargingTimeMinutes < 2)
    $BCS::EstimatedRemainingChargingTime.phys = 0;
  else
    $BCS::EstimatedRemainingChargingTime.phys = (remainingEnergy / inputEnergy) * chargingTimeMinutes;
}

long GBT27930IL_OnRxMessage(pg * rxPG)
{
  if(rxPG.PGN == 0x1F00)//Charger Error message, CEM
  {
    GBT27930IL_SetCommunicationState(19); //End of charging
  }
  return 1;
}

on sysvar GBT27930::BMS::svInterruptBCL
{
  if(@this == 1)
  {
    GBT27930IL_BlockTxMessage(0x1000, 0xFFFFFFFF, 0,0);
  }
  else
  {
    GBT27930IL_ResetBlockedTxMessage(0x1000, 0xFFFFFFFF, 0,0);  
  }
}

on sysvar GBT27930::BMS::svInterruptBCS
{
  if(@this == 1)
  {
    GBT27930IL_BlockTxMessage(0x1100, 0xFFFFFFFF, 0,0);
  }
  else
  {
    GBT27930IL_ResetBlockedTxMessage(0x1100, 0xFFFFFFFF, 0,0);  
  }
}

on sysvar GBT27930::BMS::svInterruptBSM
{
  if(@this == 1)
  {
    GBT27930IL_BlockTxMessage(0x1300, 0xFFFFFFFF, 0,0);
  }
  else
  {
    GBT27930IL_ResetBlockedTxMessage(0x1300, 0xFFFFFFFF, 0,0);  
  }
}

on sysvar_update sysvar::GBT27930::Control::auxiliary_voltage
{
  if(@this <= 0.2) //Relay for auxiliary power supply OFF (K3K4)
    CHA_open_close_K5K6(OPEN);
}

on pg CST
{
 StartTimerReadyToOpen_K5_K6(10000); 
}

on pg CEM
{
  StartTimerReadyToOpen_K5_K6(10000); 
}

on pg BEM
{
  StartTimerReadyToOpen_K5_K6(10000); 
}

on key 'n'
{
  if(@GBT27930::svStart == 0)
  {
    @GBT27930::svStart = 1;
  }
  else
  {
    @GBT27930::svStart = 0;
  }
}