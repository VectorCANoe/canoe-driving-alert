/*@!Encoding:1252*/
includes
{
  #include "GBT_HW_Interface_EV.cin"
}

variables
{
  dword msStartOfChargingMS = 0;
  msTimer tmrUpdatePanel;
  double inputEnergy;
  word currentBmsStatus;
  word lastBmsStatus;
  const double cCP2VoltageTolerance = 0.5;

  msTimer tmr_InitTimeout;
  msTimer tmr_check_CP2Voltage;
  msTimer tmr_check_auxVoltage;
  msTimer tmr_monitor_CP2Voltage;
  msTimer tmr_monitor_auxVoltage;
  msTimer tmr_resetSystem;
  dword interval_resetSystem = 1;//3000;
  long timeout_systemStartUp = 5000;
  
  dword interval_check_CP2Voltage = 100;
  dword interval_check_auxVoltage = 100;
  dword interval_monitor_CP2Voltage = 1000;
  dword interval_monitor_auxVoltage = 1000;
  
  msTimer stateTransitionTimer;
  msTimer sendCyclicBHMMessage;
  msTimer sendCyclicBRMMessage;
  msTimer sendCyclicBCPMessage;
  msTimer sendCyclicBROMessage;
  msTimer sendCyclicBCLMessage;
  msTimer sendCyclicBCSMessage;
  msTimer sendCyclicBSMMessage;
  msTimer sendCyclicBMVMessage;
  msTimer sendCyclicBMTMessage;
  msTimer sendCyclicBSPMessage;
  msTimer sendCyclicBSTMessage;
  msTimer sendCyclicBSDMessage;
  msTimer sendCyclicBEMMessage;
  
  // Message cycle time in ms
  word messageCycleTimeBHM = 250;
  word messageCycleTimeBRM = 250;
  word messageCycleTimeBCP = 500;
  word messageCycleTimeBRO = 250;
  word messageCycleTimeBCL = 50;
  word messageCycleTimeBCS = 250;
  word messageCycleTimeBSM = 250;
  word messageCycleTimeBMV = 10000; // 10s
  word messageCycleTimeBMT = 10000; // 10s
  word messageCycleTimeBSP = 10000; // 10s
  word messageCycleTimeBST = 10;
  word messageCycleTimeBSD = 250;
  word messageCycleTimeBEM = 250;
  
  enum PGN
  {
    kCRM = 0x100,
    kBRM = 0x200,
    kBCP = 0x600,
    kCTS = 0x700,
    kCML = 0x800,
    kBRO = 0x900,
    kCRO = 0xA00,
    kBCL = 0x1000,
    kBCS = 0x1100,
    kCCS = 0x1200,
    kBSM = 0x1300,
    kBMV = 0x1500,
    kBMT = 0x1600,
    kBSP = 0x1700,
    kBST = 0x1900,
    kCST = 0x1A00,
    kBSD = 0x1C00,
    kCSD = 0x1D00,
    kBEM = 0x1E00,
    kCEM = 0x1F00,
    kDM1 = 0x2000,
    kDM2 = 0x2100,
    kDM3 = 0x2200,
    kDM4 = 0x2300,
    kDM5 = 0x2400,
    kDM6 = 0x2500,
    kCHM = 0x2600,
    kBHM = 0x2700
  };
  
  enum CableState
  {
    unknown = 0,
    disconnected,
    connected
  };
  word cableStatus = unknown;
  
  double CP2_voltage_measured;
  double aux_voltage_measured;
  int checkPoint2_voltage_detected;
}

/////////////////////////////////////////////////////////////////////////////////////
/*--------------------------------------Timer--------------------------------------*/
/////////////////////////////////////////////////////////////////////////////////////

on timer stateTransitionTimer
{
  switch(currentBmsStatus)
    {
      case 1: // Waiting for the first CHM
        break;
      case 2: // BHM is initiated
        StartTimerIfNotRunning(sendCyclicBHMMessage, 0);
        break;
      case 3: // Sending of BHM
        break;
      case 4: // Stop BHM; BRM is initiated
        cancelTimer(sendCyclicBHMMessage);
        StartTimerIfNotRunning(sendCyclicBRMMessage, 0);
        break;
      case 5: // Sending of BRM
        break;
      case 6: // Stop BRM; BCP is initiated
        cancelTimer(sendCyclicBRMMessage);
        StartTimerIfNotRunning(sendCyclicBCPMessage, 0);
        break;
      case 7: // Sending of BCP
        break;
      case 8: // Stop BCP; BRO (Not ready for charging) is initiated
        cancelTimer(sendCyclicBCPMessage);
        @sysvar::GBT27930::BMS::BRO::svBMSReadyForCharging = 0x00;
        StartTimerIfNotRunning(sendCyclicBROMessage, 0);
        break;
      case 9: // Sending of BRO (Not ready for charging); BRO (Ready for charging) is initiated
        @sysvar::GBT27930::BMS::BRO::svBMSReadyForCharging = 0xAA;
        break;
      case 10: // Sending of BRO (Ready for charging)
        break;
      case 11: // Stop BRO (Ready for charging); BCL is initiated
        cancelTimer(sendCyclicBROMessage);
        StartTimerIfNotRunning(sendCyclicBCLMessage, 0);
        break;
      case 30: // Sending of BCL
        break; 
      case 31: // Sending of BCL; BCS is initiated
        StartTimerIfNotRunning(sendCyclicBCSMessage, 0);
        break; 
      case 12: // Sending of BCL and BCS
        break;
      case 13: // Sending of BCL and BCS,  BSM is initiated
        StartTimerIfNotRunning(sendCyclicBSMMessage, 0);
        break;
      case 14: // Sending of BCL, BCS and BSM; 
        break;
      case 15: // Stop BCL, BCS and BSM; delayed start of BST is initiated. 
        cancelTimer(sendCyclicBCLMessage);
        cancelTimer(sendCyclicBCSMessage);
        cancelTimer(sendCyclicBSMMessage);
        StartTimerIfNotRunning(sendCyclicBSTMessage, 0);
        break;
      case 16: // Sending of BST.
        break;
      case 17: // Stop BST; delayed start of BSD is initiated
        cancelTimer(sendCyclicBSTMessage);
        StartTimerIfNotRunning(sendCyclicBSDMessage, 0);
        break;
      case 18: // Stop BSD; 
        cancelTimer(sendCyclicBSDMessage);
        break;
      case 19: // End of charging
		EndOfCharging();
        cancelTimers();
        break;
      case 50:
	    EndOfCharging();
        cancelTimers();
        break;
      default:
        break;
    }
}

on timer sendCyclicBHMMessage
{
  SendBHM();
  setTimer(sendCyclicBHMMessage, messageCycleTimeBHM);
}

on timer sendCyclicBRMMessage
{
  SendBRM();
  setTimer(sendCyclicBRMMessage, messageCycleTimeBRM);
}

on timer sendCyclicBCPMessage
{
  SendBCP();
  setTimer(sendCyclicBCPMessage, messageCycleTimeBCP);
}

on timer sendCyclicBROMessage
{
  SendBRO();
  setTimer(sendCyclicBROMessage, messageCycleTimeBRO);
}

on timer sendCyclicBCLMessage
{
  if(@sysvar::GBT27930::BMS::svInterruptBCL == 0)
    SendBCL();
  setTimer(sendCyclicBCLMessage, messageCycleTimeBCL);
}

on timer sendCyclicBCSMessage
{
  if(@sysvar::GBT27930::BMS::svInterruptBCS == 0)
    SendBCS();
  setTimer(sendCyclicBCSMessage, messageCycleTimeBCS);
}

on timer sendCyclicBSMMessage
{
  if(@sysvar::GBT27930::BMS::svInterruptBSM == 0)
    SendBSM();
  setTimer(sendCyclicBSMMessage, messageCycleTimeBSM);
}

on timer sendCyclicBMVMessage
{
  //SendBMV();
  setTimer(sendCyclicBMVMessage, messageCycleTimeBMV);
}

on timer sendCyclicBMTMessage
{
  //SendBMT();
  setTimer(sendCyclicBMTMessage, messageCycleTimeBMT);
}

on timer sendCyclicBSPMessage
{
  //SendBSP();
  setTimer(sendCyclicBSPMessage, messageCycleTimeBSP);
}

on timer sendCyclicBSTMessage
{
  SendBST();
  setTimer(sendCyclicBSTMessage, messageCycleTimeBST);
}

on timer sendCyclicBSDMessage
{
  SendBSD();
  setTimer(sendCyclicBSDMessage, messageCycleTimeBSD);
}

on timer sendCyclicBEMMessage
{
  SendBEM();
  setTimer(sendCyclicBEMMessage, messageCycleTimeBEM);
}

on timer tmr_check_CP2Voltage
{
  CP2_voltage_measured = BMS_measure_voltage_CP2();
  if ( CP2_voltage_measured >= 5.2 && CP2_voltage_measured <= 6.8) 
  {
    setTimer(tmr_check_auxVoltage, interval_check_auxVoltage);
  }
  else 
  {
    setTimer(tmr_check_CP2Voltage, interval_check_CP2Voltage);
  }
}

on timer tmr_check_auxVoltage
{
  aux_voltage_measured = BMS_measure_auxiliary_voltage();
  writeEx(-3,3, "BMS node: tmr_check_auxVoltage %f", aux_voltage_measured);
  if ( aux_voltage_measured > 11 && aux_voltage_measured < 13 ) {
    // VT6104 - enable CAN communication
    Connect_CAN();
    @sysvar::GBT27930::svStart = 0;  //START BMS
    cancelTimer(tmr_InitTimeout);
    writeEx(-3,3, "BMS node: tmr_check_auxVoltage called, CAN relays closed");
  }
  else 
  {
    setTimer(tmr_check_auxVoltage, interval_check_auxVoltage);
  }
}

on timer tmr_monitor_CP2Voltage 
{
  CP2_voltage_measured = BMS_measure_voltage_CP2();
  if ( CP2_voltage_measured < 5.2|| CP2_voltage_measured > 6.8) {
    //@sysvar::GBT27930::svStart = 1;  //STOP BMS
    writeEx(-3, 3, "BMS node: CP2Voltage (%f V) has detected a cable Plug Out! Would initiate BMS charging stop!", CP2_voltage_measured);
  }
  else {
    setTimer(tmr_monitor_CP2Voltage, interval_monitor_CP2Voltage);
  }
}

on timer tmr_monitor_auxVoltage
{
  aux_voltage_measured = BMS_measure_auxiliary_voltage();
  if ( aux_voltage_measured < 11 || aux_voltage_measured > 13 ) {
    //@sysvar::GBT27930::svStart = 1;  //STOP BMS
    writeEx(-3, 3, "BMS node: Auxiliary Voltage (%f V) has detected a cable Plug Out! Would initiate BMS charging stop!", aux_voltage_measured);
  }
  else {
    setTimer(tmr_monitor_auxVoltage, interval_monitor_auxVoltage);
  }
}  

on timer tmr_InitTimeout
{
  @sysvar::GBT27930::svStart = 1;  //STOP BMS
  ST_Reset();
  writeEx(-3, 3, "tmr_InitTimeout");      
}

on timer tmr_resetSystem
{
  VT_EV_Init();
}

void StartTimerIfNotRunning(msTimer myTimer, long timeout)
{
  if(!isTimerActive(myTimer))
    setTimer(myTimer, timeout);
}

void CancelTimers()
{
  cancelTimer(sendCyclicBHMMessage);
  cancelTimer(sendCyclicBRMMessage);
  cancelTimer(sendCyclicBCPMessage);
  cancelTimer(sendCyclicBROMessage);
  cancelTimer(sendCyclicBCLMessage);
  cancelTimer(sendCyclicBCSMessage);
  cancelTimer(sendCyclicBSMMessage);
  cancelTimer(sendCyclicBSTMessage);
  cancelTimer(sendCyclicBSDMessage);
  cancelTimer(sendCyclicBEMMessage);
}

on start
{
  long color;
  
  currentBmsStatus = 0;
  CHA_open_close_K5K6(OPEN);
  HV_source_reset();
  BMS_set_voltage_CP2(12.0);
}

on preStop
{
  HV_source_reset(); 
  CHA_open_close_K5K6(OPEN);
  BMS_set_voltage_CP2(12.0);
  CancelTimers();
}

void SuspendCharging()
{
  cancelTimers();
  SetCurrentBmsStatus(15);
  if (currentBmsStatus == 31)
  {
    currentBmsStatus = 15;
  }
  StartTimerIfNotRunning(stateTransitionTimer, @sysvar::GBT27930::BMS::DelayTransition::svCST_to_BST);
}

void EndOfCharging()
{
  @GBT27930::svBmsSimState = 2;
}

void ChargerMessageTimeout()
{
  cancelTimers();
  StartTimerIfNotRunning(sendCyclicBEMMessage, 0);
}

on sysvar GBT27930::svStart
{
  @GBT27930::svError = 0;
  currentBmsStatus = 0;
  if(@this == 1)
  {
    if (isSimulated() == 0)
    {
      Disconnect_CAN();
      Disconnect_CC2();
      //Disable resistance R5
      BMS_set_resistance_R5(0.0);
      Disconnect_CC1();
      //Disable resistance R4
      BMS_set_resistance_R4(0.0);
      HV_source_reset();
      CHA_open_close_K5K6(OPEN);
      cancelTimer(tmr_monitor_CP2Voltage);
      cancelTimer(tmr_monitor_auxVoltage);
      setTimer(tmr_resetSystem, interval_resetSystem);
    }
  }
  else
  {
    VT_EV_Init();
    setTimer(tmrUpdatePanel, 100);
    ResetAllGroups();
    CancelTimers();
    @GBT27930::svBmsSimState = 0;
    @sysvar::GBT27930::BMS::BRO::svBMSReadyForCharging = 0x00;
    @sysvar::GBT27930::Control::StartSimulation = 1;
    
    if (isSimulated() == 0)
    {
      setTimer(tmr_monitor_CP2Voltage, interval_monitor_CP2Voltage);
      setTimer(tmr_monitor_auxVoltage, interval_monitor_auxVoltage);    
    }
  }
}

void VT_EV_Init()
{
  writeEx(-3, 3, "BMS node: Call VT_EV_Init. isSimulated() = %d", isSimulated());
  if (isSimulated()) {
    @sysvar::GBT27930::svStart = 0;
    
    CHA_open_close_K5K6(OPEN);
  }
  else {
    writeEx(-3, 3, "BMS node: VT_EV_Init: 'isSimulated() = false' is called");
    CP2_voltage_measured = 0.0;
    checkPoint2_voltage_detected = 0;
    
    setTimer(tmr_InitTimeout, timeout_systemStartUp);
    
    // VT2004 - bus bar default
    VT2004_busBar_default();
    ST_Init();
    
    CHA_open_close_K5K6(OPEN);
    BMS_set_voltage_CP2(6.0); // Simulation only: initiate with cable beeing plugged in
    Connect_CC1();
    Connect_CC2();
    
    setTimer(tmr_check_CP2Voltage, interval_check_CP2Voltage);   
  }
}

on sysvar_update sysvar::GBT27930::Control::voltage_CP2
{
  if (cableStatus == connected && BMS_measure_voltage_CP2() > 12 - cCP2VoltageTolerance && BMS_measure_voltage_CP2() < 12 + cCP2VoltageTolerance)
  {
    writeLineEx(-3,1,"BMS: Connection to the charger has been removed");
    cableStatus = disconnected;
  }
  else if (cableStatus != connected && BMS_measure_voltage_CP2() > 6 - cCP2VoltageTolerance && BMS_measure_voltage_CP2() < 6 + cCP2VoltageTolerance)
  {
    writeLineEx(-3,1,"BMS: Charger has been connected");
    cableStatus = connected;
  }
}

On sysvar GBT27930::BMS::svInterruptBCL
{
  if (12 <= currentBmsStatus <= 15 || 30 <= currentBmsStatus <= 31)
  { 
    if(@this == 1)
    {
      cancelTimer(sendCyclicBCLMessage);
    }
    else
    {
      StartTimerIfNotRunning(sendCyclicBCLMessage, 0);  
    }
  }
}

On sysvar GBT27930::BMS::svInterruptBCS
{
  if (12 <= currentBmsStatus <= 15)
  { 
    if(@this == 1)
    {
      cancelTimer(sendCyclicBCSMessage);
    }
    else
    {
      StartTimerIfNotRunning(sendCyclicBCSMessage, 0);  
    }
  }
}

On sysvar GBT27930::BMS::svInterruptBSM
{
  if (14 <= currentBmsStatus <= 15)
  {
    if(@this == 1)
    {
      cancelTimer(sendCyclicBSMMessage);
    }
    else
    {
      StartTimerIfNotRunning(sendCyclicBSMMessage, 0);  
    }
  }
}

on sysvar GBT27930::BMS::svSuspendCharging
{
  if(@this == 1)
  {
    SuspendCharging();
  }
}

on sysvar GBT27930::BMS::svSuspendCharging2
{
  if(@this == 0)
    return;
  
  //1. Set whole payload to 0x00
  @sysvar::GBT27930::BMS::BST::svAbnormalVoltageError        = 0;
  @sysvar::GBT27930::BMS::BST::svExcessiveCurrentError       = 0;
  @sysvar::GBT27930::BMS::BST::svOtherFaults                 = 0;
  @sysvar::GBT27930::BMS::BST::svBmsConnectorOverTemp        = 0;
  @sysvar::GBT27930::BMS::BST::svVoltageDetectionFault       = 0;
  @sysvar::GBT27930::BMS::BST::svHighVoltageRelayFault       = 0;
  @sysvar::GBT27930::BMS::BST::svBatterySetOverTemp          = 0;
  @sysvar::GBT27930::BMS::BST::svChargingConnectorFault      = 0;
  @sysvar::GBT27930::BMS::BST::svOutputConnectorOverTemp     = 0;
  @sysvar::GBT27930::BMS::BST::svInsulationFault             = 0;
  @sysvar::GBT27930::BMS::BST::svChargerSuspendsActively     = 0;
  @sysvar::GBT27930::BMS::BST::svSettingValueOfSingleVoltage = 0;
  @sysvar::GBT27930::BMS::BST::svSettingValueOfTotalVoltage  = 0;
  @sysvar::GBT27930::BMS::BST::svRequiredSocTargetValue      = 0;

  //2. Set selected signal to "1"
  switch(@GBT27930::BMS::svCauseOfSuspendingCharging)
  {
    case 1  : @sysvar::GBT27930::BMS::BST::svAbnormalVoltageError                 = 1; break;
    case 2  : @sysvar::GBT27930::BMS::BST::svExcessiveCurrentError                = 1; break;
    case 3  : @sysvar::GBT27930::BMS::BST::svOtherFaults                          = 1; break;
    case 4  : @sysvar::GBT27930::BMS::BST::svBmsConnectorOverTemp                 = 1; break;
    case 5  : @sysvar::GBT27930::BMS::BST::svVoltageDetectionFault                = 1; break;
    case 6  : @sysvar::GBT27930::BMS::BST::svHighVoltageRelayFault                = 1; break;
    case 7  : @sysvar::GBT27930::BMS::BST::svBatterySetOverTemp                   = 1; break;
    case 8  : @sysvar::GBT27930::BMS::BST::svChargingConnectorFault               = 1; break;
    case 9  : @sysvar::GBT27930::BMS::BST::svOutputConnectorOverTemp              = 1; break;
    case 10 : @sysvar::GBT27930::BMS::BST::svInsulationFault                      = 1; break;
    case 11 : @sysvar::GBT27930::BMS::BST::svChargerSuspendsActively              = 1; break;
    case 12 : @sysvar::GBT27930::BMS::BST::svSettingValueOfSingleVoltage          = 1; break;
    case 13 : @sysvar::GBT27930::BMS::BST::svSettingValueOfTotalVoltage           = 1; break;
    case 14 : @sysvar::GBT27930::BMS::BST::svRequiredSocTargetValue               = 1; break;
    case 15 : @sysvar::GBT27930::BMS::BST::svChargingParameterMismatchError       = 1; break;
  }  
  //3. Suspend charging (start sending of BST)
  SuspendCharging();
}

on sysvar GBT27930::BMS::svStopChargingWithError
{
  if(@this == 1)
    ChargerMessageTimeout(); //Send BMS Error Message
}

on sysvar GBT27930::BMS::svStopChargingWithError2
{
  if(@this == 1)
  {  
    //1. Set whole payload to 0x00
    @sysvar::GBT27930::BMS::BEM::svTimeout_CRM_NotRecognized = 0;
    @sysvar::GBT27930::BMS::BEM::svTimeout_CRM_Recognized    = 0;
    @sysvar::GBT27930::BMS::BEM::svTimeout_CTS_CML           = 0;
    @sysvar::GBT27930::BMS::BEM::svTimeout_CRO               = 0;
    @sysvar::GBT27930::BMS::BEM::svTimeout_CCS               = 0;
    @sysvar::GBT27930::BMS::BEM::svTimeout_CST               = 0;
    @sysvar::GBT27930::BMS::BEM::svTimeout_CSD               = 0;
    
    //2. Set selected signal to "1"
    switch(@GBT27930::BMS::svTimeoutOfMsg)
    {
      case 1: @sysvar::GBT27930::BMS::BEM::svTimeout_CRM_NotRecognized  = 1; break;
      case 2: @sysvar::GBT27930::BMS::BEM::svTimeout_CRM_Recognized     = 1; break;
      case 3: @sysvar::GBT27930::BMS::BEM::svTimeout_CTS_CML            = 1; break;
      case 4: @sysvar::GBT27930::BMS::BEM::svTimeout_CRO                = 1; break;
      case 5: @sysvar::GBT27930::BMS::BEM::svTimeout_CCS                = 1; break;
      case 6: @sysvar::GBT27930::BMS::BEM::svTimeout_CST                = 1; break;
      case 7: @sysvar::GBT27930::BMS::BEM::svTimeout_CSD                = 1; break;
    }
    
    //3. Send Charger Error Message
    ChargerMessageTimeout(); 
  }
}

on sysvar_update sysvar::GBT27930::Control::auxiliary_voltage
{
  if(@this <= 0.2) //Relay for auxiliary power supply OFF (K3K4)
    CHA_open_close_K5K6(OPEN);
}

void SetCurrentBmsStatus(int state){
  if (currentBmsStatus < state)
  {
    currentBmsStatus = state;
  }
}

/////////////////////////////////////////////////////////////////////////////////////
/*--------------------------------Message Handling---------------------------------*/
/////////////////////////////////////////////////////////////////////////////////////

on fct_called BMS.OnLastReceivedMessageIdChanged
{
  switch($BMS.OnLastReceivedMessageIdChanged.LatestCall.lastRxMessageId)
  {
      case kCHM:
        if (currentBmsStatus<=2){
          SetCurrentBmsStatus(2); // Delayed start of BHM
          StartTimerIfNotRunning(stateTransitionTimer, @sysvar::GBT27930::BMS::DelayTransition::svCHM_to_BHM); 
        }
        break;
      case kCRM:
        if (currentBmsStatus<=3)
        {
          SetCurrentBmsStatus(4); // Delayed start of BRM
          StartTimerIfNotRunning(stateTransitionTimer, @sysvar::GBT27930::BMS::DelayTransition::svCRM_not_recognized_to_BRM); 
        } 
        else if (currentBmsStatus==5) 
        {
          SetCurrentBmsStatus(6); // Delayed start of BCP
          StartTimerIfNotRunning(stateTransitionTimer, @sysvar::GBT27930::BMS::DelayTransition::svCRM_recognized_to_BCP); 
        }
        break;
      case kCTS:
        break;
      case kCML:
        if (currentBmsStatus==7)
        {
          SetCurrentBmsStatus(8); // Delayed start of BRO (not ready)
          //UpdateBCPParameters();
          StartTimerIfNotRunning(stateTransitionTimer, @sysvar::GBT27930::BMS::DelayTransition::svCML_to_BRO_not_ready); 
        } 
        break;
      case kCRO:
        if ($BMS.CategoryA.CRO.ChargerReadyForCharging == 0xAA && currentBmsStatus<=10)
        {
          SetCurrentBmsStatus(11); // Delayed start of BCL
          StartTimerIfNotRunning(stateTransitionTimer, @sysvar::GBT27930::BMS::DelayTransition::svCRO_ready_to_BCL); 
        } 
        break;
      case kCCS:
        if (currentBmsStatus == 12)
        {
          SetCurrentBmsStatus(13);
          StartTimerIfNotRunning(stateTransitionTimer, @sysvar::GBT27930::BMS::DelayTransition::svCCS_to_BSM);
        }
        break;
      case kCST:
        if(currentBmsStatus <=14 || currentBmsStatus == 31)
        {
          SuspendCharging();
        } 
        else if (currentBmsStatus == 16)
        {
          SetCurrentBmsStatus(17);
          StartTimerIfNotRunning(stateTransitionTimer, @sysvar::GBT27930::BMS::DelayTransition::svCST_to_BST);
        }
        break;
      case kCSD:
        if (currentBmsStatus == 18)
        {
          SetCurrentBmsStatus(19);
          StartTimerIfNotRunning(stateTransitionTimer, @sysvar::GBT27930::BMS::DelayTransition::svBSD_to_End);
        }
        break;
      case kCEM:
        if (currentBmsStatus != 50)
        {
          StartTimerIfNotRunning(stateTransitionTimer, 1000);
          StartTimerReadyToOpen_K5_K6(1000); 
          SetCurrentBmsStatus(50);
        }
        break;
      default:
        // Handle for PGN not implemented
        break;
  }
}

on fct_called BMS.OnLastTransmittedMessageIdChanged
{
  switch($BMS.OnLastTransmittedMessageIdChanged.LatestCall.lastTxMessageId)
  {
      case kBHM:
        SetCurrentBmsStatus(3);
        break;
      case kBRM:
        msStartOfChargingMS = 0;
        inputEnergy = 0;  
        currentBmsStatus = 5;
        SetCurrentBmsStatus(4);
        break;
      case kBCP:
        SetCurrentBmsStatus(7);
        break;
      case kBRO:
        if ($BMS.CategoryA.BRO.BMSReadyForCharging==0x00)
        {
          SetCurrentBmsStatus(9); // Delayed start of BRO (ready)
          StartTimerIfNotRunning(stateTransitionTimer, @sysvar::GBT27930::BMS::DelayTransition::svBRO_not_ready_to_BRO_ready); 
        } 
        else if ($BMS.CategoryA.BRO.BMSReadyForCharging==0xAA)
        {
          SetCurrentBmsStatus(10);
        }
        break;
      case kBCL:
        if(msStartOfChargingMS == 0)
        {
          msStartOfChargingMS = timeNow() / 100;
        }
        if (currentBmsStatus == 11)
        {
          SetCurrentBmsStatus(31); // Sending of BCL; delayed start of BCS is initiated
          StartTimerIfNotRunning(stateTransitionTimer, @sysvar::GBT27930::BMS::DelayTransition::svBCL_to_BCL_BCS);
        }
        break;
      case kBCS:
        SetCurrentBmsStatus(12);
        if (currentBmsStatus == 31)
          currentBmsStatus = 12;
        break;
      case kBSM:
        SetCurrentBmsStatus(14);
        break;
      case kBMV:
        break;
      case kBMT:
        break;
      case kBSP:
        break;
      case kBST:
        SetCurrentBmsStatus(16);
        break;
      case kBSD:
        if (currentBmsStatus == 17)
        {
          SetCurrentBmsStatus(18);
        }
        break;
      case kBEM:
        if (currentBmsStatus != 50)
        {
          StartTimerIfNotRunning(stateTransitionTimer, 2000);
          StartTimerReadyToOpen_K5_K6(2000); 
          SetCurrentBmsStatus(50);
        }
        break;
  }
}

void SendBHM()
{
  $BMS.CategoryA.BHM.MaxChargingVoltage.phys = @sysvar::GBT27930::BMS::BHM::svMaxChargingVoltage;
}

void SendBRM()
{ 
  byte bBufVIN[17];
  long size;
  char bufBatManName[5];
  $BMS.CategoryA.BRM.MajorBMSProtocolVersion = @sysvar::GBT27930::BMS::BRM::svMajorBMSProtocolVersion;
  $BMS.CategoryA.BRM.MinorBMSProtocolVersion = @sysvar::GBT27930::BMS::BRM::svMinorBMSProtocolVersion;
  $BMS.CategoryA.BRM.BatteryType = @sysvar::GBT27930::BMS::BRM::svBatteryType;
  $BMS.CategoryA.BRM.BatterySystemCapacity.phys = @sysvar::GBT27930::BMS::BRM::svBatterySystemCapacity;
  $BMS.CategoryA.BRM.BatterySystemVoltage.phys = @sysvar::GBT27930::BMS::BRM::svBatterySystemVoltage;
  
  sysGetVariableString(sysvar::GBT27930::BMS::svManufacturerName, bufBatManName, elcount(bufBatManName));
  $BMS.CategoryA.BRM.BatteryManufacturerName = bufBatManName;
  
  $BMS.CategoryA.BRM.BatteryPackNumber.phys = @sysvar::GBT27930::BMS::BRM::svBatteryPackNumber;
  $BMS.CategoryA.BRM.BatteryProductionYear.phys = @sysvar::GBT27930::BMS::BRM::svBatteryProductionYear;
  $BMS.CategoryA.BRM.BatteryProductionMonth.phys = @sysvar::GBT27930::BMS::BRM::svBatteryProductionMonth;
  $BMS.CategoryA.BRM.BatteryProductionDay.phys = @sysvar::GBT27930::BMS::BRM::svBatteryProductionDay;
  $BMS.CategoryA.BRM.BatteryChargingCounts.phys = @sysvar::GBT27930::BMS::BRM::svBatteryChargingCounts;
  $BMS.CategoryA.BRM.BatteryOwnershipID.phys = @sysvar::GBT27930::BMS::BRM::svBatteryOwnershipID;
  
  sysGetVariableData(sysvar::GBT27930::BMS::BRM::svEVIN, bBufVIN, size);
  memcpy($BMS.CategoryA.BRM.ExtendedVehicleIdNumber, bBufVIN);
  
  $BMS.CategoryA.BRM.BMSProtocolSoftwareVersion.VersionSerialNumber.phys = @sysvar::GBT27930::BMS::BRM::svProtocolSoftwareVersion_VersionSerialNumber;
  $BMS.CategoryA.BRM.BMSProtocolSoftwareVersion.Year.phys = @sysvar::GBT27930::BMS::BRM::svProtocolSoftwareVersion_Year;
  $BMS.CategoryA.BRM.BMSProtocolSoftwareVersion.Month.phys = @sysvar::GBT27930::BMS::BRM::svProtocolSoftwareVersion_Month;
  $BMS.CategoryA.BRM.BMSProtocolSoftwareVersion.Day.phys = @sysvar::GBT27930::BMS::BRM::svProtocolSoftwareVersion_Day;
}

void SendBCP()
{
  $BMS.CategoryA.BCP.MaxBatteryCellChargingVoltage.phys = @sysvar::GBT27930::BMS::BCP::svMaxBatteryCellChargingVoltage;
  $BMS.CategoryA.BCP.MaxAllowedChargingCurrent.phys = @sysvar::GBT27930::BMS::BCP::svMaxAllowedChargingCurrent;
  $BMS.CategoryA.BCP.TotalNominalBatteryEnergy.phys = @sysvar::GBT27930::BMS::BCP::svTotalNominalBatteryEnergy;
  $BMS.CategoryA.BCP.MaxAllowedTotalChargingVoltage.phys = @sysvar::GBT27930::BMS::BCP::svMaxAllowedTotalChargingVoltage;
  $BMS.CategoryA.BCP.MaxAllowedTemperature.phys = @sysvar::GBT27930::BMS::BCP::svMaxAllowedTemperature;
  $BMS.CategoryA.BCP.StatusOfCharge.phys = @sysvar::GBT27930::BMS::BCP::svStatusOfCharge;
  $BMS.CategoryA.BCP.CurrentBatteryVoltage.phys = @sysvar::GBT27930::BMS::BCP::svCurrentBatteryVoltage;
}

void SendBRO()
{
  $BMS.CategoryA.BRO.BMSReadyForCharging = @sysvar::GBT27930::BMS::BRO::svBMSReadyForCharging;
}

void SendBCL()
{
  if (@sysvar::GBT27930::BMS::BCL::svVoltageDemand > $BMS.CategoryA.BCP.MaxAllowedTotalChargingVoltage.phys)
  {
    @sysvar::GBT27930::BMS::BCL::svVoltageDemand = $BMS.CategoryA.BCP.MaxAllowedTotalChargingVoltage.phys;
  }
  if (@sysvar::GBT27930::BMS::BCL::svCurrentDemand < $BMS.CategoryA.BCP.MaxAllowedChargingCurrent.phys)
  {
    @sysvar::GBT27930::BMS::BCL::svCurrentDemand = $BMS.CategoryA.BCP.MaxAllowedChargingCurrent.phys;
  }
  $BMS.CategoryA.BCL.VoltageDemand.phys = @sysvar::GBT27930::BMS::BCL::svVoltageDemand;
  $BMS.CategoryA.BCL.CurrentDemand.phys = @sysvar::GBT27930::BMS::BCL::svCurrentDemand;
  $BMS.CategoryA.BCL.ChargingMode = @sysvar::GBT27930::BMS::BCL::svChargingMode;
}

void SendBCS()
{
  double inputEnergy, remainingEnergy;
  double chargingTimeMinutes;
  dword currentSoC;
  
  $BMS.CategoryA.BCS.MeasuredChargingVoltage.phys = $BMS.CategoryA.CCS.VoltageOutputValue.phys * (0.99 + random(100)/5000.0);
  $BMS.CategoryA.BCS.MeasuredChargingCurrent.phys = $BMS.CategoryA.CCS.CurrentOutputValue.phys * (0.99 + random(100)/5000.0);
  @sysvar::GBT27930::BMS::BCS::svMeasuredChargingVoltage = $BMS.CategoryA.BCS.MeasuredChargingVoltage.phys;
  @sysvar::GBT27930::BMS::BCS::svMeasuredChargingCurrent = $BMS.CategoryA.BCS.MeasuredChargingCurrent.phys;
  $BMS.CategoryA.BCS.HighestBatteryVoltageGroup.HighestVoltageOfBatteryCell.phys = @sysvar::GBT27930::BMS::BCS::svHighestBatteryVoltageGroup_Voltage;
  $BMS.CategoryA.BCS.HighestBatteryVoltageGroup.GroupNrOfCellWithHighestVoltage.phys = @sysvar::GBT27930::BMS::BCS::svHighestBatteryVoltageGroup_CellNr;
  
  chargingTimeMinutes = ((timeNow() / 100) - msStartOfChargingMS) / 60000.0;
  inputEnergy = abs($BMS.CategoryA.CCS.VoltageOutputValue.phys * $BMS.CategoryA.CCS.CurrentOutputValue.phys / 1000 /*W -> kW*/) * (@GBT27930::BMS::svEfficiency / 100) * (chargingTimeMinutes / 60); //kWh
  if ($BMS.CategoryA.BCP.TotalNominalBatteryEnergy.phys != 0)
  {
    currentSoC = $BMS.CategoryA.BCP.StatusOfCharge.phys + (inputEnergy / $BMS.CategoryA.BCP.TotalNominalBatteryEnergy.phys) * 100;
  }
  else 
  {
    writeEx(0, 3, "TotalNominalBatteryEnergy is set to 0! Charging not possible.");
    $BMS.CategoryA.BCS.CurrentChargeState.phys = 0;
  }
  remainingEnergy = $BMS.CategoryA.BCP.TotalNominalBatteryEnergy.phys * (1.0 - $BMS.CategoryA.BCP.StatusOfCharge.phys/100.0) - inputEnergy;
  if(inputEnergy > 0)
  {
    @sysvar::GBT27930::BMS::BCS::svEstimatedRemainingChargingTime = (remainingEnergy / abs($BMS.CategoryA.BCS.MeasuredChargingVoltage.phys * $BMS.CategoryA.BCS.MeasuredChargingCurrent.phys / 1000)) * 60;
  }
  $BMS.CategoryA.BCS.EstimatedRemainingChargingTime = @sysvar::GBT27930::BMS::BCS::svEstimatedRemainingChargingTime;
  
  if (currentSoC >= 100)
  {
    $BMS.CategoryA.BCS.CurrentChargeState.phys = 100;
    // set all BST to zero but "RequiredSocTargetValue" and suspend charging
    @sysvar::GBT27930::BMS::BST::svAbnormalVoltageError        = 0;
    @sysvar::GBT27930::BMS::BST::svExcessiveCurrentError       = 0;
    @sysvar::GBT27930::BMS::BST::svOtherFaults                 = 0;
    @sysvar::GBT27930::BMS::BST::svBmsConnectorOverTemp        = 0;
    @sysvar::GBT27930::BMS::BST::svVoltageDetectionFault       = 0;
    @sysvar::GBT27930::BMS::BST::svHighVoltageRelayFault       = 0;
    @sysvar::GBT27930::BMS::BST::svBatterySetOverTemp          = 0;
    @sysvar::GBT27930::BMS::BST::svChargingConnectorFault      = 0;
    @sysvar::GBT27930::BMS::BST::svOutputConnectorOverTemp     = 0;
    @sysvar::GBT27930::BMS::BST::svInsulationFault             = 0;
    @sysvar::GBT27930::BMS::BST::svChargerSuspendsActively     = 0;
    @sysvar::GBT27930::BMS::BST::svSettingValueOfSingleVoltage = 0;
    @sysvar::GBT27930::BMS::BST::svSettingValueOfTotalVoltage  = 0;
    @sysvar::GBT27930::BMS::BST::svRequiredSocTargetValue      = 1;
    
    SuspendCharging();
  }
  else
  {
    $BMS.CategoryA.BCS.CurrentChargeState.phys = currentSoC;
  }
  @sysvar::GBT27930::BMS::BCS::svCurrentChargeState = $BMS.CategoryA.BCS.CurrentChargeState.phys;
}

void SendBSM()
{
  $BMS.CategoryA.BSM.BatteryHighestTemperature.phys = @sysvar::GBT27930::BMS::BSM::svBatteryHighestTemperature;
  $BMS.CategoryA.BSM.BatteryHighestTemperatureDetectionPoint.phys = @sysvar::GBT27930::BMS::BSM::svBatteryHighestTemperatureDetectionPoint;
  $BMS.CategoryA.BSM.BatteryLowestTemperature.phys = @sysvar::GBT27930::BMS::BSM::svBatteryLowestTemperature;
  $BMS.CategoryA.BSM.BatteryLowestTemperatureDetectionPoint.phys = @sysvar::GBT27930::BMS::BSM::svBatteryLowestTemperatureDetectionPoint;
  $BMS.CategoryA.BSM.BatterySerialNumber.phys = @sysvar::GBT27930::BMS::BSM::svBatterySerialNumber;
  
  $BMS.CategoryA.BSM.ChargingAllowed = @sysvar::GBT27930::BMS::BSM::svChargingAllowed;
  $BMS.CategoryA.BSM.BatteryVoltageState = @sysvar::GBT27930::BMS::BSM::svBatteryVoltageState;
  $BMS.CategoryA.BSM.StateOfCharge = @sysvar::GBT27930::BMS::BSM::svStateOfCharge;
  $BMS.CategoryA.BSM.BatteryChargingOvercurrent = @sysvar::GBT27930::BMS::BSM::svBatteryChargingOverCurrent;
  $BMS.CategoryA.BSM.BatteryExcessTemperature = @sysvar::GBT27930::BMS::BSM::svBatteryExcessTemperature;
  $BMS.CategoryA.BSM.BatteryInsulationState = @sysvar::GBT27930::BMS::BSM::svBatteryInsulationState;
  $BMS.CategoryA.BSM.BatteryOutputConnectorState = @sysvar::GBT27930::BMS::BSM::svBatteryOutputConnectorState;
}

void SendBST()
{
  $BMS.CategoryA.BST.AbnormalVoltageError = @sysvar::GBT27930::BMS::BST::svAbnormalVoltageError;
  $BMS.CategoryA.BST.ExcessiveCurrentError = @sysvar::GBT27930::BMS::BST::svExcessiveCurrentError;
  $BMS.CategoryA.BST.OtherFaults = @sysvar::GBT27930::BMS::BST::svOtherFaults;
  $BMS.CategoryA.BST.BmsConnectorOverTemp = @sysvar::GBT27930::BMS::BST::svBmsConnectorOverTemp;
  $BMS.CategoryA.BST.VoltageDetectionFault = @sysvar::GBT27930::BMS::BST::svVoltageDetectionFault;
  $BMS.CategoryA.BST.HighVoltageRelayFault = @sysvar::GBT27930::BMS::BST::svHighVoltageRelayFault;
  $BMS.CategoryA.BST.BatterySetOverTemp = @sysvar::GBT27930::BMS::BST::svBatterySetOverTemp;
  $BMS.CategoryA.BST.ChargingConnectorFault = @sysvar::GBT27930::BMS::BST::svChargingConnectorFault;
  $BMS.CategoryA.BST.OutputConnectorOverTemp = @sysvar::GBT27930::BMS::BST::svOutputConnectorOverTemp;
  $BMS.CategoryA.BST.InsulationFault = @sysvar::GBT27930::BMS::BST::svInsulationFault;
  $BMS.CategoryA.BST.ChargerSuspendsActively = @sysvar::GBT27930::BMS::BST::svChargerSuspendsActively;
  $BMS.CategoryA.BST.SettingValueOfSingleVoltage = @sysvar::GBT27930::BMS::BST::svSettingValueOfSingleVoltage;
  $BMS.CategoryA.BST.SettingValueOfTotalVoltage = @sysvar::GBT27930::BMS::BST::svSettingValueOfTotalVoltage;
  $BMS.CategoryA.BST.RequiredSocTargetValue = @sysvar::GBT27930::BMS::BST::svRequiredSocTargetValue;
  $BMS.CategoryA.BST.ChargingParameterMismatchError = @sysvar::GBT27930::BMS::BST::svChargingParameterMismatchError;
}

void SendBSD()
{
  @sysvar::GBT27930::BMS::BSD::svSuspendStateOfChargeSOC = $BMS.CategoryA.BCS.CurrentChargeState;
  $BMS.CategoryA.BSD.SuspendStateOfChargeSOC.phys = @sysvar::GBT27930::BMS::BSD::svSuspendStateOfChargeSOC; 
  $BMS.CategoryA.BSD.SingleBatteryMinVoltage.phys = @sysvar::GBT27930::BMS::BSD::svSingleBatteryMinVoltage; 
  $BMS.CategoryA.BSD.SingleBatteryMaxVoltage.phys = @sysvar::GBT27930::BMS::BSD::svSingleBatteryMaxVoltage; 
  $BMS.CategoryA.BSD.SingleBatteryMinTemperature.phys = @sysvar::GBT27930::BMS::BSD::svSingleBatteryMinTemperature; 
  $BMS.CategoryA.BSD.SingleBatteryMaxTemperature.phys = @sysvar::GBT27930::BMS::BSD::svSingleBatteryMaxTemperature; 
}

void SendBEM()
{
  $BMS.CategoryA.BEM.Timeout_CRM_NotRecognized = @sysvar::GBT27930::BMS::BEM::svTimeout_CRM_NotRecognized;
  $BMS.CategoryA.BEM.Timeout_CRM_Recognized = @sysvar::GBT27930::BMS::BEM::svTimeout_CRM_Recognized;
  $BMS.CategoryA.BEM.Timeout_CTS_CML = @sysvar::GBT27930::BMS::BEM::svTimeout_CTS_CML;
  $BMS.CategoryA.BEM.Timeout_CRO = @sysvar::GBT27930::BMS::BEM::svTimeout_CRO;
  $BMS.CategoryA.BEM.Timeout_CCS = @sysvar::GBT27930::BMS::BEM::svTimeout_CCS;
  $BMS.CategoryA.BEM.Timeout_CST = @sysvar::GBT27930::BMS::BEM::svTimeout_CST;
  $BMS.CategoryA.BEM.Timeout_CSD = @sysvar::GBT27930::BMS::BEM::svTimeout_CSD;
}

/////////////////////////////////////////////////////////////////////////////////////
/*-----------------------------------Presentation----------------------------------*/
/////////////////////////////////////////////////////////////////////////////////////

void ResetAllGroups()
{
  setDefaultControlColors("BMS", "groupBHM");
  setDefaultControlColors("BMS", "groupBRM");
  setDefaultControlColors("BMS", "groupBCP");
  setDefaultControlColors("BMS", "groupBRO");
  setDefaultControlColors("BMS", "groupBCL");
  setDefaultControlColors("BMS", "groupBCS");
  setDefaultControlColors("BMS", "groupBSM");
  setDefaultControlColors("BMS", "groupBST");
  setDefaultControlColors("BMS", "groupBSD");
}

on timer tmrUpdatePanel
{
  long clrInactive, clrActive, clrChanging, clrBackActive;
  clrInactive = MakeRGB(0,0,0);
  clrActive = MakeRGB(0, 128, 0);
  clrChanging = MakeRGB(128, 0, 0);
  clrBackActive = MakeRGB(224, 224, 255);
  
  if(lastBmsStatus != currentBmsStatus)
  {
    switch(currentBmsStatus)
    {
      case 3: //Sending of BHM
        setControlForeColor("BMS", "groupBHM"   , clrActive);
        setControlBackColor("BMS", "groupBHM"   , clrBackActive);
        break;
        
      case 4: //Sending of BHM; delayed start of BRM is initiated
        setControlForeColor("BMS", "groupBHM"   , clrChanging);
        setControlBackColor("BMS", "groupBHM"   , clrBackActive);
        break;
        
      case 5: //Sending of BRM 
        setDefaultControlColors("BMS", "groupBHM");

        setControlForeColor("BMS", "groupBRM"   , clrActive);
        setControlBackColor("BMS", "groupBRM"   , clrBackActive);
        break;

      case 6: //Sending of BRM; delayed start of BCP is initiated
        setControlForeColor("BMS", "groupBRM"   , clrChanging);
        setControlBackColor("BMS", "groupBRM"   , clrBackActive);
        break;
        
        
      case 7: //Sending of BCP
        setDefaultControlColors("BMS", "groupBRM");

        setControlForeColor("BMS", "groupBCP"   , clrActive);
        setControlBackColor("BMS", "groupBCP"   , clrBackActive);
        break;

      case 8: //Sending of BCP; delayed start of BRO (Not ready) is initiated
        setControlForeColor("BMS", "groupBCP"   , clrChanging);
        setControlBackColor("BMS", "groupBCP"   , clrBackActive);
        break;
        
      case 9: //Sending of BRO (Not Ready for charging); delayed start of BRO (Ready for charging) is initiated
        setDefaultControlColors("BMS", "groupBCP");

        setControlForeColor("BMS", "groupBCP"   , clrActive);
        setControlBackColor("BMS", "groupBCP"   , clrBackActive);
        CHA_open_close_K5K6(CLOSE); //T12
        break;

      case 10: //Sending of BRO(Ready for charging)
        setControlForeColor("BMS", "groupBRO"   , clrActive);
        setControlBackColor("BMS", "groupBRO"   , clrBackActive);
        break;
        
      case 11: //Sending of BRO (Ready for charging); delayed start of BCL is initiated
        setControlForeColor("BMS", "groupBRO"   , clrChanging);
        setControlBackColor("BMS", "groupBRO"   , clrBackActive);
        break;
        
      case 30: //Sending of BCL
        setDefaultControlColors("BMS", "groupBRO");

        setControlForeColor("BMS", "groupBCL"   , clrActive);
        setControlBackColor("BMS", "groupBCL"   , clrBackActive);
        break;        
        
      case 31: //Sending of BCL; delayed start of BCS is initiated
        setDefaultControlColors("BMS", "groupBRO");

        setControlForeColor("BMS", "groupBCL"   , clrActive);
        setControlBackColor("BMS", "groupBCL"   , clrBackActive);
        break;        
        
      case 12: //Sending of BCL und BCS
      case 13: //Sending of BCL und BCS; delayed start of BSM is initiated
        setDefaultControlColors("BMS", "groupBRO");

        setControlForeColor("BMS", "groupBCL"   , clrActive);
        setControlBackColor("BMS", "groupBCL"   , clrBackActive);
        setControlForeColor("BMS", "groupBCS"   , clrActive);
        setControlBackColor("BMS", "groupBCS"   , clrBackActive);
        break;

      case 14: //Sending of BCL, BCS and BSM
        setControlForeColor("BMS", "groupBCL"   , clrActive);
        setControlBackColor("BMS", "groupBCL"   , clrBackActive);
        setControlForeColor("BMS", "groupBCS"   , clrActive);
        setControlBackColor("BMS", "groupBCS"   , clrBackActive);
        setControlForeColor("BMS", "groupBSM"   , clrActive);
        setControlBackColor("BMS", "groupBSM"   , clrBackActive);
        break;

      case 15: //Sending of BCL, BCS and BSM; delayed start of BST is initiated
        setControlForeColor("BMS", "groupBCL"   , clrChanging);
        setControlBackColor("BMS", "groupBCL"   , clrBackActive);
        setControlForeColor("BMS", "groupBCS"   , clrChanging);
        setControlBackColor("BMS", "groupBCS"   , clrBackActive);
        setControlForeColor("BMS", "groupBSM"   , clrChanging);
        setControlBackColor("BMS", "groupBSM"   , clrBackActive);
        break;
        
      case 16: //Sending of BST
        setDefaultControlColors("BMS", "groupBCL");
        setDefaultControlColors("BMS", "groupBCS");
        setDefaultControlColors("BMS", "groupBSM");

        setControlForeColor("BMS", "groupBST"   , clrActive);
        setControlBackColor("BMS", "groupBST"   , clrBackActive);
        StartTimerReadyToOpen_K5_K6(300);
        break;
        
      case 17: //Sending of BST; delayed start of BSD is initiated
        setDefaultControlColors("BMS", "groupBCL");
        setDefaultControlColors("BMS", "groupBCS");
        setDefaultControlColors("BMS", "groupBSM");

        setControlForeColor("BMS", "groupBST"   , clrChanging);
        setControlBackColor("BMS", "groupBST"   , clrBackActive);
        StartTimerReadyToOpen_K5_K6(10000);
        break;
        
      case 18: //Sending of BSD; delayed stop of BSD is initiated 
        setDefaultControlColors("BMS", "groupBCL");
        setDefaultControlColors("BMS", "groupBCS");
        setDefaultControlColors("BMS", "groupBSM");
        setDefaultControlColors("BMS", "groupBST");

        setControlForeColor("BMS", "groupBSD"   , clrActive);
        setControlBackColor("BMS", "groupBSD"   , clrBackActive);
        break;

      case 19: //End of charging
        setDefaultControlColors("BMS", "groupBSD");
        break;
        
      case 50: //Sending of CEM
        ResetAllGroups();
        setControlForeColor("BMS", "groupBEM"   , clrActive);
        setControlBackColor("BMS", "groupBEM"   , clrBackActive);
        break;

    }
    lastBmsStatus = currentBmsStatus;
  }  
  setTimer(tmrUpdatePanel, 100);
}

/////////////////////////////////////////////////////////////////////////////////////
/*-----------------------------------Key Inputs------------------------------------*/
/////////////////////////////////////////////////////////////////////////////////////

on key 'n'
{
//  if(@GBT27930::svStart == 0)
//  {
//    @GBT27930::svStart = 1;
//  }
//  else
//  {
//    @GBT27930::svStart = 0;
//  }
}