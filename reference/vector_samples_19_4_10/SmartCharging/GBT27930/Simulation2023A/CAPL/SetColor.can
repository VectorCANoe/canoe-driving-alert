/*@!Encoding:1252*/
includes
{
  
}

variables
{
  const word pgnBCL = 0x1000;
  const word pgnBCP =  0x600;
  const word pgnBCS = 0x1100;
  const word pgnBEM = 0x1E00;
  const word pgnBHM = 0x2700;
  const word pgnBMT = 0x1600;
  const word pgnBMV = 0x1500;
  const word pgnBRM =  0x200;
  const word pgnBRO =  0x900;
  const word pgnBSD = 0x1C00;
  const word pgnBSM = 0x1300;
  const word pgnBSP = 0x1700;
  const word pgnBST = 0x1900;
  const word pgnCCS = 0x1200;
  const word pgnCEM = 0x1F00;
  const word pgnCHM = 0x2600;
  const word pgnCML =  0x800;
  const word pgnCRM =  0x100;
  const word pgnCRO =  0xA00;
  const word pgnCSD = 0x1D00;
  const word pgnCST = 0x1A00;
  const word pgnCTS =  0x700;
  
  const word pgnTPCM = 0xEC00;
  const word pgnTPDT = 0xEB00;
}

on message *
{
  word currentPgn = 0;
 
  currentPgn = (this.id & 0x00FF0000) >> 8; // get PGN from ID
  if ( currentPgn == pgnTPCM || currentPgn == pgnTPDT) // If J1939 TP message, get PGN from DO
  {
    currentPgn = $BMS.OnLastTransmittedMessageIdChanged.LatestCall.lastTxMessageId; // only BMS can have a J1939 TP message
  }
    
  // ----- Charger colors -----
  switch(currentPgn)
  {
   
    //Handshake initiation
    case pgnCHM:
      traceSetEventColors(this, makeRGB(0, 0, 0), makeRGB(226, 225, 240));
      break;

    //Handshake recognition
    case pgnCRM:
      traceSetEventColors(this, makeRGB(0, 0, 0), makeRGB(251, 222, 221));
      break;

      //Parameter configuration
    case pgnCML:
    case pgnCRO:
    case pgnCTS:
      traceSetEventColors(this, makeRGB(0, 0, 0), makeRGB(191, 236, 250));
      break;

      //Charging
    case pgnCCS:
      traceSetEventColors(this, makeRGB(0, 0, 0), makeRGB(191, 233, 216));
      break; 
    
      //Suspension of charging
    case pgnCST:
      traceSetEventColors(this, makeRGB(0, 0, 0), makeRGB(222, 199, 222));
      break;

      //End of charging
    case pgnCSD:
      traceSetEventColors(this, makeRGB(0, 0, 0), makeRGB(254, 237, 191));
      break;

      //Error
    case pgnCEM:
      traceSetEventColors(this, makeRGB(255, 0, 0), makeRGB(255, 255, 255));
      break;
    
  // ----- BMS colors -----
    //Handshake initiation
    case pgnBHM:
      traceSetEventColors(this, makeRGB(0, 0, 0), makeRGB(226, 225, 240));
      break;
  
    //Handshake recognition
    case pgnBRM:
      traceSetEventColors(this, makeRGB(0, 0, 0), makeRGB(251, 222, 221));
      break;
  
      //Parameter configuration
    case pgnBCP:
    case pgnBRO:
      traceSetEventColors(this, makeRGB(0, 0, 0), makeRGB(191, 236, 250));
      break;
  
      //Charging
    case pgnBCL:
    case pgnBCS:
    case pgnBMT:
    case pgnBMV:
    case pgnBSM:
    case pgnBSP:
      traceSetEventColors(this, makeRGB(0, 0, 0), makeRGB(191, 233, 216));
      break; 
    
      //Suspension of charging
    case pgnBST:
      traceSetEventColors(this, makeRGB(0, 0, 0), makeRGB(222, 199, 222));
      break;
  
      //End of charging
    case pgnBSD:
      traceSetEventColors(this, makeRGB(0, 0, 0), makeRGB(254, 237, 191));
      break;
  
      //Error
    case pgnBEM:
      traceSetEventColors(this, makeRGB(255, 0, 0), makeRGB(255, 255, 255));
      break;
  }
  output(this);
}
