/*@!Encoding:1252*/

/*
(July 2020)
This file contains code for the look and feel of the state diagram window for GB/T27930 nodes.
The states of the charger and BMS nodes are determined by the last message on the bus.

Vector Informatik - All rights reserved.

@author: visrio
*/

includes
{
  
}

variables
{
  const long cStateNameLen = 32;
  char cPanelTitle[16] = "StateDiagram";
  char[cStateNameLen] gStateBoxNames[ long ]; //holds the names of static text fields representing states.
  int gBROReceived = 0;
  int gCROReceived = 0;
  int gIsReset = 1;
  msTimer gMsTimer;
  int64 gLastTimeOccurred[long]; //map of PGNs and their last time they occurred. Used to fade out states.
  
  enum SuspendedCharging
  {
    eNone,
    eCharger,
    eBMS
  };
  
  enum SuspendedCharging gHasSuspendedCharging = eNone; //holds information of who has suspended the charging process.
  
  enum StateBoxColor
  {
    green = 0x00ED00,   //state reached
    red = 0xFF4500,     //state not reached, error message received
    gray = 0xCECECE,     //default after initialization
    lightGreen = 0xAAEDAA
  };
  
  //PG numbers are defined in GB/T27930 specifications.
  enum PGN
  {
    kCRM = 0x100,
    kBRM = 0x200,
    kBCP = 0x600,
    kCTS = 0x700,
    kCML = 0x800,
    kBRO = 0x900,
    kCRO = 0xA00,
    kBCL = 0x1000,
    kBCS = 0x1100,
    kCCS = 0x1200,
    kBSM = 0x1300,
    kBMV = 0x1500,
    kBMT = 0x1600,
    kBSP = 0x1700,
    kBST = 0x1900,
    kCST = 0x1A00,
    kBSD = 0x1C00,
    kCSD = 0x1D00,
    kBEM = 0x1E00,
    kCEM = 0x1F00,
    kDM1 = 0x2000,
    kDM2 = 0x2100,
    kDM3 = 0x2200,
    kDM4 = 0x2300,
    kDM5 = 0x2400,
    kDM6 = 0x2500,
    kCHM = 0x2600,
    kBHM = 0x2700
  };
}

On start
{
  AddAllStates();
  SetErrorMarkerVisibility();
}

//From Charger to BMS
on fct_called Charger.OnLastTransmittedMessageIdChanged
{
  switch($Charger.OnLastTransmittedMessageIdChanged.LatestCall.lastTxMessageId)
  {
      case kCRM:
        ResetIfNecessary();
        OnCRMReveived();
        break;
      case kCTS:
        gLastTimeOccurred[kCTS] = timeNowInt64();
        //CTS is optional, so it will only be displayed if it occurred on the bus.
        setControlVisibility(cPanelTitle, "state_CTS", 1); 
        SetState(kCTS, green);
        break;
      case kCML:
        gLastTimeOccurred[kCML] = timeNowInt64();
        SetState(kCML, green);
        break;
      case kCRO:
        OnCROReveived();
        break;
      case kCCS:
        OnCCSReceived();
        break;
      case kCST:
        OnCSTReceived();
        break;
      case kCSD:
        OnCSDReceived();
        break;
      case kCEM:
        OnCEMReceived();
        break;
      case kCHM:
        gLastTimeOccurred[kCHM] = timeNowInt64();
        ResetIfNecessary();
        SetState(kCHM, green);
        break;
      case kBHM:
        gLastTimeOccurred[kBHM] = timeNowInt64();
        SetState(kBHM, green);
        break;
      default:
        break;
  }
}
  //From BMS to Charger
on fct_called BMS.OnLastTransmittedMessageIdChanged
{
  switch($BMS.OnLastTransmittedMessageIdChanged.LatestCall.lastTxMessageId)
  {
    {
      case kBRM:
        gLastTimeOccurred[kBRM] = timeNowInt64();
        ResetIfNecessary();
        SetState(kBRM, green);
        break;
      case kBCP:
        gLastTimeOccurred[kBCP] = timeNowInt64();
        ResetIfNecessary();
        SetState(kBCP, green);
        break;
      case kBRO:
        ResetIfNecessary();
        OnBROReceived();
        break;
      case kBCL:
        gLastTimeOccurred[kBCL] = timeNowInt64();
        // Charging phase reached, so we will reset the diagram 
        // if a message of the negotiation phase is coming up again.
        gIsReset = 1;
        SetState(kBCL, green);
        break;
      case kBCS:
        gLastTimeOccurred[kBCS] = timeNowInt64();
        SetState(kBCS, green);
        break;
      case kBSM:
        gLastTimeOccurred[kBSM] = timeNowInt64();
        SetState(kBSM, green);
        break;
      case kBST:
        OnBSTReceived();
        break;
      case kBSD:
        OnBSDReceived();
        break;
      case kBEM:
        OnBEMReceived();
        break;
      case kBHM:
        gLastTimeOccurred[kBHM] = timeNowInt64();
        SetState(kBHM, green);
        break;
      default:
        break;
    }
  }
}

/*
Reset button pressed
*/
on sysvar StateDiagram::svReset
{
  if(@StateDiagram::svReset)
  {
    InitStateDiagram();
    AddAllStates();
    SetErrorMarkerVisibility();
  }
}

on sysvar GBT27930::svStart
{
  if(@GBT27930::svStart)
  {
    InitStateDiagram();
    AddAllStates();
    SetErrorMarkerVisibility();
  }
}

On timer gMsTimer
{
  int64 timeNow;
  timeNow = timeNowNS();
  
  for (long pgn : gLastTimeOccurred)
  {
    //500ms (or more) passed since the last message of this type occurred.
    if(timeNow - gLastTimeOccurred[pgn] > 500000000)
    {
      //Fade out of the state
      SetState(pgn, lightGreen);
    }
  }
}


void InitStateDiagram()
{
  long idx;
  gHasSuspendedCharging = eNone;
  gLastTimeOccurred.clear();
  SetState(0x100, gray);
  SetState(0x101, gray);
  SetState(0x200, gray);
  SetState(0x600, gray);
  SetState(0x700, gray);
  SetState(0x800, gray);
  SetState(0x900, gray);
  SetState(0x901, gray);
  SetState(0xA00, gray);
  SetState(0xA01, gray);
  SetState(0x1000, gray);
  SetState(0x1100, gray);
  SetState(0x1200, gray);
  SetState(0x1300, gray);
  SetState(0x1900, gray);
  SetState(0x1901, gray);
  SetState(0x1A00, gray);
  SetState(0x1A01, gray);
  SetState(0x1C00, gray);
  SetState(0x1C01, gray);
  SetState(0x1D00, gray);
  SetState(0x1D01, gray);
  SetState(0x1E00, gray);
  SetState(0x1F00, gray);
  SetState(0x2600, gray);
  SetState(0x2700, gray);
  
  SetErrorMarkerVisibility();
  setControlVisibility(cPanelTitle, "grp_suspendCharger", 0);
  setControlVisibility(cPanelTitle, "grp_suspendBMS", 0);
  setControlVisibility(cPanelTitle, "state_CTS", 0);
  gCROReceived = 0;
  gBROReceived = 0;
}

/*
Adds a key value pair to the associative field.
*/
void AddState(long pgnKey, char value[])
{
  strncpy(gStateBoxNames[pgnKey], value, cStateNameLen);
}

/*
Adds the names of the state "boxes" (static text fields) in the state diagram.
The names can be identified by the PGN.
Some PGNs are added as helper and are therefore not valid on the bus
but help to identify corresponding state boxes.
*/
void AddAllStates()
{
  gStateBoxNames.clear();
  AddState(0x2, "state_BMSTestCon");
  AddState(0x100, "state_CRMNotRecognized");
  AddState(0x101, "state_CRMRecognized"); //Helper (actually no GBT27930 pgn)
  AddState(0x200, "state_BRM");
  AddState(0x600, "state_BCP");
  AddState(0x700, "state_CTS");
  AddState(0x800, "state_CML");
  AddState(0x900, "state_BRONotReady");
  AddState(0x901, "state_BROReady"); //Helper
  AddState(0xA00, "state_CRONotReady");
  AddState(0xA01, "state_CROReady"); //Helper
  AddState(0x1000, "state_BCL");
  AddState(0x1100, "state_BCS");
  AddState(0x1200, "state_CCS");
  AddState(0x1300, "state_BSM");
  AddState(0x1900, "state_BST");
  AddState(0x1901, "state_BST_Charger"); //Helper
  AddState(0x1A00, "state_CST");
  AddState(0x1A01, "state_CST_Charger"); //Helper
  AddState(0x1C00, "state_BSD");
  AddState(0x1C01, "state_BSD_Charger"); //Helper
  AddState(0x1D00, "state_CSD");
  AddState(0x1D01, "state_CSD_Charger"); //Helper
  AddState(0x1E00, "state_BEM");
  AddState(0x1F00, "state_CEM");
  AddState(0x2600, "state_CHM");
  AddState(0x2700, "state_BHM");
}

/*
Changes the the background color of the state box identified by the corresponding PGN.
Only PGNs that are added to the associative field are valid values.
*/
void SetState(long pgn, enum StateBoxColor color)
{
  if(gStateBoxNames.containsKey(pgn))
  {
    setControlBackColor(cPanelTitle, gStateBoxNames[pgn], color);
  }
}

void OnCRMReveived()
{
  if($Charger.CategoryA.CRM.BMS_RecognitionResult == 0xAA)
  {
    gLastTimeOccurred[kCRM + 1] = timeNowInt64();
    SetState(kCRM + 1, green); //Waiting for Recognition
  }
  else
  {
    SetState(kCRM, green); //Sending Not Recognized
    gLastTimeOccurred[kCRM] = timeNowInt64();
  }
}

void OnBEMReceived()
{
  gIsReset = 1;
  
  if($BMS.CategoryA.BEM.Timeout_CCS)
  {
    SetState(kCCS, red);
    setControlVisibility(cPanelTitle, "err_CCS", 1);
  }
  if($BMS.CategoryA.BEM.Timeout_CRM_NotRecognized)
  {
    SetState(kCRM, red);
    setControlVisibility(cPanelTitle, "err_CRM", 1);
  }
  if($BMS.CategoryA.BEM.Timeout_CRM_Recognized)
  {
    setControlVisibility(cPanelTitle, "err_CRM_Recognized", 1);
    SetState(kCRM + 1, red);
  }
  if($BMS.CategoryA.BEM.Timeout_CRO)
  {
    if(gCROReceived)
    {
      SetState(kCRO + 1, red);
    }
    else
    {
      SetState(kCRO, red); 
    }
    setControlVisibility(cPanelTitle, "err_CRO", 1);
  }
  if($BMS.CategoryA.BEM.Timeout_CSD)
  {
    switch(gHasSuspendedCharging)
    {
      case eCharger:
        SetState(kCSD + 1, red);
        setControlVisibility(cPanelTitle, "err_CSD_Charger", 1);
        break;
      case eBMS:
        setControlVisibility(cPanelTitle, "err_CSD", 1);
        SetState(kCSD, red);
        break;
      default:
        break;
    }
  }
  if($BMS.CategoryA.BEM.Timeout_CST)
  {
    write("CST received");
    switch(gHasSuspendedCharging)
    {
      case eCharger:
        SetState(kCST + 1, red);
        setControlVisibility(cPanelTitle, "err_CST_Charger", 1);
        break;
      case eBMS:
        SetState(kCST, red);
        setControlVisibility(cPanelTitle, "err_CST", 1);
        break;
      default:
        break;
    }
  }
  if($BMS.CategoryA.BEM.Timeout_CTS_CML)
  {
    setControlVisibility(cPanelTitle, "err_CTS_CML", 1);
    SetState(kCML, red);
  }
}

void OnCEMReceived()
{
  gIsReset = 1;
  if($BMS.CategoryA.CEM.Timeout_BCL)
  {
    setControlVisibility(cPanelTitle, "err_BCL", 1);
    SetState(kBCL, red);
  }
  if($BMS.CategoryA.CEM.Timeout_BCP)
  {
    setControlVisibility(cPanelTitle, "err_BCP", 1);
    SetState(kBCP, red);
  }
  if($BMS.CategoryA.CEM.Timeout_BCS)
  {
    setControlVisibility(cPanelTitle, "err_BCS", 1);
    SetState(kBCS, red);
  }
  if($BMS.CategoryA.CEM.Timeout_BRM)
  {
    setControlVisibility(cPanelTitle, "err_BRM", 1);
    SetState(kBRM, red);
  }
  if($BMS.CategoryA.CEM.Timeout_BRO)
  {
    if(gBROReceived)
    {
      SetState(kBRO + 1, red);
    }
    else
    {
      SetState(kBRO, red);
    }
    setControlVisibility(cPanelTitle, "err_BRO", 1);
  }
  if($BMS.CategoryA.CEM.Timeout_BSD)
  {
    switch(gHasSuspendedCharging)
    {
      case eCharger:
        setControlVisibility(cPanelTitle, "err_BSD_Charger", 1);
        SetState(kBSD + 1, red);
        break;
      case eBMS:
        SetState(kBSD, red);
        setControlVisibility(cPanelTitle, "err_BSD", 1);
        break;
      default:
        break;
    }
  }
  if($BMS.CategoryA.CEM.Timeout_BST)
  {
    switch(gHasSuspendedCharging)
    {
      case eCharger:
        setControlVisibility(cPanelTitle, "err_BST_Charger", 1);
        SetState(kBST + 1, red);
        break;
      case eBMS:
        SetState(kBST, red);
        setControlVisibility(cPanelTitle, "err_BST", 1);
        break;
      default:
        break;
    }
  }
}

void OnCROReveived()
{
  gCROReceived = 1;
  if($Charger.CategoryA.CRO.ChargerReadyForCharging == 0xAA)
  {
    gLastTimeOccurred[kCRO + 1] = timeNowInt64();
    SetState(kCRO + 1, green);
  }
  else
  {
    SetState(kCRO, green);
    gLastTimeOccurred[kCRO] = timeNowInt64(); 
  }

}

void OnBROReceived()
{
  if($BMS.CategoryA.BRO.BMSReadyForCharging == 0xAA)
  {
    gLastTimeOccurred[kBRO + 1] = timeNowInt64();
    SetState(kBRO + 1, green);
  }
  else
  {
    SetState(kBRO, green);
    gLastTimeOccurred[kBRO] = timeNowInt64();
  }
  gBROReceived = 1;
}

void OnCCSReceived()
{
  gLastTimeOccurred[kCCS] = timeNowInt64();
  SetState(kCCS, green);
}

void OnCSTReceived()
{
  //if CST is the first message, BMS did suspend the charging process
  if(gHasSuspendedCharging == eNone)
  {
    gHasSuspendedCharging = eCharger;
    UpdateView(gHasSuspendedCharging);
  }
  //The diagram representation depends on who has suspended charging.
  //In fact there are two different group boxes holding the corresponding elements.
  switch(gHasSuspendedCharging)
  {
    case eCharger:
      gLastTimeOccurred[kCST + 1] = timeNowInt64();
      SetState(kCST + 1, green);
      break;
    case eBMS:
      gLastTimeOccurred[kCST] = timeNowInt64();
      SetState(kCST, green);
      break;
    default:
      SetState(kCST, red);
      SetState(kCST + 1, red);
      break;
  }
}

void OnBSTReceived()
{
  //if BST is the first message, BMS did suspend the charging process
  if(gHasSuspendedCharging == eNone)
  {
    gHasSuspendedCharging = eBMS;
    UpdateView(gHasSuspendedCharging);
  }
  //The diagram representation depends on who has suspended charging.
  //In fact there are two different group boxes holding the corresponding elements.
  switch(gHasSuspendedCharging)
  {
    case eCharger:
      gLastTimeOccurred[kBST + 1] = timeNowInt64();
      SetState(kBST + 1, green);
      break;
    case eBMS:
      gLastTimeOccurred[kBST] = timeNowInt64();
      SetState(kBST, green);
      break;
    default:
      SetState(kBST, red);
      SetState(kBST + 1, red);
      break;
  }
}

void OnBSDReceived()
{
  //The diagram representation depends on who has suspended charging.
  //In fact there are two different group boxes holding the corresponding elements.
  switch(gHasSuspendedCharging)
  {
    case eCharger:
      gLastTimeOccurred[kBSD + 1] = timeNowInt64();
      SetState(kBSD + 1, green);
      break;
    case eBMS:
      gLastTimeOccurred[kBSD] = timeNowInt64();
      SetState(kBSD, green);
      break;
    default:
      SetState(kBSD, red);
      SetState(kBSD + 1, red);
      break;
  }
}

void OnCSDReceived()
{
  //The diagram representation depends on who has suspended charging.
  //In fact there are two different group boxes holding the corresponding elements.
  switch(gHasSuspendedCharging)
  {
    case eCharger:
      gLastTimeOccurred[kCSD + 1] = timeNowInt64();
      SetState(kCSD + 1, green);
      break;
    case eBMS:
      gLastTimeOccurred[kCSD] = timeNowInt64();
      SetState(kCSD, green);
      break;
    default:
      SetState(kCSD, red);
      SetState(kCSD + 1, red);
      break;
  }
}

void ResetIfNecessary()
{
  if(gIsReset)
  {
    InitStateDiagram();
    SetErrorMarkerVisibility();
    gIsReset = 0;
    gMsTimer.setCyclic(50);
  }
}

/*
There are two different state diagrams possible dependend on the node that
suspends charging. E.g. if the Charger suspends the charging process,
the CST message is sent before the BST message but if the BMS supsends,
the BST message is sent before the CST message and therefore we need two 
different orders.
Sets the visibility of the group box containing the correct order.
*/
void UpdateView(enum SuspendedCharging sc)
{
  switch(sc)
  {
    case eNone:
      setControlVisibility(cPanelTitle, "grp_suspendBMS", 1);
      setControlVisibility(cPanelTitle, "grp_suspendCharger", 0);
      break;
    case eCharger:
      setControlVisibility(cPanelTitle, "grp_suspendCharger", 1);
      setControlVisibility(cPanelTitle, "grp_suspendBMS", 0);
      break;
    case eBMS:
      setControlVisibility(cPanelTitle, "grp_suspendBMS", 1);
      setControlVisibility(cPanelTitle, "grp_suspendCharger", 0);
      break;
    default:
      setControlVisibility(cPanelTitle, "grp_suspendBMS", 1);
      setControlVisibility(cPanelTitle, "grp_suspendCharger", 0);
      break;
  }
}

/*
On error a red lightning will be displayed at the corresponding transition.
Since this is done by setting up the visibility, we need to make them invisible first.
*/
void SetErrorMarkerVisibility()
{
  setControlVisibility(cPanelTitle, "err_CRM", 0);
  setControlVisibility(cPanelTitle, "err_CRM_Recognized", 0);
  setControlVisibility(cPanelTitle, "err_CML", 0);
  setControlVisibility(cPanelTitle, "err_CRO", 0);
  setControlVisibility(cPanelTitle, "err_CCS", 0);
  setControlVisibility(cPanelTitle, "err_CST", 0);
  setControlVisibility(cPanelTitle, "err_CST_Charger", 0);
  setControlVisibility(cPanelTitle, "err_CSD", 0);
  setControlVisibility(cPanelTitle, "err_CSD_Charger", 0);
  setControlVisibility(cPanelTitle, "err_BRM", 0);
  setControlVisibility(cPanelTitle, "err_BCP", 0);
  setControlVisibility(cPanelTitle, "err_BRO", 0);
  setControlVisibility(cPanelTitle, "err_BCL", 0);
  setControlVisibility(cPanelTitle, "err_BCS", 0);
  setControlVisibility(cPanelTitle, "err_BST_Charger", 0);
  setControlVisibility(cPanelTitle, "err_BST", 0);
  setControlVisibility(cPanelTitle, "err_BSD", 0);
  setControlVisibility(cPanelTitle, "err_BSD_Charger", 0);
  setControlVisibility(cPanelTitle, "err_CTS_CML", 0);
  
  setControlBackColor(cPanelTitle, "err_CRM", red);
  setControlBackColor(cPanelTitle, "err_CRM_Recognized", red);
  setControlBackColor(cPanelTitle, "err_CML", red);
  setControlBackColor(cPanelTitle, "err_CRO", red);
  setControlBackColor(cPanelTitle, "err_CCS", red);
  setControlBackColor(cPanelTitle, "err_CST", red);
  setControlBackColor(cPanelTitle, "err_CSD", red);
  setControlBackColor(cPanelTitle, "err_CST_Charger", red);
  setControlBackColor(cPanelTitle, "err_CSD_Charger", red);
  setControlBackColor(cPanelTitle, "err_BRM", red);
  setControlBackColor(cPanelTitle, "err_BCP", red);
  setControlBackColor(cPanelTitle, "err_BRO", red);
  setControlBackColor(cPanelTitle, "err_BCL", red);
  setControlBackColor(cPanelTitle, "err_BCS", red);
  setControlBackColor(cPanelTitle, "err_BST_Charger", red);
  setControlBackColor(cPanelTitle, "err_BST", red);
  setControlBackColor(cPanelTitle, "err_BSD", red);
  setControlBackColor(cPanelTitle, "err_BSD_Charger", red);
  setControlBackColor(cPanelTitle, "err_CTS_CML", red); 
}
