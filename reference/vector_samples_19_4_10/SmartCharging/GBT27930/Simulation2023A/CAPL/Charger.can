/*@!Encoding:1252*/
includes
{
  #include "GBT_HW_Interface_EVSE.cin"
}

variables
{
  enum PGN
  {
    kCRM = 0x100,
    kBRM = 0x200,
    kBCP = 0x600,
    kCTS = 0x700,
    kCML = 0x800,
    kBRO = 0x900,
    kCRO = 0xA00,
    kBCL = 0x1000,
    kBCS = 0x1100,
    kCCS = 0x1200,
    kBSM = 0x1300,
    kBMV = 0x1500,
    kBMT = 0x1600,
    kBSP = 0x1700,
    kBST = 0x1900,
    kCST = 0x1A00,
    kBSD = 0x1C00,
    kCSD = 0x1D00,
    kBEM = 0x1E00,
    kCEM = 0x1F00,
    kDM1 = 0x2000,
    kDM2 = 0x2100,
    kDM3 = 0x2200,
    kDM4 = 0x2300,
    kDM5 = 0x2400,
    kDM6 = 0x2500,
    kCHM = 0x2600,
    kBHM = 0x2700
  };
  
  dword msStartOfChargingMS = 0;
  msTimer tmrUpdatePanel;
  word currentChargerStatus;
  word lastChargerStatus;
  char gPanelName[8] = "Charger";
  enum eMode
  {
    Ready = 0,
    Starting,
    InsulationTest,
    PreCharge,
    Charging,
    Stopping,
    Error
  };
  enum eMode Mode = Ready;
  
  enum eMeasurementStatus
  {
    Running = 0,
    Stop = 1
  };
  enum eMeasurementStatus measurementState = Stop;
  
  enum eTargetReached
  {
    RequiredSOC = 0,
    RequiredSingleVoltage = 1,
    RequiredTotalVoltage = 2,
    TargetNotReached = 4
  };
  enum eTargetReached targetReachedStatus = TargetNotReached;
  const double cPreChargeMinimumCurrent = 0.5;
  const double cInsulationTestVoltage = 1000.0;
  const int cInsulationTestDurationMs = 500;
  const double cBatteryVoltageTolerance = 5.0;
  const double cMinOutputVoltage = 120;
  const double cMaxOutputVoltage = 1000;
  
  dword gInsulationTestStartTime = 0;
  dword gPreChargeStartTime = 0;
  
  enum eMode PresentMode = Ready;
  
  const deferStopTime = 1000;
  msTimer tOpenHVonMeasurementStop;
  const cOpenHVonMeasurementStopDelay = 500;
  msTimer tActionsAfterContactorOpen;
  const cActionsAfterContactorOpenDelay = 100;
  
  msTimer stateTransitionTimer;
  msTimer sendCyclicCHMMessage;
  msTimer sendCyclicCRMMessage;
  msTimer sendCyclicCTSMessage;
  msTimer sendCyclicCMLMessage;
  msTimer sendCyclicCROMessage;
  msTimer sendCyclicCCSMessage;
  msTimer sendCyclicCSTMessage;
  msTimer sendCyclicCSDMessage;
  msTimer sendCyclicCEMMessage;
  
  // Message cycle time in ms;
  word messageCycleTimeCHM = 250;
  word messageCycleTimeCRM = 250;
  word messageCycleTimeCTS = 500;
  word messageCycleTimeCML = 250;
  word messageCycleTimeCRO = 250;
  word messageCycleTimeCCS = 50;
  word messageCycleTimeCST = 10;
  word messageCycleTimeCSD = 250;
  word messageCycleTimeCEM = 250;
  
  const deferConnectionControlSequence = 50;
  msTimer tmrConnectionControlSequence;
  enum eConnectionControlSequnece
  {
    T0 = 0,
    T1, 
    T2, 
    T3,
    T4,
    T5,
    T19,
    T20,
    T21
  };
  word gConnectionControlSequence;
  int gConnectionControlSequenceCounter;
  double cCP1VoltageTolerance = 0.5;
}

/////////////////////////////////////////////////////////////////////////////////////
/*--------------------------------------Timer--------------------------------------*/
/////////////////////////////////////////////////////////////////////////////////////

on timer stateTransitionTimer
{
  switch(currentChargerStatus)
    {
      case 1: 
        break;
      case 2: // BHM received & Charger self-check succeded -> stop CHM, start CRM
        cancelTimer(sendCyclicCHMMessage);
        StartTimerIfNotRunning(sendCyclicCRMMessage, 0);
        break;
      case 3: 
        break;
      case 4: // Received BRM -> set CRM recogniction SPN2560=0xAA
        @sysvar::GBT27930::Charger::CRM::svBMSRecognitionResult = 0xAA;
        break;
      case 5:
        break;
      case 6: // Received BCP -> stop CRM; send CML/CTS
        cancelTimer(sendCyclicCRMMessage);
        if(@sysvar::GBT27930::Charger::svCTSEnabled) // Optional message: Charger time syncronization (CTS)
        {
          StartTimerIfNotRunning(sendCyclicCTSMessage, 0);
        }
        StartTimerIfNotRunning(sendCyclicCMLMessage, 0);
        break;
      case 7: 
        break;
      case 8: // Received BRO -> stop CML/CTS; send CRO (not ready) SPN2829=0x00
        cancelTimer(sendCyclicCTSMessage);
        cancelTimer(sendCyclicCMLMessage);
        StartTimerIfNotRunning(sendCyclicCROMessage, 0);
        break;
      case 9: // CRO (not ready) SPN2829=0x00 -> set CRO (ready) SPN2829=0xAA
        @sysvar::GBT27930::Charger::CRO::svReadyForCharging = 0xAA;
        break;
      case 10:
        break;
      case 11: // Received BCL -> stop CRO; send CCS
        cancelTimer(sendCyclicCROMessage);
        StartTimerIfNotRunning(sendCyclicCCSMessage, 0);
        break;
      case 12:
        break;
      case 13: // Received BST -> stop CCS; send CST
        cancelTimers();
        StartTimerIfNotRunning(sendCyclicCSTMessage, 0);
        break;
      case 14:
        break;
      case 15: // Receieved BSD -> stop CST; send CSD
        cancelTimer(sendCyclicCSTMessage);
        StartTimerIfNotRunning(sendCyclicCSDMessage, 0);
        break;
      case 16: // Stop CSD sending after user-defnied time
        cancelTimers();
        currentChargerStatus = 17;
      case 50:
        cancelTimers();
        break;
      default:
        break;
    }
}

on timer sendCyclicCHMMessage
{
  SendCHM();
  setTimer(sendCyclicCHMMessage, messageCycleTimeCHM);
}

on timer sendCyclicCRMMessage
{
  SendCRM();
  setTimer(sendCyclicCRMMessage, messageCycleTimeCRM);
}

on timer sendCyclicCTSMessage
{
  SendCTS();
  setTimer(sendCyclicCTSMessage, messageCycleTimeCTS);
}

on timer sendCyclicCMLMessage
{
  SendCML();
  setTimer(sendCyclicCMLMessage, messageCycleTimeCML);
}

on timer sendCyclicCROMessage
{
  SendCRO();
  setTimer(sendCyclicCROMessage, messageCycleTimeCRO);
}

on timer sendCyclicCCSMessage
{
  SendCCS();
  setTimer(sendCyclicCCSMessage, messageCycleTimeCCS);
}

on timer sendCyclicCSTMessage
{
  SendCST();
  setTimer(sendCyclicCSTMessage, messageCycleTimeCST);
}

on timer sendCyclicCSDMessage
{
  SendCSD();
  setTimer(sendCyclicCSDMessage, messageCycleTimeCSD);
}

on timer sendCyclicCEMMessage
{
  SendCEM();
  setTimer(sendCyclicCEMMessage, messageCycleTimeCEM);
}

void StartTimerIfNotRunning(msTimer myTimer, long timeout)
{
  if(!isTimerActive(myTimer))
    setTimer(myTimer, timeout);
}

void CancelTimers()
{
  cancelTimer(stateTransitionTimer);
  cancelTimer(sendCyclicCHMMessage);
  cancelTimer(sendCyclicCRMMessage);
  cancelTimer(sendCyclicCMLMessage);
  cancelTimer(sendCyclicCTSMessage);
  cancelTimer(sendCyclicCSTMessage);
  cancelTimer(sendCyclicCROMessage);
  cancelTimer(sendCyclicCCSMessage);
  cancelTimer(sendCyclicCSDMessage);
  cancelTimer(sendCyclicCEMMessage);
} 

/////////////////////////////////////////////////////////////////////////////////////
/*--------------------------------------Control------------------------------------*/
/////////////////////////////////////////////////////////////////////////////////////

on start 
{
  lastChargerStatus = 0;
  SetChargerPanelColor(Running);
  CHA_set_voltage_CP1(6.0); // Simulation only: Switch S closed, but vehicle not connected
  ST_Init();
}

on preStop
{
  SetChargingStationMode(Ready); 
  deferStop(deferStopTime);
  setTimer(tOpenHVonMeasurementStop, cOpenHVonMeasurementStopDelay); // delay to ensure reduce of current and voltage
  SetChargingStationPicturesVisibility(Ready);
  SetChargerPanelColor(Stop);
  HV_source_set_I_DC(cPreChargeMinimumCurrent);
  HV_source_set_U_DC(HV_measure_DC_U_VeriVolt());
}

on timer tOpenHVonMeasurementStop
{
  HV_source_set_U_DC(0);
  HV_source_set_I_DC(0);
  
  HV_open_close_K1K2(OPEN);
  
  CHA_set_auxiliary_voltage(0.0);
  CHA_open_close_K3K4(OPEN); // T17
  open_close_lock(OPEN); // T18
  gConnectionControlSequence = T19;
  CHA_open_close_S(OPEN); 
  CHA_set_voltage_CP1(6.0); // Simulation only: Switch S open and vehicle fully connected
  setTimerCyclic(tmrConnectionControlSequence, deferConnectionControlSequence);
  SetTimer(tActionsAfterContactorOpen, cActionsAfterContactorOpenDelay);
}

void SetChargingStationMode(enum eMode Mode)
{
  PresentMode = Mode;
  SetChargingStationPicturesVisibility(Mode);
  if(Mode == Error)
  {
    writeLineEx(-3,1,"Current A: %d", abs(HV_measure_DC_I()));
    PrepareForContactorsOpen();
  }
}

int IsVoltageWithinRange(double refVoltage, double measVoltage, double range )
{
  return ( measVoltage-range < refVoltage &&  
       refVoltage < measVoltage+range );
}

on timer tActionsAfterContactorOpen
{
  ST_Reset();
  cancelTimers();
}

void StartCommunication()
{
  CancelTimers();
  StartTimerIfNotRunning(sendCyclicCHMMessage, @sysvar::GBT27930::Charger::DelayTransition::svK3K4_to_CHM);
}

void SuspendCharging()
{
  if (currentChargerStatus != 12)
  {
    cancelTimers();
  }
  currentChargerStatus = 13; // Sending of CCS; delayed start of CST is initiated. Is skipped when BMS initializes the end of charging.
  StartTimerIfNotRunning(stateTransitionTimer, @sysvar::GBT27930::Charger::DelayTransition::svBST_to_CST);
  SetChargingStationPicturesVisibility(Error);
  PrepareForContactorsOpen();
}

void PrepareForContactorsOpen()
{
  HV_source_set_I_DC(cPreChargeMinimumCurrent);
  HV_source_set_U_DC(HV_measure_DC_U_VeriVolt());
}

void VehicleMessageTimeout()
{
  cancelTimers();
  StartTimerIfNotRunning(sendCyclicCEMMessage, 0);
}

void ChargerTargetReached(int isBMSsuspending )
{
  if(isBMSsuspending)
  {
    @sysvar::GBT27930::Charger::CST::svBmsActivelySuspends = 1;
  }
  else
  {
    @sysvar::GBT27930::Charger::CST::svConditionReached = 1;
  }
  SetChargingStationPicturesVisibility(Ready); 
  SetCurrentChargerStatus(13); // Sending of CCS; delayed start of CST is initiated. Is skipped when BMS initializes the end of charging.
  StartTimerIfNotRunning(stateTransitionTimer, @sysvar::GBT27930::Charger::DelayTransition::svBST_to_CST);
}

on sysvar GBT27930::svStart
{
  currentChargerStatus = 0;
  lastChargerStatus = 0;
  
  if(@this == 1)
  {  
    HV_source_reset();
    CHA_set_auxiliary_voltage(0.0);
    
    Disconnect_CAN();
    HV_open_close_K1K2(OPEN);
    CHA_open_close_K3K4(OPEN);
    CHA_open_Close_S(OPEN); //Plug-out starting
    Disconnect_CC1();
    Disconnect_CC2();
    CHA_open_close_S(CLOSE); //Plug-out completed
  }
  else
  {
    PresentMode = Ready;
    gInsulationTestStartTime = 0;
    ResetAllGroups();
    //Reset / clean start of relays
    HV_open_close_K1K2(OPEN);
    CHA_open_close_K3K4(OPEN);
    CHA_open_close_S(CLOSE);
        
    Connect_CAN();
    @sysvar::GBT27930::Charger::CRM::svBMSRecognitionResult = 0x00;
    @sysvar::GBT27930::Charger::CRO::svReadyForCharging = 0x00;
    if (CompareWithTolerance(CHA_measure_voltage_CP1(), 6.0 /*V*/, cCP1VoltageTolerance))
    {
      gConnectionControlSequence = T0;
    } 
    else if (CompareWithTolerance(CHA_measure_voltage_CP1(), 4.0 /*V*/, cCP1VoltageTolerance))
    { 
      gConnectionControlSequence = T2;
      WriteLineEx(-3,1,"Charger: Vehicle Connector seems to be already fully connected. Skipping Connection Control Sequence.");
    }
    else 
    {
      WriteLineEx(-3,3,"Charger: Check Point 1 Voltage is not in range. Please make sure cable is either unconnected or fully connected and switch S is not pressed.");
    }
    gConnectionControlSequenceCounter = 0;
    setTimerCyclic(tmrUpdatePanel, 100);
    setTimerCyclic(tmrConnectionControlSequence, deferConnectionControlSequence);
  }
}

on timer tmrConnectionControlSequence
{
  switch(gConnectionControlSequence)
  {
    case(T0): // coupler not connected, switch S not pressed - Press (open) switch S 
      gConnectionControlSequenceCounter++;
      CHA_open_close_S(OPEN); // Plug-in starting (after T0)
      CHA_set_voltage_CP1(12.0); // Simulation only: Switch S open, but vehicle not connected
      if (CompareWithTolerance(CHA_measure_voltage_CP1(), 12.0 /*V*/, cCP1VoltageTolerance))
      {
        gConnectionControlSequence = T1;
        gConnectionControlSequenceCounter = 0;
      }
      else if (gConnectionControlSequenceCounter == 2) // give relay time before reporting
        WriteLineEx(-3,1,"Charger: Vehicle coupler is not connected. Press connector switch S and connect plug cable into vehicle inlet.");
      break;
    case(T1): // coupler not connected, switch S pressed - Press connect coupler
      gConnectionControlSequenceCounter++;
      Connect_CC1(); // PlugIn Cable 
      Connect_CC2(); // PlugIn Cable
      CHA_set_voltage_CP1(6.0); // Simulation only: Switch S open and vehicle fully connected
      if (CompareWithTolerance(CHA_measure_voltage_CP1(), 6.0 /*V*/, cCP1VoltageTolerance))
      {
        gConnectionControlSequence = T2;
        gConnectionControlSequenceCounter = 0;
      }
      else if (gConnectionControlSequenceCounter == 2) // give relay time before reporting
        WriteLineEx(-3,1,"Charger: Vehicle coupler is not fully connected. Keep the connector switch S pressed and connect plug cable into vehicle inlet.");
      break;
    case(T2): // coupler connected, switch S still pressed -  Release (close) switch S 
      gConnectionControlSequenceCounter++;
      CHA_open_close_S(CLOSE);
      CHA_set_voltage_CP1(4.0); // Simulation only: Switch S closed and vehicle fully connected
      open_close_lock(CLOSE); //T2' Electronic lock feedback
      if (CompareWithTolerance(CHA_measure_voltage_CP1(), 4.0 /*V*/, cCP1VoltageTolerance))
      {
        gConnectionControlSequence = T3;
        gConnectionControlSequenceCounter = 0;
      }
      else if (gConnectionControlSequenceCounter == 2) // give relay time before reporting
        WriteLineEx(-3,1,"Charger: Vehicle coupler is not fully connected. Once the cable is fully inserted into the vehicle inlet, please release the connector switch S.");
      break;
    case(T3):
    CHA_open_close_K3K4(CLOSE); //T3
      gConnectionControlSequence = T4;
      break;
    case(T4):
      /* Initiate data interaction */
      cancelTimer(tmrConnectionControlSequence);
      msStartOfChargingMS = 0;
      SetChargingStationPicturesVisibility(Ready);
      StartCommunication();
      SetChargingStationMode(Starting);
      CHA_set_auxiliary_voltage(cAux_voltage);
      break;
    case(T19): // press Switch S
    case(T20): // plugOut
      gConnectionControlSequenceCounter++;
      if (CompareWithTolerance(CHA_measure_voltage_CP1(), 6.0 /*V*/, cCP1VoltageTolerance))
      {
        open_close_lock(OPEN); // T18 Electronic lock feedback
        CHA_open_close_S(OPEN); // Plug-out starting (after T0)
        CHA_set_voltage_CP1(12.0); // Simulation only: Switch S is open but vehicle is still fully connected
        gConnectionControlSequence = T20;
      }
      if (CompareWithTolerance(CHA_measure_voltage_CP1(), 12.0 /*V*/, cCP1VoltageTolerance))
      {
        Disconnect_CC1();
        Disconnect_CC2();
        CHA_set_voltage_CP1(6.0); // Simulation only: Switch S is open and vehicle disconnected
        gConnectionControlSequence = T21;        
        gConnectionControlSequenceCounter = 0;
      }
      else if (gConnectionControlSequenceCounter == 4) // give relay time before reporting
        WriteLineEx(-3,1,"Charger: Vehicle coupler is not disconnected yet. Please press the connector switch S and remove cable from vehicle socket.");
      break;
    case(T21):
      gConnectionControlSequenceCounter++;
      if (CompareWithTolerance(CHA_measure_voltage_CP1(), 6.0 /*V*/, cCP1VoltageTolerance))
      {
        cancelTimer(tmrConnectionControlSequence);
        WriteLineEx(-3,1,"Charger: Vehicle coupler is fully disconnected and switch S is detected as released.");
        gConnectionControlSequenceCounter = 0;
      }
      else if (gConnectionControlSequenceCounter == 2) // give relay time before reporting
        WriteLineEx(-3,1,"Charger: Vehicle coupler is not fully disconnected yet. Please release the connector switch S.");
      break;
    case(T5): //Sanity check in case connection state is increased incorrectly
    default:
        WriteLineEx(-3,1,"Charger: Reached undefined state in connection control sequence");  
      break;
  }
}

word CompareWithTolerance(double testValue, double targetValue, double tolerance)
{
  if (testValue > targetValue - tolerance && testValue < targetValue + tolerance)
  {
    return 1;
  }
  return 0;
}

dword timeNowMs()
{
  return timeNow()/100;
}

void ResetVariables()
{
  lastChargerStatus = 0;
  gInsulationTestStartTime = 0;
  gPreChargeStartTime = 0;
}

On sysvar GBT27930::Charger::svInterruptCCS
{
  if (12 <= currentChargerStatus <= 13)
  {
    if(@this == 1)
    {
      cancelTimer(sendCyclicCCSMessage);
    }
    else
    {
      StartTimerIfNotRunning(sendCyclicCCSMessage, 0);
    }
  }
}

on sysvar GBT27930::Charger::svSuspendCharging
{
  if(@this == 1)
  {
    SuspendCharging();
    SetChargingStationMode(Error);
  }
}

on sysvar GBT27930::Charger::svSuspendCharging2
{
  if(@this == 0)
    return;
  
  //1. Set whole payload to 0x00
  @sysvar::GBT27930::Charger::CST::svConditionReached = 0;
  @sysvar::GBT27930::Charger::CST::svManualSuspension = 0;
  @sysvar::GBT27930::Charger::CST::svFaultSuspension = 0;
  @sysvar::GBT27930::Charger::CST::svBmsActivelySuspends = 0;
  @sysvar::GBT27930::Charger::CST::svChargerOverTemp = 0;
  @sysvar::GBT27930::Charger::CST::svChargingConnectorFault = 0;
  @sysvar::GBT27930::Charger::CST::svChargerInternalOverTemp = 0;
  @sysvar::GBT27930::Charger::CST::svCannotSupplyRequiredPower = 0;
  @sysvar::GBT27930::Charger::CST::svEmergencyStop = 0;
  @sysvar::GBT27930::Charger::CST::svOtherFault = 0;
  @sysvar::GBT27930::Charger::CST::svSelfCheckFault = 0;
  @sysvar::GBT27930::Charger::CST::svPreChargeFault = 0;
  @sysvar::GBT27930::Charger::CST::svCurrentMismatchError = 0;
  @sysvar::GBT27930::Charger::CST::svAbnormalVoltageError = 0;
  @sysvar::GBT27930::Charger::CST::svChargingParametersMismatchError = 0;
  //2. Set selected signal to "1"
  switch(@GBT27930::Charger::svCauseOfSuspendingCharging)
{
    case 1  : @sysvar::GBT27930::Charger::CST::svConditionReached                = 1; break;
    case 2  : @sysvar::GBT27930::Charger::CST::svManualSuspension                = 1; break;
    case 3  : @sysvar::GBT27930::Charger::CST::svFaultSuspension                 = 1; break;
    case 4  : @sysvar::GBT27930::Charger::CST::svBmsActivelySuspends             = 1; break;
    case 5  : @sysvar::GBT27930::Charger::CST::svChargerOverTemp                 = 1; break;
    case 6  : @sysvar::GBT27930::Charger::CST::svChargingConnectorFault          = 1; break;
    case 7  : @sysvar::GBT27930::Charger::CST::svChargerInternalOverTemp         = 1; break;
    case 8  : @sysvar::GBT27930::Charger::CST::svCannotSupplyRequiredPower       = 1; break;
    case 9  : @sysvar::GBT27930::Charger::CST::svEmergencyStop                   = 1; break;
    case 10 : @sysvar::GBT27930::Charger::CST::svOtherFault                      = 1; break;
    case 11 : @sysvar::GBT27930::Charger::CST::svSelfCheckFault                  = 1; break;
    case 12 : @sysvar::GBT27930::Charger::CST::svPreChargeFault                  = 1; break;
    case 13 : @sysvar::GBT27930::Charger::CST::svCurrentMismatchError            = 1; break;
    case 14 : @sysvar::GBT27930::Charger::CST::svAbnormalVoltageError            = 1; break;
    case 15 : @sysvar::GBT27930::Charger::CST::svChargingParametersMismatchError = 1; break;
}
  
  //3. Suspend charging (start sending of CST)
  SuspendCharging();
  SetChargingStationMode(Error);
}

on sysvar GBT27930::Charger::svStopChargingWithError
{
  if(@this == 1)
  {
    VehicleMessageTimeout();
    SetChargingStationMode(Error);
  }
  SetChargingStationMode(Ready);
}

on sysvar GBT27930::Charger::svStopChargingWithError2
{
  if(@this == 1)
  {  
    //1. Set whole payload to 0x00
    @sysvar::GBT27930::Charger::CEM::svTimeout_BRM = 0;
    @sysvar::GBT27930::Charger::CEM::svTimeout_BCP = 0;
    @sysvar::GBT27930::Charger::CEM::svTimeout_BRO = 0;
    @sysvar::GBT27930::Charger::CEM::svTimeout_BCS = 0;
    @sysvar::GBT27930::Charger::CEM::svTimeout_BCL = 0;
    @sysvar::GBT27930::Charger::CEM::svTimeout_BST = 0;
    @sysvar::GBT27930::Charger::CEM::svTimeout_BSD = 0;
    @sysvar::GBT27930::Charger::CEM::svTimeout_BSM = 0;
        
    //2. Set selected signal to "1"
    switch(@GBT27930::Charger::svTimeoutOfMsg)
    {
      case 1: @sysvar::GBT27930::Charger::CEM::svTimeout_BRM = 1; break;
      case 2: @sysvar::GBT27930::Charger::CEM::svTimeout_BCP = 1; break;
      case 3: @sysvar::GBT27930::Charger::CEM::svTimeout_BRO = 1; break;
      case 4: @sysvar::GBT27930::Charger::CEM::svTimeout_BCS = 1; break;
      case 5: @sysvar::GBT27930::Charger::CEM::svTimeout_BCL = 1; break;
      case 6: @sysvar::GBT27930::Charger::CEM::svTimeout_BST = 1; break;
      case 7: @sysvar::GBT27930::Charger::CEM::svTimeout_BSD = 1; break;
    }
    
    //3. Send Charger Error Message
    VehicleMessageTimeout();
    SetChargingStationMode(Error);
  }
  else 
    SetChargingStationMode(Ready);
}

void SetCurrentChargerStatus(int state){
  if (currentChargerStatus < state)
  {
    currentChargerStatus = state;
  }
}

void EnterErrorState()
{
  SetChargingStationMode(Error);
  PrepareForContactorsOpen();
}

/////////////////////////////////////////////////////////////////////////////////////
/*--------------------------------Message Handling---------------------------------*/
/////////////////////////////////////////////////////////////////////////////////////

on fct_called Charger.OnLastTransmittedMessageIdChanged
{
  switch($Charger.OnLastTransmittedMessageIdChanged.LatestCall.lastTxMessageId)
  {
      case kCHM:
        SetCurrentChargerStatus(1); // Sending of CHM
        break;
      case kCRM:
        if($Charger.CategoryA.CRM.BMS_RecognitionResult.phys == 0x00)
          SetCurrentChargerStatus(3); // Sending of CRM (BMS is not recognized)
        else if ($Charger.CategoryA.CRM.BMS_RecognitionResult.phys == 0xAA)
          SetCurrentChargerStatus(5); // Sending of CRM (BMS is recognized)
        break;
      case kCTS:
        break;
      case kCML:
        SetCurrentChargerStatus(7); // Sending of CML
        break;
      case kCRO:
        if(@sysvar::GBT27930::Charger::CRO::svReadyForCharging == 0x00 && currentChargerStatus==8)
        {
          SetCurrentChargerStatus(9); // Sending of CRO (Not ready for charging); delayed start of CRO (Ready for charging) is initiated
          // set CRO recognized (SPN2830=0xAA) after user-defined transistion time
          StartTimerIfNotRunning(stateTransitionTimer, @sysvar::GBT27930::Charger::DelayTransition::svCRO_not_ready_to_CRO_ready); 
        }
        else if(@sysvar::GBT27930::Charger::CRO::svReadyForCharging == 0xAA)
        {
          SetCurrentChargerStatus(10); // Sending of CRO (Ready for charging)
        }
        break;
      case kCCS:
        SetChargingStationPicturesVisibility(Charging);
        SetCurrentChargerStatus(12); // Sending of CCS
        if(msStartOfChargingMS == 0)
        {
          msStartOfChargingMS = timeNowInt64() / 1000000;
        }
        break;
      case kCST:
        SetCurrentChargerStatus(14); // Sending of CST
        break;
      case kCSD:
        if (currentChargerStatus==15)
        {
          SetCurrentChargerStatus(16);
          StartTimerIfNotRunning(stateTransitionTimer, @sysvar::GBT27930::Charger::DelayTransition::svCSD_to_End);
        }
        break;
      case kCEM:
        if (currentChargerStatus != 50)
        {
          StartTimerIfNotRunning(stateTransitionTimer, 1500);
          SetCurrentChargerStatus(50);
        }
        break;
      default:
        // Handle for PGN not implemented
        break;
  }
}

on fct_called Charger.OnLastReceivedMessageIdChanged
{
  int chargingMode;
  double voltage, current;
  switch($Charger.OnLastReceivedMessageIdChanged.LatestCall.lastRxMessageId)
  {
      case kBHM:
        if( PresentMode == Starting) {
          ResetVariables();
	        SetChargingStationMode(InsulationTest);
        } 
        
        if( gInsulationTestStartTime == 0 ) 
        {
          if(HV_measure_DC_U_VeriVolt() < 10) // ensure vehicle contactors opened
          {
            HV_open_close_K1K2(CLOSE);  // Charger closes contactors
            HV_source_set_I_DC(cPreChargeMinimumCurrent); // user parameter to ensure voltage can be increased
            HV_source_set_U_DC(cInsulationTestVoltage); // apply test voltage => default 1000V
            
            // enable the insulation monitor
            HV_enable_insulation_state(1);
            
            gInsulationTestStartTime = timeNowMs();
            writelineex(-4,1,"Charger: Insulation test started");
          }
          else {
            EnterErrorState();
          }
        }
        else if( (timeNowMs() - gInsulationTestStartTime) > cInsulationTestDurationMs ) 
        {
          // terminate insulation test
          HV_source_set_I_DC(0);
          HV_source_set_U_DC(0);
          
          // disable the insulation monitor
          HV_enable_insulation_state(0);
          if(HV_measure_DC_U_VeriVolt() < 60 && currentChargerStatus==1)
          {
            HV_open_close_K1K2(OPEN);
            writelineex(-4,1,"Charger: finishing Insulation test");
            SetCurrentChargerStatus(2); // Sending of CHM; delayed start of CRM (BMS is not recognized) is initiated
            StartTimerIfNotRunning(stateTransitionTimer, @sysvar::GBT27930::Charger::DelayTransition::svBHM_to_CRM_not_recognized);
          }
        }
        else if ( gInsulationTestStartTime > 0 ) 
        {
          // during insulation test
          stack long status = HV_get_insulation_state( 1 );
          
          if( status == 2) {
            writelineex(-4,3,"Insulation test failed");
            EnterErrorState();
          }
        }
        break;
      case kBRM:
        if(@sysvar::GBT27930::Charger::CRM::svBMSRecognitionResult == 0x00 && currentChargerStatus==3)
        {
          SetCurrentChargerStatus(4); // Sending of CRM (BMS is not recognized); delayed start of CRM (BMS is recognized) is initiated
          // set CRM recognized (SPN2560=0xAA) after user-defined transistion time
          StartTimerIfNotRunning(stateTransitionTimer, @sysvar::GBT27930::Charger::DelayTransition::svBRM_to_CRMrecognized); 
        }
        break;
      case kBCP:
        if(currentChargerStatus==5)
        {
          SetCurrentChargerStatus(6); // Sending of CRM (BMS is recognized); delayed start of CML is initiated
          StartTimerIfNotRunning(stateTransitionTimer, @sysvar::GBT27930::Charger::DelayTransition::svBCP_to_CML);
        }
        break;
      case kBRO:
        if( PresentMode == InsulationTest) {
          SetChargingStationMode(PreCharge);
        } 
          
        if (gPreChargeStartTime == 0 && $Charger.CategoryA.BRO.BMSReadyForCharging == 0xAA ) // BMS is ready for charging
        {
          stack double outerVoltage;
      
          writeLineEx(-4,1,"PreCharge started");
          
          gPreChargeStartTime = timeNowMs();  
          
          outerVoltage = HV_measure_DC_U_VeriVolt();
          // TODO: "normal voltage criteria
          // 1. compare measured Battery voltage with communicated battery voltage <= +/- 5% ?
          // 2. battery voltage between min/max of charger output limits
          if( (outerVoltage < cMinOutputVoltage || outerVoltage > cMaxOutputVoltage) // crit. #2
              /* || (crit #1, we don't care) */ ) 
          {
            EnterErrorState();
            writeLineEx(-4,3,"outerVoltage: %f", outerVoltage);
            writeLineEx(-4,3,"cMinOutputVoltage: %f", cMinOutputVoltage);
            writeLineEx(-4,3,"cMaxOutputVoltage: %f", cMaxOutputVoltage);
            writeLineEx(-4,3,"Normal Voltage Criteria not met. Fault level (2)");
          }
       } 
       else if( gPreChargeStartTime > 0 )
       {
          stack double outerVoltage, chargerVoltage;
          
          outerVoltage = HV_measure_DC_U_VeriVolt();
          chargerVoltage = HV_measure_DC_U();
          HV_source_set_U_DC(outerVoltage);
          HV_source_set_I_DC(cPreChargeMinimumCurrent);
          
          //check with tolerance (upper / lower limit) specification: (1V~10V)
          if(IsVoltageWithinRange(chargerVoltage, outerVoltage, cBatteryVoltageTolerance))
          {
            HV_open_close_K1K2(CLOSE);
            // currentChargerStatus = 7 until BRO with SPN2829=0xAA is received
            if(currentChargerStatus==7)
            {
              SetCurrentChargerStatus(8); // Sending of CML; delayed start of CRO (Not ready for charging) is initiated
              StartTimerIfNotRunning(stateTransitionTimer, @sysvar::GBT27930::Charger::DelayTransition::svBRO_ready_to_CRO_not_ready);        
            }
          }
        }
        break;
      case kBCL:       
        if($Charger.CategoryA.BRO.BMSReadyForCharging == 0xAA && currentChargerStatus==10)
        {
          SetCurrentChargerStatus(11); // Sending of CRO (Ready for charging); delayed start of CCS is initiated
          StartTimerIfNotRunning(stateTransitionTimer, @sysvar::GBT27930::Charger::DelayTransition::svBCS_to_CCS);
        }
        
        HV_open_close_K1K2(CLOSE);
        if($Charger.CategoryA.BCL.ChargingMode == 1)                   // Constant Voltage
        {
          HV_source_set_U_DC($Charger.CategoryA.BCL.VoltageDemand.impl);
          HV_source_set_I_DC((double)$Charger.CategoryA.CML.MaxChargingCurrent.phys);
        }
        else if($Charger.CategoryA.BCL.ChargingMode == 2)              // Constant Current
        {
          HV_source_set_I_DC($Charger.CategoryA.BCL.CurrentDemand.impl);
          HV_source_set_U_DC(_min($Charger.CategoryA.BCP.MaxAllowedTotalChargingVoltage.phys, $Charger.CategoryA.CML.MaxChargingVoltage.phys));
        }
        break;
      case kBCS:
        if( PresentMode == PreCharge) {
          SetChargingStationMode(Charging);
        }
        break;
      case kBSM:
        break;
      case kBMV:
        break;
      case kBMT:
        break;
      case kBSP:
        if( PresentMode == Charging) {
          SetChargingStationMode(Stopping);
        }
        break;
      case kBST:
        if ($Charger.CategoryA.BST.RequiredSocTargetValue.phys == 1      ||  // required SOC reached
            $Charger.CategoryA.BST.SettingValueOfSingleVoltage.phys == 1 ||  // required single voltage reached
            $Charger.CategoryA.BST.SettingValueOfTotalVoltage.phys == 1)     // required total voltage reached
        {
          @sysvar::GBT27930::Charger::CST::svBmsActivelySuspends = 1;
          SetChargingStationPicturesVisibility(Ready);
        }
        else 
        {
          SetChargingStationPicturesVisibility(Error);
          PrepareForContactorsOpen();
        }
        if (currentChargerStatus<=12)
        {
          SetCurrentChargerStatus(13); // Sending of CCS; delayed start of CST is initiated. Is skipped when BMS initializes the end of charging.
          StartTimerIfNotRunning(stateTransitionTimer, @sysvar::GBT27930::Charger::DelayTransition::svBST_to_CST);
        }
        break;
      case kBSD:
        if (currentChargerStatus==14)
        {
          SetCurrentChargerStatus(15);
          StartTimerIfNotRunning(stateTransitionTimer, @sysvar::GBT27930::Charger::DelayTransition::svBSD_to_CSD);
        }
        break;
      case kBEM:
        if(currentChargerStatus != 50) 
        {
          SetCurrentChargerStatus(50);
          SetChargingStationMode(Error);
          PrepareForContactorsOpen();
          StartTimerIfNotRunning(stateTransitionTimer, 1000);
        }
        break;
  }
}

void SendCCS()
{
  @sysvar::GBT27930::Charger::CCS::svVoltageOutputValue = ((@sysvar::GBT27930::Charger::CCS::svVoltageOutputValue + $Charger.CategoryA.BCL.VoltageDemand.phys) / 2)* (0.995 + random(100)/ 10000.0);
  @sysvar::GBT27930::Charger::CCS::svCumulativeChargingTime = (timeNowInt64() / 1000000 - msStartOfChargingMS) / 60000;
  @sysvar::GBT27930::Charger::CCS::svCurrentOutputValue = ((@sysvar::GBT27930::Charger::CCS::svCurrentOutputValue + $Charger.CategoryA.BCL.CurrentDemand.phys) / 2)* (0.995 + random(100)/ 10000.0);
  @sysvar::GBT27930::Charger::svCalculatedOutputEnergy = abs(@sysvar::GBT27930::Charger::CCS::svCurrentOutputValue * @sysvar::GBT27930::Charger::CCS::svVoltageOutputValue / 1000) * (timeNowInt64() / 1000000 - msStartOfChargingMS) / 3600000;
  if(@sysvar::GBT27930::Charger::svInterruptCCS == 0)
  {
    $Charger.CategoryA.CCS.CumulativeChargingTime = @sysvar::GBT27930::Charger::CCS::svCumulativeChargingTime;
    $Charger.CategoryA.CCS.VoltageOutputValue.phys = @sysvar::GBT27930::Charger::CCS::svVoltageOutputValue;    
    $Charger.CategoryA.CCS.CurrentOutputValue.phys = @sysvar::GBT27930::Charger::CCS::svCurrentOutputValue;
    $Charger.CategoryA.CCS.ChargingPermissible.phys = @sysvar::GBT27930::Charger::CCS::svChargingPermissible;
  }
  if (@sysvar::GBT27930::Charger::CCS::svChargingPermissible == 0 /*Suspension*/)
  {
    writeLineEx(-3,1,"Charging suspension via CCS is currently not supported in this Simulation.");
  }
}

void SendCSD()
{
  @sysvar::GBT27930::Charger::CSD::svCumulativeChargingTime = @sysvar::GBT27930::Charger::CCS::svCumulativeChargingTime;
  @sysvar::GBT27930::Charger::CSD::svOutputEnergy = @sysvar::GBT27930::Charger::svCalculatedOutputEnergy;
  $Charger.CategoryA.CSD.OutputEnergy.phys = @sysvar::GBT27930::Charger::svCalculatedOutputEnergy;
  $Charger.CategoryA.CSD.ChargerNo.impl = @sysvar::GBT27930::Charger::CSD::svChargerNo;
  $Charger.CategoryA.CSD.CumulativeChargingTime = @sysvar::GBT27930::Charger::CSD::svCumulativeChargingTime;
}

void SendCHM()
{
  $Charger.CategoryA.CHM.MajorChargerVersion = @sysvar::GBT27930::Charger::CHM::svMajorChargerVersion; 
  $Charger.CategoryA.CHM.MinorChargerVersion = @sysvar::GBT27930::Charger::CHM::svMinorChargerVersion; 
}

void SendCTS()
{
  $Charger.CategoryA.CTS.TimeSyncInformation.Second.phys = @sysvar::GBT27930::Charger::CTS::svTimeSyncInformationSecond;
  $Charger.CategoryA.CTS.TimeSyncInformation.Minute.phys = @sysvar::GBT27930::Charger::CTS::svTimeSyncInformationMinute;
  $Charger.CategoryA.CTS.TimeSyncInformation.Hour.phys = @sysvar::GBT27930::Charger::CTS::svTimeSyncInformationHour;
  $Charger.CategoryA.CTS.TimeSyncInformation.Day.phys = @sysvar::GBT27930::Charger::CTS::svTimeSyncInformationDay;
  $Charger.CategoryA.CTS.TimeSyncInformation.Month.phys = @sysvar::GBT27930::Charger::CTS::svTimeSyncInformationMonth;
  $Charger.CategoryA.CTS.TimeSyncInformation.Year.phys = @sysvar::GBT27930::Charger::CTS::svTimeSyncInformationYear;
}

void SendCML()
{
  $Charger.CategoryA.CML.MaxChargingCurrent.phys = @sysvar::GBT27930::Charger::CML::svMaxOutputCurrent;
  $Charger.CategoryA.CML.MinChargingCurrent.phys = @sysvar::GBT27930::Charger::CML::svMinOutputCurrent;
  $Charger.CategoryA.CML.MaxChargingVoltage.phys = @sysvar::GBT27930::Charger::CML::svMaxOutputVoltage;
  $Charger.CategoryA.CML.MinChargingVoltage.phys = @sysvar::GBT27930::Charger::CML::svMinOutputVoltage;
}

void SendCRO()
{
  $Charger.CategoryA.CRO.ChargerReadyForCharging = @sysvar::GBT27930::Charger::CRO::svReadyForCharging;
}

void SendCST()
{
  $Charger.CategoryA.CST.ConditionReached = @sysvar::GBT27930::Charger::CST::svConditionReached;
  $Charger.CategoryA.CST.ManualSuspension = @sysvar::GBT27930::Charger::CST::svManualSuspension;
  $Charger.CategoryA.CST.FaultSuspension = @sysvar::GBT27930::Charger::CST::svFaultSuspension;
  $Charger.CategoryA.CST.BmsActivelySuspends = @sysvar::GBT27930::Charger::CST::svBmsActivelySuspends;
  $Charger.CategoryA.CST.ChargerOverTemp = @sysvar::GBT27930::Charger::CST::svChargerOverTemp;
  $Charger.CategoryA.CST.ChargingConnectorFault = @sysvar::GBT27930::Charger::CST::svChargingConnectorFault;
  $Charger.CategoryA.CST.ChargerInternalOverTemp = @sysvar::GBT27930::Charger::CST::svChargerInternalOverTemp;
  $Charger.CategoryA.CST.CannotSupplyRequiredPower = @sysvar::GBT27930::Charger::CST::svCannotSupplyRequiredPower;
  $Charger.CategoryA.CST.EmergencyStop = @sysvar::GBT27930::Charger::CST::svEmergencyStop;
  $Charger.CategoryA.CST.OtherFault = @sysvar::GBT27930::Charger::CST::svOtherFault;
  $Charger.CategoryA.CST.SelfCheckFault = @sysvar::GBT27930::Charger::CST::svSelfCheckFault;
  $Charger.CategoryA.CST.PreChargeFault = @sysvar::GBT27930::Charger::CST::svPreChargeFault;
  $Charger.CategoryA.CST.CurrentMismatchError = @sysvar::GBT27930::Charger::CST::svCurrentMismatchError;
  $Charger.CategoryA.CST.AbnormalVoltageError = @sysvar::GBT27930::Charger::CST::svAbnormalVoltageError;
  $Charger.CategoryA.CST.ChargingParametersMismatchError = @sysvar::GBT27930::Charger::CST::svChargingParametersMismatchError;
}

void SendCRM()
{
  char buf[4];
  dword textAsDWord;

  sysGetVariableString(sysvar::GBT27930::Charger::svChargerLocation, buf, elcount(buf));
  $Charger.CategoryA.CRM.ChargerLocation = buf;
  $Charger.CategoryA.CRM.ChargerNumber = @sysvar::GBT27930::Charger::CRM::svChargerNumber;
  $Charger.CategoryA.CRM.BMS_RecognitionResult = @sysvar::GBT27930::Charger::CRM::svBMSRecognitionResult;
}

void SendCEM()
{
  $Charger.CategoryA.CEM.Timeout_BRM = @sysvar::GBT27930::Charger::CEM::svTimeout_BRM;
  $Charger.CategoryA.CEM.Timeout_BCP = @sysvar::GBT27930::Charger::CEM::svTimeout_BCP;
  $Charger.CategoryA.CEM.Timeout_BRO = @sysvar::GBT27930::Charger::CEM::svTimeout_BRO;
  $Charger.CategoryA.CEM.Timeout_BCS = @sysvar::GBT27930::Charger::CEM::svTimeout_BCS;
  $Charger.CategoryA.CEM.Timeout_BCL = @sysvar::GBT27930::Charger::CEM::svTimeout_BCL;
  $Charger.CategoryA.CEM.Timeout_BST = @sysvar::GBT27930::Charger::CEM::svTimeout_BST;
  $Charger.CategoryA.CEM.Timeout_BSD = @sysvar::GBT27930::Charger::CEM::svTimeout_BSD;
  $Charger.CategoryA.CEM.Timeout_BSM = @sysvar::GBT27930::Charger::CEM::svTimeout_BSM;
}

/////////////////////////////////////////////////////////////////////////////////////
/*-----------------------------------Presentation----------------------------------*/
/////////////////////////////////////////////////////////////////////////////////////

void ResetAllGroups()
{
  setDefaultControlColors(gPanelName, "groupCHM");
  setDefaultControlColors(gPanelName, "groupCRM");
  setDefaultControlColors(gPanelName, "groupCML");
  setDefaultControlColors(gPanelName, "groupCTS");
  setDefaultControlColors(gPanelName, "groupCRO");
  setDefaultControlColors(gPanelName, "groupCCS");
  setDefaultControlColors(gPanelName, "groupCST");
  setDefaultControlColors(gPanelName, "groupCEM");
  setDefaultControlColors(gPanelName, "groupCSD");
}

on timer tmrUpdatePanel
{
  long clrInactive, clrActive, clrChanging, clrBackActive;
  clrInactive = MakeRGB(0,0,0);
  clrActive = MakeRGB(0, 128, 0);
  clrChanging = MakeRGB(128, 0, 0);
  clrBackActive = MakeRGB(224, 224, 255);
  
  if(lastChargerStatus != currentChargerStatus)
  {
    switch(currentChargerStatus)
    {
      case 1: //Sending of CHM
        setControlForeColor(gPanelName, "groupCHM"   , clrActive);
        setControlBackColor(gPanelName, "groupCHM"   , clrBackActive);        
        break;
        
      case 2: //Sending of CHM; delayed start of CRM (BMS is not recognized) is initiated
        setControlForeColor(gPanelName, "groupCHM"   , clrChanging);
        setControlBackColor(gPanelName, "groupCHM"   , clrBackActive);
        break;
        
      case 3: //Sending of CRM (BMS is not recognized)
        setDefaultControlColors(gPanelName, "groupCHM");

        setControlForeColor(gPanelName, "groupCRM"   , clrActive);
        setControlBackColor(gPanelName, "groupCRM"   , clrBackActive);
        
        break;

      case 4: //Sending of CRM (BMS is not recognized); delayed start of CRM (BMS is recognized) is initiated
      case 5: //Sending of CRM (BMS is recognized)
        break;

      case 6: //Sending of CRM (BMS is recognized); delayed start of CML is initiated
        setControlForeColor(gPanelName, "groupCRM"   , clrChanging);
        setControlBackColor(gPanelName, "groupCRM"   , clrBackActive);
        break;
        
      case 7: //Sending of CML
        setDefaultControlColors(gPanelName, "groupCRM");

        setControlForeColor(gPanelName, "groupCML"   , clrActive);
        setControlBackColor(gPanelName, "groupCML"   , clrBackActive);
        setControlForeColor(gPanelName, "groupCTS"   , clrActive);
        setControlBackColor(gPanelName, "groupCTS"   , clrBackActive);
        break;

      case 8: //Sending of CML; delayed start of CRO (Not ready for charging) is initiated
        setControlForeColor(gPanelName, "groupCML"   , clrChanging);
        setControlBackColor(gPanelName, "groupCML"   , clrBackActive);
        setControlForeColor(gPanelName, "groupCTS"   , clrChanging);
        setControlBackColor(gPanelName, "groupCTS"   , clrBackActive);
        break;
        
      case 9: //Sending of CRO (Not ready for charging); delayed start of CRO (Ready for charging) is initiated
        setDefaultControlColors(gPanelName, "groupCML");
        setDefaultControlColors(gPanelName, "groupCTS");

        setControlForeColor(gPanelName, "groupCRO"   , clrActive);
        setControlBackColor(gPanelName, "groupCRO"   , clrBackActive);
        break;
        
      case 10: //Sending of CRO (Ready for charging)
        break;
        
      case 11: //Sending of CRO (Ready for charging); delayed start of CCS is initiated
        setControlForeColor(gPanelName, "groupCRO"   , clrChanging);
        setControlBackColor(gPanelName, "groupCRO"   , clrBackActive);
        break;

      case 12: //Sending of CCS
        setDefaultControlColors(gPanelName, "groupCRO");
        
        setControlForeColor(gPanelName, "groupCCS"   , clrActive);
        setControlBackColor(gPanelName, "groupCCS"   , clrBackActive);
        break;

      case 13: //Sending of CCS; delayed start of CST is initiated
        setControlForeColor(gPanelName, "groupCCS"   , clrChanging);
        setControlBackColor(gPanelName, "groupCCS"   , clrBackActive);
        break;
        
      case 14: //Sending of CST
        setDefaultControlColors(gPanelName, "groupCCS");

        setControlForeColor(gPanelName, "groupCST"   , clrActive);
        setControlBackColor(gPanelName, "groupCST"   , clrBackActive);
        StartTimerReadyToOpen_K1_K2(100);
        break;
        
      case 15: //Sending of CST; delayed start of CSD is initiated
        setControlForeColor(gPanelName, "groupCST"   , clrChanging);
        setControlBackColor(gPanelName, "groupCST"   , clrBackActive);
        StartTimerReadyToOpen_K1_K2(100);
        break;
        
      case 16: //Sending of CSD; delayed stop of CSD is initiated 
        setDefaultControlColors(gPanelName, "groupCST");

        setControlForeColor(gPanelName, "groupCSD"   , clrActive);
        setControlBackColor(gPanelName, "groupCSD"   , clrBackActive);
        break;

      case 17: //End of charging
        setDefaultControlColors(gPanelName, "groupCSD");
        HV_source_reset();
        if(CHA_measure_voltage_CP1() >= 4.1 || CHA_measure_voltage_CP1() <= 3.9) //~4V
          StartTimerReadyToOpen_K1_K2(50);
        else
          StartTimerReadyToOpen_K1_K2(100);
        CHA_open_close_K3K4(OPEN);
        break;
        
      case 50: //Sending of CEM
        ResetAllGroups();
        setControlForeColor(gPanelName, "groupCEM"   , clrActive);
        setControlBackColor(gPanelName, "groupCEM"   , clrBackActive);
        break;
    }
    lastChargerStatus = currentChargerStatus;
  }  
  setTimer(tmrUpdatePanel, 100);
}

void SetChargerPanelColor(int measurementState)
{
  long foreColor;
  long backColor;
  // measurementState == Running - default state
  foreColor = MakeRGB(0, 0, 0);
  backColor = MakeRGB(255, 255, 255);
  
  if(measurementState == Stop)
  {
    foreColor = MakeRGB(112, 112, 112);
    backColor = MakeRGB(224, 224, 224);
  }
  setControlForeColor(gPanelName, "editK3K4toChm"        , foreColor);
  setControlForeColor(gPanelName, "editCrmNotRecognized" , foreColor);
  setControlForeColor(gPanelName, "editCrmRecognized"    , foreColor);
  setControlForeColor(gPanelName, "editCmlCts"           , foreColor);
  setControlForeColor(gPanelName, "editCroReady"         , foreColor);
  setControlForeColor(gPanelName, "editCroNotReady"      , foreColor);
  setControlForeColor(gPanelName, "editCcs"              , foreColor);
  setControlForeColor(gPanelName, "editCst"              , foreColor);
  setControlForeColor(gPanelName, "editCsd"              , foreColor);
  setControlForeColor(gPanelName, "editEnd"              , foreColor);
  setControlForeColor(gPanelName, "editMissBcp"          , foreColor);
  setControlForeColor(gPanelName, "editMissBroNotReady"  , foreColor);
  setControlForeColor(gPanelName, "editMissBroReady"     , foreColor);
  setControlForeColor(gPanelName, "editMissBcl"          , foreColor);
  setControlForeColor(gPanelName, "editMissBcs"          , foreColor);
  setControlForeColor(gPanelName, "editMissBst"          , foreColor);
  setControlForeColor(gPanelName, "editMissBrm"          , foreColor);
  setControlForeColor(gPanelName, "editMissBsd"          , foreColor);
  
  
  setControlBackColor(gPanelName, "editK3K4toChm"        , backColor);
  setControlBackColor(gPanelName, "editCrmNotRecognized" , backColor);
  setControlBackColor(gPanelName, "editCrmRecognized"    , backColor);
  setControlBackColor(gPanelName, "editCmlCts"           , backColor);
  setControlBackColor(gPanelName, "editCroReady"         , backColor);
  setControlBackColor(gPanelName, "editCroNotReady"      , backColor);
  setControlBackColor(gPanelName, "editCcs"              , backColor);
  setControlBackColor(gPanelName, "editCst"              , backColor);
  setControlBackColor(gPanelName, "editCsd"              , backColor);
  setControlBackColor(gPanelName, "editEnd"              , backColor);
  setControlBackColor(gPanelName, "editMissBcp"          , backColor);
  setControlBackColor(gPanelName, "editMissBroNotReady"  , backColor);
  setControlBackColor(gPanelName, "editMissBroReady"     , backColor);
  setControlBackColor(gPanelName, "editMissBcl"          , backColor);
  setControlBackColor(gPanelName, "editMissBcs"          , backColor);
  setControlBackColor(gPanelName, "editMissBst"          , backColor);
  setControlBackColor(gPanelName, "editMissBrm"          , backColor);
  setControlBackColor(gPanelName, "editMissBsd"          , backColor);
}

void SetChargingStationPicturesVisibility(enum eMode Mode)
{  
  If(Mode == Ready)
  {
   SetControlVisibility(gPanelName, "pictureChargingStationReady", 1);
   SetControlVisibility(gPanelName, "pictureChargingStationCharging", 0);
   SetControlVisibility(gPanelName, "pictureChargingStationError", 0);
  }
  else If(Mode == Charging)
  {
   SetControlVisibility(gPanelName, "pictureChargingStationReady", 0);
   SetControlVisibility(gPanelName, "pictureChargingStationCharging", 1);
   SetControlVisibility(gPanelName, "pictureChargingStationError", 0);
  }
  else If(Mode == Error)
  {
   SetControlVisibility(gPanelName, "pictureChargingStationReady", 0);
   SetControlVisibility(gPanelName, "pictureChargingStationCharging", 0);
   SetControlVisibility(gPanelName, "pictureChargingStationError", 1);
  }
}

/////////////////////////////////////////////////////////////////////////////////////
/*-----------------------------------Key Inputs------------------------------------*/
/////////////////////////////////////////////////////////////////////////////////////

on key 'n'
{
  if(@GBT27930::svStart == 0)
  {
    @GBT27930::svStart = 1;
  }
  else
  {
    @GBT27930::svStart = 0;
  }
}
