/*@!Encoding:1252*/
includes
{
  
}

variables
{
  
}



ST_Init()
{
  
  @sysvar::VTS::VT_EVSE::Relay_K1 = 0;
  @sysvar::VTS::VT_EVSE::Relay_K2 = 0;
  @sysvar::VTS::VT_EVSE::Relay_K3 = 0;
  @sysvar::VTS::VT_EVSE::Relay_K4 = 0;
  @sysvar::VTS::VT_EVSE::Relay_K5 = 0;
  @sysvar::VTS::VT_EVSE::Relay_K6 = 0;
  @sysvar::VTS::VT_EVSE::Relay_K7 = 0;
  @sysvar::VTS::VT_EVSE::Relay_K8 = 0;
  @sysvar::VTS::VT_EVSE::Relay_K9 = 1; // Set required relays for CE functionality
  @sysvar::VTS::VT_EVSE::Relay_K10 = 1; // Set required relays for CE functionality
  @sysvar::VTS::VT_EVSE::Relay_K11 = 0;
  @sysvar::VTS::VT_EVSE::Relay_K12 = 0;
  @sysvar::VTS::VT_EVSE::Relay_K13 = 0;
  @sysvar::VTS::VT_EVSE::Relay_K14 = 0;
  @sysvar::VTS::VT_EVSE::Relay_K15 = 0;
  @sysvar::VTS::VT_EVSE::Relay_K16 = 0;
  @sysvar::VTS::VT_EVSE::Relay_K17 = 0;
  @sysvar::VTS::VT_EVSE::Relay_K18 = 0;
  @sysvar::VTS::VT_EVSE::Relay_K19 = 0;
  @sysvar::VTS::VT_EVSE::Relay_K20 = 0;
  @sysvar::VTS::VT_EVSE::Relay_K21 = 0;
  @sysvar::VTS::VT_EVSE::Relay_K22 = 0;
  @sysvar::VTS::VT_EVSE::Relay_K23 = 0;
  @sysvar::VTS::VT_EVSE::Relay_K24 = 0;
  @sysvar::VTS::VT_EVSE::Relay_K25 = 0;
  @sysvar::VTS::VT_EVSE::Relay_K26 = 0;
  @sysvar::VTS::VT_EVSE::Relay_K27 = 1; //Set bypass for voltage measurement Vs3
  @sysvar::VTS::VT_EVSE::Relay_K28 = 0;
  @sysvar::VTS::VT_EVSE::Relay_K29 = 1; //Set bypass for voltage measurement Vs3
  @sysvar::VTS::VT_EVSE::Relay_K31 = 0;
  @sysvar::VTS::VT_EVSE::Relay_K32 = 0;
  @sysvar::VTS::VT_EVSE::Relay_K33 = 0;
  @sysvar::VTS::VT_EVSE::Relay_K34 = 0;
  @sysvar::VTS::VT_EVSE::Relay_K35 = 0;
  @sysvar::VTS::VT_EVSE::Relay_K36 = 0;
  @sysvar::VTS::VT_EVSE::Relay_K37 = 0;
  @sysvar::VTS::VT_EVSE::Relay_K38 = 0;
  @sysvar::VTS::VT_EVSE::Relay_K39 = 0;
  @sysvar::VTS::VT_EVSE::Relay_K40 = 0;
  @sysvar::VTS::VT_EVSE::Relay_K41 = 0;
  @sysvar::VTS::VT_EVSE::Relay_K42 = 0;
  @sysvar::VTS::VT_EVSE::Relay_K43 = 0;
  @sysvar::VTS::VT_EVSE::Relay_K46 = 1; // Set required relays for CE functionality
  @sysvar::VTS::VT_EVSE::Relay_K47 = 1; // Set required relays for CE functionality
  @sysvar::VTS::VT_EVSE::Relay_K48 = 1; // Set required relays for CE functionality
  @sysvar::VTS::VT_EVSE::Relay_K52 = 0;
  @sysvar::VTS::VT_EVSE::Relay_K53 = 0;
  @sysvar::VTS::VT_EVSE::Relay_K54 = 0;
  @sysvar::VTS::VT_EVSE::Relay_K55 = 0;
  @sysvar::VTS::VT_EVSE::Relay_K56 = 0;
  @sysvar::VTS::VT_EVSE::Relay_K57 = 0;
  @sysvar::VTS::VT_EVSE::Relay_K58 = 0;
  @sysvar::VTS::VT_EVSE::Relay_K59 = 0;
  @sysvar::VTS::VT_EVSE::Relay_K60 = 0;
  @sysvar::VTS::VT_EVSE::Relay_K61 = 0;
  @sysvar::VTS::VT_EVSE::Relay_K62 = 0;
  @sysvar::VTS::VT_EVSE::Relay_K63 = 0;
  @sysvar::VTS::VT_EVSE::Relay_K65 = 1; // Set required relays for CE functionality
  @sysvar::VTS::VT_EVSE::Relay_K66 = 0; // Set required relays for CE functionality
  @sysvar::VTS::VT_EVSE::Relay_K67 = 1; // Set required relays for ID functionality without real Outlet (10kOhm)
  @sysvar::VTS::VT_EVSE::Relay_K68 = 0;
  @sysvar::VTS::VT_EVSE::Relay_K69 = 0;
  @sysvar::VTS::VT_EVSE::Relay_K82 = 0; // Set required relays for ID functionality with real Outlet (10kOhm)
  @sysvar::VTS::VT_EVSE::Relay_K85 = 0;
  
  @sysvar::VTS::VT_EVSE::StimulationMode = 1; //Set required voltage for CE functionality
  @sysvar::VTS::VT_EVSE::StimConstVoltage = 5; //Set required voltage for CE functionality
  
  @sysvar::VTS::VT_EVSE::StimVoltageHigh = 0; //Disable PWM
  @sysvar::VTS::VT_EVSE::StimVoltageLow = 0; //Disable PWM
  @sysvar::VTS::VT_EVSE::StimDutyCycle = 0; //Disable PWM
  @sysvar::VTS::VT_EVSE::StimFrequency = 1000; //Disable PWM
  
  // Set required resistors and switches 
  @sysvar::SECC::IEC61851::Rs4 = 270;
  @sysvar::SECC::IEC61851::Rs5 = 220; 
  @sysvar::SECC::IEC61851::Ss3 = 0;
  

}

/// <CharINInterface>
void ST_Reset()
{
  ST_Init();
}

/// <CharINInterface>
ST_PlugIn()
{
  @sysvar::VTS::VT_EVSE::Relay_K1 = 1;
  @sysvar::VTS::VT_EVSE::Relay_K26 = 1;
  @sysvar::VTS::VT_EVSE::Relay_K28 = 1;
  pluggedIn = 1;
}

/// <CharINInterface>
ST_PlugOut()
{
  @sysvar::VTS::VT_EVSE::Relay_K1 = 0;
  @sysvar::VTS::VT_EVSE::Relay_K26 = 0;
  @sysvar::VTS::VT_EVSE::Relay_K28 = 0;
  pluggedIn = 0;
  expectedCEState = State_A;
}


on sysvar_update VTS::VT_EVSE::MeasPPVoltage
{
  @sysvar::SECC::IEC61851::Vs2_ID_SE = @this;
  
}

on sysvar_update VTS::VT_EVSE::MeasVoltageHigh
{
 @sysvar::SECC::IEC61851::Vs3_CE_SE = @this; 
}

on sysvar_update SECC::IEC61851::Ss3
{
  if(@this == 1)
  {
    @sysvar::VTS::VT_EVSE::Resistance = 210; // 10 Ohm Bypass resistance for low pass filter considerd
  }
  else
  {
    @sysvar::VTS::VT_EVSE::Resistance = 480; // 10 Ohm Bypass resistance for low pass filter considerd
  }
}

on value_update EVSE.StimCPState
{
  switch ($this)
  {
    // CE state A0/B0/C0 (EVSE not ready for HLC)
    case _CCS::DataTypes::CPStateType::State_A:
      setCEstateA();
      SetChargingStationPicturesVisibility(Ready);
      break;
    case _CCS::DataTypes::CPStateType::State_E:
      setCEstateE();
      SetChargingStationPicturesVisibility(Error);
      break;
    default:
      WriteLineEx(0, 2, "EVSE: 'OnStimCPStateChanged' called wih invalid value %d!", $this);
      break;
  }
}

/// <CE_ID>
void setCEstateA()
{
  @sysvar::VTS::VT_EVSE::StimConstVoltage = 5; //Set required voltage for CE functionality
  @SECC::IEC61851::Ss3 = 1;
}

/// <CE_ID>
void setCEstateE()
{
  @sysvar::VTS::VT_EVSE::StimConstVoltage = 0; //Set required voltage for CE functionality
  @SECC::IEC61851::Ss3 = 0;
}

on sysvar VTS::VT_EVSE::MeasVoltageHigh
{
  //*_Aux states are ignored, because the card cannot measure them
  if((@this >= 4.5) && (@this <= 5.5))
  {
    //state A
    if((expectedCEState == State_A || debounceCounter++ >= debounceLimit)
      && simulationRunning == 1)
    {
      DebouncedCEStateDetection(State_A);
      debounceCounter = 0;
    }
  }
  else if((@this >= 2.48) && (@this <= 3.15))
  {
    //state B0
    if((expectedCEState == State_B0 || debounceCounter++ >= debounceLimit)
      && simulationRunning == 1)
    {
      DebouncedCEStateDetection(State_B0);
      debounceCounter = 0;
    }
  }
  else if((@this >= 3.28) && (@this <= 4.04))
  {
    //state B
    if((expectedCEState == State_B || debounceCounter++ >= debounceLimit)
      && simulationRunning == 1)
    {
      DebouncedCEStateDetection(State_B);
      debounceCounter = 0;
    }
  }
  else if((@this >= 1.02) && (@this <= 1.4))
  {
    //state C
    if((expectedCEState == State_C || debounceCounter++ >= debounceLimit)
      && simulationRunning == 1)
    {
      DebouncedCEStateDetection(State_C);
      debounceCounter = 0;
    }
  }
  else if((@this >= 0.53) && (@this <= 0.74))
  {
    //state EC
    if((expectedCEState == State_EC || debounceCounter++ >= debounceLimit)
      && simulationRunning == 1)
    {
      DebouncedCEStateDetection(State_EC);
      debounceCounter = 0;
    }
  }
  else if((@this >= -0.1) && (@this <= 0.1))
  {
    //state E
    if((expectedCEState == State_E || debounceCounter++ >= debounceLimit)
      && simulationRunning == 1)
    {
      DebouncedCEStateDetection(State_E);
      debounceCounter = 0;
    }
  }
  else
  {
    //unexpected voltage measured during simulation
    if(simulationRunning == 1)
    {
      if(debounceCounter++ >= debounceLimit)
      {
        WriteLineEx(0, 3, "EVSE: Measured unexpected voltage not matching any defined CE state: %fV", @this);
      }        
    }
  }
}

void DebouncedCEStateDetection(int ceState)
{
  if(ceState != expectedCEState 
    && expectedCEState != State_Undefined 
    && simulationRunning == 1)
  {
    WriteLineEx(0, 3, "EVSE: Unexpectedly measured CE state %d; Expected: %d", ceState, expectedCEState);
  }
}

on sysvar VTS::VT_EVSE::MeasPPVoltage
{
  //*_Aux states are ignored, because the card cannot measure them
  if(simulationRunning == 0)
    return;
  
  if((@this >= -0.1) && (@this <= 0.1))
  {
    //Unmated
    if(expectedCEState != State_A && expectedCEState != State_Undefined)
    {
      WriteLineEx(0, 3, "EVSE: Unexpectedly measured ID state 'Unmated'");
    }
  }
  else if((@this >= 0.74) && (@this <= 1.37))
  {
    //Mated
    if(expectedCEState == State_A) // start of simulation, EV connected now
    {
      expectedCEState = State_B;
    }
    if(simulationRunning == 0)
    {
      WriteLineEx(0, 3, "EVSE: Unexpectedly measured ID state 'Mated'");
    }
  }
  else
  {
    WriteLineEx(0, 3, "EVSE: Measured unexpected voltage not matching any defined ID state: %fV", @this);
  }
}

/// <CharINInterface>
/**********************************************************************************************************************
 *  general HW interface
 *********************************************************************************************************************/

/// <CharINInterface>
void HV_source_set_output(long enabled)
{
  if( enabled == 0)
  {
    HV_source_set_I_DC(0);
    HV_source_set_U_DC(0);
  }
}

/// <CharINInterface>
void HV_source_perform_welding()
{
  return;
}

/// <CharINInterface>
long HV_get_isolation_state(long imdInstalled, long imdIntervalInMs, long imdDurationInMs)
{
  return 1;
}

/// <CharINInterfaceDC>
void HV_source_set_I_DC(double current)
{  
  @sysvar::EVSE_Sim::SysEVSE_PresentCurrent = current;
}

/// <CharINInterfaceDC>
void HV_source_set_U_DC(double voltage)
{
  @sysvar::EVSE_Sim::SysEVSE_PresentVoltage = voltage;
}

/// <CharINInterfaceDC>
double HV_measure_DC_U_VeriVolt()
{
  return 0;
}

/// <CharINInterfaceDC>
double HV_measure_DC_U()
{
  return @sysvar::EVSE_Sim::SysEVSE_PresentVoltage;
}

/// <CharINInterfaceDC>
 double HV_measure_DC_I()
{
  return @sysvar::EVSE_Sim::SysEVSE_PresentCurrent;
}