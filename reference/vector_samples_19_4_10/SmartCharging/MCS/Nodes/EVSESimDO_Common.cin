/*@!Encoding:1252*/
includes
{
  #include "EVSECommonFunctions.cin"
}

variables
{
  char gPanelName[5] = "EVSE";
  char gControlName[19] = "sw_ChargeDischarge";
  char gLabelControlMode[15] = "lblControlMode";
  char gCanvasDisableChargeDischarge[26] = "cv_DisableChargeDischarge";
  int EVSEProcessingLoopCounter = 0;
  int EVSESRProcessingLoopCounter = 0;
  char evseConnections[256];

  char responseCode[100];
  const int ProcessingLoopRepetitions = 10;
  int SessionId2[8];
  int SessionId[8];    // Session ID for first session, used throughout all CAPL functions
  
  int AutoFill_header = 0;
  
  msTimer tDelayedStart;
  const cStartAfterEthernetLinkUp = 2000; //[ms]
  msTimer tRestartAfterReset;
  const cRestartAfterReset = 100; //[ms]
  msTimer tResetAfterTCPClose;
  const cResetAfterTCPClose = 1000;
    
  enum eMode
  {
    Ready = 0,
    Charging = 1,
    Error = 2
  };

  enum eMode Mode = Ready;
  
  enum SmartChargingMessageIDs
  {
    //ScheduleRenegotiation
    SRACChargeParameterDiscoveryReq = 400,
    SRDCChargeParameterDiscoveryReq = 402,
    SRScheduleExchangeReq = 404,
    SRPowerDeliveryReq = 406,
    //MeteringConfirmation
    MeteringConfirmationReq = 450
  };
  
  float previousCurrent = 0;
  
  enum eCEState
  {
    State_Undefined = 0,
    State_A = 1,
    State_B0 = 2,
    State_B0_Aux = 3,
    State_B = 4,
    State_B_Aux = 5,
    State_C = 6,
    State_C_Aux = 7,
    State_EC = 8,
    State_EC_Aux = 9,
    State_E = 10
  };

  msTimer tStateTransition;
  int stateTransitionTimeout = 300; // [ms]
  int stateTransitionExpected = 0;
  enum eStateTransition
  {
    NoTransition = 0,
    TransitionA2B = 1,
    TransitionB2C = 2,
    TransitionC2B = 3,
    TransitionB2A = 4
  };
  
  int simulationRunning = 0;
  int pluggedIn = 0;
  int expectedCEState = State_Undefined;
  int debounceCounter = 0;
  int debounceLimit = 15;
  
  int gSessionStopReqCounter = 0;
  
  const cPreChargeMinimumCurrent = 2;
  msTimer tOpenContactors;
  const dword cOpenContactorsDelay = 500;
  msTimer tActionsAfterContactorOpen;
  const dword cActionsAfterContactorOpenDelay = 100;
  const dword cAdditionMeasurementStopDelay = 100;
  const dword cDeferStopDelay = 3 * cOpenContactorsDelay + cActionsAfterContactorOpenDelay + cAdditionMeasurementStopDelay;
}

/**********************************************************************************************************************
 *  ON START/STOP
 *********************************************************************************************************************/

on preStart
{
  EVSE.SetAdHocSendingEnabled.Call(0);
  ST_PlugOut();
  HV_source_set_U_DC(0); 
  HV_source_set_I_DC(0);
  HV_source_set_output(0);
}

on start
{  
  ST_Init();
  FUNC_Set_DepartureTimeDefaults();
  FUNC_Set_EVSEChargingMode();
  FUNC_Set_ChargeDischargeValues();
  @sysvar::EVSE_Sim::SysEVSE_SelectedControlMode = @sysvar::EVSE_Sim::SysEVSE_SelectedControlMode::NA;
  FUNC_CheckEVSE_BPT_Visibility();
  gSessionStopReqCounter = 0;
  simulationRunning = 0;
  pluggedIn = 0;
  debounceCounter = 0;
  
  if(isSimulated())
  {
    FUNC_EVSE_PrepareCommunication();
    SetEVSEPluggedInState();
  }
  else
  {
    setTimer(tDelayedStart, cStartAfterEthernetLinkUp); //start simulation after "cStartAfterEthernetLinkUp" to ensure ethernet link is up
  }
}

on timer tDelayedStart
{
  FUNC_EVSE_PrepareCommunication();
  SetEVSEPluggedInState();
}

on timer tRestartAfterReset
{
  @EVSE_Sim::Control::SysEVSE_Reset = 0;
  SetEVSEPluggedOutState();
}

on timer tResetAfterTCPClose
{
  ResetAndRestartEVSE();
}

on preStop
{
  @sysvar::EVSE_Sim::SysEVSE_StopCharging = 0;
  HV_source_set_U_DC(0); 
  HV_source_set_I_DC(0);
  SetChargingStationPicturesVisibility(Ready);
  
  if(!isSimulated())
  {
    deferStop(cDeferStopDelay);
    HV_reduce_VoltageAndCurrent();
    setTimer(tOpenContactors, cOpenContactorsDelay);
  }
}

/**********************************************************************************************************************
 *  ON METHOD
 *********************************************************************************************************************/

on fct_returning EVSE.TransportLayerDisconnectInd
{
  HV_reduce_VoltageAndCurrent();
  setTimer(tOpenContactors, cOpenContactorsDelay);
  setTimer(tResetAfterTCPClose, cResetAfterTCPClose);
}

/**********************************************************************************************************************
 *  ON SYSVAR
 *********************************************************************************************************************/
on sysvar Common::SysUserBPTMode
{
  FUNC_Set_EVSEChargingMode();
  FUNC_Set_ChargeDischargeValues();
  FUNC_CheckEVSE_BPT_Visibility();
}

on sysvar EVSE_Sim::SysEVSE_SelectedControlMode
{
  if(@this == @sysvar::EVSE_Sim::SysEVSE_SelectedControlMode::Scheduled)
    setControlProperty(gPanelName, gLabelControlMode, "Text", "Scheduled");
  else if (@this == @sysvar::EVSE_Sim::SysEVSE_SelectedControlMode::Dynamic)
    setControlProperty(gPanelName, gLabelControlMode, "Text", "Dynamic");
  else
    setControlProperty(gPanelName, gLabelControlMode, "Text", "N/A");
  
  SetControlVisibility(gPanelName, gControlName, 1);
  FUNC_CheckEVSE_BPT_Visibility();
}

on sysvar EVSE_Sim::Control::SysEVSE_Reset
{
  if (@this == 1)
  {
    HV_reduce_VoltageAndCurrent();
    setTimer(tOpenContactors, cOpenContactorsDelay);
    ResetAndRestartEVSE();
  }  
}

/**********************************************************************************************************************
 *  communication start/stop
 *********************************************************************************************************************/

// Allow some time for state transition without error
on timer tStateTransition
{
  stateTransitionExpected = NoTransition;
}

void FUNC_EVSE_PrepareCommunication()
{
  ST_Init();
  
  FUNC_Set_Attributes();
  
  // Start Simulation
  FUNC_Set_ChargeDischargeValues();
  EVSE.StartSimulation.Call();
  simulationRunning = 1;
  expectedCEState = State_A;
  @sysvar::EVSE_Sim::SysEVSE_SimState = 0;
  strncpy(evseConnections, "", 256);
  SysSetVariableString(sysvar::EVSE_Sim::SysEVSE_Connections, evseConnections);
  
  ST_PlugIn();
}

void Reset_EVSE_Values()
{
  EVSE.SetAdHocSendingEnabled.Call(0);
  @sysvar::Common::SysProtocolBar = 0; 
  @sysvar::EVSE_Sim::Control::SysEVSE_WaitResume = 0;
  @sysvar::EVSE_Sim::SysEVSE_SimState = 2;
  sysSetVariableString(sysvar::EVSE_Sim::SysEVSE_DCStatusCode, "N/A"); 
  
  // Do not send PriceSchedule because ServiceDetailRes offers only Pricing = NoPricing 
  ($EVSE.ISO20.ScheduleExchange_Response.SEResControlMode.Dynamic_SEResControlMode.PriceSchedule).SetInvalid();
  EVSE.ResetSimulation.Call();
  simulationRunning = 0;
  expectedCEState = State_Undefined;
  stateTransitionExpected = NoTransition;
}

void ResetAndRestartEVSE()
{
  Reset_EVSE_Values(); 
  FUNC_EVSE_PrepareCommunication();
  @sysvar::EVSE_Sim::SysEVSE_SimState = 2;
  ST_Reset();
  SetEVSEPluggedOutState();
  // allow TCP shutdown to take place before restarting and setting new key
  setTimer(tRestartAfterReset, cRestartAfterReset);
}

void SetEVSEPluggedOutState()
{
  Reset_EVSE_Values();   
  FUNC_EVSE_PrepareCommunication();
}

void SetEVSEPluggedInState()
{
  FUNC_Set_Attributes();
}

void FUNC_CheckEVSE_BPT_Visibility()
{
  if ((@Common::SysUserBPTMode == sysvar::Common::SysUserBPTMode::BPT) 
        && (( @sysvar::EVSE_Sim::SysEVSE_SelectedControlMode == @sysvar::EVSE_Sim::SysEVSE_SelectedControlMode::NA)
          || @sysvar::EVSE_Sim::SysEVSE_SelectedControlMode == @sysvar::EVSE_Sim::SysEVSE_SelectedControlMode::Dynamic))
  {
    /* We don't know yet who decides energy flow direction or EVSE decides */
    SetControlVisibility(gPanelName, gCanvasDisableChargeDischarge, 0);
  }
  else
  {
    /* EV decides energy flow direction or only charging allowed */
    SetControlVisibility(gPanelName, gCanvasDisableChargeDischarge, 1);
  }
}

on sysvar EVSE_Sim::Control::SysEVSE_WaitResume
{
  if (@this == 1)
  {
    EVSE.StopSimulation.Call();
    @sysvar::EVSE_Sim::SysEVSE_SimState = 2;
  }
}

on sysvar Common::SysUserChargingMode
{
  FUNC_Set_EVSEChargingMode();
  FUNC_Set_ChargeDischargeValues();
}

on sysvar EVSE_Sim::SysEVSE_StopCharging
{
  if(@this == 1)
    EVSE.SetNextEVSENotification.Call(_CCS::DataTypes::EVSENotificationType::Terminate);
  @this = 0;
}

on sysvar EVSE_Sim::Control::SysEVSE_TriggerMeteringConfirmation
{
  if (@this == 1)
  {
    EVSE.SetNextEVSENotification.Call(_CCS::DataTypes::EVSENotificationType::MeteringConfirmation);
  }
  @this = 0;
}

on sysvar EVSE_Sim::Control::SysEVSE_ReturnFailed
{  
  if (@this == 1)
  {
    EVSE.SAP.SetNextResponseCode.Call(_CCS::DataTypes::SAPResponseCodeType::FAILED_NoNegotiation);
    EVSE.ISO20.SetNextResponseCode.Call(_CCS::DataTypes::ISO20ResponseCodeType::FAILED);
    SetChargingStationPicturesVisibility(Error);
  }
  @this = 0;
}

on sysvar EVSE_Sim::Control::SysEVSE_AbortConnection
{
  if (@this == 1)
  {
    Reset_EVSE_Values();
    FUNC_EVSE_PrepareCommunication();
    SetChargingStationPicturesVisibility(Error);
  }
  @this = 0;
}

on sysvar EVSE_Sim::Control::SysEVSE_ChargeDischarge
{
  FUNC_Set_ChargeDischargeValues();
}

on sysvar EVSE_Sim::Control::SysEVSE_TriggerScheduleRenegotiation
{
  EVSE.SetNextEVSENotification.Call(_CCS::DataTypes::parChargeProgressType::ScheduleRenegotiation);
}

on sysvar EVSE_Sim::SysEVSE_PresentCurrent
{
  /* Check if the panels has to be adjusted according to the Presentcurrent value  */
  /* But only change setting if two consecutive values are positive or negative */
  if (@this < 0 && previousCurrent < 0)
  {
    /* negative values */
    if((@sysvar::Common::SysUserBPTMode == sysvar::Common::SysUserBPTMode::BPT) 
      && (@sysvar::EVSE_Sim::Control::SysEVSE_ChargeDischarge == @sysvar::EVSE_Sim::Control::SysEVSE_ChargeDischarge::Charge))
    {
      @sysvar::EVSE_Sim::Control::SysEVSE_ChargeDischarge = @sysvar::EVSE_Sim::Control::SysEVSE_ChargeDischarge::Discharge;
    }
  }
  else if( 0 < @this && 0 < previousCurrent )
  { 
    /* positive values */
    if((@sysvar::Common::SysUserBPTMode == sysvar::Common::SysUserBPTMode::BPT) 
      && (@sysvar::EVSE_Sim::Control::SysEVSE_ChargeDischarge == @sysvar::EVSE_Sim::Control::SysEVSE_ChargeDischarge::Discharge))
    {
      @sysvar::EVSE_Sim::Control::SysEVSE_ChargeDischarge = @sysvar::EVSE_Sim::Control::SysEVSE_ChargeDischarge::Charge;
    }
  }
  previousCurrent = @this;
}

/**********************************************************************************************************************
 *  ON V2G MESSAGE
 *********************************************************************************************************************/

on value_update EVSE.SDP.SECC_Discovery_Request
{
  SetChargingStationPicturesVisibility(Charging);
}

/// <MCS_or_DC>
on value_change EVSE.ISO20.ServiceDiscovery_Request
{
  FUNC_Set_ServiceDiscovery_MCSServiceID();
}

// Manual definition of the parameter set for ServiceDetail Response by the user
on value_change EVSE.ISO20.ServiceDetail_Request
{
  FUNC_Set_ServiceDetailRes();
}

on value_change EVSE.ISO20.AuthorizationSetup_Request
{
  FUNC_Set_AuthorizationSetupRes();
}

on value_update EVSE.ISO20.Authorization_Response
{
  if (EVSEProcessingLoopCounter < ProcessingLoopRepetitions)
  {
    EVSEProcessingLoopCounter++; 
  }
  else
  {
    EVSEProcessingLoopCounter = 0;
    EVSE.ISO20.FinishProcessing.Call();
  }
}

on value_update EVSE.ISO20.SessionSetup_Response
{
  long connectionCount;
  byte sessionIdTemp[8];
  int sessionIdTempInt[8];
  char sessionIdTempChar[17];
  long  lTemp;
  byte tmpByte;
  
  strncpy(evseConnections, "", 256);
  
  memcpy(sessionIdTemp, $EVSE.ISO20.SessionSetup_Response.Header.SessionID);
  
  WriteHex(sessionIdTempChar, sessionIdTemp);
  sessionIdTempChar[16] = '\0';
  strncat(evseConnections, sessionIdTempChar, 256);
  
  SysSetVariableString(sysvar::EVSE_Sim::SysEVSE_Connections, evseConnections);
}

on value_update EVSE.ISO20.DC_ChargeParameterDiscovery_Request
{
  FUNC_Set_EVSEDCLimits_ChargeParameterDiscoveryRes(); 
}

on fct_called EVSE.OnLastTransmittedMessageIdChanged 
{
  if ($EVSE.OnLastTransmittedMessageIdChanged.LatestCall.lastTxMessageId == _CCS::DataTypes::MessageIdType::ACDERChargeParameterDiscoveryRes)
  {
    EVSE.ISO20.EnableAutoBodyFill.Call(1); // re-enable auto body fill set in ChargeParameterDiscovery_Request
    AutoFill_body = 1;
  }
}

on value_update EVSE.ScheduleRenegotiation.DC_ChargeParameterDiscovery_Request
{
  FUNC_Set_EVSEDCLimits_ScheduleRenegotiationChargeParameterDiscoveryRes(); 
}

on value_update EVSE.ISO20.ScheduleExchange_Request
{
  FUNC_Set_ScheduleExchangeRes();

  if($EVSE.ISO20.ScheduleExchange_Request.SEReqControlModeElementId == _CCS::DataTypes::parISO20SEReqMode::Dynamic_SEReq)
    @sysvar::EVSE_Sim::SysEVSE_SelectedControlMode = @sysvar::EVSE_Sim::SysEVSE_SelectedControlMode::Dynamic;
  // Scheduled Mode
  else
  {
    @sysvar::EVSE_Sim::SysEVSE_SelectedControlMode = @sysvar::EVSE_Sim::SysEVSE_SelectedControlMode::Scheduled;
  }
}

on value_update EVSE.ScheduleRenegotiation.ScheduleExchange_Request
{
  if($EVSE.ScheduleRenegotiation.ScheduleExchange_Request.SEReqControlModeElementId == _CCS::DataTypes::parISO20SEReqMode::Dynamic_SEReq)
    @sysvar::EVSE_Sim::SysEVSE_SelectedControlMode = @sysvar::EVSE_Sim::SysEVSE_SelectedControlMode::Dynamic;
  else
    @sysvar::EVSE_Sim::SysEVSE_SelectedControlMode = @sysvar::EVSE_Sim::SysEVSE_SelectedControlMode::Scheduled;
  
  if (EVSESRProcessingLoopCounter < ProcessingLoopRepetitions)
  {
    EVSESRProcessingLoopCounter++; 
  }
  else
  {
    EVSESRProcessingLoopCounter = 0;
    EVSE.ScheduleRenegotiation.FinishProcessing.Call();
  }
}

on value_update EVSE.ISO20.ScheduleExchange_Response
{
  if (EVSEProcessingLoopCounter < ProcessingLoopRepetitions)
  {
    EVSEProcessingLoopCounter++; 
  }
  else
  {
    EVSEProcessingLoopCounter = 0;
    EVSE.ISO20.FinishProcessing.Call();
  }
  
  if($this.EVSEProcessing == _CCS::DataTypes::parProcessingType::Finished)
  {
    expectedCEState = State_C;
    stateTransitionExpected = TransitionB2C;
    setTimer(tStateTransition, stateTransitionTimeout);
  }
}

on value_update EVSE.ISO20.DC_CableCheck_Request
{
  int cntCableCheck=0;
  cntCableCheck++;
  
  if((HV_measure_DC_U_VeriVolt() < 10) && (cntCableCheck == 1))
  {
    HV_source_set_output(1); // Close switches of DC power supply
    HV_source_set_I_DC(cPreChargeMinimumCurrent);
    HV_source_set_U_DC(@EVSE_Sim::SysEVSE_MaxVoltage);
  }
  else if(cntCableCheck == 1)
  {
    WriteLineEx(0, 3, "EVSE: Voltage on cable > 10V. EV contactors appear to be closed.");
    return;
  }
}

on value_update EVSE.ISO20.DC_CableCheck_Response
{
  if(isSimulated())
  {
    if (EVSEProcessingLoopCounter < ProcessingLoopRepetitions)
    {
      EVSEProcessingLoopCounter++;
    }
    else
    {
      EVSEProcessingLoopCounter = 0;
      EVSE.ISO20.FinishProcessing.Call();
    }
  }
  else
  {
    stack long isoState = HV_get_isolation_state(1, 0, 0);
    if(isoState == 1) // valid
    {
      HV_source_set_U_DC(0);
      EVSE.ISO20.FinishProcessing.Call(); // Set EVSE Processing to Finished
    }
    else if(isoState == 2) // fault
    {
      HV_source_set_I_DC(0);
      HV_source_set_U_DC(0);
      HV_source_set_output(0); // Open switches of DC power supply
      
      WriteLineEx(0, 3, "EVSE: Fault result of cable check insulation test.");
      
      @EVSE_Sim::Control::SysEVSE_ReturnFailed = 1;
      EVSE.ISO20.FinishProcessing.Call(); // Set EVSE Processing to Finished
    }
    else // ongoing
    {
      EVSEProcessingLoopCounter++; // Set EVSE Processing to OnGoing
    }
  }
}

on value_update EVSE.ISO20.DC_PreCharge_Request
{
  /* Set requested voltage from EV */
  float evTargetVoltage;  
  evTargetVoltage = getValueConsideringExponent($EVSE.ISO20.DC_PreCharge_Request.EVTargetVoltage.Value,$EVSE.ISO20.DC_PreCharge_Request.EVTargetVoltage.Exponent);
  HV_source_set_U_DC(evTargetVoltage < @EVSE_Sim::SysEVSE_MaxVoltage ? evTargetVoltage : @EVSE_Sim::SysEVSE_MaxVoltage);
  HV_source_set_I_DC(cPreChargeMinimumCurrent);
  FUNC_Set_PreChargeRes();
}

on value_update EVSE.ISO20.PowerDelivery_Request
{
  if ($EVSE.ISO20.PowerDelivery_Request.ChargeProgress == _CCS::DataTypes::parChargeProgressType::`Stop
            || $EVSE.ISO20.PowerDelivery_Request.ChargeProgress == _CCS::DataTypes::parChargeProgressType::Standby)
  {
    HV_reduce_VoltageAndCurrent();
    expectedCEState = State_B;
    stateTransitionExpected = TransitionC2B;
    setTimer(tStateTransition, stateTransitionTimeout);
  }
}

on value_update EVSE.ISO20.DC_ChargeLoop_Request
{
  //Mark EVSEStatus as a missing optional element
  ($EVSE.ISO20.DC_ChargeLoop_Response.EVSEStatus).SetInvalid();
  FUNC_Get_EVSE_DCChargeLoopValues();
  
  if( $this.CLReqControlModeElementId == 2 ){
    HV_source_set_U_DC(getValueConsideringExponent($this.CLReqControlMode.Scheduled_DC_CLReqControlMode.EVTargetVoltage.Value, $this.CLReqControlMode.Scheduled_DC_CLReqControlMode.EVTargetVoltage.Exponent));
    HV_source_set_I_DC(getValueConsideringExponent($this.CLReqControlMode.Scheduled_DC_CLReqControlMode.EVTargetCurrent.Value, $this.CLReqControlMode.Scheduled_DC_CLReqControlMode.EVTargetCurrent.Exponent));
  }
  else if($this.CLReqControlModeElementId == 3){
    HV_source_set_U_DC(getValueConsideringExponent($this.CLReqControlMode.BPT_Scheduled_DC_CLReqControlMode.EVTargetVoltage.Value, $this.CLReqControlMode.BPT_Scheduled_DC_CLReqControlMode.EVTargetVoltage.Exponent));
    HV_source_set_I_DC(getValueConsideringExponent($this.CLReqControlMode.BPT_Scheduled_DC_CLReqControlMode.EVTargetCurrent.Value, $this.CLReqControlMode.BPT_Scheduled_DC_CLReqControlMode.EVTargetCurrent.Exponent));
  }
  else{ //Dynamic
    HV_source_set_U_DC(@EVSE_Sim::SysEVSE_PresentVoltage);
    HV_source_set_I_DC(@EVSE_Sim::SysEVSE_PresentCurrent);
  }
}

on value_update EVSE.ISO20.DC_ChargeLoop_Response
{
  FUNC_Set_EVSE_DCChargeLoopValues();
}

on value_update EVSE.ISO20.DC_WeldingDetection_Request
{
  HV_reduce_VoltageAndCurrent();
  setTimer(tOpenContactors, cOpenContactorsDelay);  
  HV_source_perform_welding();
}

on value_update EVSE.ISO20.SessionStop_Request
{
  HV_reduce_VoltageAndCurrent();
  setTimer(tOpenContactors, cOpenContactorsDelay);  
  gSessionStopReqCounter++;
}

on value_update EVSE.ISO20.SessionStop_Response
{
  SetChargingStationPicturesVisibility(Ready);
}

/**********************************************************************************************************************
 *  ON DATA
 *********************************************************************************************************************/
on value_update EVSE.CurrentLinkStatus
{
  if ($EVSE.CurrentLinkStatus == _CCS::DataTypes::Connected)
  {
    @sysvar::EVSE_Sim::SysEVSE_LinkStatus = 1;
  }
  else if ($EVSE.CurrentLinkStatus == _CCS::DataTypes::ReadyToJoin)
  {
    @sysvar::EVSE_Sim::SysEVSE_LinkStatus = 2;
  }
  else
  {
    @sysvar::EVSE_Sim::SysEVSE_LinkStatus = 0;
  }
}

on value_update EVSE.ExpectedCPState
{
  if ($this ==  _CCS::DataTypes::CPStateType::State_B)
   SetChargingStationPicturesVisibility(Charging);
}

on value_update EVSE.Reporting.CCSError
{
  if($EVSE.Reporting.CCSError.LastReceivedMessage.IsValid){
     if(!IsSideStreamMessageReceived())
       SetChargingStationPicturesVisibility(Error);
    }
}

on value_update EVSE.Reporting.EXIError
{
  SetChargingStationPicturesVisibility(Error);
}

/**********************************************************************************************************************
 *  attributes
 *********************************************************************************************************************/

void FUNC_Set_Attributes()
{
  reReadSharedAttributes();
  
  // Set Processing    
  if (@sysvar::Common::SysUseProcessing == 1){
    setAttribute(CCS::Simulation::EVSE, CCSBinding::ProcessingLooping, CCSBinding::Enabled); 
    SetControlForeColor(gPanelName, "TProcessing",  MakeRGB(0, 0, 255)); 
  }
  else{
    setAttribute(CCS::Simulation::EVSE, CCSBinding::ProcessingLooping, CCSBinding::Disabled); 
  }
}

reReadSharedAttributes()
{
  setTLSAttribute();
  setAuthorizationMode();
}

setTLSAttribute()
{
  // Response TLS only when the "TLS" option is checked
  // Set TLS
  if (@sysVar::Common::SysTLSEnabled == @sysvar::Common::SysTLSEnabled::TLSEnabled){
    setAttribute(CCS::Simulation::EVSE, CCSBinding::TLS, CCSBinding::TLSEnabled); 
  }
  else{
    setAttribute(CCS::Simulation::EVSE, CCSBinding::TLS, CCSBinding::TLSDisabled); 
  }
}

setAuthorizationMode()
{
  // Set AuthorizationMode
  if (@sysvar::Common::SysUserAuthorizationMode == sysvar::Common::SysUserAuthorizationMode::EIM){
    setAttribute(CCS::Simulation::EVSE, CCSBinding::EVSE::AuthorizationMode, 0);   
  }
  else{
    setAttribute(CCS::Simulation::EVSE, CCSBinding::EVSE::AuthorizationMode, 1); //PnC
  }
}

/**********************************************************************************************************************
 *  helper
 *********************************************************************************************************************/

int IsSideStreamMessageReceived()
{
 if(($EVSE.Reporting.CCSError.LastReceivedMessage == _CCS::DataTypes::MessageIdType::SRACChargeParameterDiscoveryReq)||
   ($EVSE.Reporting.CCSError.LastReceivedMessage == _CCS::DataTypes::MessageIdType::SRDCChargeParameterDiscoveryReq)||
   ($EVSE.Reporting.CCSError.LastReceivedMessage == _CCS::DataTypes::MessageIdType::SRScheduleExchangeReq)||
   ($EVSE.Reporting.CCSError.LastReceivedMessage == _CCS::DataTypes::MessageIdType::SRPowerDeliveryReq)||
   ($EVSE.Reporting.CCSError.LastReceivedMessage == _CCS::DataTypes::MessageIdType::MeteringConfirmationReq))
    return 1;
   
  return 0;  
}

void SetChargingStationPicturesVisibility(int Mode)
{
  If(Mode == Ready)
  {
   SetControlVisibility(gPanelName, "pictureChargingStationReady", 1);
   SetControlVisibility(gPanelName, "pictureChargingStationCharging", 0);
   SetControlVisibility(gPanelName, "pictureChargingStationError", 0);
  }
  else If(Mode == Charging)
  {
   SetControlVisibility(gPanelName, "pictureChargingStationReady", 0);
   SetControlVisibility(gPanelName, "pictureChargingStationCharging", 1);
   SetControlVisibility(gPanelName, "pictureChargingStationError", 0);
  }
  else If(Mode == Error)
  {
   SetControlVisibility(gPanelName, "pictureChargingStationReady", 0);
   SetControlVisibility(gPanelName, "pictureChargingStationCharging", 0);
   SetControlVisibility(gPanelName, "pictureChargingStationError", 1);
  }
}

double getValueConsideringExponent(int value, int exponent)
{
  return (value * _pow(10, exponent)); 
}

/**********************************************************************************************************************
 *  HV control
 *********************************************************************************************************************/

on timer tActionsAfterContactorOpen
{
  HV_ActionsAfterContactorOpen();
}

on timer tOpenContactors
{
  if(abs(HV_measure_DC_I()) > 5)
  {
    HV_reduce_VoltageAndCurrent();
    setTimer(tOpenContactors, cOpenContactorsDelay);
  }
  else
  {
    HV_OpenContactors();
    setTimer(tActionsAfterContactorOpen, cActionsAfterContactorOpenDelay);
  }
}

void HV_reduce_VoltageAndCurrent()
{
  if(abs(HV_measure_DC_I()) > 5)
    HV_source_set_I_DC(cPreChargeMinimumCurrent);
  HV_source_set_U_DC(HV_measure_DC_U_VeriVolt());
}

void HV_OpenContactors()
{
  HV_source_set_output(0); // Open switches of DC power supply
}

void HV_ActionsAfterContactorOpen()
{
  HV_source_set_I_DC(0);
  HV_source_set_U_DC(0);
  
  ST_Reset();
}