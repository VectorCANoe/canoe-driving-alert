/*@!Encoding:1252*/
includes
{
  #include "EVSESimDO_Common.cin"
  #include "CharIn_HW_Interface_EVSE.cin"
}

variables
{
  
}

