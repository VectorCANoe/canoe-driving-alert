/*@!Encoding:1252*/
includes
{
  
}

variables
{
  int monitoringActive = 0;
  int activateMonitoringTimeout = 100; // [ms]
  msTimer tActivateMonitoring;
}

on timer tActivateMonitoring
{
  // HW needs a bit of time to initially set relays and measure correct values
  monitoringActive = 1;
}

on sysvar_update VTS::VT2816_1_Ch1::CurVoltage
{
  @sysvar::SECC::IEC61851::Vs3_CE_SE = @this;
}

on sysvar_update VTS::VT2816_1_Ch2::CurVoltage
{
  @sysvar::SECC::IEC61851::Vs2_ID_SE = @this;
}

on sysvar_update SECC::IEC61851::Xs2
{
  @sysvar::VTS::VT2004_1_Ch1::Voltage = @this;
}

on sysvar_update SECC::IEC61851::Rs4
{
  Calculate_Resistance_CE_EVSE(@this, @SECC::IEC61851::Rs5, @SECC::IEC61851::Ss3);
}

on sysvar_update SECC::IEC61851::Rs5
{
  Calculate_Resistance_CE_EVSE(@SECC::IEC61851::Rs4, @this, @SECC::IEC61851::Ss3);
}

on sysvar_update SECC::IEC61851::Ss3
{
  Calculate_Resistance_CE_EVSE(@SECC::IEC61851::Rs4, @SECC::IEC61851::Rs5, @this);
}

// Resitor calculation for Rs4, Rs5 and Ss3 (see IEC 61851-23-3)
Calculate_Resistance_CE_EVSE(double Rs4, double Rs5, double Ss3)
{
  if(Ss3==0)
  {
    @sysvar::VTS::VT2004_1_Ch2::RelayShortCircuit = 0;
  }
  else
  {
    @sysvar::VTS::VT2004_1_Ch2::RelayShortCircuit = 1;
  }
  
  sysvar::VTS::VT2004_1_Ch2.SetStimulationMode(eVTSStimulationModeResistanceGreater);
  @sysvar::VTS::VT2004_1_Ch2::Resistor = Rs4;
  sysvar::VTS::VT2004_1_Ch2.StartStimulation();
  
  sysvar::VTS::VT2004_1_Ch3.SetStimulationMode(eVTSStimulationModeResistanceGreater);
  @sysvar::VTS::VT2004_1_Ch3::Resistor = Rs5;
  sysvar::VTS::VT2004_1_Ch3.StartStimulation();
}

on sysvar_update SECC::IEC61851::Rs2
{
  Calculate_Resistance_ID_EVSE(@this, @SECC::IEC61851::Rs3);  
}

on sysvar_update SECC::IEC61851::Rs3
{
  Calculate_Resistance_ID_EVSE(@SECC::IEC61851::Rs2, @this);
}

// Resitor calculation for Rs2, Rs3 (see IEC 61851-23-3)
Calculate_Resistance_ID_EVSE(double Rs2, double Rs3)
{  
  double Rcalc;
  
  if(Rs2>0 && Rs3>0)
    Rcalc = (1 / ((1/Rs2) + (1/Rs3)));
  else
    Rcalc = 0;
  
  sysvar::VTS::VT2004_1_Ch4.SetStimulationMode(eVTSStimulationModeResistanceGreater);
  @sysvar::VTS::VT2004_1_Ch4::Resistor = Rcalc;
  sysvar::VTS::VT2004_1_Ch4.StartStimulation();
}

on value_update EVSE.StimCPState
{
  switch ($this)
  {
    // CE state A0/B0/C0 (EVSE not ready)
    case _CCS::DataTypes::CPStateType::State_A:
      setCEstateA();
      SetChargingStationPicturesVisibility(Ready);
      break;
    case _CCS::DataTypes::CPStateType::State_E:
      setCEstateE();
      SetChargingStationPicturesVisibility(Error);
      break;
    default:
      WriteLineEx(0, 2, "EVSE: 'OnStimCPStateChanged' called wih invalid value %d!", $this);
      break;
  }
}

void setCEstateA()
{
  // Initial switch on of Xs2 (5V) for CE supply
  sysvar::VTS::VT2004_1_Ch1.SetStimulationMode(eVTSStimulationModeVoltage);
  @sysvar::VTS::VT2004_1_Ch1::Voltage = 5;
  sysvar::VTS::VT2004_1_Ch1.StartStimulation();
  @SECC::IEC61851::Ss3 = 1;
  expectedCEState = State_A;
}

void setCEstateE()
{
  // Initial switch on of Xs2 (5V) for CE supply
  sysvar::VTS::VT2004_1_Ch1.SetStimulationMode(eVTSStimulationModeVoltage);
  @sysvar::VTS::VT2004_1_Ch1::Voltage = 0;
  sysvar::VTS::VT2004_1_Ch1.StopStimulation();
  @SECC::IEC61851::Ss3 = 0;
  expectedCEState = State_E;
}

on sysvar VTS::VT2816_1_Ch1::CurVoltage
{
  //*_Aux states are ignored, because the card cannot measure them
  if((@this >= 4.5) && (@this <= 5.5))
  {
    //state A
    if((expectedCEState == State_A || debounceCounter++ >= debounceLimit)
      && simulationRunning == 1)
    {
      DebouncedCEStateDetection(State_A);
      debounceCounter = 0;
    }
  }
  else if((@this >= 2.48) && (@this <= 3.15))
  {
    //state B0
    if((expectedCEState == State_B0 || debounceCounter++ >= debounceLimit)
      && simulationRunning == 1)
    {
      DebouncedCEStateDetection(State_B0);
      debounceCounter = 0;
    }
  }
  else if((@this >= 3.28) && (@this <= 4.04))
  {
    //state B
    if((expectedCEState == State_B || debounceCounter++ >= debounceLimit)
      && simulationRunning == 1)
    {
      DebouncedCEStateDetection(State_B);
      debounceCounter = 0;
    }
  }
  else if((@this >= 1.02) && (@this <= 1.4))
  {
    //state C
    if((expectedCEState == State_C || debounceCounter++ >= debounceLimit)
      && simulationRunning == 1)
    {
      DebouncedCEStateDetection(State_C);
      debounceCounter = 0;
    }
  }
  else if((@this >= 0.53) && (@this <= 0.74))
  {
    //state EC
    if((expectedCEState == State_EC || debounceCounter++ >= debounceLimit)
      && simulationRunning == 1)
    {
      DebouncedCEStateDetection(State_EC);
      debounceCounter = 0;
    }
  }
  else if((@this >= -0.1) && (@this <= 0.1))
  {
    //state E
    if((expectedCEState == State_E || debounceCounter++ >= debounceLimit)
      && simulationRunning == 1)
    {
      DebouncedCEStateDetection(State_E);
      debounceCounter = 0;
    }
  }
  else
  {
    //unexpected voltage measured during simulation
    if(simulationRunning == 1)
    {
      debounceCounter++;
      if(debounceCounter >= debounceLimit)
      {
        debounceCounter = 0;
        WriteLineEx(0, 2, "EVSE: Measured unexpected voltage not matching any defined CE state: %fV", @this);
      }        
    }
  }
}

void DebouncedCEStateDetection(int ceState)
{
  if((ceState == State_B && expectedCEState == State_C && stateTransitionExpected == TransitionB2C)
    || ceState == State_C && expectedCEState == State_B && stateTransitionExpected == TransitionC2B)
    return; // Some time may be needed to switch between states, do not report

  if(ceState != expectedCEState 
    && expectedCEState != State_Undefined 
    && simulationRunning == 1
    && monitoringActive == 1)
  {
    WriteLineEx(0, 3, "EVSE: Unexpectedly measured CE state %d; Expected: %d", ceState, expectedCEState);
    WriteLineEx(-3, 3, "EVSE: Unexpectedly measured CE state %d; Expected: %d; transition: %d", ceState, expectedCEState, stateTransitionExpected);
  }
}

// ID
on sysvar VTS::VT2816_1_Ch2::CurVoltage
{
  //*_Aux states are ignored, because the card cannot measure them
  if(simulationRunning == 0 || monitoringActive == 0)
    return;
  
  if((@this >= -0.1) && (@this <= 0.1))
  {
    //Unmated
    if(expectedCEState != State_A && expectedCEState != State_Undefined)
    {
      WriteLineEx(0, 3, "EVSE: Unexpectedly measured ID state 'Unmated'");
    }
  }
  else if((@this >= 0.74) && (@this <= 1.37))
  {
    //Mated
    if(expectedCEState == State_A) // start of simulation, EV connected now
    {
      expectedCEState = State_B;
      stateTransitionExpected = TransitionA2B;
      setTimer(tStateTransition, stateTransitionTimeout);
    }
    if(simulationRunning == 0)
    {
      WriteLineEx(0, 3, "EVSE: Unexpectedly measured ID state 'Mated'");
    }
  }
  else
  {
    WriteLineEx(0, 3, "EVSE: Measured unexpected voltage not matching any configured ID state: %fV", @this);
  }
}

/// <CharINInterface>
/**********************************************************************************************************************
 *  general HW interface
 *********************************************************************************************************************/

ST_Init()
{
  // Close required bus bars at VT2004
  @sysvar::VTS::VT2004_1_Ch1::RelayBusBar2B = 1;
  @sysvar::VTS::VT2004_1_Ch4::RelayBusBar2B = 1;

  // Initial setting of resistor values
  Calculate_Resistance_CE_EVSE(@SECC::IEC61851::Rs4, @SECC::IEC61851::Rs5, @SECC::IEC61851::Ss3);
  Calculate_Resistance_ID_EVSE(@SECC::IEC61851::Rs2, @SECC::IEC61851::Rs3);
  monitoringActive = 0;
}

/// <CharINInterface>
void ST_Reset()
{
  ST_Init();
}

/// <CharINInterface>
ST_PlugIn()
{
  @sysvar::VTS::VT2004_1_Ch3::RelayOrgSensor = 1;
  @sysvar::VTS::VT2004_1_Ch4::RelayOrgSensor = 1;
  pluggedIn = 1;
  setTimer(tActivateMonitoring, activateMonitoringTimeout);
}

/// <CharINInterface>
ST_PlugOut()
{
  @sysvar::VTS::VT2004_1_Ch3::RelayOrgSensor = 0;
  @sysvar::VTS::VT2004_1_Ch4::RelayOrgSensor = 0;
  pluggedIn = 0;
  expectedCEState = State_A;
}

/// <CharINInterface>
void HV_source_set_output(long enabled)
{
  if( enabled == 0)
  {
    HV_source_set_I_DC(0);
    HV_source_set_U_DC(0);
  }
}

/// <CharINInterface>
void HV_source_perform_welding()
{
  return;
}

/// <CharINInterface>
long HV_get_isolation_state(long imdInstalled, long imdIntervalInMs, long imdDurationInMs)
{
  return 1;
}

/// <CharINInterfaceDC>
void HV_source_set_I_DC(double current)
{  
  @sysvar::EVSE_Sim::SysEVSE_PresentCurrent = current;
}

/// <CharINInterfaceDC>
void HV_source_set_U_DC(double voltage)
{
  @sysvar::EVSE_Sim::SysEVSE_PresentVoltage = voltage;
}

/// <CharINInterfaceDC>
double HV_measure_DC_U()
{
  return @sysvar::EVSE_Sim::SysEVSE_PresentVoltage;
}

/// <CharINInterfaceDC>
double HV_measure_DC_U_VeriVolt()
{
  return 0;
}

/// <CharINInterfaceDC>
 double HV_measure_DC_I()
{
  return @sysvar::EVSE_Sim::SysEVSE_PresentCurrent;
}