/*@!Encoding:1252*/
includes
{
  
}

variables
{
  char gProtocolPanelName[9] = "Protocol";
  char gPanelName[5] = "EVSE";
  char gEVPanelName[3] = "EV";
  char gControlName[19] = "sw_ChargeDischarge";
  char gDcCurrent[17]   = "upDown_dcCurrent";
}

/**********************************************************************************************************************
 *  ON START/STOP
 *********************************************************************************************************************/

on start
{
  ClearProtocolPanel();
  @sysvar::Common::SysProtocolBar = 0;
  FUNC_CheckEVSE_BPT_Visibility();
  FUNC_CheckEV_BPT_Visibility();
}

on sysvar Common::SysUserBPTMode
{
  FUNC_CheckEVSE_BPT_Visibility();
  FUNC_CheckEV_BPT_Visibility();
}

on sysvar EV_Sim::Control::SysEV_ControlModeDynamic
{
  FUNC_CheckEVSE_BPT_Visibility();
  FUNC_CheckEV_BPT_Visibility();
}

on sysvar EV_Sim::Control::SysEV_Connected
{
  if(@this == 1)
    ClearProtocolPanel();
}

/**********************************************************************************************************************
 *  HELPER FUNCTIONS
 *********************************************************************************************************************/

on sysvar Common::LastReceivedMessageId
{
  switch (@this)
  {
    case _CCS::DataTypes::SECCDiscoveryReq:
    case _CCS::DataTypes::SECCDiscoveryRes:
      @sysvar::Common::SysProtocolBar = @sysvar::Common::SysProtocolBar::SDP;
      break;
      
    // V2G messages
    case _CCS::DataTypes::SupportedAppProtocolReq: 
    case _CCS::DataTypes::SupportedAppProtocolRes: 
    case _CCS::DataTypes::SessionSetupReq:
    case _CCS::DataTypes::SessionSetupRes:
      @sysvar::Common::SysProtocolBar = @sysvar::Common::SysProtocolBar::SessionSetup;
      break;
      
    case _CCS::DataTypes::AuthorizationSetupReq:
    case _CCS::DataTypes::AuthorizationSetupRes:
    case _CCS::DataTypes::AuthorizationReq:
    case _CCS::DataTypes::AuthorizationRes:
      @sysvar::Common::SysProtocolBar = @sysvar::Common::SysProtocolBar::Authorization;
      break; 
      
    case _CCS::DataTypes::CertificateInstallationReq:
    case _CCS::DataTypes::CertificateInstallationRes:
      @sysvar::Common::SysProtocolBar = @sysvar::Common::SysProtocolBar::CertificateInstallation;
      break;  
      
    case _CCS::DataTypes::ServiceDiscoveryReq:
    case _CCS::DataTypes::ServiceDiscoveryRes:
      @sysvar::Common::SysProtocolBar = @sysvar::Common::SysProtocolBar::ServiceDiscovery;
      break; 
      
    case _CCS::DataTypes::ServiceDetailReq:
    case _CCS::DataTypes::ServiceDetailRes:
    case _CCS::DataTypes::ServiceSelectionReq:
    case _CCS::DataTypes::ServiceSelectionRes:
      @sysvar::Common::SysProtocolBar = @sysvar::Common::SysProtocolBar::ServiceDetail;
      break;    
     
    case _CCS::DataTypes::ACChargeParameterDiscoveryReq:
    case _CCS::DataTypes::ACChargeParameterDiscoveryRes:
    case _CCS::DataTypes::DCChargeParameterDiscoveryReq:
    case _CCS::DataTypes::DCChargeParameterDiscoveryRes:
      @sysvar::Common::SysProtocolBar = @sysvar::Common::SysProtocolBar::ChargeParameterDiscovery;
      break;
      
    case _CCS::DataTypes::ScheduleExchangeReq:
    case _CCS::DataTypes::ScheduleExchangeRes:
      @sysvar::Common::SysProtocolBar = @sysvar::Common::SysProtocolBar::ScheduleExchange;
      break;
      
    case _CCS::DataTypes::MeteringConfirmationReq:
    case _CCS::DataTypes::MeteringConfirmationRes:
    case _CCS::DataTypes::ACChargeLoopReq:
    case _CCS::DataTypes::ACChargeLoopRes:
    case _CCS::DataTypes::DCChargeLoopReq:
    case _CCS::DataTypes::DCChargeLoopRes:
      @sysvar::Common::SysProtocolBar = @sysvar::Common::SysProtocolBar::ChargeLoop;
      break;  

      case _CCS::DataTypes::SessionStopReq:
    case _CCS::DataTypes::SessionStopRes:
    case _CCS::DataTypes::DCWeldingDetectionReq:
    case _CCS::DataTypes::DCWeldingDetectionRes:
      @sysvar::Common::SysProtocolBar = @sysvar::Common::SysProtocolBar::StopCharging;
      break;       
    default:
      // Ignore
      break;
  }
}

ClearProtocolPanel()
{
  SetControlVisibility(gProtocolPanelName, "TResult1OK",  0);
  SetControlVisibility(gProtocolPanelName, "TResult1NOK", 0);
  SetControlVisibility(gProtocolPanelName, "TResult2OK",  0);
  SetControlVisibility(gProtocolPanelName, "TResult2NOK", 0);
  SetControlVisibility(gProtocolPanelName, "TResult3OK",  0);
  SetControlVisibility(gProtocolPanelName, "TResult3NOK", 0);
  SetControlVisibility(gProtocolPanelName, "TResult4OK",  0);
  SetControlVisibility(gProtocolPanelName, "TResult4NOK", 0);
  SetControlVisibility(gProtocolPanelName, "TResult5OK",  0);
  SetControlVisibility(gProtocolPanelName, "TResult5NOK", 0);
  SetControlVisibility(gProtocolPanelName, "TResult6OK",  0);
  SetControlVisibility(gProtocolPanelName, "TResult6NOK", 0);
  SetControlVisibility(gProtocolPanelName, "TResult7OK",  0);
  SetControlVisibility(gProtocolPanelName, "TResult7NOK", 0);
  SetControlVisibility(gProtocolPanelName, "TResult8OK",  0);
  SetControlVisibility(gProtocolPanelName, "TResult8NOK", 0);
  SetControlVisibility(gProtocolPanelName, "TResult9OK",  0);
  SetControlVisibility(gProtocolPanelName, "TResult9NOK", 0);
  SetControlVisibility(gProtocolPanelName, "TResult10OK",  0);
  SetControlVisibility(gProtocolPanelName, "TResult10NOK", 0);
  SetControlVisibility(gProtocolPanelName, "TResult11OK",  0);
  SetControlVisibility(gProtocolPanelName, "TResult11NOK", 0); 
  
  SetControlVisibility(gProtocolPanelName, "CertAuthOK", 0);
  SetControlVisibility(gProtocolPanelName, "CertAuthNOK", 0);
  SetControlVisibility(gProtocolPanelName, "CertUpdateOK", 0);
  SetControlVisibility(gProtocolPanelName, "CertUpdateNOK", 0);
  SetControlVisibility(gProtocolPanelName, "CertChargeParOK", 0);
  SetControlVisibility(gProtocolPanelName, "CertChargeParNOK", 0);
  SetControlVisibility(gProtocolPanelName, "CertChargeLoopOK", 0);
  SetControlVisibility(gProtocolPanelName, "CertChargeLoopNOK", 0);
}

void FUNC_CheckEVSE_BPT_Visibility()
{
  if ((@Common::SysUserBPTMode == sysvar::Common::SysUserBPTMode::BPT) && ( @sysvar::EV_Sim::Control::SysEV_ControlModeDynamic == sysvar::EV_Sim::Control::SysEV_ControlModeDynamic::Dynamic))
  {
    SetControlVisibility(gPanelName, gControlName, 1);
    SetMinMax(gPanelName, gDcCurrent, -1000.0, 1000.0);
  }
  else
  {
    SetControlVisibility(gPanelName, gControlName, 0);
    SetMinMax(gPanelName, gDcCurrent, 0.0, 1000.0);
  }
}

void FUNC_CheckEV_BPT_Visibility()
{
  if ((@Common::SysUserBPTMode == sysvar::Common::SysUserBPTMode::BPT) && ( @sysvar::EV_Sim::Control::SysEV_ControlModeDynamic == sysvar::EV_Sim::Control::SysEV_ControlModeDynamic::Scheduled))
  {
    SetControlVisibility(gEVPanelName, gControlName, 1);
  }
  else
  {
    SetControlVisibility(gEVPanelName, gControlName, 0);
  }
}