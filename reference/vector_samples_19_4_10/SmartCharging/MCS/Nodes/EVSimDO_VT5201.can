/*@!Encoding:1252*/
includes
{
  #include "EVSimDO_Common.cin"
  #include "CharIn_HW_InterfaceVT5201_EV.cin"
}

variables
{
  
}

