/*@!Encoding:1252*/
includes
{
  #include "EVSimDO_Common.cin"
  #include "CharIn_HW_Interface_EV.cin"
}

variables
{
  
}

