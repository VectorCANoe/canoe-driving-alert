/*@!Encoding:1252*/
includes
{
  #include "EVSESimDO_Common.cin"
  #include "CharIn_HW_InterfaceVT5201_EVSE.cin"
}

variables
{
  
}

