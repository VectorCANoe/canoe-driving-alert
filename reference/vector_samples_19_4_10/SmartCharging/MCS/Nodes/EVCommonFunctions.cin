/*@!Encoding:1252*/

variables
{
  const int cDC_ServiceID = 2;
  const int cDC_BPT_ServiceID = 6;  
  const int cMCS_ServiceID = 8;
  const int cMCS_BPT_ServiceID = 9;
  int AutoFill_body = 0;
  const long cBatteryCapacityInWh = 80000;
  const float cTargetSOC = 80.0;
  const float cMinimumSOC = 20.0;
  const int cRationalNumberMaxValue = 32767; // sint16 MaxValue
}

void ResetVariables()
{
  EVProcessingLoopCounter = 0;
 	EVSRProcessingLoopCounter = 0;
}

int GetCorrespondingMessageControlModeForSelectedControlMode()
{
  if (@sysvar::EV_Sim::Control::SysEV_ControlModeDynamic == @sysvar::EV_Sim::Control::SysEV_ControlModeDynamic::Dynamic){
    return _CCS::DataTypes::ControlModeType::Dynamic;
  }
  else{
    return _CCS::DataTypes::ControlModeType::Scheduled;
  }
}

/// <MCS_or_DC>
int GetCorrespondingMessageServiceIDForSelectedChargingMode()
{
  if (@sysvar::Common::SysUserBPTMode == sysvar::Common::SysUserBPTMode::No_BPT && @sysvar::Common::SysMCSServiceAMD == sysvar::Common::SysMCSServiceAMD::MCS)
  {    
    return cMCS_ServiceID; 
  }
  else if (@sysvar::Common::SysUserBPTMode == sysvar::Common::SysUserBPTMode::BPT && @sysvar::Common::SysMCSServiceAMD == sysvar::Common::SysMCSServiceAMD::MCS)
  { 
    return cMCS_BPT_ServiceID;
  }  
  else if (@sysvar::Common::SysUserBPTMode == sysvar::Common::SysUserBPTMode::No_BPT && @sysvar::Common::SysMCSServiceAMD == sysvar::Common::SysMCSServiceAMD::No_MCS)
  { 
    return cDC_ServiceID;
  } 
  else if (@sysvar::Common::SysUserBPTMode == sysvar::Common::SysUserBPTMode::BPT && @sysvar::Common::SysMCSServiceAMD == sysvar::Common::SysMCSServiceAMD::No_MCS)
  { 
    return cDC_BPT_ServiceID;
  } 
  else 
  {
    return 65535;
    writeLineEx(0,2,"Invalid ServiceID");
  }
}

ServiceSelection()
{
  int it;
  int selectedControlMode;
  int selectedServiceID;

  selectedControlMode = GetCorrespondingMessageControlModeForSelectedControlMode();
  selectedServiceID = GetCorrespondingMessageServiceIDForSelectedChargingMode();

  if ($EV.ISO20.ServiceDetail_Response.ServiceID == selectedServiceID)
  {
    EV.EnableAutoBodyFill.Call(0);
    AutoFill_body = 0;
    $EV.ISO20.ServiceSelection_Request.SelectedEnergyTransferService.ServiceID = $EV.ISO20.ServiceDetail_Response.ServiceID;
    
    switch($EV.ISO20.ServiceDetail_Response.ServiceID)
    {
      case 2: //DC
          for(it = 0; it < $EV.ISO20.ServiceDetail_Response.ServiceParameterList.ParameterSet.length; it++)
          {
            if($EV.ISO20.ServiceDetail_Response.ServiceParameterList.ParameterSet[it].Parameter.DC.ControlMode == selectedControlMode) 
            {              
              $EV.ISO20.ServiceSelection_Request.SelectedEnergyTransferService.ParameterSetID = $EV.ISO20.ServiceDetail_Response.ServiceParameterList.ParameterSet[it].ParameterSetID;
              break;
            }
          }
          break;
      case 8: //MCS      
        {
          for(it = 0; it < $EV.ISO20.ServiceDetail_Response.ServiceParameterList.ParameterSet.length; it++)
          {
            if($EV.ISO20.ServiceDetail_Response.ServiceParameterList.ParameterSet[it].Parameter.MCS.ControlMode == selectedControlMode) 
            {              
              $EV.ISO20.ServiceSelection_Request.SelectedEnergyTransferService.ParameterSetID = $EV.ISO20.ServiceDetail_Response.ServiceParameterList.ParameterSet[it].ParameterSetID;
              break;
            }
          }
        }
        break;
      case 6: //DC_BPT
          for(it = 0; it < $EV.ISO20.ServiceDetail_Response.ServiceParameterList.ParameterSet.length; it++)
          {
            if($EV.ISO20.ServiceDetail_Response.ServiceParameterList.ParameterSet[it].Parameter.DC_BPT.ControlMode == selectedControlMode) 
            {              
              $EV.ISO20.ServiceSelection_Request.SelectedEnergyTransferService.ParameterSetID = $EV.ISO20.ServiceDetail_Response.ServiceParameterList.ParameterSet[it].ParameterSetID;
              break;
            }
          }
          break;
      case 9: //MCS_BPT
        {
          for(it = 0; it < $EV.ISO20.ServiceDetail_Response.ServiceParameterList.ParameterSet.length; it++)
          {
            if($EV.ISO20.ServiceDetail_Response.ServiceParameterList.ParameterSet[it].Parameter.MCS_BPT.ControlMode == selectedControlMode)
            {
              $EV.ISO20.ServiceSelection_Request.SelectedEnergyTransferService.ParameterSetID = $EV.ISO20.ServiceDetail_Response.ServiceParameterList.ParameterSet[it].ParameterSetID;
              break;
            }
          }
        }
        break;
      default:// no charge mode
        {
          writeLineEx(0 , 2,"EV: No matching ParameterSetID was found. The default ParameterSetID value is used in the ServiceSelectionReq.");
        }
        break;
    }
  }
}

void FUNC_Set_DepartureTimeDefaults()
{
  const int DepartureTimeDefault = 900; //15 min
  
  $CCS::Simulation::EV.ISO20.ScheduleExchange_Request.SEReqControlMode.Dynamic_SEReqControlMode.DepartureTime = DepartureTimeDefault;
  //$CCS::Simulation::EV.ISO20.ScheduleExchange_Request.SEReqControlMode.Scheduled_SEReqControlMode.DepartureTime = DepartureTimeDefault;
  
  $CCS::Simulation::EV.ISO20.ScheduleExchange_Request.SEReqControlMode.Dynamic_SEReqControlMode.DepartureTime = DepartureTimeDefault;
  //$CCS::Simulation::EV.ISO20.ScheduleExchange_Request.SEReqControlMode.Scheduled_SEReqControlMode.DepartureTime = DepartureTimeDefault;

  $CCS::Simulation::EV.ISO20.DC_ChargeLoop_Request.CLReqControlMode.BPT_Dynamic_DC_CLReqControlMode.DepartureTime = DepartureTimeDefault;
  $CCS::Simulation::EV.ISO20.DC_ChargeLoop_Request.CLReqControlMode.Dynamic_DC_CLReqControlMode.DepartureTime = DepartureTimeDefault;
  
  $CCS::Simulation::EV.ISO20.AC_ChargeLoop_Request.CLReqControlMode.Dynamic_AC_CLReqControlMode.DepartureTime =  DepartureTimeDefault;
  $CCS::Simulation::EV.ISO20.AC_ChargeLoop_Request.CLReqControlMode.BPT_Dynamic_AC_CLReqControlMode.DepartureTime =  DepartureTimeDefault;
}

void FUNC_CheckEV_TargetCurrent_Visibility()
{
  if(@sysvar::EV_Sim::Control::SysEV_ControlModeDynamic == @sysvar::EV_Sim::Control::SysEV_ControlModeDynamic::Scheduled)
  {
    SetControlVisibility(gPanelName, "upDown_DCTargetCurrent", 1);
    SetControlVisibility(gPanelName, "lbl_DCTargetCurrent", 1);
  }
  else
  {
    SetControlVisibility(gPanelName, "upDown_DCTargetCurrent", 0);
    SetControlVisibility(gPanelName, "lbl_DCTargetCurrent", 0);
  }
}

void FUNC_Set_EVChargingMode()
{
  /* MCS */
  if (@sysvar::Common::SysUserBPTMode == sysvar::Common::SysUserBPTMode::No_BPT)
  {
    /* No BPT */
    setAttribute(CCS::Simulation::EV, CCSBinding::EnergyTransferService, CCSBinding::MCS);  
  }
  else
  {
    /* BPT */
    setAttribute(CCS::Simulation::EV, CCSBinding::EnergyTransferService, CCSBinding::MCS_BPT); 
  } 
}

void FUNC_Set_EVDCLimits_ChargeParameterDiscoveryReq()
{  
  /* EVMaximumChargePower */
  $EV.ISO20.DC_ChargeParameterDiscovery_Request.CPDReqEnergyTransferMode.DC_CPDReqEnergyTransferMode.EVMaximumChargePower.Value = @sysvar::EV_Sim::SysEV_MaxPowerDC;
  $EV.ISO20.DC_ChargeParameterDiscovery_Request.CPDReqEnergyTransferMode.DC_CPDReqEnergyTransferMode.EVMaximumChargePower.Exponent = 3; //Unit: kW
  $EV.ISO20.DC_ChargeParameterDiscovery_Request.CPDReqEnergyTransferMode.BPT_DC_CPDReqEnergyTransferMode.EVMaximumChargePower.Value = @sysvar::EV_Sim::SysEV_MaxPowerDC;
  $EV.ISO20.DC_ChargeParameterDiscovery_Request.CPDReqEnergyTransferMode.BPT_DC_CPDReqEnergyTransferMode.EVMaximumChargePower.Exponent = 3; //Unit: kW
  
  /* EVMaximumVoltage */
  $EV.ISO20.DC_ChargeParameterDiscovery_Request.CPDReqEnergyTransferMode.DC_CPDReqEnergyTransferMode.EVMaximumVoltage.Value = @sysvar::EV_Sim::SysEV_MaxVoltage;
  $EV.ISO20.DC_ChargeParameterDiscovery_Request.CPDReqEnergyTransferMode.DC_CPDReqEnergyTransferMode.EVMaximumVoltage.Exponent = 0;
  $EV.ISO20.DC_ChargeParameterDiscovery_Request.CPDReqEnergyTransferMode.BPT_DC_CPDReqEnergyTransferMode.EVMaximumVoltage.Value= @sysvar::EV_Sim::SysEV_MaxVoltage;
  $EV.ISO20.DC_ChargeParameterDiscovery_Request.CPDReqEnergyTransferMode.BPT_DC_CPDReqEnergyTransferMode.EVMaximumVoltage.Exponent = 0;
  
  /* EVMaximumChargeCurrent */
  $EV.ISO20.DC_ChargeParameterDiscovery_Request.CPDReqEnergyTransferMode.DC_CPDReqEnergyTransferMode.EVMaximumChargeCurrent.Value = @sysvar::EV_Sim::SysEV_MaxCurrent;
  $EV.ISO20.DC_ChargeParameterDiscovery_Request.CPDReqEnergyTransferMode.DC_CPDReqEnergyTransferMode.EVMaximumChargeCurrent.Exponent = 0;
  $EV.ISO20.DC_ChargeParameterDiscovery_Request.CPDReqEnergyTransferMode.BPT_DC_CPDReqEnergyTransferMode.EVMaximumChargeCurrent.Value = @sysvar::EV_Sim::SysEV_MaxCurrent;
  $EV.ISO20.DC_ChargeParameterDiscovery_Request.CPDReqEnergyTransferMode.BPT_DC_CPDReqEnergyTransferMode.EVMaximumChargeCurrent.Exponent = 0;
  
  /* EVMinimumChargeCurrent */
  $EV.ISO20.DC_ChargeParameterDiscovery_Request.CPDReqEnergyTransferMode.DC_CPDReqEnergyTransferMode.EVMinimumChargeCurrent.Value = @sysvar::EV_Sim::SysEV_MinCurrent;
  $EV.ISO20.DC_ChargeParameterDiscovery_Request.CPDReqEnergyTransferMode.DC_CPDReqEnergyTransferMode.EVMinimumChargeCurrent.Exponent = 0;
  $EV.ISO20.DC_ChargeParameterDiscovery_Request.CPDReqEnergyTransferMode.BPT_DC_CPDReqEnergyTransferMode.EVMinimumChargeCurrent.Value = @sysvar::EV_Sim::SysEV_MinCurrent;
  $EV.ISO20.DC_ChargeParameterDiscovery_Request.CPDReqEnergyTransferMode.BPT_DC_CPDReqEnergyTransferMode.EVMinimumChargeCurrent.Exponent = 0;
  
  /* EVMaximumDischargePower */
  $EV.ISO20.DC_ChargeParameterDiscovery_Request.CPDReqEnergyTransferMode.BPT_DC_CPDReqEnergyTransferMode.EVMaximumDischargePower.Value = - abs(@sysvar::EV_Sim::SysEV_MaxPowerDC);
  $EV.ISO20.DC_ChargeParameterDiscovery_Request.CPDReqEnergyTransferMode.BPT_DC_CPDReqEnergyTransferMode.EVMaximumDischargePower.Exponent = 3; //Unit: kW

  /* EVMaximumDischargeCurrent */
  $EV.ISO20.DC_ChargeParameterDiscovery_Request.CPDReqEnergyTransferMode.BPT_DC_CPDReqEnergyTransferMode.EVMaximumDischargeCurrent.Value = - abs(@sysvar::EV_Sim::SysEV_MaxCurrent);
  $EV.ISO20.DC_ChargeParameterDiscovery_Request.CPDReqEnergyTransferMode.BPT_DC_CPDReqEnergyTransferMode.EVMaximumDischargeCurrent.Exponent = 0;  
  
  /* EVMinimumDischargeCurrent */
  $EV.ISO20.DC_ChargeParameterDiscovery_Request.CPDReqEnergyTransferMode.BPT_DC_CPDReqEnergyTransferMode.EVMinimumDischargeCurrent.Value = - abs(@sysvar::EV_Sim::SysEV_MinCurrent);
  $EV.ISO20.DC_ChargeParameterDiscovery_Request.CPDReqEnergyTransferMode.BPT_DC_CPDReqEnergyTransferMode.EVMinimumDischargeCurrent.Exponent = 0;
}

void FUNC_Set_RationalNumberValue(struct _CCS::DataTypes::RationalNumber_Type rationalNumber, long valueToBeSet)
{
  int sign;
  int exponent;
  long value;
  
  sign = 1;
  exponent = 0;
  value = valueToBeSet;
  
  // Remember sign
  if(value < 0)
  {
    sign = -1; 
    value = abs(value);
  }
  
  while((value > cRationalNumberMaxValue)
          && (exponent < 3))
  {
    value /= 10;
    exponent++;
  }
  
  if(exponent == 3 && value > cRationalNumberMaxValue)
  {
    writeLineEx(0, 3, "Error: Value '%d' is too big or small and cannot be represented as a RationalNumber element", valueToBeSet);
    exponent = 0;
    value = 0;
  }
  else
  {
    // Apply sign again
    value *= sign;
  }
  
  rationalNumber.Value = value;
  rationalNumber.Exponent = exponent;
}

void FUNC_Set_EVEnergyValues_ScheduleExchangeReq()
{
  stack long PresentSOC = _round(@sysvar::EV_Sim::SysEV_BatteryState);
  
  // float helpers for calculations
  stack float remainingPercentageUntilTargetSOC = (cTargetSOC - PresentSOC) / 100;
  stack float remainingPercentageUntilFull = (100.0 - PresentSOC) / 100;
  stack float remainingPercentageUntilMinSOC = (PresentSOC - cMinimumSOC) / 100;
  
  // values to be set in message
  stack long EVTargetEnergyRequest = _round(cBatteryCapacityInWh * remainingPercentageUntilTargetSOC);
  stack long EVMaximumEnergyRequest = _round(cBatteryCapacityInWh * remainingPercentageUntilFull);
  stack long EVMinimumEnergyRequest = _round(cBatteryCapacityInWh * remainingPercentageUntilMinSOC);
  stack long EVMaximumV2XEnergyRequest = 0;
  stack long EVMinimumV2XEnergyRequest = 0;
  
  // already above target, so we would need to discharge
  if(PresentSOC > cTargetSOC)
  {
    EVTargetEnergyRequest *= -1;
  }
  
  // already above minimum, so we could discharge
  if(PresentSOC > cMinimumSOC)
  {
    EVMinimumEnergyRequest *= -1;
  }
  
  if(@sysvar::EV_Sim::Control::SysEV_ControlModeDynamic == @sysvar::EV_Sim::Control::SysEV_ControlModeDynamic::Dynamic)
  {
    // Common charging values
    $EV.ISO20.ScheduleExchange_Request.SEReqControlModeElementId = _CCS::DataTypes::parISO20SEReqMode::Dynamic_SEReq;
    FUNC_Set_RationalNumberValue($EV.ISO20.ScheduleExchange_Request.SEReqControlMode.Dynamic_SEReqControlMode.EVTargetEnergyRequest, EVTargetEnergyRequest);
    FUNC_Set_RationalNumberValue($EV.ISO20.ScheduleExchange_Request.SEReqControlMode.Dynamic_SEReqControlMode.EVMaximumEnergyRequest, EVMaximumEnergyRequest);
    FUNC_Set_RationalNumberValue($EV.ISO20.ScheduleExchange_Request.SEReqControlMode.Dynamic_SEReqControlMode.EVMinimumEnergyRequest, EVMinimumEnergyRequest);
    $EV.ISO20.ScheduleExchange_Request.SEReqControlMode.Dynamic_SEReqControlMode.MinimumSOC = cMinimumSOC;
    $EV.ISO20.ScheduleExchange_Request.SEReqControlMode.Dynamic_SEReqControlMode.TargetSOC = cTargetSOC;
    
    // BPT specific discharging values
    if(@sysvar::Common::SysUserBPTMode == @sysvar::Common::SysUserBPTMode::BPT)
    {
      FUNC_Set_RationalNumberValue($EV.ISO20.ScheduleExchange_Request.SEReqControlMode.Dynamic_SEReqControlMode.EVMaximumV2XEnergyRequest, EVMaximumV2XEnergyRequest);
      FUNC_Set_RationalNumberValue($EV.ISO20.ScheduleExchange_Request.SEReqControlMode.Dynamic_SEReqControlMode.EVMinimumV2XEnergyRequest, EVMinimumV2XEnergyRequest);
    }
    else
    {
      $EV.ISO20.ScheduleExchange_Request.SEReqControlMode.Dynamic_SEReqControlMode.EVMaximumV2XEnergyRequest.SetInvalid();
      $EV.ISO20.ScheduleExchange_Request.SEReqControlMode.Dynamic_SEReqControlMode.EVMinimumV2XEnergyRequest.SetInvalid();
    }
  }
  else
  {
    // Common charging values
    $EV.ISO20.ScheduleExchange_Request.SEReqControlModeElementId = _CCS::DataTypes::parISO20SEReqMode::Scheduled_SEReq;
    FUNC_Set_RationalNumberValue($EV.ISO20.ScheduleExchange_Request.SEReqControlMode.Scheduled_SEReqControlMode.EVTargetEnergyRequest, EVTargetEnergyRequest);
    FUNC_Set_RationalNumberValue($EV.ISO20.ScheduleExchange_Request.SEReqControlMode.Scheduled_SEReqControlMode.EVMaximumEnergyRequest, EVMaximumEnergyRequest);
    FUNC_Set_RationalNumberValue($EV.ISO20.ScheduleExchange_Request.SEReqControlMode.Scheduled_SEReqControlMode.EVMinimumEnergyRequest, EVMinimumEnergyRequest);    
    
    // BPT specific discharging values
    if(@sysvar::Common::SysUserBPTMode == @sysvar::Common::SysUserBPTMode::BPT)
    {
      FUNC_SET_EVEnergyOffer_ScheduleExchangeReq();
    }
    else
    {
      $EV.ISO20.ScheduleExchange_Request.SEReqControlMode.Scheduled_SEReqControlMode.EVEnergyOffer.SetInvalid();
    }
  }
}

void FUNC_SET_EVEnergyOffer_ScheduleExchangeReq()
{
  int i;
  
  $EV.ISO20.ScheduleExchange_Request.SEReqControlModeElementId = _CCS::DataTypes::parISO20SEReqMode::Scheduled_SEReq;
  $EV.ISO20.ScheduleExchange_Request.SEReqControlMode.Scheduled_SEReqControlMode.EVEnergyOffer.EVPowerSchedule.EVPowerScheduleEntries.EVPowerScheduleEntry.Length = 3;
  $EV.ISO20.ScheduleExchange_Request.SEReqControlMode.Scheduled_SEReqControlMode.EVEnergyOffer.EVAbsolutePriceSchedule.EVPriceRuleStacks.EVPriceRuleStack.Length = 3;
  for(i = 0; i < 3; i++)
  {
    $EV.ISO20.ScheduleExchange_Request.SEReqControlMode.Scheduled_SEReqControlMode.EVEnergyOffer.EVPowerSchedule.EVPowerScheduleEntries.EVPowerScheduleEntry[i].Duration = 100 + i * 100;
    $EV.ISO20.ScheduleExchange_Request.SEReqControlMode.Scheduled_SEReqControlMode.EVEnergyOffer.EVPowerSchedule.EVPowerScheduleEntries.EVPowerScheduleEntry[i].Power.Value = 100 + i * 100;
    $EV.ISO20.ScheduleExchange_Request.SEReqControlMode.Scheduled_SEReqControlMode.EVEnergyOffer.EVPowerSchedule.EVPowerScheduleEntries.EVPowerScheduleEntry[i].Power.Exponent = 1;
    
    $EV.ISO20.ScheduleExchange_Request.SEReqControlMode.Scheduled_SEReqControlMode.EVEnergyOffer.EVAbsolutePriceSchedule.EVPriceRuleStacks.EVPriceRuleStack[i].Duration = 100 + i * 100;
    $EV.ISO20.ScheduleExchange_Request.SEReqControlMode.Scheduled_SEReqControlMode.EVEnergyOffer.EVAbsolutePriceSchedule.EVPriceRuleStacks.EVPriceRuleStack[i].EVPriceRule.Length = 1;
    $EV.ISO20.ScheduleExchange_Request.SEReqControlMode.Scheduled_SEReqControlMode.EVEnergyOffer.EVAbsolutePriceSchedule.EVPriceRuleStacks.EVPriceRuleStack[i].EVPriceRule[0].EnergyFee.Value = 50;
    $EV.ISO20.ScheduleExchange_Request.SEReqControlMode.Scheduled_SEReqControlMode.EVEnergyOffer.EVAbsolutePriceSchedule.EVPriceRuleStacks.EVPriceRuleStack[i].EVPriceRule[0].EnergyFee.Exponent = 0;
    $EV.ISO20.ScheduleExchange_Request.SEReqControlMode.Scheduled_SEReqControlMode.EVEnergyOffer.EVAbsolutePriceSchedule.EVPriceRuleStacks.EVPriceRuleStack[i].EVPriceRule[0].PowerRangeStart.Value = 200;
    $EV.ISO20.ScheduleExchange_Request.SEReqControlMode.Scheduled_SEReqControlMode.EVEnergyOffer.EVAbsolutePriceSchedule.EVPriceRuleStacks.EVPriceRuleStack[i].EVPriceRule[0].PowerRangeStart.Exponent = 1;
  }
  $EV.ISO20.ScheduleExchange_Request.SEReqControlMode.Scheduled_SEReqControlMode.EVEnergyOffer.EVPowerSchedule.TimeAnchor = 200;
  $EV.ISO20.ScheduleExchange_Request.SEReqControlMode.Scheduled_SEReqControlMode.EVEnergyOffer.EVAbsolutePriceSchedule.TimeAnchor = 200;
  $EV.ISO20.ScheduleExchange_Request.SEReqControlMode.Scheduled_SEReqControlMode.EVEnergyOffer.EVAbsolutePriceSchedule.Currency = "EUR";
  $EV.ISO20.ScheduleExchange_Request.SEReqControlMode.Scheduled_SEReqControlMode.EVEnergyOffer.EVAbsolutePriceSchedule.PriceAlgorithm = "PriceAlgorithm";    
}

void FUNC_Set_EVDCLimits_PreChargeReq()
{
  $CCS::Simulation::EV.ISO20.DC_PreCharge_Request.EVTargetVoltage.Value = (@sysvar::EV_Sim::SysEV_TargetVoltage * 10);
  $CCS::Simulation::EV.ISO20.DC_PreCharge_Request.EVTargetVoltage.Exponent = -1;
}

void FUNC_Set_EVDCLimits_ChargeLoopReq()
{
  /* EVMaximumVoltage */
  $EV.ISO20.DC_ChargeLoop_Request.CLReqControlMode.Dynamic_DC_CLReqControlMode.EVMaximumVoltage.Value = @sysvar::EV_Sim::SysEV_MaxVoltage;
  $EV.ISO20.DC_ChargeLoop_Request.CLReqControlMode.Dynamic_DC_CLReqControlMode.EVMaximumVoltage.Exponent = 0;
  $EV.ISO20.DC_ChargeLoop_Request.CLReqControlMode.BPT_Dynamic_DC_CLReqControlMode.EVMaximumVoltage.Value = @sysvar::EV_Sim::SysEV_MaxVoltage;
  $EV.ISO20.DC_ChargeLoop_Request.CLReqControlMode.BPT_Dynamic_DC_CLReqControlMode.EVMaximumVoltage.Exponent = 0;
  $EV.ISO20.DC_ChargeLoop_Request.CLReqControlMode.Scheduled_DC_CLReqControlMode.EVMaximumVoltage.Value = @sysvar::EV_Sim::SysEV_MaxVoltage;
  $EV.ISO20.DC_ChargeLoop_Request.CLReqControlMode.Scheduled_DC_CLReqControlMode.EVMaximumVoltage.Exponent = 0;
  $EV.ISO20.DC_ChargeLoop_Request.CLReqControlMode.BPT_Scheduled_DC_CLReqControlMode.EVMaximumVoltage.Value = @sysvar::EV_Sim::SysEV_MaxVoltage;
  $EV.ISO20.DC_ChargeLoop_Request.CLReqControlMode.BPT_Scheduled_DC_CLReqControlMode.EVMaximumVoltage.Exponent = 0;
  
  /* EVMaximumChargePower */
  $EV.ISO20.DC_ChargeLoop_Request.CLReqControlMode.Scheduled_DC_CLReqControlMode.EVMaximumChargePower.Value = @sysvar::EV_Sim::SysEV_MaxPowerDC;
  $EV.ISO20.DC_ChargeLoop_Request.CLReqControlMode.Scheduled_DC_CLReqControlMode.EVMaximumChargePower.Exponent = 3; //Unit: kW  
  $EV.ISO20.DC_ChargeLoop_Request.CLReqControlMode.BPT_Scheduled_DC_CLReqControlMode.EVMaximumChargePower.Value = @sysvar::EV_Sim::SysEV_MaxPowerDC;
  $EV.ISO20.DC_ChargeLoop_Request.CLReqControlMode.BPT_Scheduled_DC_CLReqControlMode.EVMaximumChargePower.Exponent = 3; //Unit: kW
  $EV.ISO20.DC_ChargeLoop_Request.CLReqControlMode.Dynamic_DC_CLReqControlMode.EVMaximumChargePower.Value = @sysvar::EV_Sim::SysEV_MaxPowerDC;
  $EV.ISO20.DC_ChargeLoop_Request.CLReqControlMode.Dynamic_DC_CLReqControlMode.EVMaximumChargePower.Exponent = 3; //Unit: kW
  $EV.ISO20.DC_ChargeLoop_Request.CLReqControlMode.BPT_Dynamic_DC_CLReqControlMode.EVMaximumChargePower.Value = @sysvar::EV_Sim::SysEV_MaxPowerDC;
  $EV.ISO20.DC_ChargeLoop_Request.CLReqControlMode.BPT_Dynamic_DC_CLReqControlMode.EVMaximumChargePower.Exponent = 3; //Unit: kW

  /* EVMaximumChargeCurrent */
  $EV.ISO20.DC_ChargeLoop_Request.CLReqControlMode.Scheduled_DC_CLReqControlMode.EVMaximumChargeCurrent.Value = @sysvar::EV_Sim::SysEV_MaxCurrent;
  $EV.ISO20.DC_ChargeLoop_Request.CLReqControlMode.Scheduled_DC_CLReqControlMode.EVMaximumChargeCurrent.Exponent = 0;
  $EV.ISO20.DC_ChargeLoop_Request.CLReqControlMode.BPT_Scheduled_DC_CLReqControlMode.EVMaximumChargeCurrent.Value = @sysvar::EV_Sim::SysEV_MaxCurrent;
  $EV.ISO20.DC_ChargeLoop_Request.CLReqControlMode.BPT_Scheduled_DC_CLReqControlMode.EVMaximumChargeCurrent.Exponent = 0;
  $EV.ISO20.DC_ChargeLoop_Request.CLReqControlMode.Dynamic_DC_CLReqControlMode.EVMaximumChargeCurrent.Value = @sysvar::EV_Sim::SysEV_MaxCurrent;
  $EV.ISO20.DC_ChargeLoop_Request.CLReqControlMode.Dynamic_DC_CLReqControlMode.EVMaximumChargeCurrent.Exponent = 0;
  $EV.ISO20.DC_ChargeLoop_Request.CLReqControlMode.BPT_Dynamic_DC_CLReqControlMode.EVMaximumChargeCurrent.Value = @sysvar::EV_Sim::SysEV_MaxCurrent;
  $EV.ISO20.DC_ChargeLoop_Request.CLReqControlMode.BPT_Dynamic_DC_CLReqControlMode.EVMaximumChargeCurrent.Exponent = 0;
  
  /* EVMaximumDischargePower */
  $EV.ISO20.DC_ChargeLoop_Request.CLReqControlMode.BPT_Scheduled_DC_CLReqControlMode.EVMaximumDischargePower.Value = - abs(@sysvar::EV_Sim::SysEV_MaxPowerDC);
  $EV.ISO20.DC_ChargeLoop_Request.CLReqControlMode.BPT_Scheduled_DC_CLReqControlMode.EVMaximumDischargePower.Exponent = 3; //Unit: kW
  $EV.ISO20.DC_ChargeLoop_Request.CLReqControlMode.BPT_Dynamic_DC_CLReqControlMode.EVMaximumDischargePower.Value = - abs(@sysvar::EV_Sim::SysEV_MaxPowerDC);
  $EV.ISO20.DC_ChargeLoop_Request.CLReqControlMode.BPT_Dynamic_DC_CLReqControlMode.EVMaximumDischargePower.Exponent = 3; //Unit: kW
  
  /* EVMaximumDischargeCurrent */
  $EV.ISO20.DC_ChargeLoop_Request.CLReqControlMode.BPT_Scheduled_DC_CLReqControlMode.EVMaximumDischargeCurrent.Value = - abs(@sysvar::EV_Sim::SysEV_MaxCurrent);
  $EV.ISO20.DC_ChargeLoop_Request.CLReqControlMode.BPT_Scheduled_DC_CLReqControlMode.EVMaximumDischargeCurrent.Exponent = 0;
  $EV.ISO20.DC_ChargeLoop_Request.CLReqControlMode.BPT_Dynamic_DC_CLReqControlMode.EVMaximumDischargeCurrent.Value = - abs(@sysvar::EV_Sim::SysEV_MaxCurrent);
  $EV.ISO20.DC_ChargeLoop_Request.CLReqControlMode.BPT_Dynamic_DC_CLReqControlMode.EVMaximumDischargeCurrent.Exponent = 0;
  
  /*EVPowerProfileEntry */
  $CCS::Simulation::EV.ISO20.PowerDelivery_Request.EVPowerProfile.EVPowerProfileEntries.EVPowerProfileEntry[0].Power.Value = 5000;
  $CCS::Simulation::EV.ISO20.PowerDelivery_Request.EVPowerProfile.EVPowerProfileEntries.EVPowerProfileEntry[0].Power.Exponent = 0;
  $CCS::Simulation::EV.ISO20.PowerDelivery_Request.EVPowerProfile.EVPowerProfileEntries.EVPowerProfileEntry[1].Power.Value = 5000;
  $CCS::Simulation::EV.ISO20.PowerDelivery_Request.EVPowerProfile.EVPowerProfileEntries.EVPowerProfileEntry[1].Power.Exponent = 0;
  $CCS::Simulation::EV.ISO20.PowerDelivery_Request.EVPowerProfile.EVPowerProfileEntries.EVPowerProfileEntry[2].Power.Value = 5000;
  $CCS::Simulation::EV.ISO20.PowerDelivery_Request.EVPowerProfile.EVPowerProfileEntries.EVPowerProfileEntry[2].Power.Exponent = 0;
}


void FUNC_Set_EVDCChargeLoopValues()
{
  stack word TargetSOC = $EV.ISO20.DC_ChargeLoop_Request.DisplayParameters.TargetSOC;
  stack word PresentSOC = @sysvar::EV_Sim::SysEV_BatteryState;
  
  $EV.ISO20.DC_ChargeLoop_Request.EVPresentVoltage.Value = (HV_measure_DC_U() * 10);  
  $EV.ISO20.DC_ChargeLoop_Request.EVPresentVoltage.Exponent = -1;
    
  if (@sysvar::EV_Sim::Control::SysEV_ControlModeDynamic == @sysvar::EV_Sim::Control::SysEV_ControlModeDynamic::Dynamic)
  {
    if (@sysvar::Common::SysUserBPTMode == sysvar::Common::SysUserBPTMode::BPT) 
    { 
      stack double EVMaximumEnergyRequest;
      $EV.ISO20.DC_ChargeLoop_Request.CLReqControlModeElementId = 1; /* 1 for BPT_Dynamic_DC_CLReqControlMode */
      $EV.ISO20.DC_ChargeLoop_Request.CLReqControlMode.BPT_Dynamic_DC_CLReqControlMode.EVMaximumEnergyRequest.Value = 10000;
      $EV.ISO20.DC_ChargeLoop_Request.CLReqControlMode.BPT_Dynamic_DC_CLReqControlMode.EVMaximumEnergyRequest.Exponent = 0;
      EVMaximumEnergyRequest = getValueConsideringExponent($EV.ISO20.DC_ChargeLoop_Request.CLReqControlMode.BPT_Dynamic_DC_CLReqControlMode.EVMaximumEnergyRequest.Value, 
                                                           $EV.ISO20.DC_ChargeLoop_Request.CLReqControlMode.BPT_Dynamic_DC_CLReqControlMode.EVMaximumEnergyRequest.Exponent);
      $EV.ISO20.DC_ChargeLoop_Request.CLReqControlMode.BPT_Dynamic_DC_CLReqControlMode.EVTargetEnergyRequest.Value = EVMaximumEnergyRequest * (TargetSOC - PresentSOC)/100;
      $EV.ISO20.DC_ChargeLoop_Request.CLReqControlMode.BPT_Dynamic_DC_CLReqControlMode.EVTargetEnergyRequest.Exponent = 0;
    }
    else
    {
      stack double EVMaximumEnergyRequest;
      $EV.ISO20.DC_ChargeLoop_Request.CLReqControlModeElementId = 0; /* 0 for Dynamic_DC_CLReqControlMode */
      $EV.ISO20.DC_ChargeLoop_Request.CLReqControlMode.Dynamic_DC_CLReqControlMode.EVMaximumEnergyRequest.Value = 10000;
      $EV.ISO20.DC_ChargeLoop_Request.CLReqControlMode.Dynamic_DC_CLReqControlMode.EVMaximumEnergyRequest.Exponent = 0;
      EVMaximumEnergyRequest = $EV.ISO20.DC_ChargeLoop_Request.CLReqControlMode.Dynamic_DC_CLReqControlMode.EVMaximumEnergyRequest.Value;
      EVMaximumEnergyRequest = $EV.ISO20.DC_ChargeLoop_Request.CLReqControlMode.Dynamic_DC_CLReqControlMode.EVMaximumEnergyRequest.Exponent = 0;
      $EV.ISO20.DC_ChargeLoop_Request.CLReqControlMode.Dynamic_DC_CLReqControlMode.EVTargetEnergyRequest.Value = EVMaximumEnergyRequest * (TargetSOC - PresentSOC)/100;
      $EV.ISO20.DC_ChargeLoop_Request.CLReqControlMode.Dynamic_DC_CLReqControlMode.EVTargetEnergyRequest.Exponent = 0;
    }
  }
  else
  {
    if (@sysvar::Common::SysUserBPTMode == sysvar::Common::SysUserBPTMode::BPT) 
    {
      $EV.ISO20.DC_ChargeLoop_Request.CLReqControlModeElementId = 3; /* 3 for BPT_Scheduled_DC_CLReqControlMode */
      if($EV.ISO20.DC_ChargeLoop_Request.CLReqControlMode.BPT_Scheduled_DC_CLReqControlMode.EVMaximumEnergyRequest.IsValid)
      {
        stack double EVMaximumEnergyRequest = getValueConsideringExponent($EV.ISO20.DC_ChargeLoop_Request.CLReqControlMode.BPT_Scheduled_DC_CLReqControlMode.EVMaximumEnergyRequest.Value, 
                                                                          $EV.ISO20.DC_ChargeLoop_Request.CLReqControlMode.BPT_Scheduled_DC_CLReqControlMode.EVMaximumEnergyRequest.Exponent);
        $EV.ISO20.DC_ChargeLoop_Request.CLReqControlMode.BPT_Scheduled_DC_CLReqControlMode.EVTargetEnergyRequest.Value = EVMaximumEnergyRequest * (TargetSOC - PresentSOC)/100;
        $EV.ISO20.DC_ChargeLoop_Request.CLReqControlMode.BPT_Scheduled_DC_CLReqControlMode.EVTargetEnergyRequest.Exponent = 0;
      }
      $EV.ISO20.DC_ChargeLoop_Request.CLReqControlModeElementId = 3; /* 3 for BPT_Scheduled_DC_CLReqControlMode */
      if (@sysvar::EV_Sim::Control::SysEV_ChargeDischarge == sysvar::EV_Sim::Control::SysEV_ChargeDischarge::Charge)
        $EV.ISO20.DC_ChargeLoop_Request.CLReqControlMode.BPT_Scheduled_DC_CLReqControlMode.EVTargetCurrent.Value = @sysvar::EV_Sim::SysEV_TargetCurrent;
      else
        $EV.ISO20.DC_ChargeLoop_Request.CLReqControlMode.BPT_Scheduled_DC_CLReqControlMode.EVTargetCurrent.Value = - abs(@sysvar::EV_Sim::SysEV_TargetCurrent);
      $EV.ISO20.DC_ChargeLoop_Request.CLReqControlMode.BPT_Scheduled_DC_CLReqControlMode.EVTargetCurrent.Exponent = 0;
      $EV.ISO20.DC_ChargeLoop_Request.CLReqControlMode.BPT_Scheduled_DC_CLReqControlMode.EVTargetVoltage.Value = @sysvar::EV_Sim::SysEV_TargetVoltage;
      $EV.ISO20.DC_ChargeLoop_Request.CLReqControlMode.BPT_Scheduled_DC_CLReqControlMode.EVTargetVoltage.Exponent = 0;
    }
    else
    {
      $EV.ISO20.DC_ChargeLoop_Request.CLReqControlModeElementId = 2; /* 2 for Scheduled_DC_CLReqControlMode */
      if($EV.ISO20.DC_ChargeLoop_Request.CLReqControlMode.Scheduled_DC_CLReqControlMode.EVMaximumEnergyRequest.isValid)
      {
        stack double EVMaximumEnergyRequest = getValueConsideringExponent($EV.ISO20.DC_ChargeLoop_Request.CLReqControlMode.Scheduled_DC_CLReqControlMode.EVMaximumEnergyRequest.Value, 
                                                                        $EV.ISO20.DC_ChargeLoop_Request.CLReqControlMode.Scheduled_DC_CLReqControlMode.EVMaximumEnergyRequest.Exponent);
        $EV.ISO20.DC_ChargeLoop_Request.CLReqControlMode.Scheduled_DC_CLReqControlMode.EVTargetEnergyRequest.Value = EVMaximumEnergyRequest * (TargetSOC - PresentSOC)/100;
        $EV.ISO20.DC_ChargeLoop_Request.CLReqControlMode.Scheduled_DC_CLReqControlMode.EVTargetEnergyRequest.Exponent = 0;
      }
      $EV.ISO20.DC_ChargeLoop_Request.CLReqControlModeElementId = 2; /* 2 for Scheduled_DC_CLReqControlMode */
      $EV.ISO20.DC_ChargeLoop_Request.CLReqControlMode.Scheduled_DC_CLReqControlMode.EVTargetCurrent.Value = @sysvar::EV_Sim::SysEV_TargetCurrent;
      $EV.ISO20.DC_ChargeLoop_Request.CLReqControlMode.Scheduled_DC_CLReqControlMode.EVTargetCurrent.Exponent = 0;
      $EV.ISO20.DC_ChargeLoop_Request.CLReqControlMode.Scheduled_DC_CLReqControlMode.EVTargetVoltage.Value = @sysvar::EV_Sim::SysEV_TargetVoltage;
      $EV.ISO20.DC_ChargeLoop_Request.CLReqControlMode.Scheduled_DC_CLReqControlMode.EVTargetVoltage.Exponent = 0;
    }
  }
}

void FUNC_Set_EVDCLimits_ScheduleRenegotiationChargeParameterDiscoveryReq()
{  
  /* EVMaximumChargePower */
  $EV.ScheduleRenegotiation.DC_ChargeParameterDiscovery_Request.CPDReqEnergyTransferMode.DC_CPDReqEnergyTransferMode.EVMaximumChargePower.Value = @sysvar::EV_Sim::SysEV_MaxPowerDC;
  $EV.ScheduleRenegotiation.DC_ChargeParameterDiscovery_Request.CPDReqEnergyTransferMode.DC_CPDReqEnergyTransferMode.EVMaximumChargePower.Exponent = 3; //Unit: kW
  $EV.ScheduleRenegotiation.DC_ChargeParameterDiscovery_Request.CPDReqEnergyTransferMode.BPT_DC_CPDReqEnergyTransferMode.EVMaximumChargePower.Value = @sysvar::EV_Sim::SysEV_MaxPowerDC;
  $EV.ScheduleRenegotiation.DC_ChargeParameterDiscovery_Request.CPDReqEnergyTransferMode.BPT_DC_CPDReqEnergyTransferMode.EVMaximumChargePower.Exponent = 3; //Unit: kW
  
  /* EVMaximumVoltage */
  $EV.ScheduleRenegotiation.DC_ChargeParameterDiscovery_Request.CPDReqEnergyTransferMode.DC_CPDReqEnergyTransferMode.EVMaximumVoltage.Value = @sysvar::EV_Sim::SysEV_MaxVoltage;
  $EV.ScheduleRenegotiation.DC_ChargeParameterDiscovery_Request.CPDReqEnergyTransferMode.DC_CPDReqEnergyTransferMode.EVMaximumVoltage.Exponent = 0;
  $EV.ScheduleRenegotiation.DC_ChargeParameterDiscovery_Request.CPDReqEnergyTransferMode.BPT_DC_CPDReqEnergyTransferMode.EVMaximumVoltage.Value= @sysvar::EV_Sim::SysEV_MaxVoltage;
  $EV.ScheduleRenegotiation.DC_ChargeParameterDiscovery_Request.CPDReqEnergyTransferMode.BPT_DC_CPDReqEnergyTransferMode.EVMaximumVoltage.Exponent = 0;
  
  /* EVMaximumChargeCurrent */
  $EV.ScheduleRenegotiation.DC_ChargeParameterDiscovery_Request.CPDReqEnergyTransferMode.DC_CPDReqEnergyTransferMode.EVMaximumChargeCurrent.Value = @sysvar::EV_Sim::SysEV_MaxCurrent;
  $EV.ScheduleRenegotiation.DC_ChargeParameterDiscovery_Request.CPDReqEnergyTransferMode.DC_CPDReqEnergyTransferMode.EVMaximumChargeCurrent.Exponent = 0;
  $EV.ScheduleRenegotiation.DC_ChargeParameterDiscovery_Request.CPDReqEnergyTransferMode.BPT_DC_CPDReqEnergyTransferMode.EVMaximumChargeCurrent.Value = @sysvar::EV_Sim::SysEV_MaxCurrent;
  $EV.ScheduleRenegotiation.DC_ChargeParameterDiscovery_Request.CPDReqEnergyTransferMode.BPT_DC_CPDReqEnergyTransferMode.EVMaximumChargeCurrent.Exponent = 0;
  
  /* EVMinimumChargeCurrent */
  $EV.ScheduleRenegotiation.DC_ChargeParameterDiscovery_Request.CPDReqEnergyTransferMode.DC_CPDReqEnergyTransferMode.EVMinimumChargeCurrent.Value = @sysvar::EV_Sim::SysEV_MinCurrent;
  $EV.ScheduleRenegotiation.DC_ChargeParameterDiscovery_Request.CPDReqEnergyTransferMode.DC_CPDReqEnergyTransferMode.EVMinimumChargeCurrent.Exponent = 0;
  $EV.ScheduleRenegotiation.DC_ChargeParameterDiscovery_Request.CPDReqEnergyTransferMode.BPT_DC_CPDReqEnergyTransferMode.EVMinimumChargeCurrent.Value = @sysvar::EV_Sim::SysEV_MinCurrent;
  $EV.ScheduleRenegotiation.DC_ChargeParameterDiscovery_Request.CPDReqEnergyTransferMode.BPT_DC_CPDReqEnergyTransferMode.EVMinimumChargeCurrent.Exponent = 0;
  
  /* EVMaximumDischargePower */
  $EV.ScheduleRenegotiation.DC_ChargeParameterDiscovery_Request.CPDReqEnergyTransferMode.BPT_DC_CPDReqEnergyTransferMode.EVMaximumDischargePower.Value = - abs(@sysvar::EV_Sim::SysEV_MaxPowerDC);
  $EV.ScheduleRenegotiation.DC_ChargeParameterDiscovery_Request.CPDReqEnergyTransferMode.BPT_DC_CPDReqEnergyTransferMode.EVMaximumDischargePower.Exponent = 3; //Unit: kW

  /* EVMaximumDischargeCurrent */
  $EV.ScheduleRenegotiation.DC_ChargeParameterDiscovery_Request.CPDReqEnergyTransferMode.BPT_DC_CPDReqEnergyTransferMode.EVMaximumDischargeCurrent.Value = - abs(@sysvar::EV_Sim::SysEV_MaxCurrent);
  $EV.ScheduleRenegotiation.DC_ChargeParameterDiscovery_Request.CPDReqEnergyTransferMode.BPT_DC_CPDReqEnergyTransferMode.EVMaximumDischargeCurrent.Exponent = 0;  
  
  /* EVMinimumDischargeCurrent */
  $EV.ScheduleRenegotiation.DC_ChargeParameterDiscovery_Request.CPDReqEnergyTransferMode.BPT_DC_CPDReqEnergyTransferMode.EVMinimumDischargeCurrent.Value = - abs(@sysvar::EV_Sim::SysEV_MinCurrent);
  $EV.ScheduleRenegotiation.DC_ChargeParameterDiscovery_Request.CPDReqEnergyTransferMode.BPT_DC_CPDReqEnergyTransferMode.EVMinimumDischargeCurrent.Exponent = 0;
}