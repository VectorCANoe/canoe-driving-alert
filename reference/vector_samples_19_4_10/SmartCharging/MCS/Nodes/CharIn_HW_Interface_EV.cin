/*@!Encoding:1252*/
includes
{
  
}

variables
{
  int inletLocked = 0, muteISO = 0;  
}

ST_Init()
{
  // Close required bus bars at VT2004
  @sysvar::VTS::VT2004_2_Ch1::RelayBusBar2B = 1;
  @sysvar::VTS::VT2004_2_Ch2::RelayBusBar2B = 1;
  @sysvar::VTS::VT2004_2_Ch3::RelayBusBar2B = 0;
  @sysvar::VTS::VT2004_2_Ch4::RelayBusBar2B = 1; 

  // Initial setting of resistor values
  Calculate_Resistance_CE_EV(@EVCC::IEC61851::Rv4, @EVCC::IEC61851::Rv5, @EVCC::IEC61851::Rv6, @EVCC::IEC61851::Rv7, @EVCC::IEC61851::Sv3, @EVCC::IEC61851::Sv4);
  
  // Initial switch on of Xv1 (5V) for ID supply
  sysvar::VTS::VT2004_2_Ch1.SetStimulationMode(eVTSStimulationModeVoltage);
  @sysvar::VTS::VT2004_2_Ch1::Voltage = 5;
  sysvar::VTS::VT2004_2_Ch1.StartStimulation();
  
  //Initial switch on of Rv1
  sysvar::VTS::VT2004_2_Ch4.SetStimulationMode(eVTSStimulationModeResistanceGreater);
  @sysvar::VTS::VT2004_2_Ch4::Resistor = @EVCC::IEC61851::Rv1;
  sysvar::VTS::VT2004_2_Ch4.StartStimulation();
  
  //Initial switch on of Rv3
  sysvar::VTS::VT2004_2_Ch3.SetStimulationMode(eVTSStimulationModeResistanceGreater);
  @sysvar::VTS::VT2004_2_Ch3::Resistor = @EVCC::IEC61851::Rv3;
  sysvar::VTS::VT2004_2_Ch3.StartStimulation();
  // open DC contactors
  HV_source_set_output(0);
  HV_PSU_DC_enable(0);
  
  //UnMute ISO
  UnMute_ISO();  
}

/// <CharINInterface>
export long ST_Reset()
{  
  HV_source_set_output(0);
  HV_PSU_DC_enable(0);
    
  return 0;
}

/// <CharINInterface>
ST_PlugIn()
{
  //ID relay
  @sysvar::VTS::VT2004_2_Ch2::RelayOrgSensor = 1;
  //CE relay
  @sysvar::VTS::VT2004_2_Ch4::RelayOrgSensor = 1;
  expectedCEState = State_B;
}

/// <CharINInterface>
ST_PlugOut()
{
  //ID relay
  @sysvar::VTS::VT2004_2_Ch2::RelayOrgSensor = 0;
  //CE relay
  @sysvar::VTS::VT2004_2_Ch4::RelayOrgSensor = 0;
  expectedCEState = State_A; // or E
}

on sysvar_update VTS::VT2816_2_Ch1::CurVoltage
{
  @sysvar::EVCC::IEC61851::Vv2_CE_EV = @this;
}

on sysvar_update VTS::VT2816_2_Ch2::CurVoltage
{
  @sysvar::EVCC::IEC61851::Vv1_ID_EV = @this;
}

on sysvar_update EVCC::IEC61851::Xv1
{
  @sysvar::VTS::VT2004_2_Ch1::Voltage = @this;
}

on sysvar_update EVCC::IEC61851::Rv1
{
  @sysvar::VTS::VT2004_2_Ch4::Resistor = @this;
}

on sysvar_update EVCC::IEC61851::Rv3
{
  @sysvar::VTS::VT2004_2_Ch3::Resistor = @this;
}

on sysvar_update EVCC::IEC61851::Rv4
{
  Calculate_Resistance_CE_EV(@this, @EVCC::IEC61851::Rv5, @EVCC::IEC61851::Rv6, @EVCC::IEC61851::Rv7, @EVCC::IEC61851::Sv3, @EVCC::IEC61851::Sv4);
}

on sysvar_update EVCC::IEC61851::Rv5
{
  Calculate_Resistance_CE_EV(@EVCC::IEC61851::Rv4, @this, @EVCC::IEC61851::Rv6, @EVCC::IEC61851::Rv7, @EVCC::IEC61851::Sv3, @EVCC::IEC61851::Sv4);
}

on sysvar_update EVCC::IEC61851::Rv6
{
  Calculate_Resistance_CE_EV(@EVCC::IEC61851::Rv4, @EVCC::IEC61851::Rv5, @this, @EVCC::IEC61851::Rv7, @EVCC::IEC61851::Sv3, @EVCC::IEC61851::Sv4);
}

on sysvar_update EVCC::IEC61851::Rv7
{
  Calculate_Resistance_CE_EV(@EVCC::IEC61851::Rv4, @EVCC::IEC61851::Rv5, @EVCC::IEC61851::Rv6, @this, @EVCC::IEC61851::Sv3, @EVCC::IEC61851::Sv4);
}

on sysvar_update EVCC::IEC61851::Sv3
{
  Calculate_Resistance_CE_EV(@EVCC::IEC61851::Rv4, @EVCC::IEC61851::Rv5, @EVCC::IEC61851::Rv6, @EVCC::IEC61851::Rv7, @this, @EVCC::IEC61851::Sv4);
}

on sysvar_update EVCC::IEC61851::Sv4
{
  Calculate_Resistance_CE_EV(@EVCC::IEC61851::Rv4, @EVCC::IEC61851::Rv5, @EVCC::IEC61851::Rv6, @EVCC::IEC61851::Rv7, @EVCC::IEC61851::Sv3, @this);
}

// Resitor calculation for Rv4, Rv5, Rv6, Rv7 (see IEC 61851-23-3)
Calculate_Resistance_CE_EV(double Rv4, double Rv5, double Rv6, double Rv7, double Sv3, double Sv4)
{
  double Rcalc;
  
  if(Rv4>0 && Rv5>0 && Rv6>0 && Rv7>0)
    Rcalc = Rv4 + (1 / ( (1/Rv5) + (1/Rv6)*Sv3 + (1/Rv7)*Sv4));
  else
    Rcalc = 0;
  
  sysvar::VTS::VT2004_2_Ch2.SetStimulationMode(eVTSStimulationModeResistanceGreater);
  @sysvar::VTS::VT2004_2_Ch2::Resistor = Rcalc;
  sysvar::VTS::VT2004_2_Ch2.StartStimulation();  
}

on value_update EV.StimCPState
{
  switch ($EV.StimCPState)
  {
    case _CCS::DataTypes::CPStateType::State_B:
      SetCPStateB();
      break;
    case _CCS::DataTypes::CPStateType::State_C:
    case _CCS::DataTypes::CPStateType::State_D:
      SetCPStateC();
      break;
    case _CCS::DataTypes::CPStateType::State_Undefined:
      break; // Initial state
    default:
      // other states not allowed (set by EV)
      WriteLineEx(0, 2, "EV: 'OnStimCPStateChanged' called wih invalid value %d!", $this);
      break;
  }
}

/// <CP_PP>
void SetCPStateB()
{
  @EVCC::IEC61851::Sv3 = 0;
  expectedCEState = State_B;
}

/// <CP_PP>
void SetCPStateC()
{
  @EVCC::IEC61851::Sv3 = 1;
  expectedCEState = State_C;
}

on sysvar VTS::VT2816_2_Ch1::CurVoltage
{
  //*_Aux states are ignored, because the card cannot measure them
  if((@this >= -0.1) && (@this <= 0.1))
  {
    //state A or E
    if((expectedCEState == State_A || expectedCEState == State_E || debounceCounter++ >= debounceLimit)
      && simulationRunning == 1)
    {
      DebouncedCEStateDetection(State_A);
      debounceCounter = 0;
    }
  }
  else if((@this >= 2.38) && (@this <= 3.16))
  {
    //state B0
    if((expectedCEState == State_B0) || debounceCounter++ >= debounceLimit)
    {
      DebouncedCEStateDetection(State_B0);
      debounceCounter = 0; 
      ReactToStateB0();
    }
  }
  else if((@this >= 3.38) && (@this <= 4.04))
  {
    //state B
    if((expectedCEState == State_B || debounceCounter++ >= debounceLimit))      
    {
      DebouncedCEStateDetection(State_B);
      debounceCounter = 0; 
      ReactToStateB();
    }
  }
  else if((@this >= 1.02) && (@this <= 1.4))
  {
    //state C
    if((expectedCEState == State_C || debounceCounter++ >= debounceLimit) 
      && simulationRunning == 1)
    {
      DebouncedCEStateDetection(State_C);
      debounceCounter = 0;
    }
      
  }
  else if((@this >= 0.53) && (@this <= 0.74))
  {
    //state EC
    if((expectedCEState == State_EC || debounceCounter++ >= debounceLimit) 
      && simulationRunning == 1)
    {
      DebouncedCEStateDetection(State_EC);
      debounceCounter = 0;
      ReactToStateEC();
    }
  }
  else
  {
    //unexpected voltage measured during simulation
    if(simulationRunning == 1)
    {
      if(debounceCounter++ >= debounceLimit)
      {
        debounceCounter = 0;
        WriteLineEx(0, 3, "EV: Measured unexpected voltage not matching any defined CE state: %fV", @this);
      }        
    }
  }
}

void DebouncedCEStateDetection(int ceState)
{
  if(ceState != expectedCEState 
    && expectedCEState != State_Undefined 
    && simulationRunning == 1)
  {
    WriteLineEx(0, 3, "EV: Unexpectedly measured CE state %d; Expected: %d", ceState, expectedCEState);
  }
}

// ID
on sysvar VTS::VT2816_2_Ch2::CurVoltage
{
  //*_Aux states are ignored, because the card cannot measure them
  if(simulationRunning == 0)
    return;
  
  if((@this >= 4.5) && (@this <= 5.5))
  {
    //Inlet not present
  }
  else if((@this >= 2.19) && (@this <= 2.75))
  {
    //Unmated
    if(expectedCEState != State_A && inletLocked != 0)
      WriteLineEx(0, 3, "EV: Unexpectedly measured ID state 'Unmated'");
  }
  else if((@this >= 1.43) && (@this <= 1.82))
  {
    //Mated_NoEVSE
    if(expectedCEState != State_B && inletLocked != 1)
      WriteLineEx(0, 3, "EV: Unexpectedly measured ID state 'Mated_NoEVSE'; State: %d", expectedCEState);
  }
  else if((@this >= 0.74) && (@this <= 1.37))
  {
    //Mated_EVSE
    if(expectedCEState != State_B 
      && expectedCEState != State_C
      && expectedCEState != State_EC 
      && inletLocked != 1)
      WriteLineEx(0, 3, "EV: Unexpectedly measured ID state 'Mated_EVSE'; State: %d", expectedCEState);
  }
  else
  {
    WriteLineEx(0, 3, "EV: Measured unexpected voltage not matching any defined ID state: %fV", @this);
  }
}

//////////////////////////////////////////////////////////////////////////////////////////////////////
// general HW interface
//////////////////////////////////////////////////////////////////////////////////////////////////////


/// <CharINInterface>
export long HV_source_set_output(int enable)
{
  return 0;
}

/// <CharINInterfaceDC>
export long HV_PSU_DC_enable(int enable)
{
  //enable DC power supply
  
  return 0;
}

/// <CharINInterface>
export long HV_source_perform_welding()
{
  return 0;
}

export long HV_source_set_I_DC(double current)
{
  return 0;
}

export long HV_source_set_U_DC(double voltage)
{
  if(voltage > 10)  //sink voltage
    voltage -= 10;
  
  return 0;
}

//function will receive positive voltage value within PreCharge and CurrentDemand
export long HV_source_set_U_DC_PreCharge(double voltage)
{
  return 0;
}

/// <CharINInterfaceDC>
double HV_measure_DC_U()
{
  if(@sysvar::EV_Sim::SysEV_State > 18)
    return ($EV.ISO20.DC_ChargeLoop_Response.EVSEPresentVoltage.Value * _pow(10, $EV.ISO20.DC_ChargeLoop_Response.EVSEPresentVoltage.Exponent));
  else
    return ($EV.ISO20.DC_PreCharge_Response.EVSEPresentVoltage.Value * _pow(10, $EV.ISO20.DC_PreCharge_Response.EVSEPresentVoltage.Exponent));
}

/// <CharINInterfaceDC>
export double HV_measure_DC_U_VeriVolt()
{
  return HV_measure_DC_U();
}

/// <CharINInterfaceDC>
 double HV_measure_DC_I()
{
  return ($EV.ISO20.DC_ChargeLoop_Response.EVSEPresentCurrent.Value * _pow(10, $EV.ISO20.DC_ChargeLoop_Response.EVSEPresentCurrent.Exponent));
}

/// <CharInInterface>
int GetLockState()
{
  return 0;
}

Mute_ISO()
{
  muteISO = 1;
  return;
}

UnMute_ISO()
{
  muteISO = 0;
  return;
}

int GetISOMonitoringMuted()
{
  return muteISO;
}

LockConnector()
{
  inletLocked = 1;
}

UnlockConnector()
{
  inletLocked = 0;
}

int GetConnectorLockState()
{
  return inletLocked;
}