/*@!Encoding:1252*/
includes
{
  #include "UtilityFunctions.cin"
}

variables
{
  const int cHeartbeatInterval = 60; // seconds
  int transactionID;
}

/**********************************************************************************************************************
 *  Trigger sending of request as reaction to response (example behavior)
 *********************************************************************************************************************/

on value_update OCPP::Simulation::CSMS.OCPP16.StartTransactionResponse
{
  if (@sysvar::Common::SysPricingRequirementMode == 0)
  {
    // trigger sending of message
    $OCPP::Simulation::CSMS.OCPP16.SetChargingProfileRequest;
  }
}

on value_update OCPP::Simulation::CSMS.OCPP16.SetChargingProfileResponse
{
  // trigger sending of message
  $OCPP::Simulation::CSMS.OCPP16.RemoteStopTransactionRequest;
}

/**********************************************************************************************************************
 *  Trigger sending of response as reaction to request
 *********************************************************************************************************************/

on value_update OCPP::Simulation::CSMS.OCPP16.AuthorizeRequest
{
  // trigger sending of message
  $OCPP::Simulation::CSMS.OCPP16.AuthorizeResponse;
}

on value_update OCPP::Simulation::CSMS.OCPP16.BootNotificationRequest
{
  // trigger sending of message
  $OCPP::Simulation::CSMS.OCPP16.BootNotificationResponse.interval = cHeartbeatInterval;
  $OCPP::Simulation::CSMS.OCPP16.BootNotificationResponse;
}

on value_update OCPP::Simulation::CSMS.OCPP16.DataTransferRequest
{
  // trigger sending of message
  $OCPP::Simulation::CSMS.OCPP16.DataTransferResponse;
}

on value_update OCPP::Simulation::CSMS.OCPP16.DiagnosticsStatusNotificationRequest
{
  // trigger sending of message
  $OCPP::Simulation::CSMS.OCPP16.DiagnosticsStatusNotificationResponse;
}

on value_update OCPP::Simulation::CSMS.OCPP16.FirmwareStatusNotificationRequest
{
  // trigger sending of message
  $OCPP::Simulation::CSMS.OCPP16.FirmwareStatusNotificationResponse;
}

on value_update OCPP::Simulation::CSMS.OCPP16.HeartbeatRequest
{
  // trigger sending of message
  $OCPP::Simulation::CSMS.OCPP16.HeartbeatResponse;
}

on value_update OCPP::Simulation::CSMS.OCPP16.MeterValuesRequest
{
  // trigger sending of message
  $OCPP::Simulation::CSMS.OCPP16.MeterValuesResponse;
}

on value_update OCPP::Simulation::CSMS.OCPP16.StartTransactionRequest
{
  // In OCPP 1.6 the transactionID is not generated by the charging point but by the CSMS (needs to be set by user in the UI panel)
  $OCPP::Simulation::CSMS.OCPP16.StartTransactionResponse.transactionId = @sysvar::Control::CSMS::ReceivedValues::Sys_TransactionID_16;
}

on value_update OCPP::Simulation::CSMS.OCPP16.StatusNotificationRequest
{
  // trigger sending of message
  $OCPP::Simulation::CSMS.OCPP16.StatusNotificationResponse;
}

on value_update OCPP::Simulation::CSMS.OCPP16.StopTransactionRequest
{
  // trigger sending of message
  $OCPP::Simulation::CSMS.OCPP16.StopTransactionResponse;
}

on value_update OCPP::Simulation::CSMS.OCPP16.LogStatusNotificationRequest
{
  // trigger sending of message
  $OCPP::Simulation::CSMS.OCPP16.LogStatusNotificationResponse;
}

on value_update OCPP::Simulation::CSMS.OCPP16.SecurityEventNotificationRequest
{
  // trigger sending of message
  $OCPP::Simulation::CSMS.OCPP16.SecurityEventNotificationResponse;
}

on value_update OCPP::Simulation::CSMS.OCPP16.SignCertificateRequest
{
  // trigger sending of message
  $OCPP::Simulation::CSMS.OCPP16.SignCertificateResponse;
}

on value_update OCPP::Simulation::CSMS.OCPP16.SignedFirmwareStatusNotificationRequest
{
  // trigger sending of message
  $OCPP::Simulation::CSMS.OCPP16.SignedFirmwareStatusNotificationResponse;
}

/**********************************************************************************************************************
 *  Trigger sending of response as reaction to request OCPP 2.0.1
 *********************************************************************************************************************/

on value_update OCPP::Simulation::CSMS.OCPP201.AuthorizeRequest
{
  if (@sysvar::Common::SysPricingRequirementMode == 0)
  {
    $OCPP::Simulation::CSMS.OCPP201.AuthorizeResponse.idTokenInfo.status = "Accepted";
    $OCPP::Simulation::CSMS.OCPP201.AuthorizeResponse.idTokenInfo.personalMessage.content = "$0.123/kWh, idle fee: $1/h";
  }
  else {
    // trigger sending of message
    $OCPP::Simulation::CSMS.OCPP201.AuthorizeResponse;
  }
}

on value_update OCPP::Simulation::CSMS.OCPP201.BootNotificationRequest
{
 // trigger sending of message
  $OCPP::Simulation::CSMS.OCPP201.BootNotificationResponse.interval = cHeartbeatInterval;
  $OCPP::Simulation::CSMS.OCPP201.BootNotificationResponse;
}

on value_update OCPP::Simulation::CSMS.OCPP201.DataTransferRequest
{
  // trigger sending of message
  $OCPP::Simulation::CSMS.OCPP201.DataTransferResponse;
}

on value_update OCPP::Simulation::CSMS.OCPP201.FirmwareStatusNotificationRequest
{
  // trigger sending of message
  $OCPP::Simulation::CSMS.OCPP201.FirmwareStatusNotificationResponse;
}

on value_update OCPP::Simulation::CSMS.OCPP201.HeartbeatRequest
{
  // trigger sending of message
  $OCPP::Simulation::CSMS.OCPP201.HeartbeatResponse;
}

on value_update OCPP::Simulation::CSMS.OCPP201.MeterValuesRequest
{
  // trigger sending of message
  $OCPP::Simulation::CSMS.OCPP201.MeterValuesResponse;
}

on value_update OCPP::Simulation::CSMS.OCPP201.RequestStartTransactionRequest
{
  // trigger sending of message
  $OCPP::Simulation::CSMS.OCPP201.RequestStartTransactionResponse;
}

on value_update OCPP::Simulation::CSMS.OCPP201.StatusNotificationRequest
{
  // trigger sending of message
  $OCPP::Simulation::CSMS.OCPP201.StatusNotificationResponse;
}

on value_update OCPP::Simulation::CSMS.OCPP201.RequestStopTransactionRequest
{
  // trigger sending of message
  $OCPP::Simulation::CSMS.OCPP201.RequestStopTransactionResponse;
}

on value_update OCPP::Simulation::CSMS.OCPP201.LogStatusNotificationRequest
{
  // trigger sending of message
  $OCPP::Simulation::CSMS.OCPP201.LogStatusNotificationResponse;
}

on value_update OCPP::Simulation::CSMS.OCPP201.SecurityEventNotificationRequest
{
  // trigger sending of message
  $OCPP::Simulation::CSMS.OCPP201.SecurityEventNotificationResponse;
}

on value_update OCPP::Simulation::CSMS.OCPP201.SignCertificateRequest
{
  // trigger sending of message
  $OCPP::Simulation::CSMS.OCPP201.SignCertificateResponse;
}

on value_update OCPP::Simulation::CSMS.OCPP201.TransactionEventRequest
{
  char tempTransactionId[50];
  
  // trigger sending of message
  $OCPP::Simulation::CSMS.OCPP201.TransactionEventResponse;
  
  // save transactionId
  strncpy(tempTransactionId, $CSMS.OCPP201.TransactionEventRequest.transactionInfo.transactionId, 50);
  sysSetVariableString(sysvar::Control::CSMS::ReceivedValues::Sys_TransactionID_201, tempTransactionId);
}

/**********************************************************************************************************************
 *  Trigger sending of response as reaction to request OCPP 2.1
 *********************************************************************************************************************/

on value_update OCPP::Simulation::CSMS.OCPP21.AuthorizeRequest
{
  if (@sysvar::Common::SysPricingRequirementMode == 0)
  {
    $OCPP::Simulation::CSMS.OCPP21.AuthorizeResponse.idTokenInfo.status = "Accepted";
    $OCPP::Simulation::CSMS.OCPP21.AuthorizeResponse.idTokenInfo.personalMessage.content = "$0.123/kWh, idle fee: $1/h";
  }
  else {
    // trigger sending of message
    $OCPP::Simulation::CSMS.OCPP21.AuthorizeResponse;
  }
}

on value_update OCPP::Simulation::CSMS.OCPP21.BootNotificationRequest
{
  // trigger sending of message
  $OCPP::Simulation::CSMS.OCPP21.BootNotificationResponse;
}

on value_update OCPP::Simulation::CSMS.OCPP21.ClearedChargingLimitRequest
{
  // trigger sending of message
  $OCPP::Simulation::CSMS.OCPP21.ClearedChargingLimitResponse;
}

on value_update OCPP::Simulation::CSMS.OCPP21.DataTransferRequest
{
  // trigger sending of message
  $OCPP::Simulation::CSMS.OCPP21.DataTransferResponse;
}

on value_update OCPP::Simulation::CSMS.OCPP21.FirmwareStatusNotificationRequest
{
  // trigger sending of message
  $OCPP::Simulation::CSMS.OCPP21.FirmwareStatusNotificationResponse;
}

on value_update OCPP::Simulation::CSMS.OCPP21.Get15118EVCertificateRequest
{
  // trigger sending of message
  $OCPP::Simulation::CSMS.OCPP21.Get15118EVCertificateResponse;
}

on value_update OCPP::Simulation::CSMS.OCPP21.GetCertificateStatusRequest
{
  // trigger sending of message
  $OCPP::Simulation::CSMS.OCPP21.GetCertificateStatusResponse;
}

on value_update OCPP::Simulation::CSMS.OCPP21.HeartbeatRequest
{
  // trigger sending of message
  $OCPP::Simulation::CSMS.OCPP21.HeartbeatResponse;
}

on value_update OCPP::Simulation::CSMS.OCPP21.LogStatusNotificationRequest
{
  // trigger sending of message
  $OCPP::Simulation::CSMS.OCPP21.LogStatusNotificationResponse;
}

on value_update OCPP::Simulation::CSMS.OCPP21.MeterValuesRequest
{
  // trigger sending of message
  $OCPP::Simulation::CSMS.OCPP21.MeterValuesResponse;
}

on value_update OCPP::Simulation::CSMS.OCPP21.NotifyChargingLimitRequest
{
  // trigger sending of message
  $OCPP::Simulation::CSMS.OCPP21.NotifyChargingLimitResponse;
}

on value_update OCPP::Simulation::CSMS.OCPP21.NotifyCustomerInformationRequest
{
  // trigger sending of message
  $OCPP::Simulation::CSMS.OCPP21.NotifyCustomerInformationResponse;
}

on value_update OCPP::Simulation::CSMS.OCPP21.NotifyDisplayMessagesRequest
{
  // trigger sending of message
  $OCPP::Simulation::CSMS.OCPP21.NotifyDisplayMessagesResponse;
}

on value_update OCPP::Simulation::CSMS.OCPP21.NotifyEVChargingNeedsRequest
{
  // trigger sending of message
  $OCPP::Simulation::CSMS.OCPP21.NotifyEVChargingNeedsResponse;
}

on value_update OCPP::Simulation::CSMS.OCPP21.NotifyEVChargingScheduleRequest
{
  // trigger sending of message
  $OCPP::Simulation::CSMS.OCPP21.NotifyEVChargingScheduleResponse;
}

on value_update OCPP::Simulation::CSMS.OCPP21.NotifyEventRequest
{
  // trigger sending of message
  $OCPP::Simulation::CSMS.OCPP21.NotifyEventResponse;
}

on value_update OCPP::Simulation::CSMS.OCPP21.NotifyMonitoringReportRequest
{
  // trigger sending of message
  $OCPP::Simulation::CSMS.OCPP21.NotifyMonitoringReportResponse;
}

on value_update OCPP::Simulation::CSMS.OCPP21.NotifyReportRequest
{
  // trigger sending of message
  $OCPP::Simulation::CSMS.OCPP21.NotifyReportResponse;
}

on value_update OCPP::Simulation::CSMS.OCPP21.PublishFirmwareStatusNotificationRequest
{
  // trigger sending of message
  $OCPP::Simulation::CSMS.OCPP21.PublishFirmwareStatusNotificationResponse;
}

on value_update OCPP::Simulation::CSMS.OCPP21.ReportChargingProfilesRequest
{
  // trigger sending of message
  $OCPP::Simulation::CSMS.OCPP21.ReportChargingProfilesResponse;
}

on value_update OCPP::Simulation::CSMS.OCPP21.ReservationStatusUpdateRequest
{
  // trigger sending of message
  $OCPP::Simulation::CSMS.OCPP21.ReservationStatusUpdateResponse;
}

on value_update OCPP::Simulation::CSMS.OCPP21.SecurityEventNotificationRequest
{
  // trigger sending of message
  $OCPP::Simulation::CSMS.OCPP21.SecurityEventNotificationResponse;
}

on value_update OCPP::Simulation::CSMS.OCPP21.SignCertificateRequest
{
  // trigger sending of message
  $OCPP::Simulation::CSMS.OCPP21.SignCertificateResponse;
}

on value_update OCPP::Simulation::CSMS.OCPP21.StatusNotificationRequest
{
  // trigger sending of message
  $OCPP::Simulation::CSMS.OCPP21.StatusNotificationResponse;
}

on value_update OCPP::Simulation::CSMS.OCPP21.TransactionEventRequest
{
  char tempTransactionId[50];
  
  // trigger sending of message
  $OCPP::Simulation::CSMS.OCPP21.TransactionEventResponse;
  
  // save transactionId
  strncpy(tempTransactionId, $CSMS.OCPP21.TransactionEventRequest.transactionInfo.transactionId, 50);
  sysSetVariableString(sysvar::Control::CSMS::ReceivedValues::Sys_TransactionID_21, tempTransactionId);
}