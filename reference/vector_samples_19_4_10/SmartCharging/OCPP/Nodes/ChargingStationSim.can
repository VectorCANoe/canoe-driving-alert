/*@!Encoding:1252*/
includes
{
   #include "ChargingStationMessageHandling.cin"
}

variables
{
  char gPanelName[20] = "ChargingStation";
  msTimer tDelayedStart;
  msTimer tDelayedCommunicationStart;
  const cStartAfterEthernetLinkUp = 1000; //[ms]
  const cCommunicationStartAfterConnect = 500; //[ms]
}

on preStop
{
  UpdatePictureChargingStationNotConnected();
}

on preStart
{
  reReadAttributes();
}

on start
{
  setTimer(tDelayedStart, cStartAfterEthernetLinkUp); //start simulation after "cStartAfterEthernetLinkUp" to ensure ethernet link is up  
}

on timer tDelayedStart
{
  OCPP::Simulation::ChargingStation.OpenWebSocketConnection.Call();
}

on timer tDelayedCommunicationStart
{
  // Don't start the CAPL defined state machine if in Pricing Requirements mode
  if (@sysvar::Common::SysPricingRequirementMode == 0)
  {
    UpdatePictureChargingStation();
    
    //trigger sending of BootNotificationRequest as soon as ChargingStation is connected
    if (IsChargingStationConnected() && IsOCPP16Configured())
    {
      // trigger sending of message
      $OCPP::Simulation::ChargingStation.OCPP16.BootNotificationRequest;
    }
    else if (IsChargingStationConnected() && IsOCPP201Configured())
    {
      $OCPP::Simulation::ChargingStation.OCPP201.AuthorizeRequest;
      //$OCPP::Simulation::ChargingStation.OCPP201.BootNotificationRequest;
    }
    else if (IsChargingStationConnected() && IsOCPP21Configured())
    {
      // trigger sending of message
      $OCPP::Simulation::ChargingStation.OCPP21.AuthorizeRequest;
    }
  }
}

on value_change OCPP::Simulation::ChargingStation.CurrentWebsocketConnectionStatus
{
  setTimer(tDelayedCommunicationStart, cCommunicationStartAfterConnect);
}

on sysvar sysvar::Common::SysSelectedProtocol
{
  setChargingStationAttributeOCPPVersion();
}

on sysVar Control::ChargingStation::SysChargingStation_Start
{
  if (@this == 1)
  {
    OCPP::Simulation::ChargingStation.OpenWebSocketConnection.Call();
  }
}

on sysVar Control::ChargingStation::SysChargingStation_Stop
{
  if (@this == 1)
  {
    OCPP::Simulation::ChargingStation.CloseWebSocketConnection.Call();
  }
}

on sysvar Control::ChargingStation::SysChargingStation_ConnectionURL
{
  setConnectionURL(); 
}

on sysvar Control::ChargingStation::SysChargingStation_CSMSAddress
{
  setCSMSAddress(); 
}

on sysvar Control::ChargingStation::SysChargingStation_HTTPBasicAuthenticationEnabled
{
  setHTTPBasicAuthenticationEnabled(); 
}

on sysvar Control::ChargingStation::SysChargingStation_HTTPBasicAuthenticationPassword
{
  setHTTPBasicAuthenticationPassword(); 
}

on sysvar Control::ChargingStation::SysChargingStation_HTTPBasicAuthenticationUsername
{
  setHTTPBasicAuthenticationUsername(); 
}

on sysvar Common::SysTLSEnabled
{
  setTLSEnabled(); 
}

int IsChargingStationConnected()
{
  return $OCPP::Simulation::ChargingStation.CurrentWebsocketConnectionStatus == _OCPP::DataTypes::WebsocketConnectionStatusType::Connected;
}

int IsOCPP16Configured()
{
  long versionAttribute;
  getAttribute(OCPP::Simulation::ChargingStation, OCPPBinding::OCPPVersion, versionAttribute); 
  return versionAttribute == OCPPBinding::OCPP16;
}

int IsOCPP201Configured()
{
  long versionAttribute;
  getAttribute(OCPP::Simulation::ChargingStation, OCPPBinding::OCPPVersion, versionAttribute); 
  return versionAttribute == OCPPBinding::OCPP201;
}

int IsOCPP21Configured()
{
  long versionAttribute;
  getAttribute(OCPP::Simulation::ChargingStation, OCPPBinding::OCPPVersion, versionAttribute); 
  return versionAttribute == OCPPBinding::OCPP21;
}

void UpdatePictureChargingStation()
{
  if (IsChargingStationConnected())
  {
    UpdatePictureChargingStationConnected();
  }
  else
  {
    UpdatePictureChargingStationNotConnected();
  }
}

void UpdatePictureChargingStationConnected()
{
  SetChargingStationPicturesVisibility(1);
}

void UpdatePictureChargingStationNotConnected()
{
  SetChargingStationPicturesVisibility(0);
}

void SetChargingStationPicturesVisibility(int showConnected)
{
 SetControlVisibility(gPanelName, "pictureChargingStationConnected", showConnected);
 SetControlVisibility(gPanelName, "pictureChargingStationDisconnected", !showConnected);
}

void setChargingStationAttributeOCPPVersion()
{
  int retval;
  
  if (@sysvar::Common::SysSelectedProtocol == @sysvar::Common::SysSelectedProtocol::OCPP_16)
  {
    retval = setAttribute(OCPP::Simulation::ChargingStation, OCPPBinding::OCPPVersion, OCPPBinding::OCPP16); 
  }
  else if (@sysvar::Common::SysSelectedProtocol == @sysvar::Common::SysSelectedProtocol::OCPP_201)
  {
    retval = setAttribute(OCPP::Simulation::ChargingStation, OCPPBinding::OCPPVersion, OCPPBinding::OCPP201); 
  }
  else if (@sysvar::Common::SysSelectedProtocol == @sysvar::Common::SysSelectedProtocol::OCPP_21)
  {
    retval = setAttribute(OCPP::Simulation::ChargingStation, OCPPBinding::OCPPVersion, OCPPBinding::OCPP21); 
  }
  else
  {
    writeLineEx(0 , 2,"Charging Station: No matching OCPP Version was found.");
  }
  
  if (retval != 0)
  {
    writeLineEx(0 , 3,"Return value from function setAttribute() = %d (More information in CANoe-Help)", retval);
  }   
}

void reReadAttributes()
{
  setChargingStationAttributeOCPPVersion();
  setCSMSAddress();
  setConnectionURL();
  setHTTPBasicAuthenticationEnabled();
  setHTTPBasicAuthenticationUsername();
  setHTTPBasicAuthenticationPassword();
  setTLSEnabled();
  setPort();
}

void setCSMSAddress()
{
  const long bufferLen = 100;
  char csmsAddress[bufferLen];
  sysGetVariableString(sysvar::Control::ChargingStation::SysChargingStation_CSMSAddress, csmsAddress, bufferLen);
  setAttribute(OCPP::Simulation::ChargingStation, OCPPBinding::ChargingStation::CSMSAddress, csmsAddress);
}

void setConnectionURL()
{
  const long bufferLen = 100;
  char connectionURL[bufferLen];
  sysGetVariableString(sysvar::Control::ChargingStation::SysChargingStation_ConnectionURL, connectionURL, bufferLen);
  setAttribute(OCPP::Simulation::ChargingStation, OCPPBinding::ChargingStation::ConnectionURL, connectionURL);
}

void setHTTPBasicAuthenticationEnabled()
{
  if (@sysVar::Control::ChargingStation::SysChargingStation_HTTPBasicAuthenticationEnabled == @sysVar::Control::ChargingStation::SysChargingStation_HTTPBasicAuthenticationEnabled::Enabled){
    setAttribute(OCPP::Simulation::ChargingStation, OCPPBinding::ChargingStation::HTTPBasicAuthenticationEnabled, OCPPBinding::Enabled); 
  }
  else
  {
    setAttribute(OCPP::Simulation::ChargingStation, OCPPBinding::ChargingStation::HTTPBasicAuthenticationEnabled, OCPPBinding::Disabled); 
  }
}

void setHTTPBasicAuthenticationUsername()
{
  const long bufferLen = 100;
  char username[bufferLen];
  sysGetVariableString(sysvar::Control::ChargingStation::SysChargingStation_HTTPBasicAuthenticationUsername, username, bufferLen);
  setAttribute(OCPP::Simulation::ChargingStation, OCPPBinding::ChargingStation::HTTPBasicAuthenticationUsername, username);
}

void setHTTPBasicAuthenticationPassword()
{
  const long bufferLen = 100;
  char password[bufferLen];
  sysGetVariableString(sysvar::Control::ChargingStation::SysChargingStation_HTTPBasicAuthenticationPassword, password, bufferLen);
  setAttribute(OCPP::Simulation::ChargingStation, OCPPBinding::ChargingStation::HTTPBasicAuthenticationPassword, password);
}

void setTLSEnabled()
{
  if (@sysVar::Common::SysTLSEnabled == @sysVar::Common::SysTLSEnabled::Enabled){
    setAttribute(OCPP::Simulation::ChargingStation, OCPPBinding::TLS, OCPPBinding::Enabled); 
  }
  else
  {
    setAttribute(OCPP::Simulation::ChargingStation, OCPPBinding::TLS, OCPPBinding::Disabled); 
  }
}

void setPort()
{
  int retval;
  
  if (@sysVar::Common::SysTLSEnabled == @sysVar::Common::SysTLSEnabled::Enabled)
  {
    retval = setAttribute(OCPP::Simulation::ChargingStation, OCPPBinding::ServerPort, 443); 
  }
  else
  {
    retval = setAttribute(OCPP::Simulation::ChargingStation, OCPPBinding::ServerPort, 80); 
  }
  
  if (retval != 0)
  {
    writeLineEx(0 , 3,"Return value from function setAttribute() = %d (More information in CANoe-Help)", retval);
  } 
}


on sysvar Control::ChargingStation::OCPP16::SysSendAuthorize
{
  long bufferIdTokenLen = 100;
  char bufferIdTokenString[100];

  if (@this == 1)
  {
    sysGetVariableString(sysvar::Control::ChargingStation::OCPP16::SysIdToken, bufferIdTokenString, bufferIdTokenLen);
    $OCPP::Simulation::ChargingStation.OCPP16.AuthorizeRequest.idTag = bufferIdTokenString;
  }
}

on sysvar Control::ChargingStation::OCPP201::SysSendAuthorize
{
  long bufferIdTokenLen = 100;
  char bufferIdTokenString[100];

  if (@this == 1)
  {
    sysGetVariableString(sysvar::Control::ChargingStation::OCPP201::SysIdToken, bufferIdTokenString, bufferIdTokenLen);
    $OCPP::Simulation::ChargingStation.OCPP201.AuthorizeRequest.idToken.idToken = bufferIdTokenString;
  }
}

on sysvar Control::ChargingStation::OCPP21::SysSendAuthorize
{
  long bufferIdTokenLen = 100;
  char bufferIdTokenString[100];

  if (@this == 1)
  {
    sysGetVariableString(sysvar::Control::ChargingStation::OCPP21::SysIdToken, bufferIdTokenString, bufferIdTokenLen);
    $OCPP::Simulation::ChargingStation.OCPP21.AuthorizeRequest.idToken.idToken = bufferIdTokenString;
  }
}

on sysvar Control::ChargingStation::OCPP16::SysStartTransaction
{
  long bufferIdTokenLen = 100;
  char bufferIdTokenString[100];
  char time[100];

  if (@this == 1)
  {
    // fetch current time
    GetCurrentTimeRFC3339(time);

    $OCPP::Simulation::ChargingStation.OCPP16.StartTransactionRequest.connectorId = 1;
    $OCPP::Simulation::ChargingStation.OCPP16.StartTransactionRequest.idTag = $OCPP::Simulation::ChargingStation.OCPP16.AuthorizeRequest.idTag;
    $OCPP::Simulation::ChargingStation.OCPP16.StartTransactionRequest.meterStart = @sysvar::Control::ChargingStation::OCPP16::SysMeterValue;
    $OCPP::Simulation::ChargingStation.OCPP16.StartTransactionRequest.timestamp = time;
  }
}

on sysvar Control::ChargingStation::OCPP16::SysSendMeterValue
{
  long bufferLen = 500;
  char bufferData[500];
  char time[100];

  if (@this == 1)
  {
    // fetch current time
    GetCurrentTimeRFC3339(time);
    snprintf(bufferData, bufferLen, "%d", @sysvar::Control::ChargingStation::OCPP16::SysMeterValue);
    $OCPP::Simulation::ChargingStation.OCPP16.MeterValuesRequest.meterValue.Length = 1;
    $OCPP::Simulation::ChargingStation.OCPP16.MeterValuesRequest.meterValue[0].sampledValue.Length = 1;

    $OCPP::Simulation::ChargingStation.OCPP16.MeterValuesRequest.meterValue[0].sampledValue[0].value = bufferData;
    $OCPP::Simulation::ChargingStation.OCPP16.MeterValuesRequest.meterValue[0].timestamp = time;
  }
}

on sysvar Control::ChargingStation::OCPP201::SysSendTransactionEvent
{
  // for fetching transactionId
  long transactionIdBufferLen = 50;
  char transactionIdBuffer[50];
  char time[100];

  if (@this == 1)
  {
    sysGetVariableString(sysvar::Control::ChargingStation::OCPP201::SysTransactionId, transactionIdBuffer, transactionIdBufferLen);
    $OCPP::Simulation::ChargingStation.OCPP201.TransactionEventRequest.transactionInfo.transactionId = transactionIdBuffer;
    // fetch current time
    GetCurrentTimeRFC3339(time);

    if (@sysvar::Control::ChargingStation::OCPP201::SysEventTypeTransaction == @sysvar::Control::ChargingStation::OCPP201::SysEventTypeTransaction::Started)
    {
      $OCPP::Simulation::ChargingStation.OCPP201.TransactionEventRequest.eventType = "Started";
    }

    if (@sysvar::Control::ChargingStation::OCPP201::SysEventTypeTransaction == @sysvar::Control::ChargingStation::OCPP201::SysEventTypeTransaction::Updated)
    {
      $OCPP::Simulation::ChargingStation.OCPP201.TransactionEventRequest.eventType = "Updated";

      $OCPP::Simulation::ChargingStation.OCPP201.TransactionEventRequest.meterValue.Length = 1;
      $OCPP::Simulation::ChargingStation.OCPP201.TransactionEventRequest.meterValue[0].sampledValue.Length = 1;
      $OCPP::Simulation::ChargingStation.OCPP201.TransactionEventRequest.meterValue[0].sampledValue[0].value = @Control::ChargingStation::OCPP201::SysMeterValue;
      $OCPP::Simulation::ChargingStation.OCPP201.TransactionEventRequest.meterValue[0].timestamp = time;
    }

    if (@sysvar::Control::ChargingStation::OCPP201::SysEventTypeTransaction == @sysvar::Control::ChargingStation::OCPP201::SysEventTypeTransaction::Finished)
    {
      $OCPP::Simulation::ChargingStation.OCPP201.TransactionEventRequest.eventType = "Finished";
      $OCPP::Simulation::ChargingStation.OCPP201.TransactionEventRequest.meterValue[0].timestamp = time;
    }
    
    $OCPP::Simulation::ChargingStation.OCPP201.TransactionEventRequest.timestamp = time;
  }
}

on sysvar Control::ChargingStation::OCPP21::SysSendTransactionEvent
{
  // for fetching transactionId
  long transactionIdBufferLen = 50;
  char transactionIdBuffer[50];
  char time[100];

  if (@this == 1)
  {
    sysGetVariableString(sysvar::Control::ChargingStation::OCPP21::SysTransactionId, transactionIdBuffer, transactionIdBufferLen);
    $OCPP::Simulation::ChargingStation.OCPP21.TransactionEventRequest.transactionInfo.transactionId = transactionIdBuffer;
    // fetch current time
    GetCurrentTimeRFC3339(time);

    if (@sysvar::Control::ChargingStation::OCPP21::SysEventTypeTransaction == @sysvar::Control::ChargingStation::OCPP21::SysEventTypeTransaction::Started)
    {
      $OCPP::Simulation::ChargingStation.OCPP21.TransactionEventRequest.eventType = "Started";
    }

    if (@sysvar::Control::ChargingStation::OCPP21::SysEventTypeTransaction == @sysvar::Control::ChargingStation::OCPP21::SysEventTypeTransaction::Updated)
    {
      $OCPP::Simulation::ChargingStation.OCPP21.TransactionEventRequest.eventType = "Updated";

      $OCPP::Simulation::ChargingStation.OCPP21.TransactionEventRequest.meterValue.Length = 1;
      $OCPP::Simulation::ChargingStation.OCPP21.TransactionEventRequest.meterValue[0].sampledValue.Length = 1;
      $OCPP::Simulation::ChargingStation.OCPP21.TransactionEventRequest.meterValue[0].sampledValue[0].value = @Control::ChargingStation::OCPP21::SysMeterValue;
      $OCPP::Simulation::ChargingStation.OCPP21.TransactionEventRequest.meterValue[0].timestamp = time;
    }

    if (@sysvar::Control::ChargingStation::OCPP21::SysEventTypeTransaction == @sysvar::Control::ChargingStation::OCPP21::SysEventTypeTransaction::Finished)
    {
      $OCPP::Simulation::ChargingStation.OCPP21.TransactionEventRequest.eventType = "Finished";
      $OCPP::Simulation::ChargingStation.OCPP21.TransactionEventRequest.meterValue[0].timestamp = time;
    }
    
    $OCPP::Simulation::ChargingStation.OCPP21.TransactionEventRequest.timestamp = time;
  }
}