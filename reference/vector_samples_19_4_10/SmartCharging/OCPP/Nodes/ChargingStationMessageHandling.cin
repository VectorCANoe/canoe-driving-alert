/*@!Encoding:1252*/
includes
{
  #include "UtilityFunctions.cin"
}

variables
{

}

/**********************************************************************************************************************
 *  Trigger sending of request as reaction to response (example behavior)
 *********************************************************************************************************************/

on value_update OCPP::Simulation::ChargingStation.OCPP16.AuthorizeResponse
{
  // don't proceed into state CAPL defined state machine if Pricing Requirement Mode active
  if (@sysvar::Common::SysPricingRequirementMode == 0)
  {
    // trigger sending of message
    $OCPP::Simulation::ChargingStation.OCPP16.StartTransactionRequest.connectorId = 1;
  }
}

on value_update OCPP::Simulation::ChargingStation.OCPP16.BootNotificationResponse
{
  // trigger sending of message
  $OCPP::Simulation::ChargingStation.OCPP16.AuthorizeRequest;
}

/**********************************************************************************************************************
 *  Trigger sending of response as reaction to request
 *********************************************************************************************************************/

on value_update OCPP::Simulation::ChargingStation.OCPP16.CancelReservationRequest
{
  // trigger sending of message
  $OCPP::Simulation::ChargingStation.OCPP16.CancelReservationResponse;
}

on value_update OCPP::Simulation::ChargingStation.OCPP16.ChangeAvailabilityRequest
{
  // trigger sending of message
  $OCPP::Simulation::ChargingStation.OCPP16.ChangeAvailabilityResponse;
}

on value_update OCPP::Simulation::ChargingStation.OCPP16.ChangeConfigurationRequest
{
  // trigger sending of message
  $OCPP::Simulation::ChargingStation.OCPP16.ChangeConfigurationResponse;
}

on value_update OCPP::Simulation::ChargingStation.OCPP16.ClearCacheRequest
{
  // trigger sending of message
  $OCPP::Simulation::ChargingStation.OCPP16.ClearCacheResponse;
}

on value_update OCPP::Simulation::ChargingStation.OCPP16.ClearChargingProfileRequest
{
  // trigger sending of message
  $OCPP::Simulation::ChargingStation.OCPP16.ClearChargingProfileResponse;
}

on value_update OCPP::Simulation::ChargingStation.OCPP16.DataTransferReq
{
  // trigger sending of message
  $OCPP::Simulation::ChargingStation.OCPP16.DataTransferRes;
}

on value_update OCPP::Simulation::ChargingStation.OCPP16.GetCompositeScheduleRequest
{
  // trigger sending of message
  $OCPP::Simulation::ChargingStation.OCPP16.GetCompositeScheduleResponse;
}

on value_update OCPP::Simulation::ChargingStation.OCPP16.GetConfigurationRequest
{
  // trigger sending of message
  $OCPP::Simulation::ChargingStation.OCPP16.GetConfigurationResponse;
}

on value_update OCPP::Simulation::ChargingStation.OCPP16.GetDiagnosticsRequest
{
  // trigger sending of message
  $OCPP::Simulation::ChargingStation.OCPP16.GetDiagnosticsResponse;
}

on value_update OCPP::Simulation::ChargingStation.OCPP16.GetLocalListVersionRequest
{
  // trigger sending of message
  $OCPP::Simulation::ChargingStation.OCPP16.GetLocalListVersionResponse;
}

on value_update OCPP::Simulation::ChargingStation.OCPP16.RemoteStartTransactionRequest
{
  // trigger sending of message
  $OCPP::Simulation::ChargingStation.OCPP16.RemoteStartTransactionResponse;
}

on value_update OCPP::Simulation::ChargingStation.OCPP16.RemoteStopTransactionRequest
{
  // trigger sending of message
  $OCPP::Simulation::ChargingStation.OCPP16.RemoteStopTransactionResponse;
}

on value_update OCPP::Simulation::ChargingStation.OCPP16.ReserveNowRequest
{
  // trigger sending of message
  $OCPP::Simulation::ChargingStation.OCPP16.ReserveNowResponse;
}

on value_update OCPP::Simulation::ChargingStation.OCPP16.ResetRequest
{
  // trigger sending of message
  $OCPP::Simulation::ChargingStation.OCPP16.ResetResponse;
}

on value_update OCPP::Simulation::ChargingStation.OCPP16.SendLocalListRequest
{
  // trigger sending of message
  $OCPP::Simulation::ChargingStation.OCPP16.SendLocalListResponse;
}

on value_update OCPP::Simulation::ChargingStation.OCPP16.SetChargingProfileRequest
{
  // trigger sending of message
  $OCPP::Simulation::ChargingStation.OCPP16.SetChargingProfileResponse;
}

on value_update OCPP::Simulation::ChargingStation.OCPP16.TriggerMessageRequest
{
  // trigger sending of message
  $OCPP::Simulation::ChargingStation.OCPP16.TriggerMessageResponse;
}

on value_update OCPP::Simulation::ChargingStation.OCPP16.UnlockConnectorRequest
{
  // trigger sending of message
  $OCPP::Simulation::ChargingStation.OCPP16.UnlockConnectorResponse;
}

on value_update OCPP::Simulation::ChargingStation.OCPP16.UpdateFirmwareRequest
{
  // trigger sending of message
  $OCPP::Simulation::ChargingStation.OCPP16.UpdateFirmwareResponse;
}

on value_update OCPP::Simulation::ChargingStation.OCPP16.CertificateSignedRequest
{
  // trigger sending of message
  $OCPP::Simulation::ChargingStation.OCPP16.CertificateSignedResponse;
}

on value_update OCPP::Simulation::ChargingStation.OCPP16.DeleteCertificateRequest
{
  // trigger sending of message
  $OCPP::Simulation::ChargingStation.OCPP16.DeleteCertificateResponse;
}

on value_update OCPP::Simulation::ChargingStation.OCPP16.ExtendedTriggerMessageRequest
{
  // trigger sending of message
  $OCPP::Simulation::ChargingStation.OCPP16.ExtendedTriggerMessageResponse;
}

on value_update OCPP::Simulation::ChargingStation.OCPP16.GetInstalledCertificateIdsRequest
{
  // trigger sending of message
  $OCPP::Simulation::ChargingStation.OCPP16.GetInstalledCertificateIdsResponse;
}

on value_update OCPP::Simulation::ChargingStation.OCPP16.GetLogRequest
{
  // trigger sending of message
  $OCPP::Simulation::ChargingStation.OCPP16.GetLogResponse;
}

on value_update OCPP::Simulation::ChargingStation.OCPP16.InstallCertificateRequest
{
  // trigger sending of message
  $OCPP::Simulation::ChargingStation.OCPP16.InstallCertificateResponse;
}

on value_update OCPP::Simulation::ChargingStation.OCPP16.SignedUpdateFirmwareRequest
{
  // trigger sending of message
  $OCPP::Simulation::ChargingStation.OCPP16.SignedUpdateFirmwareResponse;
}

/**********************************************************************************************************************
 *  Trigger sending of response as reaction to request OCPP 2.0.1
 *********************************************************************************************************************/

on value_update OCPP::Simulation::ChargingStation.OCPP201.AuthorizeResponse
{
  // trigger sending of message
  $OCPP::Simulation::ChargingStation.OCPP201.BootNotificationRequest;
}

on value_update OCPP::Simulation::ChargingStation.OCPP201.BootNotificationResponse
{
  // trigger sending of message
  $OCPP::Simulation::ChargingStation.OCPP201.ClearedChargingLimitRequest;
}

on value_update OCPP::Simulation::ChargingStation.OCPP201.ClearedChargingLimitResponse
{
  // trigger sending of message
  $OCPP::Simulation::ChargingStation.OCPP201.DataTransferRequest;
}

on value_update OCPP::Simulation::ChargingStation.OCPP201.DataTransferResponse
{
  // trigger sending of message
  $OCPP::Simulation::ChargingStation.OCPP201.FirmwareStatusNotificationRequest;
}

on value_update OCPP::Simulation::ChargingStation.OCPP201.FirmwareStatusNotificationResponse
{
  // trigger sending of message
  $OCPP::Simulation::ChargingStation.OCPP201.Get15118EVCertificateRequest;
}

on value_update OCPP::Simulation::ChargingStation.OCPP201.Get15118EVCertificateResponse
{
  // trigger sending of message
  $OCPP::Simulation::ChargingStation.OCPP201.GetCertificateStatusRequest;
}

on value_update OCPP::Simulation::ChargingStation.OCPP201.GetCertificateStatusResponse
{
  // trigger sending of message
  $OCPP::Simulation::ChargingStation.OCPP201.HeartbeatRequest;
}

on value_update OCPP::Simulation::ChargingStation.OCPP201.HeartbeatRequest
{
  // trigger sending of message
  $OCPP::Simulation::ChargingStation.OCPP201.HeartbeatResponse;
}

on value_update OCPP::Simulation::ChargingStation.OCPP201.HeartbeatResponse
{
  // trigger sending of message
  $OCPP::Simulation::ChargingStation.OCPP201.LogStatusNotificationRequest;
}

on value_update OCPP::Simulation::ChargingStation.OCPP201.LogStatusNotificationResponse
{
  // trigger sending of message
  $OCPP::Simulation::ChargingStation.OCPP201.MeterValuesRequest;
}

on value_update OCPP::Simulation::ChargingStation.OCPP201.MeterValuesResponse
{
  // trigger sending of message
  $OCPP::Simulation::ChargingStation.OCPP201.NotifyChargingLimitRequest;
}

on value_update OCPP::Simulation::ChargingStation.OCPP201.NotifyChargingLimitResponse
{
  // trigger sending of message
  $OCPP::Simulation::ChargingStation.OCPP201.NotifyCustomerInformationRequest;
}

on value_update OCPP::Simulation::ChargingStation.OCPP201.NotifyCustomerInformationResponse
{
  // trigger sending of message
  $OCPP::Simulation::ChargingStation.OCPP201.NotifyDisplayMessagesRequest;
}

on value_update OCPP::Simulation::ChargingStation.OCPP201.NotifyDisplayMessagesResponse
{
  // trigger sending of message
  $OCPP::Simulation::ChargingStation.OCPP201.NotifyEVChargingNeedsRequest;
}

on value_update OCPP::Simulation::ChargingStation.OCPP201.NotifyEVChargingNeedsResponse
{
  // trigger sending of message
  $OCPP::Simulation::ChargingStation.OCPP201.NotifyEVChargingScheduleRequest;
}

on value_update OCPP::Simulation::ChargingStation.OCPP201.NotifyEVChargingScheduleResponse
{
  // trigger sending of message
  $OCPP::Simulation::ChargingStation.OCPP201.NotifyEventRequest;
}

on value_update OCPP::Simulation::ChargingStation.OCPP201.NotifyEventResponse
{
  // trigger sending of message
  $OCPP::Simulation::ChargingStation.OCPP201.NotifyMonitoringReportRequest;
}

on value_update OCPP::Simulation::ChargingStation.OCPP201.NotifyMonitoringReportResponse
{
  // trigger sending of message
  $OCPP::Simulation::ChargingStation.OCPP201.NotifyReportRequest;
}

on value_update OCPP::Simulation::ChargingStation.OCPP201.NotifyReportResponse
{
  // trigger sending of message
  $OCPP::Simulation::ChargingStation.OCPP201.PublishFirmwareStatusNotificationRequest;
}

on value_update OCPP::Simulation::ChargingStation.OCPP201.PublishFirmwareStatusNotificationResponse
{
  // trigger sending of message
  $OCPP::Simulation::ChargingStation.OCPP201.ReportChargingProfilesRequest;
}

on value_update OCPP::Simulation::ChargingStation.OCPP201.ReportChargingProfilesResponse
{
  // trigger sending of message
  $OCPP::Simulation::ChargingStation.OCPP201.ReservationStatusUpdateRequest;
}

on value_update OCPP::Simulation::ChargingStation.OCPP201.ReservationStatusUpdateResponse
{
  // trigger sending of message
  $OCPP::Simulation::ChargingStation.OCPP201.SecurityEventNotificationRequest;
}

on value_update OCPP::Simulation::ChargingStation.OCPP201.SecurityEventNotificationResponse
{
  // trigger sending of message
  $OCPP::Simulation::ChargingStation.OCPP201.SignCertificateRequest;
}

on value_update OCPP::Simulation::ChargingStation.OCPP201.SignCertificateResponse
{
  // trigger sending of message
  $OCPP::Simulation::ChargingStation.OCPP201.StatusNotificationRequest;
}

on value_update OCPP::Simulation::ChargingStation.OCPP201.StatusNotificationResponse
{
  // trigger sending of message
  $OCPP::Simulation::ChargingStation.OCPP201.TransactionEventRequest.transactionInfo.transactionId = "1";
}

on value_update OCPP::Simulation::ChargingStation.OCPP201.TransactionEventResponse
{
  // trigger sending of message
  $OCPP::Simulation::ChargingStation.OCPP201.CertificateSignedRequest;
}

on value_update OCPP::Simulation::ChargingStation.OCPP201.BootNotificationRequest
{
  // trigger sending of message
  $OCPP::Simulation::ChargingStation.OCPP201.BootNotificationResponse;
}

on value_update OCPP::Simulation::ChargingStation.OCPP201.ClearedChargingLimitRequest
{
  // trigger sending of message
  $OCPP::Simulation::ChargingStation.OCPP201.ClearedChargingLimitResponse;
}

on value_update OCPP::Simulation::ChargingStation.OCPP201.DataTransferRequest
{
  // trigger sending of message
  $OCPP::Simulation::ChargingStation.OCPP201.DataTransferResponse;
}

on value_update OCPP::Simulation::ChargingStation.OCPP201.FirmwareStatusNotificationRequest
{
  // trigger sending of message
  $OCPP::Simulation::ChargingStation.OCPP201.FirmwareStatusNotificationResponse;
}

on value_update OCPP::Simulation::ChargingStation.OCPP201.Get15118EVCertificateRequest
{
  // trigger sending of message
  $OCPP::Simulation::ChargingStation.OCPP201.Get15118EVCertificateResponse;
}

on value_update OCPP::Simulation::ChargingStation.OCPP201.GetCertificateStatusRequest
{
  // trigger sending of message
  $OCPP::Simulation::ChargingStation.OCPP201.GetCertificateStatusResponse;
}

on value_update OCPP::Simulation::ChargingStation.OCPP201.LogStatusNotificationRequest
{
  // trigger sending of message
  $OCPP::Simulation::ChargingStation.OCPP201.LogStatusNotificationResponse;
}

on value_update OCPP::Simulation::ChargingStation.OCPP201.MeterValuesRequest
{
  // trigger sending of message
  $OCPP::Simulation::ChargingStation.OCPP201.MeterValuesResponse;
}

on value_update OCPP::Simulation::ChargingStation.OCPP201.NotifyChargingLimitRequest
{
  // trigger sending of message
  $OCPP::Simulation::ChargingStation.OCPP201.NotifyChargingLimitResponse;
}

on value_update OCPP::Simulation::ChargingStation.OCPP201.NotifyCustomerInformationRequest
{
  // trigger sending of message
  $OCPP::Simulation::ChargingStation.OCPP201.NotifyCustomerInformationResponse;
}

on value_update OCPP::Simulation::ChargingStation.OCPP201.NotifyDisplayMessagesRequest
{
  // trigger sending of message
  $OCPP::Simulation::ChargingStation.OCPP201.NotifyDisplayMessagesResponse;
}

on value_update OCPP::Simulation::ChargingStation.OCPP201.NotifyEVChargingNeedsRequest
{
  // trigger sending of message
  $OCPP::Simulation::ChargingStation.OCPP201.NotifyEVChargingNeedsResponse;
}

on value_update OCPP::Simulation::ChargingStation.OCPP201.NotifyEVChargingScheduleRequest
{
  // trigger sending of message
  $OCPP::Simulation::ChargingStation.OCPP201.NotifyEVChargingScheduleResponse;
}

on value_update OCPP::Simulation::ChargingStation.OCPP201.NotifyEventRequest
{
  // trigger sending of message
  $OCPP::Simulation::ChargingStation.OCPP201.NotifyEventResponse;
}

on value_update OCPP::Simulation::ChargingStation.OCPP201.NotifyMonitoringReportRequest
{
  // trigger sending of message
  $OCPP::Simulation::ChargingStation.OCPP201.NotifyMonitoringReportResponse;
}

on value_update OCPP::Simulation::ChargingStation.OCPP201.NotifyReportRequest
{
  // trigger sending of message
  $OCPP::Simulation::ChargingStation.OCPP201.NotifyReportResponse;
}

on value_update OCPP::Simulation::ChargingStation.OCPP201.PublishFirmwareStatusNotificationRequest
{
  // trigger sending of message
  $OCPP::Simulation::ChargingStation.OCPP201.PublishFirmwareStatusNotificationResponse;
}

on value_update OCPP::Simulation::ChargingStation.OCPP201.ReportChargingProfilesRequest
{
  // trigger sending of message
  $OCPP::Simulation::ChargingStation.OCPP201.ReportChargingProfilesResponse;
}

on value_update OCPP::Simulation::ChargingStation.OCPP201.ReservationStatusUpdateRequest
{
  // trigger sending of message
  $OCPP::Simulation::ChargingStation.OCPP201.ReservationStatusUpdateResponse;
}

on value_update OCPP::Simulation::ChargingStation.OCPP201.SecurityEventNotificationRequest
{
  // trigger sending of message
  $OCPP::Simulation::ChargingStation.OCPP201.SecurityEventNotificationResponse;
}

on value_update OCPP::Simulation::ChargingStation.OCPP201.SignCertificateRequest
{
  // trigger sending of message
  $OCPP::Simulation::ChargingStation.OCPP201.SignCertificateResponse;
}

on value_update OCPP::Simulation::ChargingStation.OCPP201.StatusNotificationRequest
{
  // trigger sending of message
  $OCPP::Simulation::ChargingStation.OCPP201.StatusNotificationResponse;
}

on value_update OCPP::Simulation::ChargingStation.OCPP201.TransactionEventRequest
{
  // trigger sending of message
  $OCPP::Simulation::ChargingStation.OCPP201.TransactionEventResponse;
}

on value_update OCPP::Simulation::ChargingStation.OCPP201.CertificateSignedRequest
{
  // trigger sending of message
  $OCPP::Simulation::ChargingStation.OCPP201.TriggerMessageRequest;
}

/**********************************************************************************************************************
 *  Trigger sending of response as reaction to request OCPP 2.1
 *********************************************************************************************************************/

on value_update OCPP::Simulation::ChargingStation.OCPP21.AuthorizeResponse
{
  // trigger sending of message
  $OCPP::Simulation::ChargingStation.OCPP21.BootNotificationRequest;
}

on value_update OCPP::Simulation::ChargingStation.OCPP21.BootNotificationResponse
{
  // trigger sending of message
  $OCPP::Simulation::ChargingStation.OCPP21.ClearedChargingLimitRequest;
}

on value_update OCPP::Simulation::ChargingStation.OCPP21.ClearedChargingLimitResponse
{
  // trigger sending of message
  $OCPP::Simulation::ChargingStation.OCPP21.DataTransferRequest;
}

on value_update OCPP::Simulation::ChargingStation.OCPP21.DataTransferResponse
{
  // trigger sending of message
  $OCPP::Simulation::ChargingStation.OCPP21.FirmwareStatusNotificationRequest;
}

on value_update OCPP::Simulation::ChargingStation.OCPP21.FirmwareStatusNotificationResponse
{
  // trigger sending of message
  $OCPP::Simulation::ChargingStation.OCPP21.Get15118EVCertificateRequest;
}

on value_update OCPP::Simulation::ChargingStation.OCPP21.Get15118EVCertificateResponse
{
  // trigger sending of message
  $OCPP::Simulation::ChargingStation.OCPP21.GetCertificateStatusRequest;
}

on value_update OCPP::Simulation::ChargingStation.OCPP21.GetCertificateStatusResponse
{
  // trigger sending of message
  $OCPP::Simulation::ChargingStation.OCPP21.HeartbeatRequest;
}

on value_update OCPP::Simulation::ChargingStation.OCPP21.HeartbeatRequest
{
  // trigger sending of message
  $OCPP::Simulation::ChargingStation.OCPP21.HeartbeatResponse;
}

on value_update OCPP::Simulation::ChargingStation.OCPP21.HeartbeatResponse
{
  // trigger sending of message
  $OCPP::Simulation::ChargingStation.OCPP21.LogStatusNotificationRequest;
}

on value_update OCPP::Simulation::ChargingStation.OCPP21.LogStatusNotificationResponse
{
  // trigger sending of message
  $OCPP::Simulation::ChargingStation.OCPP21.MeterValuesRequest;
}

on value_update OCPP::Simulation::ChargingStation.OCPP21.MeterValuesResponse
{
  // trigger sending of message
  $OCPP::Simulation::ChargingStation.OCPP21.NotifyChargingLimitRequest;
}

on value_update OCPP::Simulation::ChargingStation.OCPP21.NotifyChargingLimitResponse
{
  // trigger sending of message
  $OCPP::Simulation::ChargingStation.OCPP21.NotifyCustomerInformationRequest;
}

on value_update OCPP::Simulation::ChargingStation.OCPP21.NotifyCustomerInformationResponse
{
  // trigger sending of message
  $OCPP::Simulation::ChargingStation.OCPP21.NotifyDisplayMessagesRequest;
}

on value_update OCPP::Simulation::ChargingStation.OCPP21.NotifyDisplayMessagesResponse
{
  // trigger sending of message
  $OCPP::Simulation::ChargingStation.OCPP21.NotifyEVChargingNeedsRequest;
}

on value_update OCPP::Simulation::ChargingStation.OCPP21.NotifyEVChargingNeedsResponse
{
  // trigger sending of message
  $OCPP::Simulation::ChargingStation.OCPP21.NotifyEVChargingScheduleRequest;
}

on value_update OCPP::Simulation::ChargingStation.OCPP21.NotifyEVChargingScheduleResponse
{
  // trigger sending of message
  $OCPP::Simulation::ChargingStation.OCPP21.NotifyEventRequest;
}

on value_update OCPP::Simulation::ChargingStation.OCPP21.NotifyEventResponse
{
  // trigger sending of message
  $OCPP::Simulation::ChargingStation.OCPP21.NotifyMonitoringReportRequest;
}

on value_update OCPP::Simulation::ChargingStation.OCPP21.NotifyMonitoringReportResponse
{
  // trigger sending of message
  $OCPP::Simulation::ChargingStation.OCPP21.NotifyReportRequest;
}

on value_update OCPP::Simulation::ChargingStation.OCPP21.NotifyReportResponse
{
  // trigger sending of message
  $OCPP::Simulation::ChargingStation.OCPP21.PublishFirmwareStatusNotificationRequest;
}

on value_update OCPP::Simulation::ChargingStation.OCPP21.PublishFirmwareStatusNotificationResponse
{
  // trigger sending of message
  $OCPP::Simulation::ChargingStation.OCPP21.ReportChargingProfilesRequest;
}

on value_update OCPP::Simulation::ChargingStation.OCPP21.ReportChargingProfilesResponse
{
  // trigger sending of message
  $OCPP::Simulation::ChargingStation.OCPP21.ReservationStatusUpdateRequest;
}

on value_update OCPP::Simulation::ChargingStation.OCPP21.ReservationStatusUpdateResponse
{
  // trigger sending of message
  $OCPP::Simulation::ChargingStation.OCPP21.SecurityEventNotificationRequest;
}

on value_update OCPP::Simulation::ChargingStation.OCPP21.SecurityEventNotificationResponse
{
  // trigger sending of message
  $OCPP::Simulation::ChargingStation.OCPP21.SignCertificateRequest;
}

on value_update OCPP::Simulation::ChargingStation.OCPP21.SignCertificateResponse
{
  // trigger sending of message
  $OCPP::Simulation::ChargingStation.OCPP21.StatusNotificationRequest;
}

on value_update OCPP::Simulation::ChargingStation.OCPP21.StatusNotificationResponse
{
  // trigger sending of message
  $OCPP::Simulation::ChargingStation.OCPP21.TransactionEventRequest.transactionInfo.transactionId = "2";
}

on value_update OCPP::Simulation::ChargingStation.OCPP21.TransactionEventResponse
{
  // trigger sending of message
  $OCPP::Simulation::ChargingStation.OCPP21.CertificateSignedRequest;
}

on value_update OCPP::Simulation::ChargingStation.OCPP21.CertificateSignedRequest
{
  // trigger sending of message
  $OCPP::Simulation::ChargingStation.OCPP21.TriggerMessageRequest;
}

on value_update OCPP::Simulation::ChargingStation.OCPP21.TriggerMessageRequest
{
  $OCPP::Simulation::ChargingStation.OCPP21.StatusNotificationRequest.evseId = 1;
}