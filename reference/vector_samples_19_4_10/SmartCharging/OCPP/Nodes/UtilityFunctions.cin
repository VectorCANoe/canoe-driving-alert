/*@!Encoding:1252*/
variables
{
  // set the timezone
  const int cTimezone = 1;
}

// Helper function
void GetCurrentTimeRFC3339(char buffer[])
{

  long tm[9];
  long seconds;
  long minutes;
  long hours;
  long day;
  long month;
  long year;
  long summerTime;
  
  getLocalTime(tm);
  seconds = tm[0];
  minutes = tm[1];
  hours = tm[2];
  day = tm[3];
  month = tm[4] + 1; // month value in array is zero-based
  year = 1900 + tm[5]; // year value in array is calculated starting from zear 1900
  summerTime = tm[8];

  snprintf(buffer, elCount(buffer), "%4d-%02d-%02dT%02d:%02d:%02d+%02d:00", year, month, day, hours, minutes, seconds, cTimezone + summerTime);
}