/*@!Encoding:1252*/
includes
{
  #include "MME_Functions.cin"
}

variables
{
  mstimer tPWMpolling;
  
  char cControlName[20] = "VH5110 Control";
 
  double c_CP_State_A_low = 11.0;
  double c_CP_State_A_high = 13.0;
  double c_CP_State_B_low = 8.0;
  double c_CP_State_B_high = 10.0;
  double c_CP_State_C_low = 5.0;
  double c_CP_State_C_high = 7.0;
  double c_CP_State_D_low = 2.0;
  double c_CP_State_D_high = 4.0;
  double c_CP_State_E_low = -1.0;
  double c_CP_State_E_high = 1.0;
  double c_CP_State_F_low = -13.0;
  double c_CP_State_F_high = -11.0;

}

on start
{
  @Control::sysvarCyclicPolling = 0;
  //SetPwmControlState(1); // poll state
  MME_GetPwmConf();
}


on timer tPWMpolling
{  
  MME_GetPwmStats();
}

/// <TX>
on sysvar Control::MME::SendPwmStatsReq
{
  if(@this == 1)
  {
    MME_GetPwmStats();
    @this = 0;
  }
}

/// <TX>
on sysvar Control::MME::SendGetPwmConfReq
{
  if(@this == 1)
  {
    MME_GetPwmConf(); 
    @this = 0;
  }
}

/// <TX>
on sysvar Control::MME::SendGetVersionReq
{
  if(@this == 1)
  {
    MME_GetVersion();
    @this = 0;
  }
}

on sysvar Control::MME::SendResetReq
{
  if(@this == 1)
  {
    MME_Reset();
    @this = 0;
  }
}


on any_monitored_value_update _CCS::DataTypes::IMonitoredCommon.MME.VS_Get_PWM_Stats_Cnf
{
  writeLineEx(1, 1, "vs get pwm stats cnf test");
  @VH5110_Demo::PWM_Frequency_scaled = $this.value.PWMFrequency.phys; // [Hz]
  @VH5110_Demo::PWM_DutyCycle_scaled = $this.value.PWMDutyCycle.phys; // [%]
  @VH5110_Demo::PWM_Voltage_scaled = $this.value.PWMVoltage.phys / 1000.0;  // [V] from mV
}

on any_monitored_value_update _CCS::DataTypes::IMonitoredCommon.MME.VS_Get_PWM_Stats_Ind
{
  writeLineEx(1, 1, "vs get pwm stats ind test");
  @VH5110_Demo::PWM_Frequency_scaled = $this.value.PWMFrequency.phys; // [Hz]
  @VH5110_Demo::PWM_DutyCycle_scaled = $this.value.PWMDutyCycle.phys; // [%]
  @VH5110_Demo::PWM_Voltage_scaled = $this.value.PWMVoltage.phys / 1000.0;  // [V] from mV
}

on sysvar_update VH5110_Demo::PWM_DutyCycle_scaled
{
  stack double dutyCycle = @this;
  
  if( dutyCycle >= 3.0  && dutyCycle <= 7.0 )
  {
    // defined by HLC
    @VH5110_Demo::PWM_MaximumCurrent = -1;
  }
  else if( dutyCycle >= 8.0 && dutyCycle < 10.0)
  {
    @VH5110_Demo::PWM_MaximumCurrent = 6;
  }
  else if( dutyCycle >= 10.0 && dutyCycle <= 85.0)
  {
    @VH5110_Demo::PWM_MaximumCurrent = dutyCycle*0.6;
  }
  else if( dutyCycle > 85.0 && dutyCycle <= 96.0)
  {
    @VH5110_Demo::PWM_MaximumCurrent = (dutyCycle-64)*2.5;
  }
  else if( dutyCycle > 96.0 && dutyCycle <= 97.0)
  {
    @VH5110_Demo::PWM_MaximumCurrent = 80;
  }
  else
  {
    @VH5110_Demo::PWM_MaximumCurrent = 0;
  }
}

on sysvar VH5110_Demo::PWM_Voltage_scaled
{
  stack double currentVoltageHigh = @this;
  
  if ((currentVoltageHigh >= c_CP_State_A_low) && (currentVoltageHigh <= c_CP_State_A_high))
  {
    @sysvar::VH5110_Demo::CP_State = CP_State_A;     
  }
  else if ((currentVoltageHigh >= c_CP_State_B_low) && (currentVoltageHigh <= c_CP_State_B_high))
  {
    @sysvar::VH5110_Demo::CP_State = CP_State_B;
  }
  else if ((currentVoltageHigh >= c_CP_State_C_low) && (currentVoltageHigh <= c_CP_State_C_high))
  {
    @sysvar::VH5110_Demo::CP_State = CP_State_C;
  }
  else if ((currentVoltageHigh >= c_CP_State_D_low) && (currentVoltageHigh <= c_CP_State_D_high))
  {
    @sysvar::VH5110_Demo::CP_State = CP_State_D;
  }
  else if ((currentVoltageHigh >= c_CP_State_E_low) && (currentVoltageHigh <= c_CP_State_E_high)) 
  {
    @sysvar::VH5110_Demo::CP_State = CP_State_E;
  } 
  else if ( (currentVoltageHigh >= c_CP_State_F_low) && (currentVoltageHigh <= c_CP_State_F_high) ) 
  {
    @sysvar::VH5110_Demo::CP_State = CP_State_F;
  }
  else
    @sysvar::VH5110_Demo::CP_State = CP_State_NotSet;
}

on sysvar Control::sysvarCyclicPolling
{
  if( @this == 1 )
  {
    if( @Control::sysvarCyclicPollPeriod>0 )
    {
      setControlVisibility(cControlName,"Button Get Status",0);
      setTimerCyclic(tPWMpolling, @Control::sysvarCyclicPollPeriod);
    }
    else @this=0;
  }
  else
  {
    cancelTimer(tPWMpolling);
    setControlVisibility(cControlName,"Button Get Status",1);
  }
}

on sysvar Control::sysvarMeasurementMethod
{
  // stop cyclic polling timer
  if( @Control::sysvarCyclicPolling != 0) 
  { 
    @Control::sysvarCyclicPolling = 0;
  }

  SetPwmControlState(@this);
  MME_SetMeasurementMethod(@this);
}

void SetPwmControlState(int state)
{
  if( state < 0 ) return;
  setControlVisibility(cControlName,"Picture Shade",1-state);
  setControlVisibility(cControlName,"Switch Cyclic",state);
  enableControl(cControlName,"Button Write PWM Conf", 1-state);
  enableControl(cControlName,"IO PWM Period", 1-state);
  enableControl(cControlName,"IO Freq change", 1-state);
  enableControl(cControlName,"IO Duty change", 1-state);
  enableControl(cControlName,"IO Voltage change", 1-state);
}