/*@!Encoding:1252*/
includes
{
}

// SLAC Parameter Request
on any_monitored_value_change _CCS::DataTypes::IMonitoredChargePoint.SLAC.CM_SLAC_PARM_REQ
{
    UpdateProgressBar(CmSLACParamReq);
}

// Start Attenuation Characterization Indication
on any_monitored_value_change _CCS::DataTypes::IMonitoredChargePoint.SLAC.CM_START_ATTEN_CHAR_IND
{
    UpdateProgressBar(CmStartAttenCharInd);
}

// Attenuation Characterization Indication
on any_monitored_value_change _CCS::DataTypes::IMonitoredVehicle.SLAC.CM_ATTEN_CHAR_IND
{
    UpdateProgressBar(CmAttenCharInd);
}

// Validate Request
on any_monitored_value_change _CCS::DataTypes::IMonitoredChargePoint.SLAC.CM_VALIDATE_REQ
{
    UpdateProgressBar(CmValidateReq);
}

// SLAC Match Request
on any_monitored_value_change _CCS::DataTypes::IMonitoredChargePoint.SLAC.CM_SLAC_MATCH_REQ
{
    UpdateProgressBar(CmSLACMatchReq);
}
