/*@!Encoding:ASCII*/
includes
{
  
}

variables
{
  
}

on ethernetPacket * {
  const long slacType = 0x88e1;
  stack int filterOut = 0;
  
  if(this.type == slacType)
  {
    if (this.length >=3)
    {
      // check if the ethernet packet contains a VS_Sniffer_Indication based on the MME Type that is coded into the second and third byte
      if (this.byte(1) == 0x2E &&  this.byte(2) == 0xA0)
      {
        filterOut = 1;
      }
    }
  }
  
  if (!filterOut)
  {
    output(this);
  }
}