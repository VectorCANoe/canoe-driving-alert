/*@!Encoding:1252*/
includes
{
  #include "Monitor.cin"
  #include "Monitor_SLAC.cin"
  #include "Monitor_DIN.cin"
  #include "Monitor_ISO2.cin"
  #include "Monitor_ISO20.cin"
}

variables
{
  dword elapsedTime = 0;
}

on start 
{
  InitProgressBars();
  ResetVariables();
}

on sysvar Common::SysProtocolBar
{
  if( @this == 1 ) ResetVariables();
}

void ResetVariables()
{
  elapsedTime = 0;
  @sysvar::VH5110_Demo::EnergyTransfered = 0;
}

on any_monitored_value_update _CCS::DataTypes::IMonitoredVehicle.ISO20.DC_ChargeLoop_Response
{
  float presentCurrent;
  float presentVoltage;
  
  presentCurrent = $this.Value.EVSEPresentCurrent.Value*_pow(10,$this.Value.EVSEPresentCurrent.Exponent);
  presentVoltage = $this.Value.EVSEPresentVoltage.Value*_pow(10, $this.Value.EVSEPresentVoltage.Exponent);
  
  MeasureTransferedEnergy(presentVoltage,presentCurrent);
}

on any_monitored_value_update _CCS::DataTypes::IMonitoredVehicle.ISO2.CurrentDemand_Response
{
  float presentCurrent;
  float presentVoltage;

  presentCurrent = $this.Value.EVSEPresentCurrent.Value*_pow(10,$this.Value.EVSEPresentCurrent.Multiplier);
  presentVoltage = $this.Value.EVSEPresentVoltage.Value*_pow(10, $this.Value.EVSEPresentVoltage.Multiplier);
  
  MeasureTransferedEnergy(presentVoltage,presentCurrent);
}

on any_monitored_value_update _CCS::DataTypes::IMonitoredVehicle.DIN.CurrentDemand_Response
{
  float presentCurrent;
  float presentVoltage;
  
  presentCurrent = $this.Value.EVSEPresentCurrent.Value*_pow(10,$this.Value.EVSEPresentCurrent.Multiplier);
  presentVoltage = $this.Value.EVSEPresentVoltage.Value*_pow(10,$this.Value.EVSEPresentVoltage.Multiplier);
  
  MeasureTransferedEnergy(presentVoltage,presentCurrent);
}


void MeasureTransferedEnergy( float presentVoltage, float presentCurrent )
{
  if(elapsedTime > 0)
  {
    @sysvar::VH5110_Demo::EnergyTransfered += (presentCurrent * presentVoltage * ((timeNow() - elapsedTime)/360000000.0));
  }
  elapsedTime = timeNow();
}

/**********************************************************************************************************************
//  SECC + SAP
 *********************************************************************************************************************/

// SECC Discovery
on any_monitored_value_change _CCS::DataTypes::IMonitoredChargePoint.SDP.SECC_Discovery_Request
{
  UpdateProgressBar(SECCDiscoveryReq);
}

on any_monitored_value_change _CCS::DataTypes::IMonitoredVehicle.SDP.SECC_Discovery_Response
{
  if ($this.value.SecurityType == _CCS::DataTypes::parSecurityTypeSDP::NoTLS)
  {
    SetControlVisibility(gProtocolPanelName, "TResultTLS",  0);
    SetControlVisibility(gProtocolPanelName, "TResultNoTLS",  1);
  }

  if ($this.value.SecurityType == _CCS::DataTypes::parSecurityTypeSDP::TLS)
  {
    SetControlVisibility(gProtocolPanelName, "TResultNoTLS",  0);
    SetControlVisibility(gProtocolPanelName, "TResultTLS",  1);
  }

  UpdateProgressBar(SECCDiscoveryRes);
}


// SECC Discovery Wireless
on any_monitored_value_change _CCS::DataTypes::IMonitoredChargePoint.SDP.SECC_Discovery_Wireless_Request
{
  UpdateProgressBar(SECCDiscoveryReq);
}

on any_monitored_value_change _CCS::DataTypes::IMonitoredVehicle.SDP.SECC_Discovery_Wireless_Response
{

  if ($this.value.SecurityType == _CCS::DataTypes::parSecurityTypeSDP::NoTLS)
  {
    SetControlVisibility(gProtocolPanelName, "TResultTLS",  0);
    SetControlVisibility(gProtocolPanelName, "TResultNoTLS",  1);
  }

  if ($this.value.SecurityType == _CCS::DataTypes::parSecurityTypeSDP::TLS)
  {
    SetControlVisibility(gProtocolPanelName, "TResultNoTLS",  0);
    SetControlVisibility(gProtocolPanelName, "TResultTLS",  1);
  }

  UpdateProgressBar(SECCDiscoveryRes);
}


// SupportedAppProtocol
on any_monitored_value_change _CCS::DataTypes::IMonitoredChargePoint.SAP.SupportedAppProtocol_Request
{
  UpdateProgressBar(SupportedAppProtocolReq);
}

on any_monitored_value_change _CCS::DataTypes::IMonitoredVehicle.SAP.SupportedAppProtocol_Response
{
  if($this.value.ResponseCode <= 1)
    sysSetVariableString(sysvar::Common::ResponseCode, "OK");
  else
    sysSetVariableString(sysvar::Common::ResponseCode, "NOK");
  
  UpdateProgressBar(SupportedAppProtocolRes);
}
