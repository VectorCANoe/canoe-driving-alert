/*@!Encoding:65001*/
includes
{
  
}

variables
{
  msTimer tDriveOff;
  const long cDriveOffIntervall_ms = 5 * 60 * 1000;
  
  char gV2ICPServerPanelName[12] = "V2ICPServer";
  
  int64 gDriveOff;
}

on value_update V2ICP::Endpoints::V2ICPServer.OnRequestReceived
{
  if($V2ICP::Endpoints::V2ICPServer.PreProcessingData.PathData.PathV1Match)
  {
     _OnV1Request();
  }
  
}

_OnV1Request()
{
  if($V2ICP::Endpoints::V2ICPServer.PreProcessingData.V1RequestData.IsValid)
  {
    // Randomize Ambient Temperature
    $V2ICP::Endpoints::V2ICPServer.Control.ResponseControl.ResponseDataV1.AmbientTemp = _GetAmbientTemperature();
    $V2ICP::Endpoints::V2ICPServer.Control.ResponseControl.ResponseDataV1.PrecDsrd    = V2ICP::DataTypes::V1::PreconditioningRequestByDMS::YES;
    $V2ICP::Endpoints::V2ICPServer.Control.ResponseControl.ResponseDataV1.PrecHvac    = V2ICP::DataTypes::V1::PreconditioningRequestByHVAC::HOT_WATER_AND_HEATER;
    $V2ICP::Endpoints::V2ICPServer.Control.ResponseControl.ResponseDataV1.Driveoff    = _GetDriveOffValue(); // x5[min]
    
  }
}

int64 _GetAmbientTemperature()
{
 return (int64)random(121) /*0..120*/ - (int64)50; 
}

on timer tDriveOff
{
  if(gDriveOff > 0)
  {
    gDriveOff--;
  }   
}

int64 _GetDriveOffValue()
{
  if(tDriveOff.IsRunning())
  {
    if(gDriveOff > 0)
    {
      
    }
    else
    {
      cancelTimer(tDriveOff);
    }
  }
  else
  {
    gDriveOff = 500;
    setTimerCyclic(tDriveOff, cDriveOffIntervall_ms);
  }
  
  
  return gDriveOff;
}

on sysvar SimulationControl::Sys_DMSShutdown
{
  if(@this == 1)
    V2ICP::Endpoints::V2ICPServer.Shutdown.Call();
}

on sysvar SimulationControl::Sys_DMSStartup
{
  if(@this == 1)
    V2ICP::Endpoints::V2ICPServer.Startup.Call();
}

on fct_returned V2ICPServer.Startup
{
  @sysvar::SimulationControl::Sys_EVSEConnectedToBackend = 1;
  SetDMSPicturesVisibility(1);
}

on fct_returned V2ICPServer.Shutdown
{
  @sysvar::SimulationControl::Sys_EVSEConnectedToBackend = 0;
  SetDMSPicturesVisibility(0);
}

void SetDMSPicturesVisibility(int showConnected)
{
  SetControlVisibility(gV2ICPServerPanelName, "pictureDMSDisconnected", !showConnected);
  SetControlVisibility(gV2ICPServerPanelName, "pictureDMSConnected", showConnected);
}

on preStop
{
  SetDMSPicturesVisibility(0);
}