/*@!Encoding:1252*/
includes
{
  #include "EVSE_MsgCallbacks.cin"
  #include "CharIn_HW_InterfaceVTS_EVSE.cin"
  #include "MessageIDs.cin"
  #include "EVSE_Sendfunctions.cin"
  #include "Sendfunctions_Common.cin"
  #include "Util.cin"
}

variables
{  
  dword writeTab;  // Sink identifier
  
  long lTemp;
  char strBuffer1[100], strBuffer2[100], strBuffer3[100];
  char DCStatusCode[32];
  
  int isDIN = 0;
  int isISO_IS = 0;
  int isPncMode = 0;

  byte SessionId2[8];

  char gPanelName[5] = "EVSE";
  char gProtocolPanelName[12] = "Protocol";
    
  long isSimulationStarted = 0;
  int isPassiveMode = 0;

  char evseConnections[256];
   
  msTimer tProcessingTime;
  msTimer tMessageTx; 
  msTimer tInvalidMessage;
  msTimer tVerification;
  msTimer tRestartAfterReset;
  msTimer tDelayedStart;
  
  const int processingTimeForContractAuthentication = 3000;
  const int processingTimeForCableCheck = 2500;
  const int processingTimeForChargeParameterDiscovery = 4000;
  const int processingTimeForPowerDelivery = 3000;
  const int processingTimeMaxJitter = 2000;
  
  const cStartAfterEthernetLinkUp = 1000; //[ms]
  
  const int tPreChargeTime = 75;   // [ms]
  float fPreChargeTargetVoltage = 0;
   
  enum eProcessing
  {
    ProcessingNone = 0,
    ProcessingActive = 1,
    ProcessingFinished = 2
  };
  
  enum eProcessing processing = ProcessingNone;

  int chargeLoopCount = 0;
    
  char errorCode[10] = "FAILED";
  
  enum eMode
  {
    Ready = 0,
    Charging = 1,
    Error = 2
  };
  
  enum eMode Mode = Ready;

  msTimer tDelayed_CP_PP;
  const cCP_PP_Delay = 3000;

  msTimer tOpenContactors;
  const dword cOpenContactorsDelay = 500;
  msTimer tActionsAfterContactorOpen;
  const dword cActionsAfterContactorOpenDelay = 100;
  const dword cAdditionMeasurementStopDelay = 100;
  const dword cDeferStopDelay = 3 * cOpenContactorsDelay + cActionsAfterContactorOpenDelay + cAdditionMeasurementStopDelay;
  
  const float cPreChargeMinimumCurrent = 0.5;
  
  msTimer tDeactivateEVSE;
  const dword cDeactivateEVSEdelay = 5000;  //time to reset the EVSE Simulation after TCP close. Will be skipped receiving PLC host action with AVLN DISCONNECTED
  
  msTimer tLinkStatusAvailable;
  const int cLinkStatusAvailableMaxDelay = 10;
  
  msTimer tReEnableEVSE;
  const int cTimeToReEnableEVSE = 100;
}

// ==========================================================================================
//   Initialization
// ==========================================================================================

on preStart
{
  if (@sysVar::Common::SysVerboseWrite)
    SCC_SetVerbosity(5);
  else
    SCC_SetVerbosity(2);

  @sysVar::EVSE_Sim::Control::SysEVSE_WaitResume = 0;
  @sysVar::Test::SysTestApplyControlMode = 0;
  @sysVar::SLAC_Test::SysStartSLACTest = 0;
  @EVSE_Sim::SysEVSE_Enabled = 0;
  
  UpdateSimState();
  
  ST_Init();
}

on preStop
{
  ST_Init();
  Reset_CP_PP();
  SetChargingStationPicturesVisibility(Ready);

  if(!isSimulated())
  {
    deferStop(cDeferStopDelay);
    HV_reduce_VoltageAndCurrent();
    setTimer(tOpenContactors, cOpenContactorsDelay);
  }
}

on start
{
  writeTab = WriteCreate("SCC EVSE");    // same name as tab created by nodelayer

  PrintEthernetSettings("EVSE");
  ReadEVSEStatus();
  
  // Reset power
  @sysVar::EVSE_Sim::SysEVSE_PresentVoltage = 0;
  @sysVar::EVSE_Sim::SysEVSE_PresentCurrent = 0;

  if(isSimulated())
    @sysvar::Common::VT_Access::ChipPresent = 0;
  else 
    @sysvar::Common::VT_Access::ChipPresent = 1;
    
  setTimer(tReEnableEVSE, cTimeToReEnableEVSE);
}

on sysvar EVSE_Sim::VT_Control::IEC61851_State_EVSE
{
  if(@EVSE_Sim::SysEVSE_Enabled == 1)
  {
    if ((@this == @EVSE_Sim::VT_Control::IEC61851_State_EVSE::State_C) || (@this == @EVSE_Sim::VT_Control::IEC61851_State_EVSE::State_D))
    {
      if((@sysvar::EVSE_Sim::Control::SysEVSE_ChargingMode == sysvar::EVSE_Sim::Control::SysEVSE_ChargingMode::AC) || (@sysvar::EVSE_Sim::SysEVSE_AC_PWM_Activate == sysvar::EVSE_Sim::SysEVSE_AC_PWM_Activate::BC))
      {
        if(@sysvar::EVSE_Sim::SysEVSE_AC_Phases == sysvar::EVSE_Sim::SysEVSE_AC_Phases::ThreePhase) // AC three phase
        {
          HV_set_AC_relays(1, 1, 1, 1); // Close switches of AC power supply (L1, L2, L3, N)
        }
        else if(@sysvar::EVSE_Sim::SysEVSE_AC_Phases == sysvar::EVSE_Sim::SysEVSE_AC_Phases::SinglePhase) // AC single phase
        {
          HV_set_AC_relays(1, 0, 0, 1); // Close switches of AC power supply (L1, N)
        }
        else if(@sysvar::EVSE_Sim::SysEVSE_AC_Phases == sysvar::EVSE_Sim::SysEVSE_AC_Phases::Custom) // Use selected AC phases
        {
          HV_set_AC_relays(@sysvar::EVSE_Sim::SysEVSE_AC_Phases_L1_Enabled, @sysvar::EVSE_Sim::SysEVSE_AC_Phases_L2_Enabled, @sysvar::EVSE_Sim::SysEVSE_AC_Phases_L3_Enabled, @sysvar::EVSE_Sim::SysEVSE_AC_Phases_N_Enabled);
        }
      }
    }
    else
    {
      //Open switches of AC and DC Powersupply
      HV_set_AC_relays(0, 0, 0, 0); // Open switches of AC power supply
      HV_source_set_output(0);
    }
  }
}

on timer tReEnableEVSE
{
  @EVSE_Sim::SysEVSE_Enabled = 1;
}

on sysvar EVSE_Sim::SysEVSE_Enabled
{
  @EVSE_Sim::SysEVSE_StopCharging = 0;
  
  if(@this == 1)
  {
    if(@EVSE_Sim::SysEVSE_AC_PWM_Activate == sysvar::EVSE_Sim::SysEVSE_AC_PWM_Activate::BC)
    {
      StartBasicCharging();
    }
    else
    {
      // Apply "chip present" (which is off by default)
      if(isSimulated())
      {
        @sysvar::Common::VT_Access::ChipPresent = 0;
        StartSimulation();
      }
      else
      {
        @sysvar::Common::VT_Access::ChipPresent = 1;
        setTimer(tDelayedStart, cStartAfterEthernetLinkUp);  //start simulation after "cStartAfterEthernetLinkUp" to ensure ethernet link is up     
      }
    }
  }
  else
  {
    ResetSimulation();
  }
}

on timer tDelayedStart
{
  StartSimulation();
}

void StartSimulation()
{  
  if(@EVSE_Sim::Control::SysEVSE_SchemaPreference == @EVSE_Sim::Control::SysEVSE_SchemaPreference::DIN70121)
    SCC_LoadCommunicationConfig(2);
  else
    SCC_LoadCommunicationConfig(10);
  
  SCC_StartSimulation();
  isSimulationStarted = 1;
  
  SCC_SLAC_GenerateApplyKey();
    
  @sysVar::EVSE_Sim::SysEVSE_LinkStatus = 0;
  
  ApplyMessageDelay();
  
  @sysvar::EVSE_Sim::SysEVSE_Processing = 0;
  SetProcessing(0, 0);

  SetControlForeColor(gPanelName, "TEnabled", MakeRGB(72, 72, 72));  

  strncpy(evseConnections, "", 256);
  SysSetVariableString(sysVar::EVSE_Sim::SysEVSE_Connections, evseConnections);
  
  UpdateSimState();

  setTimer(tDelayed_CP_PP, cCP_PP_Delay);

  SetChargingStationPicturesVisibility(Ready);
  
  if(@EVSE_Sim::Control::SysEVSE_ChargingMode == @EVSE_Sim::Control::SysEVSE_ChargingMode::AC)
    HV_source_set_AC_frequency();

  SCC_SLAC_SetChipPresent(@sysvar::Common::VT_Access::ChipPresent);
}

on sysvar EVSE_Sim::Control::SysEVSE_ChargingMode
{
  if(@this == @EVSE_Sim::Control::SysEVSE_ChargingMode::AC)
    HV_source_set_AC_frequency();
}

// ==========================================================================================
//   Status callbacks from simulation DLL
// ==========================================================================================

// generic host indication for all supported PLCs
/// <Callbacks_general>
void SCC_Generic_VS_HostMessage_Ind( byte sourceMacAddess[], dword hostMessage )
{
  // Device is ready to communicate on power line but may not be a member of an AVLN yet. 
  const byte PLC_READY_TO_JOIN_AVLN = 0x01;
  // Device is ready to communicate on power line but may not be a member of an AVLN yet. 
  const byte PLC_AVLN_JOINED = 0x02;
  // Device is disconnected from  an AVLN and there are no peers available. 
  const byte PLC_AVLN_DISCONNECTED = 0x03;  
  
  if (hostMessage == PLC_AVLN_JOINED)
  {
    @sysVar::EVSE_Sim::SysEVSE_LinkStatus = 1;
    SCC_SLAC_SetLinkStatus(1);
    cancelTimer(tLinkStatusAvailable);
  }
  else
  {
    @sysVar::EVSE_Sim::SysEVSE_LinkStatus = 0;
    SCC_SLAC_SetLinkStatus(0);
  }  
  
  if((hostMessage == PLC_READY_TO_JOIN_AVLN) && isTimerActive(tDelayed_CP_PP))
  {
    cancelTimer(tDelayed_CP_PP);
    ConnectAndApply_CP_PP();
  }
  
  if((hostMessage == PLC_AVLN_DISCONNECTED) && isTimerActive(tDeactivateEVSE))
  {
    cancelTimer(tDeactivateEVSE);
    @EVSE_Sim::SysEVSE_Enabled = 0;
    setTimer(tReEnableEVSE, cTimeToReEnableEVSE);
  }
  
  WriteLineEx(writeTab, 1, "EVSE: Link status changed to %i", @sysVar::EVSE_Sim::SysEVSE_LinkStatus);
}

void SCC_ProtocolFinishedInd( byte SessionId[])
{
  WriteLineEx(writeTab, 1, "EVSE: Protocol finished!");
}

void SCC_ConnectionTimeoutInd( byte SessionId[])
{  
  WriteLineEx(writeTab, 2, "EVSE: Connection closed due to inactivity");
}

void SCC_MessageRxInd(byte SessionID[], dword MessageID)
{
  SetLastMessageID(MessageID);
  if(MessageID == 101)
    SetChargingStationPicturesVisibility(Charging);
}

void SCC_MessageTxInd( byte SessionID[], dword messageId, long error)
{
  /*
  WriteHex(strBuffer, SessionID);
  WriteLineEx(writeTab, 0, "EVSE: Message Tx: Session Id = %s, result = %i", strBuffer1, error);
  */   
  
  @Sysvar::EVSE_Sim::SysEVSE_MessageTx = 1;
  setTimer(tMessageTx, 150);
  
  if (error > 0){
    WriteLineEx(writeTab, 2, "EVSE: Message sending of type %0x failed: %i", messageId, error); 
    SetChargingStationPicturesVisibility(Error);
  }
  else
  {
    if(messageId == 34)
     SetChargingStationPicturesVisibility(Ready);
  }
}

void SCC_SLACFinishedInd( dword Result )
{
  if (Result)
  {
    WriteLineEx(writeTab, 1, "EVSE: SLAC finished, result : OK");

    if(isSimulated())
      setTimer(tLinkStatusAvailable, cLinkStatusAvailableMaxDelay);
  }
  else
  {
    WriteLineEx(writeTab, 1, "EVSE: SLAC finished, result : FAILED");
  }

  WriteLineEx(writeTab, 1, "EVSE: Waiting for link state = 1");
}

void SCC_PreSendInd( byte SessionId[], dword MessageId, char ResponseCode[] )
{
  if (ShallWrite())
    WriteLineEx(writeTab, 0, "Pre Send Ind: Message ID = %i, Response Code = %s", MessageId, ResponseCode);  
  
  sysSetVariableString(sysvar::Common::LastReceivedResponseCode, ResponseCode);
  SetChargingStationPictureError(ResponseCode);
}

void SCC_SchemaSelectionInd( char SchemaNamespace[], dword VersionMajor, dword VersionMinor)
{
  int targetConfig = 0;
  
  isDIN = 0;
  isISO_IS = 0;
  
  WriteLineEx(writeTab, 1, "Schema Selected: %s, %i.%i", SchemaNamespace, VersionMajor, VersionMinor);
  
  // There is no session ID assigned yet so we cannot address the connection.
  // Set the schema namespace for all active connections.

  // Switch config dependent on protocol version
  if (strncmp(SchemaNamespace, "urn:iso:15118:2:2013:MsgDef", strlen("urn:iso:15118:2:2013:MsgDef")) == 0
    && VersionMajor == 2)
  {
    targetConfig = 0;
    isISO_IS = 1;
  }
  else if (strncmp(SchemaNamespace, "urn:din:70121:2012:MsgDef", strlen("urn:din:70121:2012:MsgDef")) == 0)
  {
    targetConfig = 2;
    isDIN = 1;
  }  

  if (SCC_LoadV2GConfig(targetConfig))     // session ID = 0
    WriteLineEx(writeTab, 1, "Switching to config %i", targetConfig);  
}

void SCC_TCPConnectInd( dword Port, long isSender)
{
  if (isSender)    // cannot happen here
    WriteLineEx(writeTab, 1, "EVSE: TCP connection established on port %i", Port);
  else
    WriteLineEx(writeTab, 1, "EVSE: TCP client connected to port %i", Port);
}

void SCC_TCPShutdownInd(dword Port, long isSender)
{
  if (isSender)
    WriteLineEx(writeTab, 1, "EVSE: TCP connection on port %i closed", Port);
  else
    WriteLineEx(writeTab, 1, "EVSE: TCP connection on port %i was closed by remote station", Port);
  
  HV_reduce_VoltageAndCurrent();
  setTimer(tOpenContactors, cOpenContactorsDelay);
  
  setTimer(tDeactivateEVSE, cDeactivateEVSEdelay);
}

void SCC_InvalidMessageInd ( long MessageType, long ErrorCode)
{
  @Sysvar::Test::SysErrorIndEVSE = 1;
  setTimer(tInvalidMessage, 3000);    
  
  if (ErrorCode == 0)    
    WriteLineEx(writeTab, 1, "EVSE: Invalid message received - wrong version number or format!");
  else if (ErrorCode == 1)
    WriteLineEx(writeTab, 1, "EVSE: Invalid message received - unknown payload type!");
  else if (ErrorCode == 2)
    WriteLineEx(writeTab, 1, "EVSE: Invalid message received - invalid payload length!");
  else if (ErrorCode == 3)
    WriteLineEx(writeTab, 1, "EVSE: Invalid message received - decoding error");
  
  SetChargingStationPicturesVisibility(Error);
}

SCC_SignaturePreSendInd( byte SessionID[], dword messageId, byte Signature[], dword& SignatureLength)
{  
  WriteLineEx(writeTab, 1, "EVSE: Signature of length %i created for Message ID = %d", SignatureLength, messageId); 
}

SCC_SignatureVerificationInd( dword MessageID, dword Result)
{
  setControlVisibility(gPanelName, "Verification", 1);
  setTimer(tVerification, 1000);
}

void SCC_CertChainVerificationInd( byte SessionId[], char chainName[], dword Result )
{  
  int i;
  char certName[255];
  dword errorCode;
  
  if (Result > 0)
  {
    WriteLineEx(writeTab, 1 /* info */, "%s verified, result: OK", chainName);
  }
  else
  { 
    WriteLineEx(writeTab, 2 /* warning */, "%s verified, result: FAILED", chainName);
    
    for (i = 0; i < SCC_GetCertChainVerificationErrorCount(); ++i)
    {
      SCC_GetCertChainVerificationError(i, certName, errorCode);      
      WriteLineEx(writeTab, 2 /* warning */, "  Error %i was found in certificate %s", errorCode, certName );
    }
  }
}

// ==========================================================================================
//   Helper functions
// ==========================================================================================

void ApplyPaymentOptions()
{
  if(isDIN)
  {
    SCC_SetExternalPaymentAllowed(1);
    SCC_SetContractPaymentAllowed(0);
  }
  else
  {
    if (@sysvar::EVSE_Sim::Control::SysEVSE_PaymentOptions == @EVSE_Sim::Control::SysEVSE_PaymentOptions::External)
    {
      if(@Common::SysTLSEnabled == 1)
        SCC_LoadV2GConfig(12); //offer InternetService if tls connection is established
      
      SCC_SetExternalPaymentAllowed(1);
      SCC_SetContractPaymentAllowed(0);
    }
    else if (@sysvar::EVSE_Sim::Control::SysEVSE_PaymentOptions == @EVSE_Sim::Control::SysEVSE_PaymentOptions::Contract)
    {
      SCC_LoadV2GConfig(11);
      SCC_SetExternalPaymentAllowed(0);
      SCC_SetContractPaymentAllowed(1);
    }
    else
    {
      SCC_LoadV2GConfig(11);
      SCC_SetExternalPaymentAllowed(1);
      SCC_SetContractPaymentAllowed(1);
    }    
  }
}

void ApplyChargingMode()
{
  if(isDIN)
  {
    SCC_SetEnergyTransferType("DC_extended");
  }
  else
  {
    if(@EVSE_Sim::Control::SysEVSE_ChargingMode == @EVSE_Sim::Control::SysEVSE_ChargingMode::AC)
    {
      if(@sysvar::EVSE_Sim::SysEVSE_AC_Phases == sysvar::EVSE_Sim::SysEVSE_AC_Phases::SinglePhase)
      {
        SCC_LoadV2GConfig(19);
      }
      else
      {
        SCC_LoadV2GConfig(20);
      }
    }
    else //DC
    {
      SCC_LoadV2GConfig(13);
    }
  }
}

void GenerateNMK()
{ 
  byte nmk[16];
  byte nid[7];
  
  SCC_SLAC_GetKeyData(nid, nmk);
  
  WriteHex(strBuffer1, nmk); 
  WriteHex(strBuffer2, nid); 
  
  // read NMK and NID from chip, before new key is set
  WriteLineEx(writeTab, 0, "Generating key, old key is: %s (NID: %s)", strBuffer1, strBuffer2);
  
  SCC_SLAC_GenerateApplyKey();  
  SCC_SLAC_GetKeyData(nid, nmk);
  
  WriteHex(strBuffer1, nmk); 
  WriteHex(strBuffer2, nid); 
  
  // read new NMK and NID from chip
  WriteLineEx(writeTab, 0, "Generated new key: %s (NID: %s)", strBuffer1, strBuffer2);
}

void UpdateSimState()
{
  lTemp = SCC_GetSimulationState();
    
  if (lTemp == 2)
    @sysvar::EVSE_Sim::SysEVSE_SimState = 0;
  else if (lTemp == 3)
    @sysvar::EVSE_Sim::SysEVSE_SimState = 1;
  else
    @sysvar::EVSE_Sim::SysEVSE_SimState = 2;    
}

void UpdateConnections()
{  
  long connectionCount;
  byte sessionIdTemp[8];
  char sessionIdTempChar[17];
  
  // Note: this functions works only in active mode!
  if (@sysvar::Test::SysTestApplyControlMode)
    return;
  
  connectionCount = SCC_GetConnectionCount();
  @sysVar::EVSE_Sim::SysEVSE_ConnectionCount = connectionCount;

  if (connectionCount == 0)
    SetControlForeColor(gPanelName, "TEnabled", MakeRGB(72, 72, 72));
  else
    SetControlForeColor(gPanelName, "TEnabled", MakeRGB(192, 0, 0));

  strncpy(evseConnections, "", 256);
  
  for (lTemp = 0; lTemp < connectionCount; ++lTemp)
  {
    SCC_GetSessionId(lTemp, sessionIdTemp);

    // Remember IDs of current sessions
    //  (store only the newest connections, as sometimes old connections stay open)
    if (lTemp == connectionCount - 2)
      memcpy(SessionId2, sessionIdTemp, 8);      
    else if (lTemp == connectionCount - 1)
      memcpy(SessionId, sessionIdTemp, 8);
    
    WriteHex(sessionIdTempChar, sessionIdTemp);
    sessionIdTempChar[16] = '\0';
    strncat(evseConnections, sessionIdTempChar, 256);

    SysSetVariableString(sysVar::EVSE_Sim::SysEVSE_Connections, evseConnections);
  } 
}

void ReadEVSEStatus()
{
  // Print DC status code 
  strncpy(DCStatusCode, "                                 ", 32);
  SCC_GetDCStatusCode(DCStatusCode);
  SysSetVariableString(sysVar::EVSE_Sim::SysEVSE_DCStatusCode, DCStatusCode);
}

void SetProcessing( int startProcessing, int avgTime)
{  
  dword jitterTime;  
  jitterTime = random(processingTimeMaxJitter) - processingTimeMaxJitter/2;
    
  @sysvar::EVSE_Sim::SysEVSE_Processing = startProcessing;
  
  if (startProcessing && processing == ProcessingNone)
  {
    processing = ProcessingActive;
    SCC_SetProcessing(1);
    SetControlForeColor(gPanelName, "TProcessing",  MakeRGB(0, 0, 255)); 
      
    setTimer(tProcessingTime, _max(avgTime + jitterTime, 1)); 
  }  
  else
  { 
    SCC_SetProcessing(0);
    SetControlForeColor(gPanelName, "TProcessing",  MakeRGB(255, 255, 255));  
    
    cancelTimer(tProcessingTime);
  } 
}

void SetChargingStationPicturesVisibility(int Mode)
{
  If(Mode == Ready)
  {
   SetControlVisibility(gPanelName, "pictureChargingStationReady", 1);
   SetControlVisibility(gPanelName, "pictureChargingStationCharging", 0);
   SetControlVisibility(gPanelName, "pictureChargingStationError", 0);
  }
  else If(Mode == Charging)
  {
   SetControlVisibility(gPanelName, "pictureChargingStationReady", 0);
   SetControlVisibility(gPanelName, "pictureChargingStationCharging", 1);
   SetControlVisibility(gPanelName, "pictureChargingStationError", 0);
  }
  else If(Mode == Error)
  {
   SetControlVisibility(gPanelName, "pictureChargingStationReady", 0);
   SetControlVisibility(gPanelName, "pictureChargingStationCharging", 0);
   SetControlVisibility(gPanelName, "pictureChargingStationError", 1);
  }
}

void SetChargingStationPictureError(char ResponseCode[])
{
  if (strncmp(ResponseCode, "OK", 2) != 0)
      SetChargingStationPicturesVisibility(Error);
}
// ==========================================================================================
//   Timers
// ==========================================================================================

on timer tLinkStatusAvailable
{ 
  SCC_SLAC_SetLinkStatus(1);
  @sysVar::EVSE_Sim::SysEVSE_LinkStatus = SCC_SLAC_GetLinkStatus(); 
  WriteLineEx(writeTab, 1, "EVSE: Set simulated link status = 1");
}

on timer tMessageTx
{  
  @Sysvar::EVSE_Sim::SysEVSE_MessageTx = 0;
}
on timer tInvalidMessage
{  
  @Sysvar::Test::SysErrorIndEVSE = 0;
}

on timer tVerification
{
  setControlVisibility(gPanelName, "Verification", 0);
}

on timer tProcessingTime
{ 
  processing = ProcessingFinished;
  SetProcessing(0, 0);
}

on timer tRestartAfterReset
{
  if(@EVSE_Sim::SysEVSE_AC_PWM_Activate == sysvar::EVSE_Sim::SysEVSE_AC_PWM_Activate::BC)
    StartBasicCharging();
  else
    StartSimulation();
 
  @sysVar::EVSE_Sim::Control::SysEVSE_WaitResume = 0;
}

on timer tOpenContactors
{
  if(abs(HV_measure_DC_I()) > 5)
  {
    HV_reduce_VoltageAndCurrent();
    setTimer(tOpenContactors, cOpenContactorsDelay);
  }
  else
  {
    HV_OpenContactors();
    setTimer(tActionsAfterContactorOpen, cActionsAfterContactorOpenDelay);
  }
}

on timer tActionsAfterContactorOpen
{
  HV_ActionsAfterContactorOpen();
}

on timer tDelayed_CP_PP
{
  ConnectAndApply_CP_PP();
}

on timer tDeactivateEVSE
{
  @EVSE_Sim::SysEVSE_Enabled = 0;
  setTimer(tReEnableEVSE, cTimeToReEnableEVSE);
}

// ==========================================================================================
//   System variable handlers (simulation <-> GUI)
// ==========================================================================================

on sysVar EVSE_Sim::SysEVSE_StopCharging
{ 
  if(@EVSE_Sim::SysEVSE_Enabled == 1)
  {
    SCC_SetShutdownRequest(@this);
    
    if (@this == 1)
    {
      SCC_SetDCStatusCode("EVSE_Shutdown");

      if(@sysvar::EVSE_Sim::SysEVSE_AC_PWM_Activate == sysvar::EVSE_Sim::SysEVSE_AC_PWM_Activate::BC)
      {
        CP_EVSE_set_Dutycycle(0);
      }
    }
  }
}

on sysVar EVSE_Sim::Control::SysEVSE_ReturnFailed
{  
  if (@this == 1 && @EVSE_Sim::SysEVSE_Enabled == 1)
  {
    SCC_SetResponseCode(errorCode);
    SetChargingStationPicturesVisibility(Error);
  }
}

on sysVar EVSE_Sim::Control::SysEVSE_AbortConnection
{
  if (@this == 1 && @EVSE_Sim::SysEVSE_Enabled == 1)
  {
    SCC_StopSession(1 /* close TCP */);
    SetChargingStationPicturesVisibility(Error); 
  }
}

on sysvar EVSE_Sim::Control::SysEVSE_NewNMK
{
  if (@this == 1 && @EVSE_Sim::SysEVSE_Enabled == 1)
  {
    GenerateNMK();
    
    @EVSE_Sim::Control::SysEVSE_NewNMK = 0;
  }
}

on sysVar EVSE_Sim::Control::SysEVSE_WaitResume
{
  if(@EVSE_Sim::SysEVSE_Enabled == 1)
  {
    if(@this == 0)
      SCC_SimulationResume();
    else
      SCC_SimulationWait();
    
    UpdateSimState();
  }
}

on sysVar EVSE_Sim::SysEVSE_MinVoltage
{
  if(@EVSE_Sim::SysEVSE_Enabled == 1)
    SCC_SetMinVoltage(@this);
}

on sysVar EVSE_Sim::SysEVSE_MaxVoltage
{
  if(@EVSE_Sim::SysEVSE_Enabled == 1)
    SCC_SetMaxVoltage(@this);
}

on sysVar EVSE_Sim::SysEVSE_MinCurrent
{
  if(@EVSE_Sim::SysEVSE_Enabled == 1)
    SCC_SetMinCurrent(@this);
}

on sysVar EVSE_Sim::SysEVSE_MaxCurrent
{
  if((@EVSE_Sim::SysEVSE_Enabled == 1) && (@EVSE_Sim::Control::SysEVSE_ChargingMode == @EVSE_Sim::Control::SysEVSE_ChargingMode::DC))
    SCC_SetMaxCurrent(@this);
}

on sysVar EVSE_Sim::SysEVSE_MaxCurrent_AC
{
  if((@EVSE_Sim::SysEVSE_Enabled == 1) && (@EVSE_Sim::Control::SysEVSE_ChargingMode == @EVSE_Sim::Control::SysEVSE_ChargingMode::AC))
    SCC_SetMaxCurrent(@this);
}

on sysVar EVSE_Sim::SysEVSE_MaxPower
{
  if(@EVSE_Sim::SysEVSE_Enabled == 1)
    SCC_SetMaxPower(@this * 1000);    // variable in [kW]
}

on sysVar EVSE_Sim::SysEVSE_CurrentRegulationTolerance
{
  if(@EVSE_Sim::SysEVSE_Enabled == 1)
    SCC_SetCurrentRegulationTolerance(@this);
}

on sysVar EVSE_Sim::SysEVSE_PeakCurrentRipple
{
  if(@EVSE_Sim::SysEVSE_Enabled == 1)
    SCC_SetPeakCurrentRipple(@this);
}

on sysVar EVSE_Sim::SysEVSE_PresentCurrent
{
  if(@EVSE_Sim::SysEVSE_Enabled == 1)
    SCC_SetPresentCurrent(@this);
}

on sysVar EVSE_Sim::SysEVSE_PresentVoltage
{
  if(@EVSE_Sim::SysEVSE_Enabled == 1)
    SCC_SetPresentVoltage(@this);
}

on sysvar EVSE_Sim::Control::SysEVSE_Reset
{
  if (@this == 0)
    return;
  
  ResetSimulation();
}

void ResetSimulation()
{
  SCC_SimulationReset();
  Reset_CP_PP();
  
  HV_reduce_VoltageAndCurrent();
  setTimer(tOpenContactors, cOpenContactorsDelay);
    
  if(@EVSE_Sim::SysEVSE_Enabled == 1)
  {
    // allow TCP shutdown to take place before restarting and setting new key
    setTimer(tRestartAfterReset, 100);
  }
}

on sysvar EVSE_Sim::Control::SysEVSE_Renegotiate
{
  if (@this == 1 && @EVSE_Sim::SysEVSE_Enabled == 1)
  {
    SCC_LoadV2GConfig(17);
	  SCC_SetEVSENotification("ReNegotiation");
  }
}

on sysvar EVSE_Sim::Control::SysEVSE_PaymentOptions
{
  if(@EVSE_Sim::SysEVSE_Enabled == 1)
    ApplyPaymentOptions();
}

on sysVar Test::SysTestApplyControlMode
{
  if (@this == 1)
  {
    SCC_SimulationReset();
    
    if (@sysVar::Test::SysTestControlledEntity != 0)
    {      
      isPassiveMode = 1;
      SCC_StartPassive();
    }
    else if (@sysvar::EVSE_Sim::SysEVSE_AC_PWM_Activate == 0)
    {
      SCC_StartSimulation();
    }
  
    // apply "chip present" (which is off by default)
    SCC_SLAC_SetChipPresent(@sysvar::Common::VT_Access::ChipPresent);
  }
  else
  {
    setTimer(tReEnableEVSE, cTimeToReEnableEVSE);
  }
}

on sysVar SLAC_Test::SysStartSLACTest
{  
  if (@this == 1)
  {
    SCC_SimulationReset();    
    isPassiveMode = 1;
    SCC_StartPassive(0 /* start with manual SLAC */);    
  }
}

on sysVar Common::SysMessageDelay
{
  if(@EVSE_Sim::SysEVSE_Enabled == 1)
    ApplyMessageDelay();
}

on sysVar Common::SysMessageDelayJitter
{
  if(@EVSE_Sim::SysEVSE_Enabled == 1)
    ApplyMessageDelay();
}

on sysvar Common::SysVerboseWrite
{  
  if(@EVSE_Sim::SysEVSE_Enabled == 1)
  {
    if (@this)
      SCC_SetVerbosity(5);
    else
      SCC_SetVerbosity(2);
  }
}

on sysvar Common::VT_Access::ChipPresent
{
  // toggled from VT_EVSE node to disable simulated attenuation
  SCC_SLAC_SetChipPresent(@this);
}

// Functions to switch sender roles in Test

int IsEVRoleActive()
{
  return @sysvar::Test::SysTestSwitchRoles == 1;
}

int IsEVSERoleActive()
{
  return @sysvar::Test::SysTestSwitchRoles == 0;
}

FUNC_AC_PWM_Calculate_DutyCycle()
{
  /* Implementation according to Table A.8 from IEC 61851-1 */
  double dutyCycle = 0;
  if ((@sysvar::EVSE_Sim::SysEVSE_AC_PWM_MaxCurrent > 1) && (@sysvar::EVSE_Sim::SysEVSE_AC_PWM_MaxCurrent <= 6))
  {
    dutyCycle = 10;
  }
  else if ((@sysvar::EVSE_Sim::SysEVSE_AC_PWM_MaxCurrent > 6) && (@sysvar::EVSE_Sim::SysEVSE_AC_PWM_MaxCurrent <= 51))
  {
    dutyCycle = @sysvar::EVSE_Sim::SysEVSE_AC_PWM_MaxCurrent/0.6;
  }
   else if ((@sysvar::EVSE_Sim::SysEVSE_AC_PWM_MaxCurrent > 51) && (@sysvar::EVSE_Sim::SysEVSE_AC_PWM_MaxCurrent <= 80))
  {
    dutyCycle = (@sysvar::EVSE_Sim::SysEVSE_AC_PWM_MaxCurrent/2.5) + 64;
  }
  else
  {
    dutyCycle = 0;
  }
  
  CP_EVSE_set_Dutycycle(dutyCycle);
}

on sysvar_update EVSE_Sim::SysEVSE_AC_PWM_MaxCurrent
{
  if ((@EVSE_Sim::SysEVSE_Enabled == 1) && (@sysvar::EVSE_Sim::SysEVSE_AC_PWM_Activate == sysvar::EVSE_Sim::SysEVSE_AC_PWM_Activate::BC))
  {
    FUNC_AC_PWM_Calculate_DutyCycle();
  }
}

on sysvar_update EVSE_Sim::SysEVSE_AC_PWM_Activate
{
  ResetSimulation();
}

on sysvar_update EVSE_Sim::SysEVSE_AC_Phases
{
  ResetSimulation();
}

on sysvar_update EVSE_Sim::SysEVSE_AC_Phases_L1_Enabled
{
  if(@sysvar::EVSE_Sim::SysEVSE_AC_Phases == sysvar::EVSE_Sim::SysEVSE_AC_Phases::Custom)
    ResetSimulation();
}

on sysvar_update EVSE_Sim::SysEVSE_AC_Phases_L2_Enabled
{
  if(@sysvar::EVSE_Sim::SysEVSE_AC_Phases == sysvar::EVSE_Sim::SysEVSE_AC_Phases::Custom)
    ResetSimulation();
}

on sysvar_update EVSE_Sim::SysEVSE_AC_Phases_L3_Enabled
{
  if(@sysvar::EVSE_Sim::SysEVSE_AC_Phases == sysvar::EVSE_Sim::SysEVSE_AC_Phases::Custom)
    ResetSimulation();
}

on sysvar_update EVSE_Sim::SysEVSE_AC_Phases_N_Enabled
{
  if(@sysvar::EVSE_Sim::SysEVSE_AC_Phases == sysvar::EVSE_Sim::SysEVSE_AC_Phases::Custom)
    ResetSimulation();
}

void StartBasicCharging()
{
  if(@sysvar::EVSE_Sim::SysEVSE_Enabled == 1)
  {
    ST_Init();
    CP_EVSE_set_open_circuit(1);
    CP_EVSE_set_Voltage(12);
    FUNC_AC_PWM_Calculate_DutyCycle();
    HV_source_set_AC_frequency();
    
    if(@sysvar::EVSE_Sim::SysEVSE_AC_Phases == sysvar::EVSE_Sim::SysEVSE_AC_Phases::ThreePhase) // AC three phase
    {
      HV_source_set_U_L1_rms(@EVSE_Sim::SysEVSE_NominalVoltage);
      HV_source_set_U_L2_rms(@EVSE_Sim::SysEVSE_NominalVoltage);
      HV_source_set_U_L3_rms(@EVSE_Sim::SysEVSE_NominalVoltage);
    }
    else if(@sysvar::EVSE_Sim::SysEVSE_AC_Phases == sysvar::EVSE_Sim::SysEVSE_AC_Phases::SinglePhase) // AC single phase
    {
      HV_source_set_U_L1_rms(@EVSE_Sim::SysEVSE_NominalVoltage);
      HV_source_set_U_L2_rms(0);
      HV_source_set_U_L3_rms(0);
    }
    else // Custom AC phases
    {
      if(@sysvar::EVSE_Sim::SysEVSE_AC_Phases_L1_Enabled == 1)
        HV_source_set_U_L1_rms(@EVSE_Sim::SysEVSE_NominalVoltage);
      else
        HV_source_set_U_L1_rms(0);
      
      if(@sysvar::EVSE_Sim::SysEVSE_AC_Phases_L2_Enabled == 1)
        HV_source_set_U_L2_rms(@EVSE_Sim::SysEVSE_NominalVoltage);
      else
        HV_source_set_U_L2_rms(0);
      
      if(@sysvar::EVSE_Sim::SysEVSE_AC_Phases_L3_Enabled == 1)
        HV_source_set_U_L3_rms(@EVSE_Sim::SysEVSE_NominalVoltage);
      else
        HV_source_set_U_L3_rms(0);
    }
    
    PP_EVSE_set_open_circuit(1);
    PP_EVSE_set_resistance(@EVSE_Sim::SysEVSE_PP_resistance);
  }
}

void ConnectAndApply_CP_PP()
{
  CP_EVSE_set_open_circuit(1);
  CP_EVSE_set_Dutycycle(5);
  CP_EVSE_set_Voltage(12);
  CP_EVSE_set_Oscillator(1);
  
  PP_EVSE_set_open_circuit(1);
  PP_EVSE_set_resistance(@EVSE_Sim::SysEVSE_PP_resistance);
}

void Reset_CP_PP()
{
  CP_EVSE_set_Voltage(0);
  CP_EVSE_set_Oscillator(0);
  CP_EVSE_set_open_circuit(0);
  CP_EVSE_set_Dutycycle(0);
  
  PP_EVSE_set_open_circuit(0);
  PP_EVSE_set_resistance(0);
}

void HV_reduce_VoltageAndCurrent()
{
  HV_source_set_I_DC(cPreChargeMinimumCurrent);
  HV_source_set_U_DC(HV_measure_DC_U_VeriVolt());
  
  HV_source_set_U_L1_rms(0);
  HV_source_set_U_L2_rms(0);
  HV_source_set_U_L3_rms(0);
}

void HV_OpenContactors()
{
  HV_source_set_output(0); // Open switches of DC power supply
  
  HV_set_AC_relays(0, 0, 0, 0); // Open switches of AC power supply
}

void HV_ActionsAfterContactorOpen()
{
  HV_source_set_I_DC(0);
  HV_source_set_U_DC(0);
  
  ST_Reset();
}