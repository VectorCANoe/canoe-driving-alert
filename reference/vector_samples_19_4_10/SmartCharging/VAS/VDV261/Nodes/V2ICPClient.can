/*@!Encoding:1252*/
includes
{
  
}

variables
{
  char addrStr[50];
  ip_address test_addr[2];
}

OnIpAddressAdded(dword ifIndex, ip_address address, dword prefix, dword origin)
{
  dword count;
  if (address.PrintAddressToString( addrStr ) == 0)
  {
    Write("Client: Added Address is %s", addrStr);
  }
}

OnIpAddressRemoved(dword ifIndex, ip_address address, dword prefix, dword origin)
{
  if (address.PrintAddressToString( addrStr ) == 0)
  {
    Write("Client: Removed Address is %s", addrStr);
  }
}

