/*@!Encoding:1252*/
includes
{
  #include "./Nodes_DIN70121_ISO15118/EV.can"
}

variables
{

}

on preStart
{
  ConfigureEVForVDV();
}

void ConfigureEVForVDV()
{
  writeLineEx(0 ,1 ,"Configuring EV for ISO15118-2 communication");
  @sysvar::EV_Sim::Control::SysUserChargingCommunication = 1; // Use high level communication
  @sysvar::EV_Sim::Control::SysEV_Schema = @sysvar::EV_Sim::Control::SysEV_Schema::ISO15118;
}

on stopMeasurement
{
  @sysvar::EV_Sim::Control::SysEV_Connected = 0;
}