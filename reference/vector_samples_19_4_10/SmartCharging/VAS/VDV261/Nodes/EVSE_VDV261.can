/*@!Encoding:1252*/
includes
{
  #include "./Nodes_DIN70121_ISO15118/EVSE.can"
}

variables
{

}

on preStart
{
  ConfigureEVSEForVDV();
}

void ConfigureEVSEForVDV()
{
  writeLineEx(0, 1, "Configuring EVSE for ISO15118-2 communication");
  @sysvar::EVSE_Sim::SysEVSE_AC_PWM_Activate = 0; // Use high level communication
}