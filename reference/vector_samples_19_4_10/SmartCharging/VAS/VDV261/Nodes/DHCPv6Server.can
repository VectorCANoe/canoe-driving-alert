/*@!Encoding:1252*/
includes
{

}

variables
{
  const dword PREFERRED_LIFETIME = 3600;
  const dword VALID_LIFETIME = 7200;
  const dword T1_duration =  3600;
  const dword T2_duration =  5760;

  const kMaxMTU = 512;
  
  enum dhcp6Type
  {
    kSolicit = 1,
    kAdvertise = 2,
    kRequest = 3,
    kReply = 7
  };
  
  enum dhcp6StatusCode
  {
    Success        = 0 , // Success.
    UnspecFail     = 1 , //Failure, reason unspecified; this
                         // status code is sent by either a client
                         // or a server to indicate a failure
                         // not explicitly specified in this
                         // document.
    NoAddrsAvail   = 2 , // Server has no addresses available to assign to
                         // the IA(s).
    NoBinding      = 3 , // Client record (binding) unavailable.
    NotOnLink      = 4 , // The prefix for the address is not appropriate for
                         // the link to which the client is attached.
    UseMulticast   = 5   // Sent by a server to a client to force the
                         // client to send messages to the server.
                         // using the All_DHCP_Relay_Agents_and_Servers
                         // address.
  };
    
  enum dhcp6OptionCode
  {
    kOPTION_CLIENTID       = 1 ,
    kOPTION_SERVERID       = 2 ,
    kOPTION_IA_NA          = 3 ,
    kOPTION_IA_TA          = 4 ,
    kOPTION_IAADDR         = 5 ,
    kOPTION_ORO            = 6 ,
    kOPTION_PREFERENCE     = 7 ,
    kOPTION_ELAPSED_TIME   = 8 ,
    kOPTION_RELAY_MSG      = 9 ,
    kOPTION_AUTH           = 11,
    kOPTION_UNICAST        = 12,
    kOPTION_STATUS_CODE    = 13,
    kOPTION_RAPID_COMMIT   = 14,
    kOPTION_USER_CLASS     = 15,
    kOPTION_VENDOR_CLASS   = 16,
    kOPTION_VENDOR_OPTS    = 17,
    kOPTION_INTERFACE_ID   = 18,
    kOPTION_RECONF_MSG     = 19,
    kOPTION_RECONF_ACCEPT  = 20
  };
    
  struct dhcpv6Option
  {
    word type;
    word len;
    byte data[kMaxMTU - 8];
  };
  
  _align(1) struct dhcpv6Address
  {
    word code;
    word len;
    byte address[16];
    dword prefLifetime;
    dword validLifetime;
  };
  
  _align(1) struct dhcpv6DuidLLT
  {
    word code;
    word len;
    word type;
    word hwType;
    dword time;
    byte addr[6];      
  };
  
  struct dhcpv6IANA
  {
    word code;
    word len;
    dword iaid;
    dword T1;
    dword T2;
    struct dhcpv6Address addr[2];
    enum dhcp6StatusCode state;
  };
  
  struct dhcpv6
  {
    byte type;
    byte xid[3];
    byte data[kMaxMTU - 4];
    dword len;
    dword parseOffset;
  };
  
  byte gServerAddr[16];
  byte gClientAddr[16];
  DWORD gClientPort = 546;
  DWORD gServerPort = 547;
  
  byte gXid[3];
  
  DWORD gSo; // socket handle
  dword gWriteSocket;
  char gRecBuf[kMaxMTU + 4];
  char gSendBuf[kMaxMTU + 4];
  
  struct dhcpv6Option gClientId;
  struct dhcpv6DuidLLT gServerId;
  struct dhcpv6IANA gClientIA;
  struct dhcpv6IANA gServerIA;
}

on start
{
  ipGetAddressAsArray("::", gServerAddr);
  gSo = UdpOpen(gServerAddr, gServerPort);
  ipGetAddressAsArray("FF02::1:2", gServerAddr);
  ipJoinMulticastGroup(gSo, 1, gServerAddr);
  udpReceiveFrom(gSo, gRecBuf, elcount(gRecBuf));
  
  gServerId.code = kOPTION_SERVERID;
  gServerId.len = 14;
  gServerId.type = 1;
  gServerId.hwType = 1;
  gServerId.time = 0x1F76BED6;
  gServerId.addr[0] = 0x02;
  gServerId.addr[1] = 0x00;
  gServerId.addr[2] = 0x00;
  gServerId.addr[3] = 0x12;
  gServerId.addr[4] = 0x11;
  gServerId.addr[5] = 0x01;      
  
  gServerIA.code = kOPTION_IA_NA;
  gServerIA.len = 40; 
  gServerIA.iaid = 0; 
  gServerIA.T1 = T1_duration; 
  gServerIA.T2 = T2_duration; 
  gServerIA.addr[0].code = kOPTION_IAADDR; 
  gServerIA.addr[0].len = 24;
  ipGetAddressAsArray("2001:DB8:CAFE::1", gServerIA.addr[0].address);
  gServerIA.addr[0].prefLifetime = PREFERRED_LIFETIME;
  gServerIA.addr[0].validLifetime = VALID_LIFETIME;
  gServerIA.state = Success;
}

void SendAdvertise()
{
  struct dhcpv6 msg;
  byte buf[200];
  struct dhcpv6Option option;
  
  initDhcpv6(msg);
  msg.type = kAdvertise;
  SetXid(gXid, msg.xid);
  
  ApendOption(msg, gClientId);
  memcpy_h2n(buf, gServerId); 
  ApendOption(msg, buf, gServerId.len);
  
  gServerIA.iaid = gClientIA.iaid;
  gServerIA.state = Success;
  ApendOption(msg, gServerIA);
  
  Send(msg);
}

void SendReply()
{
  struct dhcpv6 msg;
  byte buf[200];
  struct dhcpv6Option option;

  initDhcpv6(msg);
  msg.type = kReply;
  SetXid(gXid, msg.xid);
  
  ApendOption(msg, gClientId);
  memcpy_h2n(buf, gServerId); 
  ApendOption(msg, buf, gServerId.len);
  
  gServerIA.iaid = gClientIA.iaid;
  gServerIA.state = Success;
  ApendOption(msg, gServerIA);
  
  Send(msg);
}

void initDhcpv6(struct dhcpv6 msg)
{
  msg.len = 0;
  msg.type = 0;
  msg.xid[0] = 0;
  msg.xid[1] = 0;
  msg.xid[2] = 0;
  msg.parseOffset = 0;  
}

void Send(struct dhcpv6 msg)
{
  char addr[255];
  dword result;
  if(gSo)
  {
    CopyMsg2Buffer(msg, gSendBuf);
    result = udpSendTo(gSo, gClientAddr, gClientPort, gSendBuf, msg.len + 4);
  }
}

dword Apend(struct dhcpv6 msg, word value)
{
  msg.data[msg.len++] = value >> 8;
  msg.data[msg.len++] = value;
  return 2;
}

dword Apend(struct dhcpv6 msg, dword value)
{
  msg.data[msg.len++] = value >> 24;
  msg.data[msg.len++] = value >> 16;
  msg.data[msg.len++] = value >> 8;
  msg.data[msg.len++] = value;
  return 4;
}

dword ApendOption(struct dhcpv6 msg, struct dhcpv6Option opt)
{
  int i;
  msg.data[msg.len++] = opt.type >> 8;
  msg.data[msg.len++] = opt.type;
  msg.data[msg.len++] = opt.len >> 8;
  msg.data[msg.len++] = opt.len;
  for( i = 0; i < opt.len; i++)
  {
    msg.data[msg.len++] = opt.data[i];
  }
  return i+4;
}

dword ApendOption(struct dhcpv6 msg, byte opt[], dword size)
{
  int i;
  //write("apend option with size %d", size);
  for( i = 0; i < (size+4); i++)
  {
    msg.data[msg.len++] = opt[i];
  }
  return i;
}

dword ApendOption(struct dhcpv6 msg, struct dhcpv6Address opt)
{
  int i;
  Apend(msg, opt.code);
  Apend(msg, opt.len);
  for(i=0; i<16; i++)
  {
    msg.data[msg.len++] = opt.address[i];
  }
  Apend(msg, opt.prefLifetime);
  Apend(msg, opt.validLifetime);
  return __size_of(struct dhcpv6Address);
}

dword ApendOption(struct dhcpv6 msg, struct dhcpv6IANA opt)
{
  int len, i, statelen;
  struct dhcpv6Option option;

  Apend(msg, opt.code);
  len = opt.len;
  if(opt.state != Success)
  {
    opt.len += 6;
  }
  Apend(msg, opt.len);
  if(len >= 12)
  {
    len -= Apend(msg, opt.iaid);
    len -= Apend(msg, opt.T1);
    len -= Apend(msg, opt.T2);
    i = 0;
    while(len >= __size_of(struct dhcpv6Address))
    {
      len -= ApendOption(msg, opt.addr[i++]);
    }
  }
  
  if(opt.state != Success)
  {
   option.type = kOPTION_STATUS_CODE;
   option.len = 2;
   option.data[0] = 0;
   option.data[1] = opt.state;
   ApendOption(msg, option);
  }
  
  return 4+opt.len+statelen-len;
}


dword ParseOption(struct dhcpv6 msg, struct dhcpv6Option opt)
{
  dword i, j;
  j = 0;
  if(msg.len - msg.parseOffset > 4)
  {
    j = 4;
    opt.type = (msg.data[msg.parseOffset++] << 8) | msg.data[msg.parseOffset++];
    opt.len = (msg.data[msg.parseOffset++] << 8) | msg.data[msg.parseOffset++];
    for(i = 0; i<opt.len && (msg.len - msg.parseOffset >= 4); i++)
    {
      j++;
      opt.data[i] = msg.data[msg.parseOffset++];
    }
  }
  return j;
}

void CopyMsg2Buffer(struct dhcpv6 msg, char buffer[])
{
  int i;
  buffer[0] = msg.type;
  buffer[1] = msg.xid[0];
  buffer[2] = msg.xid[1];
  buffer[3] = msg.xid[2];
  for( i = 0; i < msg.len; i++)
  {
    buffer[i+4] = msg.data[i];
  }
}

void CopyOption(struct dhcpv6Option src, struct dhcpv6Option dst)
{
  int i;
  dst.type = src.type;
  dst.len = src.len;
  for(i = 0; i < dst.len; i++)
  {
    dst.data[i] = src.data[i];
  }
}

void CopyOption(struct dhcpv6Option src, struct dhcpv6IANA dst)
{
  int i;
  i=0;
  dst.code = src.type;
  dst.len = src.len;
  if(src.len >= 12)
  {
    dst.iaid = src.data[i++] | src.data[i++] | src.data[i++] | src.data[i++];
    dst.T1 = src.data[i++] | src.data[i++] | src.data[i++] | src.data[i++];
    dst.T2 = src.data[i++] | src.data[i++] | src.data[i++] | src.data[i++];
  }
  
  
}


void SetXid(byte src[], byte dst[])
{
  dst[0] = src[0];
  dst[1] = src[1];
  dst[2] = src[2];
}

OnUdpReceiveFrom(dword socket, long result, byte ipv6Address[], dword port, char buffer[], dword size)
{
  struct dhcpv6Option opt;
  struct dhcpv6 msg;
  int i;
   
  initDhcpv6(msg);
  msg.type = buffer[0];
  msg.xid[0] = buffer[1];
  msg.xid[1] = buffer[2];
  msg.xid[2] = buffer[3];
  SetXid(msg.xid, gXid);

  memcpy_off(msg.data, 0, buffer, 4, size - 4);
  msg.len = size;
  
  for(i = 0; i < 16; i++)
  {
    gClientAddr[i] = ipv6Address[i];
  }
  
  while (ParseOption(msg, opt))
  {
    //write("option %d with len %d received", opt.type, opt.len);
    switch (opt.type)
    {
      case kOPTION_CLIENTID:
        CopyOption(opt, gClientId);
        break;
      case kOPTION_IA_NA:
        CopyOption(opt, gClientIA);
        break;
      default:;
    }
  }

  // advertise
  if (msg.type == 1)
  {
    //writeLineEx(1, 1, "Sending DHCPv6 Advertise");
    SendAdvertise();
  }

  if (msg.type == 3)
  {
    //writeLineEx(1, 1, "Sending DHCPv6 Reply");
    SendReply();
  }
  
  udpReceiveFrom(socket, gRecBuf, elcount(gRecBuf));
}

