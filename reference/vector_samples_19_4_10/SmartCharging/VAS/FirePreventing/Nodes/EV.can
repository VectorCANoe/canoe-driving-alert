/*@!Encoding:1252*/
includes
{
  #include "EV_MsgCallbacks.cin"
  #include "CharIn_HW_InterfaceVTS_EV.cin"
  #include "MessageIDs.cin"
  #include "Util.cin"
  #include "do_transmission_handler.cin"
}

variables
{
  dword writeTab;  // Sink identifier
  
  int   iTemp1, iTemp2;
  long  lTemp;
  float fTemp;
  
  char strBuffer1[100];
  
  char gPanelName[32] = "Vehicle";
  char gCheckboxActivateDeactivatePnC[15] = "CheckBoxEV1PnC";
  char gCanvasInstallCert[20] = "ButtonEVCertInstall";
  char gCanvasUpdateCert[20] = "ButtonEVCertUpdate";
  char gCheckBoxDIN[22] = "RadioButtonEV1Schema4";
  char gCheckBoxISO[22] = "RadioButtonEV1Schema3";
  char gCanvasRenegotiate[19] = "Renegotiate Button";
  char gCanvasReset[19] = "Reset Button";
  char gCheckBoxACBasic[28] = "RadioButtonEV1SchemaACBasic";
  
  char gCheckBoxACPhaseL1[20] = "CheckBoxACPhaseL1";
  char gCheckBoxACPhaseL2[20] = "CheckBoxACPhaseL2";
  char gCheckBoxACPhaseL3[20] = "CheckBoxACPhaseL3";
  char gCheckBoxACPhaseN[20] = "CheckBoxACPhaseN";
  
  int certificateServiceRequested = 0;    // 1 = installation, 2 = update
  int serviceDetailRequests = 0;
  
  char gProtocolPanelName[9] = "Protocol";
  char DCStatusCode[32];

  int isConnected = 0;
  int isPowerOn = 0;
  int chargeLoopEntered = 0;
  int isDCMode = 0;
  int isPassiveMode = 0;
  int reNegotiationRequested = 0;
  int reNegotiationRunning = 0;
  int isReset = 0;
  
  msTimer tMessageTx;
  msTimer tVerification;
  msTimer tProcessingTime;
  msTimer tStartSimulationDelay; //Start Simulation Delay after Plug-In
  msTimer tResume;
  msTimer tSECCDiscoveryMaxDelay;  
  
  const int cSECCDiscoveryMaxDelay = 5000;
    
  int processing = 0;
  int processingFinished = 0;
  
  // CableCheck loop
  int cableCheckStep = 0;
  
  // PreCharge loop
  int preChargeStep = 0; // to control connector close
  
  // VT access  
  int MSGreaction = 0;
  int nextStateChange_IECrelevant = 0;
  
  msTimer tOpenContactors;
  const cOpenContactorsDelay = 500;
  const cAdditionalMeasurementStopDelay = 100;
  
  msTimer tActionsAfterContactorOpen;
  const dword cActionsAfterContactorOpenDelay = 100;
  
  const dword cDeferStopDelay = 7500; // Maximum time to reach connector unlatched acc. Table AA.18 in IEC 61851-23:2023
  int deferStop_called = 0;
  
  msTimer tCurrentReduction;
  const cCurrentReductionDelay = 100;
  
  msTimer tDisableACPowerSupply;
  const cDisableACPowerSupplyDelay = 100; // must be less than 250ms
  
  msTimer tBasicChargingUpdate;
  const cBasicChargingUpdateDelay = 200;
  
  msTimer tPhaseSelection;
  const cPhaseSelectionDelay = 3000;
  
  int Protocol;
  
  msTimer tResetPhaseLoss_Step1;
  msTimer tResetPhaseLoss_Step2;
  
  int StopChargingRunning = 0;
  
  int gEVBasicChargingEnabled = 0;
  
  const double cHVControlMinumumCurrent = 0.5;
  
  // VAS FirePreventing
  long connection = 0;
  byte  sessionIpv6Addr[16];
  dword sessionPort;
  struct ConnectionData {
    byte  ipv6Addr[16];
    dword port;
  };
  
  struct ConnectionData socketMap[long];
  /*
| Group | Num   | Description                     | T     | L(Byte) | L(Value)         | Resolution | Default value | Min value | Max value     | Unit |
|-------|-------|---------------------------------|-------|---------|------------------|------------|--------------|-----------|----------------|------|
| A     | 1-1   | TimeStamp                       | 0xA1  | 1       | 0x04             |            |              |           |                | UTC  |
| A     | 1-2   | SessionDuration                 | 0xB1  | 1       | 0x04             |            |              |           |                |      |
| A     | 1-3   | Counter                         | 0xC1  | 1       | 0x02             |            |              |           |                |      |
| B     | 2-1   | VIN                             | 0xA2  | 1       | 0x11             | ASCII      | 0x00         |           |                |      |
| B     | 2-2   | BatteryID                       | 0xB2  | 1       | 0x01~0xFF        | ASCII      | 0x00         |           |                |      |
| B     | 2-3   | EncryptedVIN                    | 0xC2  | 1       | 0x01~0xFF        |            | 0x00         |           |                |      |
| C     | 3     | SoC                             | 0xA3  | 1       | 0x01             | 0.5        | 0xFF         | 0         | 200 (100%)     | %    |
| D     | 4     | SoH                             | 0xA4  | 1       | 0x01             | 1          | 0xFF         | 0         | 100 (100%)     | %    |
| E     | 5     | Battery pack current            | 0xA5  | 1       | 0x02             | 0.1        | 0xFFFF       | 0         | 65000 (6500A)  | A    |
| F     | 6     | Battery pack voltage            | 0xA6  | 1       | 0x02             | 0.1        | 0xFFFF       | 0         | 65000 (6500V)  | V    |
| G     | 7-1   | Battery cell voltage (All)      | 0xA7  | 2       | 0x0001~0xFFFF    | 0.02       | 0xFF         | 0         | 255 (5.1V)     | V    |
| G     | 7-2   | Battery cell voltage (Max/Min)  | 0xB7  | 1       | 0x02             | 0.02       | 0xFF         | 0         | 255 (5.1V)     | V    |
| H     | 8-1   | Battery temperature (All)       | 0xA8  | 1       | 0x01~0xFF        | 1          | 0xFF         | 0 (-40C)  | 255 (214C)     | C    |
| H     | 8-2   | Battery temperature (Max/Min)   | 0xB8  | 1       | 0x02             |            | 0xFF         | 0 (-40C)  | 255 (214C)     | C    |
  */
  byte gBatteryData[65834]; 
  
  msTimer timer_batteryData; 
  
  int gSessionDuration;
  int gSessionCounter;
  int gIsFirstBatteryDataTransmitted;
  int gTransmittedEndOfChargingBatteryData;
  long gLastTransmittedSoH;
  word gLastTransmittedBatteryPackCurrent;
  word gLastTransmittedBatteryPackVoltage;
  
  int cTcpConnectTimeoutMs = 3000;
  msTimer timer_TcpConnect;
}

on sysvar EV_Sim::Control::SysEV_Connected
{
  if (@this == 1)
  {
    // Set TLS state - request TLS only for ISO15118 when the "TLS" option is checked
    if ((@sysVar::Common::SysTLSEnabled) && @sysVar::EV_Sim::Control::SysEV_Schema != sysVar::EV_Sim::Control::SysEV_Schema::DIN70121)
    {
      SCC_SetTLSEnabled(1);
    }
    else
    {
      SCC_SetTLSEnabled(0);
    }
    
    setTimer(tStartSimulationDelay, 3000); // Instead of SCC_StartSimulation() immediately; can be increased if Duty Cycle is not detected within this timer
    
    @sysVar::EV_Sim::SysEV_State = 0;    
    @sysVar::EV_Sim::SysEV_Error = 0;
    
    SCC_SLAC_SetLinkStatus(0);
    @sysVar::EV_Sim::SysEV_LinkStatus = 0;      
    
    if (@sysvar::EV_Sim::Control::SysEV_CertificateInstallation)
    {
      certificateServiceRequested = 1;
      @sysVar::EV_Sim::Control::SysEV_CertificateUpdate = 0;
    }  
    else if (@sysvar::EV_Sim::Control::SysEV_CertificateUpdate)
    {
      certificateServiceRequested = 2;
      @sysVar::EV_Sim::Control::SysEV_CertificateInstallation = 0;      
    }
    
    CP_EV_SetCPStateB();
    CP_EV_set_Open_Circuit(1);
    PP_EV_set_open_circuit(1);
    
    if(@sysvar::Common::SysUserChargingMode == sysvar::Common::SysUserChargingMode::AC &&
       @sysvar::EV_Sim::Control::SysUserChargingCommunication == sysvar::EV_Sim::Control::SysUserChargingCommunication::LLC)
      gEVBasicChargingEnabled = 1;
  }
  else
  {    
    SCC_StopSimulation();
  
    @sysVar::EV_Sim::Control::SysEV_CertificateInstallation = 0;
    @sysVar::EV_Sim::Control::SysEV_CertificateUpdate = 0;    
    @sysVar::EV_Sim::SysEV_LinkStatus = 2;
    @sysVar::EV_Sim::SysEV_TargetCurrent = 1;
    @sysVar::EV_Sim::SysEV_TargetCurrent_AC = 1;
    certificateServiceRequested = 0;
    
    if(@sysvar::VT_Control::IEC61851_State_EV == sysvar::VT_Control::IEC61851_State_EV::State_C ||
     @sysvar::VT_Control::IEC61851_State_EV == sysvar::VT_Control::IEC61851_State_EV::State_D)
    {
      StopCharging();
    }
    
    if(StopChargingRunning == 0)
    {
      CP_EV_set_Open_Circuit(0); // open CP
    
      if(HV_ContactorsState() == 1)
        setTimer(tOpenContactors, 1); // immediatly try to open contactors
    }
    
    gEVBasicChargingEnabled = 0;
  }
    
  EnableSchemaControls(!@this);
  
  @sysVar::EV_Sim::Control::SysEV_WaitResume = 0;
    
  ReadEVStatus();
  UpdateSimState();
  
  // VT access
  @sysvar::EV_Sim::VT_Access::SysEV_S2close = 0;
}

on sysvar EV_Sim::Control::SysEV_Reset
{
  if (@this == 0)
    return;
  
  isReset = 1;
  
  StopCharging();
  gSessionDuration = 0;
  gSessionCounter = 0;
  gIsFirstBatteryDataTransmitted = 1;
  gTransmittedEndOfChargingBatteryData = 0;
  gLastTransmittedSoH = 0;
  gLastTransmittedBatteryPackCurrent = 0;
  gLastTransmittedBatteryPackVoltage = 0;
}

on sysvar EV_Sim::Control::SysEV_Stop
{
  if (@this == 1)
  {
    if((@sysvar::Common::SysUserChargingMode == sysvar::Common::SysUserChargingMode::AC && @sysvar::EV_Sim::Control::SysUserChargingCommunication == sysvar::EV_Sim::Control::SysUserChargingCommunication::HLC) ||
       (@sysvar::Common::SysUserChargingMode == sysvar::Common::SysUserChargingMode::DC))
    {
      // Shutdown and send "Terminate"
      if(chargeLoopEntered)
        SCC_Shutdown(1); // only has an effect when in charge loop
      else
      {
        StopCharging();
        SCC_StopSimulation();
      }
    }
    else if(@sysvar::Common::SysUserChargingMode == sysvar::Common::SysUserChargingMode::AC && @sysvar::EV_Sim::Control::SysUserChargingCommunication == sysvar::EV_Sim::Control::SysUserChargingCommunication::LLC)
    {
      StopBasicCharging();
    }
  }
}

void StopBasicCharging()
{
  gEVBasicChargingEnabled = 0;
  StopCharging();
}

on sysvar EV_Sim::Control::SysEV_Renegotiate
{
  if (@this == 1)
  {    
    SCC_StartRenegotiation();
    reNegotiationRequested = 1;
  }
}

on sysvar EV_Sim::Control::SysEV_CertificateInstallation
{
  if (@this == 1)
  {
    certificateServiceRequested = 1;
    @sysVar::EV_Sim::Control::SysEV_CertificateUpdate = 0;
  }
}

on sysvar EV_Sim::Control::SysEV_CertificateUpdate 
{
  if (@this == 1)
  {
    certificateServiceRequested = 2;
    @sysVar::EV_Sim::Control::SysEV_CertificateInstallation = 0;
  }
}

on sysvar VT_Control::IEC61851_State_EV
{
  if(@sysvar::VT_Control::IEC61851_State_EV == sysvar::VT_Control::IEC61851_State_EV::State_C && @sysVar::EV_Sim::SysEV_State == 6 /*ChargeParameterDiscovery*/)
   ResumeSimulation();
}

on start
{
  writeTab = WriteCreate("SCC EV");    // same name as tab created by nodelayer

  EnableSchemaControls(!@sysvar::EV_Sim::Control::SysEV_Connected);
  SetCertificateControlsVisible(@sysvar::EV_Sim::Control::SysEV_PnCEnabled);
  
  @sysVar::EV_Sim::SysEV_Error = 0;
  
  InitSimulation();
  PrintEthernetSettings("EV");  
  AdaptPanelToSchema();
  SetRequiredSelectedElements();

  iTemp1 = sysGetVariableInt(sysvar::EV_Sim::Control::SysEV_Connected);
  
  if (iTemp1 == 1)
  {
    SCC_StartSimulation(); 
  }
  else
    SCC_StopSimulation();
  
  ST_Init();
  CP_EV_set_Open_Circuit(0);
  
  HV_set_AC_relays(0);
  HV_source_set_output(0);
  PP_EV_set_open_circuit(0);
  
  OnStartPhaseControl();
  
  gEVBasicChargingEnabled = 0;
  
  SetControlElementVisibilityChargingMode();
  gSessionDuration = 0;
  gSessionCounter = 0;
  gIsFirstBatteryDataTransmitted = 1;
  gTransmittedEndOfChargingBatteryData = 0;
  gLastTransmittedSoH = 0;
  gLastTransmittedBatteryPackCurrent = 0;
  gLastTransmittedBatteryPackVoltage = 0;
}

void InitSimulation()
{ 
  int i;
  
  UpdateSelectedSchema();    
  ApplyMessageDelay();
  UpdateSimState();
  isReset = 0;
  firePreventingServiceIndex = -1;
  for (i = 0; i < 16; i++) {
    sessionIpv6Addr[i] = 0;
  }
  sessionParameterSetCount=0;
}

on preStart
{
  if (@sysVar::Common::SysVerboseWrite)
    SCC_SetVerbosity(5);
  else
    SCC_SetVerbosity(2);

  @sysVar::EV_Sim::Control::SysEV_WaitResume = 0;
  
  UpdateSimState();
  deferStop_called = 0;
}

on sysvar_update EV_Sim::Control::SysEV_ClearBattery
{
  SCC_SetBatteryState(0.0);
  @sysVar::EV_Sim::SysEV_BatteryState = 0.0;
}

on sysVar Common::SysUserChargingMode
{
  if(@sysvar::Common::SysUserChargingMode == sysvar::Common::SysUserChargingMode::AC && gEVBasicChargingEnabled == 1)
    StopBasicCharging();
  
  SetChargingModeAndPaymentOption();
}

on sysvar EV_Sim::Control::SysEV_PnCEnabled
{
  SetChargingModeAndPaymentOption();  
  SetCertificateControlsVisible(@this);
}

double Get_BatteryVoltage()
{
  return @sysvar::EV_Sim::SysEV_TargetVoltage; 
}

double Get_TargetCurrent()
{
  return @sysvar::EV_Sim::SysEV_TargetCurrent;
}

double Get_TargetCurrentAC()
{
  return @sysvar::EV_Sim::SysEV_TargetCurrent_AC;
}

void SCC_MessageRxInd(byte SessionID[], dword MessageID)
{
  stack double actualVoltage;
  stack double allowedDeviationFromTargetVoltage;
  stack double batteryVoltage;

  char responseCodeString[50];
  SCC_GetResponseCodeString(responseCodeString);
  sysSetVariableString(sysvar::Common::LastReceivedResponseCode, responseCodeString);
  
  if( MessageID == PreChargeRes )
  {
    batteryVoltage = Get_BatteryVoltage();

    // wait for voltage adjustment from EVSE
    if( 2 == preChargeStep ) 
    {
      actualVoltage = HV_measure_DC_U_VeriVolt();
      allowedDeviationFromTargetVoltage = 20;
      if( (batteryVoltage - allowedDeviationFromTargetVoltage < actualVoltage) 
          && (actualVoltage < batteryVoltage + allowedDeviationFromTargetVoltage))
      {
        // close contactors
        HV_source_set_output(1);
        preChargeStep = 3; // do not repeat
      }      
    }

  }
  
  if( MessageID == ChargeParameterDiscoveryRes ) 
  {
    cableCheckStep = 0;
  
    if((@Common::SysUserChargingMode == @Common::SysUserChargingMode::DC) && (0 == SCC_GetProcessing()))
    {
        //[V2G2-912] change and wait for cp state c or d before sending cable check request
        //simulation will be resumed after changing to c or d
        SuspendSimulation();
        CP_EV_SetCPStateC(); 
      
        if(isSimulated())
          setTimer(tResume, 100);
    }
  }
  
  SetLastMessageID(MessageID);
}


void SCC_MessageTxInd( byte SessionID[], dword MessageId, long Error)
{
  stack double actualVoltage;
  stack double allowedDeviationFromTargetVoltage;
  stack double batteryVoltage;
  
  /*
  WriteLineEx(writeTab, 0, "EV: Message Tx: Session Id = %0X%0X%0X%0X%0X%0X%0X%0X, result = %i",
    SessionID[0], SessionID[1], SessionID[2], SessionID[3], SessionID[4], SessionID[5], SessionID[6], SessionID[7],
    error
  );
  */
  
  // VT Access
  // IEC61851 Synchronization (only relevant for AC charging, because for DC we react to the response)
  //-------------------------------------------------------------------------------------------------------
  if (MSGreaction) 
  {
    // AC charging and no ReNegotiation
    if (@sysvar::Common::SysUserChargingMode == @Common::SysUserChargingMode::AC & @sysvar::EV_Sim::Control::SysEV_Renegotiate == 0)
    {
      // entering charge loop --> close S2
      if (!isPowerOn)
        @sysvar::EV_Sim::VT_Access::SysEV_S2close = 1;
    }
  }
  MSGreaction = 0;
  
  //----------------------------------------------------------------------------------------------
  
  // set current before PSU is potentially enabled or disabled below
  if(MessageId == ChargingStatusReq)
  {
    stack double targetCurrent, maxHVcurrent = 0;

    targetCurrent = Get_TargetCurrentAC();
    maxHVcurrent = HV_source_get_max_I_AC();
    
    targetCurrent = _min(targetCurrent, maxHVcurrent);
    
    HV_source_set_I_L1_rms(targetCurrent);
    HV_source_set_I_L2_rms(targetCurrent);
    HV_source_set_I_L3_rms(targetCurrent);
  }

  if(@Common::SysUserChargingMode == @Common::SysUserChargingMode::AC)
  {
    if(MessageId == PowerDeliveryReq)
    {
      // note: SCC_GetChargeProgress will only return 0 or 1 if a PowerDeliveryReq has been sent
      if(SCC_GetChargeProgress() == 1 /*Start*/)
      {
        CP_EV_SetCPStateC();
      }
      else if(SCC_GetChargeProgress() == 0 /*Stop*/)
      {
        StopCharging();
      }
    }
  }
  else //dc charging
  {
    if(MessageId == CableCheckReq) 
    {
      if( 0 == cableCheckStep)
      {
        if( !CTS_EV_get_connector_lock_state() ) 
        {  
          // Terminate execution if plug not locked
          @sysvar::EV_Sim::Control::SysEV_Stop = 1;
          WriteLineEx(writeTab, 3, "EV: Plug not locked!");
          return;
        }
        
        CP_EV_SetCPStateC(); //[V2G2-912] change and wait for cp state c or d before sending cable check request
      }

      cableCheckStep = 1;
      preChargeStep = 0;
    }
  }

  if(MessageId == PreChargeReq)
  {
    batteryVoltage = Get_BatteryVoltage();
    
    // enable PSU and set battery voltage
    if( 0 == preChargeStep) 
    {
      HV_PSU_DC_enable(1);
      HV_source_set_I_DC(1.0);
      HV_source_set_U_DC(batteryVoltage);
      preChargeStep = 1;
    }
    
    // wait for battery voltage reached
    if( 1 == preChargeStep ) 
    {
      actualVoltage = HV_measure_DC_U();
      allowedDeviationFromTargetVoltage = 1;      
      if( (batteryVoltage - allowedDeviationFromTargetVoltage < actualVoltage) 
          && (actualVoltage < batteryVoltage + allowedDeviationFromTargetVoltage))
      {
        preChargeStep = 2;
      }
    }
  }
  else if(MessageId == CurrentDemandReq)
  {
    HV_source_set_I_DC(Get_TargetCurrent());
    HV_source_set_U_DC(Get_BatteryVoltage());
  }
  
  if(MessageId == WeldingDetectionReq)
    HV_source_perform_welding();
  
  if(MessageId == PowerDeliveryReq)
    @sysvar::Common::ChargeProgress = SCC_GetChargeProgress();
  
  if(MessageId == PowerDeliveryReq && SCC_GetChargeProgress() == 0 /*Stop*/ )
  {
    if( @sysvar::Common::SysUserChargingMode && abs(HV_measure_DC_I()) < 5 )
    {
      EnableIsolationMonitoring();
    }
  }

  if( MessageId == WeldingDetectionReq || MessageId == SessionStopReq )
  {
    StopCharging();
    
    EnableIsolationMonitoring();
  }
  
  if(MessageId == CmSLACParamReq && isSimulated())
    SCC_SLAC_SetLinkStatus(0);  //avoid link status problem within restart
  
  @sysvar::EV_Sim::SysEV_MessageTx = 1;
  setTimer(tMessageTx, 150);
  
  if (Error > 0)
    WriteLineEx(writeTab, 2, "EV: Message sending of type %0x failed: %i", MessageId, Error); 
}

on timer tStartSimulationDelay
{
  if(gEVBasicChargingEnabled == 0)
    SCC_StartSimulation();
}

on timer tMessageTx
{  
  @sysvar::EV_Sim::SysEV_MessageTx = 0;
}

on timer tVerification
{
  setControlVisibility(gPanelName, "Verification", 0);
}

on timer tSECCDiscoveryMaxDelay
{ 
  SCC_SLAC_SetLinkStatus(1);
  @sysVar::EV_Sim::SysEV_LinkStatus = SCC_SLAC_GetLinkStatus(); 
}

on timer tProcessingTime
{ 
  processingFinished = 1;
}

on timer tResume
{
  SCC_SimulationResume();
}

SCC_ErrorStateInd( byte sessionId[], long errorState)
{  
  @sysVar::EV_Sim::SysEV_Error = errorState;
}

on timer tOpenContactors
{
  if(abs(HV_measure_DC_I()) > 5)
  {
    HV_source_set_U_DC(Get_BatteryVoltage());
    HV_reduce_Current();
    setTimer(tOpenContactors, cOpenContactorsDelay);
  }
  else if(abs(HV_measure_AC_I_L1_rms()) > 1 || abs(HV_measure_AC_I_L2_rms()) > 1 || abs(HV_measure_AC_I_L3_rms()) > 1)
  {
    HV_reduce_Current();
    setTimer(tOpenContactors, cOpenContactorsDelay);
  }
  else
  {
    HV_OpenContactors();
    setTimer(tActionsAfterContactorOpen, cActionsAfterContactorOpenDelay);
  }
}

void HV_reduce_Current()
{
  HV_source_set_I_DC(cHVControlMinumumCurrent);
  
  HV_source_set_I_L1_rms(0);
  HV_source_set_I_L2_rms(0);
  HV_source_set_I_L3_rms(0);
}

void HV_OpenContactors()
{    
  HV_source_set_output(0); // contactors
  HV_set_AC_relays(0);
}

void HV_ActionsAfterContactorOpen()
{
  HV_source_set_I_DC(0);
  HV_source_set_U_DC(0);
  
  CP_EV_set_Open_Circuit(0);
    
  EnableIsolationMonitoring();
    
  PP_EV_set_open_circuit(0);
  
  ST_Reset();
}

on timer tActionsAfterContactorOpen
{
  HV_ActionsAfterContactorOpen();
  
  if(isReset)
    OnReset();
  
  StopChargingRunning = 0;
  
  if(deferStop_called == 1 && CTS_EV_get_connector_lock_state() == 0)
  {
    CompleteStop();
    deferStop_called = 0;
  }
}

SCC_RestartInd( byte sessionID[] )
{
  WriteLineEx(writeTab, 1, "EV: Restarting protocol, retries left: %d", SCC_GetRetriesLeft());
}

SCC_LinkStatusChangeInd( dword oldStatus, dword newStatus)
{
  // Note: this indication is only received when polling is enabled
  WriteLineEx(writeTab, 1, "EV: Link status changed from %i to %i", oldStatus, newStatus);
  @sysVar::EV_Sim::SysEV_LinkStatus = newStatus;
}

// generic host indication for all supported PLCs
void SCC_Generic_VS_HostMessage_Ind( byte sourceMacAddess[], dword hostMessage )
{
  // Device is ready to communicate on power line but may not be a member of an AVLN yet. 
  const byte PLC_READY_TO_JOIN_AVLN = 0x01;
  // Device is ready to communicate on power line but may not be a member of an AVLN yet. 
  const byte PLC_AVLN_JOINED = 0x02;
  // Device is disconnected from  an AVLN and there are no peers available. 
  const byte PLC_AVLN_DISCONNECTED = 0x03;  
  
  if (hostMessage == PLC_AVLN_JOINED)
  {
    @sysVar::EV_Sim::SysEV_LinkStatus = 1;
    SCC_SLAC_SetLinkStatus(1);
    cancelTimer(tSECCDiscoveryMaxDelay);
  }
  else
  {
    @sysVar::EV_Sim::SysEV_LinkStatus = 0;
    SCC_SLAC_SetLinkStatus(0);
  } 
  
  WriteLineEx(writeTab, 1, "EV: Link status changed to %i", @sysVar::EV_Sim::SysEV_LinkStatus);
}


SCC_SLACFinishedInd( dword result)
{
  float resultBuffer[16];
  long  resultCount = 0;
  int i;
  
  if (result)
    WriteLineEx(writeTab, 1, "EV: SLAC finished, result : OK");
  else
    WriteLineEx(writeTab, 1, "EV: SLAC finished, result : FAILED");
  
  if (result) // SLAC finished successfully
  {
    // Get and print attenuation values
    SCC_SLAC_GetAttenResults(resultBuffer, resultCount);
    
    if (resultCount > 0)
      WriteLineEx(writeTab, 1, "EV: %i EVSEs found, results sorted by attenuation are:", resultCount);
    else
      WriteLineEx(writeTab, 2, "EV: No EVSEs found");
    
    for (i = 0; i< resultCount; ++i)
    {
      WriteLineEx(writeTab, 1, "EVSE %i: %f db", i+1, resultBuffer[i]);
    }

    if (isSimulated())
    {
      SCC_SLAC_SetLinkStatus(1);
      @sysVar::EV_Sim::SysEV_LinkStatus = SCC_SLAC_GetLinkStatus(); 
      WriteLineEx(writeTab, 1, "EV: Set simulated link status = 1");
    }
    else
    {
      setTimer(tSECCDiscoveryMaxDelay, cSECCDiscoveryMaxDelay);
      WriteLineEx(writeTab, 1, "EV: Waiting for link status from chip = 1");
    }
  }
}

SCC_StateTransitionInd( byte sessionId[], dword oldState, dword newState)
{
  SCC_GetStateName(newState, strBuffer1, 100);
  
  WriteLineEx(writeTab, 1, "EV: Entering state \"%s\"", strBuffer1);
  
  // Map state machine's state to protocol bar
  // Note: For the definition of the state IDs, see appendix section of the manual
  
  // Special handling for charge loop init
  if ( (newState == 8 && oldState < 8)
    || (newState == 10 && oldState == 101)
    || (newState == 100 && oldState == 7))
  {
    @sysVar::EV_Sim::SysEV_State = 7; 
    return;
  }
  
  switch (newState)
  {
    case 0:
      // Nothing
      @sysVar::EV_Sim::SysEV_State = 0; break;
    case 1:
      // Session Setup
      @sysVar::EV_Sim::SysEV_State = 2; break;
    case 2:
    case 3:
      // Service Discovery
      @sysVar::EV_Sim::SysEV_State = 3; break;
    case 4:
      // Service Payment Sel
      @sysVar::EV_Sim::SysEV_State = 4; break;
    case 5:
    case 6:
    case 16:
    case 17:
      // Payment / Authorization
      @sysVar::EV_Sim::SysEV_State = 5; break;
    case 7:
      // Charge Par Discovery / Renegotiation
      @sysVar::EV_Sim::SysEV_State = 6; break;
    case 11:
    case 12:
    case 101:
      // Charge Loop Init
      @sysVar::EV_Sim::SysEV_State = 7; break;
    case 9:
    case 10:
    case 13:
    case 102:
    case 103:
      // Charge Loop
      chargeLoopEntered = 1;
      @sysVar::EV_Sim::SysEV_State = 8; break;
    case 14:
    case 15:
    case 104:
      // Stop Charging
      @sysVar::EV_Sim::SysEV_State = 9; break;   
  }
}

SCC_TCPConnectInd( dword socket, long isSender)
{
  if (isSender)
    WriteLineEx(writeTab, 1, "EV: TCP connection established on socket %i", socket);
  else    // cannot happen here
    WriteLineEx(writeTab, 1, "EV: TCP client connected to socket %i", socket);
  
  cancelTimer(timer_TcpConnect);
}

SCC_TCPShutdownInd( dword socket, long isSender)
{
  if (isSender)
    WriteLineEx(writeTab, 1, "EV: TCP connection on socket %i closed", socket);
  else
    WriteLineEx(writeTab, 1, "EV: TCP connection on socket %i was closed by remote station", socket);
  
  StopCharging();
}

SCC_InvalidMessageInd( long MessageType, long ErrorCode)
{  
  if (ErrorCode == 0)    
    WriteLineEx(writeTab, 1, "EV: Invalid message received - wrong version number or format!");
  else if (ErrorCode == 1)
    WriteLineEx(writeTab, 1, "EV: Invalid message received - unknown payload type!");
  else if (ErrorCode == 2)
    WriteLineEx(writeTab, 1, "EV: Invalid message received - invalid payload length!");
  else if (ErrorCode == 3)
    WriteLineEx(writeTab, 1, "EV: Invalid message received - decoding error");
}  

SCC_SignaturePreSendInd( byte sessionID[], dword messageId, byte signature[], dword& signatureLength)
{ 
  WriteLineEx(writeTab, 1, "EV: Signature of length %i created for Message ID = %d", signatureLength, messageId);
}

SCC_SignatureVerificationInd( dword messageID, dword result)
{
  setControlVisibility(gPanelName, "Verification", 1);
  setTimer(tVerification, 1000);
}

SCC_CertChainVerificationInd( byte SessionId[], char chainName[], dword Result )
{  
  int i;
  char certName[255];
  dword errorCode;
  
  if (Result > 0)
  {
    WriteLineEx(writeTab, 1 /* info */, "%s verified, result: OK", chainName);
  }
  else
  { 
    WriteLineEx(writeTab, 2 /* warning */, "%s verified, result: FAILED", chainName);
    
    for (i = 0; i < SCC_GetCertChainVerificationErrorCount(); ++i)
    {
      SCC_GetCertChainVerificationError(i, certName, errorCode);      
      WriteLineEx(writeTab, 2 /* warning */, "  Error %i was found in certificate %s", errorCode, certName );
    }
  }
}

SCC_ConnectionTimeoutInd( byte sessionId[] )
{  
  WriteLineEx(writeTab, 2, "EV: Connection closed due to inactivity. Closing VAS connection.");
  cancelTimer(timer_batteryData);
  CloseAllClientConnections();
}

SCC_V2G_EVCC_Msg_TimeoutInd( byte RunId[], dword MessageID)
{
  writeLineEx(writeTab, 0, "V2G_EVCC_Msg_TimeoutInd for message %i indication", MessageID);
}

SCC_V2G_EVCC_PreCharge_TimeoutInd( byte RunId[] )
{
  writeLineEx(writeTab, 0, "V2G_EVCC_PreCharge_Timeout indication");
}

SCC_V2G_EVCC_CableCheck_TimeoutInd( byte RunID[] )
{
  writeLineEx(writeTab, 0, "V2G_EVCC_CableCheck_Timeout indication");
}

SCC_ProtocolFinishedInd( byte sessionId[] )
{
  WriteLineEx(writeTab, 1, "EV: Protocol finished, closing VAS connection!");
  cancelTimer(timer_batteryData);
  CloseAllClientConnections();
}

void ReadEVStatus()
{
  @sysVar::EV_Sim::SysEV_BatteryState = SCC_GetBatterySoC();

  // Print DC status code 
  strncpy(DCStatusCode, "                                 ", 32);
  SCC_GetDCStatusCode(DCStatusCode);
  SysSetVariableString(sysVar::EV_Sim::SysEV_DCStatusCode, DCStatusCode);
}

void UpdateSimState()
{
  lTemp = SCC_GetSimulationState();
    
  if (lTemp == 2)
    @sysvar::EV_Sim::SysEV_SimState = 0;
  else if (lTemp == 3)
    @sysvar::EV_Sim::SysEV_SimState = 1;
  else
    @sysvar::EV_Sim::SysEV_SimState = 2;    
}


void SetPlugLockedStatus(int status)
{
  enableControl(gPanelName, "PowerPlugSwitch", status);
  setControlVisibility(gPanelName, "LockSymbol", !status);
}


export void ResumeSimulation()
{
  if ( (@sysvar::EV_Sim::Control::SysEV_Connected == 1) && (SCC_GetSimulationState() == 3 /*waiting*/) )
  {
    SCC_SimulationResume();
  }
}

export void SuspendSimulation()
{
  SCC_SimulationWait();
}

void ApplyChargeLoopInterval()
{
  dTemp1 = @sysvar::EV_Sim::Control::SysEV_ChargeLoopInterval;
  lTemp2 = @sysvar::EV_Sim::Control::SysEV_ChargeLoopIntervalJitter;
  
  if (lTemp2 == 0)
    SCC_SetChargeLoopInterval(dTemp1);  // jitter off
  else
    SCC_SetChargeLoopInterval(dTemp1, 5.0);  // jitter on with 5%
}

SetChargingModeAndPaymentOption()
{
  if (@sysVar::Common::SysUserChargingMode == @Common::SysUserChargingMode::AC)    // AC mode
  { 
    if(@sysvar::EV_Sim::Control::SysEV_Schema == sysvar::EV_Sim::Control::SysEV_Schema::ISO15118) 
    {
      SCC_SetEnergyTransferType("AC_single_phase_core", 0 /* not forced */);
      
      isDCMode = 0;
    }
    else
    {
      @sysVar::Common::SysUserChargingMode = @Common::SysUserChargingMode::DC;   
    }
  }
  else  // DC mode
  {
    // DC_core and DC_extended can be switched using the panel    
    if (@sysVar::EV_Sim::Control::SysEV_DCChargingMode == 1)
      SCC_SetEnergyTransferType("DC_core", 0 /* not forced */);
    else
      SCC_SetEnergyTransferType("DC_extended", 0 /* not forced */);

    isDCMode = 1;
  }
  
  if(@sysvar::EV_Sim::Control::SysEV_Schema == sysvar::EV_Sim::Control::SysEV_Schema::ISO15118)
  {
    // Preferred Payment Option (hint: set second parameter to 1 for forced selection)
    if(@sysVar::EV_Sim::Control::SysEV_PnCEnabled == 1)
      SCC_SetPaymentOption("Contract", 0);
    else
      SCC_SetPaymentOption("ExternalPayment", 0);
  }
}

HandleMessageGeneric( int responseCode)
{    
  long maxDelay;
  
  CheckFaultNotification();
  
  SCC_GetEVSENotification(strBuffer1, maxDelay);
  
  if (strncmp(strBuffer1, "ReNegotiation", strlen("ReNegotiation")) == 0)
    reNegotiationRequested = 1;
 
  
  if (maxDelay > 0)
    WriteLineEx(writeTab, 0, "  NotificationMaxDelay: %i", maxDelay);
}

EnableSchemaControls( int enabled)
{
  enableControl(gPanelName, "RadioButtonEV1Schema1", enabled);
  enableControl(gPanelName, "RadioButtonEV1Schema2", enabled);
  enableControl(gPanelName, "RadioButtonEV1Schema3", enabled);
  enableControl(gPanelName, "RadioButtonEV1Schema4", enabled);
  enableControl(gPanelName, "CheckBoxEV1PNC", enabled);
  enableControl(gPanelName, "ButtonEVCertInstall", enabled);
  enableControl(gPanelName, "ButtonEVCertUpdate", enabled);
}

SetCertificateControlsVisible( int visible)
{
  // show certificate buttons only for PnC
  setControlVisibility(gPanelName, "ButtonEVCertInstall", visible);
  setControlVisibility(gPanelName, "ButtonEVCertUpdate", visible);
}

// [V2GBIP_M03_054]: Group G is fixed to 7-2, H is fixed tp 8-1
void SetRequiredSelectedElements()
{
  if(@sysvar::PanelControl::SysClientBatteryDataExchangeStrategy == @sysvar::PanelControl::SysClientBatteryDataExchangeStrategy::CASE_2)
  {
    @sysvar::PanelControl::SysClientSelectedElementGroupG = @sysvar::PanelControl::SysClientSelectedElementGroupG::MaxMinBatteryCellVoltages;
    @sysvar::PanelControl::SysClientSelectedElementGroupH = @sysvar::PanelControl::SysClientSelectedElementGroupH::AllBatteryTemperatures;
  }
}

on preStop
{  
  isReset = 1;
  firePreventingServiceIndex = -1;
  sessionParameterSetCount = 0;
  SCC_StopSimulation();
  CloseAllClientConnections();
  SetCertificateControlsVisible(1);
  @sysvar::PanelControl::Sys_ClientConnectionStatus = 0;
  deferStop_called = 1;
  deferStop(cDeferStopDelay);
  
  StopCharging();
}

on stopMeasurement
{
  if(abs(HV_measure_DC_I()>5))
  {
    write("Contactors not opened, current > 5A");
  }
}

on sysvar EV_Sim::Control::SysEV_Schema
{
  UpdateSelectedSchema();
  
  // set valid options for the selected schema
  if (@this == sysVar::EV_Sim::Control::SysEV_Schema::DIN70121)
  {
    @sysVar::Common::SysUserChargingMode = @Common::SysUserChargingMode::DC;
    @sysVar::EV_Sim::Control::SysEV_PnCEnabled = 0;
  }
  
  AdaptPanelToSchema();
}

UpdateSelectedSchema()
{
  switch (@sysvar::EV_Sim::Control::SysEV_Schema)
  {
    case sysvar::EV_Sim::Control::SysEV_Schema::ISO15118:
      SCC_SetSchema("urn:iso:15118:2:2013:MsgDef", 2, 0);
      break;
    case sysvar::EV_Sim::Control::SysEV_Schema::DIN70121:
      SCC_SetSchema("urn:din:70121:2012:MsgDef", 2, 0);
      break;
  }
}

on sysvar EV_Sim::Control::SysEV_WaitResume
{
  if(@this == 0)
  {
    SCC_SimulationResume();
    
    if(@sysvar::Common::SysUserChargingMode == sysvar::Common::SysUserChargingMode::AC &&
       @sysvar::EV_Sim::Control::SysUserChargingCommunication == sysvar::EV_Sim::Control::SysUserChargingCommunication::LLC)
    {
      gEVBasicChargingEnabled = 1;
      ControlBasicCharging();
    }
  }
  else
  {
    SCC_SimulationWait();
    
    if(@sysvar::Common::SysUserChargingMode == sysvar::Common::SysUserChargingMode::AC &&
       @sysvar::EV_Sim::Control::SysUserChargingCommunication == sysvar::EV_Sim::Control::SysUserChargingCommunication::LLC)
    {
      gEVBasicChargingEnabled = 0;
      HV_reduce_Current();
      setTimer(tCurrentReduction, cCurrentReductionDelay);
    }
  }
  
  UpdateSimState();
}

on timer tCurrentReduction
{
  if(HV_measure_AC_I_L1_rms() > 1 || HV_measure_AC_I_L2_rms() > 1 || HV_measure_AC_I_L3_rms() > 1)
  {
    HV_reduce_Current();
    setTimer(tCurrentReduction, cCurrentReductionDelay);
  }
  else
  {
    CP_EV_SetCPStateB();
    HV_PSU_AC_enable(0);
  }
}

on sysvar EV_Sim::SysEV_MaxPower
{
  SCC_SetMaxPower(@this * 1000);    // variable in [kW]
}

on sysvar EV_Sim::SysEV_MinCurrent
{
  SCC_SetMinCurrent(@this);
}

on sysvar EV_Sim::SysEV_MaxCurrent
{
  SCC_SetMaxCurrent(@this);
}

on sysvar EV_Sim::SysEV_MaxVoltage
{
  SCC_SetMaxVoltage(@this);
}

on sysvar EV_Sim::SysEV_TargetVoltage
{
  SCC_SetTargetVoltage(@this);
}

on sysvar EV_Sim::SysEV_TargetCurrent
{
  SCC_SetTargetCurrent(@this);
}

on sysVar Common::SysMessageDelay
{
  ApplyMessageDelay();
}

on sysvar Common::SysMessageDelayJitter
{
  ApplyMessageDelay();
}

on sysvar EV_Sim::Control::SysEV_ChargeLoopInterval
{
  ApplyChargeLoopInterval();
}

on sysvar EV_Sim::Control::SysEV_ChargeLoopIntervalJitter
{
  ApplyChargeLoopInterval();
}

on sysvar Common::SysVerboseWrite
{  
  if (@this)
    SCC_SetVerbosity(5);
  else
    SCC_SetVerbosity(2);
}

void AdaptPanelToSchema()
{
  if(@sysvar::EV_Sim::Control::SysEV_Schema == sysvar::EV_Sim::Control::SysEV_Schema::ISO15118)
  {
    SetControlColors(gProtocolPanelName, "lblCertificate", MakeRGB(255,255,255), MakeRGB(0,0,0));
  }
  else if (@sysvar::EV_Sim::Control::SysEV_Schema == sysVar::EV_Sim::Control::SysEV_Schema::DIN70121)
  {
    SetControlColors(gProtocolPanelName, "lblCertificate", MakeRGB(255,255,255), MakeRGB(150,150,150));
  }
}

void StopCharging()
{
  if(StopChargingRunning == 1)
    return;
  
  StopChargingRunning = 1;
  
  if(@sysvar::PanelControl::SysClientBatteryDataExchangeStrategy == @sysvar::PanelControl::SysClientBatteryDataExchangeStrategy::CASE_2
    && gTransmittedEndOfChargingBatteryData == 0)
  {
    SendBatteryDataStartEndCharging();
    gTransmittedEndOfChargingBatteryData = 1;
  }
  
  if(@sysvar::Common::SysUserChargingMode == sysvar::Common::SysUserChargingMode::AC || @sysvar::EV_Sim::Control::SysUserChargingCommunication == @sysvar::EV_Sim::Control::SysUserChargingCommunication::LLC)
    StopACCharging();
  else
    StopDCCharging();
}

void StopDCCharging()
{
  @sysVar::EV_Sim::SysEV_TargetCurrent = 1;
  
  CP_EV_SetCPStateB();
  
  HV_source_set_U_DC(Get_BatteryVoltage());
  HV_reduce_Current();
  
  setTimer(tOpenContactors, cOpenContactorsDelay);
}

void StopACCharging()
{
  @sysVar::EV_Sim::SysEV_TargetCurrent_AC = 1;
  
  HV_reduce_Current();
  
  setTimer(tDisableACPowerSupply, cDisableACPowerSupplyDelay);
}

on timer tDisableACPowerSupply
{
  HV_PSU_AC_enable(0);
  CP_EV_SetCPStateB();
  setTimer(tOpenContactors, cOpenContactorsDelay);
}

void OnIMDStatusTimeout()
{
  // inform about IMD wasn't not muted
  WriteLineEx(writeTab, 3, "EV: Isolation monitor hasn't been muted!");
  // simulation is kept on hold
}

void OnInsolationMonitorStatus(long status)
{
  if( 0 == status ) 
  {
    ResumeSimulation();
  }
}

void OnDisconnect()
{
  @sysVar::EV_Sim::Control::SysEV_CertificateInstallation = 0;
  @sysVar::EV_Sim::Control::SysEV_CertificateUpdate = 0;    
  @sysVar::EV_Sim::SysEV_LinkStatus = 2;
  @sysVar::EV_Sim::SysEV_TargetCurrent = 1;
  @sysVar::EV_Sim::SysEV_TargetCurrent_AC = 1;
  certificateServiceRequested = 0;
  
  EnableSchemaControls(1);
    
  @sysVar::EV_Sim::Control::SysEV_WaitResume = 0;
      
  ReadEVStatus();
  UpdateSimState();
  
  if(@sysvar::VT_Control::IEC61851_State_EV == sysvar::VT_Control::IEC61851_State_EV::State_C ||
     @sysvar::VT_Control::IEC61851_State_EV == sysvar::VT_Control::IEC61851_State_EV::State_D)
  {
    StopCharging();
  }
  
  // VT access
  @sysvar::EV_Sim::VT_Access::SysEV_S2close = 0;
  
  if(StopChargingRunning == 0)
  {
    if(CP_EV_get_Open_Circuit() == 1)
      CP_EV_set_Open_Circuit(0); // open CP
  
    if(HV_ContactorsState() == 1)
      setTimer(tOpenContactors, 1); // immediatly try to open contactors
  }
  
  SCC_StopSimulation();
}

void OnLockedStatusChanged(int lockState)
{
  SetPlugLockedStatus(!lockState);
  if((deferStop_called)&&(!lockState))
  {
    CompleteStop();
    deferStop_called = 0;
    SetPlugLockedStatus(0); // Enable button again
  }
}

void OnReset()
{
  SCC_SimulationReset();
  CloseAllClientConnections();
  InitSimulation();
  cancelTimer(timer_batteryData);
  @sysVar::EV_Sim::Control::SysEV_WaitResume = 0;
  @sysVar::EV_Sim::Control::SysEV_Connected = 0;
  @sysVar::EV_Sim::Control::SysEV_CertificateInstallation = 0;
  @sysVar::EV_Sim::Control::SysEV_CertificateUpdate = 0;

  isReset = 0;
}

double GetInletPPResistance_Rv1()
{
  // VT7970 = 330
  return 330;
}

on sysvar EV_Sim::Control::SysUserChargingCommunication
{
  SetControlElementVisibilityChargingMode();
  
  if(gEVBasicChargingEnabled == 1 &&
     @sysvar::Common::SysUserChargingMode == sysvar::Common::SysUserChargingMode::AC &&
     @sysvar::EV_Sim::Control::SysUserChargingCommunication != sysvar::EV_Sim::Control::SysUserChargingCommunication::LLC)
    StopBasicCharging();
}

void SetControlElementVisibilityChargingMode()
{
  if(@sysvar::Common::SysUserChargingMode == sysvar::Common::SysUserChargingMode::AC &&
     @sysvar::EV_Sim::Control::SysUserChargingCommunication == sysvar::EV_Sim::Control::SysUserChargingCommunication::LLC)
  {
    setControlVisibility(gPanelName, gCheckboxActivateDeactivatePnC, 0);
    setControlVisibility(gPanelName, gCanvasInstallCert, 0);
    setControlVisibility(gPanelName, gCanvasUpdateCert, 0);
    setControlVisibility(gPanelName, gCheckBoxDIN, 0);
    setControlVisibility(gPanelName, gCheckBoxISO, 0);
    setControlVisibility(gPanelName, gCanvasRenegotiate, 0);
    setControlVisibility(gPanelName, gCanvasReset, 0);
  }
  else if(@sysvar::Common::SysUserChargingMode == sysvar::Common::SysUserChargingMode::DC)
  {
    setControlVisibility(gPanelName, gCheckboxActivateDeactivatePnC, 1);
    setControlVisibility(gPanelName, gCanvasInstallCert, 1);
    setControlVisibility(gPanelName, gCanvasUpdateCert, 1);
    setControlVisibility(gPanelName, gCheckBoxDIN, 1);
    setControlVisibility(gPanelName, gCheckBoxISO, 1);
    setControlVisibility(gPanelName, gCanvasRenegotiate, 1);
    setControlVisibility(gPanelName, gCanvasReset, 1);
    setControlVisibility(gPanelName, gCheckBoxACBasic, 0);
  }
  else
  {
    setControlVisibility(gPanelName, gCheckboxActivateDeactivatePnC, 1);
    setControlVisibility(gPanelName, gCanvasInstallCert, 1);
    setControlVisibility(gPanelName, gCanvasUpdateCert, 1);
    setControlVisibility(gPanelName, gCheckBoxDIN, 1);
    setControlVisibility(gPanelName, gCheckBoxISO, 1);
    setControlVisibility(gPanelName, gCanvasRenegotiate, 1);
    setControlVisibility(gPanelName, gCanvasReset, 1);
    setControlVisibility(gPanelName, gCheckBoxACBasic, 1);
  }
}

void OnStartPhaseControl()
{
  @sysvar::EV_Sim::Control::SysEV_AC_Phases = sysvar::EV_Sim::Control::SysEV_AC_Phases::ThreePhase;
  @sysvar::EV_Sim::Control::SysEV_AC_Phases_L1_Enabled = 1;
  @sysvar::EV_Sim::Control::SysEV_AC_Phases_L2_Enabled = 1;
  @sysvar::EV_Sim::Control::SysEV_AC_Phases_L3_Enabled = 1;
  @sysvar::EV_Sim::Control::SysEV_AC_Phases_N_Enabled = 1;
  
  enableControl(gPanelName, gCheckBoxACPhaseL1, 0);
  enableControl(gPanelName, gCheckBoxACPhaseL2, 0);
  enableControl(gPanelName, gCheckBoxACPhaseL3, 0);
  enableControl(gPanelName, gCheckBoxACPhaseN, 0);
  
  setTimer(tResetPhaseLoss_Step1, 10);
}

on timer tResetPhaseLoss_Step1
{
  HV_source_set_L2_PhaseLoss(1);
  HV_source_set_L3_PhaseLoss(1);
  
  setTimer(tResetPhaseLoss_Step2, 10);
}

on timer tResetPhaseLoss_Step2
{
  HV_source_set_L2_PhaseLoss(0);
  HV_source_set_L3_PhaseLoss(0);
}

on sysvar sysvar::EV_Sim::Control::SysEV_AC_Phases
{
  if(@this == sysvar::EV_Sim::Control::SysEV_AC_Phases::CustomPhase)
  {
    enableControl(gPanelName, gCheckBoxACPhaseL2, 1);
    enableControl(gPanelName, gCheckBoxACPhaseL3, 1);
  }
  else if(@this == sysvar::EV_Sim::Control::SysEV_AC_Phases::SinglePhase &&
          (@sysvar::EV_Sim::Control::SysEV_AC_Phases_L2_Enabled == 0 && @sysvar::EV_Sim::Control::SysEV_AC_Phases_L3_Enabled == 0))
  {
    enableControl(gPanelName, gCheckBoxACPhaseL2, 0);
    enableControl(gPanelName, gCheckBoxACPhaseL3, 0);
  }
  else if(@this == sysvar::EV_Sim::Control::SysEV_AC_Phases::SinglePhase &&
         (@sysvar::EV_Sim::Control::SysEV_AC_Phases_L2_Enabled == 1 || @sysvar::EV_Sim::Control::SysEV_AC_Phases_L3_Enabled == 1))
  {
    @sysvar::EV_Sim::Control::SysEV_WaitResume = 1;
    enableControl(gPanelName, gCheckBoxACPhaseL2, 1);
    enableControl(gPanelName, gCheckBoxACPhaseL3, 1);
    @sysvar::EV_Sim::Control::SysEV_AC_Phases_L2_Enabled == 0;
    @sysvar::EV_Sim::Control::SysEV_AC_Phases_L3_Enabled == 0;
    enableControl(gPanelName, gCheckBoxACPhaseL2, 0);
    enableControl(gPanelName, gCheckBoxACPhaseL3, 0);
  }
  else if(@this == sysvar::EV_Sim::Control::SysEV_AC_Phases::ThreePhase &&
          (@sysvar::EV_Sim::Control::SysEV_AC_Phases_L2_Enabled == 1 && @sysvar::EV_Sim::Control::SysEV_AC_Phases_L3_Enabled == 1))
  {
    enableControl(gPanelName, gCheckBoxACPhaseL2, 0);
    enableControl(gPanelName, gCheckBoxACPhaseL3, 0);
  }
  else if(@this == sysvar::EV_Sim::Control::SysEV_AC_Phases::ThreePhase &&
          (@sysvar::EV_Sim::Control::SysEV_AC_Phases_L2_Enabled == 0 || @sysvar::EV_Sim::Control::SysEV_AC_Phases_L3_Enabled == 0))
  {
    @sysvar::EV_Sim::Control::SysEV_WaitResume = 1;
    enableControl(gPanelName, gCheckBoxACPhaseL2, 1);
    enableControl(gPanelName, gCheckBoxACPhaseL3, 1);
    @sysvar::EV_Sim::Control::SysEV_AC_Phases_L2_Enabled == 1;
    @sysvar::EV_Sim::Control::SysEV_AC_Phases_L3_Enabled == 1;
    enableControl(gPanelName, gCheckBoxACPhaseL2, 0);
    enableControl(gPanelName, gCheckBoxACPhaseL3, 0);
  }
  
  if(@sysvar::EV_Sim::Control::SysEV_Connected == sysvar::EV_Sim::Control::SysEV_Connected::Connected)
  {
    setTimer(tPhaseSelection, cPhaseSelectionDelay);
  }
  
  setTimer(tPhaseSelection, 0);
}

on timer tPhaseSelection
{
  //set phases according to selection in the driver
  if(@sysvar::EV_Sim::Control::SysEV_AC_Phases == sysvar::EV_Sim::Control::SysEV_AC_Phases::SinglePhase)
  {
    enableControl(gPanelName, gCheckBoxACPhaseL1, 0);
    enableControl(gPanelName, gCheckBoxACPhaseL2, 0);
    enableControl(gPanelName, gCheckBoxACPhaseL3, 0);
    enableControl(gPanelName, gCheckBoxACPhaseN, 0);
    @sysvar::EV_Sim::Control::SysEV_AC_Phases_L1_Enabled = 1;
    @sysvar::EV_Sim::Control::SysEV_AC_Phases_L2_Enabled = 0;
    @sysvar::EV_Sim::Control::SysEV_AC_Phases_L3_Enabled = 0;
    @sysvar::EV_Sim::Control::SysEV_AC_Phases_N_Enabled = 1;
  }
  else if(@sysvar::EV_Sim::Control::SysEV_AC_Phases == sysvar::EV_Sim::Control::SysEV_AC_Phases::ThreePhase)
  {
    enableControl(gPanelName, gCheckBoxACPhaseL1, 0);
    enableControl(gPanelName, gCheckBoxACPhaseL2, 0);
    enableControl(gPanelName, gCheckBoxACPhaseL3, 0);
    enableControl(gPanelName, gCheckBoxACPhaseN, 0);
    @sysvar::EV_Sim::Control::SysEV_AC_Phases_L1_Enabled = 1;
    @sysvar::EV_Sim::Control::SysEV_AC_Phases_L2_Enabled = 1;
    @sysvar::EV_Sim::Control::SysEV_AC_Phases_L3_Enabled = 1;
    @sysvar::EV_Sim::Control::SysEV_AC_Phases_N_Enabled = 1;
  }
  else
  {
    //enableControl(gPanelName, gCheckBoxACPhaseL1, 1);
    enableControl(gPanelName, gCheckBoxACPhaseL2, 1);
    enableControl(gPanelName, gCheckBoxACPhaseL3, 1);
    //enableControl(gPanelName, gCheckBoxACPhaseN, 1);
  }
}

void ControlBasicCharging()
{
  if(isTimerActive(tBasicChargingUpdate))
    cancelTimer(tBasicChargingUpdate);
  
  if(gEVBasicChargingEnabled == 0)
    return;
  
  if(StopChargingRunning == 1)
    return;
  
  if(GetMaxCurrentFromDutyCycle() >= 0.0 && // basic charging active
     @sysvar::EV_Sim::Control::SysEV_Stop == 0 && // stop button not pressed
     @sysvar::EV_Sim::Control::SysEV_WaitResume == 0) // pause button not pressed
  {
    if(@sysvar::VT_Control::IEC61851_State_EV == sysvar::VT_Control::IEC61851_State_EV::State_B &&
       HV_measure_AC_I_L1_rms() < 0.1 &&
       HV_measure_AC_I_L2_rms() < 0.1 &&
       HV_measure_AC_I_L3_rms() < 0.1)
    {
      HV_source_set_I_L1_rms(0.5);
      HV_source_set_I_L2_rms(0.5);
      HV_source_set_I_L3_rms(0.5);
      CP_EV_SetCPStateC();
      setTimer(tBasicChargingUpdate, cBasicChargingUpdateDelay);
    }
    else if(@sysvar::VT_Control::IEC61851_State_EV == sysvar::VT_Control::IEC61851_State_EV::State_C ||
            @sysvar::VT_Control::IEC61851_State_EV == sysvar::VT_Control::IEC61851_State_EV::State_D)
    {
      HV_source_set_I_L1_rms(Get_TargetCurrentAC());
      HV_source_set_I_L2_rms(Get_TargetCurrentAC());
      HV_source_set_I_L3_rms(Get_TargetCurrentAC());
    }
  }
}

export OnDutyCycleChange()
{
  ControlBasicCharging();
}

on sysvar sysvar::EV_Sim::SysEV_TargetCurrent_AC
{
  ControlBasicCharging();
}

on timer tBasicChargingUpdate
{
  ControlBasicCharging();
}

on sysvar EV_Sim::Control::SysEV_AC_Phases_L1_Enabled
{
  //L1 cannot be switched off
}

on sysvar EV_Sim::Control::SysEV_AC_Phases_L2_Enabled
{
  if(@sysvar::EV_Sim::Control::SysEV_AC_Phases == sysvar::EV_Sim::Control::SysEV_AC_Phases::CustomPhase)
  {
    @sysvar::EV_Sim::Control::SysEV_WaitResume = 1;
    HV_source_set_L2_PhaseLoss(!@this);
    setTimer(tPhaseSelection, cPhaseSelectionDelay);
  }
  else if(@sysvar::EV_Sim::Control::SysEV_AC_Phases == sysvar::EV_Sim::Control::SysEV_AC_Phases::SinglePhase)
  {
    HV_source_set_L2_PhaseLoss(1);
  }
  else if(@sysvar::EV_Sim::Control::SysEV_AC_Phases == sysvar::EV_Sim::Control::SysEV_AC_Phases::ThreePhase)
  {
    HV_source_set_L2_PhaseLoss(0);
  }
}

on sysvar EV_Sim::Control::SysEV_AC_Phases_L3_Enabled
{
  if(@sysvar::EV_Sim::Control::SysEV_AC_Phases == sysvar::EV_Sim::Control::SysEV_AC_Phases::CustomPhase)
  {
    @sysvar::EV_Sim::Control::SysEV_WaitResume = 1;
    HV_source_set_L3_PhaseLoss(!@this);
    setTimer(tPhaseSelection, cPhaseSelectionDelay);
  }
  else if(@sysvar::EV_Sim::Control::SysEV_AC_Phases == sysvar::EV_Sim::Control::SysEV_AC_Phases::SinglePhase)
  {
    HV_source_set_L3_PhaseLoss(1);
  }
  else if(@sysvar::EV_Sim::Control::SysEV_AC_Phases == sysvar::EV_Sim::Control::SysEV_AC_Phases::ThreePhase)
  {
    HV_source_set_L3_PhaseLoss(0);
  }
}

on sysvar EV_Sim::Control::SysEV_AC_Phases_N_Enabled
{
  //N cannot be disabled in Y configuration
}

/******************************************************************************************************************
* FirePreveting VAS
******************************************************************************************************************/

void SetIPv6AddrAndPortFromServiceDetailRes()
{
  long parameterSetID, lTmp2;
  int i, j;
  
  stack char parName[64];
  stack char parType[256];
  stack char parValue[256];
  struct VAS_FirePreventing::VAS_FirePreventingSettingsType firePreventingSettings;
  
  for (i = 0; i < sessionParameterSetCount; ++i)
  {    
    SCC_GetServiceParameterSetData(i, parameterSetID, lTmp2);      
    if (parameterSetID == cParameterSetID_VASFirePreventing)
    {
      firePreventingSettings.ParameterSetID = cParameterSetID_VASFirePreventing;
      for (j = 0; j < lTmp2; ++j)
      {
        SCC_GetServiceParameterData(i, j, parName, parType);
        if (strncmp(parName, "IP", strlen("IP")) == 0)
        {
          if (strncmp(parType, "string", strlen("string")) == 0)  
          {
            SCC_GetServiceParameterStringValue(i, j, parValue);
            firePreventingSettings.IPv6Addr = parValue;
            IpGetAddressAsArray(parValue, sessionIpv6Addr);
          }
          else 
          {
            writeLineEx(-3,1,"IP value is not a string type. Cannot read IP address from ServiceDetailResponse");
          }
        }
        else if (strncmp(parName, "Port", strlen("Port")) == 0)
        {
          if (strncmp(parType, "string", strlen("string")) == 0)  
          {
            SCC_GetServiceParameterStringValue(i, j, parValue);
            sessionPort = atol(parValue);
          }
          else if (strncmp(parType, "int", strlen("int")) == 0)
          {
            sessionPort = (dword)(long)(SCC_GetServiceParameterNumericalValue(i, j));
          } else {
            writeLineEx(-3,1,"Port value is not a string type nor a int value. Cannot read Port from ServiceDetailResponse");
          }
          firePreventingSettings.Port = sessionPort;
        } // else if Port
      } // j-for loop
    } // if parameterSetID == eg. 31000 (set in cParameterSetID_VASFirePreventing)
    break; 
  }
  Binding::ValueReceived(VAS_FirePreventing::FirePreventingClient.VAS_FirePreventingSettings, firePreventingSettings);
}

void InitVasService_FirePrevention()
{  
  int i, j;
  long parameterSetID, lTmp2; 
  
  connection = VAS_CreateClientConnection(sessionIpv6Addr, sessionPort);
  if( connection > 0 && $VAS_FirePreventing::FirePreventingClient.BatteryDataSendInterval != 0)
  {    
      timer_batteryData.set($VAS_FirePreventing::FirePreventingClient.BatteryDataSendInterval); 
  }
}

long VAS_CreateClientConnection(byte ipv6Addr[], dword port)
{
  stack long result = -1;
  stack dword error;
  stack struct ConnectionData connectionData;
  stack  byte ipv6AddrWildcard[16];
  stack long socket;

  memcpy(connectionData.ipv6Addr, ipv6Addr, elcount( connectionData.ipv6Addr));
  connectionData.port = port;
  
  if( 0 != IpGetAddressAsArray( "::", ipv6AddrWildcard) ) {
    writeLineEx(-3,3,"Client: Failed to create IPV6 wildcard address"); // write error to trace
    return result;
  }
  
  socket = tcpOpen( ipv6AddrWildcard, 0 ); 
  if( socket != ~0) {
    result = TcpConnect( socket, connectionData.ipv6Addr, connectionData.port );
    if( result == -1) {
      error = IpGetLastSocketError(socket);
      if( error == 10035) {
        memcpy(socketMap[socket], connectionData);
        result = socket;
        writeLineEx(-3, 1,"Client: Connection to port %d established on socket %d.", connectionData.port, socket);
        @sysvar::PanelControl::Sys_ClientConnectionStatus = 1;
        cancelTimer(timer_TcpConnect);
        return result;
      }
    }

    writeLineEx(-3,3,"Client: Error %d/%d connecting to socket.", result, error);
    tcpClose(socket);
  } else {
    writeLineEx(-3,3,"Client: Socket creation on port %d failed", connectionData.port);
  }
  return result;
}

void CloseAllClientConnections()
{
  stack long socket;
  
  for (long socket: socketMap) {
    tcpClose(socket);
  }
  socketMap.clear();
}

void OnTcpClose( dword socket, long result)
{
  if( socketMap.containsKey(socket) != 0)
  {
    socketMap.remove(socket);
    TcpClose(socket);
    cancelTimer(timer_batteryData);
    writeLineEx(-3, 1,"Client: Closed connection on socket %d.", socket);
    @sysvar::PanelControl::Sys_ClientConnectionStatus = 0;
  }
}

long OnIpSendPrepare( dword socket, ethernetPacket * packet)
{
  //When the VAS Client socket calls the callback and the blocking flag is on, block every message.
  if(socketMap.containsKey(socket) && @sysvar::PanelControl::SysClientTcpResponsesActive == @sysvar::PanelControl::SysClientTcpResponsesActive::BlockTcpAcks)
    return 0;
  else
    return 1;
}

void VAS_SendData(long socket, byte data[], dword size)
{
  stack long result;
  
  if (socketMap.size() == 0)
  {
    writeLineEx(-3,3,"Client: VAS FirePreventing is currently not running on the EV"); 
    return;
  }
  
  if( socketMap.containsKey(socket) == 0)
  {
    writeLineEx(-3,3,"Client: Socket %d not found", socket); 
    return;
  }
  
  result = tcpSend(socket, data, size);
  
  if( 0 != result)
  {
    if( result == -1 && IpGetLastSocketError(socket) != 997 ) // If the specific error code is 997 this just indicates asynchronous sending
    {
      writeLineEx(-3,3,"Client: Sending data on socket %d failed with error %d",socket, IpGetLastSocketError(socket));
      return;
    }
  }
  
}

on sysvar PanelControl::SysSendBatteryDataOnce
{
  if(@this==1)
  {
    stack long length = GetBatteryData( gBatteryData );
    if( length > 0)
    {
      VAS_SendData(connection, gBatteryData, length);
    }
  }
}

on sysvar PanelControl::SysClientOpenTcpSocket
{
  if(@this == 1)
  {
    writelineex(-3,0,"Client: User opened TCP socket on port %d", sessionPort);
    connection = VAS_CreateClientConnection(sessionIpv6Addr, sessionPort);
  }  
}

on sysvar PanelControl::SysClientCloseTcpSocket
{
  if(@this == 1)
  {
    writelineex(-3,0,"Client: User closed all TCP sockets");
    CloseAllClientConnections();
  }
}

on sysvar_change PanelControl::SysClientBatteryDataExchangeStrategy
{
  SetRequiredSelectedElements();
}

on value_change VAS_FirePreventing::FirePreventingClient.BatteryDataSendInterval
{
  if($VAS_FirePreventing::FirePreventingClient.BatteryDataSendInterval!=0)
    timer_batteryData.set($VAS_FirePreventing::FirePreventingClient.BatteryDataSendInterval);
}

void SendBatteryDataStartEndCharging()
{
  stack long length = GetBatteryData_Case2_StartEndCharging(gBatteryData);
  if( length > 0)
  {
    VAS_FirePreventing::FirePreventingClient.BatteryData.BeginValueBulkUpdate();
    VAS_SendData(connection, gBatteryData, length);
    VAS_FirePreventing::FirePreventingClient.BatteryData.EndValueBulkUpdate();
  }
}

on timer timer_TcpConnect
{
  writeLineEx(writeTab, 2, "TCP connection was not established within 3s of receiving PaymentServiceSelectionRes. Not fulfilling requirement [V2GBIP_M03_037]");
}

on timer timer_batteryData
{
  stack long length;
  
  gSessionDuration += 3;
  gSessionCounter++;
  
  if($VAS_FirePreventing::FirePreventingClient.BatteryDataSendInterval != 0)
    timer_batteryData.set($VAS_FirePreventing::FirePreventingClient.BatteryDataSendInterval);
  
  if(gIsFirstBatteryDataTransmitted == 1 )
  {
    SelectTransmittedElements();
    cancelTimer(timer_TcpConnect);
    gIsFirstBatteryDataTransmitted = 0;
    if (@sysvar::PanelControl::SysClientBatteryDataExchangeStrategy == @sysvar::PanelControl::SysClientBatteryDataExchangeStrategy::CASE_2)
    {
      SendBatteryDataStartEndCharging();
      return;
    } 
  }
  
  length = GetBatteryData(gBatteryData);
  if( length > 0)
  {
    VAS_FirePreventing::FirePreventingClient.BatteryData.BeginValueBulkUpdate();
    VAS_SendData(connection, gBatteryData, length);
    VAS_FirePreventing::FirePreventingClient.BatteryData.EndValueBulkUpdate();
  }
}

void SelectTransmittedElements()
{
  if($VAS_FirePreventing::FirePreventingClient.BatteryData.GroupASelectedElement != @sysvar::PanelControl::SysClientSelectedElementGroupA)
    $VAS_FirePreventing::FirePreventingClient.BatteryData.GroupASelectedElement = @sysvar::PanelControl::SysClientSelectedElementGroupA;
  
  if($VAS_FirePreventing::FirePreventingClient.BatteryData.GroupBSelectedElement != @sysvar::PanelControl::SysClientSelectedElementGroupB)
    $VAS_FirePreventing::FirePreventingClient.BatteryData.GroupBSelectedElement = @sysvar::PanelControl::SysClientSelectedElementGroupB;
  
  if($VAS_FirePreventing::FirePreventingClient.BatteryData.GroupGSelectedElement != @sysvar::PanelControl::SysClientSelectedElementGroupG)
    $VAS_FirePreventing::FirePreventingClient.BatteryData.GroupGSelectedElement = @sysvar::PanelControl::SysClientSelectedElementGroupG;
  
  if($VAS_FirePreventing::FirePreventingClient.BatteryData.GroupHSelectedElement != @sysvar::PanelControl::SysClientSelectedElementGroupH)
    $VAS_FirePreventing::FirePreventingClient.BatteryData.GroupHSelectedElement = @sysvar::PanelControl::SysClientSelectedElementGroupH;
}

long GetBatteryData(byte batteryData[])
{  
  switch(@sysvar::PanelControl::SysClientBatteryDataExchangeStrategy)
  {
    case sysvar::PanelControl::SysClientBatteryDataExchangeStrategy::CASE_1:
      return GetBatteryData_Case1(batteryData);
    case sysvar::PanelControl::SysClientBatteryDataExchangeStrategy::CASE_2:
      return GetBatteryData_Case2_Periodic(batteryData);
    case sysvar::PanelControl::SysClientBatteryDataExchangeStrategy::CASE_3:
      return GetBatteryData_Case3(batteryData);
    default:
      return GetBatteryData_Case1(batteryData);;
  }
}

// [V2GBIP_M03_050]: Periodically transmit *all* items
long GetBatteryData_Case1(byte batteryData[])
{
  stack long offset = 0;
  
  offset = AddGroupA(batteryData, offset);
  if( offset < 0 ) { writeLineEx(-3,3,"GroupA buffer too small"); return -1; }
  offset = AddGroupB(batteryData, offset);
  if( offset < 0 ) { writeLineEx(-3,3,"GroupB buffer too small"); return -1; }
  offset = AddSoC(batteryData, offset);
  if( offset < 0 ) { writeLineEx(-3,3,"SoC buffer too small"); return -1; }
  offset = AddSoH(batteryData, offset);
  if( offset < 0 ) { writeLineEx(-3,3,"SoH buffer too small"); return -1; }
  offset = BatteryPackCurrent(batteryData, offset);
  if( offset < 0 ) { writeLineEx(-3,3,"Battery pack current buffer too small"); return -1; }
  offset = BatteryPackVoltage(batteryData, offset);
  if( offset < 0 ) { writeLineEx(-3,3,"Battery pack voltage buffer too small"); return -1; }
  offset = AddGroupG(batteryData, offset);
  if( offset < 0 ) { writeLineEx(-3,3,"Battery cell voltage buffer too small"); return -1; }
  offset = AddGroupH(batteryData, offset);
  if( offset < 0 ) { writeLineEx(-3,3,"Battery module temperature buffer too small"); return -1; }
 
  return offset;
}

// [V2GBIP_M03_052]: Periodically transmit items A, B & C; *All* at start and end of charging
long GetBatteryData_Case2_Periodic(byte batteryData[])
{
  stack long offset = 0;
  
  writeLineEx(-3,1,"GetBatteryData_Case2_Periodic");
  
  offset = AddGroupA(batteryData, offset);
  if( offset < 0 ) { writeLineEx(-3,3,"GroupA buffer too small"); return -1; }
  offset = AddGroupB(batteryData, offset);
  if( offset < 0 ) { writeLineEx(-3,3,"GroupB buffer too small"); return -1; }
  offset = AddSoC(batteryData, offset);
  if( offset < 0 ) { writeLineEx(-3,3,"SoC buffer too small"); return -1; }
 
  $VAS_FirePreventing::FirePreventingClient.BatteryData.SoH.SetInvalid();
  $VAS_FirePreventing::FirePreventingClient.BatteryData.BatteryPackCurrent.SetInvalid();
  $VAS_FirePreventing::FirePreventingClient.BatteryData.BatteryPackVoltage.SetInvalid();
  $VAS_FirePreventing::FirePreventingClient.BatteryData.GroupGSelectedElement.SetInvalid();
  $VAS_FirePreventing::FirePreventingClient.BatteryData.GroupG.SetInvalid();
  $VAS_FirePreventing::FirePreventingClient.BatteryData.GroupHSelectedElement.SetInvalid();
  $VAS_FirePreventing::FirePreventingClient.BatteryData.GroupH.SetInvalid();
  
  return offset;
}

// [V2GBIP_M03_052]: Periodically transmit items A, B & C; *All* at start and end of charging
// [V2GBIP_M03_054]: Group G is fixed to 7-2, H is fixed tp 8-1
long GetBatteryData_Case2_StartEndCharging(byte batteryData[])
{
  stack long offset = 0;
  
  writeLineEx(writeTab, 1, "CASE_2 Start or End of charging message");
  writeLineEx(-3,1,"CASE_2 Start or End of charging message");
  
  $VAS_FirePreventing::FirePreventingClient.BatteryData.GroupGSelectedElement = VAS_FirePreventing::parGroupGSelectedElement::TransmitBatteryCellVoltageMaxMin;
  $VAS_FirePreventing::FirePreventingClient.BatteryData.GroupHSelectedElement = VAS_FirePreventing::parGroupHSelectedElement::TransmitAllBatteryModuleTemperatures;
  
  offset = AddGroupA(batteryData, offset);
  if( offset < 0 ) { writeLineEx(-3,3,"GroupA buffer too small"); return -1; }
  offset = AddGroupB(batteryData, offset);
  if( offset < 0 ) { writeLineEx(-3,3,"GroupB buffer too small"); return -1; }
  offset = AddSoC(batteryData, offset);
  if( offset < 0 ) { writeLineEx(-3,3,"SoC buffer too small"); return -1; }
  offset = AddSoH(batteryData, offset);
  if( offset < 0 ) { writeLineEx(-3,3,"SoH buffer too small"); return -1; }
  offset = BatteryPackCurrent(batteryData, offset);
  if( offset < 0 ) { writeLineEx(-3,3,"Battery pack current buffer too small"); return -1; }
  offset = BatteryPackVoltage(batteryData, offset);
  if( offset < 0 ) { writeLineEx(-3,3,"Battery pack voltage buffer too small"); return -1; }
  offset = AddGroupG(batteryData, offset);
  if( offset < 0 ) { writeLineEx(-3,3,"Battery cell voltage buffer too small"); return -1; }
  offset = AddGroupH(batteryData, offset);
  if( offset < 0 ) { writeLineEx(-3,3,"Battery module temperature buffer too small"); return -1; }
 
  return offset;
}

// [V2GBIP_M03_055]: Periodically transmit items A, B & C
long GetBatteryData_Case3(byte batteryData[])
{
  stack long offset = 0;
  
  offset = AddGroupA(batteryData, offset);
  if( offset < 0 ) { writeLineEx(-3,3,"GroupA buffer too small"); return -1; }
  offset = AddGroupB(batteryData, offset);
  if( offset < 0 ) { writeLineEx(-3,3,"GroupB buffer too small"); return -1; }
  offset = AddSoC(batteryData, offset);
  if( offset < 0 ) { writeLineEx(-3,3,"SoC buffer too small"); return -1; }
  
  $VAS_FirePreventing::FirePreventingClient.BatteryData.SoH.SetInvalid();
  $VAS_FirePreventing::FirePreventingClient.BatteryData.BatteryPackCurrent.SetInvalid();
  $VAS_FirePreventing::FirePreventingClient.BatteryData.BatteryPackVoltage.SetInvalid();
  $VAS_FirePreventing::FirePreventingClient.BatteryData.GroupGSelectedElement.SetInvalid();
  $VAS_FirePreventing::FirePreventingClient.BatteryData.GroupG.SetInvalid();
  $VAS_FirePreventing::FirePreventingClient.BatteryData.GroupHSelectedElement.SetInvalid();
  $VAS_FirePreventing::FirePreventingClient.BatteryData.GroupH.SetInvalid();
 
  return offset;
}

int AddGroupA(byte batteryData[], int offset)
{
  switch($VAS_FirePreventing::FirePreventingClient.BatteryData.GroupASelectedElement)
  {
    case VAS_FirePreventing::parGroupASelectedElement::TransmitTimeStamp:
      return AddTimeStamp(batteryData, offset);
    case VAS_FirePreventing::parGroupASelectedElement::TransmitSessionDuration:
      return AddSessionDuration(batteryData, offset);
    case VAS_FirePreventing::parGroupASelectedElement::TransmitCounter:
      return AddCounter(batteryData, offset);
    default:
      return AddTimeStamp(batteryData, offset);
  }
}

int AddTimeStamp(byte batteryData[], int offset)
{
  stack Int64 unixTimestamp;
  stack long max = elcount(batteryData);
  stack int n;

  if(offset + 6 > max) return -1;
  
  // calculate "present" unix timestamp
  unixTimestamp = $VAS_FirePreventing::FirePreventingClient.BatteryData.GroupA.TimeStamp;
   
  batteryData[offset]   = 0xA1; // TimeStamp Tag
  batteryData[offset+1] = 4;    // length of time stamp data
  for(n=0; n < 4; ++n) batteryData[offset + 2 + n] = ((unixTimestamp >> n * 8) & 0xFF);  

  return offset + 6;
}

int AddSessionDuration(byte batteryData[], int offset)
{
  stack long max = elcount(batteryData);
  stack int n;

  if(offset + 6 > max) return -1;
  
  $VAS_FirePreventing::FirePreventingClient.BatteryData.GroupA.SessionDuration = gSessionDuration;
   
  batteryData[offset]   = 0xB1; // SessionDuration Tag
  batteryData[offset + 1] = 4;    // length of sessionDuration data
  for(n=0; n < 4; ++n) batteryData[offset + 2 + n] = ((gSessionDuration >> n * 8) & 0xFF);  

  return offset + 6;
}

int AddCounter(byte batteryData[], int offset)
{
  stack long max = elcount(batteryData);
  stack int n;

  if(offset + 4 > max) return -1;
  
  $VAS_FirePreventing::FirePreventingClient.BatteryData.GroupA.Counter = gSessionCounter;
   
  batteryData[offset]   = 0xC1; // Counter Tag
  batteryData[offset + 1] = 2;    // length of Counter data
  for(n = 0; n < 2; ++n) batteryData[offset + 2 + n] = ((gSessionCounter >> n * 8) & 0xFF);  

  return offset + 4;
}

int AddGroupB(byte batteryData[], int offset)
{
  switch($VAS_FirePreventing::FirePreventingClient.BatteryData.GroupBSelectedElement)
  {
    case VAS_FirePreventing::parGroupBSelectedElement::TransmitVIN:
      return AddVIN(batteryData, offset);
    case VAS_FirePreventing::parGroupBSelectedElement::TransmitBatteryID:
      return AddBatteryID(batteryData, offset);
    case VAS_FirePreventing::parGroupBSelectedElement::TransmitEncryptedVIN:
      return AddEncryptedVIN(batteryData, offset);
    default:
      return AddVIN(batteryData, offset);
  }
}

int AddVIN(byte batteryData[], int offset)
{
  stack long max = elcount(batteryData);

  if(offset + 19 > max) return -1;
    
  batteryData[offset] = 0xA2; // VIN Tag
  batteryData[offset + 1] = 17;    // length of VIN data
  memcpy_off(batteryData, offset + 2, $VAS_FirePreventing::FirePreventingClient.BatteryData.GroupB.VIN, 0, 17); 

  return offset + 19;
}

int AddBatteryID(byte batteryData[], int offset)
{
  stack long max = elcount(batteryData);
  const int batteryIDMaxLength = 255;
  char batteryIDBuffer[batteryIDMaxLength];
  int batteryIDLength;
  
  sysGetVariableString(sysvar::PanelControl::SysClientBatteryID, batteryIDBuffer, elcount(batteryIDBuffer));
  batteryIDLength = sysGetVariableArrayLength(sysvar::PanelControl::SysClientBatteryID);
  batteryIDLength = _min(batteryIDLength, batteryIDMaxLength); // List is limited to 255 elements
  
  if(offset + batteryIDLength + 2 > max) return -1;
  
  batteryData[offset]   = 0xB2; // BatteryID Tag
  batteryData[offset + 1] = batteryIDLength;    // length of BatteryID data
  $VAS_FirePreventing::FirePreventingClient.BatteryData.GroupB.BatteryID = batteryIDBuffer;
  memcpy_off(batteryData, offset + 2, $VAS_FirePreventing::FirePreventingClient.BatteryData.GroupB.BatteryID, 0, batteryIDLength); 

  return offset + batteryIDLength + 2;
}

int AddEncryptedVIN(byte batteryData[], int offset)
{
  int i;
  const int encryptedVINMaxLength = 255;
  char buffer[encryptedVINMaxLength];
  int encryptedVinLength;
  stack long max = elcount(batteryData);
  
  sysGetVariableString(sysvar::PanelControl::SysClientEncryptedVIN, buffer, elcount(buffer));
  encryptedVinLength = sysGetVariableArrayLength(sysvar::PanelControl::SysClientEncryptedVIN);
  encryptedVinLength = _min(encryptedVinLength, encryptedVINMaxLength); // List is limited to 255 elements
  
  if(offset + encryptedVinLength + 2 > max) return -1;
  
  batteryData[offset]   = 0xC2; // EncryptedVIN Tag
  batteryData[offset + 1] = encryptedVinLength;    // length of EncryptedVIN data
  $VAS_FirePreventing::FirePreventingClient.BatteryData.GroupB.EncryptedVIN.Length = encryptedVinLength;
  for(i = 0; i < encryptedVinLength; i++)
  {
    $VAS_FirePreventing::FirePreventingClient.BatteryData.GroupB.EncryptedVIN[i] = buffer[i];
    batteryData[offset + 2 + i] = buffer[i]; 
  }

  return offset + encryptedVinLength + 2;
}

int AddSoC(byte batteryData[], int offset)
{
  stack long max = elcount(batteryData);

  if( offset + 3 > max) return -1;
    
  batteryData[offset]   = 0xA3; // SoC Tag
  batteryData[offset + 1] = 1;    // length of SoC data
  batteryData[offset + 2] = $VAS_FirePreventing::FirePreventingClient.BatteryData.SoC.impl;

  return offset + 3;
}

int AddSoH(byte batteryData[], int offset)
{
  stack long max = elcount(batteryData);

  if( offset + 3 > max) return -1;
  
  // Might not be sent during CASE_2 strategy (set to invalid), so make sure it is enabled
  if($VAS_FirePreventing::FirePreventingClient.BatteryData.SoH.IsValid)
    gLastTransmittedSoH = $VAS_FirePreventing::FirePreventingClient.BatteryData.SoH.impl;
  else
    $VAS_FirePreventing::FirePreventingClient.BatteryData.SoH.impl = gLastTransmittedSoH;
    
  batteryData[offset]   = 0xA4; // SoH Tag
  batteryData[offset + 1] = 1;    // length of SoH data
  batteryData[offset + 2] = $VAS_FirePreventing::FirePreventingClient.BatteryData.SoH.impl;

  return offset + 3;
}

int BatteryPackCurrent(byte batteryData[], int offset)
{
  stack long max = elcount(batteryData);
  stack word current;

  // Might not be sent during CASE_2 strategy (set to invalid), so make sure it is enabled
  if($VAS_FirePreventing::FirePreventingClient.BatteryData.BatteryPackCurrent.IsValid)
    gLastTransmittedBatteryPackCurrent = $VAS_FirePreventing::FirePreventingClient.BatteryData.BatteryPackCurrent.impl;
  else
    $VAS_FirePreventing::FirePreventingClient.BatteryData.BatteryPackCurrent.impl = gLastTransmittedBatteryPackCurrent;
  
  if( offset + 4 > max) return -1;
  
  current = $VAS_FirePreventing::FirePreventingClient.BatteryData.BatteryPackCurrent.impl;
  
  batteryData[offset]   = 0xA5; // Battery pack current Tag
  batteryData[offset + 1] = 2;    // length of Battery pack current data
  batteryData[offset + 2] = ((current >> 8) & 0xFF);
  batteryData[offset + 3] = (current & 0xFF);

  return offset + 4;
}

int BatteryPackVoltage(byte batteryData[], int offset)
{
  stack long max = elcount(batteryData);
  stack word voltage; 

  if( offset + 4 > max) return -1;
  
  // Might not be sent during CASE_2 strategy (set to invalid), so make sure it is enabled
  if($VAS_FirePreventing::FirePreventingClient.BatteryData.BatteryPackVoltage.IsValid)
    gLastTransmittedBatteryPackVoltage = $VAS_FirePreventing::FirePreventingClient.BatteryData.BatteryPackVoltage.impl;
  else
    $VAS_FirePreventing::FirePreventingClient.BatteryData.BatteryPackVoltage.impl = gLastTransmittedBatteryPackVoltage;
  
  voltage = $VAS_FirePreventing::FirePreventingClient.BatteryData.BatteryPackVoltage.impl;
  
  batteryData[offset]   = 0xA6; // Battery pack voltage Tag
  batteryData[offset + 1] = 2;    // length of Battery pack voltage data
  batteryData[offset + 2] = ((voltage >> 8) & 0xFF);
  batteryData[offset + 3] = (voltage & 0xFF);

  return offset+4;
}

int AddGroupG(byte batteryData[], int offset)
{
  switch($VAS_FirePreventing::FirePreventingClient.BatteryData.GroupGSelectedElement)
  {
    case VAS_FirePreventing::parGroupGSelectedElement::TransmitAllBatteryCellVoltages:
      return AddAllBatteryCellVoltages(batteryData, offset);
    case VAS_FirePreventing::parGroupGSelectedElement::TransmitBatteryCellVoltageMaxMin:
      return AddMaxMinBatteryCellVoltages(batteryData, offset);
    default:
      return AddAllBatteryCellVoltages(batteryData, offset);
  }
}

int AddAllBatteryCellVoltages(byte batteryData[], int offset)
{
  stack long max = elcount(batteryData);
  stack word numCells = $VAS_FirePreventing::FirePreventingClient.BatteryData.GroupG.AllBatteryCellVoltages.Length;
  stack int size = 3 + numCells; // 3 Bytes for Tag and Length 
  stack int n;
  
  if(offset + size > max) return -1;
  
  batteryData[offset]   = 0xA7; // Battery cell voltage Tag
  batteryData[offset + 1] = (numCells >> 8) & 0xFF;  // length of Battery cell voltage data high byte
  batteryData[offset + 2] = (numCells & 0xFF);     // length of Battery cell voltage data lo byte

  for(n = 0; n < numCells; ++n) {
    batteryData[offset + 3 + n] = $VAS_FirePreventing::FirePreventingClient.BatteryData.GroupG.AllBatteryCellVoltages[n].impl;
  }
 
  return offset + size;
}

int AddMaxMinBatteryCellVoltages(byte batteryData[], int offset)
{
  stack long max = elcount(batteryData);
  stack word numCells = 2;
  stack int size = 2 + numCells; // 2 Bytes for Tag and Length 
  stack int n;
  long maxMinValues[2];
  
  sysGetVariableLongArray(sysvar::PanelControl::SysClientMaxMinBatteryCellVoltages, maxMinValues, elcount(maxMinValues));
  
  if(offset + size > max) return -1;
  
  batteryData[offset]   = 0xB7; // MaxMin Battery cell voltage Tag
  batteryData[offset + 1] = numCells;  // length of Battery cell voltage data
  
  for(n = 0; n < numCells; ++n) {
    $VAS_FirePreventing::FirePreventingClient.BatteryData.GroupG.BatteryCellVoltageMaxMin[n].impl = maxMinValues[n] & 0xFF;
    batteryData[offset + 2 + n] = maxMinValues[n] & 0xFF;
  }
 
  return offset + size;
}

int AddGroupH(byte batteryData[], int offset)
{
  switch($VAS_FirePreventing::FirePreventingClient.BatteryData.GroupHSelectedElement)
  {
    case VAS_FirePreventing::parGroupHSelectedElement::TransmitAllBatteryModuleTemperatures:
      return AddAllBatteryModuleTemperatures(batteryData, offset);
    case VAS_FirePreventing::parGroupHSelectedElement::TransmitBatteryModuleTemperatureMaxMin:
      return AddMaxMinBatteryModuleTemperatures(batteryData, offset);
    default:
      return AddAllBatteryModuleTemperatures(batteryData, offset);
  }
}

int AddAllBatteryModuleTemperatures(byte batteryData[], int offset)
{
  stack long max = elcount(batteryData);
  const int allTemperaturesMaxLength = 255;
  stack int numModules;
  stack int size; 
  stack int n;
  long allTemperatures[allTemperaturesMaxLength];
  
  sysGetVariableLongArray(sysvar::PanelControl::SysClientAllBatteryModuleTemperatures, allTemperatures, elcount(allTemperatures));
  numModules = sysGetVariableArrayLength(sysvar::PanelControl::SysClientAllBatteryModuleTemperatures);
  numModules = _min(numModules, allTemperaturesMaxLength); // List is limited to 255 elements

  size = 2 + numModules; // 2 Bytes for Tag and Length
  if(offset + size > max) return -1;
  
  batteryData[offset] = 0xA8; // Battery module temperture Tag
  batteryData[offset + 1] = numModules;  // length of Battery module temperture data
  
  $VAS_FirePreventing::FirePreventingClient.BatteryData.GroupH.AllBatteryModuleTemperatures.Length = numModules;
  for(n=0; n < numModules; ++n) {
    $VAS_FirePreventing::FirePreventingClient.BatteryData.GroupH.AllBatteryModuleTemperatures[n].impl = allTemperatures[n];
    batteryData[offset + 2 + n] = allTemperatures[n];
  }
 
  return offset + size;
}

int AddMaxMinBatteryModuleTemperatures(byte batteryData[], int offset)
{
  stack long max = elcount(batteryData);
  stack int numModules = $VAS_FirePreventing::FirePreventingClient.BatteryData.GroupH.BatteryModuleTemperatureMaxMin.Length;
  stack int size = 2 + numModules; // 2 Bytes for Tag and Length 
  stack int n;
  long maxMinValues[2];
  
  sysGetVariableLongArray(sysvar::PanelControl::SysClientMaxMinBatteryModuleTemperatures, maxMinValues, elcount(maxMinValues));
  
  if(offset + size > max) return -1;
  
  batteryData[offset]   = 0xB8; // MaxMin Battery module temperture Tag
  batteryData[offset + 1] = numModules;  // length of MaxMin Battery module temperture data

  for(n=0; n < numModules; ++n) {
    $VAS_FirePreventing::FirePreventingClient.BatteryData.GroupH.BatteryModuleTemperatureMaxMin[n].impl = maxMinValues[n] & 0xFF;
    batteryData[offset + 2 + n] = maxMinValues[n] & 0xFF;
  }
 
  return offset + size;
}
