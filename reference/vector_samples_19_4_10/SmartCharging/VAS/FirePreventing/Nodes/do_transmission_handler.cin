/*@!Encoding:1252*/
includes
{
  
}

variables
{
  
}

on transmit_value VAS_FirePreventing::FirePreventingClient.BatteryData
{
  // handle data on transmit if needed
}


on transmit_value VAS_FirePreventing::FirePreventingClient.BatteryDataSendInterval
{
  // handle data on transmit if needed
}
