/*@!Encoding:1252*/
variables
{
  int AutoFill_body = 0;
  int gSessionStopReqCounter = 0;
  int gEUFrequencyDroop = 1;
  int priceScheduleId = 0;
}

on sysvar Common::SysTLSEnabled
{
  setTLSAttribute();
}

on sysvar Common::SysUserAuthorizationMode
{
  setAuthorizationMode(); 
}

int IsEVSERolePassive()
{
  if((@sysVar::Test::SysTestControlledEntity != 0) && (@Test::SysTestApplyControlMode == 1))
    return 1;
  
  return 0;
}

/**********************************************************************************************************************
 *  ON METHODE
 *********************************************************************************************************************/
on fct_called EVSE.OnLastReceivedMessageIdChanged
{
  @Common::LastReceivedMessageId = $EVSE.OnLastReceivedMessageIdChanged.LatestCall.lastRxMessageId;
  // Enable AutoBodyFill if it was previously disabeld at the Req/Resp loop
  if (AutoFill_body == 0)
  {
    EVSE.EnableAutoBodyFill.Call(1);
    AutoFill_body = 1;
  }
}

void Reset_EVSE_Values()
{
  EVSE.SetAdHocSendingEnabled.Call(0);
  @sysvar::Common::SysProtocolBar = 0; 
  @sysvar::EVSE_Sim::Control::SysEVSE_WaitResume = 0;
  @sysvar::EVSE_Sim::SysEVSE_SimState = 2;
  sysSetVariableString(sysvar::EVSE_Sim::SysEVSE_DCStatusCode, "N/A"); 
  @sysvar::EVSE_Sim::SysEVSE_SelectedControlMode = @sysvar::EVSE_Sim::SysEVSE_SelectedControlMode::NA;
  
  // Do not send PriceSchedule because ServiceDetailRes offers only Pricing = NoPricing 
  ($EVSE.ISO20.ScheduleExchange_Response.SEResControlMode.Dynamic_SEResControlMode.PriceSchedule).SetInvalid();
  gSessionStopReqCounter = 0;
  EVSE.ResetSimulation.Call();
  gEUFrequencyDroop = 1;
  previousCurrent = 0;
  EVSEProcessingLoopCounter = 0;
  EVSESRProcessingLoopCounter = 0;
}

reReadSharedAttributes()
{
  setTLSAttribute();
  setAuthorizationMode();
}

setTLSAttribute()
{
  // Response TLS only when the "TLS" option is checked
  // Set TLS
  if (@sysVar::Common::SysTLSEnabled == @sysvar::Common::SysTLSEnabled::TLSEnabled){
    setAttribute(CCS::Simulation::EVSE, CCSBinding::TLS, CCSBinding::TLSEnabled); 
  }
  else{
    setAttribute(CCS::Simulation::EVSE, CCSBinding::TLS, CCSBinding::TLSDisabled); 
  }
}

setAuthorizationMode()
{
  // Set AuthorizationMode
  if (@sysvar::Common::SysUserAuthorizationMode == sysvar::Common::SysUserAuthorizationMode::EIM){
      setAttribute(CCS::Simulation::EVSE, CCSBinding::EVSE::AuthorizationMode, 0);   
  }
  else{
      setAttribute(CCS::Simulation::EVSE, CCSBinding::EVSE::AuthorizationMode, 1); //PnC
  }
}

void _SetAbsolutePriceSchedule(struct _CCS::DataTypes::AbsolutePriceSchedule_Type absolutePriceSchedule)
{
  // max elements
  int taxRules;
  int priceRuleStacks;
  int priceRules;
  int overstayRules;
  int additionalSelectedServices;
  // counters
  int taxRulesCounter;
  int priceRuleStacksCounter;
  int priceRulesCounter;
  int overstayRulesCounter;
  int additionalSelectedServicesCounter;
  char priceScheduleIDString[50];
  char taxRuleNameString[50];
  
  taxRules = 2;
  priceRuleStacks = 2;
  priceRules = 2;
  overstayRules = 2;
  additionalSelectedServices = 2;
  
  priceScheduleId++;
  snprintf(priceScheduleIDString, elcount(priceScheduleIDString), "ID%d", priceScheduleId);
  absolutePriceSchedule.Id = priceScheduleIDString;
  absolutePriceSchedule.TimeAnchor = 75;
  absolutePriceSchedule.PriceScheduleID = priceScheduleId;
  absolutePriceSchedule.PriceScheduleDescription = "PriceScheduleDescription";
  absolutePriceSchedule.Currency = "EUR";
  absolutePriceSchedule.Language = "FRA";
  absolutePriceSchedule.PriceAlgorithm = "PriceAlgorithm";
  absolutePriceSchedule.MinimumCost.Exponent = 1;
  absolutePriceSchedule.MinimumCost.Value = 1;
  absolutePriceSchedule.MaximumCost.Exponent = 1;
  absolutePriceSchedule.MaximumCost.Value = 2;
  
  // TaxRules
  absolutePriceSchedule.TaxRules.TaxRule.Length = taxRules;
  for(taxRulesCounter = 0; taxRulesCounter < taxRules; taxRulesCounter++)
  {
    absolutePriceSchedule.TaxRules.TaxRule[taxRulesCounter].TaxRuleID = taxRulesCounter + 1;
    snprintf(taxRuleNameString, elcount(taxRuleNameString), "TaxRule %d", (taxRulesCounter + 1));
    absolutePriceSchedule.TaxRules.TaxRule[taxRulesCounter].TaxRuleName = taxRuleNameString;
    absolutePriceSchedule.TaxRules.TaxRule[taxRulesCounter].TaxRate.Value = 10 * (taxRulesCounter + 1);
    absolutePriceSchedule.TaxRules.TaxRule[taxRulesCounter].TaxRate.Exponent = 1;
    absolutePriceSchedule.TaxRules.TaxRule[taxRulesCounter].TaxIncludedInPrice = 0;
    absolutePriceSchedule.TaxRules.TaxRule[taxRulesCounter].AppliesToEnergyFee = taxRulesCounter % 2;
    absolutePriceSchedule.TaxRules.TaxRule[taxRulesCounter].AppliesToParkingFee = taxRulesCounter % 2;
    absolutePriceSchedule.TaxRules.TaxRule[taxRulesCounter].AppliesToOverstayFee = 0;
    absolutePriceSchedule.TaxRules.TaxRule[taxRulesCounter].AppliesMinimumMaximumCost = 1; 
  }
  
  // PriceRuleStacks
  absolutePriceSchedule.PriceRuleStacks.PriceRuleStack.Length = priceRuleStacks;
  for(priceRuleStacksCounter = 0; priceRuleStacksCounter < priceRuleStacks; priceRuleStacksCounter++)
  {
    absolutePriceSchedule.PriceRuleStacks.PriceRuleStack[priceRuleStacksCounter].Duration = 250 * (priceRuleStacksCounter + 1);
    absolutePriceSchedule.PriceRuleStacks.PriceRuleStack[priceRuleStacksCounter].PriceRule.Length = priceRules;
    for(priceRulesCounter = 0; priceRulesCounter < priceRules; priceRulesCounter++)
    {
      absolutePriceSchedule.PriceRuleStacks.PriceRuleStack[priceRuleStacksCounter].PriceRule[priceRulesCounter].EnergyFee.Value = 10;
      absolutePriceSchedule.PriceRuleStacks.PriceRuleStack[priceRuleStacksCounter].PriceRule[priceRulesCounter].EnergyFee.Exponent = 1;
      absolutePriceSchedule.PriceRuleStacks.PriceRuleStack[priceRuleStacksCounter].PriceRule[priceRulesCounter].ParkingFee.Value = 10;
      absolutePriceSchedule.PriceRuleStacks.PriceRuleStack[priceRuleStacksCounter].PriceRule[priceRulesCounter].ParkingFee.Exponent = 1;
      absolutePriceSchedule.PriceRuleStacks.PriceRuleStack[priceRuleStacksCounter].PriceRule[priceRulesCounter].ParkingFeePeriod = 500;
      absolutePriceSchedule.PriceRuleStacks.PriceRuleStack[priceRuleStacksCounter].PriceRule[priceRulesCounter].CarbonDioxideEmission = 10 * (priceRulesCounter + 1);
      absolutePriceSchedule.PriceRuleStacks.PriceRuleStack[priceRuleStacksCounter].PriceRule[priceRulesCounter].RenewableGenerationPercentage = 100 - 25 * (priceRulesCounter + 1);
      absolutePriceSchedule.PriceRuleStacks.PriceRuleStack[priceRuleStacksCounter].PriceRule[priceRulesCounter].PowerRangeStart.Value = 10;
      absolutePriceSchedule.PriceRuleStacks.PriceRuleStack[priceRuleStacksCounter].PriceRule[priceRulesCounter].PowerRangeStart.Exponent = 1;
    }
  }
  
  // OverstayRules
  absolutePriceSchedule.OverstayRules.OverstayPowerThreshold.Value = 10;
  absolutePriceSchedule.OverstayRules.OverstayPowerThreshold.Exponent = 1;
  absolutePriceSchedule.OverstayRules.OverstayTimeThreshold = 100;
  absolutePriceSchedule.OverstayRules.OverstayRule.Length = overstayRules;
  for(overstayRulesCounter = 0; overstayRulesCounter < overstayRules; overstayRulesCounter++)
  {
    absolutePriceSchedule.OverstayRules.OverstayRule[overstayRulesCounter].OverstayRuleDescription = "OverstayRuleDescription";
    absolutePriceSchedule.OverstayRules.OverstayRule[overstayRulesCounter].StartTime = 100 * overstayRulesCounter;
    absolutePriceSchedule.OverstayRules.OverstayRule[overstayRulesCounter].OverstayFee.Value = 1;
    absolutePriceSchedule.OverstayRules.OverstayRule[overstayRulesCounter].OverstayFee.Exponent = 1;
    absolutePriceSchedule.OverstayRules.OverstayRule[overstayRulesCounter].OverstayFeePeriod = 100 * (overstayRules + 1) - 100 * (overstayRulesCounter + 1);
  }
  
  // AdditionalSelectedServices
  absolutePriceSchedule.AdditionalSelectedServices.AdditionalService.Length = additionalSelectedServices;
  for(additionalSelectedServicesCounter = 0; additionalSelectedServicesCounter < additionalSelectedServices; additionalSelectedServicesCounter++)
  {
    absolutePriceSchedule.AdditionalSelectedServices.AdditionalService[additionalSelectedServicesCounter].ServiceName = "ServiceName";
    absolutePriceSchedule.AdditionalSelectedServices.AdditionalService[additionalSelectedServicesCounter].ServiceFee.Value = 10 * (additionalSelectedServicesCounter + 1);
    absolutePriceSchedule.AdditionalSelectedServices.AdditionalService[additionalSelectedServicesCounter].ServiceFee.Exponent = 1;
  }
}

void _SetChargingSchedule(struct _CCS::DataTypes::ChargingSchedule_Type chargingSchedule)
{
  int scheduleEntryValue;
  int powerScheduleEntries;
  int scheduleTupleCounter;
  int powerScheduleEntryCounter;
  
  powerScheduleEntries = 3;
  
  // 1. Available Energy
  chargingSchedule.PowerSchedule.AvailableEnergy.Exponent = 2;
  chargingSchedule.PowerSchedule.AvailableEnergy.Value = 33;
  // 2. PowerTolerance
  chargingSchedule.PowerSchedule.PowerTolerance.Exponent = -2;
  chargingSchedule.PowerSchedule.PowerTolerance.Value = 10;
  
  // 3. PowerScheduleEntries
  chargingSchedule.PowerSchedule.PowerScheduleEntries.PowerScheduleEntry.Length = powerScheduleEntries;
  for(powerScheduleEntryCounter = 0; powerScheduleEntryCounter < powerScheduleEntries; powerScheduleEntryCounter++)
  {
    scheduleEntryValue = 10 * (powerScheduleEntryCounter + 1);
    chargingSchedule.PowerSchedule.PowerScheduleEntries.PowerScheduleEntry[powerScheduleEntryCounter].Duration = 900;
    chargingSchedule.PowerSchedule.PowerScheduleEntries.PowerScheduleEntry[powerScheduleEntryCounter].Power.Exponent = 2;
    chargingSchedule.PowerSchedule.PowerScheduleEntries.PowerScheduleEntry[powerScheduleEntryCounter].Power.Value = scheduleEntryValue;
    if(@sysvar::Common::SysUserChargingMode == @sysvar::Common::SysUserChargingMode::AC)
    {
      chargingSchedule.PowerSchedule.PowerScheduleEntries.PowerScheduleEntry[powerScheduleEntryCounter].Power_L2.Exponent = 2;
      chargingSchedule.PowerSchedule.PowerScheduleEntries.PowerScheduleEntry[powerScheduleEntryCounter].Power_L2.Value = scheduleEntryValue;
      chargingSchedule.PowerSchedule.PowerScheduleEntries.PowerScheduleEntry[powerScheduleEntryCounter].Power_L3.Exponent = 2;
      chargingSchedule.PowerSchedule.PowerScheduleEntries.PowerScheduleEntry[powerScheduleEntryCounter].Power_L3.Value = 0; 
    }
    else
    {
      (chargingSchedule.PowerSchedule.PowerScheduleEntries.PowerScheduleEntry[powerScheduleEntryCounter].Power_L2).SetInvalid();
      (chargingSchedule.PowerSchedule.PowerScheduleEntries.PowerScheduleEntry[powerScheduleEntryCounter].Power_L3).SetInvalid();
    }
  }      
   
  // The PriceSchedule is only shown when in PnC mode
  if(@Common::SysUserAuthorizationMode == @Common::SysUserAuthorizationMode::PnC)
  {
    // General elements
    chargingSchedule.PriceScheduleModeElementId = 0;
    _SetAbsolutePriceSchedule(chargingSchedule.PriceSchedule.AbsolutePriceSchedule);
  }
}

void FUNC_Set_ScheduleExchangeRes()
{
  int scheduleTuples;
  int scheduleTupleCounter;
  
  // Disable AutoBodyFill for manual definition of the parameter set
  EVSE.EnableAutoBodyFill.Call(0);
  AutoFill_body = 0;
  scheduleTuples = 3;
  priceScheduleId = 0;

  // Distinction between schedule and dynamic mode
  if($CCS::Simulation::EVSE.ISO20.ServiceSelection_Request.SelectedEnergyTransferService.ParameterSetID == 1)
  {
    $CCS::Simulation::EVSE.ISO20.ScheduleExchange_Response.SEResControlMode.Scheduled_SEResControlMode.ScheduleTuple.Length = scheduleTuples;
    for(scheduleTupleCounter = 0; scheduleTupleCounter < scheduleTuples; scheduleTupleCounter++)
    {
      // Tuple Id (1-255)
      $CCS::Simulation::EVSE.ISO20.ScheduleExchange_Response.SEResControlMode.Scheduled_SEResControlMode.ScheduleTuple[scheduleTupleCounter].ScheduleTupleID = scheduleTupleCounter + 1;
      _SetChargingSchedule($CCS::Simulation::EVSE.ISO20.ScheduleExchange_Response.SEResControlMode.Scheduled_SEResControlMode.ScheduleTuple[scheduleTupleCounter].ChargingSchedule);
      _SetChargingSchedule($CCS::Simulation::EVSE.ISO20.ScheduleExchange_Response.SEResControlMode.Scheduled_SEResControlMode.ScheduleTuple[scheduleTupleCounter].DischargingSchedule);
    }
  }
  else
  {
    // The PriceSchedule is only shown when in PnC mode
    if(@Common::SysUserAuthorizationMode == @Common::SysUserAuthorizationMode::PnC)
    {
      // Definition of price schedule, can be extended 
      $CCS::Simulation::EVSE.ISO20.ScheduleExchange_Response.SEResControlMode.Dynamic_SEResControlMode.PriceScheduleModeElementId = 0;
      _SetAbsolutePriceSchedule($CCS::Simulation::EVSE.ISO20.ScheduleExchange_Response.SEResControlMode.Dynamic_SEResControlMode.PriceSchedule.AbsolutePriceSchedule);
    }
  }
}

void FUNC_Set_ServiceDetailRes()
{
  // Selection of ServiceID (e.g. DC_BPT)
  if ($EVSE.ISO20.ServiceDetail_Request.ServiceID == 6)
  {
    // Disable AutoBodyFill for manual definition of the parameter set
    if (AutoFill_body == 1)
    {
      EVSE.EnableAutoBodyFill.Call(0);
      AutoFill_body = 0;
    } 
    
    // Definition of required service ID (shall be equal to the if query)
    $EVSE.ISO20.ServiceDetail_Response.ServiceID = $EVSE.ISO20.ServiceDetail_Request.ServiceID;
    
    _ServiceDetail_PrepareResponseContent_DC_BPT_List();
  }
  else if ($EVSE.ISO20.ServiceDetail_Request.ServiceID == 2)
  {
    // Disable AutoBodyFill for manual definition of the parameter set
    if (AutoFill_body == 1)
    {
      EVSE.EnableAutoBodyFill.Call(0);
      AutoFill_body = 0;
    } 
    
    // Definition of required service ID (shall be equal to the if query)
    $EVSE.ISO20.ServiceDetail_Response.ServiceID = $EVSE.ISO20.ServiceDetail_Request.ServiceID;
    _ServiceDetail_PrepareResponseContent_DC_List();
  }
}

/// <ServiceDetail>
_ServiceDetail_PrepareResponseContent_DC_List()
{
  int pricing;
  
  if(@Common::SysUserAuthorizationMode == @Common::SysUserAuthorizationMode::PnC)
    pricing = _CCS::DataTypes::PricingType::AbsolutePricing;
  else
    pricing = _CCS::DataTypes::PricingType::NoPricing;
  
  // Short or enlarge ParameterSet length if necessary
  $EVSE.ISO20.ServiceDetail_Response.ServiceParameterList.ParameterSet.Length = 3;
  
  /* Entry[0] ParameterSet 1: Extended, Scheduled, ProvidedByEVCC, pricing*/
  _ServiceDetail_PrepareResponseContent_DC_Parameter(0, 1, _CCS::DataTypes::DCConnectorType::Extended
                                                         , _CCS::DataTypes::ControlModeType::Scheduled
                                                         , _CCS::DataTypes::MobilityNeedsModeType::ProvidedByEVCC       
                                                         , (enum _CCS::DataTypes::PricingType) pricing); 
  /* Entry[1] ParameterSet 2: Extended, Dynamic, ProvidedByEVCC, pricing*/
  _ServiceDetail_PrepareResponseContent_DC_Parameter(1, 2, _CCS::DataTypes::DCConnectorType::Extended
                                                         , _CCS::DataTypes::ControlModeType::Dynamic
                                                         , _CCS::DataTypes::MobilityNeedsModeType::ProvidedByEVCC
                                                         , (enum _CCS::DataTypes::PricingType) pricing); 
  /* Entry[2] ParameterSet 3: Extended, Dynamic, ProvidedBySECCAllowed, pricing*/
  _ServiceDetail_PrepareResponseContent_DC_Parameter(2, 3, _CCS::DataTypes::DCConnectorType::Extended
                                                         , _CCS::DataTypes::ControlModeType::Dynamic
                                                         , _CCS::DataTypes::MobilityNeedsModeType::ProvidedBySECCAllowed
                                                         , (enum _CCS::DataTypes::PricingType) pricing); 
}

/// <ServiceDetail>
_ServiceDetail_PrepareResponseContent_DC_Parameter( long paramIndex
                                                  , long paramSetID
                                                  , enum _CCS::DataTypes::DCConnectorType       connector
                                                  , enum _CCS::DataTypes::ControlModeType       controlMode
                                                  , enum _CCS::DataTypes::MobilityNeedsModeType mobilityNeedsMode
                                                  , enum _CCS::DataTypes::PricingType           pricing )
{
  $EVSE.ISO20.ServiceDetail_Response.ServiceParameterList.ParameterSet[paramIndex].ParameterSetID = paramSetID;
  $EVSE.ISO20.ServiceDetail_Response.ServiceParameterList.ParameterSet[paramIndex].Parameter.DC.Connector = connector;
  $EVSE.ISO20.ServiceDetail_Response.ServiceParameterList.ParameterSet[paramIndex].Parameter.DC.ControlMode = controlMode;
  $EVSE.ISO20.ServiceDetail_Response.ServiceParameterList.ParameterSet[paramIndex].Parameter.DC.MobilityNeedsMode = mobilityNeedsMode;
  $EVSE.ISO20.ServiceDetail_Response.ServiceParameterList.ParameterSet[paramIndex].Parameter.DC.Pricing = pricing;  
}

/// <ServiceDetail>
_ServiceDetail_PrepareResponseContent_DC_BPT_List()
{
  int pricing;
  
  if(@Common::SysUserAuthorizationMode == @Common::SysUserAuthorizationMode::PnC)
    pricing = _CCS::DataTypes::PricingType::AbsolutePricing;
  else
    pricing = _CCS::DataTypes::PricingType::NoPricing;
  
  // Short or enlarge ParameterSet length if necessary
  $EVSE.ISO20.ServiceDetail_Response.ServiceParameterList.ParameterSet.Length = 3;
  
  /* Entry[0] ParameterSet 1: Core, Scheduled, ProvidedByEVCC, pricing, Unified, GridFollowing  */
  _ServiceDetail_PrepareResponseContent_DC_BPT_Parameter(0, 1, _CCS::DataTypes::DCConnectorType::Core
                                                             , _CCS::DataTypes::ControlModeType::Scheduled 
                                                             , _CCS::DataTypes::MobilityNeedsModeType::ProvidedByEVCC
                                                             , (enum _CCS::DataTypes::PricingType) pricing
                                                             , _CCS::DataTypes::BPTChannelType::Unified
                                                             , _CCS::DataTypes::GeneratorModeType::GridFollowing); 
  /* Entry[0] ParameterSet 2: Core, Dynamic, ProvidedByEVCC, pricing, Unified, GridFollowing */
  _ServiceDetail_PrepareResponseContent_DC_BPT_Parameter(1, 2, _CCS::DataTypes::DCConnectorType::Core
                                                             , _CCS::DataTypes::ControlModeType::Dynamic
                                                             , _CCS::DataTypes::MobilityNeedsModeType::ProvidedByEVCC
                                                             , (enum _CCS::DataTypes::PricingType) pricing
                                                             , _CCS::DataTypes::BPTChannelType::Unified
                                                             , _CCS::DataTypes::GeneratorModeType::GridFollowing); 
  /* Entry[1] ParameterSet 3: Core, Dynamic, ProvidedBySECCAllowed, pricing, Separated, GridFollowing */
  _ServiceDetail_PrepareResponseContent_DC_BPT_Parameter(2, 3, _CCS::DataTypes::DCConnectorType::Core
                                                             , _CCS::DataTypes::ControlModeType::Dynamic
                                                             , _CCS::DataTypes::MobilityNeedsModeType::ProvidedBySECCAllowed
                                                             , (enum _CCS::DataTypes::PricingType) pricing
                                                             , _CCS::DataTypes::BPTChannelType::Separated
                                                             , _CCS::DataTypes::GeneratorModeType::GridFollowing); 
}

/// <ServiceDetail>
_ServiceDetail_PrepareResponseContent_DC_BPT_Parameter( long paramIndex
                                                      , long paramSetID
                                                      , enum _CCS::DataTypes::DCConnectorType       connector
                                                      , enum _CCS::DataTypes::ControlModeType       controlMode
                                                      , enum _CCS::DataTypes::MobilityNeedsModeType mobilityNeedsMode
                                                      , enum _CCS::DataTypes::PricingType           pricing
                                                      , enum _CCS::DataTypes::BPTChannelType        bptChannel
                                                      , enum _CCS::DataTypes::GeneratorModeType     generatorMode )
{
  $EVSE.ISO20.ServiceDetail_Response.ServiceParameterList.ParameterSet[paramIndex].ParameterSetID = paramSetID;
  $EVSE.ISO20.ServiceDetail_Response.ServiceParameterList.ParameterSet[paramIndex].Parameter.DC_BPT.BPTChannel = bptChannel;
  $EVSE.ISO20.ServiceDetail_Response.ServiceParameterList.ParameterSet[paramIndex].Parameter.DC_BPT.Connector = connector;
  $EVSE.ISO20.ServiceDetail_Response.ServiceParameterList.ParameterSet[paramIndex].Parameter.DC_BPT.ControlMode = controlMode;
  $EVSE.ISO20.ServiceDetail_Response.ServiceParameterList.ParameterSet[paramIndex].Parameter.DC_BPT.GeneratorMode = generatorMode;
  $EVSE.ISO20.ServiceDetail_Response.ServiceParameterList.ParameterSet[paramIndex].Parameter.DC_BPT.MobilityNeedsMode = mobilityNeedsMode;
  $EVSE.ISO20.ServiceDetail_Response.ServiceParameterList.ParameterSet[paramIndex].Parameter.DC_BPT.Pricing = pricing;
}

void FUNC_Set_AuthorizationSetupRes()
{
  if(@sysvar::Common::SysUserAuthorizationMode == @sysvar::Common::SysUserAuthorizationMode::PnC)
  {
    // ensure PnC element is active and add a default value
    $CCS::Simulation::EVSE.ISO20.AuthorizationSetup_Response.ASResAuthorizationModeElementId = _CCS::DataTypes::parISO20ASResAuthorizationMode::PnC_ASRes;
    $CCS::Simulation::EVSE.ISO20.AuthorizationSetup_Response.ASResAuthorizationMode.PnC_ASResAuthorizationMode.SupportedProviders.ProviderID.Length = 1;
    $CCS::Simulation::EVSE.ISO20.AuthorizationSetup_Response.ASResAuthorizationMode.PnC_ASResAuthorizationMode.SupportedProviders.ProviderID[0] = "Vector";
  }
}

void FUNC_Set_EVSEDCLimits_ChargeParameterDiscoveryRes()
{
  /* EVSEMaximumChargePower */
  $EVSE.ISO20.DC_ChargeParameterDiscovery_Response.CPDResEnergyTransferMode.DC_CPDResEnergyTransferMode.EVSEMaximumChargePower.Value = @sysvar::EVSE_Sim::SysEVSE_MaxPowerDC;
  $EVSE.ISO20.DC_ChargeParameterDiscovery_Response.CPDResEnergyTransferMode.DC_CPDResEnergyTransferMode.EVSEMaximumChargePower.Exponent = 3; //Unit: kW
  $EVSE.ISO20.DC_ChargeParameterDiscovery_Response.CPDResEnergyTransferMode.BPT_DC_CPDResEnergyTransferMode.EVSEMaximumChargePower.Value = @sysvar::EVSE_Sim::SysEVSE_MaxPowerDC;
  $EVSE.ISO20.DC_ChargeParameterDiscovery_Response.CPDResEnergyTransferMode.BPT_DC_CPDResEnergyTransferMode.EVSEMaximumChargePower.Exponent = 3; //Unit: kW
  
  /* EVSEMinimumChargePower */
  $EVSE.ISO20.DC_ChargeParameterDiscovery_Response.CPDResEnergyTransferMode.DC_CPDResEnergyTransferMode.EVSEMinimumChargePower.Value = @sysvar::EVSE_Sim::SysEVSE_MinPowerDC;
  $EVSE.ISO20.DC_ChargeParameterDiscovery_Response.CPDResEnergyTransferMode.DC_CPDResEnergyTransferMode.EVSEMinimumChargePower.Exponent = 3; //Unit: kW
  $EVSE.ISO20.DC_ChargeParameterDiscovery_Response.CPDResEnergyTransferMode.BPT_DC_CPDResEnergyTransferMode.EVSEMinimumChargePower.Value = @sysvar::EVSE_Sim::SysEVSE_MinPowerDC;
  $EVSE.ISO20.DC_ChargeParameterDiscovery_Response.CPDResEnergyTransferMode.BPT_DC_CPDResEnergyTransferMode.EVSEMinimumChargePower.Exponent = 3; //Unit: kW
  
  /* EVSEMaximumChargeCurrent */
  $EVSE.ISO20.DC_ChargeParameterDiscovery_Response.CPDResEnergyTransferMode.DC_CPDResEnergyTransferMode.EVSEMaximumChargeCurrent.Value = @sysvar::EVSE_Sim::SysEVSE_MaxCurrent;
  $EVSE.ISO20.DC_ChargeParameterDiscovery_Response.CPDResEnergyTransferMode.DC_CPDResEnergyTransferMode.EVSEMaximumChargeCurrent.Exponent = 0;
  $EVSE.ISO20.DC_ChargeParameterDiscovery_Response.CPDResEnergyTransferMode.BPT_DC_CPDResEnergyTransferMode.EVSEMaximumChargeCurrent.Value = @sysvar::EVSE_Sim::SysEVSE_MaxCurrent;
  $EVSE.ISO20.DC_ChargeParameterDiscovery_Response.CPDResEnergyTransferMode.BPT_DC_CPDResEnergyTransferMode.EVSEMaximumChargeCurrent.Exponent = 0;
  
  /* EVSEMaximumVoltage */
  $EVSE.ISO20.DC_ChargeParameterDiscovery_Response.CPDResEnergyTransferMode.DC_CPDResEnergyTransferMode.EVSEMaximumVoltage.Value = @sysvar::EVSE_Sim::SysEVSE_MaxVoltage;
  $EVSE.ISO20.DC_ChargeParameterDiscovery_Response.CPDResEnergyTransferMode.DC_CPDResEnergyTransferMode.EVSEMaximumVoltage.Exponent = 0;
  $EVSE.ISO20.DC_ChargeParameterDiscovery_Response.CPDResEnergyTransferMode.BPT_DC_CPDResEnergyTransferMode.EVSEMaximumVoltage.Value = @sysvar::EVSE_Sim::SysEVSE_MaxVoltage;
  $EVSE.ISO20.DC_ChargeParameterDiscovery_Response.CPDResEnergyTransferMode.BPT_DC_CPDResEnergyTransferMode.EVSEMaximumVoltage.Exponent = 0;
  
  /* EVSEMinimumVoltage */
  $EVSE.ISO20.DC_ChargeParameterDiscovery_Response.CPDResEnergyTransferMode.DC_CPDResEnergyTransferMode.EVSEMinimumVoltage.Value = @sysvar::EVSE_Sim::SysEVSE_MinVoltage;
  $EVSE.ISO20.DC_ChargeParameterDiscovery_Response.CPDResEnergyTransferMode.DC_CPDResEnergyTransferMode.EVSEMinimumVoltage.Exponent = 0;
  $EVSE.ISO20.DC_ChargeParameterDiscovery_Response.CPDResEnergyTransferMode.BPT_DC_CPDResEnergyTransferMode.EVSEMinimumVoltage.Value = @sysvar::EVSE_Sim::SysEVSE_MinVoltage;
  $EVSE.ISO20.DC_ChargeParameterDiscovery_Response.CPDResEnergyTransferMode.BPT_DC_CPDResEnergyTransferMode.EVSEMinimumVoltage.Exponent = 0;
  
  /* EVSEMaximumDischargePower */
  $EVSE.ISO20.DC_ChargeParameterDiscovery_Response.CPDResEnergyTransferMode.BPT_DC_CPDResEnergyTransferMode.EVSEMaximumDischargePower.Value = - abs(@sysvar::EVSE_Sim::SysEVSE_MaxPowerDC);
  $EVSE.ISO20.DC_ChargeParameterDiscovery_Response.CPDResEnergyTransferMode.BPT_DC_CPDResEnergyTransferMode.EVSEMaximumDischargePower.Exponent = 3; //Unit: kW
  
  /* EVSEMinimumDischargePower */
  $EVSE.ISO20.DC_ChargeParameterDiscovery_Response.CPDResEnergyTransferMode.BPT_DC_CPDResEnergyTransferMode.EVSEMinimumDischargePower.Value = - abs(@sysvar::EVSE_Sim::SysEVSE_MinPowerDC);
  $EVSE.ISO20.DC_ChargeParameterDiscovery_Response.CPDResEnergyTransferMode.BPT_DC_CPDResEnergyTransferMode.EVSEMinimumDischargePower.Exponent = 3; //Unit: kW
  
  /* EVSEMaximumDischargeCurrent */
  $EVSE.ISO20.DC_ChargeParameterDiscovery_Response.CPDResEnergyTransferMode.BPT_DC_CPDResEnergyTransferMode.EVSEMaximumDischargeCurrent.Value = - abs(@sysvar::EVSE_Sim::SysEVSE_MaxCurrent);
  $EVSE.ISO20.DC_ChargeParameterDiscovery_Response.CPDResEnergyTransferMode.BPT_DC_CPDResEnergyTransferMode.EVSEMaximumDischargeCurrent.Exponent = 0;
}

void FUNC_Set_EVSEACLimits_ChargeParameterDiscoveryRes()
{
  /* EVSEMaximumChargePower */
  $EVSE.ISO20.AC_ChargeParameterDiscovery_Response.CPDResEnergyTransferMode.AC_CPDResEnergyTransferMode.EVSEMaximumChargePower.Value = @sysvar::EVSE_Sim::SysEVSE_MaxPowerAC;
  $EVSE.ISO20.AC_ChargeParameterDiscovery_Response.CPDResEnergyTransferMode.AC_CPDResEnergyTransferMode.EVSEMaximumChargePower.Exponent = 3; //Unit: kW
  $EVSE.ISO20.AC_ChargeParameterDiscovery_Response.CPDResEnergyTransferMode.BPT_AC_CPDResEnergyTransferMode.EVSEMaximumChargePower.Value = @sysvar::EVSE_Sim::SysEVSE_MaxPowerAC;
  $EVSE.ISO20.AC_ChargeParameterDiscovery_Response.CPDResEnergyTransferMode.BPT_AC_CPDResEnergyTransferMode.EVSEMaximumChargePower.Exponent = 3; //Unit: kW
  
  /* EVSEMaximumChargePower L2 */
  $EVSE.ISO20.AC_ChargeParameterDiscovery_Response.CPDResEnergyTransferMode.AC_CPDResEnergyTransferMode.EVSEMaximumChargePower_L2.Value = @sysvar::EVSE_Sim::SysEVSE_MaxPowerAC;
  $EVSE.ISO20.AC_ChargeParameterDiscovery_Response.CPDResEnergyTransferMode.AC_CPDResEnergyTransferMode.EVSEMaximumChargePower_L2.Exponent = 3; //Unit: kW
  $EVSE.ISO20.AC_ChargeParameterDiscovery_Response.CPDResEnergyTransferMode.BPT_AC_CPDResEnergyTransferMode.EVSEMaximumChargePower_L2.Value = @sysvar::EVSE_Sim::SysEVSE_MaxPowerAC;
  $EVSE.ISO20.AC_ChargeParameterDiscovery_Response.CPDResEnergyTransferMode.BPT_AC_CPDResEnergyTransferMode.EVSEMaximumChargePower_L2.Exponent = 3; //Unit: kW
  
  /* EVSEMaximumChargePower L3 */
  $EVSE.ISO20.AC_ChargeParameterDiscovery_Response.CPDResEnergyTransferMode.AC_CPDResEnergyTransferMode.EVSEMaximumChargePower_L3.Value = @sysvar::EVSE_Sim::SysEVSE_MaxPowerAC;
  $EVSE.ISO20.AC_ChargeParameterDiscovery_Response.CPDResEnergyTransferMode.AC_CPDResEnergyTransferMode.EVSEMaximumChargePower_L3.Exponent = 3; //Unit: kW
  $EVSE.ISO20.AC_ChargeParameterDiscovery_Response.CPDResEnergyTransferMode.BPT_AC_CPDResEnergyTransferMode.EVSEMaximumChargePower_L3.Value = @sysvar::EVSE_Sim::SysEVSE_MaxPowerAC;
  $EVSE.ISO20.AC_ChargeParameterDiscovery_Response.CPDResEnergyTransferMode.BPT_AC_CPDResEnergyTransferMode.EVSEMaximumChargePower_L3.Exponent = 3; //Unit: kW
  
  /* EVSEMinimumChargePower */
  $EVSE.ISO20.AC_ChargeParameterDiscovery_Response.CPDResEnergyTransferMode.AC_CPDResEnergyTransferMode.EVSEMinimumChargePower.Value = @sysvar::EVSE_Sim::SysEVSE_MinPowerAC;
  $EVSE.ISO20.AC_ChargeParameterDiscovery_Response.CPDResEnergyTransferMode.AC_CPDResEnergyTransferMode.EVSEMinimumChargePower.Exponent = 3; //Unit: kW
  $EVSE.ISO20.AC_ChargeParameterDiscovery_Response.CPDResEnergyTransferMode.BPT_AC_CPDResEnergyTransferMode.EVSEMinimumChargePower.Value = @sysvar::EVSE_Sim::SysEVSE_MinPowerAC;
  $EVSE.ISO20.AC_ChargeParameterDiscovery_Response.CPDResEnergyTransferMode.BPT_AC_CPDResEnergyTransferMode.EVSEMinimumChargePower.Exponent = 3; //Unit: kW
  
  /* EVSEMinimumChargePower L2 */
  $EVSE.ISO20.AC_ChargeParameterDiscovery_Response.CPDResEnergyTransferMode.AC_CPDResEnergyTransferMode.EVSEMinimumChargePower_L2.Value = @sysvar::EVSE_Sim::SysEVSE_MinPowerAC;
  $EVSE.ISO20.AC_ChargeParameterDiscovery_Response.CPDResEnergyTransferMode.AC_CPDResEnergyTransferMode.EVSEMinimumChargePower_L2.Exponent = 3; //Unit: kW
  $EVSE.ISO20.AC_ChargeParameterDiscovery_Response.CPDResEnergyTransferMode.BPT_AC_CPDResEnergyTransferMode.EVSEMinimumChargePower_L2.Value = @sysvar::EVSE_Sim::SysEVSE_MinPowerAC;
  $EVSE.ISO20.AC_ChargeParameterDiscovery_Response.CPDResEnergyTransferMode.BPT_AC_CPDResEnergyTransferMode.EVSEMinimumChargePower_L2.Exponent = 3; //Unit: kW
  
  /* EVSEMinimumChargePower L3 */
  $EVSE.ISO20.AC_ChargeParameterDiscovery_Response.CPDResEnergyTransferMode.AC_CPDResEnergyTransferMode.EVSEMinimumChargePower_L3.Value = @sysvar::EVSE_Sim::SysEVSE_MinPowerAC;
  $EVSE.ISO20.AC_ChargeParameterDiscovery_Response.CPDResEnergyTransferMode.AC_CPDResEnergyTransferMode.EVSEMinimumChargePower_L3.Exponent = 3; //Unit: kW
  $EVSE.ISO20.AC_ChargeParameterDiscovery_Response.CPDResEnergyTransferMode.BPT_AC_CPDResEnergyTransferMode.EVSEMinimumChargePower_L3.Value = @sysvar::EVSE_Sim::SysEVSE_MinPowerAC;
  $EVSE.ISO20.AC_ChargeParameterDiscovery_Response.CPDResEnergyTransferMode.BPT_AC_CPDResEnergyTransferMode.EVSEMinimumChargePower_L3.Exponent = 3; //Unit: kW

  /* EVSEMaximumDischargePower */
  $EVSE.ISO20.AC_ChargeParameterDiscovery_Response.CPDResEnergyTransferMode.BPT_AC_CPDResEnergyTransferMode.EVSEMaximumDischargePower.Value = - abs(@sysvar::EVSE_Sim::SysEVSE_MaxPowerAC);
  $EVSE.ISO20.AC_ChargeParameterDiscovery_Response.CPDResEnergyTransferMode.BPT_AC_CPDResEnergyTransferMode.EVSEMaximumDischargePower.Exponent = 3; //Unit: kW
  
  /* EVSEMaximumDischargePower L2 */
  $EVSE.ISO20.AC_ChargeParameterDiscovery_Response.CPDResEnergyTransferMode.BPT_AC_CPDResEnergyTransferMode.EVSEMaximumDischargePower_L2.Value = - abs(@sysvar::EVSE_Sim::SysEVSE_MaxPowerAC);
  $EVSE.ISO20.AC_ChargeParameterDiscovery_Response.CPDResEnergyTransferMode.BPT_AC_CPDResEnergyTransferMode.EVSEMaximumDischargePower_L2.Exponent = 3; //Unit: kW
  
  /* EVSEMaximumDischargePower L3 */
  $EVSE.ISO20.AC_ChargeParameterDiscovery_Response.CPDResEnergyTransferMode.BPT_AC_CPDResEnergyTransferMode.EVSEMaximumDischargePower_L3.Value = - abs(@sysvar::EVSE_Sim::SysEVSE_MaxPowerAC);
  $EVSE.ISO20.AC_ChargeParameterDiscovery_Response.CPDResEnergyTransferMode.BPT_AC_CPDResEnergyTransferMode.EVSEMaximumDischargePower_L3.Exponent = 3; //Unit: kW
  
  /* EVSEMinimumDischargePower */
  $EVSE.ISO20.AC_ChargeParameterDiscovery_Response.CPDResEnergyTransferMode.BPT_AC_CPDResEnergyTransferMode.EVSEMinimumDischargePower.Value = - abs(@sysvar::EVSE_Sim::SysEVSE_MinPowerAC);
  $EVSE.ISO20.AC_ChargeParameterDiscovery_Response.CPDResEnergyTransferMode.BPT_AC_CPDResEnergyTransferMode.EVSEMinimumDischargePower.Exponent = 3; //Unit: kW
  
  /* EVSEMinimumDischargePower L2 */
  $EVSE.ISO20.AC_ChargeParameterDiscovery_Response.CPDResEnergyTransferMode.BPT_AC_CPDResEnergyTransferMode.EVSEMinimumDischargePower_L2.Value = - abs(@sysvar::EVSE_Sim::SysEVSE_MinPowerAC);
  $EVSE.ISO20.AC_ChargeParameterDiscovery_Response.CPDResEnergyTransferMode.BPT_AC_CPDResEnergyTransferMode.EVSEMinimumDischargePower_L2.Exponent = 3; //Unit: kW
  
  /* EVSEMinimumDischargePower L3 */
  $EVSE.ISO20.AC_ChargeParameterDiscovery_Response.CPDResEnergyTransferMode.BPT_AC_CPDResEnergyTransferMode.EVSEMinimumDischargePower_L3.Value = - abs(@sysvar::EVSE_Sim::SysEVSE_MinPowerAC);
  $EVSE.ISO20.AC_ChargeParameterDiscovery_Response.CPDResEnergyTransferMode.BPT_AC_CPDResEnergyTransferMode.EVSEMinimumDischargePower_L3.Exponent = 3; //Unit: kW
}

void FUNC_Set_EVSEACDERLimits_ChargeParameterDiscoveryRes()
{
  EVSE.ISO20.EnableAutoBodyFill.Call(0);
  AutoFill_body = 0;
  
  if((@Common::SysUserACDERMode == 0) && (@Common::SysUserBPTMode == 0))
    UseACElement();
  else if(@Common::SysUserBPTMode == 1)
    UseACBPTElement();
  else
    UseACDERElement();
}

void UseACElement()
{
  /* EVSEMaximumChargePower */
  $EVSE.ISO20.AC_DER_ChargeParameterDiscovery_Response.CPDResEnergyTransferMode.AC_CPDResEnergyTransferMode.EVSEMaximumChargePower.Value = @sysvar::EVSE_Sim::SysEVSE_MaxPowerAC;
  $EVSE.ISO20.AC_DER_ChargeParameterDiscovery_Response.CPDResEnergyTransferMode.AC_CPDResEnergyTransferMode.EVSEMaximumChargePower.Exponent = 3; //Unit: kW
}

void UseACBPTElement()
{
  /* EVSEMaximumChargePower */
  $EVSE.ISO20.AC_DER_ChargeParameterDiscovery_Response.CPDResEnergyTransferMode.BPT_AC_CPDResEnergyTransferMode.EVSEMaximumChargePower.Value = @sysvar::EVSE_Sim::SysEVSE_MaxPowerAC;
  $EVSE.ISO20.AC_DER_ChargeParameterDiscovery_Response.CPDResEnergyTransferMode.BPT_AC_CPDResEnergyTransferMode.EVSEMaximumChargePower.Exponent = 3; //Unit: kW
}

void UseACDERElement()
{
  // AC_CPDResEnergyTransferMode
  /* EVSEMaximumChargePower */
  $EVSE.ISO20.AC_DER_ChargeParameterDiscovery_Response.CPDResEnergyTransferMode.DER_AC_CPDResEnergyTransferMode.EVSEMaximumChargePower.Value = @sysvar::EVSE_Sim::SysEVSE_MaxPowerAC;
  $EVSE.ISO20.AC_DER_ChargeParameterDiscovery_Response.CPDResEnergyTransferMode.DER_AC_CPDResEnergyTransferMode.EVSEMaximumChargePower.Exponent = 3; //Unit: kW
  
  /* EVSEMaximumChargePower L2 */
  $EVSE.ISO20.AC_DER_ChargeParameterDiscovery_Response.CPDResEnergyTransferMode.DER_AC_CPDResEnergyTransferMode.EVSEMaximumChargePower_L2.Value = @sysvar::EVSE_Sim::SysEVSE_MaxPowerAC;
  $EVSE.ISO20.AC_DER_ChargeParameterDiscovery_Response.CPDResEnergyTransferMode.DER_AC_CPDResEnergyTransferMode.EVSEMaximumChargePower_L2.Exponent = 3; //Unit: kW
  
  /* EVSEMaximumChargePower L3 */
  $EVSE.ISO20.AC_DER_ChargeParameterDiscovery_Response.CPDResEnergyTransferMode.DER_AC_CPDResEnergyTransferMode.EVSEMaximumChargePower_L3.Value = @sysvar::EVSE_Sim::SysEVSE_MaxPowerAC;
  $EVSE.ISO20.AC_DER_ChargeParameterDiscovery_Response.CPDResEnergyTransferMode.DER_AC_CPDResEnergyTransferMode.EVSEMaximumChargePower_L3.Exponent = 3; //Unit: kW
  
  /* EVSEMinimumChargePower */
  $EVSE.ISO20.AC_DER_ChargeParameterDiscovery_Response.CPDResEnergyTransferMode.DER_AC_CPDResEnergyTransferMode.EVSEMinimumChargePower.Value = @sysvar::EVSE_Sim::SysEVSE_MinPowerAC;
  $EVSE.ISO20.AC_DER_ChargeParameterDiscovery_Response.CPDResEnergyTransferMode.DER_AC_CPDResEnergyTransferMode.EVSEMinimumChargePower.Exponent = 3; //Unit: kW
  
  /* EVSEMinimumChargePower L2 */
  $EVSE.ISO20.AC_DER_ChargeParameterDiscovery_Response.CPDResEnergyTransferMode.DER_AC_CPDResEnergyTransferMode.EVSEMinimumChargePower_L2.Value = @sysvar::EVSE_Sim::SysEVSE_MinPowerAC;
  $EVSE.ISO20.AC_DER_ChargeParameterDiscovery_Response.CPDResEnergyTransferMode.DER_AC_CPDResEnergyTransferMode.EVSEMinimumChargePower_L2.Exponent = 3; //Unit: kW
  
  /* EVSEMinimumChargePower L3 */
  $EVSE.ISO20.AC_DER_ChargeParameterDiscovery_Response.CPDResEnergyTransferMode.DER_AC_CPDResEnergyTransferMode.EVSEMinimumChargePower_L3.Value = @sysvar::EVSE_Sim::SysEVSE_MinPowerAC;
  $EVSE.ISO20.AC_DER_ChargeParameterDiscovery_Response.CPDResEnergyTransferMode.DER_AC_CPDResEnergyTransferMode.EVSEMinimumChargePower_L3.Exponent = 3; //Unit: kW
  

  /* EVSEStatus */
  $EVSE.ISO20.AC_DER_ChargeParameterDiscovery_Response.CPDResEnergyTransferMode.DER_AC_CPDResEnergyTransferMode.EVSEStatus.NotificationMaxDelay = 5;
  $EVSE.ISO20.AC_DER_ChargeParameterDiscovery_Response.CPDResEnergyTransferMode.DER_AC_CPDResEnergyTransferMode.EVSEStatus.EVSENotification = _CCS::DataTypes::EVSENotificationType::ExitStandby;

  /* DERControl */
    /* VoltageTrip */
    $EVSE.ISO20.AC_DER_ChargeParameterDiscovery_Response.CPDResEnergyTransferMode.DER_AC_CPDResEnergyTransferMode.DERControl.VoltageTrip.OverVoltageMustTripCurve.Enable = 1;
    $EVSE.ISO20.AC_DER_ChargeParameterDiscovery_Response.CPDResEnergyTransferMode.DER_AC_CPDResEnergyTransferMode.DERControl.VoltageTrip.OverVoltageMustTripCurve.Priority = 2;
    $EVSE.ISO20.AC_DER_ChargeParameterDiscovery_Response.CPDResEnergyTransferMode.DER_AC_CPDResEnergyTransferMode.DERControl.VoltageTrip.OverVoltageMustTripCurve.xUnit = _CCS::DataTypes::CurveDataPointsUnitType::W;
    $EVSE.ISO20.AC_DER_ChargeParameterDiscovery_Response.CPDResEnergyTransferMode.DER_AC_CPDResEnergyTransferMode.DERControl.VoltageTrip.OverVoltageMustTripCurve.yUnit = _CCS::DataTypes::CurveDataPointsUnitType::W;
    $EVSE.ISO20.AC_DER_ChargeParameterDiscovery_Response.CPDResEnergyTransferMode.DER_AC_CPDResEnergyTransferMode.DERControl.VoltageTrip.OverVoltageMustTripCurve.CurveDataPoints.CurveDataPoint.Length = 3;
    $EVSE.ISO20.AC_DER_ChargeParameterDiscovery_Response.CPDResEnergyTransferMode.DER_AC_CPDResEnergyTransferMode.DERControl.VoltageTrip.OverVoltageMustTripCurve.CurveDataPoints.CurveDataPoint[0].x.Exponent = 1;
    $EVSE.ISO20.AC_DER_ChargeParameterDiscovery_Response.CPDResEnergyTransferMode.DER_AC_CPDResEnergyTransferMode.DERControl.VoltageTrip.OverVoltageMustTripCurve.CurveDataPoints.CurveDataPoint[0].x.Value = 2;
    $EVSE.ISO20.AC_DER_ChargeParameterDiscovery_Response.CPDResEnergyTransferMode.DER_AC_CPDResEnergyTransferMode.DERControl.VoltageTrip.OverVoltageMustTripCurve.CurveDataPoints.CurveDataPoint[0].y.Exponent = 1;
    $EVSE.ISO20.AC_DER_ChargeParameterDiscovery_Response.CPDResEnergyTransferMode.DER_AC_CPDResEnergyTransferMode.DERControl.VoltageTrip.OverVoltageMustTripCurve.CurveDataPoints.CurveDataPoint[0].y.Value = 2;
    $EVSE.ISO20.AC_DER_ChargeParameterDiscovery_Response.CPDResEnergyTransferMode.DER_AC_CPDResEnergyTransferMode.DERControl.VoltageTrip.OverVoltageMustTripCurve.CurveDataPoints.CurveDataPoint[1].x.Exponent = 1;
    $EVSE.ISO20.AC_DER_ChargeParameterDiscovery_Response.CPDResEnergyTransferMode.DER_AC_CPDResEnergyTransferMode.DERControl.VoltageTrip.OverVoltageMustTripCurve.CurveDataPoints.CurveDataPoint[1].x.Value = 2;
    $EVSE.ISO20.AC_DER_ChargeParameterDiscovery_Response.CPDResEnergyTransferMode.DER_AC_CPDResEnergyTransferMode.DERControl.VoltageTrip.OverVoltageMustTripCurve.CurveDataPoints.CurveDataPoint[1].y.Exponent = 1;
    $EVSE.ISO20.AC_DER_ChargeParameterDiscovery_Response.CPDResEnergyTransferMode.DER_AC_CPDResEnergyTransferMode.DERControl.VoltageTrip.OverVoltageMustTripCurve.CurveDataPoints.CurveDataPoint[1].y.Value = 2;
    $EVSE.ISO20.AC_DER_ChargeParameterDiscovery_Response.CPDResEnergyTransferMode.DER_AC_CPDResEnergyTransferMode.DERControl.VoltageTrip.OverVoltageMustTripCurve.CurveDataPoints.CurveDataPoint[2].x.Exponent = 1;
    $EVSE.ISO20.AC_DER_ChargeParameterDiscovery_Response.CPDResEnergyTransferMode.DER_AC_CPDResEnergyTransferMode.DERControl.VoltageTrip.OverVoltageMustTripCurve.CurveDataPoints.CurveDataPoint[2].x.Value = 2;
    $EVSE.ISO20.AC_DER_ChargeParameterDiscovery_Response.CPDResEnergyTransferMode.DER_AC_CPDResEnergyTransferMode.DERControl.VoltageTrip.OverVoltageMustTripCurve.CurveDataPoints.CurveDataPoint[2].y.Exponent = 1;
    $EVSE.ISO20.AC_DER_ChargeParameterDiscovery_Response.CPDResEnergyTransferMode.DER_AC_CPDResEnergyTransferMode.DERControl.VoltageTrip.OverVoltageMustTripCurve.CurveDataPoints.CurveDataPoint[2].y.Value = 2;
    $EVSE.ISO20.AC_DER_ChargeParameterDiscovery_Response.CPDResEnergyTransferMode.DER_AC_CPDResEnergyTransferMode.DERControl.VoltageTrip.OverVoltageMustTripCurve.LockInValue = _CCS::DataTypes::LockValueUnitType::W;
    $EVSE.ISO20.AC_DER_ChargeParameterDiscovery_Response.CPDResEnergyTransferMode.DER_AC_CPDResEnergyTransferMode.DERControl.VoltageTrip.OverVoltageMustTripCurve.LockOutValue = _CCS::DataTypes::LockValueUnitType::W;
    $EVSE.ISO20.AC_DER_ChargeParameterDiscovery_Response.CPDResEnergyTransferMode.DER_AC_CPDResEnergyTransferMode.DERControl.VoltageTrip.OverVoltageMustTripCurve.OpenLoopResponseTime.Exponent = 2;
    $EVSE.ISO20.AC_DER_ChargeParameterDiscovery_Response.CPDResEnergyTransferMode.DER_AC_CPDResEnergyTransferMode.DERControl.VoltageTrip.OverVoltageMustTripCurve.OpenLoopResponseTime.Value = 1;
    $EVSE.ISO20.AC_DER_ChargeParameterDiscovery_Response.CPDResEnergyTransferMode.DER_AC_CPDResEnergyTransferMode.DERControl.VoltageTrip.OverVoltageMustTripCurve.TimeConstantPT1 = 2;
    $EVSE.ISO20.AC_DER_ChargeParameterDiscovery_Response.CPDResEnergyTransferMode.DER_AC_CPDResEnergyTransferMode.DERControl.VoltageTrip.OverVoltageMustTripCurve.IntentionalDelay.Exponent = 2;
    $EVSE.ISO20.AC_DER_ChargeParameterDiscovery_Response.CPDResEnergyTransferMode.DER_AC_CPDResEnergyTransferMode.DERControl.VoltageTrip.OverVoltageMustTripCurve.IntentionalDelay.Value = 1;
  
    $EVSE.ISO20.AC_DER_ChargeParameterDiscovery_Response.CPDResEnergyTransferMode.DER_AC_CPDResEnergyTransferMode.DERControl.VoltageTrip.UnderVoltageMustTripCurve.Enable = 1;
    $EVSE.ISO20.AC_DER_ChargeParameterDiscovery_Response.CPDResEnergyTransferMode.DER_AC_CPDResEnergyTransferMode.DERControl.VoltageTrip.UnderVoltageMustTripCurve.Priority = 2;
    $EVSE.ISO20.AC_DER_ChargeParameterDiscovery_Response.CPDResEnergyTransferMode.DER_AC_CPDResEnergyTransferMode.DERControl.VoltageTrip.UnderVoltageMustTripCurve.xUnit = _CCS::DataTypes::CurveDataPointsUnitType::W;
    $EVSE.ISO20.AC_DER_ChargeParameterDiscovery_Response.CPDResEnergyTransferMode.DER_AC_CPDResEnergyTransferMode.DERControl.VoltageTrip.UnderVoltageMustTripCurve.yUnit = _CCS::DataTypes::CurveDataPointsUnitType::W;
    $EVSE.ISO20.AC_DER_ChargeParameterDiscovery_Response.CPDResEnergyTransferMode.DER_AC_CPDResEnergyTransferMode.DERControl.VoltageTrip.UnderVoltageMustTripCurve.CurveDataPoints.CurveDataPoint.Length = 3;
    $EVSE.ISO20.AC_DER_ChargeParameterDiscovery_Response.CPDResEnergyTransferMode.DER_AC_CPDResEnergyTransferMode.DERControl.VoltageTrip.UnderVoltageMustTripCurve.CurveDataPoints.CurveDataPoint[0].x.Exponent = 1;
    $EVSE.ISO20.AC_DER_ChargeParameterDiscovery_Response.CPDResEnergyTransferMode.DER_AC_CPDResEnergyTransferMode.DERControl.VoltageTrip.UnderVoltageMustTripCurve.CurveDataPoints.CurveDataPoint[0].x.Value = 2;
    $EVSE.ISO20.AC_DER_ChargeParameterDiscovery_Response.CPDResEnergyTransferMode.DER_AC_CPDResEnergyTransferMode.DERControl.VoltageTrip.UnderVoltageMustTripCurve.CurveDataPoints.CurveDataPoint[0].y.Exponent = 1;
    $EVSE.ISO20.AC_DER_ChargeParameterDiscovery_Response.CPDResEnergyTransferMode.DER_AC_CPDResEnergyTransferMode.DERControl.VoltageTrip.UnderVoltageMustTripCurve.CurveDataPoints.CurveDataPoint[0].y.Value = 2;
    $EVSE.ISO20.AC_DER_ChargeParameterDiscovery_Response.CPDResEnergyTransferMode.DER_AC_CPDResEnergyTransferMode.DERControl.VoltageTrip.UnderVoltageMustTripCurve.CurveDataPoints.CurveDataPoint[1].x.Exponent = 1;
    $EVSE.ISO20.AC_DER_ChargeParameterDiscovery_Response.CPDResEnergyTransferMode.DER_AC_CPDResEnergyTransferMode.DERControl.VoltageTrip.UnderVoltageMustTripCurve.CurveDataPoints.CurveDataPoint[1].x.Value = 2;
    $EVSE.ISO20.AC_DER_ChargeParameterDiscovery_Response.CPDResEnergyTransferMode.DER_AC_CPDResEnergyTransferMode.DERControl.VoltageTrip.UnderVoltageMustTripCurve.CurveDataPoints.CurveDataPoint[1].y.Exponent = 1;
    $EVSE.ISO20.AC_DER_ChargeParameterDiscovery_Response.CPDResEnergyTransferMode.DER_AC_CPDResEnergyTransferMode.DERControl.VoltageTrip.UnderVoltageMustTripCurve.CurveDataPoints.CurveDataPoint[1].y.Value = 2;
    $EVSE.ISO20.AC_DER_ChargeParameterDiscovery_Response.CPDResEnergyTransferMode.DER_AC_CPDResEnergyTransferMode.DERControl.VoltageTrip.UnderVoltageMustTripCurve.CurveDataPoints.CurveDataPoint[2].x.Exponent = 1;
    $EVSE.ISO20.AC_DER_ChargeParameterDiscovery_Response.CPDResEnergyTransferMode.DER_AC_CPDResEnergyTransferMode.DERControl.VoltageTrip.UnderVoltageMustTripCurve.CurveDataPoints.CurveDataPoint[2].x.Value = 2;
    $EVSE.ISO20.AC_DER_ChargeParameterDiscovery_Response.CPDResEnergyTransferMode.DER_AC_CPDResEnergyTransferMode.DERControl.VoltageTrip.UnderVoltageMustTripCurve.CurveDataPoints.CurveDataPoint[2].y.Exponent = 1;
    $EVSE.ISO20.AC_DER_ChargeParameterDiscovery_Response.CPDResEnergyTransferMode.DER_AC_CPDResEnergyTransferMode.DERControl.VoltageTrip.UnderVoltageMustTripCurve.CurveDataPoints.CurveDataPoint[2].y.Value = 2;
    $EVSE.ISO20.AC_DER_ChargeParameterDiscovery_Response.CPDResEnergyTransferMode.DER_AC_CPDResEnergyTransferMode.DERControl.VoltageTrip.UnderVoltageMustTripCurve.LockInValue = _CCS::DataTypes::LockValueUnitType::W;
    $EVSE.ISO20.AC_DER_ChargeParameterDiscovery_Response.CPDResEnergyTransferMode.DER_AC_CPDResEnergyTransferMode.DERControl.VoltageTrip.UnderVoltageMustTripCurve.LockOutValue = _CCS::DataTypes::LockValueUnitType::W;
    $EVSE.ISO20.AC_DER_ChargeParameterDiscovery_Response.CPDResEnergyTransferMode.DER_AC_CPDResEnergyTransferMode.DERControl.VoltageTrip.UnderVoltageMustTripCurve.OpenLoopResponseTime.Exponent = 2;
    $EVSE.ISO20.AC_DER_ChargeParameterDiscovery_Response.CPDResEnergyTransferMode.DER_AC_CPDResEnergyTransferMode.DERControl.VoltageTrip.UnderVoltageMustTripCurve.OpenLoopResponseTime.Value = 1;
    $EVSE.ISO20.AC_DER_ChargeParameterDiscovery_Response.CPDResEnergyTransferMode.DER_AC_CPDResEnergyTransferMode.DERControl.VoltageTrip.UnderVoltageMustTripCurve.TimeConstantPT1 = 2;
    $EVSE.ISO20.AC_DER_ChargeParameterDiscovery_Response.CPDResEnergyTransferMode.DER_AC_CPDResEnergyTransferMode.DERControl.VoltageTrip.UnderVoltageMustTripCurve.IntentionalDelay.Exponent = 2;
    $EVSE.ISO20.AC_DER_ChargeParameterDiscovery_Response.CPDResEnergyTransferMode.DER_AC_CPDResEnergyTransferMode.DERControl.VoltageTrip.UnderVoltageMustTripCurve.IntentionalDelay.Value = 1;

    $EVSE.ISO20.AC_DER_ChargeParameterDiscovery_Response.CPDResEnergyTransferMode.DER_AC_CPDResEnergyTransferMode.DERControl.VoltageTrip.OverVoltageMomentaryCessationTripCurve.Enable = 1;
    $EVSE.ISO20.AC_DER_ChargeParameterDiscovery_Response.CPDResEnergyTransferMode.DER_AC_CPDResEnergyTransferMode.DERControl.VoltageTrip.OverVoltageMomentaryCessationTripCurve.Priority = 2;
    $EVSE.ISO20.AC_DER_ChargeParameterDiscovery_Response.CPDResEnergyTransferMode.DER_AC_CPDResEnergyTransferMode.DERControl.VoltageTrip.OverVoltageMomentaryCessationTripCurve.xUnit = _CCS::DataTypes::CurveDataPointsUnitType::W;
    $EVSE.ISO20.AC_DER_ChargeParameterDiscovery_Response.CPDResEnergyTransferMode.DER_AC_CPDResEnergyTransferMode.DERControl.VoltageTrip.OverVoltageMomentaryCessationTripCurve.yUnit = _CCS::DataTypes::CurveDataPointsUnitType::W;
    $EVSE.ISO20.AC_DER_ChargeParameterDiscovery_Response.CPDResEnergyTransferMode.DER_AC_CPDResEnergyTransferMode.DERControl.VoltageTrip.OverVoltageMomentaryCessationTripCurve.CurveDataPoints.CurveDataPoint.Length = 3;
    $EVSE.ISO20.AC_DER_ChargeParameterDiscovery_Response.CPDResEnergyTransferMode.DER_AC_CPDResEnergyTransferMode.DERControl.VoltageTrip.OverVoltageMomentaryCessationTripCurve.CurveDataPoints.CurveDataPoint[0].x.Exponent = 1;
    $EVSE.ISO20.AC_DER_ChargeParameterDiscovery_Response.CPDResEnergyTransferMode.DER_AC_CPDResEnergyTransferMode.DERControl.VoltageTrip.OverVoltageMomentaryCessationTripCurve.CurveDataPoints.CurveDataPoint[0].x.Value = 2;
    $EVSE.ISO20.AC_DER_ChargeParameterDiscovery_Response.CPDResEnergyTransferMode.DER_AC_CPDResEnergyTransferMode.DERControl.VoltageTrip.OverVoltageMomentaryCessationTripCurve.CurveDataPoints.CurveDataPoint[0].y.Exponent = 1;
    $EVSE.ISO20.AC_DER_ChargeParameterDiscovery_Response.CPDResEnergyTransferMode.DER_AC_CPDResEnergyTransferMode.DERControl.VoltageTrip.OverVoltageMomentaryCessationTripCurve.CurveDataPoints.CurveDataPoint[0].y.Value = 2;
    $EVSE.ISO20.AC_DER_ChargeParameterDiscovery_Response.CPDResEnergyTransferMode.DER_AC_CPDResEnergyTransferMode.DERControl.VoltageTrip.OverVoltageMomentaryCessationTripCurve.CurveDataPoints.CurveDataPoint[1].x.Exponent = 1;
    $EVSE.ISO20.AC_DER_ChargeParameterDiscovery_Response.CPDResEnergyTransferMode.DER_AC_CPDResEnergyTransferMode.DERControl.VoltageTrip.OverVoltageMomentaryCessationTripCurve.CurveDataPoints.CurveDataPoint[1].x.Value = 2;
    $EVSE.ISO20.AC_DER_ChargeParameterDiscovery_Response.CPDResEnergyTransferMode.DER_AC_CPDResEnergyTransferMode.DERControl.VoltageTrip.OverVoltageMomentaryCessationTripCurve.CurveDataPoints.CurveDataPoint[1].y.Exponent = 1;
    $EVSE.ISO20.AC_DER_ChargeParameterDiscovery_Response.CPDResEnergyTransferMode.DER_AC_CPDResEnergyTransferMode.DERControl.VoltageTrip.OverVoltageMomentaryCessationTripCurve.CurveDataPoints.CurveDataPoint[1].y.Value = 2;
    $EVSE.ISO20.AC_DER_ChargeParameterDiscovery_Response.CPDResEnergyTransferMode.DER_AC_CPDResEnergyTransferMode.DERControl.VoltageTrip.OverVoltageMomentaryCessationTripCurve.CurveDataPoints.CurveDataPoint[2].x.Exponent = 1;
    $EVSE.ISO20.AC_DER_ChargeParameterDiscovery_Response.CPDResEnergyTransferMode.DER_AC_CPDResEnergyTransferMode.DERControl.VoltageTrip.OverVoltageMomentaryCessationTripCurve.CurveDataPoints.CurveDataPoint[2].x.Value = 2;
    $EVSE.ISO20.AC_DER_ChargeParameterDiscovery_Response.CPDResEnergyTransferMode.DER_AC_CPDResEnergyTransferMode.DERControl.VoltageTrip.OverVoltageMomentaryCessationTripCurve.CurveDataPoints.CurveDataPoint[2].y.Exponent = 1;
    $EVSE.ISO20.AC_DER_ChargeParameterDiscovery_Response.CPDResEnergyTransferMode.DER_AC_CPDResEnergyTransferMode.DERControl.VoltageTrip.OverVoltageMomentaryCessationTripCurve.CurveDataPoints.CurveDataPoint[2].y.Value = 2;
    $EVSE.ISO20.AC_DER_ChargeParameterDiscovery_Response.CPDResEnergyTransferMode.DER_AC_CPDResEnergyTransferMode.DERControl.VoltageTrip.OverVoltageMomentaryCessationTripCurve.LockInValue = _CCS::DataTypes::LockValueUnitType::W;
    $EVSE.ISO20.AC_DER_ChargeParameterDiscovery_Response.CPDResEnergyTransferMode.DER_AC_CPDResEnergyTransferMode.DERControl.VoltageTrip.OverVoltageMomentaryCessationTripCurve.LockOutValue = _CCS::DataTypes::LockValueUnitType::W;
    $EVSE.ISO20.AC_DER_ChargeParameterDiscovery_Response.CPDResEnergyTransferMode.DER_AC_CPDResEnergyTransferMode.DERControl.VoltageTrip.OverVoltageMomentaryCessationTripCurve.OpenLoopResponseTime.Exponent = 2;
    $EVSE.ISO20.AC_DER_ChargeParameterDiscovery_Response.CPDResEnergyTransferMode.DER_AC_CPDResEnergyTransferMode.DERControl.VoltageTrip.OverVoltageMomentaryCessationTripCurve.OpenLoopResponseTime.Value = 1;
    $EVSE.ISO20.AC_DER_ChargeParameterDiscovery_Response.CPDResEnergyTransferMode.DER_AC_CPDResEnergyTransferMode.DERControl.VoltageTrip.OverVoltageMomentaryCessationTripCurve.TimeConstantPT1 = 2;
    $EVSE.ISO20.AC_DER_ChargeParameterDiscovery_Response.CPDResEnergyTransferMode.DER_AC_CPDResEnergyTransferMode.DERControl.VoltageTrip.OverVoltageMomentaryCessationTripCurve.IntentionalDelay.Exponent = 2;
    $EVSE.ISO20.AC_DER_ChargeParameterDiscovery_Response.CPDResEnergyTransferMode.DER_AC_CPDResEnergyTransferMode.DERControl.VoltageTrip.OverVoltageMomentaryCessationTripCurve.IntentionalDelay.Value = 1;

    $EVSE.ISO20.AC_DER_ChargeParameterDiscovery_Response.CPDResEnergyTransferMode.DER_AC_CPDResEnergyTransferMode.DERControl.VoltageTrip.UnderVoltageMomentaryCessationTripCurve.Enable = 1;
    $EVSE.ISO20.AC_DER_ChargeParameterDiscovery_Response.CPDResEnergyTransferMode.DER_AC_CPDResEnergyTransferMode.DERControl.VoltageTrip.UnderVoltageMomentaryCessationTripCurve.Priority = 2;
    $EVSE.ISO20.AC_DER_ChargeParameterDiscovery_Response.CPDResEnergyTransferMode.DER_AC_CPDResEnergyTransferMode.DERControl.VoltageTrip.UnderVoltageMomentaryCessationTripCurve.xUnit = _CCS::DataTypes::CurveDataPointsUnitType::W;
    $EVSE.ISO20.AC_DER_ChargeParameterDiscovery_Response.CPDResEnergyTransferMode.DER_AC_CPDResEnergyTransferMode.DERControl.VoltageTrip.UnderVoltageMomentaryCessationTripCurve.yUnit = _CCS::DataTypes::CurveDataPointsUnitType::W;
    $EVSE.ISO20.AC_DER_ChargeParameterDiscovery_Response.CPDResEnergyTransferMode.DER_AC_CPDResEnergyTransferMode.DERControl.VoltageTrip.UnderVoltageMomentaryCessationTripCurve.CurveDataPoints.CurveDataPoint.Length = 3;
    $EVSE.ISO20.AC_DER_ChargeParameterDiscovery_Response.CPDResEnergyTransferMode.DER_AC_CPDResEnergyTransferMode.DERControl.VoltageTrip.UnderVoltageMomentaryCessationTripCurve.CurveDataPoints.CurveDataPoint[0].x.Exponent = 1;
    $EVSE.ISO20.AC_DER_ChargeParameterDiscovery_Response.CPDResEnergyTransferMode.DER_AC_CPDResEnergyTransferMode.DERControl.VoltageTrip.UnderVoltageMomentaryCessationTripCurve.CurveDataPoints.CurveDataPoint[0].x.Value = 2;
    $EVSE.ISO20.AC_DER_ChargeParameterDiscovery_Response.CPDResEnergyTransferMode.DER_AC_CPDResEnergyTransferMode.DERControl.VoltageTrip.UnderVoltageMomentaryCessationTripCurve.CurveDataPoints.CurveDataPoint[0].y.Exponent = 1;
    $EVSE.ISO20.AC_DER_ChargeParameterDiscovery_Response.CPDResEnergyTransferMode.DER_AC_CPDResEnergyTransferMode.DERControl.VoltageTrip.UnderVoltageMomentaryCessationTripCurve.CurveDataPoints.CurveDataPoint[0].y.Value = 2;
    $EVSE.ISO20.AC_DER_ChargeParameterDiscovery_Response.CPDResEnergyTransferMode.DER_AC_CPDResEnergyTransferMode.DERControl.VoltageTrip.UnderVoltageMomentaryCessationTripCurve.CurveDataPoints.CurveDataPoint[1].x.Exponent = 1;
    $EVSE.ISO20.AC_DER_ChargeParameterDiscovery_Response.CPDResEnergyTransferMode.DER_AC_CPDResEnergyTransferMode.DERControl.VoltageTrip.UnderVoltageMomentaryCessationTripCurve.CurveDataPoints.CurveDataPoint[1].x.Value = 2;
    $EVSE.ISO20.AC_DER_ChargeParameterDiscovery_Response.CPDResEnergyTransferMode.DER_AC_CPDResEnergyTransferMode.DERControl.VoltageTrip.UnderVoltageMomentaryCessationTripCurve.CurveDataPoints.CurveDataPoint[1].y.Exponent = 1;
    $EVSE.ISO20.AC_DER_ChargeParameterDiscovery_Response.CPDResEnergyTransferMode.DER_AC_CPDResEnergyTransferMode.DERControl.VoltageTrip.UnderVoltageMomentaryCessationTripCurve.CurveDataPoints.CurveDataPoint[1].y.Value = 2;
    $EVSE.ISO20.AC_DER_ChargeParameterDiscovery_Response.CPDResEnergyTransferMode.DER_AC_CPDResEnergyTransferMode.DERControl.VoltageTrip.UnderVoltageMomentaryCessationTripCurve.CurveDataPoints.CurveDataPoint[2].x.Exponent = 1;
    $EVSE.ISO20.AC_DER_ChargeParameterDiscovery_Response.CPDResEnergyTransferMode.DER_AC_CPDResEnergyTransferMode.DERControl.VoltageTrip.UnderVoltageMomentaryCessationTripCurve.CurveDataPoints.CurveDataPoint[2].x.Value = 2;
    $EVSE.ISO20.AC_DER_ChargeParameterDiscovery_Response.CPDResEnergyTransferMode.DER_AC_CPDResEnergyTransferMode.DERControl.VoltageTrip.UnderVoltageMomentaryCessationTripCurve.CurveDataPoints.CurveDataPoint[2].y.Exponent = 1;
    $EVSE.ISO20.AC_DER_ChargeParameterDiscovery_Response.CPDResEnergyTransferMode.DER_AC_CPDResEnergyTransferMode.DERControl.VoltageTrip.UnderVoltageMomentaryCessationTripCurve.CurveDataPoints.CurveDataPoint[2].y.Value = 2;
    $EVSE.ISO20.AC_DER_ChargeParameterDiscovery_Response.CPDResEnergyTransferMode.DER_AC_CPDResEnergyTransferMode.DERControl.VoltageTrip.UnderVoltageMomentaryCessationTripCurve.LockInValue = _CCS::DataTypes::LockValueUnitType::W;
    $EVSE.ISO20.AC_DER_ChargeParameterDiscovery_Response.CPDResEnergyTransferMode.DER_AC_CPDResEnergyTransferMode.DERControl.VoltageTrip.UnderVoltageMomentaryCessationTripCurve.LockOutValue = _CCS::DataTypes::LockValueUnitType::W;
    $EVSE.ISO20.AC_DER_ChargeParameterDiscovery_Response.CPDResEnergyTransferMode.DER_AC_CPDResEnergyTransferMode.DERControl.VoltageTrip.UnderVoltageMomentaryCessationTripCurve.OpenLoopResponseTime.Exponent = 2;
    $EVSE.ISO20.AC_DER_ChargeParameterDiscovery_Response.CPDResEnergyTransferMode.DER_AC_CPDResEnergyTransferMode.DERControl.VoltageTrip.UnderVoltageMomentaryCessationTripCurve.OpenLoopResponseTime.Value = 1;
    $EVSE.ISO20.AC_DER_ChargeParameterDiscovery_Response.CPDResEnergyTransferMode.DER_AC_CPDResEnergyTransferMode.DERControl.VoltageTrip.UnderVoltageMomentaryCessationTripCurve.TimeConstantPT1 = 2;
    $EVSE.ISO20.AC_DER_ChargeParameterDiscovery_Response.CPDResEnergyTransferMode.DER_AC_CPDResEnergyTransferMode.DERControl.VoltageTrip.UnderVoltageMomentaryCessationTripCurve.IntentionalDelay.Exponent = 2;
    $EVSE.ISO20.AC_DER_ChargeParameterDiscovery_Response.CPDResEnergyTransferMode.DER_AC_CPDResEnergyTransferMode.DERControl.VoltageTrip.UnderVoltageMomentaryCessationTripCurve.IntentionalDelay.Value = 1;

    $EVSE.ISO20.AC_DER_ChargeParameterDiscovery_Response.CPDResEnergyTransferMode.DER_AC_CPDResEnergyTransferMode.DERControl.VoltageTrip.OverVoltageMayTripCurve.Enable = 1;
    $EVSE.ISO20.AC_DER_ChargeParameterDiscovery_Response.CPDResEnergyTransferMode.DER_AC_CPDResEnergyTransferMode.DERControl.VoltageTrip.OverVoltageMayTripCurve.Priority = 2;
    $EVSE.ISO20.AC_DER_ChargeParameterDiscovery_Response.CPDResEnergyTransferMode.DER_AC_CPDResEnergyTransferMode.DERControl.VoltageTrip.OverVoltageMayTripCurve.xUnit = _CCS::DataTypes::CurveDataPointsUnitType::W;
    $EVSE.ISO20.AC_DER_ChargeParameterDiscovery_Response.CPDResEnergyTransferMode.DER_AC_CPDResEnergyTransferMode.DERControl.VoltageTrip.OverVoltageMayTripCurve.yUnit = _CCS::DataTypes::CurveDataPointsUnitType::W;
    $EVSE.ISO20.AC_DER_ChargeParameterDiscovery_Response.CPDResEnergyTransferMode.DER_AC_CPDResEnergyTransferMode.DERControl.VoltageTrip.OverVoltageMayTripCurve.CurveDataPoints.CurveDataPoint.Length = 3;
    $EVSE.ISO20.AC_DER_ChargeParameterDiscovery_Response.CPDResEnergyTransferMode.DER_AC_CPDResEnergyTransferMode.DERControl.VoltageTrip.OverVoltageMayTripCurve.CurveDataPoints.CurveDataPoint[0].x.Exponent = 1;
    $EVSE.ISO20.AC_DER_ChargeParameterDiscovery_Response.CPDResEnergyTransferMode.DER_AC_CPDResEnergyTransferMode.DERControl.VoltageTrip.OverVoltageMayTripCurve.CurveDataPoints.CurveDataPoint[0].x.Value = 2;
    $EVSE.ISO20.AC_DER_ChargeParameterDiscovery_Response.CPDResEnergyTransferMode.DER_AC_CPDResEnergyTransferMode.DERControl.VoltageTrip.OverVoltageMayTripCurve.CurveDataPoints.CurveDataPoint[0].y.Exponent = 1;
    $EVSE.ISO20.AC_DER_ChargeParameterDiscovery_Response.CPDResEnergyTransferMode.DER_AC_CPDResEnergyTransferMode.DERControl.VoltageTrip.OverVoltageMayTripCurve.CurveDataPoints.CurveDataPoint[0].y.Value = 2;
    $EVSE.ISO20.AC_DER_ChargeParameterDiscovery_Response.CPDResEnergyTransferMode.DER_AC_CPDResEnergyTransferMode.DERControl.VoltageTrip.OverVoltageMayTripCurve.CurveDataPoints.CurveDataPoint[1].x.Exponent = 1;
    $EVSE.ISO20.AC_DER_ChargeParameterDiscovery_Response.CPDResEnergyTransferMode.DER_AC_CPDResEnergyTransferMode.DERControl.VoltageTrip.OverVoltageMayTripCurve.CurveDataPoints.CurveDataPoint[1].x.Value = 2;
    $EVSE.ISO20.AC_DER_ChargeParameterDiscovery_Response.CPDResEnergyTransferMode.DER_AC_CPDResEnergyTransferMode.DERControl.VoltageTrip.OverVoltageMayTripCurve.CurveDataPoints.CurveDataPoint[1].y.Exponent = 1;
    $EVSE.ISO20.AC_DER_ChargeParameterDiscovery_Response.CPDResEnergyTransferMode.DER_AC_CPDResEnergyTransferMode.DERControl.VoltageTrip.OverVoltageMayTripCurve.CurveDataPoints.CurveDataPoint[1].y.Value = 2;
    $EVSE.ISO20.AC_DER_ChargeParameterDiscovery_Response.CPDResEnergyTransferMode.DER_AC_CPDResEnergyTransferMode.DERControl.VoltageTrip.OverVoltageMayTripCurve.CurveDataPoints.CurveDataPoint[2].x.Exponent = 1;
    $EVSE.ISO20.AC_DER_ChargeParameterDiscovery_Response.CPDResEnergyTransferMode.DER_AC_CPDResEnergyTransferMode.DERControl.VoltageTrip.OverVoltageMayTripCurve.CurveDataPoints.CurveDataPoint[2].x.Value = 2;
    $EVSE.ISO20.AC_DER_ChargeParameterDiscovery_Response.CPDResEnergyTransferMode.DER_AC_CPDResEnergyTransferMode.DERControl.VoltageTrip.OverVoltageMayTripCurve.CurveDataPoints.CurveDataPoint[2].y.Exponent = 1;
    $EVSE.ISO20.AC_DER_ChargeParameterDiscovery_Response.CPDResEnergyTransferMode.DER_AC_CPDResEnergyTransferMode.DERControl.VoltageTrip.OverVoltageMayTripCurve.CurveDataPoints.CurveDataPoint[2].y.Value = 2;
    $EVSE.ISO20.AC_DER_ChargeParameterDiscovery_Response.CPDResEnergyTransferMode.DER_AC_CPDResEnergyTransferMode.DERControl.VoltageTrip.OverVoltageMayTripCurve.LockInValue = _CCS::DataTypes::LockValueUnitType::W;
    $EVSE.ISO20.AC_DER_ChargeParameterDiscovery_Response.CPDResEnergyTransferMode.DER_AC_CPDResEnergyTransferMode.DERControl.VoltageTrip.OverVoltageMayTripCurve.LockOutValue = _CCS::DataTypes::LockValueUnitType::W;
    $EVSE.ISO20.AC_DER_ChargeParameterDiscovery_Response.CPDResEnergyTransferMode.DER_AC_CPDResEnergyTransferMode.DERControl.VoltageTrip.OverVoltageMayTripCurve.OpenLoopResponseTime.Exponent = 2;
    $EVSE.ISO20.AC_DER_ChargeParameterDiscovery_Response.CPDResEnergyTransferMode.DER_AC_CPDResEnergyTransferMode.DERControl.VoltageTrip.OverVoltageMayTripCurve.OpenLoopResponseTime.Value = 1;
    $EVSE.ISO20.AC_DER_ChargeParameterDiscovery_Response.CPDResEnergyTransferMode.DER_AC_CPDResEnergyTransferMode.DERControl.VoltageTrip.OverVoltageMayTripCurve.TimeConstantPT1 = 2;
    $EVSE.ISO20.AC_DER_ChargeParameterDiscovery_Response.CPDResEnergyTransferMode.DER_AC_CPDResEnergyTransferMode.DERControl.VoltageTrip.OverVoltageMayTripCurve.IntentionalDelay.Exponent = 2;
    $EVSE.ISO20.AC_DER_ChargeParameterDiscovery_Response.CPDResEnergyTransferMode.DER_AC_CPDResEnergyTransferMode.DERControl.VoltageTrip.OverVoltageMayTripCurve.IntentionalDelay.Value = 1;

    $EVSE.ISO20.AC_DER_ChargeParameterDiscovery_Response.CPDResEnergyTransferMode.DER_AC_CPDResEnergyTransferMode.DERControl.VoltageTrip.UnderVoltageMayTripCurve.Enable = 1;
    $EVSE.ISO20.AC_DER_ChargeParameterDiscovery_Response.CPDResEnergyTransferMode.DER_AC_CPDResEnergyTransferMode.DERControl.VoltageTrip.UnderVoltageMayTripCurve.Priority = 2;
    $EVSE.ISO20.AC_DER_ChargeParameterDiscovery_Response.CPDResEnergyTransferMode.DER_AC_CPDResEnergyTransferMode.DERControl.VoltageTrip.UnderVoltageMayTripCurve.xUnit = _CCS::DataTypes::CurveDataPointsUnitType::W;
    $EVSE.ISO20.AC_DER_ChargeParameterDiscovery_Response.CPDResEnergyTransferMode.DER_AC_CPDResEnergyTransferMode.DERControl.VoltageTrip.UnderVoltageMayTripCurve.yUnit = _CCS::DataTypes::CurveDataPointsUnitType::W;
    $EVSE.ISO20.AC_DER_ChargeParameterDiscovery_Response.CPDResEnergyTransferMode.DER_AC_CPDResEnergyTransferMode.DERControl.VoltageTrip.UnderVoltageMayTripCurve.CurveDataPoints.CurveDataPoint.Length = 3;
    $EVSE.ISO20.AC_DER_ChargeParameterDiscovery_Response.CPDResEnergyTransferMode.DER_AC_CPDResEnergyTransferMode.DERControl.VoltageTrip.UnderVoltageMayTripCurve.CurveDataPoints.CurveDataPoint[0].x.Exponent = 1;
    $EVSE.ISO20.AC_DER_ChargeParameterDiscovery_Response.CPDResEnergyTransferMode.DER_AC_CPDResEnergyTransferMode.DERControl.VoltageTrip.UnderVoltageMayTripCurve.CurveDataPoints.CurveDataPoint[0].x.Value = 2;
    $EVSE.ISO20.AC_DER_ChargeParameterDiscovery_Response.CPDResEnergyTransferMode.DER_AC_CPDResEnergyTransferMode.DERControl.VoltageTrip.UnderVoltageMayTripCurve.CurveDataPoints.CurveDataPoint[0].y.Exponent = 1;
    $EVSE.ISO20.AC_DER_ChargeParameterDiscovery_Response.CPDResEnergyTransferMode.DER_AC_CPDResEnergyTransferMode.DERControl.VoltageTrip.UnderVoltageMayTripCurve.CurveDataPoints.CurveDataPoint[0].y.Value = 2;
    $EVSE.ISO20.AC_DER_ChargeParameterDiscovery_Response.CPDResEnergyTransferMode.DER_AC_CPDResEnergyTransferMode.DERControl.VoltageTrip.UnderVoltageMayTripCurve.CurveDataPoints.CurveDataPoint[1].x.Exponent = 1;
    $EVSE.ISO20.AC_DER_ChargeParameterDiscovery_Response.CPDResEnergyTransferMode.DER_AC_CPDResEnergyTransferMode.DERControl.VoltageTrip.UnderVoltageMayTripCurve.CurveDataPoints.CurveDataPoint[1].x.Value = 2;
    $EVSE.ISO20.AC_DER_ChargeParameterDiscovery_Response.CPDResEnergyTransferMode.DER_AC_CPDResEnergyTransferMode.DERControl.VoltageTrip.UnderVoltageMayTripCurve.CurveDataPoints.CurveDataPoint[1].y.Exponent = 1;
    $EVSE.ISO20.AC_DER_ChargeParameterDiscovery_Response.CPDResEnergyTransferMode.DER_AC_CPDResEnergyTransferMode.DERControl.VoltageTrip.UnderVoltageMayTripCurve.CurveDataPoints.CurveDataPoint[1].y.Value = 2;
    $EVSE.ISO20.AC_DER_ChargeParameterDiscovery_Response.CPDResEnergyTransferMode.DER_AC_CPDResEnergyTransferMode.DERControl.VoltageTrip.UnderVoltageMayTripCurve.CurveDataPoints.CurveDataPoint[2].x.Exponent = 1;
    $EVSE.ISO20.AC_DER_ChargeParameterDiscovery_Response.CPDResEnergyTransferMode.DER_AC_CPDResEnergyTransferMode.DERControl.VoltageTrip.UnderVoltageMayTripCurve.CurveDataPoints.CurveDataPoint[2].x.Value = 2;
    $EVSE.ISO20.AC_DER_ChargeParameterDiscovery_Response.CPDResEnergyTransferMode.DER_AC_CPDResEnergyTransferMode.DERControl.VoltageTrip.UnderVoltageMayTripCurve.CurveDataPoints.CurveDataPoint[2].y.Exponent = 1;
    $EVSE.ISO20.AC_DER_ChargeParameterDiscovery_Response.CPDResEnergyTransferMode.DER_AC_CPDResEnergyTransferMode.DERControl.VoltageTrip.UnderVoltageMayTripCurve.CurveDataPoints.CurveDataPoint[2].y.Value = 2;
    $EVSE.ISO20.AC_DER_ChargeParameterDiscovery_Response.CPDResEnergyTransferMode.DER_AC_CPDResEnergyTransferMode.DERControl.VoltageTrip.UnderVoltageMayTripCurve.LockInValue = _CCS::DataTypes::LockValueUnitType::W;
    $EVSE.ISO20.AC_DER_ChargeParameterDiscovery_Response.CPDResEnergyTransferMode.DER_AC_CPDResEnergyTransferMode.DERControl.VoltageTrip.UnderVoltageMayTripCurve.LockOutValue = _CCS::DataTypes::LockValueUnitType::W;
    $EVSE.ISO20.AC_DER_ChargeParameterDiscovery_Response.CPDResEnergyTransferMode.DER_AC_CPDResEnergyTransferMode.DERControl.VoltageTrip.UnderVoltageMayTripCurve.OpenLoopResponseTime.Exponent = 2;
    $EVSE.ISO20.AC_DER_ChargeParameterDiscovery_Response.CPDResEnergyTransferMode.DER_AC_CPDResEnergyTransferMode.DERControl.VoltageTrip.UnderVoltageMayTripCurve.OpenLoopResponseTime.Value = 1;
    $EVSE.ISO20.AC_DER_ChargeParameterDiscovery_Response.CPDResEnergyTransferMode.DER_AC_CPDResEnergyTransferMode.DERControl.VoltageTrip.UnderVoltageMayTripCurve.TimeConstantPT1 = 2;
    $EVSE.ISO20.AC_DER_ChargeParameterDiscovery_Response.CPDResEnergyTransferMode.DER_AC_CPDResEnergyTransferMode.DERControl.VoltageTrip.UnderVoltageMayTripCurve.IntentionalDelay.Exponent = 2;
    $EVSE.ISO20.AC_DER_ChargeParameterDiscovery_Response.CPDResEnergyTransferMode.DER_AC_CPDResEnergyTransferMode.DERControl.VoltageTrip.UnderVoltageMayTripCurve.IntentionalDelay.Value = 1;

    $EVSE.ISO20.AC_DER_ChargeParameterDiscovery_Response.CPDResEnergyTransferMode.DER_AC_CPDResEnergyTransferMode.DERControl.VoltageTrip.OverVoltageMeanValue10min.Exponent = 2;
    $EVSE.ISO20.AC_DER_ChargeParameterDiscovery_Response.CPDResEnergyTransferMode.DER_AC_CPDResEnergyTransferMode.DERControl.VoltageTrip.OverVoltageMeanValue10min.Value = 2;
    $EVSE.ISO20.AC_DER_ChargeParameterDiscovery_Response.CPDResEnergyTransferMode.DER_AC_CPDResEnergyTransferMode.DERControl.VoltageTrip.OverVoltage10MinMeanTripDelay.Exponent = 2;
    $EVSE.ISO20.AC_DER_ChargeParameterDiscovery_Response.CPDResEnergyTransferMode.DER_AC_CPDResEnergyTransferMode.DERControl.VoltageTrip.OverVoltage10MinMeanTripDelay.Value = 2;
    $EVSE.ISO20.AC_DER_ChargeParameterDiscovery_Response.CPDResEnergyTransferMode.DER_AC_CPDResEnergyTransferMode.DERControl.VoltageTrip.PowerDuringCessation = _CCS::DataTypes::PowerDuringCessationType::ReactivePower;
    
    /* FrequencyTrip */
    $EVSE.ISO20.AC_DER_ChargeParameterDiscovery_Response.CPDResEnergyTransferMode.DER_AC_CPDResEnergyTransferMode.DERControl.FrequencyTrip.OverFrequencyMustTripCurve.Enable = 1;
    $EVSE.ISO20.AC_DER_ChargeParameterDiscovery_Response.CPDResEnergyTransferMode.DER_AC_CPDResEnergyTransferMode.DERControl.FrequencyTrip.OverFrequencyMustTripCurve.Priority = 2;
    $EVSE.ISO20.AC_DER_ChargeParameterDiscovery_Response.CPDResEnergyTransferMode.DER_AC_CPDResEnergyTransferMode.DERControl.FrequencyTrip.OverFrequencyMustTripCurve.xUnit = _CCS::DataTypes::CurveDataPointsUnitType::W;
    $EVSE.ISO20.AC_DER_ChargeParameterDiscovery_Response.CPDResEnergyTransferMode.DER_AC_CPDResEnergyTransferMode.DERControl.FrequencyTrip.OverFrequencyMustTripCurve.yUnit = _CCS::DataTypes::CurveDataPointsUnitType::W;
    $EVSE.ISO20.AC_DER_ChargeParameterDiscovery_Response.CPDResEnergyTransferMode.DER_AC_CPDResEnergyTransferMode.DERControl.FrequencyTrip.OverFrequencyMustTripCurve.CurveDataPoints.CurveDataPoint.Length = 3;
    $EVSE.ISO20.AC_DER_ChargeParameterDiscovery_Response.CPDResEnergyTransferMode.DER_AC_CPDResEnergyTransferMode.DERControl.FrequencyTrip.OverFrequencyMustTripCurve.CurveDataPoints.CurveDataPoint[0].x.Exponent = 1;
    $EVSE.ISO20.AC_DER_ChargeParameterDiscovery_Response.CPDResEnergyTransferMode.DER_AC_CPDResEnergyTransferMode.DERControl.FrequencyTrip.OverFrequencyMustTripCurve.CurveDataPoints.CurveDataPoint[0].x.Value = 2;
    $EVSE.ISO20.AC_DER_ChargeParameterDiscovery_Response.CPDResEnergyTransferMode.DER_AC_CPDResEnergyTransferMode.DERControl.FrequencyTrip.OverFrequencyMustTripCurve.CurveDataPoints.CurveDataPoint[0].y.Exponent = 1;
    $EVSE.ISO20.AC_DER_ChargeParameterDiscovery_Response.CPDResEnergyTransferMode.DER_AC_CPDResEnergyTransferMode.DERControl.FrequencyTrip.OverFrequencyMustTripCurve.CurveDataPoints.CurveDataPoint[0].y.Value = 2;
    $EVSE.ISO20.AC_DER_ChargeParameterDiscovery_Response.CPDResEnergyTransferMode.DER_AC_CPDResEnergyTransferMode.DERControl.FrequencyTrip.OverFrequencyMustTripCurve.CurveDataPoints.CurveDataPoint[1].x.Exponent = 1;
    $EVSE.ISO20.AC_DER_ChargeParameterDiscovery_Response.CPDResEnergyTransferMode.DER_AC_CPDResEnergyTransferMode.DERControl.FrequencyTrip.OverFrequencyMustTripCurve.CurveDataPoints.CurveDataPoint[1].x.Value = 2;
    $EVSE.ISO20.AC_DER_ChargeParameterDiscovery_Response.CPDResEnergyTransferMode.DER_AC_CPDResEnergyTransferMode.DERControl.FrequencyTrip.OverFrequencyMustTripCurve.CurveDataPoints.CurveDataPoint[1].y.Exponent = 1;
    $EVSE.ISO20.AC_DER_ChargeParameterDiscovery_Response.CPDResEnergyTransferMode.DER_AC_CPDResEnergyTransferMode.DERControl.FrequencyTrip.OverFrequencyMustTripCurve.CurveDataPoints.CurveDataPoint[1].y.Value = 2;
    $EVSE.ISO20.AC_DER_ChargeParameterDiscovery_Response.CPDResEnergyTransferMode.DER_AC_CPDResEnergyTransferMode.DERControl.FrequencyTrip.OverFrequencyMustTripCurve.CurveDataPoints.CurveDataPoint[2].x.Exponent = 1;
    $EVSE.ISO20.AC_DER_ChargeParameterDiscovery_Response.CPDResEnergyTransferMode.DER_AC_CPDResEnergyTransferMode.DERControl.FrequencyTrip.OverFrequencyMustTripCurve.CurveDataPoints.CurveDataPoint[2].x.Value = 2;
    $EVSE.ISO20.AC_DER_ChargeParameterDiscovery_Response.CPDResEnergyTransferMode.DER_AC_CPDResEnergyTransferMode.DERControl.FrequencyTrip.OverFrequencyMustTripCurve.CurveDataPoints.CurveDataPoint[2].y.Exponent = 1;
    $EVSE.ISO20.AC_DER_ChargeParameterDiscovery_Response.CPDResEnergyTransferMode.DER_AC_CPDResEnergyTransferMode.DERControl.FrequencyTrip.OverFrequencyMustTripCurve.CurveDataPoints.CurveDataPoint[2].y.Value = 2;
    $EVSE.ISO20.AC_DER_ChargeParameterDiscovery_Response.CPDResEnergyTransferMode.DER_AC_CPDResEnergyTransferMode.DERControl.FrequencyTrip.OverFrequencyMustTripCurve.LockInValue = _CCS::DataTypes::LockValueUnitType::W;
    $EVSE.ISO20.AC_DER_ChargeParameterDiscovery_Response.CPDResEnergyTransferMode.DER_AC_CPDResEnergyTransferMode.DERControl.FrequencyTrip.OverFrequencyMustTripCurve.LockOutValue = _CCS::DataTypes::LockValueUnitType::W;
    $EVSE.ISO20.AC_DER_ChargeParameterDiscovery_Response.CPDResEnergyTransferMode.DER_AC_CPDResEnergyTransferMode.DERControl.FrequencyTrip.OverFrequencyMustTripCurve.OpenLoopResponseTime.Exponent = 2;
    $EVSE.ISO20.AC_DER_ChargeParameterDiscovery_Response.CPDResEnergyTransferMode.DER_AC_CPDResEnergyTransferMode.DERControl.FrequencyTrip.OverFrequencyMustTripCurve.OpenLoopResponseTime.Value = 1;
    $EVSE.ISO20.AC_DER_ChargeParameterDiscovery_Response.CPDResEnergyTransferMode.DER_AC_CPDResEnergyTransferMode.DERControl.FrequencyTrip.OverFrequencyMustTripCurve.TimeConstantPT1 = 2;
    $EVSE.ISO20.AC_DER_ChargeParameterDiscovery_Response.CPDResEnergyTransferMode.DER_AC_CPDResEnergyTransferMode.DERControl.FrequencyTrip.OverFrequencyMustTripCurve.IntentionalDelay.Exponent = 2;
    $EVSE.ISO20.AC_DER_ChargeParameterDiscovery_Response.CPDResEnergyTransferMode.DER_AC_CPDResEnergyTransferMode.DERControl.FrequencyTrip.OverFrequencyMustTripCurve.IntentionalDelay.Value = 1;

    $EVSE.ISO20.AC_DER_ChargeParameterDiscovery_Response.CPDResEnergyTransferMode.DER_AC_CPDResEnergyTransferMode.DERControl.FrequencyTrip.UnderFrequencyMustTripCurve.Enable = 1;
    $EVSE.ISO20.AC_DER_ChargeParameterDiscovery_Response.CPDResEnergyTransferMode.DER_AC_CPDResEnergyTransferMode.DERControl.FrequencyTrip.UnderFrequencyMustTripCurve.Priority = 2;
    $EVSE.ISO20.AC_DER_ChargeParameterDiscovery_Response.CPDResEnergyTransferMode.DER_AC_CPDResEnergyTransferMode.DERControl.FrequencyTrip.UnderFrequencyMustTripCurve.xUnit = _CCS::DataTypes::CurveDataPointsUnitType::W;
    $EVSE.ISO20.AC_DER_ChargeParameterDiscovery_Response.CPDResEnergyTransferMode.DER_AC_CPDResEnergyTransferMode.DERControl.FrequencyTrip.UnderFrequencyMustTripCurve.yUnit = _CCS::DataTypes::CurveDataPointsUnitType::W;
    $EVSE.ISO20.AC_DER_ChargeParameterDiscovery_Response.CPDResEnergyTransferMode.DER_AC_CPDResEnergyTransferMode.DERControl.FrequencyTrip.UnderFrequencyMustTripCurve.CurveDataPoints.CurveDataPoint.Length = 3;
    $EVSE.ISO20.AC_DER_ChargeParameterDiscovery_Response.CPDResEnergyTransferMode.DER_AC_CPDResEnergyTransferMode.DERControl.FrequencyTrip.UnderFrequencyMustTripCurve.CurveDataPoints.CurveDataPoint[0].x.Exponent = 1;
    $EVSE.ISO20.AC_DER_ChargeParameterDiscovery_Response.CPDResEnergyTransferMode.DER_AC_CPDResEnergyTransferMode.DERControl.FrequencyTrip.UnderFrequencyMustTripCurve.CurveDataPoints.CurveDataPoint[0].x.Value = 2;
    $EVSE.ISO20.AC_DER_ChargeParameterDiscovery_Response.CPDResEnergyTransferMode.DER_AC_CPDResEnergyTransferMode.DERControl.FrequencyTrip.UnderFrequencyMustTripCurve.CurveDataPoints.CurveDataPoint[0].y.Exponent = 1;
    $EVSE.ISO20.AC_DER_ChargeParameterDiscovery_Response.CPDResEnergyTransferMode.DER_AC_CPDResEnergyTransferMode.DERControl.FrequencyTrip.UnderFrequencyMustTripCurve.CurveDataPoints.CurveDataPoint[0].y.Value = 2;
    $EVSE.ISO20.AC_DER_ChargeParameterDiscovery_Response.CPDResEnergyTransferMode.DER_AC_CPDResEnergyTransferMode.DERControl.FrequencyTrip.UnderFrequencyMustTripCurve.CurveDataPoints.CurveDataPoint[1].x.Exponent = 1;
    $EVSE.ISO20.AC_DER_ChargeParameterDiscovery_Response.CPDResEnergyTransferMode.DER_AC_CPDResEnergyTransferMode.DERControl.FrequencyTrip.UnderFrequencyMustTripCurve.CurveDataPoints.CurveDataPoint[1].x.Value = 2;
    $EVSE.ISO20.AC_DER_ChargeParameterDiscovery_Response.CPDResEnergyTransferMode.DER_AC_CPDResEnergyTransferMode.DERControl.FrequencyTrip.UnderFrequencyMustTripCurve.CurveDataPoints.CurveDataPoint[1].y.Exponent = 1;
    $EVSE.ISO20.AC_DER_ChargeParameterDiscovery_Response.CPDResEnergyTransferMode.DER_AC_CPDResEnergyTransferMode.DERControl.FrequencyTrip.UnderFrequencyMustTripCurve.CurveDataPoints.CurveDataPoint[1].y.Value = 2;
    $EVSE.ISO20.AC_DER_ChargeParameterDiscovery_Response.CPDResEnergyTransferMode.DER_AC_CPDResEnergyTransferMode.DERControl.FrequencyTrip.UnderFrequencyMustTripCurve.CurveDataPoints.CurveDataPoint[2].x.Exponent = 1;
    $EVSE.ISO20.AC_DER_ChargeParameterDiscovery_Response.CPDResEnergyTransferMode.DER_AC_CPDResEnergyTransferMode.DERControl.FrequencyTrip.UnderFrequencyMustTripCurve.CurveDataPoints.CurveDataPoint[2].x.Value = 2;
    $EVSE.ISO20.AC_DER_ChargeParameterDiscovery_Response.CPDResEnergyTransferMode.DER_AC_CPDResEnergyTransferMode.DERControl.FrequencyTrip.UnderFrequencyMustTripCurve.CurveDataPoints.CurveDataPoint[2].y.Exponent = 1;
    $EVSE.ISO20.AC_DER_ChargeParameterDiscovery_Response.CPDResEnergyTransferMode.DER_AC_CPDResEnergyTransferMode.DERControl.FrequencyTrip.UnderFrequencyMustTripCurve.CurveDataPoints.CurveDataPoint[2].y.Value = 2;
    $EVSE.ISO20.AC_DER_ChargeParameterDiscovery_Response.CPDResEnergyTransferMode.DER_AC_CPDResEnergyTransferMode.DERControl.FrequencyTrip.UnderFrequencyMustTripCurve.LockInValue = _CCS::DataTypes::LockValueUnitType::W;
    $EVSE.ISO20.AC_DER_ChargeParameterDiscovery_Response.CPDResEnergyTransferMode.DER_AC_CPDResEnergyTransferMode.DERControl.FrequencyTrip.UnderFrequencyMustTripCurve.LockOutValue = _CCS::DataTypes::LockValueUnitType::W;
    $EVSE.ISO20.AC_DER_ChargeParameterDiscovery_Response.CPDResEnergyTransferMode.DER_AC_CPDResEnergyTransferMode.DERControl.FrequencyTrip.UnderFrequencyMustTripCurve.OpenLoopResponseTime.Exponent = 2;
    $EVSE.ISO20.AC_DER_ChargeParameterDiscovery_Response.CPDResEnergyTransferMode.DER_AC_CPDResEnergyTransferMode.DERControl.FrequencyTrip.UnderFrequencyMustTripCurve.OpenLoopResponseTime.Value = 1;
    $EVSE.ISO20.AC_DER_ChargeParameterDiscovery_Response.CPDResEnergyTransferMode.DER_AC_CPDResEnergyTransferMode.DERControl.FrequencyTrip.UnderFrequencyMustTripCurve.TimeConstantPT1 = 2;
    $EVSE.ISO20.AC_DER_ChargeParameterDiscovery_Response.CPDResEnergyTransferMode.DER_AC_CPDResEnergyTransferMode.DERControl.FrequencyTrip.UnderFrequencyMustTripCurve.IntentionalDelay.Exponent = 2;
    $EVSE.ISO20.AC_DER_ChargeParameterDiscovery_Response.CPDResEnergyTransferMode.DER_AC_CPDResEnergyTransferMode.DERControl.FrequencyTrip.UnderFrequencyMustTripCurve.IntentionalDelay.Value = 1;

    $EVSE.ISO20.AC_DER_ChargeParameterDiscovery_Response.CPDResEnergyTransferMode.DER_AC_CPDResEnergyTransferMode.DERControl.FrequencyTrip.OverFrequencyMayTripCurve.Enable = 1;
    $EVSE.ISO20.AC_DER_ChargeParameterDiscovery_Response.CPDResEnergyTransferMode.DER_AC_CPDResEnergyTransferMode.DERControl.FrequencyTrip.OverFrequencyMayTripCurve.Priority = 2;
    $EVSE.ISO20.AC_DER_ChargeParameterDiscovery_Response.CPDResEnergyTransferMode.DER_AC_CPDResEnergyTransferMode.DERControl.FrequencyTrip.OverFrequencyMayTripCurve.xUnit = _CCS::DataTypes::CurveDataPointsUnitType::W;
    $EVSE.ISO20.AC_DER_ChargeParameterDiscovery_Response.CPDResEnergyTransferMode.DER_AC_CPDResEnergyTransferMode.DERControl.FrequencyTrip.OverFrequencyMayTripCurve.yUnit = _CCS::DataTypes::CurveDataPointsUnitType::W;
    $EVSE.ISO20.AC_DER_ChargeParameterDiscovery_Response.CPDResEnergyTransferMode.DER_AC_CPDResEnergyTransferMode.DERControl.FrequencyTrip.OverFrequencyMayTripCurve.CurveDataPoints.CurveDataPoint.Length = 3;
    $EVSE.ISO20.AC_DER_ChargeParameterDiscovery_Response.CPDResEnergyTransferMode.DER_AC_CPDResEnergyTransferMode.DERControl.FrequencyTrip.OverFrequencyMayTripCurve.CurveDataPoints.CurveDataPoint[0].x.Exponent = 1;
    $EVSE.ISO20.AC_DER_ChargeParameterDiscovery_Response.CPDResEnergyTransferMode.DER_AC_CPDResEnergyTransferMode.DERControl.FrequencyTrip.OverFrequencyMayTripCurve.CurveDataPoints.CurveDataPoint[0].x.Value = 2;
    $EVSE.ISO20.AC_DER_ChargeParameterDiscovery_Response.CPDResEnergyTransferMode.DER_AC_CPDResEnergyTransferMode.DERControl.FrequencyTrip.OverFrequencyMayTripCurve.CurveDataPoints.CurveDataPoint[0].y.Exponent = 1;
    $EVSE.ISO20.AC_DER_ChargeParameterDiscovery_Response.CPDResEnergyTransferMode.DER_AC_CPDResEnergyTransferMode.DERControl.FrequencyTrip.OverFrequencyMayTripCurve.CurveDataPoints.CurveDataPoint[0].y.Value = 2;
    $EVSE.ISO20.AC_DER_ChargeParameterDiscovery_Response.CPDResEnergyTransferMode.DER_AC_CPDResEnergyTransferMode.DERControl.FrequencyTrip.OverFrequencyMayTripCurve.CurveDataPoints.CurveDataPoint[1].x.Exponent = 1;
    $EVSE.ISO20.AC_DER_ChargeParameterDiscovery_Response.CPDResEnergyTransferMode.DER_AC_CPDResEnergyTransferMode.DERControl.FrequencyTrip.OverFrequencyMayTripCurve.CurveDataPoints.CurveDataPoint[1].x.Value = 2;
    $EVSE.ISO20.AC_DER_ChargeParameterDiscovery_Response.CPDResEnergyTransferMode.DER_AC_CPDResEnergyTransferMode.DERControl.FrequencyTrip.OverFrequencyMayTripCurve.CurveDataPoints.CurveDataPoint[1].y.Exponent = 1;
    $EVSE.ISO20.AC_DER_ChargeParameterDiscovery_Response.CPDResEnergyTransferMode.DER_AC_CPDResEnergyTransferMode.DERControl.FrequencyTrip.OverFrequencyMayTripCurve.CurveDataPoints.CurveDataPoint[1].y.Value = 2;
    $EVSE.ISO20.AC_DER_ChargeParameterDiscovery_Response.CPDResEnergyTransferMode.DER_AC_CPDResEnergyTransferMode.DERControl.FrequencyTrip.OverFrequencyMayTripCurve.CurveDataPoints.CurveDataPoint[2].x.Exponent = 1;
    $EVSE.ISO20.AC_DER_ChargeParameterDiscovery_Response.CPDResEnergyTransferMode.DER_AC_CPDResEnergyTransferMode.DERControl.FrequencyTrip.OverFrequencyMayTripCurve.CurveDataPoints.CurveDataPoint[2].x.Value = 2;
    $EVSE.ISO20.AC_DER_ChargeParameterDiscovery_Response.CPDResEnergyTransferMode.DER_AC_CPDResEnergyTransferMode.DERControl.FrequencyTrip.OverFrequencyMayTripCurve.CurveDataPoints.CurveDataPoint[2].y.Exponent = 1;
    $EVSE.ISO20.AC_DER_ChargeParameterDiscovery_Response.CPDResEnergyTransferMode.DER_AC_CPDResEnergyTransferMode.DERControl.FrequencyTrip.OverFrequencyMayTripCurve.CurveDataPoints.CurveDataPoint[2].y.Value = 2;
    $EVSE.ISO20.AC_DER_ChargeParameterDiscovery_Response.CPDResEnergyTransferMode.DER_AC_CPDResEnergyTransferMode.DERControl.FrequencyTrip.OverFrequencyMayTripCurve.LockInValue = _CCS::DataTypes::LockValueUnitType::W;
    $EVSE.ISO20.AC_DER_ChargeParameterDiscovery_Response.CPDResEnergyTransferMode.DER_AC_CPDResEnergyTransferMode.DERControl.FrequencyTrip.OverFrequencyMayTripCurve.LockOutValue = _CCS::DataTypes::LockValueUnitType::W;
    $EVSE.ISO20.AC_DER_ChargeParameterDiscovery_Response.CPDResEnergyTransferMode.DER_AC_CPDResEnergyTransferMode.DERControl.FrequencyTrip.OverFrequencyMayTripCurve.OpenLoopResponseTime.Exponent = 2;
    $EVSE.ISO20.AC_DER_ChargeParameterDiscovery_Response.CPDResEnergyTransferMode.DER_AC_CPDResEnergyTransferMode.DERControl.FrequencyTrip.OverFrequencyMayTripCurve.OpenLoopResponseTime.Value = 1;
    $EVSE.ISO20.AC_DER_ChargeParameterDiscovery_Response.CPDResEnergyTransferMode.DER_AC_CPDResEnergyTransferMode.DERControl.FrequencyTrip.OverFrequencyMayTripCurve.TimeConstantPT1 = 2;
    $EVSE.ISO20.AC_DER_ChargeParameterDiscovery_Response.CPDResEnergyTransferMode.DER_AC_CPDResEnergyTransferMode.DERControl.FrequencyTrip.OverFrequencyMayTripCurve.IntentionalDelay.Exponent = 2;
    $EVSE.ISO20.AC_DER_ChargeParameterDiscovery_Response.CPDResEnergyTransferMode.DER_AC_CPDResEnergyTransferMode.DERControl.FrequencyTrip.OverFrequencyMayTripCurve.IntentionalDelay.Value = 1;

    $EVSE.ISO20.AC_DER_ChargeParameterDiscovery_Response.CPDResEnergyTransferMode.DER_AC_CPDResEnergyTransferMode.DERControl.FrequencyTrip.UnderFrequencyMayTripCurve.Enable = 1;
    $EVSE.ISO20.AC_DER_ChargeParameterDiscovery_Response.CPDResEnergyTransferMode.DER_AC_CPDResEnergyTransferMode.DERControl.FrequencyTrip.UnderFrequencyMayTripCurve.Priority = 2;
    $EVSE.ISO20.AC_DER_ChargeParameterDiscovery_Response.CPDResEnergyTransferMode.DER_AC_CPDResEnergyTransferMode.DERControl.FrequencyTrip.UnderFrequencyMayTripCurve.xUnit = _CCS::DataTypes::CurveDataPointsUnitType::W;
    $EVSE.ISO20.AC_DER_ChargeParameterDiscovery_Response.CPDResEnergyTransferMode.DER_AC_CPDResEnergyTransferMode.DERControl.FrequencyTrip.UnderFrequencyMayTripCurve.yUnit = _CCS::DataTypes::CurveDataPointsUnitType::W;
    $EVSE.ISO20.AC_DER_ChargeParameterDiscovery_Response.CPDResEnergyTransferMode.DER_AC_CPDResEnergyTransferMode.DERControl.FrequencyTrip.UnderFrequencyMayTripCurve.CurveDataPoints.CurveDataPoint.Length = 3;
    $EVSE.ISO20.AC_DER_ChargeParameterDiscovery_Response.CPDResEnergyTransferMode.DER_AC_CPDResEnergyTransferMode.DERControl.FrequencyTrip.UnderFrequencyMayTripCurve.CurveDataPoints.CurveDataPoint[0].x.Exponent = 1;
    $EVSE.ISO20.AC_DER_ChargeParameterDiscovery_Response.CPDResEnergyTransferMode.DER_AC_CPDResEnergyTransferMode.DERControl.FrequencyTrip.UnderFrequencyMayTripCurve.CurveDataPoints.CurveDataPoint[0].x.Value = 2;
    $EVSE.ISO20.AC_DER_ChargeParameterDiscovery_Response.CPDResEnergyTransferMode.DER_AC_CPDResEnergyTransferMode.DERControl.FrequencyTrip.UnderFrequencyMayTripCurve.CurveDataPoints.CurveDataPoint[0].y.Exponent = 1;
    $EVSE.ISO20.AC_DER_ChargeParameterDiscovery_Response.CPDResEnergyTransferMode.DER_AC_CPDResEnergyTransferMode.DERControl.FrequencyTrip.UnderFrequencyMayTripCurve.CurveDataPoints.CurveDataPoint[0].y.Value = 2;
    $EVSE.ISO20.AC_DER_ChargeParameterDiscovery_Response.CPDResEnergyTransferMode.DER_AC_CPDResEnergyTransferMode.DERControl.FrequencyTrip.UnderFrequencyMayTripCurve.CurveDataPoints.CurveDataPoint[1].x.Exponent = 1;
    $EVSE.ISO20.AC_DER_ChargeParameterDiscovery_Response.CPDResEnergyTransferMode.DER_AC_CPDResEnergyTransferMode.DERControl.FrequencyTrip.UnderFrequencyMayTripCurve.CurveDataPoints.CurveDataPoint[1].x.Value = 2;
    $EVSE.ISO20.AC_DER_ChargeParameterDiscovery_Response.CPDResEnergyTransferMode.DER_AC_CPDResEnergyTransferMode.DERControl.FrequencyTrip.UnderFrequencyMayTripCurve.CurveDataPoints.CurveDataPoint[1].y.Exponent = 1;
    $EVSE.ISO20.AC_DER_ChargeParameterDiscovery_Response.CPDResEnergyTransferMode.DER_AC_CPDResEnergyTransferMode.DERControl.FrequencyTrip.UnderFrequencyMayTripCurve.CurveDataPoints.CurveDataPoint[1].y.Value = 2;
    $EVSE.ISO20.AC_DER_ChargeParameterDiscovery_Response.CPDResEnergyTransferMode.DER_AC_CPDResEnergyTransferMode.DERControl.FrequencyTrip.UnderFrequencyMayTripCurve.CurveDataPoints.CurveDataPoint[2].x.Exponent = 1;
    $EVSE.ISO20.AC_DER_ChargeParameterDiscovery_Response.CPDResEnergyTransferMode.DER_AC_CPDResEnergyTransferMode.DERControl.FrequencyTrip.UnderFrequencyMayTripCurve.CurveDataPoints.CurveDataPoint[2].x.Value = 2;
    $EVSE.ISO20.AC_DER_ChargeParameterDiscovery_Response.CPDResEnergyTransferMode.DER_AC_CPDResEnergyTransferMode.DERControl.FrequencyTrip.UnderFrequencyMayTripCurve.CurveDataPoints.CurveDataPoint[2].y.Exponent = 1;
    $EVSE.ISO20.AC_DER_ChargeParameterDiscovery_Response.CPDResEnergyTransferMode.DER_AC_CPDResEnergyTransferMode.DERControl.FrequencyTrip.UnderFrequencyMayTripCurve.CurveDataPoints.CurveDataPoint[2].y.Value = 2;
    $EVSE.ISO20.AC_DER_ChargeParameterDiscovery_Response.CPDResEnergyTransferMode.DER_AC_CPDResEnergyTransferMode.DERControl.FrequencyTrip.UnderFrequencyMayTripCurve.LockInValue = _CCS::DataTypes::LockValueUnitType::W;
    $EVSE.ISO20.AC_DER_ChargeParameterDiscovery_Response.CPDResEnergyTransferMode.DER_AC_CPDResEnergyTransferMode.DERControl.FrequencyTrip.UnderFrequencyMayTripCurve.LockOutValue = _CCS::DataTypes::LockValueUnitType::W;
    $EVSE.ISO20.AC_DER_ChargeParameterDiscovery_Response.CPDResEnergyTransferMode.DER_AC_CPDResEnergyTransferMode.DERControl.FrequencyTrip.UnderFrequencyMayTripCurve.OpenLoopResponseTime.Exponent = 2;
    $EVSE.ISO20.AC_DER_ChargeParameterDiscovery_Response.CPDResEnergyTransferMode.DER_AC_CPDResEnergyTransferMode.DERControl.FrequencyTrip.UnderFrequencyMayTripCurve.OpenLoopResponseTime.Value = 1;
    $EVSE.ISO20.AC_DER_ChargeParameterDiscovery_Response.CPDResEnergyTransferMode.DER_AC_CPDResEnergyTransferMode.DERControl.FrequencyTrip.UnderFrequencyMayTripCurve.TimeConstantPT1 = 2;
    $EVSE.ISO20.AC_DER_ChargeParameterDiscovery_Response.CPDResEnergyTransferMode.DER_AC_CPDResEnergyTransferMode.DERControl.FrequencyTrip.UnderFrequencyMayTripCurve.IntentionalDelay.Exponent = 2;
    $EVSE.ISO20.AC_DER_ChargeParameterDiscovery_Response.CPDResEnergyTransferMode.DER_AC_CPDResEnergyTransferMode.DERControl.FrequencyTrip.UnderFrequencyMayTripCurve.IntentionalDelay.Value = 1;

    /* FaultRideThrough */
    $EVSE.ISO20.AC_DER_ChargeParameterDiscovery_Response.CPDResEnergyTransferMode.DER_AC_CPDResEnergyTransferMode.DERControl.FaultRideThrough.OverVoltageRideThroughPositiveCurveKFactor.Exponent = 2;
    $EVSE.ISO20.AC_DER_ChargeParameterDiscovery_Response.CPDResEnergyTransferMode.DER_AC_CPDResEnergyTransferMode.DERControl.FaultRideThrough.OverVoltageRideThroughPositiveCurveKFactor.Value = 2;
    $EVSE.ISO20.AC_DER_ChargeParameterDiscovery_Response.CPDResEnergyTransferMode.DER_AC_CPDResEnergyTransferMode.DERControl.FaultRideThrough.OverVoltageRideThroughNegativeCurveKFactor.Exponent = 2;
    $EVSE.ISO20.AC_DER_ChargeParameterDiscovery_Response.CPDResEnergyTransferMode.DER_AC_CPDResEnergyTransferMode.DERControl.FaultRideThrough.OverVoltageRideThroughNegativeCurveKFactor.Value = 2;
    $EVSE.ISO20.AC_DER_ChargeParameterDiscovery_Response.CPDResEnergyTransferMode.DER_AC_CPDResEnergyTransferMode.DERControl.FaultRideThrough.UnderVoltageRideThroughPositiveCurveKFactor.Exponent = 2;
    $EVSE.ISO20.AC_DER_ChargeParameterDiscovery_Response.CPDResEnergyTransferMode.DER_AC_CPDResEnergyTransferMode.DERControl.FaultRideThrough.UnderVoltageRideThroughPositiveCurveKFactor.Value = 2; 
    $EVSE.ISO20.AC_DER_ChargeParameterDiscovery_Response.CPDResEnergyTransferMode.DER_AC_CPDResEnergyTransferMode.DERControl.FaultRideThrough.UnderVoltageRideThroughNegativeCurveKFactor.Exponent = 2;
    $EVSE.ISO20.AC_DER_ChargeParameterDiscovery_Response.CPDResEnergyTransferMode.DER_AC_CPDResEnergyTransferMode.DERControl.FaultRideThrough.UnderVoltageRideThroughNegativeCurveKFactor.Value = 2;

    $EVSE.ISO20.AC_DER_ChargeParameterDiscovery_Response.CPDResEnergyTransferMode.DER_AC_CPDResEnergyTransferMode.DERControl.FaultRideThrough.DeadBand.MidLow.Exponent = 2;
    $EVSE.ISO20.AC_DER_ChargeParameterDiscovery_Response.CPDResEnergyTransferMode.DER_AC_CPDResEnergyTransferMode.DERControl.FaultRideThrough.DeadBand.MidLow.Value = 2;
    $EVSE.ISO20.AC_DER_ChargeParameterDiscovery_Response.CPDResEnergyTransferMode.DER_AC_CPDResEnergyTransferMode.DERControl.FaultRideThrough.DeadBand.MidHigh.Exponent = 2;
    $EVSE.ISO20.AC_DER_ChargeParameterDiscovery_Response.CPDResEnergyTransferMode.DER_AC_CPDResEnergyTransferMode.DERControl.FaultRideThrough.DeadBand.MidHigh.Value = 2;
    $EVSE.ISO20.AC_DER_ChargeParameterDiscovery_Response.CPDResEnergyTransferMode.DER_AC_CPDResEnergyTransferMode.DERControl.FaultRideThrough.DeadBand.Low.Exponent = 2;
    $EVSE.ISO20.AC_DER_ChargeParameterDiscovery_Response.CPDResEnergyTransferMode.DER_AC_CPDResEnergyTransferMode.DERControl.FaultRideThrough.DeadBand.Low.Value = 2;
    $EVSE.ISO20.AC_DER_ChargeParameterDiscovery_Response.CPDResEnergyTransferMode.DER_AC_CPDResEnergyTransferMode.DERControl.FaultRideThrough.DeadBand.High.Exponent = 2;
    $EVSE.ISO20.AC_DER_ChargeParameterDiscovery_Response.CPDResEnergyTransferMode.DER_AC_CPDResEnergyTransferMode.DERControl.FaultRideThrough.DeadBand.High.Value = 2;
    
    /* EnterService */
    $EVSE.ISO20.AC_DER_ChargeParameterDiscovery_Response.CPDResEnergyTransferMode.DER_AC_CPDResEnergyTransferMode.DERControl.EnterService.PermitService = 1;
    $EVSE.ISO20.AC_DER_ChargeParameterDiscovery_Response.CPDResEnergyTransferMode.DER_AC_CPDResEnergyTransferMode.DERControl.EnterService.EnterServiceVoltageHigh.Exponent = 2;
    $EVSE.ISO20.AC_DER_ChargeParameterDiscovery_Response.CPDResEnergyTransferMode.DER_AC_CPDResEnergyTransferMode.DERControl.EnterService.EnterServiceVoltageHigh.Value = 2;
    $EVSE.ISO20.AC_DER_ChargeParameterDiscovery_Response.CPDResEnergyTransferMode.DER_AC_CPDResEnergyTransferMode.DERControl.EnterService.EnterServiceVoltageLow.Exponent = 2;
    $EVSE.ISO20.AC_DER_ChargeParameterDiscovery_Response.CPDResEnergyTransferMode.DER_AC_CPDResEnergyTransferMode.DERControl.EnterService.EnterServiceVoltageLow.Value = 2;
    $EVSE.ISO20.AC_DER_ChargeParameterDiscovery_Response.CPDResEnergyTransferMode.DER_AC_CPDResEnergyTransferMode.DERControl.EnterService.EnterServiceFrequencyHigh.Exponent = 2;
    $EVSE.ISO20.AC_DER_ChargeParameterDiscovery_Response.CPDResEnergyTransferMode.DER_AC_CPDResEnergyTransferMode.DERControl.EnterService.EnterServiceFrequencyHigh.Value = 2;
    $EVSE.ISO20.AC_DER_ChargeParameterDiscovery_Response.CPDResEnergyTransferMode.DER_AC_CPDResEnergyTransferMode.DERControl.EnterService.EnterServiceFrequencyLow.Exponent = 2;
    $EVSE.ISO20.AC_DER_ChargeParameterDiscovery_Response.CPDResEnergyTransferMode.DER_AC_CPDResEnergyTransferMode.DERControl.EnterService.EnterServiceFrequencyLow.Value = 2;
    $EVSE.ISO20.AC_DER_ChargeParameterDiscovery_Response.CPDResEnergyTransferMode.DER_AC_CPDResEnergyTransferMode.DERControl.EnterService.EnterServiceDelay.Exponent = 2;
    $EVSE.ISO20.AC_DER_ChargeParameterDiscovery_Response.CPDResEnergyTransferMode.DER_AC_CPDResEnergyTransferMode.DERControl.EnterService.EnterServiceDelay.Value = 2;
    $EVSE.ISO20.AC_DER_ChargeParameterDiscovery_Response.CPDResEnergyTransferMode.DER_AC_CPDResEnergyTransferMode.DERControl.EnterService.EnterServiceRandomizedDelay.Exponent = 2;
    $EVSE.ISO20.AC_DER_ChargeParameterDiscovery_Response.CPDResEnergyTransferMode.DER_AC_CPDResEnergyTransferMode.DERControl.EnterService.EnterServiceRandomizedDelay.Value = 2;
    $EVSE.ISO20.AC_DER_ChargeParameterDiscovery_Response.CPDResEnergyTransferMode.DER_AC_CPDResEnergyTransferMode.DERControl.EnterService.EnterServiceRampTime.Exponent = 2;
    $EVSE.ISO20.AC_DER_ChargeParameterDiscovery_Response.CPDResEnergyTransferMode.DER_AC_CPDResEnergyTransferMode.DERControl.EnterService.EnterServiceRampTime.Value = 2;
    $EVSE.ISO20.AC_DER_ChargeParameterDiscovery_Response.CPDResEnergyTransferMode.DER_AC_CPDResEnergyTransferMode.DERControl.EnterService.EnterServiceGradient.Exponent = 2;
    $EVSE.ISO20.AC_DER_ChargeParameterDiscovery_Response.CPDResEnergyTransferMode.DER_AC_CPDResEnergyTransferMode.DERControl.EnterService.EnterServiceGradient.Value = 2;
    
    /* ReactivePowerSupport */
    $EVSE.ISO20.AC_DER_ChargeParameterDiscovery_Response.CPDResEnergyTransferMode.DER_AC_CPDResEnergyTransferMode.DERControl.ReactivePowerSupport.ConstantPowerFactor.Enable = 1;
    $EVSE.ISO20.AC_DER_ChargeParameterDiscovery_Response.CPDResEnergyTransferMode.DER_AC_CPDResEnergyTransferMode.DERControl.ReactivePowerSupport.ConstantPowerFactor.Priority = 2;
    $EVSE.ISO20.AC_DER_ChargeParameterDiscovery_Response.CPDResEnergyTransferMode.DER_AC_CPDResEnergyTransferMode.DERControl.ReactivePowerSupport.ConstantPowerFactor.PowerFactorValue.Exponent = 2;
    $EVSE.ISO20.AC_DER_ChargeParameterDiscovery_Response.CPDResEnergyTransferMode.DER_AC_CPDResEnergyTransferMode.DERControl.ReactivePowerSupport.ConstantPowerFactor.PowerFactorValue.Value = 2;
    $EVSE.ISO20.AC_DER_ChargeParameterDiscovery_Response.CPDResEnergyTransferMode.DER_AC_CPDResEnergyTransferMode.DERControl.ReactivePowerSupport.ConstantPowerFactor.PowerFactorExcitation = _CCS::DataTypes::PowerFactorExcitationType::Under_Excited;

    $EVSE.ISO20.AC_DER_ChargeParameterDiscovery_Response.CPDResEnergyTransferMode.DER_AC_CPDResEnergyTransferMode.DERControl.ReactivePowerSupport.VoltVar.Enable = 1;
    $EVSE.ISO20.AC_DER_ChargeParameterDiscovery_Response.CPDResEnergyTransferMode.DER_AC_CPDResEnergyTransferMode.DERControl.ReactivePowerSupport.VoltVar.Priority = 2;
    $EVSE.ISO20.AC_DER_ChargeParameterDiscovery_Response.CPDResEnergyTransferMode.DER_AC_CPDResEnergyTransferMode.DERControl.ReactivePowerSupport.VoltVar.xUnit = _CCS::DataTypes::CurveDataPointsUnitType::W;
    $EVSE.ISO20.AC_DER_ChargeParameterDiscovery_Response.CPDResEnergyTransferMode.DER_AC_CPDResEnergyTransferMode.DERControl.ReactivePowerSupport.VoltVar.yUnit = _CCS::DataTypes::CurveDataPointsUnitType::W;
    $EVSE.ISO20.AC_DER_ChargeParameterDiscovery_Response.CPDResEnergyTransferMode.DER_AC_CPDResEnergyTransferMode.DERControl.ReactivePowerSupport.VoltVar.CurveDataPoints.CurveDataPoint.Length = 3;
    $EVSE.ISO20.AC_DER_ChargeParameterDiscovery_Response.CPDResEnergyTransferMode.DER_AC_CPDResEnergyTransferMode.DERControl.ReactivePowerSupport.VoltVar.CurveDataPoints.CurveDataPoint[0].x.Exponent = 1;
    $EVSE.ISO20.AC_DER_ChargeParameterDiscovery_Response.CPDResEnergyTransferMode.DER_AC_CPDResEnergyTransferMode.DERControl.ReactivePowerSupport.VoltVar.CurveDataPoints.CurveDataPoint[0].x.Value = 2;
    $EVSE.ISO20.AC_DER_ChargeParameterDiscovery_Response.CPDResEnergyTransferMode.DER_AC_CPDResEnergyTransferMode.DERControl.ReactivePowerSupport.VoltVar.CurveDataPoints.CurveDataPoint[0].y.Exponent = 1;
    $EVSE.ISO20.AC_DER_ChargeParameterDiscovery_Response.CPDResEnergyTransferMode.DER_AC_CPDResEnergyTransferMode.DERControl.ReactivePowerSupport.VoltVar.CurveDataPoints.CurveDataPoint[0].y.Value = 2;
    $EVSE.ISO20.AC_DER_ChargeParameterDiscovery_Response.CPDResEnergyTransferMode.DER_AC_CPDResEnergyTransferMode.DERControl.ReactivePowerSupport.VoltVar.CurveDataPoints.CurveDataPoint[1].x.Exponent = 1;
    $EVSE.ISO20.AC_DER_ChargeParameterDiscovery_Response.CPDResEnergyTransferMode.DER_AC_CPDResEnergyTransferMode.DERControl.ReactivePowerSupport.VoltVar.CurveDataPoints.CurveDataPoint[1].x.Value = 2;
    $EVSE.ISO20.AC_DER_ChargeParameterDiscovery_Response.CPDResEnergyTransferMode.DER_AC_CPDResEnergyTransferMode.DERControl.ReactivePowerSupport.VoltVar.CurveDataPoints.CurveDataPoint[1].y.Exponent = 1;
    $EVSE.ISO20.AC_DER_ChargeParameterDiscovery_Response.CPDResEnergyTransferMode.DER_AC_CPDResEnergyTransferMode.DERControl.ReactivePowerSupport.VoltVar.CurveDataPoints.CurveDataPoint[1].y.Value = 2;
    $EVSE.ISO20.AC_DER_ChargeParameterDiscovery_Response.CPDResEnergyTransferMode.DER_AC_CPDResEnergyTransferMode.DERControl.ReactivePowerSupport.VoltVar.CurveDataPoints.CurveDataPoint[2].x.Exponent = 1;
    $EVSE.ISO20.AC_DER_ChargeParameterDiscovery_Response.CPDResEnergyTransferMode.DER_AC_CPDResEnergyTransferMode.DERControl.ReactivePowerSupport.VoltVar.CurveDataPoints.CurveDataPoint[2].x.Value = 2;
    $EVSE.ISO20.AC_DER_ChargeParameterDiscovery_Response.CPDResEnergyTransferMode.DER_AC_CPDResEnergyTransferMode.DERControl.ReactivePowerSupport.VoltVar.CurveDataPoints.CurveDataPoint[2].y.Exponent = 1;
    $EVSE.ISO20.AC_DER_ChargeParameterDiscovery_Response.CPDResEnergyTransferMode.DER_AC_CPDResEnergyTransferMode.DERControl.ReactivePowerSupport.VoltVar.CurveDataPoints.CurveDataPoint[2].y.Value = 2;
    $EVSE.ISO20.AC_DER_ChargeParameterDiscovery_Response.CPDResEnergyTransferMode.DER_AC_CPDResEnergyTransferMode.DERControl.ReactivePowerSupport.VoltVar.LockInValue = _CCS::DataTypes::LockValueUnitType::W;
    $EVSE.ISO20.AC_DER_ChargeParameterDiscovery_Response.CPDResEnergyTransferMode.DER_AC_CPDResEnergyTransferMode.DERControl.ReactivePowerSupport.VoltVar.LockOutValue = _CCS::DataTypes::LockValueUnitType::W;
    $EVSE.ISO20.AC_DER_ChargeParameterDiscovery_Response.CPDResEnergyTransferMode.DER_AC_CPDResEnergyTransferMode.DERControl.ReactivePowerSupport.VoltVar.OpenLoopResponseTime.Exponent = 2;
    $EVSE.ISO20.AC_DER_ChargeParameterDiscovery_Response.CPDResEnergyTransferMode.DER_AC_CPDResEnergyTransferMode.DERControl.ReactivePowerSupport.VoltVar.OpenLoopResponseTime.Value = 1;
    $EVSE.ISO20.AC_DER_ChargeParameterDiscovery_Response.CPDResEnergyTransferMode.DER_AC_CPDResEnergyTransferMode.DERControl.ReactivePowerSupport.VoltVar.TimeConstantPT1 = 2;
    $EVSE.ISO20.AC_DER_ChargeParameterDiscovery_Response.CPDResEnergyTransferMode.DER_AC_CPDResEnergyTransferMode.DERControl.ReactivePowerSupport.VoltVar.IntentionalDelay.Exponent = 2;
    $EVSE.ISO20.AC_DER_ChargeParameterDiscovery_Response.CPDResEnergyTransferMode.DER_AC_CPDResEnergyTransferMode.DERControl.ReactivePowerSupport.VoltVar.IntentionalDelay.Value = 1;

    $EVSE.ISO20.AC_DER_ChargeParameterDiscovery_Response.CPDResEnergyTransferMode.DER_AC_CPDResEnergyTransferMode.DERControl.ReactivePowerSupport.WattVar.Enable = 1;
    $EVSE.ISO20.AC_DER_ChargeParameterDiscovery_Response.CPDResEnergyTransferMode.DER_AC_CPDResEnergyTransferMode.DERControl.ReactivePowerSupport.WattVar.Priority = 2;
    $EVSE.ISO20.AC_DER_ChargeParameterDiscovery_Response.CPDResEnergyTransferMode.DER_AC_CPDResEnergyTransferMode.DERControl.ReactivePowerSupport.WattVar.xUnit = _CCS::DataTypes::CurveDataPointsUnitType::W;
    $EVSE.ISO20.AC_DER_ChargeParameterDiscovery_Response.CPDResEnergyTransferMode.DER_AC_CPDResEnergyTransferMode.DERControl.ReactivePowerSupport.WattVar.yUnit = _CCS::DataTypes::CurveDataPointsUnitType::W;
    $EVSE.ISO20.AC_DER_ChargeParameterDiscovery_Response.CPDResEnergyTransferMode.DER_AC_CPDResEnergyTransferMode.DERControl.ReactivePowerSupport.WattVar.CurveDataPoints.CurveDataPoint.Length = 3;
    $EVSE.ISO20.AC_DER_ChargeParameterDiscovery_Response.CPDResEnergyTransferMode.DER_AC_CPDResEnergyTransferMode.DERControl.ReactivePowerSupport.WattVar.CurveDataPoints.CurveDataPoint[0].x.Exponent = 1;
    $EVSE.ISO20.AC_DER_ChargeParameterDiscovery_Response.CPDResEnergyTransferMode.DER_AC_CPDResEnergyTransferMode.DERControl.ReactivePowerSupport.WattVar.CurveDataPoints.CurveDataPoint[0].x.Value = 2;
    $EVSE.ISO20.AC_DER_ChargeParameterDiscovery_Response.CPDResEnergyTransferMode.DER_AC_CPDResEnergyTransferMode.DERControl.ReactivePowerSupport.WattVar.CurveDataPoints.CurveDataPoint[0].y.Exponent = 1;
    $EVSE.ISO20.AC_DER_ChargeParameterDiscovery_Response.CPDResEnergyTransferMode.DER_AC_CPDResEnergyTransferMode.DERControl.ReactivePowerSupport.WattVar.CurveDataPoints.CurveDataPoint[0].y.Value = 2;
    $EVSE.ISO20.AC_DER_ChargeParameterDiscovery_Response.CPDResEnergyTransferMode.DER_AC_CPDResEnergyTransferMode.DERControl.ReactivePowerSupport.WattVar.CurveDataPoints.CurveDataPoint[1].x.Exponent = 1;
    $EVSE.ISO20.AC_DER_ChargeParameterDiscovery_Response.CPDResEnergyTransferMode.DER_AC_CPDResEnergyTransferMode.DERControl.ReactivePowerSupport.WattVar.CurveDataPoints.CurveDataPoint[1].x.Value = 2;
    $EVSE.ISO20.AC_DER_ChargeParameterDiscovery_Response.CPDResEnergyTransferMode.DER_AC_CPDResEnergyTransferMode.DERControl.ReactivePowerSupport.WattVar.CurveDataPoints.CurveDataPoint[1].y.Exponent = 1;
    $EVSE.ISO20.AC_DER_ChargeParameterDiscovery_Response.CPDResEnergyTransferMode.DER_AC_CPDResEnergyTransferMode.DERControl.ReactivePowerSupport.WattVar.CurveDataPoints.CurveDataPoint[1].y.Value = 2;
    $EVSE.ISO20.AC_DER_ChargeParameterDiscovery_Response.CPDResEnergyTransferMode.DER_AC_CPDResEnergyTransferMode.DERControl.ReactivePowerSupport.WattVar.CurveDataPoints.CurveDataPoint[2].x.Exponent = 1;
    $EVSE.ISO20.AC_DER_ChargeParameterDiscovery_Response.CPDResEnergyTransferMode.DER_AC_CPDResEnergyTransferMode.DERControl.ReactivePowerSupport.WattVar.CurveDataPoints.CurveDataPoint[2].x.Value = 2;
    $EVSE.ISO20.AC_DER_ChargeParameterDiscovery_Response.CPDResEnergyTransferMode.DER_AC_CPDResEnergyTransferMode.DERControl.ReactivePowerSupport.WattVar.CurveDataPoints.CurveDataPoint[2].y.Exponent = 1;
    $EVSE.ISO20.AC_DER_ChargeParameterDiscovery_Response.CPDResEnergyTransferMode.DER_AC_CPDResEnergyTransferMode.DERControl.ReactivePowerSupport.WattVar.CurveDataPoints.CurveDataPoint[2].y.Value = 2;
    $EVSE.ISO20.AC_DER_ChargeParameterDiscovery_Response.CPDResEnergyTransferMode.DER_AC_CPDResEnergyTransferMode.DERControl.ReactivePowerSupport.WattVar.LockInValue = _CCS::DataTypes::LockValueUnitType::W;
    $EVSE.ISO20.AC_DER_ChargeParameterDiscovery_Response.CPDResEnergyTransferMode.DER_AC_CPDResEnergyTransferMode.DERControl.ReactivePowerSupport.WattVar.LockOutValue = _CCS::DataTypes::LockValueUnitType::W;
    $EVSE.ISO20.AC_DER_ChargeParameterDiscovery_Response.CPDResEnergyTransferMode.DER_AC_CPDResEnergyTransferMode.DERControl.ReactivePowerSupport.WattVar.OpenLoopResponseTime.Exponent = 2;
    $EVSE.ISO20.AC_DER_ChargeParameterDiscovery_Response.CPDResEnergyTransferMode.DER_AC_CPDResEnergyTransferMode.DERControl.ReactivePowerSupport.WattVar.OpenLoopResponseTime.Value = 1;
    $EVSE.ISO20.AC_DER_ChargeParameterDiscovery_Response.CPDResEnergyTransferMode.DER_AC_CPDResEnergyTransferMode.DERControl.ReactivePowerSupport.WattVar.TimeConstantPT1 = 2;
    $EVSE.ISO20.AC_DER_ChargeParameterDiscovery_Response.CPDResEnergyTransferMode.DER_AC_CPDResEnergyTransferMode.DERControl.ReactivePowerSupport.WattVar.IntentionalDelay.Exponent = 2;
    $EVSE.ISO20.AC_DER_ChargeParameterDiscovery_Response.CPDResEnergyTransferMode.DER_AC_CPDResEnergyTransferMode.DERControl.ReactivePowerSupport.WattVar.IntentionalDelay.Value = 1;

    /* ConstantVar */
    $EVSE.ISO20.AC_DER_ChargeParameterDiscovery_Response.CPDResEnergyTransferMode.DER_AC_CPDResEnergyTransferMode.DERControl.ReactivePowerSupport.ConstantVar.Enable = 1;
    $EVSE.ISO20.AC_DER_ChargeParameterDiscovery_Response.CPDResEnergyTransferMode.DER_AC_CPDResEnergyTransferMode.DERControl.ReactivePowerSupport.ConstantVar.Priority = 3;
    $EVSE.ISO20.AC_DER_ChargeParameterDiscovery_Response.CPDResEnergyTransferMode.DER_AC_CPDResEnergyTransferMode.DERControl.ReactivePowerSupport.ConstantVar.Setpoint.Exponent = 2;
    $EVSE.ISO20.AC_DER_ChargeParameterDiscovery_Response.CPDResEnergyTransferMode.DER_AC_CPDResEnergyTransferMode.DERControl.ReactivePowerSupport.ConstantVar.Setpoint.Value = 2;
    $EVSE.ISO20.AC_DER_ChargeParameterDiscovery_Response.CPDResEnergyTransferMode.DER_AC_CPDResEnergyTransferMode.DERControl.ReactivePowerSupport.ConstantVar.Unit = _CCS::DataTypes::CurveDataPointsUnitType::W;


    $EVSE.ISO20.AC_DER_ChargeParameterDiscovery_Response.CPDResEnergyTransferMode.DER_AC_CPDResEnergyTransferMode.DERControl.ReactivePowerSupport.WattCosPhi.Enable = 1;
    $EVSE.ISO20.AC_DER_ChargeParameterDiscovery_Response.CPDResEnergyTransferMode.DER_AC_CPDResEnergyTransferMode.DERControl.ReactivePowerSupport.WattCosPhi.Priority = 2;
    $EVSE.ISO20.AC_DER_ChargeParameterDiscovery_Response.CPDResEnergyTransferMode.DER_AC_CPDResEnergyTransferMode.DERControl.ReactivePowerSupport.WattCosPhi.xUnit = _CCS::DataTypes::CurveDataPointsUnitType::W;
    $EVSE.ISO20.AC_DER_ChargeParameterDiscovery_Response.CPDResEnergyTransferMode.DER_AC_CPDResEnergyTransferMode.DERControl.ReactivePowerSupport.WattCosPhi.yUnit = _CCS::DataTypes::CurveDataPointsUnitType::W;
    $EVSE.ISO20.AC_DER_ChargeParameterDiscovery_Response.CPDResEnergyTransferMode.DER_AC_CPDResEnergyTransferMode.DERControl.ReactivePowerSupport.WattCosPhi.CurveDataPoints.CurveDataPoint.Length = 3;
    $EVSE.ISO20.AC_DER_ChargeParameterDiscovery_Response.CPDResEnergyTransferMode.DER_AC_CPDResEnergyTransferMode.DERControl.ReactivePowerSupport.WattCosPhi.CurveDataPoints.CurveDataPoint[0].x.Exponent = 1;
    $EVSE.ISO20.AC_DER_ChargeParameterDiscovery_Response.CPDResEnergyTransferMode.DER_AC_CPDResEnergyTransferMode.DERControl.ReactivePowerSupport.WattCosPhi.CurveDataPoints.CurveDataPoint[0].x.Value = 2;
    $EVSE.ISO20.AC_DER_ChargeParameterDiscovery_Response.CPDResEnergyTransferMode.DER_AC_CPDResEnergyTransferMode.DERControl.ReactivePowerSupport.WattCosPhi.CurveDataPoints.CurveDataPoint[0].y.Exponent = 1;
    $EVSE.ISO20.AC_DER_ChargeParameterDiscovery_Response.CPDResEnergyTransferMode.DER_AC_CPDResEnergyTransferMode.DERControl.ReactivePowerSupport.WattCosPhi.CurveDataPoints.CurveDataPoint[0].y.Value = 2;
    $EVSE.ISO20.AC_DER_ChargeParameterDiscovery_Response.CPDResEnergyTransferMode.DER_AC_CPDResEnergyTransferMode.DERControl.ReactivePowerSupport.WattCosPhi.CurveDataPoints.CurveDataPoint[1].x.Exponent = 1;
    $EVSE.ISO20.AC_DER_ChargeParameterDiscovery_Response.CPDResEnergyTransferMode.DER_AC_CPDResEnergyTransferMode.DERControl.ReactivePowerSupport.WattCosPhi.CurveDataPoints.CurveDataPoint[1].x.Value = 2;
    $EVSE.ISO20.AC_DER_ChargeParameterDiscovery_Response.CPDResEnergyTransferMode.DER_AC_CPDResEnergyTransferMode.DERControl.ReactivePowerSupport.WattCosPhi.CurveDataPoints.CurveDataPoint[1].y.Exponent = 1;
    $EVSE.ISO20.AC_DER_ChargeParameterDiscovery_Response.CPDResEnergyTransferMode.DER_AC_CPDResEnergyTransferMode.DERControl.ReactivePowerSupport.WattCosPhi.CurveDataPoints.CurveDataPoint[1].y.Value = 2;
    $EVSE.ISO20.AC_DER_ChargeParameterDiscovery_Response.CPDResEnergyTransferMode.DER_AC_CPDResEnergyTransferMode.DERControl.ReactivePowerSupport.WattCosPhi.CurveDataPoints.CurveDataPoint[2].x.Exponent = 1;
    $EVSE.ISO20.AC_DER_ChargeParameterDiscovery_Response.CPDResEnergyTransferMode.DER_AC_CPDResEnergyTransferMode.DERControl.ReactivePowerSupport.WattCosPhi.CurveDataPoints.CurveDataPoint[2].x.Value = 2;
    $EVSE.ISO20.AC_DER_ChargeParameterDiscovery_Response.CPDResEnergyTransferMode.DER_AC_CPDResEnergyTransferMode.DERControl.ReactivePowerSupport.WattCosPhi.CurveDataPoints.CurveDataPoint[2].y.Exponent = 1;
    $EVSE.ISO20.AC_DER_ChargeParameterDiscovery_Response.CPDResEnergyTransferMode.DER_AC_CPDResEnergyTransferMode.DERControl.ReactivePowerSupport.WattCosPhi.CurveDataPoints.CurveDataPoint[2].y.Value = 2;
    $EVSE.ISO20.AC_DER_ChargeParameterDiscovery_Response.CPDResEnergyTransferMode.DER_AC_CPDResEnergyTransferMode.DERControl.ReactivePowerSupport.WattCosPhi.LockInValue = _CCS::DataTypes::LockValueUnitType::W;
    $EVSE.ISO20.AC_DER_ChargeParameterDiscovery_Response.CPDResEnergyTransferMode.DER_AC_CPDResEnergyTransferMode.DERControl.ReactivePowerSupport.WattCosPhi.LockOutValue = _CCS::DataTypes::LockValueUnitType::W;
    $EVSE.ISO20.AC_DER_ChargeParameterDiscovery_Response.CPDResEnergyTransferMode.DER_AC_CPDResEnergyTransferMode.DERControl.ReactivePowerSupport.WattCosPhi.OpenLoopResponseTime.Exponent = 2;
    $EVSE.ISO20.AC_DER_ChargeParameterDiscovery_Response.CPDResEnergyTransferMode.DER_AC_CPDResEnergyTransferMode.DERControl.ReactivePowerSupport.WattCosPhi.OpenLoopResponseTime.Value = 1;
    $EVSE.ISO20.AC_DER_ChargeParameterDiscovery_Response.CPDResEnergyTransferMode.DER_AC_CPDResEnergyTransferMode.DERControl.ReactivePowerSupport.WattCosPhi.TimeConstantPT1 = 2;
    $EVSE.ISO20.AC_DER_ChargeParameterDiscovery_Response.CPDResEnergyTransferMode.DER_AC_CPDResEnergyTransferMode.DERControl.ReactivePowerSupport.WattCosPhi.IntentionalDelay.Exponent = 2;
    $EVSE.ISO20.AC_DER_ChargeParameterDiscovery_Response.CPDResEnergyTransferMode.DER_AC_CPDResEnergyTransferMode.DERControl.ReactivePowerSupport.WattCosPhi.IntentionalDelay.Value = 1;
    
    /* ActivePowerSupport */
  if(gEUFrequencyDroop == 1)
  {
    $EVSE.ISO20.AC_DER_ChargeParameterDiscovery_Response.CPDResEnergyTransferMode.DER_AC_CPDResEnergyTransferMode.DERControl.ActivePowerSupport.FrequencyDroopElementId = 0;
    $EVSE.ISO20.AC_DER_ChargeParameterDiscovery_Response.CPDResEnergyTransferMode.DER_AC_CPDResEnergyTransferMode.DERControl.ActivePowerSupport.FrequencyDroop.EU_FrequencyDroop.Priority = 2;
    $EVSE.ISO20.AC_DER_ChargeParameterDiscovery_Response.CPDResEnergyTransferMode.DER_AC_CPDResEnergyTransferMode.DERControl.ActivePowerSupport.FrequencyDroop.EU_FrequencyDroop.Enable = 1;

    $EVSE.ISO20.AC_DER_ChargeParameterDiscovery_Response.CPDResEnergyTransferMode.DER_AC_CPDResEnergyTransferMode.DERControl.ActivePowerSupport.FrequencyDroop.EU_FrequencyDroop.OverFrequencyDroop.Fstart.Exponent = 2;
    $EVSE.ISO20.AC_DER_ChargeParameterDiscovery_Response.CPDResEnergyTransferMode.DER_AC_CPDResEnergyTransferMode.DERControl.ActivePowerSupport.FrequencyDroop.EU_FrequencyDroop.OverFrequencyDroop.Fstart.Value = 2;
    $EVSE.ISO20.AC_DER_ChargeParameterDiscovery_Response.CPDResEnergyTransferMode.DER_AC_CPDResEnergyTransferMode.DERControl.ActivePowerSupport.FrequencyDroop.EU_FrequencyDroop.OverFrequencyDroop.s.Exponent = 2;
    $EVSE.ISO20.AC_DER_ChargeParameterDiscovery_Response.CPDResEnergyTransferMode.DER_AC_CPDResEnergyTransferMode.DERControl.ActivePowerSupport.FrequencyDroop.EU_FrequencyDroop.OverFrequencyDroop.s.Value = 2;
    $EVSE.ISO20.AC_DER_ChargeParameterDiscovery_Response.CPDResEnergyTransferMode.DER_AC_CPDResEnergyTransferMode.DERControl.ActivePowerSupport.FrequencyDroop.EU_FrequencyDroop.OverFrequencyDroop.DeactivationTime.Exponent = 2;
    $EVSE.ISO20.AC_DER_ChargeParameterDiscovery_Response.CPDResEnergyTransferMode.DER_AC_CPDResEnergyTransferMode.DERControl.ActivePowerSupport.FrequencyDroop.EU_FrequencyDroop.OverFrequencyDroop.DeactivationTime.Value = 2;
    $EVSE.ISO20.AC_DER_ChargeParameterDiscovery_Response.CPDResEnergyTransferMode.DER_AC_CPDResEnergyTransferMode.DERControl.ActivePowerSupport.FrequencyDroop.EU_FrequencyDroop.OverFrequencyDroop.IntentionalDelayPowerControl.Exponent = 2;
    $EVSE.ISO20.AC_DER_ChargeParameterDiscovery_Response.CPDResEnergyTransferMode.DER_AC_CPDResEnergyTransferMode.DERControl.ActivePowerSupport.FrequencyDroop.EU_FrequencyDroop.OverFrequencyDroop.IntentionalDelayPowerControl.Value = 2;
    $EVSE.ISO20.AC_DER_ChargeParameterDiscovery_Response.CPDResEnergyTransferMode.DER_AC_CPDResEnergyTransferMode.DERControl.ActivePowerSupport.FrequencyDroop.EU_FrequencyDroop.OverFrequencyDroop.PowerReference = _CCS::DataTypes::PowerReferenceType::PresentActivePower;

    /* HysteresisControl */
    $EVSE.ISO20.AC_DER_ChargeParameterDiscovery_Response.CPDResEnergyTransferMode.DER_AC_CPDResEnergyTransferMode.DERControl.ActivePowerSupport.FrequencyDroop.EU_FrequencyDroop.OverFrequencyDroop.HysteresisControl.Fstop.Exponent = 2;
    $EVSE.ISO20.AC_DER_ChargeParameterDiscovery_Response.CPDResEnergyTransferMode.DER_AC_CPDResEnergyTransferMode.DERControl.ActivePowerSupport.FrequencyDroop.EU_FrequencyDroop.OverFrequencyDroop.HysteresisControl.Fstop.Value = 2;
    $EVSE.ISO20.AC_DER_ChargeParameterDiscovery_Response.CPDResEnergyTransferMode.DER_AC_CPDResEnergyTransferMode.DERControl.ActivePowerSupport.FrequencyDroop.EU_FrequencyDroop.OverFrequencyDroop.HysteresisControl.PowerUpRamp = 5;
    $EVSE.ISO20.AC_DER_ChargeParameterDiscovery_Response.CPDResEnergyTransferMode.DER_AC_CPDResEnergyTransferMode.DERControl.ActivePowerSupport.FrequencyDroop.EU_FrequencyDroop.OverFrequencyDroop.HysteresisControl.IntentionalDelayFstop.Exponent = 2;
    $EVSE.ISO20.AC_DER_ChargeParameterDiscovery_Response.CPDResEnergyTransferMode.DER_AC_CPDResEnergyTransferMode.DERControl.ActivePowerSupport.FrequencyDroop.EU_FrequencyDroop.OverFrequencyDroop.HysteresisControl.IntentionalDelayFstop.Value = 2;
    
    $EVSE.ISO20.AC_DER_ChargeParameterDiscovery_Response.CPDResEnergyTransferMode.DER_AC_CPDResEnergyTransferMode.DERControl.ActivePowerSupport.FrequencyDroop.EU_FrequencyDroop.OverFrequencyDroop.MaxReactionTime.Exponent = 2;
    $EVSE.ISO20.AC_DER_ChargeParameterDiscovery_Response.CPDResEnergyTransferMode.DER_AC_CPDResEnergyTransferMode.DERControl.ActivePowerSupport.FrequencyDroop.EU_FrequencyDroop.OverFrequencyDroop.MaxReactionTime.Value = 2;
    
    $EVSE.ISO20.AC_DER_ChargeParameterDiscovery_Response.CPDResEnergyTransferMode.DER_AC_CPDResEnergyTransferMode.DERControl.ActivePowerSupport.FrequencyDroop.EU_FrequencyDroop.UnderFrequencyDroop.Fstart.Exponent = 2;
    $EVSE.ISO20.AC_DER_ChargeParameterDiscovery_Response.CPDResEnergyTransferMode.DER_AC_CPDResEnergyTransferMode.DERControl.ActivePowerSupport.FrequencyDroop.EU_FrequencyDroop.UnderFrequencyDroop.Fstart.Value = 2;
    $EVSE.ISO20.AC_DER_ChargeParameterDiscovery_Response.CPDResEnergyTransferMode.DER_AC_CPDResEnergyTransferMode.DERControl.ActivePowerSupport.FrequencyDroop.EU_FrequencyDroop.UnderFrequencyDroop.s.Exponent = 2;
    $EVSE.ISO20.AC_DER_ChargeParameterDiscovery_Response.CPDResEnergyTransferMode.DER_AC_CPDResEnergyTransferMode.DERControl.ActivePowerSupport.FrequencyDroop.EU_FrequencyDroop.UnderFrequencyDroop.s.Value = 2;
    $EVSE.ISO20.AC_DER_ChargeParameterDiscovery_Response.CPDResEnergyTransferMode.DER_AC_CPDResEnergyTransferMode.DERControl.ActivePowerSupport.FrequencyDroop.EU_FrequencyDroop.UnderFrequencyDroop.DeactivationTime.Exponent = 2;
    $EVSE.ISO20.AC_DER_ChargeParameterDiscovery_Response.CPDResEnergyTransferMode.DER_AC_CPDResEnergyTransferMode.DERControl.ActivePowerSupport.FrequencyDroop.EU_FrequencyDroop.UnderFrequencyDroop.DeactivationTime.Value = 2;
    $EVSE.ISO20.AC_DER_ChargeParameterDiscovery_Response.CPDResEnergyTransferMode.DER_AC_CPDResEnergyTransferMode.DERControl.ActivePowerSupport.FrequencyDroop.EU_FrequencyDroop.UnderFrequencyDroop.IntentionalDelayPowerControl.Exponent = 2;
    $EVSE.ISO20.AC_DER_ChargeParameterDiscovery_Response.CPDResEnergyTransferMode.DER_AC_CPDResEnergyTransferMode.DERControl.ActivePowerSupport.FrequencyDroop.EU_FrequencyDroop.UnderFrequencyDroop.IntentionalDelayPowerControl.Value = 2;
    $EVSE.ISO20.AC_DER_ChargeParameterDiscovery_Response.CPDResEnergyTransferMode.DER_AC_CPDResEnergyTransferMode.DERControl.ActivePowerSupport.FrequencyDroop.EU_FrequencyDroop.UnderFrequencyDroop.PowerReference = _CCS::DataTypes::PowerReferenceType::PresentActivePower;

    /* HysteresisControl */
    $EVSE.ISO20.AC_DER_ChargeParameterDiscovery_Response.CPDResEnergyTransferMode.DER_AC_CPDResEnergyTransferMode.DERControl.ActivePowerSupport.FrequencyDroop.EU_FrequencyDroop.UnderFrequencyDroop.HysteresisControl.Fstop.Exponent = 2;
    $EVSE.ISO20.AC_DER_ChargeParameterDiscovery_Response.CPDResEnergyTransferMode.DER_AC_CPDResEnergyTransferMode.DERControl.ActivePowerSupport.FrequencyDroop.EU_FrequencyDroop.UnderFrequencyDroop.HysteresisControl.Fstop.Value = 2;
    $EVSE.ISO20.AC_DER_ChargeParameterDiscovery_Response.CPDResEnergyTransferMode.DER_AC_CPDResEnergyTransferMode.DERControl.ActivePowerSupport.FrequencyDroop.EU_FrequencyDroop.UnderFrequencyDroop.HysteresisControl.PowerUpRamp = 5;
    $EVSE.ISO20.AC_DER_ChargeParameterDiscovery_Response.CPDResEnergyTransferMode.DER_AC_CPDResEnergyTransferMode.DERControl.ActivePowerSupport.FrequencyDroop.EU_FrequencyDroop.UnderFrequencyDroop.HysteresisControl.IntentionalDelayFstop.Exponent = 2;
    $EVSE.ISO20.AC_DER_ChargeParameterDiscovery_Response.CPDResEnergyTransferMode.DER_AC_CPDResEnergyTransferMode.DERControl.ActivePowerSupport.FrequencyDroop.EU_FrequencyDroop.UnderFrequencyDroop.HysteresisControl.IntentionalDelayFstop.Value = 2;
    
    $EVSE.ISO20.AC_DER_ChargeParameterDiscovery_Response.CPDResEnergyTransferMode.DER_AC_CPDResEnergyTransferMode.DERControl.ActivePowerSupport.FrequencyDroop.EU_FrequencyDroop.UnderFrequencyDroop.MaxReactionTime.Exponent = 2;
    $EVSE.ISO20.AC_DER_ChargeParameterDiscovery_Response.CPDResEnergyTransferMode.DER_AC_CPDResEnergyTransferMode.DERControl.ActivePowerSupport.FrequencyDroop.EU_FrequencyDroop.UnderFrequencyDroop.MaxReactionTime.Value = 2;
  }
  else
  {
    $EVSE.ISO20.AC_DER_ChargeParameterDiscovery_Response.CPDResEnergyTransferMode.DER_AC_CPDResEnergyTransferMode.DERControl.ActivePowerSupport.FrequencyDroopElementId = 1;
    $EVSE.ISO20.AC_DER_ChargeParameterDiscovery_Response.CPDResEnergyTransferMode.DER_AC_CPDResEnergyTransferMode.DERControl.ActivePowerSupport.FrequencyDroop.US_FrequencyDroop.Priority = 2;
    $EVSE.ISO20.AC_DER_ChargeParameterDiscovery_Response.CPDResEnergyTransferMode.DER_AC_CPDResEnergyTransferMode.DERControl.ActivePowerSupport.FrequencyDroop.US_FrequencyDroop.Enable = 1;
  
    $EVSE.ISO20.AC_DER_ChargeParameterDiscovery_Response.CPDResEnergyTransferMode.DER_AC_CPDResEnergyTransferMode.DERControl.ActivePowerSupport.FrequencyDroop.US_FrequencyDroop.OverFrequencyDroop.db.Exponent = 2;
    $EVSE.ISO20.AC_DER_ChargeParameterDiscovery_Response.CPDResEnergyTransferMode.DER_AC_CPDResEnergyTransferMode.DERControl.ActivePowerSupport.FrequencyDroop.US_FrequencyDroop.OverFrequencyDroop.db.Value = 2;
    $EVSE.ISO20.AC_DER_ChargeParameterDiscovery_Response.CPDResEnergyTransferMode.DER_AC_CPDResEnergyTransferMode.DERControl.ActivePowerSupport.FrequencyDroop.US_FrequencyDroop.OverFrequencyDroop.k.Exponent = 2;
    $EVSE.ISO20.AC_DER_ChargeParameterDiscovery_Response.CPDResEnergyTransferMode.DER_AC_CPDResEnergyTransferMode.DERControl.ActivePowerSupport.FrequencyDroop.US_FrequencyDroop.OverFrequencyDroop.k.Value = 2;
    $EVSE.ISO20.AC_DER_ChargeParameterDiscovery_Response.CPDResEnergyTransferMode.DER_AC_CPDResEnergyTransferMode.DERControl.ActivePowerSupport.FrequencyDroop.US_FrequencyDroop.OverFrequencyDroop.PowerReference = _CCS::DataTypes::PowerReferenceType::PresentActivePower;
    $EVSE.ISO20.AC_DER_ChargeParameterDiscovery_Response.CPDResEnergyTransferMode.DER_AC_CPDResEnergyTransferMode.DERControl.ActivePowerSupport.FrequencyDroop.US_FrequencyDroop.OverFrequencyDroop.OpenLoopResponseTime.Exponent = 2;
    $EVSE.ISO20.AC_DER_ChargeParameterDiscovery_Response.CPDResEnergyTransferMode.DER_AC_CPDResEnergyTransferMode.DERControl.ActivePowerSupport.FrequencyDroop.US_FrequencyDroop.OverFrequencyDroop.OpenLoopResponseTime.Value = 2;

    $EVSE.ISO20.AC_DER_ChargeParameterDiscovery_Response.CPDResEnergyTransferMode.DER_AC_CPDResEnergyTransferMode.DERControl.ActivePowerSupport.FrequencyDroop.US_FrequencyDroop.UnderFrequencyDroop.db.Exponent = 2;
    $EVSE.ISO20.AC_DER_ChargeParameterDiscovery_Response.CPDResEnergyTransferMode.DER_AC_CPDResEnergyTransferMode.DERControl.ActivePowerSupport.FrequencyDroop.US_FrequencyDroop.UnderFrequencyDroop.db.Value = 2;
    $EVSE.ISO20.AC_DER_ChargeParameterDiscovery_Response.CPDResEnergyTransferMode.DER_AC_CPDResEnergyTransferMode.DERControl.ActivePowerSupport.FrequencyDroop.US_FrequencyDroop.UnderFrequencyDroop.k.Exponent = 2;
    $EVSE.ISO20.AC_DER_ChargeParameterDiscovery_Response.CPDResEnergyTransferMode.DER_AC_CPDResEnergyTransferMode.DERControl.ActivePowerSupport.FrequencyDroop.US_FrequencyDroop.UnderFrequencyDroop.k.Value = 2;
    $EVSE.ISO20.AC_DER_ChargeParameterDiscovery_Response.CPDResEnergyTransferMode.DER_AC_CPDResEnergyTransferMode.DERControl.ActivePowerSupport.FrequencyDroop.US_FrequencyDroop.UnderFrequencyDroop.PowerReference = _CCS::DataTypes::PowerReferenceType::PresentActivePower;
    $EVSE.ISO20.AC_DER_ChargeParameterDiscovery_Response.CPDResEnergyTransferMode.DER_AC_CPDResEnergyTransferMode.DERControl.ActivePowerSupport.FrequencyDroop.US_FrequencyDroop.UnderFrequencyDroop.OpenLoopResponseTime.Exponent = 2;
    $EVSE.ISO20.AC_DER_ChargeParameterDiscovery_Response.CPDResEnergyTransferMode.DER_AC_CPDResEnergyTransferMode.DERControl.ActivePowerSupport.FrequencyDroop.US_FrequencyDroop.UnderFrequencyDroop.OpenLoopResponseTime.Value = 2;
  }

    /* FrequencyWatt */
    $EVSE.ISO20.AC_DER_ChargeParameterDiscovery_Response.CPDResEnergyTransferMode.DER_AC_CPDResEnergyTransferMode.DERControl.ActivePowerSupport.FrequencyWatt.Enable = 1;
    $EVSE.ISO20.AC_DER_ChargeParameterDiscovery_Response.CPDResEnergyTransferMode.DER_AC_CPDResEnergyTransferMode.DERControl.ActivePowerSupport.FrequencyWatt.Priority = 3;
    $EVSE.ISO20.AC_DER_ChargeParameterDiscovery_Response.CPDResEnergyTransferMode.DER_AC_CPDResEnergyTransferMode.DERControl.ActivePowerSupport.FrequencyWatt.xUnit = _CCS::DataTypes::CurveDataPointsUnitType::W;
    $EVSE.ISO20.AC_DER_ChargeParameterDiscovery_Response.CPDResEnergyTransferMode.DER_AC_CPDResEnergyTransferMode.DERControl.ActivePowerSupport.FrequencyWatt.yUnit = _CCS::DataTypes::CurveDataPointsUnitType::W;

    $EVSE.ISO20.AC_DER_ChargeParameterDiscovery_Response.CPDResEnergyTransferMode.DER_AC_CPDResEnergyTransferMode.DERControl.ActivePowerSupport.FrequencyWatt.CurveDataPoints.CurveDataPoint.Length = 3;
    $EVSE.ISO20.AC_DER_ChargeParameterDiscovery_Response.CPDResEnergyTransferMode.DER_AC_CPDResEnergyTransferMode.DERControl.ActivePowerSupport.FrequencyWatt.CurveDataPoints.CurveDataPoint[0].x.Exponent = 1;
    $EVSE.ISO20.AC_DER_ChargeParameterDiscovery_Response.CPDResEnergyTransferMode.DER_AC_CPDResEnergyTransferMode.DERControl.ActivePowerSupport.FrequencyWatt.CurveDataPoints.CurveDataPoint[0].x.Value = 2;
    $EVSE.ISO20.AC_DER_ChargeParameterDiscovery_Response.CPDResEnergyTransferMode.DER_AC_CPDResEnergyTransferMode.DERControl.ActivePowerSupport.FrequencyWatt.CurveDataPoints.CurveDataPoint[0].y.Exponent = 1;
    $EVSE.ISO20.AC_DER_ChargeParameterDiscovery_Response.CPDResEnergyTransferMode.DER_AC_CPDResEnergyTransferMode.DERControl.ActivePowerSupport.FrequencyWatt.CurveDataPoints.CurveDataPoint[0].y.Value = 2;
    $EVSE.ISO20.AC_DER_ChargeParameterDiscovery_Response.CPDResEnergyTransferMode.DER_AC_CPDResEnergyTransferMode.DERControl.ActivePowerSupport.FrequencyWatt.CurveDataPoints.CurveDataPoint[1].x.Exponent = 1;
    $EVSE.ISO20.AC_DER_ChargeParameterDiscovery_Response.CPDResEnergyTransferMode.DER_AC_CPDResEnergyTransferMode.DERControl.ActivePowerSupport.FrequencyWatt.CurveDataPoints.CurveDataPoint[1].x.Value = 2;
    $EVSE.ISO20.AC_DER_ChargeParameterDiscovery_Response.CPDResEnergyTransferMode.DER_AC_CPDResEnergyTransferMode.DERControl.ActivePowerSupport.FrequencyWatt.CurveDataPoints.CurveDataPoint[1].y.Exponent = 1;
    $EVSE.ISO20.AC_DER_ChargeParameterDiscovery_Response.CPDResEnergyTransferMode.DER_AC_CPDResEnergyTransferMode.DERControl.ActivePowerSupport.FrequencyWatt.CurveDataPoints.CurveDataPoint[1].y.Value = 2;
    $EVSE.ISO20.AC_DER_ChargeParameterDiscovery_Response.CPDResEnergyTransferMode.DER_AC_CPDResEnergyTransferMode.DERControl.ActivePowerSupport.FrequencyWatt.CurveDataPoints.CurveDataPoint[2].x.Exponent = 1;
    $EVSE.ISO20.AC_DER_ChargeParameterDiscovery_Response.CPDResEnergyTransferMode.DER_AC_CPDResEnergyTransferMode.DERControl.ActivePowerSupport.FrequencyWatt.CurveDataPoints.CurveDataPoint[2].x.Value = 2;
    $EVSE.ISO20.AC_DER_ChargeParameterDiscovery_Response.CPDResEnergyTransferMode.DER_AC_CPDResEnergyTransferMode.DERControl.ActivePowerSupport.FrequencyWatt.CurveDataPoints.CurveDataPoint[2].y.Exponent = 1;
    $EVSE.ISO20.AC_DER_ChargeParameterDiscovery_Response.CPDResEnergyTransferMode.DER_AC_CPDResEnergyTransferMode.DERControl.ActivePowerSupport.FrequencyWatt.CurveDataPoints.CurveDataPoint[2].y.Value = 2;
    $EVSE.ISO20.AC_DER_ChargeParameterDiscovery_Response.CPDResEnergyTransferMode.DER_AC_CPDResEnergyTransferMode.DERControl.ActivePowerSupport.FrequencyWatt.OpenLoopResponseTime.Exponent = 2;
    $EVSE.ISO20.AC_DER_ChargeParameterDiscovery_Response.CPDResEnergyTransferMode.DER_AC_CPDResEnergyTransferMode.DERControl.ActivePowerSupport.FrequencyWatt.OpenLoopResponseTime.Value = 2;
    $EVSE.ISO20.AC_DER_ChargeParameterDiscovery_Response.CPDResEnergyTransferMode.DER_AC_CPDResEnergyTransferMode.DERControl.ActivePowerSupport.FrequencyWatt.HysteresisHigh.Exponent = 2;
    $EVSE.ISO20.AC_DER_ChargeParameterDiscovery_Response.CPDResEnergyTransferMode.DER_AC_CPDResEnergyTransferMode.DERControl.ActivePowerSupport.FrequencyWatt.HysteresisHigh.Value = 2;
    $EVSE.ISO20.AC_DER_ChargeParameterDiscovery_Response.CPDResEnergyTransferMode.DER_AC_CPDResEnergyTransferMode.DERControl.ActivePowerSupport.FrequencyWatt.HysteresisLow.Exponent = 2;
    $EVSE.ISO20.AC_DER_ChargeParameterDiscovery_Response.CPDResEnergyTransferMode.DER_AC_CPDResEnergyTransferMode.DERControl.ActivePowerSupport.FrequencyWatt.HysteresisLow.Value = 2;
    $EVSE.ISO20.AC_DER_ChargeParameterDiscovery_Response.CPDResEnergyTransferMode.DER_AC_CPDResEnergyTransferMode.DERControl.ActivePowerSupport.FrequencyWatt.HysteresisDelay.Exponent = 2;
    $EVSE.ISO20.AC_DER_ChargeParameterDiscovery_Response.CPDResEnergyTransferMode.DER_AC_CPDResEnergyTransferMode.DERControl.ActivePowerSupport.FrequencyWatt.HysteresisDelay.Value = 2;
    $EVSE.ISO20.AC_DER_ChargeParameterDiscovery_Response.CPDResEnergyTransferMode.DER_AC_CPDResEnergyTransferMode.DERControl.ActivePowerSupport.FrequencyWatt.HysteresisGradient.Exponent = 2;
    $EVSE.ISO20.AC_DER_ChargeParameterDiscovery_Response.CPDResEnergyTransferMode.DER_AC_CPDResEnergyTransferMode.DERControl.ActivePowerSupport.FrequencyWatt.HysteresisGradient.Value = 2;

    /* VoltWatt */
    $EVSE.ISO20.AC_DER_ChargeParameterDiscovery_Response.CPDResEnergyTransferMode.DER_AC_CPDResEnergyTransferMode.DERControl.ActivePowerSupport.VoltWatt.Enable = 1;
    $EVSE.ISO20.AC_DER_ChargeParameterDiscovery_Response.CPDResEnergyTransferMode.DER_AC_CPDResEnergyTransferMode.DERControl.ActivePowerSupport.VoltWatt.Priority = 2;
    $EVSE.ISO20.AC_DER_ChargeParameterDiscovery_Response.CPDResEnergyTransferMode.DER_AC_CPDResEnergyTransferMode.DERControl.ActivePowerSupport.VoltWatt.xUnit = _CCS::DataTypes::CurveDataPointsUnitType::W;
    $EVSE.ISO20.AC_DER_ChargeParameterDiscovery_Response.CPDResEnergyTransferMode.DER_AC_CPDResEnergyTransferMode.DERControl.ActivePowerSupport.VoltWatt.yUnit = _CCS::DataTypes::CurveDataPointsUnitType::W;
    $EVSE.ISO20.AC_DER_ChargeParameterDiscovery_Response.CPDResEnergyTransferMode.DER_AC_CPDResEnergyTransferMode.DERControl.ActivePowerSupport.VoltWatt.CurveDataPoints.CurveDataPoint.Length = 3;
    $EVSE.ISO20.AC_DER_ChargeParameterDiscovery_Response.CPDResEnergyTransferMode.DER_AC_CPDResEnergyTransferMode.DERControl.ActivePowerSupport.VoltWatt.CurveDataPoints.CurveDataPoint[0].x.Exponent = 1;
    $EVSE.ISO20.AC_DER_ChargeParameterDiscovery_Response.CPDResEnergyTransferMode.DER_AC_CPDResEnergyTransferMode.DERControl.ActivePowerSupport.VoltWatt.CurveDataPoints.CurveDataPoint[0].x.Value = 2;
    $EVSE.ISO20.AC_DER_ChargeParameterDiscovery_Response.CPDResEnergyTransferMode.DER_AC_CPDResEnergyTransferMode.DERControl.ActivePowerSupport.VoltWatt.CurveDataPoints.CurveDataPoint[0].y.Exponent = 1;
    $EVSE.ISO20.AC_DER_ChargeParameterDiscovery_Response.CPDResEnergyTransferMode.DER_AC_CPDResEnergyTransferMode.DERControl.ActivePowerSupport.VoltWatt.CurveDataPoints.CurveDataPoint[0].y.Value = 2;
    $EVSE.ISO20.AC_DER_ChargeParameterDiscovery_Response.CPDResEnergyTransferMode.DER_AC_CPDResEnergyTransferMode.DERControl.ActivePowerSupport.VoltWatt.CurveDataPoints.CurveDataPoint[1].x.Exponent = 1;
    $EVSE.ISO20.AC_DER_ChargeParameterDiscovery_Response.CPDResEnergyTransferMode.DER_AC_CPDResEnergyTransferMode.DERControl.ActivePowerSupport.VoltWatt.CurveDataPoints.CurveDataPoint[1].x.Value = 2;
    $EVSE.ISO20.AC_DER_ChargeParameterDiscovery_Response.CPDResEnergyTransferMode.DER_AC_CPDResEnergyTransferMode.DERControl.ActivePowerSupport.VoltWatt.CurveDataPoints.CurveDataPoint[1].y.Exponent = 1;
    $EVSE.ISO20.AC_DER_ChargeParameterDiscovery_Response.CPDResEnergyTransferMode.DER_AC_CPDResEnergyTransferMode.DERControl.ActivePowerSupport.VoltWatt.CurveDataPoints.CurveDataPoint[1].y.Value = 2;
    $EVSE.ISO20.AC_DER_ChargeParameterDiscovery_Response.CPDResEnergyTransferMode.DER_AC_CPDResEnergyTransferMode.DERControl.ActivePowerSupport.VoltWatt.CurveDataPoints.CurveDataPoint[2].x.Exponent = 1;
    $EVSE.ISO20.AC_DER_ChargeParameterDiscovery_Response.CPDResEnergyTransferMode.DER_AC_CPDResEnergyTransferMode.DERControl.ActivePowerSupport.VoltWatt.CurveDataPoints.CurveDataPoint[2].x.Value = 2;
    $EVSE.ISO20.AC_DER_ChargeParameterDiscovery_Response.CPDResEnergyTransferMode.DER_AC_CPDResEnergyTransferMode.DERControl.ActivePowerSupport.VoltWatt.CurveDataPoints.CurveDataPoint[2].y.Exponent = 1;
    $EVSE.ISO20.AC_DER_ChargeParameterDiscovery_Response.CPDResEnergyTransferMode.DER_AC_CPDResEnergyTransferMode.DERControl.ActivePowerSupport.VoltWatt.CurveDataPoints.CurveDataPoint[2].y.Value = 2;
    $EVSE.ISO20.AC_DER_ChargeParameterDiscovery_Response.CPDResEnergyTransferMode.DER_AC_CPDResEnergyTransferMode.DERControl.ActivePowerSupport.VoltWatt.LockInValue = _CCS::DataTypes::LockValueUnitType::W;
    $EVSE.ISO20.AC_DER_ChargeParameterDiscovery_Response.CPDResEnergyTransferMode.DER_AC_CPDResEnergyTransferMode.DERControl.ActivePowerSupport.VoltWatt.LockOutValue = _CCS::DataTypes::LockValueUnitType::W;
    $EVSE.ISO20.AC_DER_ChargeParameterDiscovery_Response.CPDResEnergyTransferMode.DER_AC_CPDResEnergyTransferMode.DERControl.ActivePowerSupport.VoltWatt.OpenLoopResponseTime.Exponent = 2;
    $EVSE.ISO20.AC_DER_ChargeParameterDiscovery_Response.CPDResEnergyTransferMode.DER_AC_CPDResEnergyTransferMode.DERControl.ActivePowerSupport.VoltWatt.OpenLoopResponseTime.Value = 1;
    $EVSE.ISO20.AC_DER_ChargeParameterDiscovery_Response.CPDResEnergyTransferMode.DER_AC_CPDResEnergyTransferMode.DERControl.ActivePowerSupport.VoltWatt.TimeConstantPT1 = 2;
    $EVSE.ISO20.AC_DER_ChargeParameterDiscovery_Response.CPDResEnergyTransferMode.DER_AC_CPDResEnergyTransferMode.DERControl.ActivePowerSupport.VoltWatt.IntentionalDelay.Exponent = 2;
    $EVSE.ISO20.AC_DER_ChargeParameterDiscovery_Response.CPDResEnergyTransferMode.DER_AC_CPDResEnergyTransferMode.DERControl.ActivePowerSupport.VoltWatt.IntentionalDelay.Value = 1;

    /* LimitMaxDischargePower */
    $EVSE.ISO20.AC_DER_ChargeParameterDiscovery_Response.CPDResEnergyTransferMode.DER_AC_CPDResEnergyTransferMode.DERControl.ActivePowerSupport.LimitMaxDischargePower.Enable = 1;
    $EVSE.ISO20.AC_DER_ChargeParameterDiscovery_Response.CPDResEnergyTransferMode.DER_AC_CPDResEnergyTransferMode.DERControl.ActivePowerSupport.LimitMaxDischargePower.Priority = 2;
    $EVSE.ISO20.AC_DER_ChargeParameterDiscovery_Response.CPDResEnergyTransferMode.DER_AC_CPDResEnergyTransferMode.DERControl.ActivePowerSupport.LimitMaxDischargePower.PercentageValue = 20;

      /* PowerMonitoringMustTripCurve*/
    $EVSE.ISO20.AC_DER_ChargeParameterDiscovery_Response.CPDResEnergyTransferMode.DER_AC_CPDResEnergyTransferMode.DERControl.ActivePowerSupport.LimitMaxDischargePower.PowerMonitoringMustTripCurve.Enable = 1;
    $EVSE.ISO20.AC_DER_ChargeParameterDiscovery_Response.CPDResEnergyTransferMode.DER_AC_CPDResEnergyTransferMode.DERControl.ActivePowerSupport.LimitMaxDischargePower.PowerMonitoringMustTripCurve.Priority = 2;
    $EVSE.ISO20.AC_DER_ChargeParameterDiscovery_Response.CPDResEnergyTransferMode.DER_AC_CPDResEnergyTransferMode.DERControl.ActivePowerSupport.LimitMaxDischargePower.PowerMonitoringMustTripCurve.xUnit = _CCS::DataTypes::CurveDataPointsUnitType::W;
    $EVSE.ISO20.AC_DER_ChargeParameterDiscovery_Response.CPDResEnergyTransferMode.DER_AC_CPDResEnergyTransferMode.DERControl.ActivePowerSupport.LimitMaxDischargePower.PowerMonitoringMustTripCurve.yUnit = _CCS::DataTypes::CurveDataPointsUnitType::W;
    $EVSE.ISO20.AC_DER_ChargeParameterDiscovery_Response.CPDResEnergyTransferMode.DER_AC_CPDResEnergyTransferMode.DERControl.ActivePowerSupport.LimitMaxDischargePower.PowerMonitoringMustTripCurve.CurveDataPoints.CurveDataPoint.Length = 3;
    $EVSE.ISO20.AC_DER_ChargeParameterDiscovery_Response.CPDResEnergyTransferMode.DER_AC_CPDResEnergyTransferMode.DERControl.ActivePowerSupport.LimitMaxDischargePower.PowerMonitoringMustTripCurve.CurveDataPoints.CurveDataPoint[0].x.Exponent = 1;
    $EVSE.ISO20.AC_DER_ChargeParameterDiscovery_Response.CPDResEnergyTransferMode.DER_AC_CPDResEnergyTransferMode.DERControl.ActivePowerSupport.LimitMaxDischargePower.PowerMonitoringMustTripCurve.CurveDataPoints.CurveDataPoint[0].x.Value = 2;
    $EVSE.ISO20.AC_DER_ChargeParameterDiscovery_Response.CPDResEnergyTransferMode.DER_AC_CPDResEnergyTransferMode.DERControl.ActivePowerSupport.LimitMaxDischargePower.PowerMonitoringMustTripCurve.CurveDataPoints.CurveDataPoint[0].y.Exponent = 1;
    $EVSE.ISO20.AC_DER_ChargeParameterDiscovery_Response.CPDResEnergyTransferMode.DER_AC_CPDResEnergyTransferMode.DERControl.ActivePowerSupport.LimitMaxDischargePower.PowerMonitoringMustTripCurve.CurveDataPoints.CurveDataPoint[0].y.Value = 2;
    $EVSE.ISO20.AC_DER_ChargeParameterDiscovery_Response.CPDResEnergyTransferMode.DER_AC_CPDResEnergyTransferMode.DERControl.ActivePowerSupport.LimitMaxDischargePower.PowerMonitoringMustTripCurve.CurveDataPoints.CurveDataPoint[1].x.Exponent = 1;
    $EVSE.ISO20.AC_DER_ChargeParameterDiscovery_Response.CPDResEnergyTransferMode.DER_AC_CPDResEnergyTransferMode.DERControl.ActivePowerSupport.LimitMaxDischargePower.PowerMonitoringMustTripCurve.CurveDataPoints.CurveDataPoint[1].x.Value = 2;
    $EVSE.ISO20.AC_DER_ChargeParameterDiscovery_Response.CPDResEnergyTransferMode.DER_AC_CPDResEnergyTransferMode.DERControl.ActivePowerSupport.LimitMaxDischargePower.PowerMonitoringMustTripCurve.CurveDataPoints.CurveDataPoint[1].y.Exponent = 1;
    $EVSE.ISO20.AC_DER_ChargeParameterDiscovery_Response.CPDResEnergyTransferMode.DER_AC_CPDResEnergyTransferMode.DERControl.ActivePowerSupport.LimitMaxDischargePower.PowerMonitoringMustTripCurve.CurveDataPoints.CurveDataPoint[1].y.Value = 2;
    $EVSE.ISO20.AC_DER_ChargeParameterDiscovery_Response.CPDResEnergyTransferMode.DER_AC_CPDResEnergyTransferMode.DERControl.ActivePowerSupport.LimitMaxDischargePower.PowerMonitoringMustTripCurve.CurveDataPoints.CurveDataPoint[2].x.Exponent = 1;
    $EVSE.ISO20.AC_DER_ChargeParameterDiscovery_Response.CPDResEnergyTransferMode.DER_AC_CPDResEnergyTransferMode.DERControl.ActivePowerSupport.LimitMaxDischargePower.PowerMonitoringMustTripCurve.CurveDataPoints.CurveDataPoint[2].x.Value = 2;
    $EVSE.ISO20.AC_DER_ChargeParameterDiscovery_Response.CPDResEnergyTransferMode.DER_AC_CPDResEnergyTransferMode.DERControl.ActivePowerSupport.LimitMaxDischargePower.PowerMonitoringMustTripCurve.CurveDataPoints.CurveDataPoint[2].y.Exponent = 1;
    $EVSE.ISO20.AC_DER_ChargeParameterDiscovery_Response.CPDResEnergyTransferMode.DER_AC_CPDResEnergyTransferMode.DERControl.ActivePowerSupport.LimitMaxDischargePower.PowerMonitoringMustTripCurve.CurveDataPoints.CurveDataPoint[2].y.Value = 2;
    $EVSE.ISO20.AC_DER_ChargeParameterDiscovery_Response.CPDResEnergyTransferMode.DER_AC_CPDResEnergyTransferMode.DERControl.ActivePowerSupport.LimitMaxDischargePower.PowerMonitoringMustTripCurve.LockInValue = _CCS::DataTypes::LockValueUnitType::W;
    $EVSE.ISO20.AC_DER_ChargeParameterDiscovery_Response.CPDResEnergyTransferMode.DER_AC_CPDResEnergyTransferMode.DERControl.ActivePowerSupport.LimitMaxDischargePower.PowerMonitoringMustTripCurve.LockOutValue = _CCS::DataTypes::LockValueUnitType::W;
    $EVSE.ISO20.AC_DER_ChargeParameterDiscovery_Response.CPDResEnergyTransferMode.DER_AC_CPDResEnergyTransferMode.DERControl.ActivePowerSupport.LimitMaxDischargePower.PowerMonitoringMustTripCurve.OpenLoopResponseTime.Exponent = 2;
    $EVSE.ISO20.AC_DER_ChargeParameterDiscovery_Response.CPDResEnergyTransferMode.DER_AC_CPDResEnergyTransferMode.DERControl.ActivePowerSupport.LimitMaxDischargePower.PowerMonitoringMustTripCurve.OpenLoopResponseTime.Value = 1;
    $EVSE.ISO20.AC_DER_ChargeParameterDiscovery_Response.CPDResEnergyTransferMode.DER_AC_CPDResEnergyTransferMode.DERControl.ActivePowerSupport.LimitMaxDischargePower.PowerMonitoringMustTripCurve.TimeConstantPT1 = 2;
    $EVSE.ISO20.AC_DER_ChargeParameterDiscovery_Response.CPDResEnergyTransferMode.DER_AC_CPDResEnergyTransferMode.DERControl.ActivePowerSupport.LimitMaxDischargePower.PowerMonitoringMustTripCurve.IntentionalDelay.Exponent = 2;
    $EVSE.ISO20.AC_DER_ChargeParameterDiscovery_Response.CPDResEnergyTransferMode.DER_AC_CPDResEnergyTransferMode.DERControl.ActivePowerSupport.LimitMaxDischargePower.PowerMonitoringMustTripCurve.IntentionalDelay.Value = 1;

  $EVSE.ISO20.AC_DER_ChargeParameterDiscovery_Response.CPDResEnergyTransferMode.DER_AC_CPDResEnergyTransferMode.DERControl.MaximumLevel1DCInjection.Exponent = 1;
  $EVSE.ISO20.AC_DER_ChargeParameterDiscovery_Response.CPDResEnergyTransferMode.DER_AC_CPDResEnergyTransferMode.DERControl.MaximumLevel1DCInjection.Value = 2;
  $EVSE.ISO20.AC_DER_ChargeParameterDiscovery_Response.CPDResEnergyTransferMode.DER_AC_CPDResEnergyTransferMode.DERControl.MaximumLevel2DCInjection.Exponent = 1;
  $EVSE.ISO20.AC_DER_ChargeParameterDiscovery_Response.CPDResEnergyTransferMode.DER_AC_CPDResEnergyTransferMode.DERControl.MaximumLevel2DCInjection.Value = 2;
  $EVSE.ISO20.AC_DER_ChargeParameterDiscovery_Response.CPDResEnergyTransferMode.DER_AC_CPDResEnergyTransferMode.DERControl.SCRatPOC.Exponent = 1;
  $EVSE.ISO20.AC_DER_ChargeParameterDiscovery_Response.CPDResEnergyTransferMode.DER_AC_CPDResEnergyTransferMode.DERControl.SCRatPOC.Value = 2;

  /* EVSENominalPower */
  $EVSE.ISO20.AC_DER_ChargeParameterDiscovery_Response.CPDResEnergyTransferMode.DER_AC_CPDResEnergyTransferMode.EVSENominalPower.Exponent = 1;
  $EVSE.ISO20.AC_DER_ChargeParameterDiscovery_Response.CPDResEnergyTransferMode.DER_AC_CPDResEnergyTransferMode.EVSENominalPower.Value = 2;

  /* Phases */

    // AnyPhase
    $EVSE.ISO20.AC_DER_ChargeParameterDiscovery_Response.CPDResEnergyTransferMode.DER_AC_CPDResEnergyTransferMode.EVSEMaximumDischargePowerElementId = 0;
    $EVSE.ISO20.AC_DER_ChargeParameterDiscovery_Response.CPDResEnergyTransferMode.DER_AC_CPDResEnergyTransferMode.EVSEMaximumDischargePower.AnyPhase.Exponent = 1;
    $EVSE.ISO20.AC_DER_ChargeParameterDiscovery_Response.CPDResEnergyTransferMode.DER_AC_CPDResEnergyTransferMode.EVSEMaximumDischargePower.AnyPhase.Value = 2;

    // PhaseSpecific
    $EVSE.ISO20.AC_DER_ChargeParameterDiscovery_Response.CPDResEnergyTransferMode.DER_AC_CPDResEnergyTransferMode.EVSEMaximumChargeReactivePowerElementId = 1;
    $EVSE.ISO20.AC_DER_ChargeParameterDiscovery_Response.CPDResEnergyTransferMode.DER_AC_CPDResEnergyTransferMode.EVSEMaximumChargeReactivePower.PhaseSpecific.PhaseL1.Exponent = 1;
    $EVSE.ISO20.AC_DER_ChargeParameterDiscovery_Response.CPDResEnergyTransferMode.DER_AC_CPDResEnergyTransferMode.EVSEMaximumChargeReactivePower.PhaseSpecific.PhaseL1.Value = 2;
    $EVSE.ISO20.AC_DER_ChargeParameterDiscovery_Response.CPDResEnergyTransferMode.DER_AC_CPDResEnergyTransferMode.EVSEMaximumChargeReactivePower.PhaseSpecific.PhaseL2.Exponent = 1;
    $EVSE.ISO20.AC_DER_ChargeParameterDiscovery_Response.CPDResEnergyTransferMode.DER_AC_CPDResEnergyTransferMode.EVSEMaximumChargeReactivePower.PhaseSpecific.PhaseL2.Value = 2;
    $EVSE.ISO20.AC_DER_ChargeParameterDiscovery_Response.CPDResEnergyTransferMode.DER_AC_CPDResEnergyTransferMode.EVSEMaximumChargeReactivePower.PhaseSpecific.PhaseL3.Exponent = 1;
    $EVSE.ISO20.AC_DER_ChargeParameterDiscovery_Response.CPDResEnergyTransferMode.DER_AC_CPDResEnergyTransferMode.EVSEMaximumChargeReactivePower.PhaseSpecific.PhaseL3.Value = 2;

    /* Remaining phase invalid */
    $EVSE.ISO20.AC_DER_ChargeParameterDiscovery_Response.CPDResEnergyTransferMode.DER_AC_CPDResEnergyTransferMode.EVSEMaximumDischargeReactivePowerElementId.SetInvalid();
    $EVSE.ISO20.AC_DER_ChargeParameterDiscovery_Response.CPDResEnergyTransferMode.DER_AC_CPDResEnergyTransferMode.EVSEMaximumDischargeReactivePower.SetInvalid();

  /* GridLimits */
  $EVSE.ISO20.AC_DER_ChargeParameterDiscovery_Response.CPDResEnergyTransferMode.DER_AC_CPDResEnergyTransferMode.GridLimits.GridNominalFrequency.Exponent = 1;
  $EVSE.ISO20.AC_DER_ChargeParameterDiscovery_Response.CPDResEnergyTransferMode.DER_AC_CPDResEnergyTransferMode.GridLimits.GridNominalFrequency.Value = 2;

  $EVSE.ISO20.AC_DER_ChargeParameterDiscovery_Response.CPDResEnergyTransferMode.DER_AC_CPDResEnergyTransferMode.GridLimits.GridNominalVoltage.Exponent = 1;
  $EVSE.ISO20.AC_DER_ChargeParameterDiscovery_Response.CPDResEnergyTransferMode.DER_AC_CPDResEnergyTransferMode.GridLimits.GridNominalVoltage.Value = 2;

  $EVSE.ISO20.AC_DER_ChargeParameterDiscovery_Response.CPDResEnergyTransferMode.DER_AC_CPDResEnergyTransferMode.GridLimits.GridNominalVoltageOffset.Exponent = 1;
  $EVSE.ISO20.AC_DER_ChargeParameterDiscovery_Response.CPDResEnergyTransferMode.DER_AC_CPDResEnergyTransferMode.GridLimits.GridNominalVoltageOffset.Value = 2;

  $EVSE.ISO20.AC_DER_ChargeParameterDiscovery_Response.CPDResEnergyTransferMode.DER_AC_CPDResEnergyTransferMode.GridLimits.GridMinFrequency.Exponent = 1;
  $EVSE.ISO20.AC_DER_ChargeParameterDiscovery_Response.CPDResEnergyTransferMode.DER_AC_CPDResEnergyTransferMode.GridLimits.GridMinFrequency.Value = 2;

  $EVSE.ISO20.AC_DER_ChargeParameterDiscovery_Response.CPDResEnergyTransferMode.DER_AC_CPDResEnergyTransferMode.GridLimits.GridMaxFrequency.Exponent = 1;
  $EVSE.ISO20.AC_DER_ChargeParameterDiscovery_Response.CPDResEnergyTransferMode.DER_AC_CPDResEnergyTransferMode.GridLimits.GridMaxFrequency.Value = 2;

  $EVSE.ISO20.AC_DER_ChargeParameterDiscovery_Response.CPDResEnergyTransferMode.DER_AC_CPDResEnergyTransferMode.GridLimits.GridMaximumVoltage.Exponent = 1;
  $EVSE.ISO20.AC_DER_ChargeParameterDiscovery_Response.CPDResEnergyTransferMode.DER_AC_CPDResEnergyTransferMode.GridLimits.GridMaximumVoltage.Value = 2;

  $EVSE.ISO20.AC_DER_ChargeParameterDiscovery_Response.CPDResEnergyTransferMode.DER_AC_CPDResEnergyTransferMode.GridLimits.GridMinimumVoltage.Exponent = 1;
  $EVSE.ISO20.AC_DER_ChargeParameterDiscovery_Response.CPDResEnergyTransferMode.DER_AC_CPDResEnergyTransferMode.GridLimits.GridMinimumVoltage.Value = 2;
}

void FUNC_Set_PreChargeRes()
{  
  $EVSE.ISO20.DC_PreCharge_Response.EVSEPresentVoltage.Value = HV_measure_DC_U(); 
  $EVSE.ISO20.DC_PreCharge_Response.EVSEPresentVoltage.Exponent = 0;
}

void FUNC_Get_EVSE_ACChargeLoopValues()
{    
  if($EVSE.ISO20.AC_ChargeLoop_Request.DisplayParameters.IsValid)
  {
    if($EVSE.ISO20.AC_ChargeLoop_Request.DisplayParameters.MinimumSOC.IsValid)
    {
      $EVSE.ISO20.AC_ChargeLoop_Response.CLResControlMode.BPT_Dynamic_AC_CLResControlMode.MinimumSOC = $EVSE.ISO20.AC_ChargeLoop_Request.DisplayParameters.MinimumSOC;
      $EVSE.ISO20.AC_ChargeLoop_Response.CLResControlMode.Dynamic_AC_CLResControlMode.MinimumSOC = $EVSE.ISO20.AC_ChargeLoop_Request.DisplayParameters.MinimumSOC;
    }
    else
    {
      $EVSE.ISO20.AC_ChargeLoop_Response.CLResControlMode.BPT_Dynamic_AC_CLResControlMode.MinimumSOC.SetInvalid();
      $EVSE.ISO20.AC_ChargeLoop_Response.CLResControlMode.Dynamic_AC_CLResControlMode.MinimumSOC.SetInvalid();
    }
     
    if($EVSE.ISO20.DC_ChargeLoop_Request.DisplayParameters.TargetSOC.IsValid)
    {
      $EVSE.ISO20.AC_ChargeLoop_Response.CLResControlMode.BPT_Dynamic_AC_CLResControlMode.TargetSOC = $EVSE.ISO20.AC_ChargeLoop_Request.DisplayParameters.TargetSOC;
      $EVSE.ISO20.AC_ChargeLoop_Response.CLResControlMode.Dynamic_AC_CLResControlMode.TargetSOC = $EVSE.ISO20.AC_ChargeLoop_Request.DisplayParameters.TargetSOC;
    }   
    else
    {
      $EVSE.ISO20.AC_ChargeLoop_Response.CLResControlMode.BPT_Dynamic_AC_CLResControlMode.TargetSOC.SetInvalid();
      $EVSE.ISO20.AC_ChargeLoop_Response.CLResControlMode.Dynamic_AC_CLResControlMode.TargetSOC.SetInvalid();
    }
  }
  else
  {
    $EVSE.ISO20.AC_ChargeLoop_Response.CLResControlMode.BPT_Dynamic_AC_CLResControlMode.MinimumSOC.SetInvalid();
    $EVSE.ISO20.AC_ChargeLoop_Response.CLResControlMode.Dynamic_AC_CLResControlMode.MinimumSOC.SetInvalid();
    $EVSE.ISO20.AC_ChargeLoop_Response.CLResControlMode.BPT_Dynamic_AC_CLResControlMode.TargetSOC.SetInvalid();
    $EVSE.ISO20.AC_ChargeLoop_Response.CLResControlMode.Dynamic_AC_CLResControlMode.TargetSOC.SetInvalid();
  }
  
  /* EVSEPresentActivePower */
  $EVSE.ISO20.AC_ChargeLoop_Response.CLResControlMode.Dynamic_AC_CLResControlMode.EVSEPresentActivePower.Value = @sysvar::EVSE_Sim::SysEVSE_PresentPower;
  $EVSE.ISO20.AC_ChargeLoop_Response.CLResControlMode.Dynamic_AC_CLResControlMode.EVSEPresentActivePower.Exponent = 0;
  $EVSE.ISO20.AC_ChargeLoop_Response.CLResControlMode.Dynamic_AC_CLResControlMode.EVSEPresentActivePower_L2.Value = @sysvar::EVSE_Sim::SysEVSE_PresentPower_L2;
  $EVSE.ISO20.AC_ChargeLoop_Response.CLResControlMode.Dynamic_AC_CLResControlMode.EVSEPresentActivePower_L2.Exponent = 0;
  $EVSE.ISO20.AC_ChargeLoop_Response.CLResControlMode.Dynamic_AC_CLResControlMode.EVSEPresentActivePower_L3.Value = @sysvar::EVSE_Sim::SysEVSE_PresentPower_L3;
  $EVSE.ISO20.AC_ChargeLoop_Response.CLResControlMode.Dynamic_AC_CLResControlMode.EVSEPresentActivePower_L3.Exponent = 0;
  
  if (@sysvar::EVSE_Sim::Control::SysEVSE_ChargeDischarge == sysvar::EVSE_Sim::Control::SysEVSE_ChargeDischarge::Charge)
    $EVSE.ISO20.AC_ChargeLoop_Response.CLResControlMode.BPT_Dynamic_AC_CLResControlMode.EVSEPresentActivePower.Value = @sysvar::EVSE_Sim::SysEVSE_PresentPower;
  else
    $EVSE.ISO20.AC_ChargeLoop_Response.CLResControlMode.BPT_Dynamic_AC_CLResControlMode.EVSEPresentActivePower.Value = - abs(@sysvar::EVSE_Sim::SysEVSE_PresentPower);
  $EVSE.ISO20.AC_ChargeLoop_Response.CLResControlMode.BPT_Dynamic_AC_CLResControlMode.EVSEPresentActivePower.Exponent = 0;
  
  if (@sysvar::EVSE_Sim::Control::SysEVSE_ChargeDischarge == sysvar::EVSE_Sim::Control::SysEVSE_ChargeDischarge::Charge)
    $EVSE.ISO20.AC_ChargeLoop_Response.CLResControlMode.BPT_Dynamic_AC_CLResControlMode.EVSEPresentActivePower_L2.Value = @sysvar::EVSE_Sim::SysEVSE_PresentPower_L2;
  else
    $EVSE.ISO20.AC_ChargeLoop_Response.CLResControlMode.BPT_Dynamic_AC_CLResControlMode.EVSEPresentActivePower_L2.Value = - abs(@sysvar::EVSE_Sim::SysEVSE_PresentPower_L2);
  $EVSE.ISO20.AC_ChargeLoop_Response.CLResControlMode.BPT_Dynamic_AC_CLResControlMode.EVSEPresentActivePower_L2.Exponent = 0;
  
  if (@sysvar::EVSE_Sim::Control::SysEVSE_ChargeDischarge == sysvar::EVSE_Sim::Control::SysEVSE_ChargeDischarge::Charge)
    $EVSE.ISO20.AC_ChargeLoop_Response.CLResControlMode.BPT_Dynamic_AC_CLResControlMode.EVSEPresentActivePower_L3.Value = @sysvar::EVSE_Sim::SysEVSE_PresentPower_L3;
  else
    $EVSE.ISO20.AC_ChargeLoop_Response.CLResControlMode.BPT_Dynamic_AC_CLResControlMode.EVSEPresentActivePower_L3.Value = - abs(@sysvar::EVSE_Sim::SysEVSE_PresentPower_L3);
  $EVSE.ISO20.AC_ChargeLoop_Response.CLResControlMode.BPT_Dynamic_AC_CLResControlMode.EVSEPresentActivePower_L3.Exponent = 0;
  
  $EVSE.ISO20.AC_ChargeLoop_Response.CLResControlMode.Scheduled_AC_CLResControlMode.EVSEPresentActivePower.Value = @sysvar::EVSE_Sim::SysEVSE_PresentPower;
  $EVSE.ISO20.AC_ChargeLoop_Response.CLResControlMode.Scheduled_AC_CLResControlMode.EVSEPresentActivePower.Exponent = 0;
  $EVSE.ISO20.AC_ChargeLoop_Response.CLResControlMode.Scheduled_AC_CLResControlMode.EVSEPresentActivePower_L2.Value = @sysvar::EVSE_Sim::SysEVSE_PresentPower_L2;
  $EVSE.ISO20.AC_ChargeLoop_Response.CLResControlMode.Scheduled_AC_CLResControlMode.EVSEPresentActivePower_L2.Exponent = 0;
  $EVSE.ISO20.AC_ChargeLoop_Response.CLResControlMode.Scheduled_AC_CLResControlMode.EVSEPresentActivePower_L3.Value = @sysvar::EVSE_Sim::SysEVSE_PresentPower_L3;
  $EVSE.ISO20.AC_ChargeLoop_Response.CLResControlMode.Scheduled_AC_CLResControlMode.EVSEPresentActivePower_L3.Exponent = 0;
  
  if (@sysvar::EVSE_Sim::Control::SysEVSE_ChargeDischarge == sysvar::EVSE_Sim::Control::SysEVSE_ChargeDischarge::Charge)
    $EVSE.ISO20.AC_ChargeLoop_Response.CLResControlMode.BPT_Scheduled_AC_CLResControlMode.EVSEPresentActivePower.Value = @sysvar::EVSE_Sim::SysEVSE_PresentPower;
  else
    $EVSE.ISO20.AC_ChargeLoop_Response.CLResControlMode.BPT_Scheduled_AC_CLResControlMode.EVSEPresentActivePower.Value = - abs(@sysvar::EVSE_Sim::SysEVSE_PresentPower);
  $EVSE.ISO20.AC_ChargeLoop_Response.CLResControlMode.BPT_Scheduled_AC_CLResControlMode.EVSEPresentActivePower.Exponent = 0;

  if (@sysvar::EVSE_Sim::Control::SysEVSE_ChargeDischarge == sysvar::EVSE_Sim::Control::SysEVSE_ChargeDischarge::Charge)
    $EVSE.ISO20.AC_ChargeLoop_Response.CLResControlMode.BPT_Scheduled_AC_CLResControlMode.EVSEPresentActivePower_L2.Value = @sysvar::EVSE_Sim::SysEVSE_PresentPower_L2;
  else
    $EVSE.ISO20.AC_ChargeLoop_Response.CLResControlMode.BPT_Scheduled_AC_CLResControlMode.EVSEPresentActivePower_L2.Value = - abs(@sysvar::EVSE_Sim::SysEVSE_PresentPower_L2);
  $EVSE.ISO20.AC_ChargeLoop_Response.CLResControlMode.BPT_Scheduled_AC_CLResControlMode.EVSEPresentActivePower_L2.Exponent = 0;
  
  if (@sysvar::EVSE_Sim::Control::SysEVSE_ChargeDischarge == sysvar::EVSE_Sim::Control::SysEVSE_ChargeDischarge::Charge)
    $EVSE.ISO20.AC_ChargeLoop_Response.CLResControlMode.BPT_Scheduled_AC_CLResControlMode.EVSEPresentActivePower_L3.Value = @sysvar::EVSE_Sim::SysEVSE_PresentPower_L3;
  else
    $EVSE.ISO20.AC_ChargeLoop_Response.CLResControlMode.BPT_Scheduled_AC_CLResControlMode.EVSEPresentActivePower_L3.Value = - abs(@sysvar::EVSE_Sim::SysEVSE_PresentPower_L3);
  $EVSE.ISO20.AC_ChargeLoop_Response.CLResControlMode.BPT_Scheduled_AC_CLResControlMode.EVSEPresentActivePower_L3.Exponent = 0;
  
  
  /* EVSETargetActivePower */
  $EVSE.ISO20.AC_ChargeLoop_Response.CLResControlMode.Dynamic_AC_CLResControlMode.EVSETargetActivePower.Value = @sysvar::EVSE_Sim::SysEVSE_PresentPower;
  $EVSE.ISO20.AC_ChargeLoop_Response.CLResControlMode.Dynamic_AC_CLResControlMode.EVSETargetActivePower.Exponent = 0; 
  $EVSE.ISO20.AC_ChargeLoop_Response.CLResControlMode.Dynamic_AC_CLResControlMode.EVSETargetActivePower_L2.Value = @sysvar::EVSE_Sim::SysEVSE_PresentPower_L2;
  $EVSE.ISO20.AC_ChargeLoop_Response.CLResControlMode.Dynamic_AC_CLResControlMode.EVSETargetActivePower_L2.Exponent = 0;
  $EVSE.ISO20.AC_ChargeLoop_Response.CLResControlMode.Dynamic_AC_CLResControlMode.EVSETargetActivePower_L3.Value = @sysvar::EVSE_Sim::SysEVSE_PresentPower_L3;
  $EVSE.ISO20.AC_ChargeLoop_Response.CLResControlMode.Dynamic_AC_CLResControlMode.EVSETargetActivePower_L3.Exponent = 0;
  
  if (@sysvar::EVSE_Sim::Control::SysEVSE_ChargeDischarge == sysvar::EVSE_Sim::Control::SysEVSE_ChargeDischarge::Charge)
    $EVSE.ISO20.AC_ChargeLoop_Response.CLResControlMode.BPT_Dynamic_AC_CLResControlMode.EVSETargetActivePower.Value = @sysvar::EVSE_Sim::SysEVSE_PresentPower;
  else
    $EVSE.ISO20.AC_ChargeLoop_Response.CLResControlMode.BPT_Dynamic_AC_CLResControlMode.EVSETargetActivePower.Value = - abs(@sysvar::EVSE_Sim::SysEVSE_PresentPower);
  $EVSE.ISO20.AC_ChargeLoop_Response.CLResControlMode.BPT_Dynamic_AC_CLResControlMode.EVSETargetActivePower.Exponent = 0;

  if (@sysvar::EVSE_Sim::Control::SysEVSE_ChargeDischarge == sysvar::EVSE_Sim::Control::SysEVSE_ChargeDischarge::Charge)
    $EVSE.ISO20.AC_ChargeLoop_Response.CLResControlMode.BPT_Dynamic_AC_CLResControlMode.EVSETargetActivePower_L2.Value = @sysvar::EVSE_Sim::SysEVSE_PresentPower_L2;
  else
    $EVSE.ISO20.AC_ChargeLoop_Response.CLResControlMode.BPT_Dynamic_AC_CLResControlMode.EVSETargetActivePower_L2.Value = - abs(@sysvar::EVSE_Sim::SysEVSE_PresentPower_L2);
  $EVSE.ISO20.AC_ChargeLoop_Response.CLResControlMode.BPT_Dynamic_AC_CLResControlMode.EVSETargetActivePower_L2.Exponent = 0;

  if (@sysvar::EVSE_Sim::Control::SysEVSE_ChargeDischarge == sysvar::EVSE_Sim::Control::SysEVSE_ChargeDischarge::Charge)
    $EVSE.ISO20.AC_ChargeLoop_Response.CLResControlMode.BPT_Dynamic_AC_CLResControlMode.EVSETargetActivePower_L3.Value = @sysvar::EVSE_Sim::SysEVSE_PresentPower_L3;
  else
    $EVSE.ISO20.AC_ChargeLoop_Response.CLResControlMode.BPT_Dynamic_AC_CLResControlMode.EVSETargetActivePower_L3.Value = - abs(@sysvar::EVSE_Sim::SysEVSE_PresentPower_L3);
  $EVSE.ISO20.AC_ChargeLoop_Response.CLResControlMode.BPT_Dynamic_AC_CLResControlMode.EVSETargetActivePower_L3.Exponent = 0;
  
  $EVSE.ISO20.AC_ChargeLoop_Response.CLResControlMode.Scheduled_AC_CLResControlMode.EVSETargetActivePower.Value = @sysvar::EVSE_Sim::SysEVSE_PresentPower;
  $EVSE.ISO20.AC_ChargeLoop_Response.CLResControlMode.Scheduled_AC_CLResControlMode.EVSETargetActivePower.Exponent = 0; 
  $EVSE.ISO20.AC_ChargeLoop_Response.CLResControlMode.Scheduled_AC_CLResControlMode.EVSETargetActivePower_L2.Value = @sysvar::EVSE_Sim::SysEVSE_PresentPower_L2;
  $EVSE.ISO20.AC_ChargeLoop_Response.CLResControlMode.Scheduled_AC_CLResControlMode.EVSETargetActivePower_L2.Exponent = 0;
  $EVSE.ISO20.AC_ChargeLoop_Response.CLResControlMode.Scheduled_AC_CLResControlMode.EVSETargetActivePower_L3.Value = @sysvar::EVSE_Sim::SysEVSE_PresentPower_L3;
  $EVSE.ISO20.AC_ChargeLoop_Response.CLResControlMode.Scheduled_AC_CLResControlMode.EVSETargetActivePower_L3.Exponent = 0;
  
  if (@sysvar::EVSE_Sim::Control::SysEVSE_ChargeDischarge == sysvar::EVSE_Sim::Control::SysEVSE_ChargeDischarge::Charge)
    $EVSE.ISO20.AC_ChargeLoop_Response.CLResControlMode.BPT_Scheduled_AC_CLResControlMode.EVSETargetActivePower.Value = @sysvar::EVSE_Sim::SysEVSE_PresentPower;
  else
    $EVSE.ISO20.AC_ChargeLoop_Response.CLResControlMode.BPT_Scheduled_AC_CLResControlMode.EVSETargetActivePower.Value = - abs(@sysvar::EVSE_Sim::SysEVSE_PresentPower);
  $EVSE.ISO20.AC_ChargeLoop_Response.CLResControlMode.BPT_Scheduled_AC_CLResControlMode.EVSETargetActivePower.Exponent = 0;

  if (@sysvar::EVSE_Sim::Control::SysEVSE_ChargeDischarge == sysvar::EVSE_Sim::Control::SysEVSE_ChargeDischarge::Charge)
    $EVSE.ISO20.AC_ChargeLoop_Response.CLResControlMode.BPT_Scheduled_AC_CLResControlMode.EVSETargetActivePower_L2.Value = @sysvar::EVSE_Sim::SysEVSE_PresentPower_L2;
  else
    $EVSE.ISO20.AC_ChargeLoop_Response.CLResControlMode.BPT_Scheduled_AC_CLResControlMode.EVSETargetActivePower_L2.Value = - abs(@sysvar::EVSE_Sim::SysEVSE_PresentPower_L2);
  $EVSE.ISO20.AC_ChargeLoop_Response.CLResControlMode.BPT_Scheduled_AC_CLResControlMode.EVSETargetActivePower_L2.Exponent = 0;

  if (@sysvar::EVSE_Sim::Control::SysEVSE_ChargeDischarge == sysvar::EVSE_Sim::Control::SysEVSE_ChargeDischarge::Charge)
    $EVSE.ISO20.AC_ChargeLoop_Response.CLResControlMode.BPT_Scheduled_AC_CLResControlMode.EVSETargetActivePower_L3.Value = @sysvar::EVSE_Sim::SysEVSE_PresentPower_L3;
  else
    $EVSE.ISO20.AC_ChargeLoop_Response.CLResControlMode.BPT_Scheduled_AC_CLResControlMode.EVSETargetActivePower_L3.Value = - abs(@sysvar::EVSE_Sim::SysEVSE_PresentPower_L3);
  $EVSE.ISO20.AC_ChargeLoop_Response.CLResControlMode.BPT_Scheduled_AC_CLResControlMode.EVSETargetActivePower_L3.Exponent = 0;
}

void FUNC_Get_EVSE_ACDERChargeLoopValues()
{
  $EVSE.ISO20.AC_DER_ChargeLoop_Response.Receipt.TimeAnchor = 30;
  $EVSE.ISO20.AC_DER_ChargeLoop_Response.Receipt.EnergyCosts.Amount.Exponent = 3;
  $EVSE.ISO20.AC_DER_ChargeLoop_Response.Receipt.EnergyCosts.Amount.Value = 1;
  $EVSE.ISO20.AC_DER_ChargeLoop_Response.Receipt.EnergyCosts.CostPerUnit.Exponent = 3;
  $EVSE.ISO20.AC_DER_ChargeLoop_Response.Receipt.EnergyCosts.CostPerUnit.Value = 1;
  $EVSE.ISO20.AC_DER_ChargeLoop_Response.Receipt.OccupancyCosts.Amount.Exponent = 3;
  $EVSE.ISO20.AC_DER_ChargeLoop_Response.Receipt.OccupancyCosts.Amount.Value = 1;
  $EVSE.ISO20.AC_DER_ChargeLoop_Response.Receipt.OccupancyCosts.CostPerUnit.Exponent = 3;
  $EVSE.ISO20.AC_DER_ChargeLoop_Response.Receipt.OccupancyCosts.CostPerUnit.Value = 1;
  $EVSE.ISO20.AC_DER_ChargeLoop_Response.Receipt.AdditionalServiceCosts.Amount.Exponent = 3;
  $EVSE.ISO20.AC_DER_ChargeLoop_Response.Receipt.AdditionalServiceCosts.Amount.Value = 1;
  $EVSE.ISO20.AC_DER_ChargeLoop_Response.Receipt.AdditionalServiceCosts.CostPerUnit.Exponent = 3;
  $EVSE.ISO20.AC_DER_ChargeLoop_Response.Receipt.AdditionalServiceCosts.CostPerUnit.Value = 1;
  $EVSE.ISO20.AC_DER_ChargeLoop_Response.Receipt.OverstayCosts.Amount.Exponent = 3;
  $EVSE.ISO20.AC_DER_ChargeLoop_Response.Receipt.OverstayCosts.Amount.Value = 1;
  $EVSE.ISO20.AC_DER_ChargeLoop_Response.Receipt.OverstayCosts.CostPerUnit.Exponent = 3;
  $EVSE.ISO20.AC_DER_ChargeLoop_Response.Receipt.OverstayCosts.CostPerUnit.Value = 1;
  $EVSE.ISO20.AC_DER_ChargeLoop_Response.Receipt.TaxCosts[0].Amount.Exponent = 3;
  $EVSE.ISO20.AC_DER_ChargeLoop_Response.Receipt.TaxCosts[0].Amount.Value = 1;
  $EVSE.ISO20.AC_DER_ChargeLoop_Response.Receipt.TaxCosts[0].TaxRuleID = 1;
  $EVSE.ISO20.AC_DER_ChargeLoop_Response.Receipt.TaxCosts[1].Amount.Exponent = 1;
  $EVSE.ISO20.AC_DER_ChargeLoop_Response.Receipt.TaxCosts[1].Amount.Value = 3;
  $EVSE.ISO20.AC_DER_ChargeLoop_Response.Receipt.TaxCosts[1].TaxRuleID = 2;
  $EVSE.ISO20.AC_DER_ChargeLoop_Response.EVSETargetFrequency.Exponent = 2;
  $EVSE.ISO20.AC_DER_ChargeLoop_Response.EVSETargetFrequency.Value = 3;

    $EVSE.ISO20.AC_DER_ChargeLoop_Response.CLResControlMode.DER_Dynamic_AC_CLResControlMode.DepartureTime = 30;
    $EVSE.ISO20.AC_DER_ChargeLoop_Response.CLResControlMode.DER_Dynamic_AC_CLResControlMode.MinimumSOC = 20;
    $EVSE.ISO20.AC_DER_ChargeLoop_Response.CLResControlMode.DER_Dynamic_AC_CLResControlMode.TargetSOC = 80;
    $EVSE.ISO20.AC_DER_ChargeLoop_Response.CLResControlMode.DER_Dynamic_AC_CLResControlMode.AckMaxDelay = 5;
    $EVSE.ISO20.AC_DER_ChargeLoop_Response.CLResControlMode.DER_Dynamic_AC_CLResControlMode.EVSETargetActivePower.Value = @sysvar::EVSE_Sim::SysEVSE_PresentPower;
    $EVSE.ISO20.AC_DER_ChargeLoop_Response.CLResControlMode.DER_Dynamic_AC_CLResControlMode.EVSETargetActivePower.Exponent = 0; 
    $EVSE.ISO20.AC_DER_ChargeLoop_Response.CLResControlMode.DER_Dynamic_AC_CLResControlMode.EVSETargetActivePower_L2.Value = @sysvar::EVSE_Sim::SysEVSE_PresentPower_L2;
    $EVSE.ISO20.AC_DER_ChargeLoop_Response.CLResControlMode.DER_Dynamic_AC_CLResControlMode.EVSETargetActivePower_L2.Exponent = 0;
    $EVSE.ISO20.AC_DER_ChargeLoop_Response.CLResControlMode.DER_Dynamic_AC_CLResControlMode.EVSETargetActivePower_L3.Value = @sysvar::EVSE_Sim::SysEVSE_PresentPower_L3;
    $EVSE.ISO20.AC_DER_ChargeLoop_Response.CLResControlMode.DER_Dynamic_AC_CLResControlMode.EVSETargetActivePower_L3.Exponent = 0;
    $EVSE.ISO20.AC_DER_ChargeLoop_Response.CLResControlMode.DER_Dynamic_AC_CLResControlMode.EVSETargetReactivePower.Exponent = 0;
    $EVSE.ISO20.AC_DER_ChargeLoop_Response.CLResControlMode.DER_Dynamic_AC_CLResControlMode.EVSETargetReactivePower.Value = @sysvar::EVSE_Sim::SysEVSE_PresentPower;
    $EVSE.ISO20.AC_DER_ChargeLoop_Response.CLResControlMode.DER_Dynamic_AC_CLResControlMode.EVSETargetReactivePower.Exponent = 0; 
    $EVSE.ISO20.AC_DER_ChargeLoop_Response.CLResControlMode.DER_Dynamic_AC_CLResControlMode.EVSETargetReactivePower_L2.Value = @sysvar::EVSE_Sim::SysEVSE_PresentPower_L2;
    $EVSE.ISO20.AC_DER_ChargeLoop_Response.CLResControlMode.DER_Dynamic_AC_CLResControlMode.EVSETargetReactivePower_L2.Exponent = 0;
    $EVSE.ISO20.AC_DER_ChargeLoop_Response.CLResControlMode.DER_Dynamic_AC_CLResControlMode.EVSETargetReactivePower_L3.Value = @sysvar::EVSE_Sim::SysEVSE_PresentPower_L3;
    $EVSE.ISO20.AC_DER_ChargeLoop_Response.CLResControlMode.DER_Dynamic_AC_CLResControlMode.EVSETargetReactivePower_L3.Exponent = 0;
    $EVSE.ISO20.AC_DER_ChargeLoop_Response.CLResControlMode.DER_Dynamic_AC_CLResControlMode.EVSEPresentActivePower.Value = @sysvar::EVSE_Sim::SysEVSE_PresentPower;
    $EVSE.ISO20.AC_DER_ChargeLoop_Response.CLResControlMode.DER_Dynamic_AC_CLResControlMode.EVSEPresentActivePower.Exponent = 0; 
    $EVSE.ISO20.AC_DER_ChargeLoop_Response.CLResControlMode.DER_Dynamic_AC_CLResControlMode.EVSEPresentActivePower_L2.Value = @sysvar::EVSE_Sim::SysEVSE_PresentPower_L2;
    $EVSE.ISO20.AC_DER_ChargeLoop_Response.CLResControlMode.DER_Dynamic_AC_CLResControlMode.EVSEPresentActivePower_L2.Exponent = 0;
    $EVSE.ISO20.AC_DER_ChargeLoop_Response.CLResControlMode.DER_Dynamic_AC_CLResControlMode.EVSEPresentActivePower_L3.Value = @sysvar::EVSE_Sim::SysEVSE_PresentPower_L3;
    $EVSE.ISO20.AC_DER_ChargeLoop_Response.CLResControlMode.DER_Dynamic_AC_CLResControlMode.EVSEPresentActivePower_L3.Exponent = 0;
    /* DERControl */
    /* VoltageTrip */
    $EVSE.ISO20.AC_DER_ChargeLoop_Response.CLResControlMode.DER_Dynamic_AC_CLResControlMode.DERControl.VoltageTrip.OverVoltageMustTripCurve.Enable = 1;
    $EVSE.ISO20.AC_DER_ChargeLoop_Response.CLResControlMode.DER_Dynamic_AC_CLResControlMode.DERControl.VoltageTrip.OverVoltageMustTripCurve.Priority = 2;
    $EVSE.ISO20.AC_DER_ChargeLoop_Response.CLResControlMode.DER_Dynamic_AC_CLResControlMode.DERControl.VoltageTrip.OverVoltageMustTripCurve.xUnit = _CCS::DataTypes::CurveDataPointsUnitType::W;
    $EVSE.ISO20.AC_DER_ChargeLoop_Response.CLResControlMode.DER_Dynamic_AC_CLResControlMode.DERControl.VoltageTrip.OverVoltageMustTripCurve.yUnit = _CCS::DataTypes::CurveDataPointsUnitType::W;
    $EVSE.ISO20.AC_DER_ChargeLoop_Response.CLResControlMode.DER_Dynamic_AC_CLResControlMode.DERControl.VoltageTrip.OverVoltageMustTripCurve.CurveDataPoints.CurveDataPoint.Length = 3;
    $EVSE.ISO20.AC_DER_ChargeLoop_Response.CLResControlMode.DER_Dynamic_AC_CLResControlMode.DERControl.VoltageTrip.OverVoltageMustTripCurve.CurveDataPoints.CurveDataPoint[0].x.Exponent = 1;
    $EVSE.ISO20.AC_DER_ChargeLoop_Response.CLResControlMode.DER_Dynamic_AC_CLResControlMode.DERControl.VoltageTrip.OverVoltageMustTripCurve.CurveDataPoints.CurveDataPoint[0].x.Value = 2;
    $EVSE.ISO20.AC_DER_ChargeLoop_Response.CLResControlMode.DER_Dynamic_AC_CLResControlMode.DERControl.VoltageTrip.OverVoltageMustTripCurve.CurveDataPoints.CurveDataPoint[0].y.Exponent = 1;
    $EVSE.ISO20.AC_DER_ChargeLoop_Response.CLResControlMode.DER_Dynamic_AC_CLResControlMode.DERControl.VoltageTrip.OverVoltageMustTripCurve.CurveDataPoints.CurveDataPoint[0].y.Value = 2;
    $EVSE.ISO20.AC_DER_ChargeLoop_Response.CLResControlMode.DER_Dynamic_AC_CLResControlMode.DERControl.VoltageTrip.OverVoltageMustTripCurve.CurveDataPoints.CurveDataPoint[1].x.Exponent = 1;
    $EVSE.ISO20.AC_DER_ChargeLoop_Response.CLResControlMode.DER_Dynamic_AC_CLResControlMode.DERControl.VoltageTrip.OverVoltageMustTripCurve.CurveDataPoints.CurveDataPoint[1].x.Value = 2;
    $EVSE.ISO20.AC_DER_ChargeLoop_Response.CLResControlMode.DER_Dynamic_AC_CLResControlMode.DERControl.VoltageTrip.OverVoltageMustTripCurve.CurveDataPoints.CurveDataPoint[1].y.Exponent = 1;
    $EVSE.ISO20.AC_DER_ChargeLoop_Response.CLResControlMode.DER_Dynamic_AC_CLResControlMode.DERControl.VoltageTrip.OverVoltageMustTripCurve.CurveDataPoints.CurveDataPoint[1].y.Value = 2;
    $EVSE.ISO20.AC_DER_ChargeLoop_Response.CLResControlMode.DER_Dynamic_AC_CLResControlMode.DERControl.VoltageTrip.OverVoltageMustTripCurve.CurveDataPoints.CurveDataPoint[2].x.Exponent = 1;
    $EVSE.ISO20.AC_DER_ChargeLoop_Response.CLResControlMode.DER_Dynamic_AC_CLResControlMode.DERControl.VoltageTrip.OverVoltageMustTripCurve.CurveDataPoints.CurveDataPoint[2].x.Value = 2;
    $EVSE.ISO20.AC_DER_ChargeLoop_Response.CLResControlMode.DER_Dynamic_AC_CLResControlMode.DERControl.VoltageTrip.OverVoltageMustTripCurve.CurveDataPoints.CurveDataPoint[2].y.Exponent = 1;
    $EVSE.ISO20.AC_DER_ChargeLoop_Response.CLResControlMode.DER_Dynamic_AC_CLResControlMode.DERControl.VoltageTrip.OverVoltageMustTripCurve.CurveDataPoints.CurveDataPoint[2].y.Value = 2;
    $EVSE.ISO20.AC_DER_ChargeLoop_Response.CLResControlMode.DER_Dynamic_AC_CLResControlMode.DERControl.VoltageTrip.OverVoltageMustTripCurve.LockInValue = _CCS::DataTypes::LockValueUnitType::W;
    $EVSE.ISO20.AC_DER_ChargeLoop_Response.CLResControlMode.DER_Dynamic_AC_CLResControlMode.DERControl.VoltageTrip.OverVoltageMustTripCurve.LockOutValue = _CCS::DataTypes::LockValueUnitType::W;
    $EVSE.ISO20.AC_DER_ChargeLoop_Response.CLResControlMode.DER_Dynamic_AC_CLResControlMode.DERControl.VoltageTrip.OverVoltageMustTripCurve.OpenLoopResponseTime.Exponent = 2;
    $EVSE.ISO20.AC_DER_ChargeLoop_Response.CLResControlMode.DER_Dynamic_AC_CLResControlMode.DERControl.VoltageTrip.OverVoltageMustTripCurve.OpenLoopResponseTime.Value = 1;
    $EVSE.ISO20.AC_DER_ChargeLoop_Response.CLResControlMode.DER_Dynamic_AC_CLResControlMode.DERControl.VoltageTrip.OverVoltageMustTripCurve.TimeConstantPT1 = 2;
    $EVSE.ISO20.AC_DER_ChargeLoop_Response.CLResControlMode.DER_Dynamic_AC_CLResControlMode.DERControl.VoltageTrip.OverVoltageMustTripCurve.IntentionalDelay.Exponent = 2;
    $EVSE.ISO20.AC_DER_ChargeLoop_Response.CLResControlMode.DER_Dynamic_AC_CLResControlMode.DERControl.VoltageTrip.OverVoltageMustTripCurve.IntentionalDelay.Value = 1;
  
    $EVSE.ISO20.AC_DER_ChargeLoop_Response.CLResControlMode.DER_Dynamic_AC_CLResControlMode.DERControl.VoltageTrip.UnderVoltageMustTripCurve.Enable = 1;
    $EVSE.ISO20.AC_DER_ChargeLoop_Response.CLResControlMode.DER_Dynamic_AC_CLResControlMode.DERControl.VoltageTrip.UnderVoltageMustTripCurve.Priority = 2;
    $EVSE.ISO20.AC_DER_ChargeLoop_Response.CLResControlMode.DER_Dynamic_AC_CLResControlMode.DERControl.VoltageTrip.UnderVoltageMustTripCurve.xUnit = _CCS::DataTypes::CurveDataPointsUnitType::W;
    $EVSE.ISO20.AC_DER_ChargeLoop_Response.CLResControlMode.DER_Dynamic_AC_CLResControlMode.DERControl.VoltageTrip.UnderVoltageMustTripCurve.yUnit = _CCS::DataTypes::CurveDataPointsUnitType::W;
    $EVSE.ISO20.AC_DER_ChargeLoop_Response.CLResControlMode.DER_Dynamic_AC_CLResControlMode.DERControl.VoltageTrip.UnderVoltageMustTripCurve.CurveDataPoints.CurveDataPoint.Length = 3;
    $EVSE.ISO20.AC_DER_ChargeLoop_Response.CLResControlMode.DER_Dynamic_AC_CLResControlMode.DERControl.VoltageTrip.UnderVoltageMustTripCurve.CurveDataPoints.CurveDataPoint[0].x.Exponent = 1;
    $EVSE.ISO20.AC_DER_ChargeLoop_Response.CLResControlMode.DER_Dynamic_AC_CLResControlMode.DERControl.VoltageTrip.UnderVoltageMustTripCurve.CurveDataPoints.CurveDataPoint[0].x.Value = 2;
    $EVSE.ISO20.AC_DER_ChargeLoop_Response.CLResControlMode.DER_Dynamic_AC_CLResControlMode.DERControl.VoltageTrip.UnderVoltageMustTripCurve.CurveDataPoints.CurveDataPoint[0].y.Exponent = 1;
    $EVSE.ISO20.AC_DER_ChargeLoop_Response.CLResControlMode.DER_Dynamic_AC_CLResControlMode.DERControl.VoltageTrip.UnderVoltageMustTripCurve.CurveDataPoints.CurveDataPoint[0].y.Value = 2;
    $EVSE.ISO20.AC_DER_ChargeLoop_Response.CLResControlMode.DER_Dynamic_AC_CLResControlMode.DERControl.VoltageTrip.UnderVoltageMustTripCurve.CurveDataPoints.CurveDataPoint[1].x.Exponent = 1;
    $EVSE.ISO20.AC_DER_ChargeLoop_Response.CLResControlMode.DER_Dynamic_AC_CLResControlMode.DERControl.VoltageTrip.UnderVoltageMustTripCurve.CurveDataPoints.CurveDataPoint[1].x.Value = 2;
    $EVSE.ISO20.AC_DER_ChargeLoop_Response.CLResControlMode.DER_Dynamic_AC_CLResControlMode.DERControl.VoltageTrip.UnderVoltageMustTripCurve.CurveDataPoints.CurveDataPoint[1].y.Exponent = 1;
    $EVSE.ISO20.AC_DER_ChargeLoop_Response.CLResControlMode.DER_Dynamic_AC_CLResControlMode.DERControl.VoltageTrip.UnderVoltageMustTripCurve.CurveDataPoints.CurveDataPoint[1].y.Value = 2;
    $EVSE.ISO20.AC_DER_ChargeLoop_Response.CLResControlMode.DER_Dynamic_AC_CLResControlMode.DERControl.VoltageTrip.UnderVoltageMustTripCurve.CurveDataPoints.CurveDataPoint[2].x.Exponent = 1;
    $EVSE.ISO20.AC_DER_ChargeLoop_Response.CLResControlMode.DER_Dynamic_AC_CLResControlMode.DERControl.VoltageTrip.UnderVoltageMustTripCurve.CurveDataPoints.CurveDataPoint[2].x.Value = 2;
    $EVSE.ISO20.AC_DER_ChargeLoop_Response.CLResControlMode.DER_Dynamic_AC_CLResControlMode.DERControl.VoltageTrip.UnderVoltageMustTripCurve.CurveDataPoints.CurveDataPoint[2].y.Exponent = 1;
    $EVSE.ISO20.AC_DER_ChargeLoop_Response.CLResControlMode.DER_Dynamic_AC_CLResControlMode.DERControl.VoltageTrip.UnderVoltageMustTripCurve.CurveDataPoints.CurveDataPoint[2].y.Value = 2;
    $EVSE.ISO20.AC_DER_ChargeLoop_Response.CLResControlMode.DER_Dynamic_AC_CLResControlMode.DERControl.VoltageTrip.UnderVoltageMustTripCurve.LockInValue = _CCS::DataTypes::LockValueUnitType::W;
    $EVSE.ISO20.AC_DER_ChargeLoop_Response.CLResControlMode.DER_Dynamic_AC_CLResControlMode.DERControl.VoltageTrip.UnderVoltageMustTripCurve.LockOutValue = _CCS::DataTypes::LockValueUnitType::W;
    $EVSE.ISO20.AC_DER_ChargeLoop_Response.CLResControlMode.DER_Dynamic_AC_CLResControlMode.DERControl.VoltageTrip.UnderVoltageMustTripCurve.OpenLoopResponseTime.Exponent = 2;
    $EVSE.ISO20.AC_DER_ChargeLoop_Response.CLResControlMode.DER_Dynamic_AC_CLResControlMode.DERControl.VoltageTrip.UnderVoltageMustTripCurve.OpenLoopResponseTime.Value = 1;
    $EVSE.ISO20.AC_DER_ChargeLoop_Response.CLResControlMode.DER_Dynamic_AC_CLResControlMode.DERControl.VoltageTrip.UnderVoltageMustTripCurve.TimeConstantPT1 = 2;
    $EVSE.ISO20.AC_DER_ChargeLoop_Response.CLResControlMode.DER_Dynamic_AC_CLResControlMode.DERControl.VoltageTrip.UnderVoltageMustTripCurve.IntentionalDelay.Exponent = 2;
    $EVSE.ISO20.AC_DER_ChargeLoop_Response.CLResControlMode.DER_Dynamic_AC_CLResControlMode.DERControl.VoltageTrip.UnderVoltageMustTripCurve.IntentionalDelay.Value = 1;

    $EVSE.ISO20.AC_DER_ChargeLoop_Response.CLResControlMode.DER_Dynamic_AC_CLResControlMode.DERControl.VoltageTrip.OverVoltageMomentaryCessationTripCurve.Enable = 1;
    $EVSE.ISO20.AC_DER_ChargeLoop_Response.CLResControlMode.DER_Dynamic_AC_CLResControlMode.DERControl.VoltageTrip.OverVoltageMomentaryCessationTripCurve.Priority = 2;
    $EVSE.ISO20.AC_DER_ChargeLoop_Response.CLResControlMode.DER_Dynamic_AC_CLResControlMode.DERControl.VoltageTrip.OverVoltageMomentaryCessationTripCurve.xUnit = _CCS::DataTypes::CurveDataPointsUnitType::W;
    $EVSE.ISO20.AC_DER_ChargeLoop_Response.CLResControlMode.DER_Dynamic_AC_CLResControlMode.DERControl.VoltageTrip.OverVoltageMomentaryCessationTripCurve.yUnit = _CCS::DataTypes::CurveDataPointsUnitType::W;
    $EVSE.ISO20.AC_DER_ChargeLoop_Response.CLResControlMode.DER_Dynamic_AC_CLResControlMode.DERControl.VoltageTrip.OverVoltageMomentaryCessationTripCurve.CurveDataPoints.CurveDataPoint.Length = 3;
    $EVSE.ISO20.AC_DER_ChargeLoop_Response.CLResControlMode.DER_Dynamic_AC_CLResControlMode.DERControl.VoltageTrip.OverVoltageMomentaryCessationTripCurve.CurveDataPoints.CurveDataPoint[0].x.Exponent = 1;
    $EVSE.ISO20.AC_DER_ChargeLoop_Response.CLResControlMode.DER_Dynamic_AC_CLResControlMode.DERControl.VoltageTrip.OverVoltageMomentaryCessationTripCurve.CurveDataPoints.CurveDataPoint[0].x.Value = 2;
    $EVSE.ISO20.AC_DER_ChargeLoop_Response.CLResControlMode.DER_Dynamic_AC_CLResControlMode.DERControl.VoltageTrip.OverVoltageMomentaryCessationTripCurve.CurveDataPoints.CurveDataPoint[0].y.Exponent = 1;
    $EVSE.ISO20.AC_DER_ChargeLoop_Response.CLResControlMode.DER_Dynamic_AC_CLResControlMode.DERControl.VoltageTrip.OverVoltageMomentaryCessationTripCurve.CurveDataPoints.CurveDataPoint[0].y.Value = 2;
    $EVSE.ISO20.AC_DER_ChargeLoop_Response.CLResControlMode.DER_Dynamic_AC_CLResControlMode.DERControl.VoltageTrip.OverVoltageMomentaryCessationTripCurve.CurveDataPoints.CurveDataPoint[1].x.Exponent = 1;
    $EVSE.ISO20.AC_DER_ChargeLoop_Response.CLResControlMode.DER_Dynamic_AC_CLResControlMode.DERControl.VoltageTrip.OverVoltageMomentaryCessationTripCurve.CurveDataPoints.CurveDataPoint[1].x.Value = 2;
    $EVSE.ISO20.AC_DER_ChargeLoop_Response.CLResControlMode.DER_Dynamic_AC_CLResControlMode.DERControl.VoltageTrip.OverVoltageMomentaryCessationTripCurve.CurveDataPoints.CurveDataPoint[1].y.Exponent = 1;
    $EVSE.ISO20.AC_DER_ChargeLoop_Response.CLResControlMode.DER_Dynamic_AC_CLResControlMode.DERControl.VoltageTrip.OverVoltageMomentaryCessationTripCurve.CurveDataPoints.CurveDataPoint[1].y.Value = 2;
    $EVSE.ISO20.AC_DER_ChargeLoop_Response.CLResControlMode.DER_Dynamic_AC_CLResControlMode.DERControl.VoltageTrip.OverVoltageMomentaryCessationTripCurve.CurveDataPoints.CurveDataPoint[2].x.Exponent = 1;
    $EVSE.ISO20.AC_DER_ChargeLoop_Response.CLResControlMode.DER_Dynamic_AC_CLResControlMode.DERControl.VoltageTrip.OverVoltageMomentaryCessationTripCurve.CurveDataPoints.CurveDataPoint[2].x.Value = 2;
    $EVSE.ISO20.AC_DER_ChargeLoop_Response.CLResControlMode.DER_Dynamic_AC_CLResControlMode.DERControl.VoltageTrip.OverVoltageMomentaryCessationTripCurve.CurveDataPoints.CurveDataPoint[2].y.Exponent = 1;
    $EVSE.ISO20.AC_DER_ChargeLoop_Response.CLResControlMode.DER_Dynamic_AC_CLResControlMode.DERControl.VoltageTrip.OverVoltageMomentaryCessationTripCurve.CurveDataPoints.CurveDataPoint[2].y.Value = 2;
    $EVSE.ISO20.AC_DER_ChargeLoop_Response.CLResControlMode.DER_Dynamic_AC_CLResControlMode.DERControl.VoltageTrip.OverVoltageMomentaryCessationTripCurve.LockInValue = _CCS::DataTypes::LockValueUnitType::W;
    $EVSE.ISO20.AC_DER_ChargeLoop_Response.CLResControlMode.DER_Dynamic_AC_CLResControlMode.DERControl.VoltageTrip.OverVoltageMomentaryCessationTripCurve.LockOutValue = _CCS::DataTypes::LockValueUnitType::W;
    $EVSE.ISO20.AC_DER_ChargeLoop_Response.CLResControlMode.DER_Dynamic_AC_CLResControlMode.DERControl.VoltageTrip.OverVoltageMomentaryCessationTripCurve.OpenLoopResponseTime.Exponent = 2;
    $EVSE.ISO20.AC_DER_ChargeLoop_Response.CLResControlMode.DER_Dynamic_AC_CLResControlMode.DERControl.VoltageTrip.OverVoltageMomentaryCessationTripCurve.OpenLoopResponseTime.Value = 1;
    $EVSE.ISO20.AC_DER_ChargeLoop_Response.CLResControlMode.DER_Dynamic_AC_CLResControlMode.DERControl.VoltageTrip.OverVoltageMomentaryCessationTripCurve.TimeConstantPT1 = 2;
    $EVSE.ISO20.AC_DER_ChargeLoop_Response.CLResControlMode.DER_Dynamic_AC_CLResControlMode.DERControl.VoltageTrip.OverVoltageMomentaryCessationTripCurve.IntentionalDelay.Exponent = 2;
    $EVSE.ISO20.AC_DER_ChargeLoop_Response.CLResControlMode.DER_Dynamic_AC_CLResControlMode.DERControl.VoltageTrip.OverVoltageMomentaryCessationTripCurve.IntentionalDelay.Value = 1;

    $EVSE.ISO20.AC_DER_ChargeLoop_Response.CLResControlMode.DER_Dynamic_AC_CLResControlMode.DERControl.VoltageTrip.UnderVoltageMomentaryCessationTripCurve.Enable = 1;
    $EVSE.ISO20.AC_DER_ChargeLoop_Response.CLResControlMode.DER_Dynamic_AC_CLResControlMode.DERControl.VoltageTrip.UnderVoltageMomentaryCessationTripCurve.Priority = 2;
    $EVSE.ISO20.AC_DER_ChargeLoop_Response.CLResControlMode.DER_Dynamic_AC_CLResControlMode.DERControl.VoltageTrip.UnderVoltageMomentaryCessationTripCurve.xUnit = _CCS::DataTypes::CurveDataPointsUnitType::W;
    $EVSE.ISO20.AC_DER_ChargeLoop_Response.CLResControlMode.DER_Dynamic_AC_CLResControlMode.DERControl.VoltageTrip.UnderVoltageMomentaryCessationTripCurve.yUnit = _CCS::DataTypes::CurveDataPointsUnitType::W;
    $EVSE.ISO20.AC_DER_ChargeLoop_Response.CLResControlMode.DER_Dynamic_AC_CLResControlMode.DERControl.VoltageTrip.UnderVoltageMomentaryCessationTripCurve.CurveDataPoints.CurveDataPoint.Length = 3;
    $EVSE.ISO20.AC_DER_ChargeLoop_Response.CLResControlMode.DER_Dynamic_AC_CLResControlMode.DERControl.VoltageTrip.UnderVoltageMomentaryCessationTripCurve.CurveDataPoints.CurveDataPoint[0].x.Exponent = 1;
    $EVSE.ISO20.AC_DER_ChargeLoop_Response.CLResControlMode.DER_Dynamic_AC_CLResControlMode.DERControl.VoltageTrip.UnderVoltageMomentaryCessationTripCurve.CurveDataPoints.CurveDataPoint[0].x.Value = 2;
    $EVSE.ISO20.AC_DER_ChargeLoop_Response.CLResControlMode.DER_Dynamic_AC_CLResControlMode.DERControl.VoltageTrip.UnderVoltageMomentaryCessationTripCurve.CurveDataPoints.CurveDataPoint[0].y.Exponent = 1;
    $EVSE.ISO20.AC_DER_ChargeLoop_Response.CLResControlMode.DER_Dynamic_AC_CLResControlMode.DERControl.VoltageTrip.UnderVoltageMomentaryCessationTripCurve.CurveDataPoints.CurveDataPoint[0].y.Value = 2;
    $EVSE.ISO20.AC_DER_ChargeLoop_Response.CLResControlMode.DER_Dynamic_AC_CLResControlMode.DERControl.VoltageTrip.UnderVoltageMomentaryCessationTripCurve.CurveDataPoints.CurveDataPoint[1].x.Exponent = 1;
    $EVSE.ISO20.AC_DER_ChargeLoop_Response.CLResControlMode.DER_Dynamic_AC_CLResControlMode.DERControl.VoltageTrip.UnderVoltageMomentaryCessationTripCurve.CurveDataPoints.CurveDataPoint[1].x.Value = 2;
    $EVSE.ISO20.AC_DER_ChargeLoop_Response.CLResControlMode.DER_Dynamic_AC_CLResControlMode.DERControl.VoltageTrip.UnderVoltageMomentaryCessationTripCurve.CurveDataPoints.CurveDataPoint[1].y.Exponent = 1;
    $EVSE.ISO20.AC_DER_ChargeLoop_Response.CLResControlMode.DER_Dynamic_AC_CLResControlMode.DERControl.VoltageTrip.UnderVoltageMomentaryCessationTripCurve.CurveDataPoints.CurveDataPoint[1].y.Value = 2;
    $EVSE.ISO20.AC_DER_ChargeLoop_Response.CLResControlMode.DER_Dynamic_AC_CLResControlMode.DERControl.VoltageTrip.UnderVoltageMomentaryCessationTripCurve.CurveDataPoints.CurveDataPoint[2].x.Exponent = 1;
    $EVSE.ISO20.AC_DER_ChargeLoop_Response.CLResControlMode.DER_Dynamic_AC_CLResControlMode.DERControl.VoltageTrip.UnderVoltageMomentaryCessationTripCurve.CurveDataPoints.CurveDataPoint[2].x.Value = 2;
    $EVSE.ISO20.AC_DER_ChargeLoop_Response.CLResControlMode.DER_Dynamic_AC_CLResControlMode.DERControl.VoltageTrip.UnderVoltageMomentaryCessationTripCurve.CurveDataPoints.CurveDataPoint[2].y.Exponent = 1;
    $EVSE.ISO20.AC_DER_ChargeLoop_Response.CLResControlMode.DER_Dynamic_AC_CLResControlMode.DERControl.VoltageTrip.UnderVoltageMomentaryCessationTripCurve.CurveDataPoints.CurveDataPoint[2].y.Value = 2;
    $EVSE.ISO20.AC_DER_ChargeLoop_Response.CLResControlMode.DER_Dynamic_AC_CLResControlMode.DERControl.VoltageTrip.UnderVoltageMomentaryCessationTripCurve.LockInValue = _CCS::DataTypes::LockValueUnitType::W;
    $EVSE.ISO20.AC_DER_ChargeLoop_Response.CLResControlMode.DER_Dynamic_AC_CLResControlMode.DERControl.VoltageTrip.UnderVoltageMomentaryCessationTripCurve.LockOutValue = _CCS::DataTypes::LockValueUnitType::W;
    $EVSE.ISO20.AC_DER_ChargeLoop_Response.CLResControlMode.DER_Dynamic_AC_CLResControlMode.DERControl.VoltageTrip.UnderVoltageMomentaryCessationTripCurve.OpenLoopResponseTime.Exponent = 2;
    $EVSE.ISO20.AC_DER_ChargeLoop_Response.CLResControlMode.DER_Dynamic_AC_CLResControlMode.DERControl.VoltageTrip.UnderVoltageMomentaryCessationTripCurve.OpenLoopResponseTime.Value = 1;
    $EVSE.ISO20.AC_DER_ChargeLoop_Response.CLResControlMode.DER_Dynamic_AC_CLResControlMode.DERControl.VoltageTrip.UnderVoltageMomentaryCessationTripCurve.TimeConstantPT1 = 2;
    $EVSE.ISO20.AC_DER_ChargeLoop_Response.CLResControlMode.DER_Dynamic_AC_CLResControlMode.DERControl.VoltageTrip.UnderVoltageMomentaryCessationTripCurve.IntentionalDelay.Exponent = 2;
    $EVSE.ISO20.AC_DER_ChargeLoop_Response.CLResControlMode.DER_Dynamic_AC_CLResControlMode.DERControl.VoltageTrip.UnderVoltageMomentaryCessationTripCurve.IntentionalDelay.Value = 1;

    $EVSE.ISO20.AC_DER_ChargeLoop_Response.CLResControlMode.DER_Dynamic_AC_CLResControlMode.DERControl.VoltageTrip.OverVoltageMayTripCurve.Enable = 1;
    $EVSE.ISO20.AC_DER_ChargeLoop_Response.CLResControlMode.DER_Dynamic_AC_CLResControlMode.DERControl.VoltageTrip.OverVoltageMayTripCurve.Priority = 2;
    $EVSE.ISO20.AC_DER_ChargeLoop_Response.CLResControlMode.DER_Dynamic_AC_CLResControlMode.DERControl.VoltageTrip.OverVoltageMayTripCurve.xUnit = _CCS::DataTypes::CurveDataPointsUnitType::W;
    $EVSE.ISO20.AC_DER_ChargeLoop_Response.CLResControlMode.DER_Dynamic_AC_CLResControlMode.DERControl.VoltageTrip.OverVoltageMayTripCurve.yUnit = _CCS::DataTypes::CurveDataPointsUnitType::W;
    $EVSE.ISO20.AC_DER_ChargeLoop_Response.CLResControlMode.DER_Dynamic_AC_CLResControlMode.DERControl.VoltageTrip.OverVoltageMayTripCurve.CurveDataPoints.CurveDataPoint.Length = 3;
    $EVSE.ISO20.AC_DER_ChargeLoop_Response.CLResControlMode.DER_Dynamic_AC_CLResControlMode.DERControl.VoltageTrip.OverVoltageMayTripCurve.CurveDataPoints.CurveDataPoint[0].x.Exponent = 1;
    $EVSE.ISO20.AC_DER_ChargeLoop_Response.CLResControlMode.DER_Dynamic_AC_CLResControlMode.DERControl.VoltageTrip.OverVoltageMayTripCurve.CurveDataPoints.CurveDataPoint[0].x.Value = 2;
    $EVSE.ISO20.AC_DER_ChargeLoop_Response.CLResControlMode.DER_Dynamic_AC_CLResControlMode.DERControl.VoltageTrip.OverVoltageMayTripCurve.CurveDataPoints.CurveDataPoint[0].y.Exponent = 1;
    $EVSE.ISO20.AC_DER_ChargeLoop_Response.CLResControlMode.DER_Dynamic_AC_CLResControlMode.DERControl.VoltageTrip.OverVoltageMayTripCurve.CurveDataPoints.CurveDataPoint[0].y.Value = 2;
    $EVSE.ISO20.AC_DER_ChargeLoop_Response.CLResControlMode.DER_Dynamic_AC_CLResControlMode.DERControl.VoltageTrip.OverVoltageMayTripCurve.CurveDataPoints.CurveDataPoint[1].x.Exponent = 1;
    $EVSE.ISO20.AC_DER_ChargeLoop_Response.CLResControlMode.DER_Dynamic_AC_CLResControlMode.DERControl.VoltageTrip.OverVoltageMayTripCurve.CurveDataPoints.CurveDataPoint[1].x.Value = 2;
    $EVSE.ISO20.AC_DER_ChargeLoop_Response.CLResControlMode.DER_Dynamic_AC_CLResControlMode.DERControl.VoltageTrip.OverVoltageMayTripCurve.CurveDataPoints.CurveDataPoint[1].y.Exponent = 1;
    $EVSE.ISO20.AC_DER_ChargeLoop_Response.CLResControlMode.DER_Dynamic_AC_CLResControlMode.DERControl.VoltageTrip.OverVoltageMayTripCurve.CurveDataPoints.CurveDataPoint[1].y.Value = 2;
    $EVSE.ISO20.AC_DER_ChargeLoop_Response.CLResControlMode.DER_Dynamic_AC_CLResControlMode.DERControl.VoltageTrip.OverVoltageMayTripCurve.CurveDataPoints.CurveDataPoint[2].x.Exponent = 1;
    $EVSE.ISO20.AC_DER_ChargeLoop_Response.CLResControlMode.DER_Dynamic_AC_CLResControlMode.DERControl.VoltageTrip.OverVoltageMayTripCurve.CurveDataPoints.CurveDataPoint[2].x.Value = 2;
    $EVSE.ISO20.AC_DER_ChargeLoop_Response.CLResControlMode.DER_Dynamic_AC_CLResControlMode.DERControl.VoltageTrip.OverVoltageMayTripCurve.CurveDataPoints.CurveDataPoint[2].y.Exponent = 1;
    $EVSE.ISO20.AC_DER_ChargeLoop_Response.CLResControlMode.DER_Dynamic_AC_CLResControlMode.DERControl.VoltageTrip.OverVoltageMayTripCurve.CurveDataPoints.CurveDataPoint[2].y.Value = 2;
    $EVSE.ISO20.AC_DER_ChargeLoop_Response.CLResControlMode.DER_Dynamic_AC_CLResControlMode.DERControl.VoltageTrip.OverVoltageMayTripCurve.LockInValue = _CCS::DataTypes::LockValueUnitType::W;
    $EVSE.ISO20.AC_DER_ChargeLoop_Response.CLResControlMode.DER_Dynamic_AC_CLResControlMode.DERControl.VoltageTrip.OverVoltageMayTripCurve.LockOutValue = _CCS::DataTypes::LockValueUnitType::W;
    $EVSE.ISO20.AC_DER_ChargeLoop_Response.CLResControlMode.DER_Dynamic_AC_CLResControlMode.DERControl.VoltageTrip.OverVoltageMayTripCurve.OpenLoopResponseTime.Exponent = 2;
    $EVSE.ISO20.AC_DER_ChargeLoop_Response.CLResControlMode.DER_Dynamic_AC_CLResControlMode.DERControl.VoltageTrip.OverVoltageMayTripCurve.OpenLoopResponseTime.Value = 1;
    $EVSE.ISO20.AC_DER_ChargeLoop_Response.CLResControlMode.DER_Dynamic_AC_CLResControlMode.DERControl.VoltageTrip.OverVoltageMayTripCurve.TimeConstantPT1 = 2;
    $EVSE.ISO20.AC_DER_ChargeLoop_Response.CLResControlMode.DER_Dynamic_AC_CLResControlMode.DERControl.VoltageTrip.OverVoltageMayTripCurve.IntentionalDelay.Exponent = 2;
    $EVSE.ISO20.AC_DER_ChargeLoop_Response.CLResControlMode.DER_Dynamic_AC_CLResControlMode.DERControl.VoltageTrip.OverVoltageMayTripCurve.IntentionalDelay.Value = 1;

    $EVSE.ISO20.AC_DER_ChargeLoop_Response.CLResControlMode.DER_Dynamic_AC_CLResControlMode.DERControl.VoltageTrip.UnderVoltageMayTripCurve.Enable = 1;
    $EVSE.ISO20.AC_DER_ChargeLoop_Response.CLResControlMode.DER_Dynamic_AC_CLResControlMode.DERControl.VoltageTrip.UnderVoltageMayTripCurve.Priority = 2;
    $EVSE.ISO20.AC_DER_ChargeLoop_Response.CLResControlMode.DER_Dynamic_AC_CLResControlMode.DERControl.VoltageTrip.UnderVoltageMayTripCurve.xUnit = _CCS::DataTypes::CurveDataPointsUnitType::W;
    $EVSE.ISO20.AC_DER_ChargeLoop_Response.CLResControlMode.DER_Dynamic_AC_CLResControlMode.DERControl.VoltageTrip.UnderVoltageMayTripCurve.yUnit = _CCS::DataTypes::CurveDataPointsUnitType::W;
    $EVSE.ISO20.AC_DER_ChargeLoop_Response.CLResControlMode.DER_Dynamic_AC_CLResControlMode.DERControl.VoltageTrip.UnderVoltageMayTripCurve.CurveDataPoints.CurveDataPoint.Length = 3;
    $EVSE.ISO20.AC_DER_ChargeLoop_Response.CLResControlMode.DER_Dynamic_AC_CLResControlMode.DERControl.VoltageTrip.UnderVoltageMayTripCurve.CurveDataPoints.CurveDataPoint[0].x.Exponent = 1;
    $EVSE.ISO20.AC_DER_ChargeLoop_Response.CLResControlMode.DER_Dynamic_AC_CLResControlMode.DERControl.VoltageTrip.UnderVoltageMayTripCurve.CurveDataPoints.CurveDataPoint[0].x.Value = 2;
    $EVSE.ISO20.AC_DER_ChargeLoop_Response.CLResControlMode.DER_Dynamic_AC_CLResControlMode.DERControl.VoltageTrip.UnderVoltageMayTripCurve.CurveDataPoints.CurveDataPoint[0].y.Exponent = 1;
    $EVSE.ISO20.AC_DER_ChargeLoop_Response.CLResControlMode.DER_Dynamic_AC_CLResControlMode.DERControl.VoltageTrip.UnderVoltageMayTripCurve.CurveDataPoints.CurveDataPoint[0].y.Value = 2;
    $EVSE.ISO20.AC_DER_ChargeLoop_Response.CLResControlMode.DER_Dynamic_AC_CLResControlMode.DERControl.VoltageTrip.UnderVoltageMayTripCurve.CurveDataPoints.CurveDataPoint[1].x.Exponent = 1;
    $EVSE.ISO20.AC_DER_ChargeLoop_Response.CLResControlMode.DER_Dynamic_AC_CLResControlMode.DERControl.VoltageTrip.UnderVoltageMayTripCurve.CurveDataPoints.CurveDataPoint[1].x.Value = 2;
    $EVSE.ISO20.AC_DER_ChargeLoop_Response.CLResControlMode.DER_Dynamic_AC_CLResControlMode.DERControl.VoltageTrip.UnderVoltageMayTripCurve.CurveDataPoints.CurveDataPoint[1].y.Exponent = 1;
    $EVSE.ISO20.AC_DER_ChargeLoop_Response.CLResControlMode.DER_Dynamic_AC_CLResControlMode.DERControl.VoltageTrip.UnderVoltageMayTripCurve.CurveDataPoints.CurveDataPoint[1].y.Value = 2;
    $EVSE.ISO20.AC_DER_ChargeLoop_Response.CLResControlMode.DER_Dynamic_AC_CLResControlMode.DERControl.VoltageTrip.UnderVoltageMayTripCurve.CurveDataPoints.CurveDataPoint[2].x.Exponent = 1;
    $EVSE.ISO20.AC_DER_ChargeLoop_Response.CLResControlMode.DER_Dynamic_AC_CLResControlMode.DERControl.VoltageTrip.UnderVoltageMayTripCurve.CurveDataPoints.CurveDataPoint[2].x.Value = 2;
    $EVSE.ISO20.AC_DER_ChargeLoop_Response.CLResControlMode.DER_Dynamic_AC_CLResControlMode.DERControl.VoltageTrip.UnderVoltageMayTripCurve.CurveDataPoints.CurveDataPoint[2].y.Exponent = 1;
    $EVSE.ISO20.AC_DER_ChargeLoop_Response.CLResControlMode.DER_Dynamic_AC_CLResControlMode.DERControl.VoltageTrip.UnderVoltageMayTripCurve.CurveDataPoints.CurveDataPoint[2].y.Value = 2;
    $EVSE.ISO20.AC_DER_ChargeLoop_Response.CLResControlMode.DER_Dynamic_AC_CLResControlMode.DERControl.VoltageTrip.UnderVoltageMayTripCurve.LockInValue = _CCS::DataTypes::LockValueUnitType::W;
    $EVSE.ISO20.AC_DER_ChargeLoop_Response.CLResControlMode.DER_Dynamic_AC_CLResControlMode.DERControl.VoltageTrip.UnderVoltageMayTripCurve.LockOutValue = _CCS::DataTypes::LockValueUnitType::W;
    $EVSE.ISO20.AC_DER_ChargeLoop_Response.CLResControlMode.DER_Dynamic_AC_CLResControlMode.DERControl.VoltageTrip.UnderVoltageMayTripCurve.OpenLoopResponseTime.Exponent = 2;
    $EVSE.ISO20.AC_DER_ChargeLoop_Response.CLResControlMode.DER_Dynamic_AC_CLResControlMode.DERControl.VoltageTrip.UnderVoltageMayTripCurve.OpenLoopResponseTime.Value = 1;
    $EVSE.ISO20.AC_DER_ChargeLoop_Response.CLResControlMode.DER_Dynamic_AC_CLResControlMode.DERControl.VoltageTrip.UnderVoltageMayTripCurve.TimeConstantPT1 = 2;
    $EVSE.ISO20.AC_DER_ChargeLoop_Response.CLResControlMode.DER_Dynamic_AC_CLResControlMode.DERControl.VoltageTrip.UnderVoltageMayTripCurve.IntentionalDelay.Exponent = 2;
    $EVSE.ISO20.AC_DER_ChargeLoop_Response.CLResControlMode.DER_Dynamic_AC_CLResControlMode.DERControl.VoltageTrip.UnderVoltageMayTripCurve.IntentionalDelay.Value = 1;

    $EVSE.ISO20.AC_DER_ChargeLoop_Response.CLResControlMode.DER_Dynamic_AC_CLResControlMode.DERControl.VoltageTrip.OverVoltageMeanValue10min.Exponent = 2;
    $EVSE.ISO20.AC_DER_ChargeLoop_Response.CLResControlMode.DER_Dynamic_AC_CLResControlMode.DERControl.VoltageTrip.OverVoltageMeanValue10min.Value = 2;
    $EVSE.ISO20.AC_DER_ChargeLoop_Response.CLResControlMode.DER_Dynamic_AC_CLResControlMode.DERControl.VoltageTrip.OverVoltage10MinMeanTripDelay.Exponent = 2;
    $EVSE.ISO20.AC_DER_ChargeLoop_Response.CLResControlMode.DER_Dynamic_AC_CLResControlMode.DERControl.VoltageTrip.OverVoltage10MinMeanTripDelay.Value = 2;
    $EVSE.ISO20.AC_DER_ChargeLoop_Response.CLResControlMode.DER_Dynamic_AC_CLResControlMode.DERControl.VoltageTrip.PowerDuringCessation = _CCS::DataTypes::PowerDuringCessationType::ReactivePower;
    
    /* FrequencyTrip */
    $EVSE.ISO20.AC_DER_ChargeLoop_Response.CLResControlMode.DER_Dynamic_AC_CLResControlMode.DERControl.FrequencyTrip.OverFrequencyMustTripCurve.Enable = 1;
    $EVSE.ISO20.AC_DER_ChargeLoop_Response.CLResControlMode.DER_Dynamic_AC_CLResControlMode.DERControl.FrequencyTrip.OverFrequencyMustTripCurve.Priority = 2;
    $EVSE.ISO20.AC_DER_ChargeLoop_Response.CLResControlMode.DER_Dynamic_AC_CLResControlMode.DERControl.FrequencyTrip.OverFrequencyMustTripCurve.xUnit = _CCS::DataTypes::CurveDataPointsUnitType::W;
    $EVSE.ISO20.AC_DER_ChargeLoop_Response.CLResControlMode.DER_Dynamic_AC_CLResControlMode.DERControl.FrequencyTrip.OverFrequencyMustTripCurve.yUnit = _CCS::DataTypes::CurveDataPointsUnitType::W;
    $EVSE.ISO20.AC_DER_ChargeLoop_Response.CLResControlMode.DER_Dynamic_AC_CLResControlMode.DERControl.FrequencyTrip.OverFrequencyMustTripCurve.CurveDataPoints.CurveDataPoint.Length = 3;
    $EVSE.ISO20.AC_DER_ChargeLoop_Response.CLResControlMode.DER_Dynamic_AC_CLResControlMode.DERControl.FrequencyTrip.OverFrequencyMustTripCurve.CurveDataPoints.CurveDataPoint[0].x.Exponent = 1;
    $EVSE.ISO20.AC_DER_ChargeLoop_Response.CLResControlMode.DER_Dynamic_AC_CLResControlMode.DERControl.FrequencyTrip.OverFrequencyMustTripCurve.CurveDataPoints.CurveDataPoint[0].x.Value = 2;
    $EVSE.ISO20.AC_DER_ChargeLoop_Response.CLResControlMode.DER_Dynamic_AC_CLResControlMode.DERControl.FrequencyTrip.OverFrequencyMustTripCurve.CurveDataPoints.CurveDataPoint[0].y.Exponent = 1;
    $EVSE.ISO20.AC_DER_ChargeLoop_Response.CLResControlMode.DER_Dynamic_AC_CLResControlMode.DERControl.FrequencyTrip.OverFrequencyMustTripCurve.CurveDataPoints.CurveDataPoint[0].y.Value = 2;
    $EVSE.ISO20.AC_DER_ChargeLoop_Response.CLResControlMode.DER_Dynamic_AC_CLResControlMode.DERControl.FrequencyTrip.OverFrequencyMustTripCurve.CurveDataPoints.CurveDataPoint[1].x.Exponent = 1;
    $EVSE.ISO20.AC_DER_ChargeLoop_Response.CLResControlMode.DER_Dynamic_AC_CLResControlMode.DERControl.FrequencyTrip.OverFrequencyMustTripCurve.CurveDataPoints.CurveDataPoint[1].x.Value = 2;
    $EVSE.ISO20.AC_DER_ChargeLoop_Response.CLResControlMode.DER_Dynamic_AC_CLResControlMode.DERControl.FrequencyTrip.OverFrequencyMustTripCurve.CurveDataPoints.CurveDataPoint[1].y.Exponent = 1;
    $EVSE.ISO20.AC_DER_ChargeLoop_Response.CLResControlMode.DER_Dynamic_AC_CLResControlMode.DERControl.FrequencyTrip.OverFrequencyMustTripCurve.CurveDataPoints.CurveDataPoint[1].y.Value = 2;
    $EVSE.ISO20.AC_DER_ChargeLoop_Response.CLResControlMode.DER_Dynamic_AC_CLResControlMode.DERControl.FrequencyTrip.OverFrequencyMustTripCurve.CurveDataPoints.CurveDataPoint[2].x.Exponent = 1;
    $EVSE.ISO20.AC_DER_ChargeLoop_Response.CLResControlMode.DER_Dynamic_AC_CLResControlMode.DERControl.FrequencyTrip.OverFrequencyMustTripCurve.CurveDataPoints.CurveDataPoint[2].x.Value = 2;
    $EVSE.ISO20.AC_DER_ChargeLoop_Response.CLResControlMode.DER_Dynamic_AC_CLResControlMode.DERControl.FrequencyTrip.OverFrequencyMustTripCurve.CurveDataPoints.CurveDataPoint[2].y.Exponent = 1;
    $EVSE.ISO20.AC_DER_ChargeLoop_Response.CLResControlMode.DER_Dynamic_AC_CLResControlMode.DERControl.FrequencyTrip.OverFrequencyMustTripCurve.CurveDataPoints.CurveDataPoint[2].y.Value = 2;
    $EVSE.ISO20.AC_DER_ChargeLoop_Response.CLResControlMode.DER_Dynamic_AC_CLResControlMode.DERControl.FrequencyTrip.OverFrequencyMustTripCurve.LockInValue = _CCS::DataTypes::LockValueUnitType::W;
    $EVSE.ISO20.AC_DER_ChargeLoop_Response.CLResControlMode.DER_Dynamic_AC_CLResControlMode.DERControl.FrequencyTrip.OverFrequencyMustTripCurve.LockOutValue = _CCS::DataTypes::LockValueUnitType::W;
    $EVSE.ISO20.AC_DER_ChargeLoop_Response.CLResControlMode.DER_Dynamic_AC_CLResControlMode.DERControl.FrequencyTrip.OverFrequencyMustTripCurve.OpenLoopResponseTime.Exponent = 2;
    $EVSE.ISO20.AC_DER_ChargeLoop_Response.CLResControlMode.DER_Dynamic_AC_CLResControlMode.DERControl.FrequencyTrip.OverFrequencyMustTripCurve.OpenLoopResponseTime.Value = 1;
    $EVSE.ISO20.AC_DER_ChargeLoop_Response.CLResControlMode.DER_Dynamic_AC_CLResControlMode.DERControl.FrequencyTrip.OverFrequencyMustTripCurve.TimeConstantPT1 = 2;
    $EVSE.ISO20.AC_DER_ChargeLoop_Response.CLResControlMode.DER_Dynamic_AC_CLResControlMode.DERControl.FrequencyTrip.OverFrequencyMustTripCurve.IntentionalDelay.Exponent = 2;
    $EVSE.ISO20.AC_DER_ChargeLoop_Response.CLResControlMode.DER_Dynamic_AC_CLResControlMode.DERControl.FrequencyTrip.OverFrequencyMustTripCurve.IntentionalDelay.Value = 1;

    $EVSE.ISO20.AC_DER_ChargeLoop_Response.CLResControlMode.DER_Dynamic_AC_CLResControlMode.DERControl.FrequencyTrip.UnderFrequencyMustTripCurve.Enable = 1;
    $EVSE.ISO20.AC_DER_ChargeLoop_Response.CLResControlMode.DER_Dynamic_AC_CLResControlMode.DERControl.FrequencyTrip.UnderFrequencyMustTripCurve.Priority = 2;
    $EVSE.ISO20.AC_DER_ChargeLoop_Response.CLResControlMode.DER_Dynamic_AC_CLResControlMode.DERControl.FrequencyTrip.UnderFrequencyMustTripCurve.xUnit = _CCS::DataTypes::CurveDataPointsUnitType::W;
    $EVSE.ISO20.AC_DER_ChargeLoop_Response.CLResControlMode.DER_Dynamic_AC_CLResControlMode.DERControl.FrequencyTrip.UnderFrequencyMustTripCurve.yUnit = _CCS::DataTypes::CurveDataPointsUnitType::W;
    $EVSE.ISO20.AC_DER_ChargeLoop_Response.CLResControlMode.DER_Dynamic_AC_CLResControlMode.DERControl.FrequencyTrip.UnderFrequencyMustTripCurve.CurveDataPoints.CurveDataPoint.Length = 3;
    $EVSE.ISO20.AC_DER_ChargeLoop_Response.CLResControlMode.DER_Dynamic_AC_CLResControlMode.DERControl.FrequencyTrip.UnderFrequencyMustTripCurve.CurveDataPoints.CurveDataPoint[0].x.Exponent = 1;
    $EVSE.ISO20.AC_DER_ChargeLoop_Response.CLResControlMode.DER_Dynamic_AC_CLResControlMode.DERControl.FrequencyTrip.UnderFrequencyMustTripCurve.CurveDataPoints.CurveDataPoint[0].x.Value = 2;
    $EVSE.ISO20.AC_DER_ChargeLoop_Response.CLResControlMode.DER_Dynamic_AC_CLResControlMode.DERControl.FrequencyTrip.UnderFrequencyMustTripCurve.CurveDataPoints.CurveDataPoint[0].y.Exponent = 1;
    $EVSE.ISO20.AC_DER_ChargeLoop_Response.CLResControlMode.DER_Dynamic_AC_CLResControlMode.DERControl.FrequencyTrip.UnderFrequencyMustTripCurve.CurveDataPoints.CurveDataPoint[0].y.Value = 2;
    $EVSE.ISO20.AC_DER_ChargeLoop_Response.CLResControlMode.DER_Dynamic_AC_CLResControlMode.DERControl.FrequencyTrip.UnderFrequencyMustTripCurve.CurveDataPoints.CurveDataPoint[1].x.Exponent = 1;
    $EVSE.ISO20.AC_DER_ChargeLoop_Response.CLResControlMode.DER_Dynamic_AC_CLResControlMode.DERControl.FrequencyTrip.UnderFrequencyMustTripCurve.CurveDataPoints.CurveDataPoint[1].x.Value = 2;
    $EVSE.ISO20.AC_DER_ChargeLoop_Response.CLResControlMode.DER_Dynamic_AC_CLResControlMode.DERControl.FrequencyTrip.UnderFrequencyMustTripCurve.CurveDataPoints.CurveDataPoint[1].y.Exponent = 1;
    $EVSE.ISO20.AC_DER_ChargeLoop_Response.CLResControlMode.DER_Dynamic_AC_CLResControlMode.DERControl.FrequencyTrip.UnderFrequencyMustTripCurve.CurveDataPoints.CurveDataPoint[1].y.Value = 2;
    $EVSE.ISO20.AC_DER_ChargeLoop_Response.CLResControlMode.DER_Dynamic_AC_CLResControlMode.DERControl.FrequencyTrip.UnderFrequencyMustTripCurve.CurveDataPoints.CurveDataPoint[2].x.Exponent = 1;
    $EVSE.ISO20.AC_DER_ChargeLoop_Response.CLResControlMode.DER_Dynamic_AC_CLResControlMode.DERControl.FrequencyTrip.UnderFrequencyMustTripCurve.CurveDataPoints.CurveDataPoint[2].x.Value = 2;
    $EVSE.ISO20.AC_DER_ChargeLoop_Response.CLResControlMode.DER_Dynamic_AC_CLResControlMode.DERControl.FrequencyTrip.UnderFrequencyMustTripCurve.CurveDataPoints.CurveDataPoint[2].y.Exponent = 1;
    $EVSE.ISO20.AC_DER_ChargeLoop_Response.CLResControlMode.DER_Dynamic_AC_CLResControlMode.DERControl.FrequencyTrip.UnderFrequencyMustTripCurve.CurveDataPoints.CurveDataPoint[2].y.Value = 2;
    $EVSE.ISO20.AC_DER_ChargeLoop_Response.CLResControlMode.DER_Dynamic_AC_CLResControlMode.DERControl.FrequencyTrip.UnderFrequencyMustTripCurve.LockInValue = _CCS::DataTypes::LockValueUnitType::W;
    $EVSE.ISO20.AC_DER_ChargeLoop_Response.CLResControlMode.DER_Dynamic_AC_CLResControlMode.DERControl.FrequencyTrip.UnderFrequencyMustTripCurve.LockOutValue = _CCS::DataTypes::LockValueUnitType::W;
    $EVSE.ISO20.AC_DER_ChargeLoop_Response.CLResControlMode.DER_Dynamic_AC_CLResControlMode.DERControl.FrequencyTrip.UnderFrequencyMustTripCurve.OpenLoopResponseTime.Exponent = 2;
    $EVSE.ISO20.AC_DER_ChargeLoop_Response.CLResControlMode.DER_Dynamic_AC_CLResControlMode.DERControl.FrequencyTrip.UnderFrequencyMustTripCurve.OpenLoopResponseTime.Value = 1;
    $EVSE.ISO20.AC_DER_ChargeLoop_Response.CLResControlMode.DER_Dynamic_AC_CLResControlMode.DERControl.FrequencyTrip.UnderFrequencyMustTripCurve.TimeConstantPT1 = 2;
    $EVSE.ISO20.AC_DER_ChargeLoop_Response.CLResControlMode.DER_Dynamic_AC_CLResControlMode.DERControl.FrequencyTrip.UnderFrequencyMustTripCurve.IntentionalDelay.Exponent = 2;
    $EVSE.ISO20.AC_DER_ChargeLoop_Response.CLResControlMode.DER_Dynamic_AC_CLResControlMode.DERControl.FrequencyTrip.UnderFrequencyMustTripCurve.IntentionalDelay.Value = 1;

    $EVSE.ISO20.AC_DER_ChargeLoop_Response.CLResControlMode.DER_Dynamic_AC_CLResControlMode.DERControl.FrequencyTrip.OverFrequencyMayTripCurve.Enable = 1;
    $EVSE.ISO20.AC_DER_ChargeLoop_Response.CLResControlMode.DER_Dynamic_AC_CLResControlMode.DERControl.FrequencyTrip.OverFrequencyMayTripCurve.Priority = 2;
    $EVSE.ISO20.AC_DER_ChargeLoop_Response.CLResControlMode.DER_Dynamic_AC_CLResControlMode.DERControl.FrequencyTrip.OverFrequencyMayTripCurve.xUnit = _CCS::DataTypes::CurveDataPointsUnitType::W;
    $EVSE.ISO20.AC_DER_ChargeLoop_Response.CLResControlMode.DER_Dynamic_AC_CLResControlMode.DERControl.FrequencyTrip.OverFrequencyMayTripCurve.yUnit = _CCS::DataTypes::CurveDataPointsUnitType::W;
    $EVSE.ISO20.AC_DER_ChargeLoop_Response.CLResControlMode.DER_Dynamic_AC_CLResControlMode.DERControl.FrequencyTrip.OverFrequencyMayTripCurve.CurveDataPoints.CurveDataPoint.Length = 3;
    $EVSE.ISO20.AC_DER_ChargeLoop_Response.CLResControlMode.DER_Dynamic_AC_CLResControlMode.DERControl.FrequencyTrip.OverFrequencyMayTripCurve.CurveDataPoints.CurveDataPoint[0].x.Exponent = 1;
    $EVSE.ISO20.AC_DER_ChargeLoop_Response.CLResControlMode.DER_Dynamic_AC_CLResControlMode.DERControl.FrequencyTrip.OverFrequencyMayTripCurve.CurveDataPoints.CurveDataPoint[0].x.Value = 2;
    $EVSE.ISO20.AC_DER_ChargeLoop_Response.CLResControlMode.DER_Dynamic_AC_CLResControlMode.DERControl.FrequencyTrip.OverFrequencyMayTripCurve.CurveDataPoints.CurveDataPoint[0].y.Exponent = 1;
    $EVSE.ISO20.AC_DER_ChargeLoop_Response.CLResControlMode.DER_Dynamic_AC_CLResControlMode.DERControl.FrequencyTrip.OverFrequencyMayTripCurve.CurveDataPoints.CurveDataPoint[0].y.Value = 2;
    $EVSE.ISO20.AC_DER_ChargeLoop_Response.CLResControlMode.DER_Dynamic_AC_CLResControlMode.DERControl.FrequencyTrip.OverFrequencyMayTripCurve.CurveDataPoints.CurveDataPoint[1].x.Exponent = 1;
    $EVSE.ISO20.AC_DER_ChargeLoop_Response.CLResControlMode.DER_Dynamic_AC_CLResControlMode.DERControl.FrequencyTrip.OverFrequencyMayTripCurve.CurveDataPoints.CurveDataPoint[1].x.Value = 2;
    $EVSE.ISO20.AC_DER_ChargeLoop_Response.CLResControlMode.DER_Dynamic_AC_CLResControlMode.DERControl.FrequencyTrip.OverFrequencyMayTripCurve.CurveDataPoints.CurveDataPoint[1].y.Exponent = 1;
    $EVSE.ISO20.AC_DER_ChargeLoop_Response.CLResControlMode.DER_Dynamic_AC_CLResControlMode.DERControl.FrequencyTrip.OverFrequencyMayTripCurve.CurveDataPoints.CurveDataPoint[1].y.Value = 2;
    $EVSE.ISO20.AC_DER_ChargeLoop_Response.CLResControlMode.DER_Dynamic_AC_CLResControlMode.DERControl.FrequencyTrip.OverFrequencyMayTripCurve.CurveDataPoints.CurveDataPoint[2].x.Exponent = 1;
    $EVSE.ISO20.AC_DER_ChargeLoop_Response.CLResControlMode.DER_Dynamic_AC_CLResControlMode.DERControl.FrequencyTrip.OverFrequencyMayTripCurve.CurveDataPoints.CurveDataPoint[2].x.Value = 2;
    $EVSE.ISO20.AC_DER_ChargeLoop_Response.CLResControlMode.DER_Dynamic_AC_CLResControlMode.DERControl.FrequencyTrip.OverFrequencyMayTripCurve.CurveDataPoints.CurveDataPoint[2].y.Exponent = 1;
    $EVSE.ISO20.AC_DER_ChargeLoop_Response.CLResControlMode.DER_Dynamic_AC_CLResControlMode.DERControl.FrequencyTrip.OverFrequencyMayTripCurve.CurveDataPoints.CurveDataPoint[2].y.Value = 2;
    $EVSE.ISO20.AC_DER_ChargeLoop_Response.CLResControlMode.DER_Dynamic_AC_CLResControlMode.DERControl.FrequencyTrip.OverFrequencyMayTripCurve.LockInValue = _CCS::DataTypes::LockValueUnitType::W;
    $EVSE.ISO20.AC_DER_ChargeLoop_Response.CLResControlMode.DER_Dynamic_AC_CLResControlMode.DERControl.FrequencyTrip.OverFrequencyMayTripCurve.LockOutValue = _CCS::DataTypes::LockValueUnitType::W;
    $EVSE.ISO20.AC_DER_ChargeLoop_Response.CLResControlMode.DER_Dynamic_AC_CLResControlMode.DERControl.FrequencyTrip.OverFrequencyMayTripCurve.OpenLoopResponseTime.Exponent = 2;
    $EVSE.ISO20.AC_DER_ChargeLoop_Response.CLResControlMode.DER_Dynamic_AC_CLResControlMode.DERControl.FrequencyTrip.OverFrequencyMayTripCurve.OpenLoopResponseTime.Value = 1;
    $EVSE.ISO20.AC_DER_ChargeLoop_Response.CLResControlMode.DER_Dynamic_AC_CLResControlMode.DERControl.FrequencyTrip.OverFrequencyMayTripCurve.TimeConstantPT1 = 2;
    $EVSE.ISO20.AC_DER_ChargeLoop_Response.CLResControlMode.DER_Dynamic_AC_CLResControlMode.DERControl.FrequencyTrip.OverFrequencyMayTripCurve.IntentionalDelay.Exponent = 2;
    $EVSE.ISO20.AC_DER_ChargeLoop_Response.CLResControlMode.DER_Dynamic_AC_CLResControlMode.DERControl.FrequencyTrip.OverFrequencyMayTripCurve.IntentionalDelay.Value = 1;

    $EVSE.ISO20.AC_DER_ChargeLoop_Response.CLResControlMode.DER_Dynamic_AC_CLResControlMode.DERControl.FrequencyTrip.UnderFrequencyMayTripCurve.Enable = 1;
    $EVSE.ISO20.AC_DER_ChargeLoop_Response.CLResControlMode.DER_Dynamic_AC_CLResControlMode.DERControl.FrequencyTrip.UnderFrequencyMayTripCurve.Priority = 2;
    $EVSE.ISO20.AC_DER_ChargeLoop_Response.CLResControlMode.DER_Dynamic_AC_CLResControlMode.DERControl.FrequencyTrip.UnderFrequencyMayTripCurve.xUnit = _CCS::DataTypes::CurveDataPointsUnitType::W;
    $EVSE.ISO20.AC_DER_ChargeLoop_Response.CLResControlMode.DER_Dynamic_AC_CLResControlMode.DERControl.FrequencyTrip.UnderFrequencyMayTripCurve.yUnit = _CCS::DataTypes::CurveDataPointsUnitType::W;
    $EVSE.ISO20.AC_DER_ChargeLoop_Response.CLResControlMode.DER_Dynamic_AC_CLResControlMode.DERControl.FrequencyTrip.UnderFrequencyMayTripCurve.CurveDataPoints.CurveDataPoint.Length = 3;
    $EVSE.ISO20.AC_DER_ChargeLoop_Response.CLResControlMode.DER_Dynamic_AC_CLResControlMode.DERControl.FrequencyTrip.UnderFrequencyMayTripCurve.CurveDataPoints.CurveDataPoint[0].x.Exponent = 1;
    $EVSE.ISO20.AC_DER_ChargeLoop_Response.CLResControlMode.DER_Dynamic_AC_CLResControlMode.DERControl.FrequencyTrip.UnderFrequencyMayTripCurve.CurveDataPoints.CurveDataPoint[0].x.Value = 2;
    $EVSE.ISO20.AC_DER_ChargeLoop_Response.CLResControlMode.DER_Dynamic_AC_CLResControlMode.DERControl.FrequencyTrip.UnderFrequencyMayTripCurve.CurveDataPoints.CurveDataPoint[0].y.Exponent = 1;
    $EVSE.ISO20.AC_DER_ChargeLoop_Response.CLResControlMode.DER_Dynamic_AC_CLResControlMode.DERControl.FrequencyTrip.UnderFrequencyMayTripCurve.CurveDataPoints.CurveDataPoint[0].y.Value = 2;
    $EVSE.ISO20.AC_DER_ChargeLoop_Response.CLResControlMode.DER_Dynamic_AC_CLResControlMode.DERControl.FrequencyTrip.UnderFrequencyMayTripCurve.CurveDataPoints.CurveDataPoint[1].x.Exponent = 1;
    $EVSE.ISO20.AC_DER_ChargeLoop_Response.CLResControlMode.DER_Dynamic_AC_CLResControlMode.DERControl.FrequencyTrip.UnderFrequencyMayTripCurve.CurveDataPoints.CurveDataPoint[1].x.Value = 2;
    $EVSE.ISO20.AC_DER_ChargeLoop_Response.CLResControlMode.DER_Dynamic_AC_CLResControlMode.DERControl.FrequencyTrip.UnderFrequencyMayTripCurve.CurveDataPoints.CurveDataPoint[1].y.Exponent = 1;
    $EVSE.ISO20.AC_DER_ChargeLoop_Response.CLResControlMode.DER_Dynamic_AC_CLResControlMode.DERControl.FrequencyTrip.UnderFrequencyMayTripCurve.CurveDataPoints.CurveDataPoint[1].y.Value = 2;
    $EVSE.ISO20.AC_DER_ChargeLoop_Response.CLResControlMode.DER_Dynamic_AC_CLResControlMode.DERControl.FrequencyTrip.UnderFrequencyMayTripCurve.CurveDataPoints.CurveDataPoint[2].x.Exponent = 1;
    $EVSE.ISO20.AC_DER_ChargeLoop_Response.CLResControlMode.DER_Dynamic_AC_CLResControlMode.DERControl.FrequencyTrip.UnderFrequencyMayTripCurve.CurveDataPoints.CurveDataPoint[2].x.Value = 2;
    $EVSE.ISO20.AC_DER_ChargeLoop_Response.CLResControlMode.DER_Dynamic_AC_CLResControlMode.DERControl.FrequencyTrip.UnderFrequencyMayTripCurve.CurveDataPoints.CurveDataPoint[2].y.Exponent = 1;
    $EVSE.ISO20.AC_DER_ChargeLoop_Response.CLResControlMode.DER_Dynamic_AC_CLResControlMode.DERControl.FrequencyTrip.UnderFrequencyMayTripCurve.CurveDataPoints.CurveDataPoint[2].y.Value = 2;
    $EVSE.ISO20.AC_DER_ChargeLoop_Response.CLResControlMode.DER_Dynamic_AC_CLResControlMode.DERControl.FrequencyTrip.UnderFrequencyMayTripCurve.LockInValue = _CCS::DataTypes::LockValueUnitType::W;
    $EVSE.ISO20.AC_DER_ChargeLoop_Response.CLResControlMode.DER_Dynamic_AC_CLResControlMode.DERControl.FrequencyTrip.UnderFrequencyMayTripCurve.LockOutValue = _CCS::DataTypes::LockValueUnitType::W;
    $EVSE.ISO20.AC_DER_ChargeLoop_Response.CLResControlMode.DER_Dynamic_AC_CLResControlMode.DERControl.FrequencyTrip.UnderFrequencyMayTripCurve.OpenLoopResponseTime.Exponent = 2;
    $EVSE.ISO20.AC_DER_ChargeLoop_Response.CLResControlMode.DER_Dynamic_AC_CLResControlMode.DERControl.FrequencyTrip.UnderFrequencyMayTripCurve.OpenLoopResponseTime.Value = 1;
    $EVSE.ISO20.AC_DER_ChargeLoop_Response.CLResControlMode.DER_Dynamic_AC_CLResControlMode.DERControl.FrequencyTrip.UnderFrequencyMayTripCurve.TimeConstantPT1 = 2;
    $EVSE.ISO20.AC_DER_ChargeLoop_Response.CLResControlMode.DER_Dynamic_AC_CLResControlMode.DERControl.FrequencyTrip.UnderFrequencyMayTripCurve.IntentionalDelay.Exponent = 2;
    $EVSE.ISO20.AC_DER_ChargeLoop_Response.CLResControlMode.DER_Dynamic_AC_CLResControlMode.DERControl.FrequencyTrip.UnderFrequencyMayTripCurve.IntentionalDelay.Value = 1;

    /* FaultRideThrough */
    $EVSE.ISO20.AC_DER_ChargeLoop_Response.CLResControlMode.DER_Dynamic_AC_CLResControlMode.DERControl.FaultRideThrough.OverVoltageRideThroughPositiveCurveKFactor.Exponent = 2;
    $EVSE.ISO20.AC_DER_ChargeLoop_Response.CLResControlMode.DER_Dynamic_AC_CLResControlMode.DERControl.FaultRideThrough.OverVoltageRideThroughPositiveCurveKFactor.Value = 2;
    $EVSE.ISO20.AC_DER_ChargeLoop_Response.CLResControlMode.DER_Dynamic_AC_CLResControlMode.DERControl.FaultRideThrough.OverVoltageRideThroughNegativeCurveKFactor.Exponent = 2;
    $EVSE.ISO20.AC_DER_ChargeLoop_Response.CLResControlMode.DER_Dynamic_AC_CLResControlMode.DERControl.FaultRideThrough.OverVoltageRideThroughNegativeCurveKFactor.Value = 2;
    $EVSE.ISO20.AC_DER_ChargeLoop_Response.CLResControlMode.DER_Dynamic_AC_CLResControlMode.DERControl.FaultRideThrough.UnderVoltageRideThroughPositiveCurveKFactor.Exponent = 2;
    $EVSE.ISO20.AC_DER_ChargeLoop_Response.CLResControlMode.DER_Dynamic_AC_CLResControlMode.DERControl.FaultRideThrough.UnderVoltageRideThroughPositiveCurveKFactor.Value = 2; 
    $EVSE.ISO20.AC_DER_ChargeLoop_Response.CLResControlMode.DER_Dynamic_AC_CLResControlMode.DERControl.FaultRideThrough.UnderVoltageRideThroughNegativeCurveKFactor.Exponent = 2;
    $EVSE.ISO20.AC_DER_ChargeLoop_Response.CLResControlMode.DER_Dynamic_AC_CLResControlMode.DERControl.FaultRideThrough.UnderVoltageRideThroughNegativeCurveKFactor.Value = 2;

    $EVSE.ISO20.AC_DER_ChargeLoop_Response.CLResControlMode.DER_Dynamic_AC_CLResControlMode.DERControl.FaultRideThrough.DeadBand.MidLow.Exponent = 2;
    $EVSE.ISO20.AC_DER_ChargeLoop_Response.CLResControlMode.DER_Dynamic_AC_CLResControlMode.DERControl.FaultRideThrough.DeadBand.MidLow.Value = 2;
    $EVSE.ISO20.AC_DER_ChargeLoop_Response.CLResControlMode.DER_Dynamic_AC_CLResControlMode.DERControl.FaultRideThrough.DeadBand.MidHigh.Exponent = 2;
    $EVSE.ISO20.AC_DER_ChargeLoop_Response.CLResControlMode.DER_Dynamic_AC_CLResControlMode.DERControl.FaultRideThrough.DeadBand.MidHigh.Value = 2;
    $EVSE.ISO20.AC_DER_ChargeLoop_Response.CLResControlMode.DER_Dynamic_AC_CLResControlMode.DERControl.FaultRideThrough.DeadBand.Low.Exponent = 2;
    $EVSE.ISO20.AC_DER_ChargeLoop_Response.CLResControlMode.DER_Dynamic_AC_CLResControlMode.DERControl.FaultRideThrough.DeadBand.Low.Value = 2;
    $EVSE.ISO20.AC_DER_ChargeLoop_Response.CLResControlMode.DER_Dynamic_AC_CLResControlMode.DERControl.FaultRideThrough.DeadBand.High.Exponent = 2;
    $EVSE.ISO20.AC_DER_ChargeLoop_Response.CLResControlMode.DER_Dynamic_AC_CLResControlMode.DERControl.FaultRideThrough.DeadBand.High.Value = 2;
    
    /* EnterService */
    $EVSE.ISO20.AC_DER_ChargeLoop_Response.CLResControlMode.DER_Dynamic_AC_CLResControlMode.DERControl.EnterService.PermitService = 1;
    $EVSE.ISO20.AC_DER_ChargeLoop_Response.CLResControlMode.DER_Dynamic_AC_CLResControlMode.DERControl.EnterService.EnterServiceVoltageHigh.Exponent = 2;
    $EVSE.ISO20.AC_DER_ChargeLoop_Response.CLResControlMode.DER_Dynamic_AC_CLResControlMode.DERControl.EnterService.EnterServiceVoltageHigh.Value = 2;
    $EVSE.ISO20.AC_DER_ChargeLoop_Response.CLResControlMode.DER_Dynamic_AC_CLResControlMode.DERControl.EnterService.EnterServiceVoltageLow.Exponent = 2;
    $EVSE.ISO20.AC_DER_ChargeLoop_Response.CLResControlMode.DER_Dynamic_AC_CLResControlMode.DERControl.EnterService.EnterServiceVoltageLow.Value = 2;
    $EVSE.ISO20.AC_DER_ChargeLoop_Response.CLResControlMode.DER_Dynamic_AC_CLResControlMode.DERControl.EnterService.EnterServiceFrequencyHigh.Exponent = 2;
    $EVSE.ISO20.AC_DER_ChargeLoop_Response.CLResControlMode.DER_Dynamic_AC_CLResControlMode.DERControl.EnterService.EnterServiceFrequencyHigh.Value = 2;
    $EVSE.ISO20.AC_DER_ChargeLoop_Response.CLResControlMode.DER_Dynamic_AC_CLResControlMode.DERControl.EnterService.EnterServiceFrequencyLow.Exponent = 2;
    $EVSE.ISO20.AC_DER_ChargeLoop_Response.CLResControlMode.DER_Dynamic_AC_CLResControlMode.DERControl.EnterService.EnterServiceFrequencyLow.Value = 2;
    $EVSE.ISO20.AC_DER_ChargeLoop_Response.CLResControlMode.DER_Dynamic_AC_CLResControlMode.DERControl.EnterService.EnterServiceDelay.Exponent = 2;
    $EVSE.ISO20.AC_DER_ChargeLoop_Response.CLResControlMode.DER_Dynamic_AC_CLResControlMode.DERControl.EnterService.EnterServiceDelay.Value = 2;
    $EVSE.ISO20.AC_DER_ChargeLoop_Response.CLResControlMode.DER_Dynamic_AC_CLResControlMode.DERControl.EnterService.EnterServiceRandomizedDelay.Exponent = 2;
    $EVSE.ISO20.AC_DER_ChargeLoop_Response.CLResControlMode.DER_Dynamic_AC_CLResControlMode.DERControl.EnterService.EnterServiceRandomizedDelay.Value = 2;
    $EVSE.ISO20.AC_DER_ChargeLoop_Response.CLResControlMode.DER_Dynamic_AC_CLResControlMode.DERControl.EnterService.EnterServiceRampTime.Exponent = 2;
    $EVSE.ISO20.AC_DER_ChargeLoop_Response.CLResControlMode.DER_Dynamic_AC_CLResControlMode.DERControl.EnterService.EnterServiceRampTime.Value = 2;
    $EVSE.ISO20.AC_DER_ChargeLoop_Response.CLResControlMode.DER_Dynamic_AC_CLResControlMode.DERControl.EnterService.EnterServiceGradient.Exponent = 2;
    $EVSE.ISO20.AC_DER_ChargeLoop_Response.CLResControlMode.DER_Dynamic_AC_CLResControlMode.DERControl.EnterService.EnterServiceGradient.Value = 2;
    
    /* ReactivePowerSupport */
    $EVSE.ISO20.AC_DER_ChargeLoop_Response.CLResControlMode.DER_Dynamic_AC_CLResControlMode.DERControl.ReactivePowerSupport.ConstantPowerFactor.Enable = 1;
    $EVSE.ISO20.AC_DER_ChargeLoop_Response.CLResControlMode.DER_Dynamic_AC_CLResControlMode.DERControl.ReactivePowerSupport.ConstantPowerFactor.Priority = 2;
    $EVSE.ISO20.AC_DER_ChargeLoop_Response.CLResControlMode.DER_Dynamic_AC_CLResControlMode.DERControl.ReactivePowerSupport.ConstantPowerFactor.PowerFactorValue.Exponent = 2;
    $EVSE.ISO20.AC_DER_ChargeLoop_Response.CLResControlMode.DER_Dynamic_AC_CLResControlMode.DERControl.ReactivePowerSupport.ConstantPowerFactor.PowerFactorValue.Value = 2;
    $EVSE.ISO20.AC_DER_ChargeLoop_Response.CLResControlMode.DER_Dynamic_AC_CLResControlMode.DERControl.ReactivePowerSupport.ConstantPowerFactor.PowerFactorExcitation = _CCS::DataTypes::PowerFactorExcitationType::Under_Excited;

    $EVSE.ISO20.AC_DER_ChargeLoop_Response.CLResControlMode.DER_Dynamic_AC_CLResControlMode.DERControl.ReactivePowerSupport.VoltVar.Enable = 1;
    $EVSE.ISO20.AC_DER_ChargeLoop_Response.CLResControlMode.DER_Dynamic_AC_CLResControlMode.DERControl.ReactivePowerSupport.VoltVar.Priority = 2;
    $EVSE.ISO20.AC_DER_ChargeLoop_Response.CLResControlMode.DER_Dynamic_AC_CLResControlMode.DERControl.ReactivePowerSupport.VoltVar.xUnit = _CCS::DataTypes::CurveDataPointsUnitType::W;
    $EVSE.ISO20.AC_DER_ChargeLoop_Response.CLResControlMode.DER_Dynamic_AC_CLResControlMode.DERControl.ReactivePowerSupport.VoltVar.yUnit = _CCS::DataTypes::CurveDataPointsUnitType::W;
    $EVSE.ISO20.AC_DER_ChargeLoop_Response.CLResControlMode.DER_Dynamic_AC_CLResControlMode.DERControl.ReactivePowerSupport.VoltVar.CurveDataPoints.CurveDataPoint.Length = 3;
    $EVSE.ISO20.AC_DER_ChargeLoop_Response.CLResControlMode.DER_Dynamic_AC_CLResControlMode.DERControl.ReactivePowerSupport.VoltVar.CurveDataPoints.CurveDataPoint[0].x.Exponent = 1;
    $EVSE.ISO20.AC_DER_ChargeLoop_Response.CLResControlMode.DER_Dynamic_AC_CLResControlMode.DERControl.ReactivePowerSupport.VoltVar.CurveDataPoints.CurveDataPoint[0].x.Value = 2;
    $EVSE.ISO20.AC_DER_ChargeLoop_Response.CLResControlMode.DER_Dynamic_AC_CLResControlMode.DERControl.ReactivePowerSupport.VoltVar.CurveDataPoints.CurveDataPoint[0].y.Exponent = 1;
    $EVSE.ISO20.AC_DER_ChargeLoop_Response.CLResControlMode.DER_Dynamic_AC_CLResControlMode.DERControl.ReactivePowerSupport.VoltVar.CurveDataPoints.CurveDataPoint[0].y.Value = 2;
    $EVSE.ISO20.AC_DER_ChargeLoop_Response.CLResControlMode.DER_Dynamic_AC_CLResControlMode.DERControl.ReactivePowerSupport.VoltVar.CurveDataPoints.CurveDataPoint[1].x.Exponent = 1;
    $EVSE.ISO20.AC_DER_ChargeLoop_Response.CLResControlMode.DER_Dynamic_AC_CLResControlMode.DERControl.ReactivePowerSupport.VoltVar.CurveDataPoints.CurveDataPoint[1].x.Value = 2;
    $EVSE.ISO20.AC_DER_ChargeLoop_Response.CLResControlMode.DER_Dynamic_AC_CLResControlMode.DERControl.ReactivePowerSupport.VoltVar.CurveDataPoints.CurveDataPoint[1].y.Exponent = 1;
    $EVSE.ISO20.AC_DER_ChargeLoop_Response.CLResControlMode.DER_Dynamic_AC_CLResControlMode.DERControl.ReactivePowerSupport.VoltVar.CurveDataPoints.CurveDataPoint[1].y.Value = 2;
    $EVSE.ISO20.AC_DER_ChargeLoop_Response.CLResControlMode.DER_Dynamic_AC_CLResControlMode.DERControl.ReactivePowerSupport.VoltVar.CurveDataPoints.CurveDataPoint[2].x.Exponent = 1;
    $EVSE.ISO20.AC_DER_ChargeLoop_Response.CLResControlMode.DER_Dynamic_AC_CLResControlMode.DERControl.ReactivePowerSupport.VoltVar.CurveDataPoints.CurveDataPoint[2].x.Value = 2;
    $EVSE.ISO20.AC_DER_ChargeLoop_Response.CLResControlMode.DER_Dynamic_AC_CLResControlMode.DERControl.ReactivePowerSupport.VoltVar.CurveDataPoints.CurveDataPoint[2].y.Exponent = 1;
    $EVSE.ISO20.AC_DER_ChargeLoop_Response.CLResControlMode.DER_Dynamic_AC_CLResControlMode.DERControl.ReactivePowerSupport.VoltVar.CurveDataPoints.CurveDataPoint[2].y.Value = 2;
    $EVSE.ISO20.AC_DER_ChargeLoop_Response.CLResControlMode.DER_Dynamic_AC_CLResControlMode.DERControl.ReactivePowerSupport.VoltVar.LockInValue = _CCS::DataTypes::LockValueUnitType::W;
    $EVSE.ISO20.AC_DER_ChargeLoop_Response.CLResControlMode.DER_Dynamic_AC_CLResControlMode.DERControl.ReactivePowerSupport.VoltVar.LockOutValue = _CCS::DataTypes::LockValueUnitType::W;
    $EVSE.ISO20.AC_DER_ChargeLoop_Response.CLResControlMode.DER_Dynamic_AC_CLResControlMode.DERControl.ReactivePowerSupport.VoltVar.OpenLoopResponseTime.Exponent = 2;
    $EVSE.ISO20.AC_DER_ChargeLoop_Response.CLResControlMode.DER_Dynamic_AC_CLResControlMode.DERControl.ReactivePowerSupport.VoltVar.OpenLoopResponseTime.Value = 1;
    $EVSE.ISO20.AC_DER_ChargeLoop_Response.CLResControlMode.DER_Dynamic_AC_CLResControlMode.DERControl.ReactivePowerSupport.VoltVar.TimeConstantPT1 = 2;
    $EVSE.ISO20.AC_DER_ChargeLoop_Response.CLResControlMode.DER_Dynamic_AC_CLResControlMode.DERControl.ReactivePowerSupport.VoltVar.IntentionalDelay.Exponent = 2;
    $EVSE.ISO20.AC_DER_ChargeLoop_Response.CLResControlMode.DER_Dynamic_AC_CLResControlMode.DERControl.ReactivePowerSupport.VoltVar.IntentionalDelay.Value = 1;

    $EVSE.ISO20.AC_DER_ChargeLoop_Response.CLResControlMode.DER_Dynamic_AC_CLResControlMode.DERControl.ReactivePowerSupport.WattVar.Enable = 1;
    $EVSE.ISO20.AC_DER_ChargeLoop_Response.CLResControlMode.DER_Dynamic_AC_CLResControlMode.DERControl.ReactivePowerSupport.WattVar.Priority = 2;
    $EVSE.ISO20.AC_DER_ChargeLoop_Response.CLResControlMode.DER_Dynamic_AC_CLResControlMode.DERControl.ReactivePowerSupport.WattVar.xUnit = _CCS::DataTypes::CurveDataPointsUnitType::W;
    $EVSE.ISO20.AC_DER_ChargeLoop_Response.CLResControlMode.DER_Dynamic_AC_CLResControlMode.DERControl.ReactivePowerSupport.WattVar.yUnit = _CCS::DataTypes::CurveDataPointsUnitType::W;
    $EVSE.ISO20.AC_DER_ChargeLoop_Response.CLResControlMode.DER_Dynamic_AC_CLResControlMode.DERControl.ReactivePowerSupport.WattVar.CurveDataPoints.CurveDataPoint.Length = 3;
    $EVSE.ISO20.AC_DER_ChargeLoop_Response.CLResControlMode.DER_Dynamic_AC_CLResControlMode.DERControl.ReactivePowerSupport.WattVar.CurveDataPoints.CurveDataPoint[0].x.Exponent = 1;
    $EVSE.ISO20.AC_DER_ChargeLoop_Response.CLResControlMode.DER_Dynamic_AC_CLResControlMode.DERControl.ReactivePowerSupport.WattVar.CurveDataPoints.CurveDataPoint[0].x.Value = 2;
    $EVSE.ISO20.AC_DER_ChargeLoop_Response.CLResControlMode.DER_Dynamic_AC_CLResControlMode.DERControl.ReactivePowerSupport.WattVar.CurveDataPoints.CurveDataPoint[0].y.Exponent = 1;
    $EVSE.ISO20.AC_DER_ChargeLoop_Response.CLResControlMode.DER_Dynamic_AC_CLResControlMode.DERControl.ReactivePowerSupport.WattVar.CurveDataPoints.CurveDataPoint[0].y.Value = 2;
    $EVSE.ISO20.AC_DER_ChargeLoop_Response.CLResControlMode.DER_Dynamic_AC_CLResControlMode.DERControl.ReactivePowerSupport.WattVar.CurveDataPoints.CurveDataPoint[1].x.Exponent = 1;
    $EVSE.ISO20.AC_DER_ChargeLoop_Response.CLResControlMode.DER_Dynamic_AC_CLResControlMode.DERControl.ReactivePowerSupport.WattVar.CurveDataPoints.CurveDataPoint[1].x.Value = 2;
    $EVSE.ISO20.AC_DER_ChargeLoop_Response.CLResControlMode.DER_Dynamic_AC_CLResControlMode.DERControl.ReactivePowerSupport.WattVar.CurveDataPoints.CurveDataPoint[1].y.Exponent = 1;
    $EVSE.ISO20.AC_DER_ChargeLoop_Response.CLResControlMode.DER_Dynamic_AC_CLResControlMode.DERControl.ReactivePowerSupport.WattVar.CurveDataPoints.CurveDataPoint[1].y.Value = 2;
    $EVSE.ISO20.AC_DER_ChargeLoop_Response.CLResControlMode.DER_Dynamic_AC_CLResControlMode.DERControl.ReactivePowerSupport.WattVar.CurveDataPoints.CurveDataPoint[2].x.Exponent = 1;
    $EVSE.ISO20.AC_DER_ChargeLoop_Response.CLResControlMode.DER_Dynamic_AC_CLResControlMode.DERControl.ReactivePowerSupport.WattVar.CurveDataPoints.CurveDataPoint[2].x.Value = 2;
    $EVSE.ISO20.AC_DER_ChargeLoop_Response.CLResControlMode.DER_Dynamic_AC_CLResControlMode.DERControl.ReactivePowerSupport.WattVar.CurveDataPoints.CurveDataPoint[2].y.Exponent = 1;
    $EVSE.ISO20.AC_DER_ChargeLoop_Response.CLResControlMode.DER_Dynamic_AC_CLResControlMode.DERControl.ReactivePowerSupport.WattVar.CurveDataPoints.CurveDataPoint[2].y.Value = 2;
    $EVSE.ISO20.AC_DER_ChargeLoop_Response.CLResControlMode.DER_Dynamic_AC_CLResControlMode.DERControl.ReactivePowerSupport.WattVar.LockInValue = _CCS::DataTypes::LockValueUnitType::W;
    $EVSE.ISO20.AC_DER_ChargeLoop_Response.CLResControlMode.DER_Dynamic_AC_CLResControlMode.DERControl.ReactivePowerSupport.WattVar.LockOutValue = _CCS::DataTypes::LockValueUnitType::W;
    $EVSE.ISO20.AC_DER_ChargeLoop_Response.CLResControlMode.DER_Dynamic_AC_CLResControlMode.DERControl.ReactivePowerSupport.WattVar.OpenLoopResponseTime.Exponent = 2;
    $EVSE.ISO20.AC_DER_ChargeLoop_Response.CLResControlMode.DER_Dynamic_AC_CLResControlMode.DERControl.ReactivePowerSupport.WattVar.OpenLoopResponseTime.Value = 1;
    $EVSE.ISO20.AC_DER_ChargeLoop_Response.CLResControlMode.DER_Dynamic_AC_CLResControlMode.DERControl.ReactivePowerSupport.WattVar.TimeConstantPT1 = 2;
    $EVSE.ISO20.AC_DER_ChargeLoop_Response.CLResControlMode.DER_Dynamic_AC_CLResControlMode.DERControl.ReactivePowerSupport.WattVar.IntentionalDelay.Exponent = 2;
    $EVSE.ISO20.AC_DER_ChargeLoop_Response.CLResControlMode.DER_Dynamic_AC_CLResControlMode.DERControl.ReactivePowerSupport.WattVar.IntentionalDelay.Value = 1;

    /* ConstantVar */
    $EVSE.ISO20.AC_DER_ChargeLoop_Response.CLResControlMode.DER_Dynamic_AC_CLResControlMode.DERControl.ReactivePowerSupport.ConstantVar.Enable = 1;
    $EVSE.ISO20.AC_DER_ChargeLoop_Response.CLResControlMode.DER_Dynamic_AC_CLResControlMode.DERControl.ReactivePowerSupport.ConstantVar.Priority = 3;
    $EVSE.ISO20.AC_DER_ChargeLoop_Response.CLResControlMode.DER_Dynamic_AC_CLResControlMode.DERControl.ReactivePowerSupport.ConstantVar.Setpoint.Exponent = 2;
    $EVSE.ISO20.AC_DER_ChargeLoop_Response.CLResControlMode.DER_Dynamic_AC_CLResControlMode.DERControl.ReactivePowerSupport.ConstantVar.Setpoint.Value = 2;
    $EVSE.ISO20.AC_DER_ChargeLoop_Response.CLResControlMode.DER_Dynamic_AC_CLResControlMode.DERControl.ReactivePowerSupport.ConstantVar.Unit = _CCS::DataTypes::CurveDataPointsUnitType::W;


    $EVSE.ISO20.AC_DER_ChargeLoop_Response.CLResControlMode.DER_Dynamic_AC_CLResControlMode.DERControl.ReactivePowerSupport.WattCosPhi.Enable = 1;
    $EVSE.ISO20.AC_DER_ChargeLoop_Response.CLResControlMode.DER_Dynamic_AC_CLResControlMode.DERControl.ReactivePowerSupport.WattCosPhi.Priority = 2;
    $EVSE.ISO20.AC_DER_ChargeLoop_Response.CLResControlMode.DER_Dynamic_AC_CLResControlMode.DERControl.ReactivePowerSupport.WattCosPhi.xUnit = _CCS::DataTypes::CurveDataPointsUnitType::W;
    $EVSE.ISO20.AC_DER_ChargeLoop_Response.CLResControlMode.DER_Dynamic_AC_CLResControlMode.DERControl.ReactivePowerSupport.WattCosPhi.yUnit = _CCS::DataTypes::CurveDataPointsUnitType::W;
    $EVSE.ISO20.AC_DER_ChargeLoop_Response.CLResControlMode.DER_Dynamic_AC_CLResControlMode.DERControl.ReactivePowerSupport.WattCosPhi.CurveDataPoints.CurveDataPoint.Length = 3;
    $EVSE.ISO20.AC_DER_ChargeLoop_Response.CLResControlMode.DER_Dynamic_AC_CLResControlMode.DERControl.ReactivePowerSupport.WattCosPhi.CurveDataPoints.CurveDataPoint[0].x.Exponent = 1;
    $EVSE.ISO20.AC_DER_ChargeLoop_Response.CLResControlMode.DER_Dynamic_AC_CLResControlMode.DERControl.ReactivePowerSupport.WattCosPhi.CurveDataPoints.CurveDataPoint[0].x.Value = 2;
    $EVSE.ISO20.AC_DER_ChargeLoop_Response.CLResControlMode.DER_Dynamic_AC_CLResControlMode.DERControl.ReactivePowerSupport.WattCosPhi.CurveDataPoints.CurveDataPoint[0].y.Exponent = 1;
    $EVSE.ISO20.AC_DER_ChargeLoop_Response.CLResControlMode.DER_Dynamic_AC_CLResControlMode.DERControl.ReactivePowerSupport.WattCosPhi.CurveDataPoints.CurveDataPoint[0].y.Value = 2;
    $EVSE.ISO20.AC_DER_ChargeLoop_Response.CLResControlMode.DER_Dynamic_AC_CLResControlMode.DERControl.ReactivePowerSupport.WattCosPhi.CurveDataPoints.CurveDataPoint[1].x.Exponent = 1;
    $EVSE.ISO20.AC_DER_ChargeLoop_Response.CLResControlMode.DER_Dynamic_AC_CLResControlMode.DERControl.ReactivePowerSupport.WattCosPhi.CurveDataPoints.CurveDataPoint[1].x.Value = 2;
    $EVSE.ISO20.AC_DER_ChargeLoop_Response.CLResControlMode.DER_Dynamic_AC_CLResControlMode.DERControl.ReactivePowerSupport.WattCosPhi.CurveDataPoints.CurveDataPoint[1].y.Exponent = 1;
    $EVSE.ISO20.AC_DER_ChargeLoop_Response.CLResControlMode.DER_Dynamic_AC_CLResControlMode.DERControl.ReactivePowerSupport.WattCosPhi.CurveDataPoints.CurveDataPoint[1].y.Value = 2;
    $EVSE.ISO20.AC_DER_ChargeLoop_Response.CLResControlMode.DER_Dynamic_AC_CLResControlMode.DERControl.ReactivePowerSupport.WattCosPhi.CurveDataPoints.CurveDataPoint[2].x.Exponent = 1;
    $EVSE.ISO20.AC_DER_ChargeLoop_Response.CLResControlMode.DER_Dynamic_AC_CLResControlMode.DERControl.ReactivePowerSupport.WattCosPhi.CurveDataPoints.CurveDataPoint[2].x.Value = 2;
    $EVSE.ISO20.AC_DER_ChargeLoop_Response.CLResControlMode.DER_Dynamic_AC_CLResControlMode.DERControl.ReactivePowerSupport.WattCosPhi.CurveDataPoints.CurveDataPoint[2].y.Exponent = 1;
    $EVSE.ISO20.AC_DER_ChargeLoop_Response.CLResControlMode.DER_Dynamic_AC_CLResControlMode.DERControl.ReactivePowerSupport.WattCosPhi.CurveDataPoints.CurveDataPoint[2].y.Value = 2;
    $EVSE.ISO20.AC_DER_ChargeLoop_Response.CLResControlMode.DER_Dynamic_AC_CLResControlMode.DERControl.ReactivePowerSupport.WattCosPhi.LockInValue = _CCS::DataTypes::LockValueUnitType::W;
    $EVSE.ISO20.AC_DER_ChargeLoop_Response.CLResControlMode.DER_Dynamic_AC_CLResControlMode.DERControl.ReactivePowerSupport.WattCosPhi.LockOutValue = _CCS::DataTypes::LockValueUnitType::W;
    $EVSE.ISO20.AC_DER_ChargeLoop_Response.CLResControlMode.DER_Dynamic_AC_CLResControlMode.DERControl.ReactivePowerSupport.WattCosPhi.OpenLoopResponseTime.Exponent = 2;
    $EVSE.ISO20.AC_DER_ChargeLoop_Response.CLResControlMode.DER_Dynamic_AC_CLResControlMode.DERControl.ReactivePowerSupport.WattCosPhi.OpenLoopResponseTime.Value = 1;
    $EVSE.ISO20.AC_DER_ChargeLoop_Response.CLResControlMode.DER_Dynamic_AC_CLResControlMode.DERControl.ReactivePowerSupport.WattCosPhi.TimeConstantPT1 = 2;
    $EVSE.ISO20.AC_DER_ChargeLoop_Response.CLResControlMode.DER_Dynamic_AC_CLResControlMode.DERControl.ReactivePowerSupport.WattCosPhi.IntentionalDelay.Exponent = 2;
    $EVSE.ISO20.AC_DER_ChargeLoop_Response.CLResControlMode.DER_Dynamic_AC_CLResControlMode.DERControl.ReactivePowerSupport.WattCosPhi.IntentionalDelay.Value = 1;
    
    /* ActivePowerSupport */
  if(gEUFrequencyDroop == 1)
  {
    $EVSE.ISO20.AC_DER_ChargeLoop_Response.CLResControlMode.DER_Dynamic_AC_CLResControlMode.DERControl.ActivePowerSupport.FrequencyDroopElementId = 0;
    $EVSE.ISO20.AC_DER_ChargeLoop_Response.CLResControlMode.DER_Dynamic_AC_CLResControlMode.DERControl.ActivePowerSupport.FrequencyDroop.EU_FrequencyDroop.Priority = 2;
    $EVSE.ISO20.AC_DER_ChargeLoop_Response.CLResControlMode.DER_Dynamic_AC_CLResControlMode.DERControl.ActivePowerSupport.FrequencyDroop.EU_FrequencyDroop.Enable = 1;

    $EVSE.ISO20.AC_DER_ChargeLoop_Response.CLResControlMode.DER_Dynamic_AC_CLResControlMode.DERControl.ActivePowerSupport.FrequencyDroop.EU_FrequencyDroop.OverFrequencyDroop.Fstart.Exponent = 2;
    $EVSE.ISO20.AC_DER_ChargeLoop_Response.CLResControlMode.DER_Dynamic_AC_CLResControlMode.DERControl.ActivePowerSupport.FrequencyDroop.EU_FrequencyDroop.OverFrequencyDroop.Fstart.Value = 2;
    $EVSE.ISO20.AC_DER_ChargeLoop_Response.CLResControlMode.DER_Dynamic_AC_CLResControlMode.DERControl.ActivePowerSupport.FrequencyDroop.EU_FrequencyDroop.OverFrequencyDroop.s.Exponent = 2;
    $EVSE.ISO20.AC_DER_ChargeLoop_Response.CLResControlMode.DER_Dynamic_AC_CLResControlMode.DERControl.ActivePowerSupport.FrequencyDroop.EU_FrequencyDroop.OverFrequencyDroop.s.Value = 2;
    $EVSE.ISO20.AC_DER_ChargeLoop_Response.CLResControlMode.DER_Dynamic_AC_CLResControlMode.DERControl.ActivePowerSupport.FrequencyDroop.EU_FrequencyDroop.OverFrequencyDroop.DeactivationTime.Exponent = 2;
    $EVSE.ISO20.AC_DER_ChargeLoop_Response.CLResControlMode.DER_Dynamic_AC_CLResControlMode.DERControl.ActivePowerSupport.FrequencyDroop.EU_FrequencyDroop.OverFrequencyDroop.DeactivationTime.Value = 2;
    $EVSE.ISO20.AC_DER_ChargeLoop_Response.CLResControlMode.DER_Dynamic_AC_CLResControlMode.DERControl.ActivePowerSupport.FrequencyDroop.EU_FrequencyDroop.OverFrequencyDroop.IntentionalDelayPowerControl.Exponent = 2;
    $EVSE.ISO20.AC_DER_ChargeLoop_Response.CLResControlMode.DER_Dynamic_AC_CLResControlMode.DERControl.ActivePowerSupport.FrequencyDroop.EU_FrequencyDroop.OverFrequencyDroop.IntentionalDelayPowerControl.Value = 2;
    $EVSE.ISO20.AC_DER_ChargeLoop_Response.CLResControlMode.DER_Dynamic_AC_CLResControlMode.DERControl.ActivePowerSupport.FrequencyDroop.EU_FrequencyDroop.OverFrequencyDroop.PowerReference = _CCS::DataTypes::PowerReferenceType::PresentActivePower;

    /* HysteresisControl */
    $EVSE.ISO20.AC_DER_ChargeLoop_Response.CLResControlMode.DER_Dynamic_AC_CLResControlMode.DERControl.ActivePowerSupport.FrequencyDroop.EU_FrequencyDroop.OverFrequencyDroop.HysteresisControl.Fstop.Exponent = 2;
    $EVSE.ISO20.AC_DER_ChargeLoop_Response.CLResControlMode.DER_Dynamic_AC_CLResControlMode.DERControl.ActivePowerSupport.FrequencyDroop.EU_FrequencyDroop.OverFrequencyDroop.HysteresisControl.Fstop.Value = 2;
    $EVSE.ISO20.AC_DER_ChargeLoop_Response.CLResControlMode.DER_Dynamic_AC_CLResControlMode.DERControl.ActivePowerSupport.FrequencyDroop.EU_FrequencyDroop.OverFrequencyDroop.HysteresisControl.PowerUpRamp = 5;
    $EVSE.ISO20.AC_DER_ChargeLoop_Response.CLResControlMode.DER_Dynamic_AC_CLResControlMode.DERControl.ActivePowerSupport.FrequencyDroop.EU_FrequencyDroop.OverFrequencyDroop.HysteresisControl.IntentionalDelayFstop.Exponent = 2;
    $EVSE.ISO20.AC_DER_ChargeLoop_Response.CLResControlMode.DER_Dynamic_AC_CLResControlMode.DERControl.ActivePowerSupport.FrequencyDroop.EU_FrequencyDroop.OverFrequencyDroop.HysteresisControl.IntentionalDelayFstop.Value = 2;
    
    $EVSE.ISO20.AC_DER_ChargeLoop_Response.CLResControlMode.DER_Dynamic_AC_CLResControlMode.DERControl.ActivePowerSupport.FrequencyDroop.EU_FrequencyDroop.OverFrequencyDroop.MaxReactionTime.Exponent = 2;
    $EVSE.ISO20.AC_DER_ChargeLoop_Response.CLResControlMode.DER_Dynamic_AC_CLResControlMode.DERControl.ActivePowerSupport.FrequencyDroop.EU_FrequencyDroop.OverFrequencyDroop.MaxReactionTime.Value = 2;
    
    $EVSE.ISO20.AC_DER_ChargeLoop_Response.CLResControlMode.DER_Dynamic_AC_CLResControlMode.DERControl.ActivePowerSupport.FrequencyDroop.EU_FrequencyDroop.UnderFrequencyDroop.Fstart.Exponent = 2;
    $EVSE.ISO20.AC_DER_ChargeLoop_Response.CLResControlMode.DER_Dynamic_AC_CLResControlMode.DERControl.ActivePowerSupport.FrequencyDroop.EU_FrequencyDroop.UnderFrequencyDroop.Fstart.Value = 2;
    $EVSE.ISO20.AC_DER_ChargeLoop_Response.CLResControlMode.DER_Dynamic_AC_CLResControlMode.DERControl.ActivePowerSupport.FrequencyDroop.EU_FrequencyDroop.UnderFrequencyDroop.s.Exponent = 2;
    $EVSE.ISO20.AC_DER_ChargeLoop_Response.CLResControlMode.DER_Dynamic_AC_CLResControlMode.DERControl.ActivePowerSupport.FrequencyDroop.EU_FrequencyDroop.UnderFrequencyDroop.s.Value = 2;
    $EVSE.ISO20.AC_DER_ChargeLoop_Response.CLResControlMode.DER_Dynamic_AC_CLResControlMode.DERControl.ActivePowerSupport.FrequencyDroop.EU_FrequencyDroop.UnderFrequencyDroop.DeactivationTime.Exponent = 2;
    $EVSE.ISO20.AC_DER_ChargeLoop_Response.CLResControlMode.DER_Dynamic_AC_CLResControlMode.DERControl.ActivePowerSupport.FrequencyDroop.EU_FrequencyDroop.UnderFrequencyDroop.DeactivationTime.Value = 2;
    $EVSE.ISO20.AC_DER_ChargeLoop_Response.CLResControlMode.DER_Dynamic_AC_CLResControlMode.DERControl.ActivePowerSupport.FrequencyDroop.EU_FrequencyDroop.UnderFrequencyDroop.IntentionalDelayPowerControl.Exponent = 2;
    $EVSE.ISO20.AC_DER_ChargeLoop_Response.CLResControlMode.DER_Dynamic_AC_CLResControlMode.DERControl.ActivePowerSupport.FrequencyDroop.EU_FrequencyDroop.UnderFrequencyDroop.IntentionalDelayPowerControl.Value = 2;
    $EVSE.ISO20.AC_DER_ChargeLoop_Response.CLResControlMode.DER_Dynamic_AC_CLResControlMode.DERControl.ActivePowerSupport.FrequencyDroop.EU_FrequencyDroop.UnderFrequencyDroop.PowerReference = _CCS::DataTypes::PowerReferenceType::PresentActivePower;

    /* HysteresisControl */
    $EVSE.ISO20.AC_DER_ChargeLoop_Response.CLResControlMode.DER_Dynamic_AC_CLResControlMode.DERControl.ActivePowerSupport.FrequencyDroop.EU_FrequencyDroop.UnderFrequencyDroop.HysteresisControl.Fstop.Exponent = 2;
    $EVSE.ISO20.AC_DER_ChargeLoop_Response.CLResControlMode.DER_Dynamic_AC_CLResControlMode.DERControl.ActivePowerSupport.FrequencyDroop.EU_FrequencyDroop.UnderFrequencyDroop.HysteresisControl.Fstop.Value = 2;
    $EVSE.ISO20.AC_DER_ChargeLoop_Response.CLResControlMode.DER_Dynamic_AC_CLResControlMode.DERControl.ActivePowerSupport.FrequencyDroop.EU_FrequencyDroop.UnderFrequencyDroop.HysteresisControl.PowerUpRamp = 5;
    $EVSE.ISO20.AC_DER_ChargeLoop_Response.CLResControlMode.DER_Dynamic_AC_CLResControlMode.DERControl.ActivePowerSupport.FrequencyDroop.EU_FrequencyDroop.UnderFrequencyDroop.HysteresisControl.IntentionalDelayFstop.Exponent = 2;
    $EVSE.ISO20.AC_DER_ChargeLoop_Response.CLResControlMode.DER_Dynamic_AC_CLResControlMode.DERControl.ActivePowerSupport.FrequencyDroop.EU_FrequencyDroop.UnderFrequencyDroop.HysteresisControl.IntentionalDelayFstop.Value = 2;
    
    $EVSE.ISO20.AC_DER_ChargeLoop_Response.CLResControlMode.DER_Dynamic_AC_CLResControlMode.DERControl.ActivePowerSupport.FrequencyDroop.EU_FrequencyDroop.UnderFrequencyDroop.MaxReactionTime.Exponent = 2;
    $EVSE.ISO20.AC_DER_ChargeLoop_Response.CLResControlMode.DER_Dynamic_AC_CLResControlMode.DERControl.ActivePowerSupport.FrequencyDroop.EU_FrequencyDroop.UnderFrequencyDroop.MaxReactionTime.Value = 2;
  }
  else
  {
    $EVSE.ISO20.AC_DER_ChargeLoop_Response.CLResControlMode.DER_Dynamic_AC_CLResControlMode.DERControl.ActivePowerSupport.FrequencyDroopElementId = 1;
    $EVSE.ISO20.AC_DER_ChargeLoop_Response.CLResControlMode.DER_Dynamic_AC_CLResControlMode.DERControl.ActivePowerSupport.FrequencyDroop.US_FrequencyDroop.Priority = 2;
    $EVSE.ISO20.AC_DER_ChargeLoop_Response.CLResControlMode.DER_Dynamic_AC_CLResControlMode.DERControl.ActivePowerSupport.FrequencyDroop.US_FrequencyDroop.Enable = 1;
  
    $EVSE.ISO20.AC_DER_ChargeLoop_Response.CLResControlMode.DER_Dynamic_AC_CLResControlMode.DERControl.ActivePowerSupport.FrequencyDroop.US_FrequencyDroop.OverFrequencyDroop.db.Exponent = 2;
    $EVSE.ISO20.AC_DER_ChargeLoop_Response.CLResControlMode.DER_Dynamic_AC_CLResControlMode.DERControl.ActivePowerSupport.FrequencyDroop.US_FrequencyDroop.OverFrequencyDroop.db.Value = 2;
    $EVSE.ISO20.AC_DER_ChargeLoop_Response.CLResControlMode.DER_Dynamic_AC_CLResControlMode.DERControl.ActivePowerSupport.FrequencyDroop.US_FrequencyDroop.OverFrequencyDroop.k.Exponent = 2;
    $EVSE.ISO20.AC_DER_ChargeLoop_Response.CLResControlMode.DER_Dynamic_AC_CLResControlMode.DERControl.ActivePowerSupport.FrequencyDroop.US_FrequencyDroop.OverFrequencyDroop.k.Value = 2;
    $EVSE.ISO20.AC_DER_ChargeLoop_Response.CLResControlMode.DER_Dynamic_AC_CLResControlMode.DERControl.ActivePowerSupport.FrequencyDroop.US_FrequencyDroop.OverFrequencyDroop.PowerReference = _CCS::DataTypes::PowerReferenceType::PresentActivePower;
    $EVSE.ISO20.AC_DER_ChargeLoop_Response.CLResControlMode.DER_Dynamic_AC_CLResControlMode.DERControl.ActivePowerSupport.FrequencyDroop.US_FrequencyDroop.OverFrequencyDroop.OpenLoopResponseTime.Exponent = 2;
    $EVSE.ISO20.AC_DER_ChargeLoop_Response.CLResControlMode.DER_Dynamic_AC_CLResControlMode.DERControl.ActivePowerSupport.FrequencyDroop.US_FrequencyDroop.OverFrequencyDroop.OpenLoopResponseTime.Value = 2;

    $EVSE.ISO20.AC_DER_ChargeLoop_Response.CLResControlMode.DER_Dynamic_AC_CLResControlMode.DERControl.ActivePowerSupport.FrequencyDroop.US_FrequencyDroop.UnderFrequencyDroop.db.Exponent = 2;
    $EVSE.ISO20.AC_DER_ChargeLoop_Response.CLResControlMode.DER_Dynamic_AC_CLResControlMode.DERControl.ActivePowerSupport.FrequencyDroop.US_FrequencyDroop.UnderFrequencyDroop.db.Value = 2;
    $EVSE.ISO20.AC_DER_ChargeLoop_Response.CLResControlMode.DER_Dynamic_AC_CLResControlMode.DERControl.ActivePowerSupport.FrequencyDroop.US_FrequencyDroop.UnderFrequencyDroop.k.Exponent = 2;
    $EVSE.ISO20.AC_DER_ChargeLoop_Response.CLResControlMode.DER_Dynamic_AC_CLResControlMode.DERControl.ActivePowerSupport.FrequencyDroop.US_FrequencyDroop.UnderFrequencyDroop.k.Value = 2;
    $EVSE.ISO20.AC_DER_ChargeLoop_Response.CLResControlMode.DER_Dynamic_AC_CLResControlMode.DERControl.ActivePowerSupport.FrequencyDroop.US_FrequencyDroop.UnderFrequencyDroop.PowerReference = _CCS::DataTypes::PowerReferenceType::PresentActivePower;
    $EVSE.ISO20.AC_DER_ChargeLoop_Response.CLResControlMode.DER_Dynamic_AC_CLResControlMode.DERControl.ActivePowerSupport.FrequencyDroop.US_FrequencyDroop.UnderFrequencyDroop.OpenLoopResponseTime.Exponent = 2;
    $EVSE.ISO20.AC_DER_ChargeLoop_Response.CLResControlMode.DER_Dynamic_AC_CLResControlMode.DERControl.ActivePowerSupport.FrequencyDroop.US_FrequencyDroop.UnderFrequencyDroop.OpenLoopResponseTime.Value = 2;
  }

    /* FrequencyWatt */
    $EVSE.ISO20.AC_DER_ChargeLoop_Response.CLResControlMode.DER_Dynamic_AC_CLResControlMode.DERControl.ActivePowerSupport.FrequencyWatt.Enable = 1;
    $EVSE.ISO20.AC_DER_ChargeLoop_Response.CLResControlMode.DER_Dynamic_AC_CLResControlMode.DERControl.ActivePowerSupport.FrequencyWatt.Priority = 3;
    $EVSE.ISO20.AC_DER_ChargeLoop_Response.CLResControlMode.DER_Dynamic_AC_CLResControlMode.DERControl.ActivePowerSupport.FrequencyWatt.xUnit = _CCS::DataTypes::CurveDataPointsUnitType::W;
    $EVSE.ISO20.AC_DER_ChargeLoop_Response.CLResControlMode.DER_Dynamic_AC_CLResControlMode.DERControl.ActivePowerSupport.FrequencyWatt.yUnit = _CCS::DataTypes::CurveDataPointsUnitType::W;

    $EVSE.ISO20.AC_DER_ChargeLoop_Response.CLResControlMode.DER_Dynamic_AC_CLResControlMode.DERControl.ActivePowerSupport.FrequencyWatt.CurveDataPoints.CurveDataPoint.Length = 3;
    $EVSE.ISO20.AC_DER_ChargeLoop_Response.CLResControlMode.DER_Dynamic_AC_CLResControlMode.DERControl.ActivePowerSupport.FrequencyWatt.CurveDataPoints.CurveDataPoint[0].x.Exponent = 1;
    $EVSE.ISO20.AC_DER_ChargeLoop_Response.CLResControlMode.DER_Dynamic_AC_CLResControlMode.DERControl.ActivePowerSupport.FrequencyWatt.CurveDataPoints.CurveDataPoint[0].x.Value = 2;
    $EVSE.ISO20.AC_DER_ChargeLoop_Response.CLResControlMode.DER_Dynamic_AC_CLResControlMode.DERControl.ActivePowerSupport.FrequencyWatt.CurveDataPoints.CurveDataPoint[0].y.Exponent = 1;
    $EVSE.ISO20.AC_DER_ChargeLoop_Response.CLResControlMode.DER_Dynamic_AC_CLResControlMode.DERControl.ActivePowerSupport.FrequencyWatt.CurveDataPoints.CurveDataPoint[0].y.Value = 2;
    $EVSE.ISO20.AC_DER_ChargeLoop_Response.CLResControlMode.DER_Dynamic_AC_CLResControlMode.DERControl.ActivePowerSupport.FrequencyWatt.CurveDataPoints.CurveDataPoint[1].x.Exponent = 1;
    $EVSE.ISO20.AC_DER_ChargeLoop_Response.CLResControlMode.DER_Dynamic_AC_CLResControlMode.DERControl.ActivePowerSupport.FrequencyWatt.CurveDataPoints.CurveDataPoint[1].x.Value = 2;
    $EVSE.ISO20.AC_DER_ChargeLoop_Response.CLResControlMode.DER_Dynamic_AC_CLResControlMode.DERControl.ActivePowerSupport.FrequencyWatt.CurveDataPoints.CurveDataPoint[1].y.Exponent = 1;
    $EVSE.ISO20.AC_DER_ChargeLoop_Response.CLResControlMode.DER_Dynamic_AC_CLResControlMode.DERControl.ActivePowerSupport.FrequencyWatt.CurveDataPoints.CurveDataPoint[1].y.Value = 2;
    $EVSE.ISO20.AC_DER_ChargeLoop_Response.CLResControlMode.DER_Dynamic_AC_CLResControlMode.DERControl.ActivePowerSupport.FrequencyWatt.CurveDataPoints.CurveDataPoint[2].x.Exponent = 1;
    $EVSE.ISO20.AC_DER_ChargeLoop_Response.CLResControlMode.DER_Dynamic_AC_CLResControlMode.DERControl.ActivePowerSupport.FrequencyWatt.CurveDataPoints.CurveDataPoint[2].x.Value = 2;
    $EVSE.ISO20.AC_DER_ChargeLoop_Response.CLResControlMode.DER_Dynamic_AC_CLResControlMode.DERControl.ActivePowerSupport.FrequencyWatt.CurveDataPoints.CurveDataPoint[2].y.Exponent = 1;
    $EVSE.ISO20.AC_DER_ChargeLoop_Response.CLResControlMode.DER_Dynamic_AC_CLResControlMode.DERControl.ActivePowerSupport.FrequencyWatt.CurveDataPoints.CurveDataPoint[2].y.Value = 2;
    $EVSE.ISO20.AC_DER_ChargeLoop_Response.CLResControlMode.DER_Dynamic_AC_CLResControlMode.DERControl.ActivePowerSupport.FrequencyWatt.OpenLoopResponseTime.Exponent = 2;
    $EVSE.ISO20.AC_DER_ChargeLoop_Response.CLResControlMode.DER_Dynamic_AC_CLResControlMode.DERControl.ActivePowerSupport.FrequencyWatt.OpenLoopResponseTime.Value = 2;
    $EVSE.ISO20.AC_DER_ChargeLoop_Response.CLResControlMode.DER_Dynamic_AC_CLResControlMode.DERControl.ActivePowerSupport.FrequencyWatt.HysteresisHigh.Exponent = 2;
    $EVSE.ISO20.AC_DER_ChargeLoop_Response.CLResControlMode.DER_Dynamic_AC_CLResControlMode.DERControl.ActivePowerSupport.FrequencyWatt.HysteresisHigh.Value = 2;
    $EVSE.ISO20.AC_DER_ChargeLoop_Response.CLResControlMode.DER_Dynamic_AC_CLResControlMode.DERControl.ActivePowerSupport.FrequencyWatt.HysteresisLow.Exponent = 2;
    $EVSE.ISO20.AC_DER_ChargeLoop_Response.CLResControlMode.DER_Dynamic_AC_CLResControlMode.DERControl.ActivePowerSupport.FrequencyWatt.HysteresisLow.Value = 2;
    $EVSE.ISO20.AC_DER_ChargeLoop_Response.CLResControlMode.DER_Dynamic_AC_CLResControlMode.DERControl.ActivePowerSupport.FrequencyWatt.HysteresisDelay.Exponent = 2;
    $EVSE.ISO20.AC_DER_ChargeLoop_Response.CLResControlMode.DER_Dynamic_AC_CLResControlMode.DERControl.ActivePowerSupport.FrequencyWatt.HysteresisDelay.Value = 2;
    $EVSE.ISO20.AC_DER_ChargeLoop_Response.CLResControlMode.DER_Dynamic_AC_CLResControlMode.DERControl.ActivePowerSupport.FrequencyWatt.HysteresisGradient.Exponent = 2;
    $EVSE.ISO20.AC_DER_ChargeLoop_Response.CLResControlMode.DER_Dynamic_AC_CLResControlMode.DERControl.ActivePowerSupport.FrequencyWatt.HysteresisGradient.Value = 2;

    /* VoltWatt */
    $EVSE.ISO20.AC_DER_ChargeLoop_Response.CLResControlMode.DER_Dynamic_AC_CLResControlMode.DERControl.ActivePowerSupport.VoltWatt.Enable = 1;
    $EVSE.ISO20.AC_DER_ChargeLoop_Response.CLResControlMode.DER_Dynamic_AC_CLResControlMode.DERControl.ActivePowerSupport.VoltWatt.Priority = 2;
    $EVSE.ISO20.AC_DER_ChargeLoop_Response.CLResControlMode.DER_Dynamic_AC_CLResControlMode.DERControl.ActivePowerSupport.VoltWatt.xUnit = _CCS::DataTypes::CurveDataPointsUnitType::W;
    $EVSE.ISO20.AC_DER_ChargeLoop_Response.CLResControlMode.DER_Dynamic_AC_CLResControlMode.DERControl.ActivePowerSupport.VoltWatt.yUnit = _CCS::DataTypes::CurveDataPointsUnitType::W;
    $EVSE.ISO20.AC_DER_ChargeLoop_Response.CLResControlMode.DER_Dynamic_AC_CLResControlMode.DERControl.ActivePowerSupport.VoltWatt.CurveDataPoints.CurveDataPoint.Length = 3;
    $EVSE.ISO20.AC_DER_ChargeLoop_Response.CLResControlMode.DER_Dynamic_AC_CLResControlMode.DERControl.ActivePowerSupport.VoltWatt.CurveDataPoints.CurveDataPoint[0].x.Exponent = 1;
    $EVSE.ISO20.AC_DER_ChargeLoop_Response.CLResControlMode.DER_Dynamic_AC_CLResControlMode.DERControl.ActivePowerSupport.VoltWatt.CurveDataPoints.CurveDataPoint[0].x.Value = 2;
    $EVSE.ISO20.AC_DER_ChargeLoop_Response.CLResControlMode.DER_Dynamic_AC_CLResControlMode.DERControl.ActivePowerSupport.VoltWatt.CurveDataPoints.CurveDataPoint[0].y.Exponent = 1;
    $EVSE.ISO20.AC_DER_ChargeLoop_Response.CLResControlMode.DER_Dynamic_AC_CLResControlMode.DERControl.ActivePowerSupport.VoltWatt.CurveDataPoints.CurveDataPoint[0].y.Value = 2;
    $EVSE.ISO20.AC_DER_ChargeLoop_Response.CLResControlMode.DER_Dynamic_AC_CLResControlMode.DERControl.ActivePowerSupport.VoltWatt.CurveDataPoints.CurveDataPoint[1].x.Exponent = 1;
    $EVSE.ISO20.AC_DER_ChargeLoop_Response.CLResControlMode.DER_Dynamic_AC_CLResControlMode.DERControl.ActivePowerSupport.VoltWatt.CurveDataPoints.CurveDataPoint[1].x.Value = 2;
    $EVSE.ISO20.AC_DER_ChargeLoop_Response.CLResControlMode.DER_Dynamic_AC_CLResControlMode.DERControl.ActivePowerSupport.VoltWatt.CurveDataPoints.CurveDataPoint[1].y.Exponent = 1;
    $EVSE.ISO20.AC_DER_ChargeLoop_Response.CLResControlMode.DER_Dynamic_AC_CLResControlMode.DERControl.ActivePowerSupport.VoltWatt.CurveDataPoints.CurveDataPoint[1].y.Value = 2;
    $EVSE.ISO20.AC_DER_ChargeLoop_Response.CLResControlMode.DER_Dynamic_AC_CLResControlMode.DERControl.ActivePowerSupport.VoltWatt.CurveDataPoints.CurveDataPoint[2].x.Exponent = 1;
    $EVSE.ISO20.AC_DER_ChargeLoop_Response.CLResControlMode.DER_Dynamic_AC_CLResControlMode.DERControl.ActivePowerSupport.VoltWatt.CurveDataPoints.CurveDataPoint[2].x.Value = 2;
    $EVSE.ISO20.AC_DER_ChargeLoop_Response.CLResControlMode.DER_Dynamic_AC_CLResControlMode.DERControl.ActivePowerSupport.VoltWatt.CurveDataPoints.CurveDataPoint[2].y.Exponent = 1;
    $EVSE.ISO20.AC_DER_ChargeLoop_Response.CLResControlMode.DER_Dynamic_AC_CLResControlMode.DERControl.ActivePowerSupport.VoltWatt.CurveDataPoints.CurveDataPoint[2].y.Value = 2;
    $EVSE.ISO20.AC_DER_ChargeLoop_Response.CLResControlMode.DER_Dynamic_AC_CLResControlMode.DERControl.ActivePowerSupport.VoltWatt.LockInValue = _CCS::DataTypes::LockValueUnitType::W;
    $EVSE.ISO20.AC_DER_ChargeLoop_Response.CLResControlMode.DER_Dynamic_AC_CLResControlMode.DERControl.ActivePowerSupport.VoltWatt.LockOutValue = _CCS::DataTypes::LockValueUnitType::W;
    $EVSE.ISO20.AC_DER_ChargeLoop_Response.CLResControlMode.DER_Dynamic_AC_CLResControlMode.DERControl.ActivePowerSupport.VoltWatt.OpenLoopResponseTime.Exponent = 2;
    $EVSE.ISO20.AC_DER_ChargeLoop_Response.CLResControlMode.DER_Dynamic_AC_CLResControlMode.DERControl.ActivePowerSupport.VoltWatt.OpenLoopResponseTime.Value = 1;
    $EVSE.ISO20.AC_DER_ChargeLoop_Response.CLResControlMode.DER_Dynamic_AC_CLResControlMode.DERControl.ActivePowerSupport.VoltWatt.TimeConstantPT1 = 2;
    $EVSE.ISO20.AC_DER_ChargeLoop_Response.CLResControlMode.DER_Dynamic_AC_CLResControlMode.DERControl.ActivePowerSupport.VoltWatt.IntentionalDelay.Exponent = 2;
    $EVSE.ISO20.AC_DER_ChargeLoop_Response.CLResControlMode.DER_Dynamic_AC_CLResControlMode.DERControl.ActivePowerSupport.VoltWatt.IntentionalDelay.Value = 1;

    /* LimitMaxDischargePower */
    $EVSE.ISO20.AC_DER_ChargeLoop_Response.CLResControlMode.DER_Dynamic_AC_CLResControlMode.DERControl.ActivePowerSupport.LimitMaxDischargePower.Enable = 1;
    $EVSE.ISO20.AC_DER_ChargeLoop_Response.CLResControlMode.DER_Dynamic_AC_CLResControlMode.DERControl.ActivePowerSupport.LimitMaxDischargePower.Priority = 2;
    $EVSE.ISO20.AC_DER_ChargeLoop_Response.CLResControlMode.DER_Dynamic_AC_CLResControlMode.DERControl.ActivePowerSupport.LimitMaxDischargePower.PercentageValue = 20;

      /* PowerMonitoringMustTripCurve*/
    $EVSE.ISO20.AC_DER_ChargeLoop_Response.CLResControlMode.DER_Dynamic_AC_CLResControlMode.DERControl.ActivePowerSupport.LimitMaxDischargePower.PowerMonitoringMustTripCurve.Enable = 1;
    $EVSE.ISO20.AC_DER_ChargeLoop_Response.CLResControlMode.DER_Dynamic_AC_CLResControlMode.DERControl.ActivePowerSupport.LimitMaxDischargePower.PowerMonitoringMustTripCurve.Priority = 2;
    $EVSE.ISO20.AC_DER_ChargeLoop_Response.CLResControlMode.DER_Dynamic_AC_CLResControlMode.DERControl.ActivePowerSupport.LimitMaxDischargePower.PowerMonitoringMustTripCurve.xUnit = _CCS::DataTypes::CurveDataPointsUnitType::W;
    $EVSE.ISO20.AC_DER_ChargeLoop_Response.CLResControlMode.DER_Dynamic_AC_CLResControlMode.DERControl.ActivePowerSupport.LimitMaxDischargePower.PowerMonitoringMustTripCurve.yUnit = _CCS::DataTypes::CurveDataPointsUnitType::W;
    $EVSE.ISO20.AC_DER_ChargeLoop_Response.CLResControlMode.DER_Dynamic_AC_CLResControlMode.DERControl.ActivePowerSupport.LimitMaxDischargePower.PowerMonitoringMustTripCurve.CurveDataPoints.CurveDataPoint.Length = 3;
    $EVSE.ISO20.AC_DER_ChargeLoop_Response.CLResControlMode.DER_Dynamic_AC_CLResControlMode.DERControl.ActivePowerSupport.LimitMaxDischargePower.PowerMonitoringMustTripCurve.CurveDataPoints.CurveDataPoint[0].x.Exponent = 1;
    $EVSE.ISO20.AC_DER_ChargeLoop_Response.CLResControlMode.DER_Dynamic_AC_CLResControlMode.DERControl.ActivePowerSupport.LimitMaxDischargePower.PowerMonitoringMustTripCurve.CurveDataPoints.CurveDataPoint[0].x.Value = 2;
    $EVSE.ISO20.AC_DER_ChargeLoop_Response.CLResControlMode.DER_Dynamic_AC_CLResControlMode.DERControl.ActivePowerSupport.LimitMaxDischargePower.PowerMonitoringMustTripCurve.CurveDataPoints.CurveDataPoint[0].y.Exponent = 1;
    $EVSE.ISO20.AC_DER_ChargeLoop_Response.CLResControlMode.DER_Dynamic_AC_CLResControlMode.DERControl.ActivePowerSupport.LimitMaxDischargePower.PowerMonitoringMustTripCurve.CurveDataPoints.CurveDataPoint[0].y.Value = 2;
    $EVSE.ISO20.AC_DER_ChargeLoop_Response.CLResControlMode.DER_Dynamic_AC_CLResControlMode.DERControl.ActivePowerSupport.LimitMaxDischargePower.PowerMonitoringMustTripCurve.CurveDataPoints.CurveDataPoint[1].x.Exponent = 1;
    $EVSE.ISO20.AC_DER_ChargeLoop_Response.CLResControlMode.DER_Dynamic_AC_CLResControlMode.DERControl.ActivePowerSupport.LimitMaxDischargePower.PowerMonitoringMustTripCurve.CurveDataPoints.CurveDataPoint[1].x.Value = 2;
    $EVSE.ISO20.AC_DER_ChargeLoop_Response.CLResControlMode.DER_Dynamic_AC_CLResControlMode.DERControl.ActivePowerSupport.LimitMaxDischargePower.PowerMonitoringMustTripCurve.CurveDataPoints.CurveDataPoint[1].y.Exponent = 1;
    $EVSE.ISO20.AC_DER_ChargeLoop_Response.CLResControlMode.DER_Dynamic_AC_CLResControlMode.DERControl.ActivePowerSupport.LimitMaxDischargePower.PowerMonitoringMustTripCurve.CurveDataPoints.CurveDataPoint[1].y.Value = 2;
    $EVSE.ISO20.AC_DER_ChargeLoop_Response.CLResControlMode.DER_Dynamic_AC_CLResControlMode.DERControl.ActivePowerSupport.LimitMaxDischargePower.PowerMonitoringMustTripCurve.CurveDataPoints.CurveDataPoint[2].x.Exponent = 1;
    $EVSE.ISO20.AC_DER_ChargeLoop_Response.CLResControlMode.DER_Dynamic_AC_CLResControlMode.DERControl.ActivePowerSupport.LimitMaxDischargePower.PowerMonitoringMustTripCurve.CurveDataPoints.CurveDataPoint[2].x.Value = 2;
    $EVSE.ISO20.AC_DER_ChargeLoop_Response.CLResControlMode.DER_Dynamic_AC_CLResControlMode.DERControl.ActivePowerSupport.LimitMaxDischargePower.PowerMonitoringMustTripCurve.CurveDataPoints.CurveDataPoint[2].y.Exponent = 1;
    $EVSE.ISO20.AC_DER_ChargeLoop_Response.CLResControlMode.DER_Dynamic_AC_CLResControlMode.DERControl.ActivePowerSupport.LimitMaxDischargePower.PowerMonitoringMustTripCurve.CurveDataPoints.CurveDataPoint[2].y.Value = 2;
    $EVSE.ISO20.AC_DER_ChargeLoop_Response.CLResControlMode.DER_Dynamic_AC_CLResControlMode.DERControl.ActivePowerSupport.LimitMaxDischargePower.PowerMonitoringMustTripCurve.LockInValue = _CCS::DataTypes::LockValueUnitType::W;
    $EVSE.ISO20.AC_DER_ChargeLoop_Response.CLResControlMode.DER_Dynamic_AC_CLResControlMode.DERControl.ActivePowerSupport.LimitMaxDischargePower.PowerMonitoringMustTripCurve.LockOutValue = _CCS::DataTypes::LockValueUnitType::W;
    $EVSE.ISO20.AC_DER_ChargeLoop_Response.CLResControlMode.DER_Dynamic_AC_CLResControlMode.DERControl.ActivePowerSupport.LimitMaxDischargePower.PowerMonitoringMustTripCurve.OpenLoopResponseTime.Exponent = 2;
    $EVSE.ISO20.AC_DER_ChargeLoop_Response.CLResControlMode.DER_Dynamic_AC_CLResControlMode.DERControl.ActivePowerSupport.LimitMaxDischargePower.PowerMonitoringMustTripCurve.OpenLoopResponseTime.Value = 1;
    $EVSE.ISO20.AC_DER_ChargeLoop_Response.CLResControlMode.DER_Dynamic_AC_CLResControlMode.DERControl.ActivePowerSupport.LimitMaxDischargePower.PowerMonitoringMustTripCurve.TimeConstantPT1 = 2;
    $EVSE.ISO20.AC_DER_ChargeLoop_Response.CLResControlMode.DER_Dynamic_AC_CLResControlMode.DERControl.ActivePowerSupport.LimitMaxDischargePower.PowerMonitoringMustTripCurve.IntentionalDelay.Exponent = 2;
    $EVSE.ISO20.AC_DER_ChargeLoop_Response.CLResControlMode.DER_Dynamic_AC_CLResControlMode.DERControl.ActivePowerSupport.LimitMaxDischargePower.PowerMonitoringMustTripCurve.IntentionalDelay.Value = 1;
    
    $EVSE.ISO20.AC_DER_ChargeLoop_Response.CLResControlMode.DER_Dynamic_AC_CLResControlMode.DERControl.MaximumLevel1DCInjection.Value = 1;
    $EVSE.ISO20.AC_DER_ChargeLoop_Response.CLResControlMode.DER_Dynamic_AC_CLResControlMode.DERControl.MaximumLevel1DCInjection.Exponent = 1;
    $EVSE.ISO20.AC_DER_ChargeLoop_Response.CLResControlMode.DER_Dynamic_AC_CLResControlMode.DERControl.MaximumLevel2DCInjection.Value = 1;
    $EVSE.ISO20.AC_DER_ChargeLoop_Response.CLResControlMode.DER_Dynamic_AC_CLResControlMode.DERControl.MaximumLevel2DCInjection.Exponent = 1;
    $EVSE.ISO20.AC_DER_ChargeLoop_Response.CLResControlMode.DER_Dynamic_AC_CLResControlMode.DERControl.SCRatPOC.Value = 1;
    $EVSE.ISO20.AC_DER_ChargeLoop_Response.CLResControlMode.DER_Dynamic_AC_CLResControlMode.DERControl.SCRatPOC.Exponent = 1;
    
    $EVSE.ISO20.AC_DER_ChargeLoop_Response.CLResControlMode.DER_Scheduled_AC_CLResControlMode.EVSETargetActivePower.Value = @sysvar::EVSE_Sim::SysEVSE_PresentPower;
    $EVSE.ISO20.AC_DER_ChargeLoop_Response.CLResControlMode.DER_Scheduled_AC_CLResControlMode.EVSETargetActivePower.Exponent = 0; 
    $EVSE.ISO20.AC_DER_ChargeLoop_Response.CLResControlMode.DER_Scheduled_AC_CLResControlMode.EVSETargetActivePower_L2.Value = @sysvar::EVSE_Sim::SysEVSE_PresentPower_L2;
    $EVSE.ISO20.AC_DER_ChargeLoop_Response.CLResControlMode.DER_Scheduled_AC_CLResControlMode.EVSETargetActivePower_L2.Exponent = 0;
    $EVSE.ISO20.AC_DER_ChargeLoop_Response.CLResControlMode.DER_Scheduled_AC_CLResControlMode.EVSETargetActivePower_L3.Value = @sysvar::EVSE_Sim::SysEVSE_PresentPower_L3;
    $EVSE.ISO20.AC_DER_ChargeLoop_Response.CLResControlMode.DER_Scheduled_AC_CLResControlMode.EVSETargetActivePower_L3.Exponent = 0;
    $EVSE.ISO20.AC_DER_ChargeLoop_Response.CLResControlMode.DER_Scheduled_AC_CLResControlMode.EVSETargetReactivePower.Exponent = 0;
    $EVSE.ISO20.AC_DER_ChargeLoop_Response.CLResControlMode.DER_Scheduled_AC_CLResControlMode.EVSETargetReactivePower.Value = @sysvar::EVSE_Sim::SysEVSE_PresentPower;
    $EVSE.ISO20.AC_DER_ChargeLoop_Response.CLResControlMode.DER_Scheduled_AC_CLResControlMode.EVSETargetReactivePower.Exponent = 0; 
    $EVSE.ISO20.AC_DER_ChargeLoop_Response.CLResControlMode.DER_Scheduled_AC_CLResControlMode.EVSETargetReactivePower_L2.Value = @sysvar::EVSE_Sim::SysEVSE_PresentPower_L2;
    $EVSE.ISO20.AC_DER_ChargeLoop_Response.CLResControlMode.DER_Scheduled_AC_CLResControlMode.EVSETargetReactivePower_L2.Exponent = 0;
    $EVSE.ISO20.AC_DER_ChargeLoop_Response.CLResControlMode.DER_Scheduled_AC_CLResControlMode.EVSETargetReactivePower_L3.Value = @sysvar::EVSE_Sim::SysEVSE_PresentPower_L3;
    $EVSE.ISO20.AC_DER_ChargeLoop_Response.CLResControlMode.DER_Scheduled_AC_CLResControlMode.EVSETargetReactivePower_L3.Exponent = 0;
    $EVSE.ISO20.AC_DER_ChargeLoop_Response.CLResControlMode.DER_Scheduled_AC_CLResControlMode.EVSEPresentActivePower.Value = @sysvar::EVSE_Sim::SysEVSE_PresentPower;
    $EVSE.ISO20.AC_DER_ChargeLoop_Response.CLResControlMode.DER_Scheduled_AC_CLResControlMode.EVSEPresentActivePower.Exponent = 0; 
    $EVSE.ISO20.AC_DER_ChargeLoop_Response.CLResControlMode.DER_Scheduled_AC_CLResControlMode.EVSEPresentActivePower_L2.Value = @sysvar::EVSE_Sim::SysEVSE_PresentPower_L2;
    $EVSE.ISO20.AC_DER_ChargeLoop_Response.CLResControlMode.DER_Scheduled_AC_CLResControlMode.EVSEPresentActivePower_L2.Exponent = 0;
    $EVSE.ISO20.AC_DER_ChargeLoop_Response.CLResControlMode.DER_Scheduled_AC_CLResControlMode.EVSEPresentActivePower_L3.Value = @sysvar::EVSE_Sim::SysEVSE_PresentPower_L3;
    $EVSE.ISO20.AC_DER_ChargeLoop_Response.CLResControlMode.DER_Scheduled_AC_CLResControlMode.EVSEPresentActivePower_L3.Exponent = 0;
    /* DERControl */
    /* VoltageTrip */
    $EVSE.ISO20.AC_DER_ChargeLoop_Response.CLResControlMode.DER_Scheduled_AC_CLResControlMode.DERControl.VoltageTrip.OverVoltageMustTripCurve.Enable = 1;
    $EVSE.ISO20.AC_DER_ChargeLoop_Response.CLResControlMode.DER_Scheduled_AC_CLResControlMode.DERControl.VoltageTrip.OverVoltageMustTripCurve.Priority = 2;
    $EVSE.ISO20.AC_DER_ChargeLoop_Response.CLResControlMode.DER_Scheduled_AC_CLResControlMode.DERControl.VoltageTrip.OverVoltageMustTripCurve.xUnit = _CCS::DataTypes::CurveDataPointsUnitType::W;
    $EVSE.ISO20.AC_DER_ChargeLoop_Response.CLResControlMode.DER_Scheduled_AC_CLResControlMode.DERControl.VoltageTrip.OverVoltageMustTripCurve.yUnit = _CCS::DataTypes::CurveDataPointsUnitType::W;
    $EVSE.ISO20.AC_DER_ChargeLoop_Response.CLResControlMode.DER_Scheduled_AC_CLResControlMode.DERControl.VoltageTrip.OverVoltageMustTripCurve.CurveDataPoints.CurveDataPoint.Length = 3;
    $EVSE.ISO20.AC_DER_ChargeLoop_Response.CLResControlMode.DER_Scheduled_AC_CLResControlMode.DERControl.VoltageTrip.OverVoltageMustTripCurve.CurveDataPoints.CurveDataPoint[0].x.Exponent = 1;
    $EVSE.ISO20.AC_DER_ChargeLoop_Response.CLResControlMode.DER_Scheduled_AC_CLResControlMode.DERControl.VoltageTrip.OverVoltageMustTripCurve.CurveDataPoints.CurveDataPoint[0].x.Value = 2;
    $EVSE.ISO20.AC_DER_ChargeLoop_Response.CLResControlMode.DER_Scheduled_AC_CLResControlMode.DERControl.VoltageTrip.OverVoltageMustTripCurve.CurveDataPoints.CurveDataPoint[0].y.Exponent = 1;
    $EVSE.ISO20.AC_DER_ChargeLoop_Response.CLResControlMode.DER_Scheduled_AC_CLResControlMode.DERControl.VoltageTrip.OverVoltageMustTripCurve.CurveDataPoints.CurveDataPoint[0].y.Value = 2;
    $EVSE.ISO20.AC_DER_ChargeLoop_Response.CLResControlMode.DER_Scheduled_AC_CLResControlMode.DERControl.VoltageTrip.OverVoltageMustTripCurve.CurveDataPoints.CurveDataPoint[1].x.Exponent = 1;
    $EVSE.ISO20.AC_DER_ChargeLoop_Response.CLResControlMode.DER_Scheduled_AC_CLResControlMode.DERControl.VoltageTrip.OverVoltageMustTripCurve.CurveDataPoints.CurveDataPoint[1].x.Value = 2;
    $EVSE.ISO20.AC_DER_ChargeLoop_Response.CLResControlMode.DER_Scheduled_AC_CLResControlMode.DERControl.VoltageTrip.OverVoltageMustTripCurve.CurveDataPoints.CurveDataPoint[1].y.Exponent = 1;
    $EVSE.ISO20.AC_DER_ChargeLoop_Response.CLResControlMode.DER_Scheduled_AC_CLResControlMode.DERControl.VoltageTrip.OverVoltageMustTripCurve.CurveDataPoints.CurveDataPoint[1].y.Value = 2;
    $EVSE.ISO20.AC_DER_ChargeLoop_Response.CLResControlMode.DER_Scheduled_AC_CLResControlMode.DERControl.VoltageTrip.OverVoltageMustTripCurve.CurveDataPoints.CurveDataPoint[2].x.Exponent = 1;
    $EVSE.ISO20.AC_DER_ChargeLoop_Response.CLResControlMode.DER_Scheduled_AC_CLResControlMode.DERControl.VoltageTrip.OverVoltageMustTripCurve.CurveDataPoints.CurveDataPoint[2].x.Value = 2;
    $EVSE.ISO20.AC_DER_ChargeLoop_Response.CLResControlMode.DER_Scheduled_AC_CLResControlMode.DERControl.VoltageTrip.OverVoltageMustTripCurve.CurveDataPoints.CurveDataPoint[2].y.Exponent = 1;
    $EVSE.ISO20.AC_DER_ChargeLoop_Response.CLResControlMode.DER_Scheduled_AC_CLResControlMode.DERControl.VoltageTrip.OverVoltageMustTripCurve.CurveDataPoints.CurveDataPoint[2].y.Value = 2;
    $EVSE.ISO20.AC_DER_ChargeLoop_Response.CLResControlMode.DER_Scheduled_AC_CLResControlMode.DERControl.VoltageTrip.OverVoltageMustTripCurve.LockInValue = _CCS::DataTypes::LockValueUnitType::W;
    $EVSE.ISO20.AC_DER_ChargeLoop_Response.CLResControlMode.DER_Scheduled_AC_CLResControlMode.DERControl.VoltageTrip.OverVoltageMustTripCurve.LockOutValue = _CCS::DataTypes::LockValueUnitType::W;
    $EVSE.ISO20.AC_DER_ChargeLoop_Response.CLResControlMode.DER_Scheduled_AC_CLResControlMode.DERControl.VoltageTrip.OverVoltageMustTripCurve.OpenLoopResponseTime.Exponent = 2;
    $EVSE.ISO20.AC_DER_ChargeLoop_Response.CLResControlMode.DER_Scheduled_AC_CLResControlMode.DERControl.VoltageTrip.OverVoltageMustTripCurve.OpenLoopResponseTime.Value = 1;
    $EVSE.ISO20.AC_DER_ChargeLoop_Response.CLResControlMode.DER_Scheduled_AC_CLResControlMode.DERControl.VoltageTrip.OverVoltageMustTripCurve.TimeConstantPT1 = 2;
    $EVSE.ISO20.AC_DER_ChargeLoop_Response.CLResControlMode.DER_Scheduled_AC_CLResControlMode.DERControl.VoltageTrip.OverVoltageMustTripCurve.IntentionalDelay.Exponent = 2;
    $EVSE.ISO20.AC_DER_ChargeLoop_Response.CLResControlMode.DER_Scheduled_AC_CLResControlMode.DERControl.VoltageTrip.OverVoltageMustTripCurve.IntentionalDelay.Value = 1;
  
    $EVSE.ISO20.AC_DER_ChargeLoop_Response.CLResControlMode.DER_Scheduled_AC_CLResControlMode.DERControl.VoltageTrip.UnderVoltageMustTripCurve.Enable = 1;
    $EVSE.ISO20.AC_DER_ChargeLoop_Response.CLResControlMode.DER_Scheduled_AC_CLResControlMode.DERControl.VoltageTrip.UnderVoltageMustTripCurve.Priority = 2;
    $EVSE.ISO20.AC_DER_ChargeLoop_Response.CLResControlMode.DER_Scheduled_AC_CLResControlMode.DERControl.VoltageTrip.UnderVoltageMustTripCurve.xUnit = _CCS::DataTypes::CurveDataPointsUnitType::W;
    $EVSE.ISO20.AC_DER_ChargeLoop_Response.CLResControlMode.DER_Scheduled_AC_CLResControlMode.DERControl.VoltageTrip.UnderVoltageMustTripCurve.yUnit = _CCS::DataTypes::CurveDataPointsUnitType::W;
    $EVSE.ISO20.AC_DER_ChargeLoop_Response.CLResControlMode.DER_Scheduled_AC_CLResControlMode.DERControl.VoltageTrip.UnderVoltageMustTripCurve.CurveDataPoints.CurveDataPoint.Length = 3;
    $EVSE.ISO20.AC_DER_ChargeLoop_Response.CLResControlMode.DER_Scheduled_AC_CLResControlMode.DERControl.VoltageTrip.UnderVoltageMustTripCurve.CurveDataPoints.CurveDataPoint[0].x.Exponent = 1;
    $EVSE.ISO20.AC_DER_ChargeLoop_Response.CLResControlMode.DER_Scheduled_AC_CLResControlMode.DERControl.VoltageTrip.UnderVoltageMustTripCurve.CurveDataPoints.CurveDataPoint[0].x.Value = 2;
    $EVSE.ISO20.AC_DER_ChargeLoop_Response.CLResControlMode.DER_Scheduled_AC_CLResControlMode.DERControl.VoltageTrip.UnderVoltageMustTripCurve.CurveDataPoints.CurveDataPoint[0].y.Exponent = 1;
    $EVSE.ISO20.AC_DER_ChargeLoop_Response.CLResControlMode.DER_Scheduled_AC_CLResControlMode.DERControl.VoltageTrip.UnderVoltageMustTripCurve.CurveDataPoints.CurveDataPoint[0].y.Value = 2;
    $EVSE.ISO20.AC_DER_ChargeLoop_Response.CLResControlMode.DER_Scheduled_AC_CLResControlMode.DERControl.VoltageTrip.UnderVoltageMustTripCurve.CurveDataPoints.CurveDataPoint[1].x.Exponent = 1;
    $EVSE.ISO20.AC_DER_ChargeLoop_Response.CLResControlMode.DER_Scheduled_AC_CLResControlMode.DERControl.VoltageTrip.UnderVoltageMustTripCurve.CurveDataPoints.CurveDataPoint[1].x.Value = 2;
    $EVSE.ISO20.AC_DER_ChargeLoop_Response.CLResControlMode.DER_Scheduled_AC_CLResControlMode.DERControl.VoltageTrip.UnderVoltageMustTripCurve.CurveDataPoints.CurveDataPoint[1].y.Exponent = 1;
    $EVSE.ISO20.AC_DER_ChargeLoop_Response.CLResControlMode.DER_Scheduled_AC_CLResControlMode.DERControl.VoltageTrip.UnderVoltageMustTripCurve.CurveDataPoints.CurveDataPoint[1].y.Value = 2;
    $EVSE.ISO20.AC_DER_ChargeLoop_Response.CLResControlMode.DER_Scheduled_AC_CLResControlMode.DERControl.VoltageTrip.UnderVoltageMustTripCurve.CurveDataPoints.CurveDataPoint[2].x.Exponent = 1;
    $EVSE.ISO20.AC_DER_ChargeLoop_Response.CLResControlMode.DER_Scheduled_AC_CLResControlMode.DERControl.VoltageTrip.UnderVoltageMustTripCurve.CurveDataPoints.CurveDataPoint[2].x.Value = 2;
    $EVSE.ISO20.AC_DER_ChargeLoop_Response.CLResControlMode.DER_Scheduled_AC_CLResControlMode.DERControl.VoltageTrip.UnderVoltageMustTripCurve.CurveDataPoints.CurveDataPoint[2].y.Exponent = 1;
    $EVSE.ISO20.AC_DER_ChargeLoop_Response.CLResControlMode.DER_Scheduled_AC_CLResControlMode.DERControl.VoltageTrip.UnderVoltageMustTripCurve.CurveDataPoints.CurveDataPoint[2].y.Value = 2;
    $EVSE.ISO20.AC_DER_ChargeLoop_Response.CLResControlMode.DER_Scheduled_AC_CLResControlMode.DERControl.VoltageTrip.UnderVoltageMustTripCurve.LockInValue = _CCS::DataTypes::LockValueUnitType::W;
    $EVSE.ISO20.AC_DER_ChargeLoop_Response.CLResControlMode.DER_Scheduled_AC_CLResControlMode.DERControl.VoltageTrip.UnderVoltageMustTripCurve.LockOutValue = _CCS::DataTypes::LockValueUnitType::W;
    $EVSE.ISO20.AC_DER_ChargeLoop_Response.CLResControlMode.DER_Scheduled_AC_CLResControlMode.DERControl.VoltageTrip.UnderVoltageMustTripCurve.OpenLoopResponseTime.Exponent = 2;
    $EVSE.ISO20.AC_DER_ChargeLoop_Response.CLResControlMode.DER_Scheduled_AC_CLResControlMode.DERControl.VoltageTrip.UnderVoltageMustTripCurve.OpenLoopResponseTime.Value = 1;
    $EVSE.ISO20.AC_DER_ChargeLoop_Response.CLResControlMode.DER_Scheduled_AC_CLResControlMode.DERControl.VoltageTrip.UnderVoltageMustTripCurve.TimeConstantPT1 = 2;
    $EVSE.ISO20.AC_DER_ChargeLoop_Response.CLResControlMode.DER_Scheduled_AC_CLResControlMode.DERControl.VoltageTrip.UnderVoltageMustTripCurve.IntentionalDelay.Exponent = 2;
    $EVSE.ISO20.AC_DER_ChargeLoop_Response.CLResControlMode.DER_Scheduled_AC_CLResControlMode.DERControl.VoltageTrip.UnderVoltageMustTripCurve.IntentionalDelay.Value = 1;

    $EVSE.ISO20.AC_DER_ChargeLoop_Response.CLResControlMode.DER_Scheduled_AC_CLResControlMode.DERControl.VoltageTrip.OverVoltageMomentaryCessationTripCurve.Enable = 1;
    $EVSE.ISO20.AC_DER_ChargeLoop_Response.CLResControlMode.DER_Scheduled_AC_CLResControlMode.DERControl.VoltageTrip.OverVoltageMomentaryCessationTripCurve.Priority = 2;
    $EVSE.ISO20.AC_DER_ChargeLoop_Response.CLResControlMode.DER_Scheduled_AC_CLResControlMode.DERControl.VoltageTrip.OverVoltageMomentaryCessationTripCurve.xUnit = _CCS::DataTypes::CurveDataPointsUnitType::W;
    $EVSE.ISO20.AC_DER_ChargeLoop_Response.CLResControlMode.DER_Scheduled_AC_CLResControlMode.DERControl.VoltageTrip.OverVoltageMomentaryCessationTripCurve.yUnit = _CCS::DataTypes::CurveDataPointsUnitType::W;
    $EVSE.ISO20.AC_DER_ChargeLoop_Response.CLResControlMode.DER_Scheduled_AC_CLResControlMode.DERControl.VoltageTrip.OverVoltageMomentaryCessationTripCurve.CurveDataPoints.CurveDataPoint.Length = 3;
    $EVSE.ISO20.AC_DER_ChargeLoop_Response.CLResControlMode.DER_Scheduled_AC_CLResControlMode.DERControl.VoltageTrip.OverVoltageMomentaryCessationTripCurve.CurveDataPoints.CurveDataPoint[0].x.Exponent = 1;
    $EVSE.ISO20.AC_DER_ChargeLoop_Response.CLResControlMode.DER_Scheduled_AC_CLResControlMode.DERControl.VoltageTrip.OverVoltageMomentaryCessationTripCurve.CurveDataPoints.CurveDataPoint[0].x.Value = 2;
    $EVSE.ISO20.AC_DER_ChargeLoop_Response.CLResControlMode.DER_Scheduled_AC_CLResControlMode.DERControl.VoltageTrip.OverVoltageMomentaryCessationTripCurve.CurveDataPoints.CurveDataPoint[0].y.Exponent = 1;
    $EVSE.ISO20.AC_DER_ChargeLoop_Response.CLResControlMode.DER_Scheduled_AC_CLResControlMode.DERControl.VoltageTrip.OverVoltageMomentaryCessationTripCurve.CurveDataPoints.CurveDataPoint[0].y.Value = 2;
    $EVSE.ISO20.AC_DER_ChargeLoop_Response.CLResControlMode.DER_Scheduled_AC_CLResControlMode.DERControl.VoltageTrip.OverVoltageMomentaryCessationTripCurve.CurveDataPoints.CurveDataPoint[1].x.Exponent = 1;
    $EVSE.ISO20.AC_DER_ChargeLoop_Response.CLResControlMode.DER_Scheduled_AC_CLResControlMode.DERControl.VoltageTrip.OverVoltageMomentaryCessationTripCurve.CurveDataPoints.CurveDataPoint[1].x.Value = 2;
    $EVSE.ISO20.AC_DER_ChargeLoop_Response.CLResControlMode.DER_Scheduled_AC_CLResControlMode.DERControl.VoltageTrip.OverVoltageMomentaryCessationTripCurve.CurveDataPoints.CurveDataPoint[1].y.Exponent = 1;
    $EVSE.ISO20.AC_DER_ChargeLoop_Response.CLResControlMode.DER_Scheduled_AC_CLResControlMode.DERControl.VoltageTrip.OverVoltageMomentaryCessationTripCurve.CurveDataPoints.CurveDataPoint[1].y.Value = 2;
    $EVSE.ISO20.AC_DER_ChargeLoop_Response.CLResControlMode.DER_Scheduled_AC_CLResControlMode.DERControl.VoltageTrip.OverVoltageMomentaryCessationTripCurve.CurveDataPoints.CurveDataPoint[2].x.Exponent = 1;
    $EVSE.ISO20.AC_DER_ChargeLoop_Response.CLResControlMode.DER_Scheduled_AC_CLResControlMode.DERControl.VoltageTrip.OverVoltageMomentaryCessationTripCurve.CurveDataPoints.CurveDataPoint[2].x.Value = 2;
    $EVSE.ISO20.AC_DER_ChargeLoop_Response.CLResControlMode.DER_Scheduled_AC_CLResControlMode.DERControl.VoltageTrip.OverVoltageMomentaryCessationTripCurve.CurveDataPoints.CurveDataPoint[2].y.Exponent = 1;
    $EVSE.ISO20.AC_DER_ChargeLoop_Response.CLResControlMode.DER_Scheduled_AC_CLResControlMode.DERControl.VoltageTrip.OverVoltageMomentaryCessationTripCurve.CurveDataPoints.CurveDataPoint[2].y.Value = 2;
    $EVSE.ISO20.AC_DER_ChargeLoop_Response.CLResControlMode.DER_Scheduled_AC_CLResControlMode.DERControl.VoltageTrip.OverVoltageMomentaryCessationTripCurve.LockInValue = _CCS::DataTypes::LockValueUnitType::W;
    $EVSE.ISO20.AC_DER_ChargeLoop_Response.CLResControlMode.DER_Scheduled_AC_CLResControlMode.DERControl.VoltageTrip.OverVoltageMomentaryCessationTripCurve.LockOutValue = _CCS::DataTypes::LockValueUnitType::W;
    $EVSE.ISO20.AC_DER_ChargeLoop_Response.CLResControlMode.DER_Scheduled_AC_CLResControlMode.DERControl.VoltageTrip.OverVoltageMomentaryCessationTripCurve.OpenLoopResponseTime.Exponent = 2;
    $EVSE.ISO20.AC_DER_ChargeLoop_Response.CLResControlMode.DER_Scheduled_AC_CLResControlMode.DERControl.VoltageTrip.OverVoltageMomentaryCessationTripCurve.OpenLoopResponseTime.Value = 1;
    $EVSE.ISO20.AC_DER_ChargeLoop_Response.CLResControlMode.DER_Scheduled_AC_CLResControlMode.DERControl.VoltageTrip.OverVoltageMomentaryCessationTripCurve.TimeConstantPT1 = 2;
    $EVSE.ISO20.AC_DER_ChargeLoop_Response.CLResControlMode.DER_Scheduled_AC_CLResControlMode.DERControl.VoltageTrip.OverVoltageMomentaryCessationTripCurve.IntentionalDelay.Exponent = 2;
    $EVSE.ISO20.AC_DER_ChargeLoop_Response.CLResControlMode.DER_Scheduled_AC_CLResControlMode.DERControl.VoltageTrip.OverVoltageMomentaryCessationTripCurve.IntentionalDelay.Value = 1;

    $EVSE.ISO20.AC_DER_ChargeLoop_Response.CLResControlMode.DER_Scheduled_AC_CLResControlMode.DERControl.VoltageTrip.UnderVoltageMomentaryCessationTripCurve.Enable = 1;
    $EVSE.ISO20.AC_DER_ChargeLoop_Response.CLResControlMode.DER_Scheduled_AC_CLResControlMode.DERControl.VoltageTrip.UnderVoltageMomentaryCessationTripCurve.Priority = 2;
    $EVSE.ISO20.AC_DER_ChargeLoop_Response.CLResControlMode.DER_Scheduled_AC_CLResControlMode.DERControl.VoltageTrip.UnderVoltageMomentaryCessationTripCurve.xUnit = _CCS::DataTypes::CurveDataPointsUnitType::W;
    $EVSE.ISO20.AC_DER_ChargeLoop_Response.CLResControlMode.DER_Scheduled_AC_CLResControlMode.DERControl.VoltageTrip.UnderVoltageMomentaryCessationTripCurve.yUnit = _CCS::DataTypes::CurveDataPointsUnitType::W;
    $EVSE.ISO20.AC_DER_ChargeLoop_Response.CLResControlMode.DER_Scheduled_AC_CLResControlMode.DERControl.VoltageTrip.UnderVoltageMomentaryCessationTripCurve.CurveDataPoints.CurveDataPoint.Length = 3;
    $EVSE.ISO20.AC_DER_ChargeLoop_Response.CLResControlMode.DER_Scheduled_AC_CLResControlMode.DERControl.VoltageTrip.UnderVoltageMomentaryCessationTripCurve.CurveDataPoints.CurveDataPoint[0].x.Exponent = 1;
    $EVSE.ISO20.AC_DER_ChargeLoop_Response.CLResControlMode.DER_Scheduled_AC_CLResControlMode.DERControl.VoltageTrip.UnderVoltageMomentaryCessationTripCurve.CurveDataPoints.CurveDataPoint[0].x.Value = 2;
    $EVSE.ISO20.AC_DER_ChargeLoop_Response.CLResControlMode.DER_Scheduled_AC_CLResControlMode.DERControl.VoltageTrip.UnderVoltageMomentaryCessationTripCurve.CurveDataPoints.CurveDataPoint[0].y.Exponent = 1;
    $EVSE.ISO20.AC_DER_ChargeLoop_Response.CLResControlMode.DER_Scheduled_AC_CLResControlMode.DERControl.VoltageTrip.UnderVoltageMomentaryCessationTripCurve.CurveDataPoints.CurveDataPoint[0].y.Value = 2;
    $EVSE.ISO20.AC_DER_ChargeLoop_Response.CLResControlMode.DER_Scheduled_AC_CLResControlMode.DERControl.VoltageTrip.UnderVoltageMomentaryCessationTripCurve.CurveDataPoints.CurveDataPoint[1].x.Exponent = 1;
    $EVSE.ISO20.AC_DER_ChargeLoop_Response.CLResControlMode.DER_Scheduled_AC_CLResControlMode.DERControl.VoltageTrip.UnderVoltageMomentaryCessationTripCurve.CurveDataPoints.CurveDataPoint[1].x.Value = 2;
    $EVSE.ISO20.AC_DER_ChargeLoop_Response.CLResControlMode.DER_Scheduled_AC_CLResControlMode.DERControl.VoltageTrip.UnderVoltageMomentaryCessationTripCurve.CurveDataPoints.CurveDataPoint[1].y.Exponent = 1;
    $EVSE.ISO20.AC_DER_ChargeLoop_Response.CLResControlMode.DER_Scheduled_AC_CLResControlMode.DERControl.VoltageTrip.UnderVoltageMomentaryCessationTripCurve.CurveDataPoints.CurveDataPoint[1].y.Value = 2;
    $EVSE.ISO20.AC_DER_ChargeLoop_Response.CLResControlMode.DER_Scheduled_AC_CLResControlMode.DERControl.VoltageTrip.UnderVoltageMomentaryCessationTripCurve.CurveDataPoints.CurveDataPoint[2].x.Exponent = 1;
    $EVSE.ISO20.AC_DER_ChargeLoop_Response.CLResControlMode.DER_Scheduled_AC_CLResControlMode.DERControl.VoltageTrip.UnderVoltageMomentaryCessationTripCurve.CurveDataPoints.CurveDataPoint[2].x.Value = 2;
    $EVSE.ISO20.AC_DER_ChargeLoop_Response.CLResControlMode.DER_Scheduled_AC_CLResControlMode.DERControl.VoltageTrip.UnderVoltageMomentaryCessationTripCurve.CurveDataPoints.CurveDataPoint[2].y.Exponent = 1;
    $EVSE.ISO20.AC_DER_ChargeLoop_Response.CLResControlMode.DER_Scheduled_AC_CLResControlMode.DERControl.VoltageTrip.UnderVoltageMomentaryCessationTripCurve.CurveDataPoints.CurveDataPoint[2].y.Value = 2;
    $EVSE.ISO20.AC_DER_ChargeLoop_Response.CLResControlMode.DER_Scheduled_AC_CLResControlMode.DERControl.VoltageTrip.UnderVoltageMomentaryCessationTripCurve.LockInValue = _CCS::DataTypes::LockValueUnitType::W;
    $EVSE.ISO20.AC_DER_ChargeLoop_Response.CLResControlMode.DER_Scheduled_AC_CLResControlMode.DERControl.VoltageTrip.UnderVoltageMomentaryCessationTripCurve.LockOutValue = _CCS::DataTypes::LockValueUnitType::W;
    $EVSE.ISO20.AC_DER_ChargeLoop_Response.CLResControlMode.DER_Scheduled_AC_CLResControlMode.DERControl.VoltageTrip.UnderVoltageMomentaryCessationTripCurve.OpenLoopResponseTime.Exponent = 2;
    $EVSE.ISO20.AC_DER_ChargeLoop_Response.CLResControlMode.DER_Scheduled_AC_CLResControlMode.DERControl.VoltageTrip.UnderVoltageMomentaryCessationTripCurve.OpenLoopResponseTime.Value = 1;
    $EVSE.ISO20.AC_DER_ChargeLoop_Response.CLResControlMode.DER_Scheduled_AC_CLResControlMode.DERControl.VoltageTrip.UnderVoltageMomentaryCessationTripCurve.TimeConstantPT1 = 2;
    $EVSE.ISO20.AC_DER_ChargeLoop_Response.CLResControlMode.DER_Scheduled_AC_CLResControlMode.DERControl.VoltageTrip.UnderVoltageMomentaryCessationTripCurve.IntentionalDelay.Exponent = 2;
    $EVSE.ISO20.AC_DER_ChargeLoop_Response.CLResControlMode.DER_Scheduled_AC_CLResControlMode.DERControl.VoltageTrip.UnderVoltageMomentaryCessationTripCurve.IntentionalDelay.Value = 1;

    $EVSE.ISO20.AC_DER_ChargeLoop_Response.CLResControlMode.DER_Scheduled_AC_CLResControlMode.DERControl.VoltageTrip.OverVoltageMayTripCurve.Enable = 1;
    $EVSE.ISO20.AC_DER_ChargeLoop_Response.CLResControlMode.DER_Scheduled_AC_CLResControlMode.DERControl.VoltageTrip.OverVoltageMayTripCurve.Priority = 2;
    $EVSE.ISO20.AC_DER_ChargeLoop_Response.CLResControlMode.DER_Scheduled_AC_CLResControlMode.DERControl.VoltageTrip.OverVoltageMayTripCurve.xUnit = _CCS::DataTypes::CurveDataPointsUnitType::W;
    $EVSE.ISO20.AC_DER_ChargeLoop_Response.CLResControlMode.DER_Scheduled_AC_CLResControlMode.DERControl.VoltageTrip.OverVoltageMayTripCurve.yUnit = _CCS::DataTypes::CurveDataPointsUnitType::W;
    $EVSE.ISO20.AC_DER_ChargeLoop_Response.CLResControlMode.DER_Scheduled_AC_CLResControlMode.DERControl.VoltageTrip.OverVoltageMayTripCurve.CurveDataPoints.CurveDataPoint.Length = 3;
    $EVSE.ISO20.AC_DER_ChargeLoop_Response.CLResControlMode.DER_Scheduled_AC_CLResControlMode.DERControl.VoltageTrip.OverVoltageMayTripCurve.CurveDataPoints.CurveDataPoint[0].x.Exponent = 1;
    $EVSE.ISO20.AC_DER_ChargeLoop_Response.CLResControlMode.DER_Scheduled_AC_CLResControlMode.DERControl.VoltageTrip.OverVoltageMayTripCurve.CurveDataPoints.CurveDataPoint[0].x.Value = 2;
    $EVSE.ISO20.AC_DER_ChargeLoop_Response.CLResControlMode.DER_Scheduled_AC_CLResControlMode.DERControl.VoltageTrip.OverVoltageMayTripCurve.CurveDataPoints.CurveDataPoint[0].y.Exponent = 1;
    $EVSE.ISO20.AC_DER_ChargeLoop_Response.CLResControlMode.DER_Scheduled_AC_CLResControlMode.DERControl.VoltageTrip.OverVoltageMayTripCurve.CurveDataPoints.CurveDataPoint[0].y.Value = 2;
    $EVSE.ISO20.AC_DER_ChargeLoop_Response.CLResControlMode.DER_Scheduled_AC_CLResControlMode.DERControl.VoltageTrip.OverVoltageMayTripCurve.CurveDataPoints.CurveDataPoint[1].x.Exponent = 1;
    $EVSE.ISO20.AC_DER_ChargeLoop_Response.CLResControlMode.DER_Scheduled_AC_CLResControlMode.DERControl.VoltageTrip.OverVoltageMayTripCurve.CurveDataPoints.CurveDataPoint[1].x.Value = 2;
    $EVSE.ISO20.AC_DER_ChargeLoop_Response.CLResControlMode.DER_Scheduled_AC_CLResControlMode.DERControl.VoltageTrip.OverVoltageMayTripCurve.CurveDataPoints.CurveDataPoint[1].y.Exponent = 1;
    $EVSE.ISO20.AC_DER_ChargeLoop_Response.CLResControlMode.DER_Scheduled_AC_CLResControlMode.DERControl.VoltageTrip.OverVoltageMayTripCurve.CurveDataPoints.CurveDataPoint[1].y.Value = 2;
    $EVSE.ISO20.AC_DER_ChargeLoop_Response.CLResControlMode.DER_Scheduled_AC_CLResControlMode.DERControl.VoltageTrip.OverVoltageMayTripCurve.CurveDataPoints.CurveDataPoint[2].x.Exponent = 1;
    $EVSE.ISO20.AC_DER_ChargeLoop_Response.CLResControlMode.DER_Scheduled_AC_CLResControlMode.DERControl.VoltageTrip.OverVoltageMayTripCurve.CurveDataPoints.CurveDataPoint[2].x.Value = 2;
    $EVSE.ISO20.AC_DER_ChargeLoop_Response.CLResControlMode.DER_Scheduled_AC_CLResControlMode.DERControl.VoltageTrip.OverVoltageMayTripCurve.CurveDataPoints.CurveDataPoint[2].y.Exponent = 1;
    $EVSE.ISO20.AC_DER_ChargeLoop_Response.CLResControlMode.DER_Scheduled_AC_CLResControlMode.DERControl.VoltageTrip.OverVoltageMayTripCurve.CurveDataPoints.CurveDataPoint[2].y.Value = 2;
    $EVSE.ISO20.AC_DER_ChargeLoop_Response.CLResControlMode.DER_Scheduled_AC_CLResControlMode.DERControl.VoltageTrip.OverVoltageMayTripCurve.LockInValue = _CCS::DataTypes::LockValueUnitType::W;
    $EVSE.ISO20.AC_DER_ChargeLoop_Response.CLResControlMode.DER_Scheduled_AC_CLResControlMode.DERControl.VoltageTrip.OverVoltageMayTripCurve.LockOutValue = _CCS::DataTypes::LockValueUnitType::W;
    $EVSE.ISO20.AC_DER_ChargeLoop_Response.CLResControlMode.DER_Scheduled_AC_CLResControlMode.DERControl.VoltageTrip.OverVoltageMayTripCurve.OpenLoopResponseTime.Exponent = 2;
    $EVSE.ISO20.AC_DER_ChargeLoop_Response.CLResControlMode.DER_Scheduled_AC_CLResControlMode.DERControl.VoltageTrip.OverVoltageMayTripCurve.OpenLoopResponseTime.Value = 1;
    $EVSE.ISO20.AC_DER_ChargeLoop_Response.CLResControlMode.DER_Scheduled_AC_CLResControlMode.DERControl.VoltageTrip.OverVoltageMayTripCurve.TimeConstantPT1 = 2;
    $EVSE.ISO20.AC_DER_ChargeLoop_Response.CLResControlMode.DER_Scheduled_AC_CLResControlMode.DERControl.VoltageTrip.OverVoltageMayTripCurve.IntentionalDelay.Exponent = 2;
    $EVSE.ISO20.AC_DER_ChargeLoop_Response.CLResControlMode.DER_Scheduled_AC_CLResControlMode.DERControl.VoltageTrip.OverVoltageMayTripCurve.IntentionalDelay.Value = 1;

    $EVSE.ISO20.AC_DER_ChargeLoop_Response.CLResControlMode.DER_Scheduled_AC_CLResControlMode.DERControl.VoltageTrip.UnderVoltageMayTripCurve.Enable = 1;
    $EVSE.ISO20.AC_DER_ChargeLoop_Response.CLResControlMode.DER_Scheduled_AC_CLResControlMode.DERControl.VoltageTrip.UnderVoltageMayTripCurve.Priority = 2;
    $EVSE.ISO20.AC_DER_ChargeLoop_Response.CLResControlMode.DER_Scheduled_AC_CLResControlMode.DERControl.VoltageTrip.UnderVoltageMayTripCurve.xUnit = _CCS::DataTypes::CurveDataPointsUnitType::W;
    $EVSE.ISO20.AC_DER_ChargeLoop_Response.CLResControlMode.DER_Scheduled_AC_CLResControlMode.DERControl.VoltageTrip.UnderVoltageMayTripCurve.yUnit = _CCS::DataTypes::CurveDataPointsUnitType::W;
    $EVSE.ISO20.AC_DER_ChargeLoop_Response.CLResControlMode.DER_Scheduled_AC_CLResControlMode.DERControl.VoltageTrip.UnderVoltageMayTripCurve.CurveDataPoints.CurveDataPoint.Length = 3;
    $EVSE.ISO20.AC_DER_ChargeLoop_Response.CLResControlMode.DER_Scheduled_AC_CLResControlMode.DERControl.VoltageTrip.UnderVoltageMayTripCurve.CurveDataPoints.CurveDataPoint[0].x.Exponent = 1;
    $EVSE.ISO20.AC_DER_ChargeLoop_Response.CLResControlMode.DER_Scheduled_AC_CLResControlMode.DERControl.VoltageTrip.UnderVoltageMayTripCurve.CurveDataPoints.CurveDataPoint[0].x.Value = 2;
    $EVSE.ISO20.AC_DER_ChargeLoop_Response.CLResControlMode.DER_Scheduled_AC_CLResControlMode.DERControl.VoltageTrip.UnderVoltageMayTripCurve.CurveDataPoints.CurveDataPoint[0].y.Exponent = 1;
    $EVSE.ISO20.AC_DER_ChargeLoop_Response.CLResControlMode.DER_Scheduled_AC_CLResControlMode.DERControl.VoltageTrip.UnderVoltageMayTripCurve.CurveDataPoints.CurveDataPoint[0].y.Value = 2;
    $EVSE.ISO20.AC_DER_ChargeLoop_Response.CLResControlMode.DER_Scheduled_AC_CLResControlMode.DERControl.VoltageTrip.UnderVoltageMayTripCurve.CurveDataPoints.CurveDataPoint[1].x.Exponent = 1;
    $EVSE.ISO20.AC_DER_ChargeLoop_Response.CLResControlMode.DER_Scheduled_AC_CLResControlMode.DERControl.VoltageTrip.UnderVoltageMayTripCurve.CurveDataPoints.CurveDataPoint[1].x.Value = 2;
    $EVSE.ISO20.AC_DER_ChargeLoop_Response.CLResControlMode.DER_Scheduled_AC_CLResControlMode.DERControl.VoltageTrip.UnderVoltageMayTripCurve.CurveDataPoints.CurveDataPoint[1].y.Exponent = 1;
    $EVSE.ISO20.AC_DER_ChargeLoop_Response.CLResControlMode.DER_Scheduled_AC_CLResControlMode.DERControl.VoltageTrip.UnderVoltageMayTripCurve.CurveDataPoints.CurveDataPoint[1].y.Value = 2;
    $EVSE.ISO20.AC_DER_ChargeLoop_Response.CLResControlMode.DER_Scheduled_AC_CLResControlMode.DERControl.VoltageTrip.UnderVoltageMayTripCurve.CurveDataPoints.CurveDataPoint[2].x.Exponent = 1;
    $EVSE.ISO20.AC_DER_ChargeLoop_Response.CLResControlMode.DER_Scheduled_AC_CLResControlMode.DERControl.VoltageTrip.UnderVoltageMayTripCurve.CurveDataPoints.CurveDataPoint[2].x.Value = 2;
    $EVSE.ISO20.AC_DER_ChargeLoop_Response.CLResControlMode.DER_Scheduled_AC_CLResControlMode.DERControl.VoltageTrip.UnderVoltageMayTripCurve.CurveDataPoints.CurveDataPoint[2].y.Exponent = 1;
    $EVSE.ISO20.AC_DER_ChargeLoop_Response.CLResControlMode.DER_Scheduled_AC_CLResControlMode.DERControl.VoltageTrip.UnderVoltageMayTripCurve.CurveDataPoints.CurveDataPoint[2].y.Value = 2;
    $EVSE.ISO20.AC_DER_ChargeLoop_Response.CLResControlMode.DER_Scheduled_AC_CLResControlMode.DERControl.VoltageTrip.UnderVoltageMayTripCurve.LockInValue = _CCS::DataTypes::LockValueUnitType::W;
    $EVSE.ISO20.AC_DER_ChargeLoop_Response.CLResControlMode.DER_Scheduled_AC_CLResControlMode.DERControl.VoltageTrip.UnderVoltageMayTripCurve.LockOutValue = _CCS::DataTypes::LockValueUnitType::W;
    $EVSE.ISO20.AC_DER_ChargeLoop_Response.CLResControlMode.DER_Scheduled_AC_CLResControlMode.DERControl.VoltageTrip.UnderVoltageMayTripCurve.OpenLoopResponseTime.Exponent = 2;
    $EVSE.ISO20.AC_DER_ChargeLoop_Response.CLResControlMode.DER_Scheduled_AC_CLResControlMode.DERControl.VoltageTrip.UnderVoltageMayTripCurve.OpenLoopResponseTime.Value = 1;
    $EVSE.ISO20.AC_DER_ChargeLoop_Response.CLResControlMode.DER_Scheduled_AC_CLResControlMode.DERControl.VoltageTrip.UnderVoltageMayTripCurve.TimeConstantPT1 = 2;
    $EVSE.ISO20.AC_DER_ChargeLoop_Response.CLResControlMode.DER_Scheduled_AC_CLResControlMode.DERControl.VoltageTrip.UnderVoltageMayTripCurve.IntentionalDelay.Exponent = 2;
    $EVSE.ISO20.AC_DER_ChargeLoop_Response.CLResControlMode.DER_Scheduled_AC_CLResControlMode.DERControl.VoltageTrip.UnderVoltageMayTripCurve.IntentionalDelay.Value = 1;

    $EVSE.ISO20.AC_DER_ChargeLoop_Response.CLResControlMode.DER_Scheduled_AC_CLResControlMode.DERControl.VoltageTrip.OverVoltageMeanValue10min.Exponent = 2;
    $EVSE.ISO20.AC_DER_ChargeLoop_Response.CLResControlMode.DER_Scheduled_AC_CLResControlMode.DERControl.VoltageTrip.OverVoltageMeanValue10min.Value = 2;
    $EVSE.ISO20.AC_DER_ChargeLoop_Response.CLResControlMode.DER_Scheduled_AC_CLResControlMode.DERControl.VoltageTrip.OverVoltage10MinMeanTripDelay.Exponent = 2;
    $EVSE.ISO20.AC_DER_ChargeLoop_Response.CLResControlMode.DER_Scheduled_AC_CLResControlMode.DERControl.VoltageTrip.OverVoltage10MinMeanTripDelay.Value = 2;
    $EVSE.ISO20.AC_DER_ChargeLoop_Response.CLResControlMode.DER_Scheduled_AC_CLResControlMode.DERControl.VoltageTrip.PowerDuringCessation = _CCS::DataTypes::PowerDuringCessationType::ReactivePower;
    
    /* FrequencyTrip */
    $EVSE.ISO20.AC_DER_ChargeLoop_Response.CLResControlMode.DER_Scheduled_AC_CLResControlMode.DERControl.FrequencyTrip.OverFrequencyMustTripCurve.Enable = 1;
    $EVSE.ISO20.AC_DER_ChargeLoop_Response.CLResControlMode.DER_Scheduled_AC_CLResControlMode.DERControl.FrequencyTrip.OverFrequencyMustTripCurve.Priority = 2;
    $EVSE.ISO20.AC_DER_ChargeLoop_Response.CLResControlMode.DER_Scheduled_AC_CLResControlMode.DERControl.FrequencyTrip.OverFrequencyMustTripCurve.xUnit = _CCS::DataTypes::CurveDataPointsUnitType::W;
    $EVSE.ISO20.AC_DER_ChargeLoop_Response.CLResControlMode.DER_Scheduled_AC_CLResControlMode.DERControl.FrequencyTrip.OverFrequencyMustTripCurve.yUnit = _CCS::DataTypes::CurveDataPointsUnitType::W;
    $EVSE.ISO20.AC_DER_ChargeLoop_Response.CLResControlMode.DER_Scheduled_AC_CLResControlMode.DERControl.FrequencyTrip.OverFrequencyMustTripCurve.CurveDataPoints.CurveDataPoint.Length = 3;
    $EVSE.ISO20.AC_DER_ChargeLoop_Response.CLResControlMode.DER_Scheduled_AC_CLResControlMode.DERControl.FrequencyTrip.OverFrequencyMustTripCurve.CurveDataPoints.CurveDataPoint[0].x.Exponent = 1;
    $EVSE.ISO20.AC_DER_ChargeLoop_Response.CLResControlMode.DER_Scheduled_AC_CLResControlMode.DERControl.FrequencyTrip.OverFrequencyMustTripCurve.CurveDataPoints.CurveDataPoint[0].x.Value = 2;
    $EVSE.ISO20.AC_DER_ChargeLoop_Response.CLResControlMode.DER_Scheduled_AC_CLResControlMode.DERControl.FrequencyTrip.OverFrequencyMustTripCurve.CurveDataPoints.CurveDataPoint[0].y.Exponent = 1;
    $EVSE.ISO20.AC_DER_ChargeLoop_Response.CLResControlMode.DER_Scheduled_AC_CLResControlMode.DERControl.FrequencyTrip.OverFrequencyMustTripCurve.CurveDataPoints.CurveDataPoint[0].y.Value = 2;
    $EVSE.ISO20.AC_DER_ChargeLoop_Response.CLResControlMode.DER_Scheduled_AC_CLResControlMode.DERControl.FrequencyTrip.OverFrequencyMustTripCurve.CurveDataPoints.CurveDataPoint[1].x.Exponent = 1;
    $EVSE.ISO20.AC_DER_ChargeLoop_Response.CLResControlMode.DER_Scheduled_AC_CLResControlMode.DERControl.FrequencyTrip.OverFrequencyMustTripCurve.CurveDataPoints.CurveDataPoint[1].x.Value = 2;
    $EVSE.ISO20.AC_DER_ChargeLoop_Response.CLResControlMode.DER_Scheduled_AC_CLResControlMode.DERControl.FrequencyTrip.OverFrequencyMustTripCurve.CurveDataPoints.CurveDataPoint[1].y.Exponent = 1;
    $EVSE.ISO20.AC_DER_ChargeLoop_Response.CLResControlMode.DER_Scheduled_AC_CLResControlMode.DERControl.FrequencyTrip.OverFrequencyMustTripCurve.CurveDataPoints.CurveDataPoint[1].y.Value = 2;
    $EVSE.ISO20.AC_DER_ChargeLoop_Response.CLResControlMode.DER_Scheduled_AC_CLResControlMode.DERControl.FrequencyTrip.OverFrequencyMustTripCurve.CurveDataPoints.CurveDataPoint[2].x.Exponent = 1;
    $EVSE.ISO20.AC_DER_ChargeLoop_Response.CLResControlMode.DER_Scheduled_AC_CLResControlMode.DERControl.FrequencyTrip.OverFrequencyMustTripCurve.CurveDataPoints.CurveDataPoint[2].x.Value = 2;
    $EVSE.ISO20.AC_DER_ChargeLoop_Response.CLResControlMode.DER_Scheduled_AC_CLResControlMode.DERControl.FrequencyTrip.OverFrequencyMustTripCurve.CurveDataPoints.CurveDataPoint[2].y.Exponent = 1;
    $EVSE.ISO20.AC_DER_ChargeLoop_Response.CLResControlMode.DER_Scheduled_AC_CLResControlMode.DERControl.FrequencyTrip.OverFrequencyMustTripCurve.CurveDataPoints.CurveDataPoint[2].y.Value = 2;
    $EVSE.ISO20.AC_DER_ChargeLoop_Response.CLResControlMode.DER_Scheduled_AC_CLResControlMode.DERControl.FrequencyTrip.OverFrequencyMustTripCurve.LockInValue = _CCS::DataTypes::LockValueUnitType::W;
    $EVSE.ISO20.AC_DER_ChargeLoop_Response.CLResControlMode.DER_Scheduled_AC_CLResControlMode.DERControl.FrequencyTrip.OverFrequencyMustTripCurve.LockOutValue = _CCS::DataTypes::LockValueUnitType::W;
    $EVSE.ISO20.AC_DER_ChargeLoop_Response.CLResControlMode.DER_Scheduled_AC_CLResControlMode.DERControl.FrequencyTrip.OverFrequencyMustTripCurve.OpenLoopResponseTime.Exponent = 2;
    $EVSE.ISO20.AC_DER_ChargeLoop_Response.CLResControlMode.DER_Scheduled_AC_CLResControlMode.DERControl.FrequencyTrip.OverFrequencyMustTripCurve.OpenLoopResponseTime.Value = 1;
    $EVSE.ISO20.AC_DER_ChargeLoop_Response.CLResControlMode.DER_Scheduled_AC_CLResControlMode.DERControl.FrequencyTrip.OverFrequencyMustTripCurve.TimeConstantPT1 = 2;
    $EVSE.ISO20.AC_DER_ChargeLoop_Response.CLResControlMode.DER_Scheduled_AC_CLResControlMode.DERControl.FrequencyTrip.OverFrequencyMustTripCurve.IntentionalDelay.Exponent = 2;
    $EVSE.ISO20.AC_DER_ChargeLoop_Response.CLResControlMode.DER_Scheduled_AC_CLResControlMode.DERControl.FrequencyTrip.OverFrequencyMustTripCurve.IntentionalDelay.Value = 1;

    $EVSE.ISO20.AC_DER_ChargeLoop_Response.CLResControlMode.DER_Scheduled_AC_CLResControlMode.DERControl.FrequencyTrip.UnderFrequencyMustTripCurve.Enable = 1;
    $EVSE.ISO20.AC_DER_ChargeLoop_Response.CLResControlMode.DER_Scheduled_AC_CLResControlMode.DERControl.FrequencyTrip.UnderFrequencyMustTripCurve.Priority = 2;
    $EVSE.ISO20.AC_DER_ChargeLoop_Response.CLResControlMode.DER_Scheduled_AC_CLResControlMode.DERControl.FrequencyTrip.UnderFrequencyMustTripCurve.xUnit = _CCS::DataTypes::CurveDataPointsUnitType::W;
    $EVSE.ISO20.AC_DER_ChargeLoop_Response.CLResControlMode.DER_Scheduled_AC_CLResControlMode.DERControl.FrequencyTrip.UnderFrequencyMustTripCurve.yUnit = _CCS::DataTypes::CurveDataPointsUnitType::W;
    $EVSE.ISO20.AC_DER_ChargeLoop_Response.CLResControlMode.DER_Scheduled_AC_CLResControlMode.DERControl.FrequencyTrip.UnderFrequencyMustTripCurve.CurveDataPoints.CurveDataPoint.Length = 3;
    $EVSE.ISO20.AC_DER_ChargeLoop_Response.CLResControlMode.DER_Scheduled_AC_CLResControlMode.DERControl.FrequencyTrip.UnderFrequencyMustTripCurve.CurveDataPoints.CurveDataPoint[0].x.Exponent = 1;
    $EVSE.ISO20.AC_DER_ChargeLoop_Response.CLResControlMode.DER_Scheduled_AC_CLResControlMode.DERControl.FrequencyTrip.UnderFrequencyMustTripCurve.CurveDataPoints.CurveDataPoint[0].x.Value = 2;
    $EVSE.ISO20.AC_DER_ChargeLoop_Response.CLResControlMode.DER_Scheduled_AC_CLResControlMode.DERControl.FrequencyTrip.UnderFrequencyMustTripCurve.CurveDataPoints.CurveDataPoint[0].y.Exponent = 1;
    $EVSE.ISO20.AC_DER_ChargeLoop_Response.CLResControlMode.DER_Scheduled_AC_CLResControlMode.DERControl.FrequencyTrip.UnderFrequencyMustTripCurve.CurveDataPoints.CurveDataPoint[0].y.Value = 2;
    $EVSE.ISO20.AC_DER_ChargeLoop_Response.CLResControlMode.DER_Scheduled_AC_CLResControlMode.DERControl.FrequencyTrip.UnderFrequencyMustTripCurve.CurveDataPoints.CurveDataPoint[1].x.Exponent = 1;
    $EVSE.ISO20.AC_DER_ChargeLoop_Response.CLResControlMode.DER_Scheduled_AC_CLResControlMode.DERControl.FrequencyTrip.UnderFrequencyMustTripCurve.CurveDataPoints.CurveDataPoint[1].x.Value = 2;
    $EVSE.ISO20.AC_DER_ChargeLoop_Response.CLResControlMode.DER_Scheduled_AC_CLResControlMode.DERControl.FrequencyTrip.UnderFrequencyMustTripCurve.CurveDataPoints.CurveDataPoint[1].y.Exponent = 1;
    $EVSE.ISO20.AC_DER_ChargeLoop_Response.CLResControlMode.DER_Scheduled_AC_CLResControlMode.DERControl.FrequencyTrip.UnderFrequencyMustTripCurve.CurveDataPoints.CurveDataPoint[1].y.Value = 2;
    $EVSE.ISO20.AC_DER_ChargeLoop_Response.CLResControlMode.DER_Scheduled_AC_CLResControlMode.DERControl.FrequencyTrip.UnderFrequencyMustTripCurve.CurveDataPoints.CurveDataPoint[2].x.Exponent = 1;
    $EVSE.ISO20.AC_DER_ChargeLoop_Response.CLResControlMode.DER_Scheduled_AC_CLResControlMode.DERControl.FrequencyTrip.UnderFrequencyMustTripCurve.CurveDataPoints.CurveDataPoint[2].x.Value = 2;
    $EVSE.ISO20.AC_DER_ChargeLoop_Response.CLResControlMode.DER_Scheduled_AC_CLResControlMode.DERControl.FrequencyTrip.UnderFrequencyMustTripCurve.CurveDataPoints.CurveDataPoint[2].y.Exponent = 1;
    $EVSE.ISO20.AC_DER_ChargeLoop_Response.CLResControlMode.DER_Scheduled_AC_CLResControlMode.DERControl.FrequencyTrip.UnderFrequencyMustTripCurve.CurveDataPoints.CurveDataPoint[2].y.Value = 2;
    $EVSE.ISO20.AC_DER_ChargeLoop_Response.CLResControlMode.DER_Scheduled_AC_CLResControlMode.DERControl.FrequencyTrip.UnderFrequencyMustTripCurve.LockInValue = _CCS::DataTypes::LockValueUnitType::W;
    $EVSE.ISO20.AC_DER_ChargeLoop_Response.CLResControlMode.DER_Scheduled_AC_CLResControlMode.DERControl.FrequencyTrip.UnderFrequencyMustTripCurve.LockOutValue = _CCS::DataTypes::LockValueUnitType::W;
    $EVSE.ISO20.AC_DER_ChargeLoop_Response.CLResControlMode.DER_Scheduled_AC_CLResControlMode.DERControl.FrequencyTrip.UnderFrequencyMustTripCurve.OpenLoopResponseTime.Exponent = 2;
    $EVSE.ISO20.AC_DER_ChargeLoop_Response.CLResControlMode.DER_Scheduled_AC_CLResControlMode.DERControl.FrequencyTrip.UnderFrequencyMustTripCurve.OpenLoopResponseTime.Value = 1;
    $EVSE.ISO20.AC_DER_ChargeLoop_Response.CLResControlMode.DER_Scheduled_AC_CLResControlMode.DERControl.FrequencyTrip.UnderFrequencyMustTripCurve.TimeConstantPT1 = 2;
    $EVSE.ISO20.AC_DER_ChargeLoop_Response.CLResControlMode.DER_Scheduled_AC_CLResControlMode.DERControl.FrequencyTrip.UnderFrequencyMustTripCurve.IntentionalDelay.Exponent = 2;
    $EVSE.ISO20.AC_DER_ChargeLoop_Response.CLResControlMode.DER_Scheduled_AC_CLResControlMode.DERControl.FrequencyTrip.UnderFrequencyMustTripCurve.IntentionalDelay.Value = 1;

    $EVSE.ISO20.AC_DER_ChargeLoop_Response.CLResControlMode.DER_Scheduled_AC_CLResControlMode.DERControl.FrequencyTrip.OverFrequencyMayTripCurve.Enable = 1;
    $EVSE.ISO20.AC_DER_ChargeLoop_Response.CLResControlMode.DER_Scheduled_AC_CLResControlMode.DERControl.FrequencyTrip.OverFrequencyMayTripCurve.Priority = 2;
    $EVSE.ISO20.AC_DER_ChargeLoop_Response.CLResControlMode.DER_Scheduled_AC_CLResControlMode.DERControl.FrequencyTrip.OverFrequencyMayTripCurve.xUnit = _CCS::DataTypes::CurveDataPointsUnitType::W;
    $EVSE.ISO20.AC_DER_ChargeLoop_Response.CLResControlMode.DER_Scheduled_AC_CLResControlMode.DERControl.FrequencyTrip.OverFrequencyMayTripCurve.yUnit = _CCS::DataTypes::CurveDataPointsUnitType::W;
    $EVSE.ISO20.AC_DER_ChargeLoop_Response.CLResControlMode.DER_Scheduled_AC_CLResControlMode.DERControl.FrequencyTrip.OverFrequencyMayTripCurve.CurveDataPoints.CurveDataPoint.Length = 3;
    $EVSE.ISO20.AC_DER_ChargeLoop_Response.CLResControlMode.DER_Scheduled_AC_CLResControlMode.DERControl.FrequencyTrip.OverFrequencyMayTripCurve.CurveDataPoints.CurveDataPoint[0].x.Exponent = 1;
    $EVSE.ISO20.AC_DER_ChargeLoop_Response.CLResControlMode.DER_Scheduled_AC_CLResControlMode.DERControl.FrequencyTrip.OverFrequencyMayTripCurve.CurveDataPoints.CurveDataPoint[0].x.Value = 2;
    $EVSE.ISO20.AC_DER_ChargeLoop_Response.CLResControlMode.DER_Scheduled_AC_CLResControlMode.DERControl.FrequencyTrip.OverFrequencyMayTripCurve.CurveDataPoints.CurveDataPoint[0].y.Exponent = 1;
    $EVSE.ISO20.AC_DER_ChargeLoop_Response.CLResControlMode.DER_Scheduled_AC_CLResControlMode.DERControl.FrequencyTrip.OverFrequencyMayTripCurve.CurveDataPoints.CurveDataPoint[0].y.Value = 2;
    $EVSE.ISO20.AC_DER_ChargeLoop_Response.CLResControlMode.DER_Scheduled_AC_CLResControlMode.DERControl.FrequencyTrip.OverFrequencyMayTripCurve.CurveDataPoints.CurveDataPoint[1].x.Exponent = 1;
    $EVSE.ISO20.AC_DER_ChargeLoop_Response.CLResControlMode.DER_Scheduled_AC_CLResControlMode.DERControl.FrequencyTrip.OverFrequencyMayTripCurve.CurveDataPoints.CurveDataPoint[1].x.Value = 2;
    $EVSE.ISO20.AC_DER_ChargeLoop_Response.CLResControlMode.DER_Scheduled_AC_CLResControlMode.DERControl.FrequencyTrip.OverFrequencyMayTripCurve.CurveDataPoints.CurveDataPoint[1].y.Exponent = 1;
    $EVSE.ISO20.AC_DER_ChargeLoop_Response.CLResControlMode.DER_Scheduled_AC_CLResControlMode.DERControl.FrequencyTrip.OverFrequencyMayTripCurve.CurveDataPoints.CurveDataPoint[1].y.Value = 2;
    $EVSE.ISO20.AC_DER_ChargeLoop_Response.CLResControlMode.DER_Scheduled_AC_CLResControlMode.DERControl.FrequencyTrip.OverFrequencyMayTripCurve.CurveDataPoints.CurveDataPoint[2].x.Exponent = 1;
    $EVSE.ISO20.AC_DER_ChargeLoop_Response.CLResControlMode.DER_Scheduled_AC_CLResControlMode.DERControl.FrequencyTrip.OverFrequencyMayTripCurve.CurveDataPoints.CurveDataPoint[2].x.Value = 2;
    $EVSE.ISO20.AC_DER_ChargeLoop_Response.CLResControlMode.DER_Scheduled_AC_CLResControlMode.DERControl.FrequencyTrip.OverFrequencyMayTripCurve.CurveDataPoints.CurveDataPoint[2].y.Exponent = 1;
    $EVSE.ISO20.AC_DER_ChargeLoop_Response.CLResControlMode.DER_Scheduled_AC_CLResControlMode.DERControl.FrequencyTrip.OverFrequencyMayTripCurve.CurveDataPoints.CurveDataPoint[2].y.Value = 2;
    $EVSE.ISO20.AC_DER_ChargeLoop_Response.CLResControlMode.DER_Scheduled_AC_CLResControlMode.DERControl.FrequencyTrip.OverFrequencyMayTripCurve.LockInValue = _CCS::DataTypes::LockValueUnitType::W;
    $EVSE.ISO20.AC_DER_ChargeLoop_Response.CLResControlMode.DER_Scheduled_AC_CLResControlMode.DERControl.FrequencyTrip.OverFrequencyMayTripCurve.LockOutValue = _CCS::DataTypes::LockValueUnitType::W;
    $EVSE.ISO20.AC_DER_ChargeLoop_Response.CLResControlMode.DER_Scheduled_AC_CLResControlMode.DERControl.FrequencyTrip.OverFrequencyMayTripCurve.OpenLoopResponseTime.Exponent = 2;
    $EVSE.ISO20.AC_DER_ChargeLoop_Response.CLResControlMode.DER_Scheduled_AC_CLResControlMode.DERControl.FrequencyTrip.OverFrequencyMayTripCurve.OpenLoopResponseTime.Value = 1;
    $EVSE.ISO20.AC_DER_ChargeLoop_Response.CLResControlMode.DER_Scheduled_AC_CLResControlMode.DERControl.FrequencyTrip.OverFrequencyMayTripCurve.TimeConstantPT1 = 2;
    $EVSE.ISO20.AC_DER_ChargeLoop_Response.CLResControlMode.DER_Scheduled_AC_CLResControlMode.DERControl.FrequencyTrip.OverFrequencyMayTripCurve.IntentionalDelay.Exponent = 2;
    $EVSE.ISO20.AC_DER_ChargeLoop_Response.CLResControlMode.DER_Scheduled_AC_CLResControlMode.DERControl.FrequencyTrip.OverFrequencyMayTripCurve.IntentionalDelay.Value = 1;

    $EVSE.ISO20.AC_DER_ChargeLoop_Response.CLResControlMode.DER_Scheduled_AC_CLResControlMode.DERControl.FrequencyTrip.UnderFrequencyMayTripCurve.Enable = 1;
    $EVSE.ISO20.AC_DER_ChargeLoop_Response.CLResControlMode.DER_Scheduled_AC_CLResControlMode.DERControl.FrequencyTrip.UnderFrequencyMayTripCurve.Priority = 2;
    $EVSE.ISO20.AC_DER_ChargeLoop_Response.CLResControlMode.DER_Scheduled_AC_CLResControlMode.DERControl.FrequencyTrip.UnderFrequencyMayTripCurve.xUnit = _CCS::DataTypes::CurveDataPointsUnitType::W;
    $EVSE.ISO20.AC_DER_ChargeLoop_Response.CLResControlMode.DER_Scheduled_AC_CLResControlMode.DERControl.FrequencyTrip.UnderFrequencyMayTripCurve.yUnit = _CCS::DataTypes::CurveDataPointsUnitType::W;
    $EVSE.ISO20.AC_DER_ChargeLoop_Response.CLResControlMode.DER_Scheduled_AC_CLResControlMode.DERControl.FrequencyTrip.UnderFrequencyMayTripCurve.CurveDataPoints.CurveDataPoint.Length = 3;
    $EVSE.ISO20.AC_DER_ChargeLoop_Response.CLResControlMode.DER_Scheduled_AC_CLResControlMode.DERControl.FrequencyTrip.UnderFrequencyMayTripCurve.CurveDataPoints.CurveDataPoint[0].x.Exponent = 1;
    $EVSE.ISO20.AC_DER_ChargeLoop_Response.CLResControlMode.DER_Scheduled_AC_CLResControlMode.DERControl.FrequencyTrip.UnderFrequencyMayTripCurve.CurveDataPoints.CurveDataPoint[0].x.Value = 2;
    $EVSE.ISO20.AC_DER_ChargeLoop_Response.CLResControlMode.DER_Scheduled_AC_CLResControlMode.DERControl.FrequencyTrip.UnderFrequencyMayTripCurve.CurveDataPoints.CurveDataPoint[0].y.Exponent = 1;
    $EVSE.ISO20.AC_DER_ChargeLoop_Response.CLResControlMode.DER_Scheduled_AC_CLResControlMode.DERControl.FrequencyTrip.UnderFrequencyMayTripCurve.CurveDataPoints.CurveDataPoint[0].y.Value = 2;
    $EVSE.ISO20.AC_DER_ChargeLoop_Response.CLResControlMode.DER_Scheduled_AC_CLResControlMode.DERControl.FrequencyTrip.UnderFrequencyMayTripCurve.CurveDataPoints.CurveDataPoint[1].x.Exponent = 1;
    $EVSE.ISO20.AC_DER_ChargeLoop_Response.CLResControlMode.DER_Scheduled_AC_CLResControlMode.DERControl.FrequencyTrip.UnderFrequencyMayTripCurve.CurveDataPoints.CurveDataPoint[1].x.Value = 2;
    $EVSE.ISO20.AC_DER_ChargeLoop_Response.CLResControlMode.DER_Scheduled_AC_CLResControlMode.DERControl.FrequencyTrip.UnderFrequencyMayTripCurve.CurveDataPoints.CurveDataPoint[1].y.Exponent = 1;
    $EVSE.ISO20.AC_DER_ChargeLoop_Response.CLResControlMode.DER_Scheduled_AC_CLResControlMode.DERControl.FrequencyTrip.UnderFrequencyMayTripCurve.CurveDataPoints.CurveDataPoint[1].y.Value = 2;
    $EVSE.ISO20.AC_DER_ChargeLoop_Response.CLResControlMode.DER_Scheduled_AC_CLResControlMode.DERControl.FrequencyTrip.UnderFrequencyMayTripCurve.CurveDataPoints.CurveDataPoint[2].x.Exponent = 1;
    $EVSE.ISO20.AC_DER_ChargeLoop_Response.CLResControlMode.DER_Scheduled_AC_CLResControlMode.DERControl.FrequencyTrip.UnderFrequencyMayTripCurve.CurveDataPoints.CurveDataPoint[2].x.Value = 2;
    $EVSE.ISO20.AC_DER_ChargeLoop_Response.CLResControlMode.DER_Scheduled_AC_CLResControlMode.DERControl.FrequencyTrip.UnderFrequencyMayTripCurve.CurveDataPoints.CurveDataPoint[2].y.Exponent = 1;
    $EVSE.ISO20.AC_DER_ChargeLoop_Response.CLResControlMode.DER_Scheduled_AC_CLResControlMode.DERControl.FrequencyTrip.UnderFrequencyMayTripCurve.CurveDataPoints.CurveDataPoint[2].y.Value = 2;
    $EVSE.ISO20.AC_DER_ChargeLoop_Response.CLResControlMode.DER_Scheduled_AC_CLResControlMode.DERControl.FrequencyTrip.UnderFrequencyMayTripCurve.LockInValue = _CCS::DataTypes::LockValueUnitType::W;
    $EVSE.ISO20.AC_DER_ChargeLoop_Response.CLResControlMode.DER_Scheduled_AC_CLResControlMode.DERControl.FrequencyTrip.UnderFrequencyMayTripCurve.LockOutValue = _CCS::DataTypes::LockValueUnitType::W;
    $EVSE.ISO20.AC_DER_ChargeLoop_Response.CLResControlMode.DER_Scheduled_AC_CLResControlMode.DERControl.FrequencyTrip.UnderFrequencyMayTripCurve.OpenLoopResponseTime.Exponent = 2;
    $EVSE.ISO20.AC_DER_ChargeLoop_Response.CLResControlMode.DER_Scheduled_AC_CLResControlMode.DERControl.FrequencyTrip.UnderFrequencyMayTripCurve.OpenLoopResponseTime.Value = 1;
    $EVSE.ISO20.AC_DER_ChargeLoop_Response.CLResControlMode.DER_Scheduled_AC_CLResControlMode.DERControl.FrequencyTrip.UnderFrequencyMayTripCurve.TimeConstantPT1 = 2;
    $EVSE.ISO20.AC_DER_ChargeLoop_Response.CLResControlMode.DER_Scheduled_AC_CLResControlMode.DERControl.FrequencyTrip.UnderFrequencyMayTripCurve.IntentionalDelay.Exponent = 2;
    $EVSE.ISO20.AC_DER_ChargeLoop_Response.CLResControlMode.DER_Scheduled_AC_CLResControlMode.DERControl.FrequencyTrip.UnderFrequencyMayTripCurve.IntentionalDelay.Value = 1;

    /* FaultRideThrough */
    $EVSE.ISO20.AC_DER_ChargeLoop_Response.CLResControlMode.DER_Scheduled_AC_CLResControlMode.DERControl.FaultRideThrough.OverVoltageRideThroughPositiveCurveKFactor.Exponent = 2;
    $EVSE.ISO20.AC_DER_ChargeLoop_Response.CLResControlMode.DER_Scheduled_AC_CLResControlMode.DERControl.FaultRideThrough.OverVoltageRideThroughPositiveCurveKFactor.Value = 2;
    $EVSE.ISO20.AC_DER_ChargeLoop_Response.CLResControlMode.DER_Scheduled_AC_CLResControlMode.DERControl.FaultRideThrough.OverVoltageRideThroughNegativeCurveKFactor.Exponent = 2;
    $EVSE.ISO20.AC_DER_ChargeLoop_Response.CLResControlMode.DER_Scheduled_AC_CLResControlMode.DERControl.FaultRideThrough.OverVoltageRideThroughNegativeCurveKFactor.Value = 2;
    $EVSE.ISO20.AC_DER_ChargeLoop_Response.CLResControlMode.DER_Scheduled_AC_CLResControlMode.DERControl.FaultRideThrough.UnderVoltageRideThroughPositiveCurveKFactor.Exponent = 2;
    $EVSE.ISO20.AC_DER_ChargeLoop_Response.CLResControlMode.DER_Scheduled_AC_CLResControlMode.DERControl.FaultRideThrough.UnderVoltageRideThroughPositiveCurveKFactor.Value = 2; 
    $EVSE.ISO20.AC_DER_ChargeLoop_Response.CLResControlMode.DER_Scheduled_AC_CLResControlMode.DERControl.FaultRideThrough.UnderVoltageRideThroughNegativeCurveKFactor.Exponent = 2;
    $EVSE.ISO20.AC_DER_ChargeLoop_Response.CLResControlMode.DER_Scheduled_AC_CLResControlMode.DERControl.FaultRideThrough.UnderVoltageRideThroughNegativeCurveKFactor.Value = 2;

    $EVSE.ISO20.AC_DER_ChargeLoop_Response.CLResControlMode.DER_Scheduled_AC_CLResControlMode.DERControl.FaultRideThrough.DeadBand.MidLow.Exponent = 2;
    $EVSE.ISO20.AC_DER_ChargeLoop_Response.CLResControlMode.DER_Scheduled_AC_CLResControlMode.DERControl.FaultRideThrough.DeadBand.MidLow.Value = 2;
    $EVSE.ISO20.AC_DER_ChargeLoop_Response.CLResControlMode.DER_Scheduled_AC_CLResControlMode.DERControl.FaultRideThrough.DeadBand.MidHigh.Exponent = 2;
    $EVSE.ISO20.AC_DER_ChargeLoop_Response.CLResControlMode.DER_Scheduled_AC_CLResControlMode.DERControl.FaultRideThrough.DeadBand.MidHigh.Value = 2;
    $EVSE.ISO20.AC_DER_ChargeLoop_Response.CLResControlMode.DER_Scheduled_AC_CLResControlMode.DERControl.FaultRideThrough.DeadBand.Low.Exponent = 2;
    $EVSE.ISO20.AC_DER_ChargeLoop_Response.CLResControlMode.DER_Scheduled_AC_CLResControlMode.DERControl.FaultRideThrough.DeadBand.Low.Value = 2;
    $EVSE.ISO20.AC_DER_ChargeLoop_Response.CLResControlMode.DER_Scheduled_AC_CLResControlMode.DERControl.FaultRideThrough.DeadBand.High.Exponent = 2;
    $EVSE.ISO20.AC_DER_ChargeLoop_Response.CLResControlMode.DER_Scheduled_AC_CLResControlMode.DERControl.FaultRideThrough.DeadBand.High.Value = 2;
    
    /* EnterService */
    $EVSE.ISO20.AC_DER_ChargeLoop_Response.CLResControlMode.DER_Scheduled_AC_CLResControlMode.DERControl.EnterService.PermitService = 1;
    $EVSE.ISO20.AC_DER_ChargeLoop_Response.CLResControlMode.DER_Scheduled_AC_CLResControlMode.DERControl.EnterService.EnterServiceVoltageHigh.Exponent = 2;
    $EVSE.ISO20.AC_DER_ChargeLoop_Response.CLResControlMode.DER_Scheduled_AC_CLResControlMode.DERControl.EnterService.EnterServiceVoltageHigh.Value = 2;
    $EVSE.ISO20.AC_DER_ChargeLoop_Response.CLResControlMode.DER_Scheduled_AC_CLResControlMode.DERControl.EnterService.EnterServiceVoltageLow.Exponent = 2;
    $EVSE.ISO20.AC_DER_ChargeLoop_Response.CLResControlMode.DER_Scheduled_AC_CLResControlMode.DERControl.EnterService.EnterServiceVoltageLow.Value = 2;
    $EVSE.ISO20.AC_DER_ChargeLoop_Response.CLResControlMode.DER_Scheduled_AC_CLResControlMode.DERControl.EnterService.EnterServiceFrequencyHigh.Exponent = 2;
    $EVSE.ISO20.AC_DER_ChargeLoop_Response.CLResControlMode.DER_Scheduled_AC_CLResControlMode.DERControl.EnterService.EnterServiceFrequencyHigh.Value = 2;
    $EVSE.ISO20.AC_DER_ChargeLoop_Response.CLResControlMode.DER_Scheduled_AC_CLResControlMode.DERControl.EnterService.EnterServiceFrequencyLow.Exponent = 2;
    $EVSE.ISO20.AC_DER_ChargeLoop_Response.CLResControlMode.DER_Scheduled_AC_CLResControlMode.DERControl.EnterService.EnterServiceFrequencyLow.Value = 2;
    $EVSE.ISO20.AC_DER_ChargeLoop_Response.CLResControlMode.DER_Scheduled_AC_CLResControlMode.DERControl.EnterService.EnterServiceDelay.Exponent = 2;
    $EVSE.ISO20.AC_DER_ChargeLoop_Response.CLResControlMode.DER_Scheduled_AC_CLResControlMode.DERControl.EnterService.EnterServiceDelay.Value = 2;
    $EVSE.ISO20.AC_DER_ChargeLoop_Response.CLResControlMode.DER_Scheduled_AC_CLResControlMode.DERControl.EnterService.EnterServiceRandomizedDelay.Exponent = 2;
    $EVSE.ISO20.AC_DER_ChargeLoop_Response.CLResControlMode.DER_Scheduled_AC_CLResControlMode.DERControl.EnterService.EnterServiceRandomizedDelay.Value = 2;
    $EVSE.ISO20.AC_DER_ChargeLoop_Response.CLResControlMode.DER_Scheduled_AC_CLResControlMode.DERControl.EnterService.EnterServiceRampTime.Exponent = 2;
    $EVSE.ISO20.AC_DER_ChargeLoop_Response.CLResControlMode.DER_Scheduled_AC_CLResControlMode.DERControl.EnterService.EnterServiceRampTime.Value = 2;
    $EVSE.ISO20.AC_DER_ChargeLoop_Response.CLResControlMode.DER_Scheduled_AC_CLResControlMode.DERControl.EnterService.EnterServiceGradient.Exponent = 2;
    $EVSE.ISO20.AC_DER_ChargeLoop_Response.CLResControlMode.DER_Scheduled_AC_CLResControlMode.DERControl.EnterService.EnterServiceGradient.Value = 2;
    
    /* ReactivePowerSupport */
    $EVSE.ISO20.AC_DER_ChargeLoop_Response.CLResControlMode.DER_Scheduled_AC_CLResControlMode.DERControl.ReactivePowerSupport.ConstantPowerFactor.Enable = 1;
    $EVSE.ISO20.AC_DER_ChargeLoop_Response.CLResControlMode.DER_Scheduled_AC_CLResControlMode.DERControl.ReactivePowerSupport.ConstantPowerFactor.Priority = 2;
    $EVSE.ISO20.AC_DER_ChargeLoop_Response.CLResControlMode.DER_Scheduled_AC_CLResControlMode.DERControl.ReactivePowerSupport.ConstantPowerFactor.PowerFactorValue.Exponent = 2;
    $EVSE.ISO20.AC_DER_ChargeLoop_Response.CLResControlMode.DER_Scheduled_AC_CLResControlMode.DERControl.ReactivePowerSupport.ConstantPowerFactor.PowerFactorValue.Value = 2;
    $EVSE.ISO20.AC_DER_ChargeLoop_Response.CLResControlMode.DER_Scheduled_AC_CLResControlMode.DERControl.ReactivePowerSupport.ConstantPowerFactor.PowerFactorExcitation = _CCS::DataTypes::PowerFactorExcitationType::Under_Excited;

    $EVSE.ISO20.AC_DER_ChargeLoop_Response.CLResControlMode.DER_Scheduled_AC_CLResControlMode.DERControl.ReactivePowerSupport.VoltVar.Enable = 1;
    $EVSE.ISO20.AC_DER_ChargeLoop_Response.CLResControlMode.DER_Scheduled_AC_CLResControlMode.DERControl.ReactivePowerSupport.VoltVar.Priority = 2;
    $EVSE.ISO20.AC_DER_ChargeLoop_Response.CLResControlMode.DER_Scheduled_AC_CLResControlMode.DERControl.ReactivePowerSupport.VoltVar.xUnit = _CCS::DataTypes::CurveDataPointsUnitType::W;
    $EVSE.ISO20.AC_DER_ChargeLoop_Response.CLResControlMode.DER_Scheduled_AC_CLResControlMode.DERControl.ReactivePowerSupport.VoltVar.yUnit = _CCS::DataTypes::CurveDataPointsUnitType::W;
    $EVSE.ISO20.AC_DER_ChargeLoop_Response.CLResControlMode.DER_Scheduled_AC_CLResControlMode.DERControl.ReactivePowerSupport.VoltVar.CurveDataPoints.CurveDataPoint.Length = 3;
    $EVSE.ISO20.AC_DER_ChargeLoop_Response.CLResControlMode.DER_Scheduled_AC_CLResControlMode.DERControl.ReactivePowerSupport.VoltVar.CurveDataPoints.CurveDataPoint[0].x.Exponent = 1;
    $EVSE.ISO20.AC_DER_ChargeLoop_Response.CLResControlMode.DER_Scheduled_AC_CLResControlMode.DERControl.ReactivePowerSupport.VoltVar.CurveDataPoints.CurveDataPoint[0].x.Value = 2;
    $EVSE.ISO20.AC_DER_ChargeLoop_Response.CLResControlMode.DER_Scheduled_AC_CLResControlMode.DERControl.ReactivePowerSupport.VoltVar.CurveDataPoints.CurveDataPoint[0].y.Exponent = 1;
    $EVSE.ISO20.AC_DER_ChargeLoop_Response.CLResControlMode.DER_Scheduled_AC_CLResControlMode.DERControl.ReactivePowerSupport.VoltVar.CurveDataPoints.CurveDataPoint[0].y.Value = 2;
    $EVSE.ISO20.AC_DER_ChargeLoop_Response.CLResControlMode.DER_Scheduled_AC_CLResControlMode.DERControl.ReactivePowerSupport.VoltVar.CurveDataPoints.CurveDataPoint[1].x.Exponent = 1;
    $EVSE.ISO20.AC_DER_ChargeLoop_Response.CLResControlMode.DER_Scheduled_AC_CLResControlMode.DERControl.ReactivePowerSupport.VoltVar.CurveDataPoints.CurveDataPoint[1].x.Value = 2;
    $EVSE.ISO20.AC_DER_ChargeLoop_Response.CLResControlMode.DER_Scheduled_AC_CLResControlMode.DERControl.ReactivePowerSupport.VoltVar.CurveDataPoints.CurveDataPoint[1].y.Exponent = 1;
    $EVSE.ISO20.AC_DER_ChargeLoop_Response.CLResControlMode.DER_Scheduled_AC_CLResControlMode.DERControl.ReactivePowerSupport.VoltVar.CurveDataPoints.CurveDataPoint[1].y.Value = 2;
    $EVSE.ISO20.AC_DER_ChargeLoop_Response.CLResControlMode.DER_Scheduled_AC_CLResControlMode.DERControl.ReactivePowerSupport.VoltVar.CurveDataPoints.CurveDataPoint[2].x.Exponent = 1;
    $EVSE.ISO20.AC_DER_ChargeLoop_Response.CLResControlMode.DER_Scheduled_AC_CLResControlMode.DERControl.ReactivePowerSupport.VoltVar.CurveDataPoints.CurveDataPoint[2].x.Value = 2;
    $EVSE.ISO20.AC_DER_ChargeLoop_Response.CLResControlMode.DER_Scheduled_AC_CLResControlMode.DERControl.ReactivePowerSupport.VoltVar.CurveDataPoints.CurveDataPoint[2].y.Exponent = 1;
    $EVSE.ISO20.AC_DER_ChargeLoop_Response.CLResControlMode.DER_Scheduled_AC_CLResControlMode.DERControl.ReactivePowerSupport.VoltVar.CurveDataPoints.CurveDataPoint[2].y.Value = 2;
    $EVSE.ISO20.AC_DER_ChargeLoop_Response.CLResControlMode.DER_Scheduled_AC_CLResControlMode.DERControl.ReactivePowerSupport.VoltVar.LockInValue = _CCS::DataTypes::LockValueUnitType::W;
    $EVSE.ISO20.AC_DER_ChargeLoop_Response.CLResControlMode.DER_Scheduled_AC_CLResControlMode.DERControl.ReactivePowerSupport.VoltVar.LockOutValue = _CCS::DataTypes::LockValueUnitType::W;
    $EVSE.ISO20.AC_DER_ChargeLoop_Response.CLResControlMode.DER_Scheduled_AC_CLResControlMode.DERControl.ReactivePowerSupport.VoltVar.OpenLoopResponseTime.Exponent = 2;
    $EVSE.ISO20.AC_DER_ChargeLoop_Response.CLResControlMode.DER_Scheduled_AC_CLResControlMode.DERControl.ReactivePowerSupport.VoltVar.OpenLoopResponseTime.Value = 1;
    $EVSE.ISO20.AC_DER_ChargeLoop_Response.CLResControlMode.DER_Scheduled_AC_CLResControlMode.DERControl.ReactivePowerSupport.VoltVar.TimeConstantPT1 = 2;
    $EVSE.ISO20.AC_DER_ChargeLoop_Response.CLResControlMode.DER_Scheduled_AC_CLResControlMode.DERControl.ReactivePowerSupport.VoltVar.IntentionalDelay.Exponent = 2;
    $EVSE.ISO20.AC_DER_ChargeLoop_Response.CLResControlMode.DER_Scheduled_AC_CLResControlMode.DERControl.ReactivePowerSupport.VoltVar.IntentionalDelay.Value = 1;

    $EVSE.ISO20.AC_DER_ChargeLoop_Response.CLResControlMode.DER_Scheduled_AC_CLResControlMode.DERControl.ReactivePowerSupport.WattVar.Enable = 1;
    $EVSE.ISO20.AC_DER_ChargeLoop_Response.CLResControlMode.DER_Scheduled_AC_CLResControlMode.DERControl.ReactivePowerSupport.WattVar.Priority = 2;
    $EVSE.ISO20.AC_DER_ChargeLoop_Response.CLResControlMode.DER_Scheduled_AC_CLResControlMode.DERControl.ReactivePowerSupport.WattVar.xUnit = _CCS::DataTypes::CurveDataPointsUnitType::W;
    $EVSE.ISO20.AC_DER_ChargeLoop_Response.CLResControlMode.DER_Scheduled_AC_CLResControlMode.DERControl.ReactivePowerSupport.WattVar.yUnit = _CCS::DataTypes::CurveDataPointsUnitType::W;
    $EVSE.ISO20.AC_DER_ChargeLoop_Response.CLResControlMode.DER_Scheduled_AC_CLResControlMode.DERControl.ReactivePowerSupport.WattVar.CurveDataPoints.CurveDataPoint.Length = 3;
    $EVSE.ISO20.AC_DER_ChargeLoop_Response.CLResControlMode.DER_Scheduled_AC_CLResControlMode.DERControl.ReactivePowerSupport.WattVar.CurveDataPoints.CurveDataPoint[0].x.Exponent = 1;
    $EVSE.ISO20.AC_DER_ChargeLoop_Response.CLResControlMode.DER_Scheduled_AC_CLResControlMode.DERControl.ReactivePowerSupport.WattVar.CurveDataPoints.CurveDataPoint[0].x.Value = 2;
    $EVSE.ISO20.AC_DER_ChargeLoop_Response.CLResControlMode.DER_Scheduled_AC_CLResControlMode.DERControl.ReactivePowerSupport.WattVar.CurveDataPoints.CurveDataPoint[0].y.Exponent = 1;
    $EVSE.ISO20.AC_DER_ChargeLoop_Response.CLResControlMode.DER_Scheduled_AC_CLResControlMode.DERControl.ReactivePowerSupport.WattVar.CurveDataPoints.CurveDataPoint[0].y.Value = 2;
    $EVSE.ISO20.AC_DER_ChargeLoop_Response.CLResControlMode.DER_Scheduled_AC_CLResControlMode.DERControl.ReactivePowerSupport.WattVar.CurveDataPoints.CurveDataPoint[1].x.Exponent = 1;
    $EVSE.ISO20.AC_DER_ChargeLoop_Response.CLResControlMode.DER_Scheduled_AC_CLResControlMode.DERControl.ReactivePowerSupport.WattVar.CurveDataPoints.CurveDataPoint[1].x.Value = 2;
    $EVSE.ISO20.AC_DER_ChargeLoop_Response.CLResControlMode.DER_Scheduled_AC_CLResControlMode.DERControl.ReactivePowerSupport.WattVar.CurveDataPoints.CurveDataPoint[1].y.Exponent = 1;
    $EVSE.ISO20.AC_DER_ChargeLoop_Response.CLResControlMode.DER_Scheduled_AC_CLResControlMode.DERControl.ReactivePowerSupport.WattVar.CurveDataPoints.CurveDataPoint[1].y.Value = 2;
    $EVSE.ISO20.AC_DER_ChargeLoop_Response.CLResControlMode.DER_Scheduled_AC_CLResControlMode.DERControl.ReactivePowerSupport.WattVar.CurveDataPoints.CurveDataPoint[2].x.Exponent = 1;
    $EVSE.ISO20.AC_DER_ChargeLoop_Response.CLResControlMode.DER_Scheduled_AC_CLResControlMode.DERControl.ReactivePowerSupport.WattVar.CurveDataPoints.CurveDataPoint[2].x.Value = 2;
    $EVSE.ISO20.AC_DER_ChargeLoop_Response.CLResControlMode.DER_Scheduled_AC_CLResControlMode.DERControl.ReactivePowerSupport.WattVar.CurveDataPoints.CurveDataPoint[2].y.Exponent = 1;
    $EVSE.ISO20.AC_DER_ChargeLoop_Response.CLResControlMode.DER_Scheduled_AC_CLResControlMode.DERControl.ReactivePowerSupport.WattVar.CurveDataPoints.CurveDataPoint[2].y.Value = 2;
    $EVSE.ISO20.AC_DER_ChargeLoop_Response.CLResControlMode.DER_Scheduled_AC_CLResControlMode.DERControl.ReactivePowerSupport.WattVar.LockInValue = _CCS::DataTypes::LockValueUnitType::W;
    $EVSE.ISO20.AC_DER_ChargeLoop_Response.CLResControlMode.DER_Scheduled_AC_CLResControlMode.DERControl.ReactivePowerSupport.WattVar.LockOutValue = _CCS::DataTypes::LockValueUnitType::W;
    $EVSE.ISO20.AC_DER_ChargeLoop_Response.CLResControlMode.DER_Scheduled_AC_CLResControlMode.DERControl.ReactivePowerSupport.WattVar.OpenLoopResponseTime.Exponent = 2;
    $EVSE.ISO20.AC_DER_ChargeLoop_Response.CLResControlMode.DER_Scheduled_AC_CLResControlMode.DERControl.ReactivePowerSupport.WattVar.OpenLoopResponseTime.Value = 1;
    $EVSE.ISO20.AC_DER_ChargeLoop_Response.CLResControlMode.DER_Scheduled_AC_CLResControlMode.DERControl.ReactivePowerSupport.WattVar.TimeConstantPT1 = 2;
    $EVSE.ISO20.AC_DER_ChargeLoop_Response.CLResControlMode.DER_Scheduled_AC_CLResControlMode.DERControl.ReactivePowerSupport.WattVar.IntentionalDelay.Exponent = 2;
    $EVSE.ISO20.AC_DER_ChargeLoop_Response.CLResControlMode.DER_Scheduled_AC_CLResControlMode.DERControl.ReactivePowerSupport.WattVar.IntentionalDelay.Value = 1;

    /* ConstantVar */
    $EVSE.ISO20.AC_DER_ChargeLoop_Response.CLResControlMode.DER_Scheduled_AC_CLResControlMode.DERControl.ReactivePowerSupport.ConstantVar.Enable = 1;
    $EVSE.ISO20.AC_DER_ChargeLoop_Response.CLResControlMode.DER_Scheduled_AC_CLResControlMode.DERControl.ReactivePowerSupport.ConstantVar.Priority = 3;
    $EVSE.ISO20.AC_DER_ChargeLoop_Response.CLResControlMode.DER_Scheduled_AC_CLResControlMode.DERControl.ReactivePowerSupport.ConstantVar.Setpoint.Exponent = 2;
    $EVSE.ISO20.AC_DER_ChargeLoop_Response.CLResControlMode.DER_Scheduled_AC_CLResControlMode.DERControl.ReactivePowerSupport.ConstantVar.Setpoint.Value = 2;
    $EVSE.ISO20.AC_DER_ChargeLoop_Response.CLResControlMode.DER_Scheduled_AC_CLResControlMode.DERControl.ReactivePowerSupport.ConstantVar.Unit = _CCS::DataTypes::CurveDataPointsUnitType::W;


    $EVSE.ISO20.AC_DER_ChargeLoop_Response.CLResControlMode.DER_Scheduled_AC_CLResControlMode.DERControl.ReactivePowerSupport.WattCosPhi.Enable = 1;
    $EVSE.ISO20.AC_DER_ChargeLoop_Response.CLResControlMode.DER_Scheduled_AC_CLResControlMode.DERControl.ReactivePowerSupport.WattCosPhi.Priority = 2;
    $EVSE.ISO20.AC_DER_ChargeLoop_Response.CLResControlMode.DER_Scheduled_AC_CLResControlMode.DERControl.ReactivePowerSupport.WattCosPhi.xUnit = _CCS::DataTypes::CurveDataPointsUnitType::W;
    $EVSE.ISO20.AC_DER_ChargeLoop_Response.CLResControlMode.DER_Scheduled_AC_CLResControlMode.DERControl.ReactivePowerSupport.WattCosPhi.yUnit = _CCS::DataTypes::CurveDataPointsUnitType::W;
    $EVSE.ISO20.AC_DER_ChargeLoop_Response.CLResControlMode.DER_Scheduled_AC_CLResControlMode.DERControl.ReactivePowerSupport.WattCosPhi.CurveDataPoints.CurveDataPoint.Length = 3;
    $EVSE.ISO20.AC_DER_ChargeLoop_Response.CLResControlMode.DER_Scheduled_AC_CLResControlMode.DERControl.ReactivePowerSupport.WattCosPhi.CurveDataPoints.CurveDataPoint[0].x.Exponent = 1;
    $EVSE.ISO20.AC_DER_ChargeLoop_Response.CLResControlMode.DER_Scheduled_AC_CLResControlMode.DERControl.ReactivePowerSupport.WattCosPhi.CurveDataPoints.CurveDataPoint[0].x.Value = 2;
    $EVSE.ISO20.AC_DER_ChargeLoop_Response.CLResControlMode.DER_Scheduled_AC_CLResControlMode.DERControl.ReactivePowerSupport.WattCosPhi.CurveDataPoints.CurveDataPoint[0].y.Exponent = 1;
    $EVSE.ISO20.AC_DER_ChargeLoop_Response.CLResControlMode.DER_Scheduled_AC_CLResControlMode.DERControl.ReactivePowerSupport.WattCosPhi.CurveDataPoints.CurveDataPoint[0].y.Value = 2;
    $EVSE.ISO20.AC_DER_ChargeLoop_Response.CLResControlMode.DER_Scheduled_AC_CLResControlMode.DERControl.ReactivePowerSupport.WattCosPhi.CurveDataPoints.CurveDataPoint[1].x.Exponent = 1;
    $EVSE.ISO20.AC_DER_ChargeLoop_Response.CLResControlMode.DER_Scheduled_AC_CLResControlMode.DERControl.ReactivePowerSupport.WattCosPhi.CurveDataPoints.CurveDataPoint[1].x.Value = 2;
    $EVSE.ISO20.AC_DER_ChargeLoop_Response.CLResControlMode.DER_Scheduled_AC_CLResControlMode.DERControl.ReactivePowerSupport.WattCosPhi.CurveDataPoints.CurveDataPoint[1].y.Exponent = 1;
    $EVSE.ISO20.AC_DER_ChargeLoop_Response.CLResControlMode.DER_Scheduled_AC_CLResControlMode.DERControl.ReactivePowerSupport.WattCosPhi.CurveDataPoints.CurveDataPoint[1].y.Value = 2;
    $EVSE.ISO20.AC_DER_ChargeLoop_Response.CLResControlMode.DER_Scheduled_AC_CLResControlMode.DERControl.ReactivePowerSupport.WattCosPhi.CurveDataPoints.CurveDataPoint[2].x.Exponent = 1;
    $EVSE.ISO20.AC_DER_ChargeLoop_Response.CLResControlMode.DER_Scheduled_AC_CLResControlMode.DERControl.ReactivePowerSupport.WattCosPhi.CurveDataPoints.CurveDataPoint[2].x.Value = 2;
    $EVSE.ISO20.AC_DER_ChargeLoop_Response.CLResControlMode.DER_Scheduled_AC_CLResControlMode.DERControl.ReactivePowerSupport.WattCosPhi.CurveDataPoints.CurveDataPoint[2].y.Exponent = 1;
    $EVSE.ISO20.AC_DER_ChargeLoop_Response.CLResControlMode.DER_Scheduled_AC_CLResControlMode.DERControl.ReactivePowerSupport.WattCosPhi.CurveDataPoints.CurveDataPoint[2].y.Value = 2;
    $EVSE.ISO20.AC_DER_ChargeLoop_Response.CLResControlMode.DER_Scheduled_AC_CLResControlMode.DERControl.ReactivePowerSupport.WattCosPhi.LockInValue = _CCS::DataTypes::LockValueUnitType::W;
    $EVSE.ISO20.AC_DER_ChargeLoop_Response.CLResControlMode.DER_Scheduled_AC_CLResControlMode.DERControl.ReactivePowerSupport.WattCosPhi.LockOutValue = _CCS::DataTypes::LockValueUnitType::W;
    $EVSE.ISO20.AC_DER_ChargeLoop_Response.CLResControlMode.DER_Scheduled_AC_CLResControlMode.DERControl.ReactivePowerSupport.WattCosPhi.OpenLoopResponseTime.Exponent = 2;
    $EVSE.ISO20.AC_DER_ChargeLoop_Response.CLResControlMode.DER_Scheduled_AC_CLResControlMode.DERControl.ReactivePowerSupport.WattCosPhi.OpenLoopResponseTime.Value = 1;
    $EVSE.ISO20.AC_DER_ChargeLoop_Response.CLResControlMode.DER_Scheduled_AC_CLResControlMode.DERControl.ReactivePowerSupport.WattCosPhi.TimeConstantPT1 = 2;
    $EVSE.ISO20.AC_DER_ChargeLoop_Response.CLResControlMode.DER_Scheduled_AC_CLResControlMode.DERControl.ReactivePowerSupport.WattCosPhi.IntentionalDelay.Exponent = 2;
    $EVSE.ISO20.AC_DER_ChargeLoop_Response.CLResControlMode.DER_Scheduled_AC_CLResControlMode.DERControl.ReactivePowerSupport.WattCosPhi.IntentionalDelay.Value = 1;
    
    /* ActivePowerSupport */
  if(gEUFrequencyDroop == 1)
  {
    $EVSE.ISO20.AC_DER_ChargeLoop_Response.CLResControlMode.DER_Scheduled_AC_CLResControlMode.DERControl.ActivePowerSupport.FrequencyDroopElementId = 0;
    $EVSE.ISO20.AC_DER_ChargeLoop_Response.CLResControlMode.DER_Scheduled_AC_CLResControlMode.DERControl.ActivePowerSupport.FrequencyDroop.EU_FrequencyDroop.Priority = 2;
    $EVSE.ISO20.AC_DER_ChargeLoop_Response.CLResControlMode.DER_Scheduled_AC_CLResControlMode.DERControl.ActivePowerSupport.FrequencyDroop.EU_FrequencyDroop.Enable = 1;

    $EVSE.ISO20.AC_DER_ChargeLoop_Response.CLResControlMode.DER_Scheduled_AC_CLResControlMode.DERControl.ActivePowerSupport.FrequencyDroop.EU_FrequencyDroop.OverFrequencyDroop.Fstart.Exponent = 2;
    $EVSE.ISO20.AC_DER_ChargeLoop_Response.CLResControlMode.DER_Scheduled_AC_CLResControlMode.DERControl.ActivePowerSupport.FrequencyDroop.EU_FrequencyDroop.OverFrequencyDroop.Fstart.Value = 2;
    $EVSE.ISO20.AC_DER_ChargeLoop_Response.CLResControlMode.DER_Scheduled_AC_CLResControlMode.DERControl.ActivePowerSupport.FrequencyDroop.EU_FrequencyDroop.OverFrequencyDroop.s.Exponent = 2;
    $EVSE.ISO20.AC_DER_ChargeLoop_Response.CLResControlMode.DER_Scheduled_AC_CLResControlMode.DERControl.ActivePowerSupport.FrequencyDroop.EU_FrequencyDroop.OverFrequencyDroop.s.Value = 2;
    $EVSE.ISO20.AC_DER_ChargeLoop_Response.CLResControlMode.DER_Scheduled_AC_CLResControlMode.DERControl.ActivePowerSupport.FrequencyDroop.EU_FrequencyDroop.OverFrequencyDroop.DeactivationTime.Exponent = 2;
    $EVSE.ISO20.AC_DER_ChargeLoop_Response.CLResControlMode.DER_Scheduled_AC_CLResControlMode.DERControl.ActivePowerSupport.FrequencyDroop.EU_FrequencyDroop.OverFrequencyDroop.DeactivationTime.Value = 2;
    $EVSE.ISO20.AC_DER_ChargeLoop_Response.CLResControlMode.DER_Scheduled_AC_CLResControlMode.DERControl.ActivePowerSupport.FrequencyDroop.EU_FrequencyDroop.OverFrequencyDroop.IntentionalDelayPowerControl.Exponent = 2;
    $EVSE.ISO20.AC_DER_ChargeLoop_Response.CLResControlMode.DER_Scheduled_AC_CLResControlMode.DERControl.ActivePowerSupport.FrequencyDroop.EU_FrequencyDroop.OverFrequencyDroop.IntentionalDelayPowerControl.Value = 2;
    $EVSE.ISO20.AC_DER_ChargeLoop_Response.CLResControlMode.DER_Scheduled_AC_CLResControlMode.DERControl.ActivePowerSupport.FrequencyDroop.EU_FrequencyDroop.OverFrequencyDroop.PowerReference = _CCS::DataTypes::PowerReferenceType::PresentActivePower;

    /* HysteresisControl */
    $EVSE.ISO20.AC_DER_ChargeLoop_Response.CLResControlMode.DER_Scheduled_AC_CLResControlMode.DERControl.ActivePowerSupport.FrequencyDroop.EU_FrequencyDroop.OverFrequencyDroop.HysteresisControl.Fstop.Exponent = 2;
    $EVSE.ISO20.AC_DER_ChargeLoop_Response.CLResControlMode.DER_Scheduled_AC_CLResControlMode.DERControl.ActivePowerSupport.FrequencyDroop.EU_FrequencyDroop.OverFrequencyDroop.HysteresisControl.Fstop.Value = 2;
    $EVSE.ISO20.AC_DER_ChargeLoop_Response.CLResControlMode.DER_Scheduled_AC_CLResControlMode.DERControl.ActivePowerSupport.FrequencyDroop.EU_FrequencyDroop.OverFrequencyDroop.HysteresisControl.PowerUpRamp = 5;
    $EVSE.ISO20.AC_DER_ChargeLoop_Response.CLResControlMode.DER_Scheduled_AC_CLResControlMode.DERControl.ActivePowerSupport.FrequencyDroop.EU_FrequencyDroop.OverFrequencyDroop.HysteresisControl.IntentionalDelayFstop.Exponent = 2;
    $EVSE.ISO20.AC_DER_ChargeLoop_Response.CLResControlMode.DER_Scheduled_AC_CLResControlMode.DERControl.ActivePowerSupport.FrequencyDroop.EU_FrequencyDroop.OverFrequencyDroop.HysteresisControl.IntentionalDelayFstop.Value = 2;
    
    $EVSE.ISO20.AC_DER_ChargeLoop_Response.CLResControlMode.DER_Scheduled_AC_CLResControlMode.DERControl.ActivePowerSupport.FrequencyDroop.EU_FrequencyDroop.OverFrequencyDroop.MaxReactionTime.Exponent = 2;
    $EVSE.ISO20.AC_DER_ChargeLoop_Response.CLResControlMode.DER_Scheduled_AC_CLResControlMode.DERControl.ActivePowerSupport.FrequencyDroop.EU_FrequencyDroop.OverFrequencyDroop.MaxReactionTime.Value = 2;
    
    $EVSE.ISO20.AC_DER_ChargeLoop_Response.CLResControlMode.DER_Scheduled_AC_CLResControlMode.DERControl.ActivePowerSupport.FrequencyDroop.EU_FrequencyDroop.UnderFrequencyDroop.Fstart.Exponent = 2;
    $EVSE.ISO20.AC_DER_ChargeLoop_Response.CLResControlMode.DER_Scheduled_AC_CLResControlMode.DERControl.ActivePowerSupport.FrequencyDroop.EU_FrequencyDroop.UnderFrequencyDroop.Fstart.Value = 2;
    $EVSE.ISO20.AC_DER_ChargeLoop_Response.CLResControlMode.DER_Scheduled_AC_CLResControlMode.DERControl.ActivePowerSupport.FrequencyDroop.EU_FrequencyDroop.UnderFrequencyDroop.s.Exponent = 2;
    $EVSE.ISO20.AC_DER_ChargeLoop_Response.CLResControlMode.DER_Scheduled_AC_CLResControlMode.DERControl.ActivePowerSupport.FrequencyDroop.EU_FrequencyDroop.UnderFrequencyDroop.s.Value = 2;
    $EVSE.ISO20.AC_DER_ChargeLoop_Response.CLResControlMode.DER_Scheduled_AC_CLResControlMode.DERControl.ActivePowerSupport.FrequencyDroop.EU_FrequencyDroop.UnderFrequencyDroop.DeactivationTime.Exponent = 2;
    $EVSE.ISO20.AC_DER_ChargeLoop_Response.CLResControlMode.DER_Scheduled_AC_CLResControlMode.DERControl.ActivePowerSupport.FrequencyDroop.EU_FrequencyDroop.UnderFrequencyDroop.DeactivationTime.Value = 2;
    $EVSE.ISO20.AC_DER_ChargeLoop_Response.CLResControlMode.DER_Scheduled_AC_CLResControlMode.DERControl.ActivePowerSupport.FrequencyDroop.EU_FrequencyDroop.UnderFrequencyDroop.IntentionalDelayPowerControl.Exponent = 2;
    $EVSE.ISO20.AC_DER_ChargeLoop_Response.CLResControlMode.DER_Scheduled_AC_CLResControlMode.DERControl.ActivePowerSupport.FrequencyDroop.EU_FrequencyDroop.UnderFrequencyDroop.IntentionalDelayPowerControl.Value = 2;
    $EVSE.ISO20.AC_DER_ChargeLoop_Response.CLResControlMode.DER_Scheduled_AC_CLResControlMode.DERControl.ActivePowerSupport.FrequencyDroop.EU_FrequencyDroop.UnderFrequencyDroop.PowerReference = _CCS::DataTypes::PowerReferenceType::PresentActivePower;

    /* HysteresisControl */
    $EVSE.ISO20.AC_DER_ChargeLoop_Response.CLResControlMode.DER_Scheduled_AC_CLResControlMode.DERControl.ActivePowerSupport.FrequencyDroop.EU_FrequencyDroop.UnderFrequencyDroop.HysteresisControl.Fstop.Exponent = 2;
    $EVSE.ISO20.AC_DER_ChargeLoop_Response.CLResControlMode.DER_Scheduled_AC_CLResControlMode.DERControl.ActivePowerSupport.FrequencyDroop.EU_FrequencyDroop.UnderFrequencyDroop.HysteresisControl.Fstop.Value = 2;
    $EVSE.ISO20.AC_DER_ChargeLoop_Response.CLResControlMode.DER_Scheduled_AC_CLResControlMode.DERControl.ActivePowerSupport.FrequencyDroop.EU_FrequencyDroop.UnderFrequencyDroop.HysteresisControl.PowerUpRamp = 5;
    $EVSE.ISO20.AC_DER_ChargeLoop_Response.CLResControlMode.DER_Scheduled_AC_CLResControlMode.DERControl.ActivePowerSupport.FrequencyDroop.EU_FrequencyDroop.UnderFrequencyDroop.HysteresisControl.IntentionalDelayFstop.Exponent = 2;
    $EVSE.ISO20.AC_DER_ChargeLoop_Response.CLResControlMode.DER_Scheduled_AC_CLResControlMode.DERControl.ActivePowerSupport.FrequencyDroop.EU_FrequencyDroop.UnderFrequencyDroop.HysteresisControl.IntentionalDelayFstop.Value = 2;
    
    $EVSE.ISO20.AC_DER_ChargeLoop_Response.CLResControlMode.DER_Scheduled_AC_CLResControlMode.DERControl.ActivePowerSupport.FrequencyDroop.EU_FrequencyDroop.UnderFrequencyDroop.MaxReactionTime.Exponent = 2;
    $EVSE.ISO20.AC_DER_ChargeLoop_Response.CLResControlMode.DER_Scheduled_AC_CLResControlMode.DERControl.ActivePowerSupport.FrequencyDroop.EU_FrequencyDroop.UnderFrequencyDroop.MaxReactionTime.Value = 2;
  }
  else
  {
    $EVSE.ISO20.AC_DER_ChargeLoop_Response.CLResControlMode.DER_Scheduled_AC_CLResControlMode.DERControl.ActivePowerSupport.FrequencyDroopElementId = 1;
    $EVSE.ISO20.AC_DER_ChargeLoop_Response.CLResControlMode.DER_Scheduled_AC_CLResControlMode.DERControl.ActivePowerSupport.FrequencyDroop.US_FrequencyDroop.Priority = 2;
    $EVSE.ISO20.AC_DER_ChargeLoop_Response.CLResControlMode.DER_Scheduled_AC_CLResControlMode.DERControl.ActivePowerSupport.FrequencyDroop.US_FrequencyDroop.Enable = 1;
  
    $EVSE.ISO20.AC_DER_ChargeLoop_Response.CLResControlMode.DER_Scheduled_AC_CLResControlMode.DERControl.ActivePowerSupport.FrequencyDroop.US_FrequencyDroop.OverFrequencyDroop.db.Exponent = 2;
    $EVSE.ISO20.AC_DER_ChargeLoop_Response.CLResControlMode.DER_Scheduled_AC_CLResControlMode.DERControl.ActivePowerSupport.FrequencyDroop.US_FrequencyDroop.OverFrequencyDroop.db.Value = 2;
    $EVSE.ISO20.AC_DER_ChargeLoop_Response.CLResControlMode.DER_Scheduled_AC_CLResControlMode.DERControl.ActivePowerSupport.FrequencyDroop.US_FrequencyDroop.OverFrequencyDroop.k.Exponent = 2;
    $EVSE.ISO20.AC_DER_ChargeLoop_Response.CLResControlMode.DER_Scheduled_AC_CLResControlMode.DERControl.ActivePowerSupport.FrequencyDroop.US_FrequencyDroop.OverFrequencyDroop.k.Value = 2;
    $EVSE.ISO20.AC_DER_ChargeLoop_Response.CLResControlMode.DER_Scheduled_AC_CLResControlMode.DERControl.ActivePowerSupport.FrequencyDroop.US_FrequencyDroop.OverFrequencyDroop.PowerReference = _CCS::DataTypes::PowerReferenceType::PresentActivePower;
    $EVSE.ISO20.AC_DER_ChargeLoop_Response.CLResControlMode.DER_Scheduled_AC_CLResControlMode.DERControl.ActivePowerSupport.FrequencyDroop.US_FrequencyDroop.OverFrequencyDroop.OpenLoopResponseTime.Exponent = 2;
    $EVSE.ISO20.AC_DER_ChargeLoop_Response.CLResControlMode.DER_Scheduled_AC_CLResControlMode.DERControl.ActivePowerSupport.FrequencyDroop.US_FrequencyDroop.OverFrequencyDroop.OpenLoopResponseTime.Value = 2;

    $EVSE.ISO20.AC_DER_ChargeLoop_Response.CLResControlMode.DER_Scheduled_AC_CLResControlMode.DERControl.ActivePowerSupport.FrequencyDroop.US_FrequencyDroop.UnderFrequencyDroop.db.Exponent = 2;
    $EVSE.ISO20.AC_DER_ChargeLoop_Response.CLResControlMode.DER_Scheduled_AC_CLResControlMode.DERControl.ActivePowerSupport.FrequencyDroop.US_FrequencyDroop.UnderFrequencyDroop.db.Value = 2;
    $EVSE.ISO20.AC_DER_ChargeLoop_Response.CLResControlMode.DER_Scheduled_AC_CLResControlMode.DERControl.ActivePowerSupport.FrequencyDroop.US_FrequencyDroop.UnderFrequencyDroop.k.Exponent = 2;
    $EVSE.ISO20.AC_DER_ChargeLoop_Response.CLResControlMode.DER_Scheduled_AC_CLResControlMode.DERControl.ActivePowerSupport.FrequencyDroop.US_FrequencyDroop.UnderFrequencyDroop.k.Value = 2;
    $EVSE.ISO20.AC_DER_ChargeLoop_Response.CLResControlMode.DER_Scheduled_AC_CLResControlMode.DERControl.ActivePowerSupport.FrequencyDroop.US_FrequencyDroop.UnderFrequencyDroop.PowerReference = _CCS::DataTypes::PowerReferenceType::PresentActivePower;
    $EVSE.ISO20.AC_DER_ChargeLoop_Response.CLResControlMode.DER_Scheduled_AC_CLResControlMode.DERControl.ActivePowerSupport.FrequencyDroop.US_FrequencyDroop.UnderFrequencyDroop.OpenLoopResponseTime.Exponent = 2;
    $EVSE.ISO20.AC_DER_ChargeLoop_Response.CLResControlMode.DER_Scheduled_AC_CLResControlMode.DERControl.ActivePowerSupport.FrequencyDroop.US_FrequencyDroop.UnderFrequencyDroop.OpenLoopResponseTime.Value = 2;
  }

    /* FrequencyWatt */
    $EVSE.ISO20.AC_DER_ChargeLoop_Response.CLResControlMode.DER_Scheduled_AC_CLResControlMode.DERControl.ActivePowerSupport.FrequencyWatt.Enable = 1;
    $EVSE.ISO20.AC_DER_ChargeLoop_Response.CLResControlMode.DER_Scheduled_AC_CLResControlMode.DERControl.ActivePowerSupport.FrequencyWatt.Priority = 3;
    $EVSE.ISO20.AC_DER_ChargeLoop_Response.CLResControlMode.DER_Scheduled_AC_CLResControlMode.DERControl.ActivePowerSupport.FrequencyWatt.xUnit = _CCS::DataTypes::CurveDataPointsUnitType::W;
    $EVSE.ISO20.AC_DER_ChargeLoop_Response.CLResControlMode.DER_Scheduled_AC_CLResControlMode.DERControl.ActivePowerSupport.FrequencyWatt.yUnit = _CCS::DataTypes::CurveDataPointsUnitType::W;

    $EVSE.ISO20.AC_DER_ChargeLoop_Response.CLResControlMode.DER_Scheduled_AC_CLResControlMode.DERControl.ActivePowerSupport.FrequencyWatt.CurveDataPoints.CurveDataPoint.Length = 3;
    $EVSE.ISO20.AC_DER_ChargeLoop_Response.CLResControlMode.DER_Scheduled_AC_CLResControlMode.DERControl.ActivePowerSupport.FrequencyWatt.CurveDataPoints.CurveDataPoint[0].x.Exponent = 1;
    $EVSE.ISO20.AC_DER_ChargeLoop_Response.CLResControlMode.DER_Scheduled_AC_CLResControlMode.DERControl.ActivePowerSupport.FrequencyWatt.CurveDataPoints.CurveDataPoint[0].x.Value = 2;
    $EVSE.ISO20.AC_DER_ChargeLoop_Response.CLResControlMode.DER_Scheduled_AC_CLResControlMode.DERControl.ActivePowerSupport.FrequencyWatt.CurveDataPoints.CurveDataPoint[0].y.Exponent = 1;
    $EVSE.ISO20.AC_DER_ChargeLoop_Response.CLResControlMode.DER_Scheduled_AC_CLResControlMode.DERControl.ActivePowerSupport.FrequencyWatt.CurveDataPoints.CurveDataPoint[0].y.Value = 2;
    $EVSE.ISO20.AC_DER_ChargeLoop_Response.CLResControlMode.DER_Scheduled_AC_CLResControlMode.DERControl.ActivePowerSupport.FrequencyWatt.CurveDataPoints.CurveDataPoint[1].x.Exponent = 1;
    $EVSE.ISO20.AC_DER_ChargeLoop_Response.CLResControlMode.DER_Scheduled_AC_CLResControlMode.DERControl.ActivePowerSupport.FrequencyWatt.CurveDataPoints.CurveDataPoint[1].x.Value = 2;
    $EVSE.ISO20.AC_DER_ChargeLoop_Response.CLResControlMode.DER_Scheduled_AC_CLResControlMode.DERControl.ActivePowerSupport.FrequencyWatt.CurveDataPoints.CurveDataPoint[1].y.Exponent = 1;
    $EVSE.ISO20.AC_DER_ChargeLoop_Response.CLResControlMode.DER_Scheduled_AC_CLResControlMode.DERControl.ActivePowerSupport.FrequencyWatt.CurveDataPoints.CurveDataPoint[1].y.Value = 2;
    $EVSE.ISO20.AC_DER_ChargeLoop_Response.CLResControlMode.DER_Scheduled_AC_CLResControlMode.DERControl.ActivePowerSupport.FrequencyWatt.CurveDataPoints.CurveDataPoint[2].x.Exponent = 1;
    $EVSE.ISO20.AC_DER_ChargeLoop_Response.CLResControlMode.DER_Scheduled_AC_CLResControlMode.DERControl.ActivePowerSupport.FrequencyWatt.CurveDataPoints.CurveDataPoint[2].x.Value = 2;
    $EVSE.ISO20.AC_DER_ChargeLoop_Response.CLResControlMode.DER_Scheduled_AC_CLResControlMode.DERControl.ActivePowerSupport.FrequencyWatt.CurveDataPoints.CurveDataPoint[2].y.Exponent = 1;
    $EVSE.ISO20.AC_DER_ChargeLoop_Response.CLResControlMode.DER_Scheduled_AC_CLResControlMode.DERControl.ActivePowerSupport.FrequencyWatt.CurveDataPoints.CurveDataPoint[2].y.Value = 2;
    $EVSE.ISO20.AC_DER_ChargeLoop_Response.CLResControlMode.DER_Scheduled_AC_CLResControlMode.DERControl.ActivePowerSupport.FrequencyWatt.OpenLoopResponseTime.Exponent = 2;
    $EVSE.ISO20.AC_DER_ChargeLoop_Response.CLResControlMode.DER_Scheduled_AC_CLResControlMode.DERControl.ActivePowerSupport.FrequencyWatt.OpenLoopResponseTime.Value = 2;
    $EVSE.ISO20.AC_DER_ChargeLoop_Response.CLResControlMode.DER_Scheduled_AC_CLResControlMode.DERControl.ActivePowerSupport.FrequencyWatt.HysteresisHigh.Exponent = 2;
    $EVSE.ISO20.AC_DER_ChargeLoop_Response.CLResControlMode.DER_Scheduled_AC_CLResControlMode.DERControl.ActivePowerSupport.FrequencyWatt.HysteresisHigh.Value = 2;
    $EVSE.ISO20.AC_DER_ChargeLoop_Response.CLResControlMode.DER_Scheduled_AC_CLResControlMode.DERControl.ActivePowerSupport.FrequencyWatt.HysteresisLow.Exponent = 2;
    $EVSE.ISO20.AC_DER_ChargeLoop_Response.CLResControlMode.DER_Scheduled_AC_CLResControlMode.DERControl.ActivePowerSupport.FrequencyWatt.HysteresisLow.Value = 2;
    $EVSE.ISO20.AC_DER_ChargeLoop_Response.CLResControlMode.DER_Scheduled_AC_CLResControlMode.DERControl.ActivePowerSupport.FrequencyWatt.HysteresisDelay.Exponent = 2;
    $EVSE.ISO20.AC_DER_ChargeLoop_Response.CLResControlMode.DER_Scheduled_AC_CLResControlMode.DERControl.ActivePowerSupport.FrequencyWatt.HysteresisDelay.Value = 2;
    $EVSE.ISO20.AC_DER_ChargeLoop_Response.CLResControlMode.DER_Scheduled_AC_CLResControlMode.DERControl.ActivePowerSupport.FrequencyWatt.HysteresisGradient.Exponent = 2;
    $EVSE.ISO20.AC_DER_ChargeLoop_Response.CLResControlMode.DER_Scheduled_AC_CLResControlMode.DERControl.ActivePowerSupport.FrequencyWatt.HysteresisGradient.Value = 2;

    /* VoltWatt */
    $EVSE.ISO20.AC_DER_ChargeLoop_Response.CLResControlMode.DER_Scheduled_AC_CLResControlMode.DERControl.ActivePowerSupport.VoltWatt.Enable = 1;
    $EVSE.ISO20.AC_DER_ChargeLoop_Response.CLResControlMode.DER_Scheduled_AC_CLResControlMode.DERControl.ActivePowerSupport.VoltWatt.Priority = 2;
    $EVSE.ISO20.AC_DER_ChargeLoop_Response.CLResControlMode.DER_Scheduled_AC_CLResControlMode.DERControl.ActivePowerSupport.VoltWatt.xUnit = _CCS::DataTypes::CurveDataPointsUnitType::W;
    $EVSE.ISO20.AC_DER_ChargeLoop_Response.CLResControlMode.DER_Scheduled_AC_CLResControlMode.DERControl.ActivePowerSupport.VoltWatt.yUnit = _CCS::DataTypes::CurveDataPointsUnitType::W;
    $EVSE.ISO20.AC_DER_ChargeLoop_Response.CLResControlMode.DER_Scheduled_AC_CLResControlMode.DERControl.ActivePowerSupport.VoltWatt.CurveDataPoints.CurveDataPoint.Length = 3;
    $EVSE.ISO20.AC_DER_ChargeLoop_Response.CLResControlMode.DER_Scheduled_AC_CLResControlMode.DERControl.ActivePowerSupport.VoltWatt.CurveDataPoints.CurveDataPoint[0].x.Exponent = 1;
    $EVSE.ISO20.AC_DER_ChargeLoop_Response.CLResControlMode.DER_Scheduled_AC_CLResControlMode.DERControl.ActivePowerSupport.VoltWatt.CurveDataPoints.CurveDataPoint[0].x.Value = 2;
    $EVSE.ISO20.AC_DER_ChargeLoop_Response.CLResControlMode.DER_Scheduled_AC_CLResControlMode.DERControl.ActivePowerSupport.VoltWatt.CurveDataPoints.CurveDataPoint[0].y.Exponent = 1;
    $EVSE.ISO20.AC_DER_ChargeLoop_Response.CLResControlMode.DER_Scheduled_AC_CLResControlMode.DERControl.ActivePowerSupport.VoltWatt.CurveDataPoints.CurveDataPoint[0].y.Value = 2;
    $EVSE.ISO20.AC_DER_ChargeLoop_Response.CLResControlMode.DER_Scheduled_AC_CLResControlMode.DERControl.ActivePowerSupport.VoltWatt.CurveDataPoints.CurveDataPoint[1].x.Exponent = 1;
    $EVSE.ISO20.AC_DER_ChargeLoop_Response.CLResControlMode.DER_Scheduled_AC_CLResControlMode.DERControl.ActivePowerSupport.VoltWatt.CurveDataPoints.CurveDataPoint[1].x.Value = 2;
    $EVSE.ISO20.AC_DER_ChargeLoop_Response.CLResControlMode.DER_Scheduled_AC_CLResControlMode.DERControl.ActivePowerSupport.VoltWatt.CurveDataPoints.CurveDataPoint[1].y.Exponent = 1;
    $EVSE.ISO20.AC_DER_ChargeLoop_Response.CLResControlMode.DER_Scheduled_AC_CLResControlMode.DERControl.ActivePowerSupport.VoltWatt.CurveDataPoints.CurveDataPoint[1].y.Value = 2;
    $EVSE.ISO20.AC_DER_ChargeLoop_Response.CLResControlMode.DER_Scheduled_AC_CLResControlMode.DERControl.ActivePowerSupport.VoltWatt.CurveDataPoints.CurveDataPoint[2].x.Exponent = 1;
    $EVSE.ISO20.AC_DER_ChargeLoop_Response.CLResControlMode.DER_Scheduled_AC_CLResControlMode.DERControl.ActivePowerSupport.VoltWatt.CurveDataPoints.CurveDataPoint[2].x.Value = 2;
    $EVSE.ISO20.AC_DER_ChargeLoop_Response.CLResControlMode.DER_Scheduled_AC_CLResControlMode.DERControl.ActivePowerSupport.VoltWatt.CurveDataPoints.CurveDataPoint[2].y.Exponent = 1;
    $EVSE.ISO20.AC_DER_ChargeLoop_Response.CLResControlMode.DER_Scheduled_AC_CLResControlMode.DERControl.ActivePowerSupport.VoltWatt.CurveDataPoints.CurveDataPoint[2].y.Value = 2;
    $EVSE.ISO20.AC_DER_ChargeLoop_Response.CLResControlMode.DER_Scheduled_AC_CLResControlMode.DERControl.ActivePowerSupport.VoltWatt.LockInValue = _CCS::DataTypes::LockValueUnitType::W;
    $EVSE.ISO20.AC_DER_ChargeLoop_Response.CLResControlMode.DER_Scheduled_AC_CLResControlMode.DERControl.ActivePowerSupport.VoltWatt.LockOutValue = _CCS::DataTypes::LockValueUnitType::W;
    $EVSE.ISO20.AC_DER_ChargeLoop_Response.CLResControlMode.DER_Scheduled_AC_CLResControlMode.DERControl.ActivePowerSupport.VoltWatt.OpenLoopResponseTime.Exponent = 2;
    $EVSE.ISO20.AC_DER_ChargeLoop_Response.CLResControlMode.DER_Scheduled_AC_CLResControlMode.DERControl.ActivePowerSupport.VoltWatt.OpenLoopResponseTime.Value = 1;
    $EVSE.ISO20.AC_DER_ChargeLoop_Response.CLResControlMode.DER_Scheduled_AC_CLResControlMode.DERControl.ActivePowerSupport.VoltWatt.TimeConstantPT1 = 2;
    $EVSE.ISO20.AC_DER_ChargeLoop_Response.CLResControlMode.DER_Scheduled_AC_CLResControlMode.DERControl.ActivePowerSupport.VoltWatt.IntentionalDelay.Exponent = 2;
    $EVSE.ISO20.AC_DER_ChargeLoop_Response.CLResControlMode.DER_Scheduled_AC_CLResControlMode.DERControl.ActivePowerSupport.VoltWatt.IntentionalDelay.Value = 1;

    /* LimitMaxDischargePower */
    $EVSE.ISO20.AC_DER_ChargeLoop_Response.CLResControlMode.DER_Scheduled_AC_CLResControlMode.DERControl.ActivePowerSupport.LimitMaxDischargePower.Enable = 1;
    $EVSE.ISO20.AC_DER_ChargeLoop_Response.CLResControlMode.DER_Scheduled_AC_CLResControlMode.DERControl.ActivePowerSupport.LimitMaxDischargePower.Priority = 2;
    $EVSE.ISO20.AC_DER_ChargeLoop_Response.CLResControlMode.DER_Scheduled_AC_CLResControlMode.DERControl.ActivePowerSupport.LimitMaxDischargePower.PercentageValue = 20;

      /* PowerMonitoringMustTripCurve*/
    $EVSE.ISO20.AC_DER_ChargeLoop_Response.CLResControlMode.DER_Scheduled_AC_CLResControlMode.DERControl.ActivePowerSupport.LimitMaxDischargePower.PowerMonitoringMustTripCurve.Enable = 1;
    $EVSE.ISO20.AC_DER_ChargeLoop_Response.CLResControlMode.DER_Scheduled_AC_CLResControlMode.DERControl.ActivePowerSupport.LimitMaxDischargePower.PowerMonitoringMustTripCurve.Priority = 2;
    $EVSE.ISO20.AC_DER_ChargeLoop_Response.CLResControlMode.DER_Scheduled_AC_CLResControlMode.DERControl.ActivePowerSupport.LimitMaxDischargePower.PowerMonitoringMustTripCurve.xUnit = _CCS::DataTypes::CurveDataPointsUnitType::W;
    $EVSE.ISO20.AC_DER_ChargeLoop_Response.CLResControlMode.DER_Scheduled_AC_CLResControlMode.DERControl.ActivePowerSupport.LimitMaxDischargePower.PowerMonitoringMustTripCurve.yUnit = _CCS::DataTypes::CurveDataPointsUnitType::W;
    $EVSE.ISO20.AC_DER_ChargeLoop_Response.CLResControlMode.DER_Scheduled_AC_CLResControlMode.DERControl.ActivePowerSupport.LimitMaxDischargePower.PowerMonitoringMustTripCurve.CurveDataPoints.CurveDataPoint.Length = 3;
    $EVSE.ISO20.AC_DER_ChargeLoop_Response.CLResControlMode.DER_Scheduled_AC_CLResControlMode.DERControl.ActivePowerSupport.LimitMaxDischargePower.PowerMonitoringMustTripCurve.CurveDataPoints.CurveDataPoint[0].x.Exponent = 1;
    $EVSE.ISO20.AC_DER_ChargeLoop_Response.CLResControlMode.DER_Scheduled_AC_CLResControlMode.DERControl.ActivePowerSupport.LimitMaxDischargePower.PowerMonitoringMustTripCurve.CurveDataPoints.CurveDataPoint[0].x.Value = 2;
    $EVSE.ISO20.AC_DER_ChargeLoop_Response.CLResControlMode.DER_Scheduled_AC_CLResControlMode.DERControl.ActivePowerSupport.LimitMaxDischargePower.PowerMonitoringMustTripCurve.CurveDataPoints.CurveDataPoint[0].y.Exponent = 1;
    $EVSE.ISO20.AC_DER_ChargeLoop_Response.CLResControlMode.DER_Scheduled_AC_CLResControlMode.DERControl.ActivePowerSupport.LimitMaxDischargePower.PowerMonitoringMustTripCurve.CurveDataPoints.CurveDataPoint[0].y.Value = 2;
    $EVSE.ISO20.AC_DER_ChargeLoop_Response.CLResControlMode.DER_Scheduled_AC_CLResControlMode.DERControl.ActivePowerSupport.LimitMaxDischargePower.PowerMonitoringMustTripCurve.CurveDataPoints.CurveDataPoint[1].x.Exponent = 1;
    $EVSE.ISO20.AC_DER_ChargeLoop_Response.CLResControlMode.DER_Scheduled_AC_CLResControlMode.DERControl.ActivePowerSupport.LimitMaxDischargePower.PowerMonitoringMustTripCurve.CurveDataPoints.CurveDataPoint[1].x.Value = 2;
    $EVSE.ISO20.AC_DER_ChargeLoop_Response.CLResControlMode.DER_Scheduled_AC_CLResControlMode.DERControl.ActivePowerSupport.LimitMaxDischargePower.PowerMonitoringMustTripCurve.CurveDataPoints.CurveDataPoint[1].y.Exponent = 1;
    $EVSE.ISO20.AC_DER_ChargeLoop_Response.CLResControlMode.DER_Scheduled_AC_CLResControlMode.DERControl.ActivePowerSupport.LimitMaxDischargePower.PowerMonitoringMustTripCurve.CurveDataPoints.CurveDataPoint[1].y.Value = 2;
    $EVSE.ISO20.AC_DER_ChargeLoop_Response.CLResControlMode.DER_Scheduled_AC_CLResControlMode.DERControl.ActivePowerSupport.LimitMaxDischargePower.PowerMonitoringMustTripCurve.CurveDataPoints.CurveDataPoint[2].x.Exponent = 1;
    $EVSE.ISO20.AC_DER_ChargeLoop_Response.CLResControlMode.DER_Scheduled_AC_CLResControlMode.DERControl.ActivePowerSupport.LimitMaxDischargePower.PowerMonitoringMustTripCurve.CurveDataPoints.CurveDataPoint[2].x.Value = 2;
    $EVSE.ISO20.AC_DER_ChargeLoop_Response.CLResControlMode.DER_Scheduled_AC_CLResControlMode.DERControl.ActivePowerSupport.LimitMaxDischargePower.PowerMonitoringMustTripCurve.CurveDataPoints.CurveDataPoint[2].y.Exponent = 1;
    $EVSE.ISO20.AC_DER_ChargeLoop_Response.CLResControlMode.DER_Scheduled_AC_CLResControlMode.DERControl.ActivePowerSupport.LimitMaxDischargePower.PowerMonitoringMustTripCurve.CurveDataPoints.CurveDataPoint[2].y.Value = 2;
    $EVSE.ISO20.AC_DER_ChargeLoop_Response.CLResControlMode.DER_Scheduled_AC_CLResControlMode.DERControl.ActivePowerSupport.LimitMaxDischargePower.PowerMonitoringMustTripCurve.LockInValue = _CCS::DataTypes::LockValueUnitType::W;
    $EVSE.ISO20.AC_DER_ChargeLoop_Response.CLResControlMode.DER_Scheduled_AC_CLResControlMode.DERControl.ActivePowerSupport.LimitMaxDischargePower.PowerMonitoringMustTripCurve.LockOutValue = _CCS::DataTypes::LockValueUnitType::W;
    $EVSE.ISO20.AC_DER_ChargeLoop_Response.CLResControlMode.DER_Scheduled_AC_CLResControlMode.DERControl.ActivePowerSupport.LimitMaxDischargePower.PowerMonitoringMustTripCurve.OpenLoopResponseTime.Exponent = 2;
    $EVSE.ISO20.AC_DER_ChargeLoop_Response.CLResControlMode.DER_Scheduled_AC_CLResControlMode.DERControl.ActivePowerSupport.LimitMaxDischargePower.PowerMonitoringMustTripCurve.OpenLoopResponseTime.Value = 1;
    $EVSE.ISO20.AC_DER_ChargeLoop_Response.CLResControlMode.DER_Scheduled_AC_CLResControlMode.DERControl.ActivePowerSupport.LimitMaxDischargePower.PowerMonitoringMustTripCurve.TimeConstantPT1 = 2;
    $EVSE.ISO20.AC_DER_ChargeLoop_Response.CLResControlMode.DER_Scheduled_AC_CLResControlMode.DERControl.ActivePowerSupport.LimitMaxDischargePower.PowerMonitoringMustTripCurve.IntentionalDelay.Exponent = 2;
    $EVSE.ISO20.AC_DER_ChargeLoop_Response.CLResControlMode.DER_Scheduled_AC_CLResControlMode.DERControl.ActivePowerSupport.LimitMaxDischargePower.PowerMonitoringMustTripCurve.IntentionalDelay.Value = 1;
    $EVSE.ISO20.AC_DER_ChargeLoop_Response.CLResControlMode.DER_Scheduled_AC_CLResControlMode.DERControl.ActivePowerSupport.LimitMaxDischargePower.PowerMonitoringMustTripCurve.IntentionalDelay.Exponent = 2;
    $EVSE.ISO20.AC_DER_ChargeLoop_Response.CLResControlMode.DER_Scheduled_AC_CLResControlMode.DERControl.MaximumLevel1DCInjection.Value = 1;
    $EVSE.ISO20.AC_DER_ChargeLoop_Response.CLResControlMode.DER_Scheduled_AC_CLResControlMode.DERControl.MaximumLevel1DCInjection.Exponent = 1;
    $EVSE.ISO20.AC_DER_ChargeLoop_Response.CLResControlMode.DER_Scheduled_AC_CLResControlMode.DERControl.MaximumLevel2DCInjection.Value = 1;
    $EVSE.ISO20.AC_DER_ChargeLoop_Response.CLResControlMode.DER_Scheduled_AC_CLResControlMode.DERControl.MaximumLevel2DCInjection.Exponent = 1;
    $EVSE.ISO20.AC_DER_ChargeLoop_Response.CLResControlMode.DER_Scheduled_AC_CLResControlMode.DERControl.SCRatPOC.Value = 1;
    $EVSE.ISO20.AC_DER_ChargeLoop_Response.CLResControlMode.DER_Scheduled_AC_CLResControlMode.DERControl.SCRatPOC.Exponent = 1;
}


void FUNC_Get_EVSE_DCChargeLoopValues()
{  
  $EVSE.ISO20.DC_ChargeLoop_Response.EVSEPresentCurrent.Value = HV_measure_DC_I();
  $EVSE.ISO20.DC_ChargeLoop_Response.EVSEPresentCurrent.Exponent = 0;
  
  $EVSE.ISO20.DC_ChargeLoop_Response.EVSEPresentVoltage.Value = HV_measure_DC_U();
  $EVSE.ISO20.DC_ChargeLoop_Response.EVSEPresentVoltage.Exponent = 0;
  
  if($EVSE.ISO20.DC_ChargeLoop_Request.DisplayParameters.IsValid)
  {
    if($EVSE.ISO20.DC_ChargeLoop_Request.DisplayParameters.MinimumSOC.IsValid)
    {
      $EVSE.ISO20.DC_ChargeLoop_Response.CLResControlMode.BPT_Dynamic_DC_CLResControlMode.MinimumSOC = $EVSE.ISO20.DC_ChargeLoop_Request.DisplayParameters.MinimumSOC;
      $EVSE.ISO20.DC_ChargeLoop_Response.CLResControlMode.Dynamic_DC_CLResControlMode.MinimumSOC = $EVSE.ISO20.DC_ChargeLoop_Request.DisplayParameters.MinimumSOC;
    }
    else
    {
      $EVSE.ISO20.DC_ChargeLoop_Response.CLResControlMode.BPT_Dynamic_DC_CLResControlMode.MinimumSOC.SetInvalid();
      $EVSE.ISO20.DC_ChargeLoop_Response.CLResControlMode.Dynamic_DC_CLResControlMode.MinimumSOC.SetInvalid();
    }
     
    if($EVSE.ISO20.DC_ChargeLoop_Request.DisplayParameters.TargetSOC.IsValid)
    {
      $EVSE.ISO20.DC_ChargeLoop_Response.CLResControlMode.BPT_Dynamic_DC_CLResControlMode.TargetSOC = $EVSE.ISO20.DC_ChargeLoop_Request.DisplayParameters.TargetSOC;
      $EVSE.ISO20.DC_ChargeLoop_Response.CLResControlMode.Dynamic_DC_CLResControlMode.TargetSOC = $EVSE.ISO20.DC_ChargeLoop_Request.DisplayParameters.TargetSOC;
    }    
    else
    {
      $EVSE.ISO20.DC_ChargeLoop_Response.CLResControlMode.BPT_Dynamic_DC_CLResControlMode.TargetSOC.SetInvalid();
      $EVSE.ISO20.DC_ChargeLoop_Response.CLResControlMode.Dynamic_DC_CLResControlMode.TargetSOC.SetInvalid();
    }
  }
  else
  {
    $EVSE.ISO20.DC_ChargeLoop_Response.CLResControlMode.BPT_Dynamic_DC_CLResControlMode.MinimumSOC.SetInvalid();
    $EVSE.ISO20.DC_ChargeLoop_Response.CLResControlMode.Dynamic_DC_CLResControlMode.MinimumSOC.SetInvalid();
    $EVSE.ISO20.DC_ChargeLoop_Response.CLResControlMode.BPT_Dynamic_DC_CLResControlMode.TargetSOC.SetInvalid();
    $EVSE.ISO20.DC_ChargeLoop_Response.CLResControlMode.Dynamic_DC_CLResControlMode.TargetSOC.SetInvalid();
  }
  
  //EVSEMinimumChargePower
  $EVSE.ISO20.DC_ChargeLoop_Response.CLResControlMode.BPT_Dynamic_DC_CLResControlMode.EVSEMinimumChargePower.Value = @sysvar::EVSE_Sim::SysEVSE_MinPowerDC;
  $EVSE.ISO20.DC_ChargeLoop_Response.CLResControlMode.BPT_Dynamic_DC_CLResControlMode.EVSEMinimumChargePower.Exponent = 3; //Unit: kW
  $EVSE.ISO20.DC_ChargeLoop_Response.CLResControlMode.Dynamic_DC_CLResControlMode.EVSEMinimumChargePower.Value = @sysvar::EVSE_Sim::SysEVSE_MinPowerDC;
  $EVSE.ISO20.DC_ChargeLoop_Response.CLResControlMode.Dynamic_DC_CLResControlMode.EVSEMinimumChargePower.Exponent = 3; //Unit: kW
  $EVSE.ISO20.DC_ChargeLoop_Response.CLResControlMode.BPT_Scheduled_DC_CLResControlMode.EVSEMinimumChargePower.Value = @sysvar::EVSE_Sim::SysEVSE_MinPowerDC;
  $EVSE.ISO20.DC_ChargeLoop_Response.CLResControlMode.BPT_Scheduled_DC_CLResControlMode.EVSEMinimumChargePower.Exponent = 3; //Unit: kW
  $EVSE.ISO20.DC_ChargeLoop_Response.CLResControlMode.Scheduled_DC_CLResControlMode.EVSEMinimumChargePower.Value = @sysvar::EVSE_Sim::SysEVSE_MinPowerDC;
  $EVSE.ISO20.DC_ChargeLoop_Response.CLResControlMode.Scheduled_DC_CLResControlMode.EVSEMinimumChargePower.Exponent = 3; //Unit: kW
  
  //EVSEMaximumChargePower
  $EVSE.ISO20.DC_ChargeLoop_Response.CLResControlMode.BPT_Dynamic_DC_CLResControlMode.EVSEMaximumChargePower.Value = @sysvar::EVSE_Sim::SysEVSE_MaxPowerDC;
  $EVSE.ISO20.DC_ChargeLoop_Response.CLResControlMode.BPT_Dynamic_DC_CLResControlMode.EVSEMaximumChargePower.Exponent = 3; //Unit: kW
  $EVSE.ISO20.DC_ChargeLoop_Response.CLResControlMode.Dynamic_DC_CLResControlMode.EVSEMaximumChargePower.Value = @sysvar::EVSE_Sim::SysEVSE_MaxPowerDC;
  $EVSE.ISO20.DC_ChargeLoop_Response.CLResControlMode.Dynamic_DC_CLResControlMode.EVSEMaximumChargePower.Exponent = 3; //Unit: kW
  $EVSE.ISO20.DC_ChargeLoop_Response.CLResControlMode.BPT_Scheduled_DC_CLResControlMode.EVSEMaximumChargePower.Value = @sysvar::EVSE_Sim::SysEVSE_MaxPowerDC;
  $EVSE.ISO20.DC_ChargeLoop_Response.CLResControlMode.BPT_Scheduled_DC_CLResControlMode.EVSEMaximumChargePower.Exponent = 3; //Unit: kW
  $EVSE.ISO20.DC_ChargeLoop_Response.CLResControlMode.Scheduled_DC_CLResControlMode.EVSEMaximumChargePower.Value = @sysvar::EVSE_Sim::SysEVSE_MaxPowerDC;
  $EVSE.ISO20.DC_ChargeLoop_Response.CLResControlMode.Scheduled_DC_CLResControlMode.EVSEMaximumChargePower.Exponent = 3; //Unit: kW
  
  //EVSEMaximumVoltage
  $EVSE.ISO20.DC_ChargeLoop_Response.CLResControlMode.BPT_Dynamic_DC_CLResControlMode.EVSEMaximumVoltage.Value = @sysvar::EVSE_Sim::SysEVSE_MaxVoltage;
  $EVSE.ISO20.DC_ChargeLoop_Response.CLResControlMode.BPT_Dynamic_DC_CLResControlMode.EVSEMaximumVoltage.Exponent = 0;
  $EVSE.ISO20.DC_ChargeLoop_Response.CLResControlMode.Dynamic_DC_CLResControlMode.EVSEMaximumVoltage.Value = @sysvar::EVSE_Sim::SysEVSE_MaxVoltage;
  $EVSE.ISO20.DC_ChargeLoop_Response.CLResControlMode.Dynamic_DC_CLResControlMode.EVSEMaximumVoltage.Exponent = 0;
  $EVSE.ISO20.DC_ChargeLoop_Response.CLResControlMode.BPT_Scheduled_DC_CLResControlMode.EVSEMaximumVoltage.Value = @sysvar::EVSE_Sim::SysEVSE_MaxVoltage;
  $EVSE.ISO20.DC_ChargeLoop_Response.CLResControlMode.BPT_Scheduled_DC_CLResControlMode.EVSEMaximumVoltage.Exponent = 0;
  $EVSE.ISO20.DC_ChargeLoop_Response.CLResControlMode.Scheduled_DC_CLResControlMode.EVSEMaximumVoltage.Value = @sysvar::EVSE_Sim::SysEVSE_MaxVoltage;
  $EVSE.ISO20.DC_ChargeLoop_Response.CLResControlMode.Scheduled_DC_CLResControlMode.EVSEMaximumVoltage.Exponent = 0;
  
  //EVSEMaximumChargeCurrent
  $EVSE.ISO20.DC_ChargeLoop_Response.CLResControlMode.BPT_Dynamic_DC_CLResControlMode.EVSEMaximumChargeCurrent.Value = @sysvar::EVSE_Sim::SysEVSE_MaxCurrent;
  $EVSE.ISO20.DC_ChargeLoop_Response.CLResControlMode.BPT_Dynamic_DC_CLResControlMode.EVSEMaximumChargeCurrent.Exponent = 0;
  $EVSE.ISO20.DC_ChargeLoop_Response.CLResControlMode.Dynamic_DC_CLResControlMode.EVSEMaximumChargeCurrent.Value = @sysvar::EVSE_Sim::SysEVSE_MaxCurrent;
  $EVSE.ISO20.DC_ChargeLoop_Response.CLResControlMode.Dynamic_DC_CLResControlMode.EVSEMaximumChargeCurrent.Exponent = 0;
  $EVSE.ISO20.DC_ChargeLoop_Response.CLResControlMode.BPT_Scheduled_DC_CLResControlMode.EVSEMaximumChargeCurrent.Value = @sysvar::EVSE_Sim::SysEVSE_MaxCurrent;
  $EVSE.ISO20.DC_ChargeLoop_Response.CLResControlMode.BPT_Scheduled_DC_CLResControlMode.EVSEMaximumChargeCurrent.Exponent = 0;
  $EVSE.ISO20.DC_ChargeLoop_Response.CLResControlMode.Scheduled_DC_CLResControlMode.EVSEMaximumChargeCurrent.Value = @sysvar::EVSE_Sim::SysEVSE_MaxCurrent;
  $EVSE.ISO20.DC_ChargeLoop_Response.CLResControlMode.Scheduled_DC_CLResControlMode.EVSEMaximumChargeCurrent.Exponent = 0;
  
  //EVSEMaximumDischargePower
  $EVSE.ISO20.DC_ChargeLoop_Response.CLResControlMode.BPT_Dynamic_DC_CLResControlMode.EVSEMaximumDischargePower.Value = - abs(@sysvar::EVSE_Sim::SysEVSE_MaxPowerDC);
  $EVSE.ISO20.DC_ChargeLoop_Response.CLResControlMode.BPT_Dynamic_DC_CLResControlMode.EVSEMaximumDischargePower.Exponent = 3; //Unit: kW
  $EVSE.ISO20.DC_ChargeLoop_Response.CLResControlMode.BPT_Scheduled_DC_CLResControlMode.EVSEMaximumDischargePower.Value = - abs(@sysvar::EVSE_Sim::SysEVSE_MaxPowerDC);
  $EVSE.ISO20.DC_ChargeLoop_Response.CLResControlMode.BPT_Scheduled_DC_CLResControlMode.EVSEMaximumDischargePower.Exponent = 3; //Unit: kW
  
  //EVSEMinimumDischargePower
  $EVSE.ISO20.DC_ChargeLoop_Response.CLResControlMode.BPT_Dynamic_DC_CLResControlMode.EVSEMinimumDischargePower.Value = - abs(@sysvar::EVSE_Sim::SysEVSE_MinPowerDC);
  $EVSE.ISO20.DC_ChargeLoop_Response.CLResControlMode.BPT_Dynamic_DC_CLResControlMode.EVSEMinimumDischargePower.Exponent = 3; //Unit: kW
  $EVSE.ISO20.DC_ChargeLoop_Response.CLResControlMode.BPT_Scheduled_DC_CLResControlMode.EVSEMinimumDischargePower.Value = - abs(@sysvar::EVSE_Sim::SysEVSE_MinPowerDC);
  $EVSE.ISO20.DC_ChargeLoop_Response.CLResControlMode.BPT_Scheduled_DC_CLResControlMode.EVSEMinimumDischargePower.Exponent = 3; //Unit: kW
  
  //EVSEMaximumDischargeCurrent
  $EVSE.ISO20.DC_ChargeLoop_Response.CLResControlMode.BPT_Dynamic_DC_CLResControlMode.EVSEMaximumDischargeCurrent.Value = - abs(@sysvar::EVSE_Sim::SysEVSE_MaxCurrent);
  $EVSE.ISO20.DC_ChargeLoop_Response.CLResControlMode.BPT_Dynamic_DC_CLResControlMode.EVSEMaximumDischargeCurrent.Exponent = 0;
  $EVSE.ISO20.DC_ChargeLoop_Response.CLResControlMode.BPT_Scheduled_DC_CLResControlMode.EVSEMaximumDischargeCurrent.Value = - abs(@sysvar::EVSE_Sim::SysEVSE_MaxCurrent);
  $EVSE.ISO20.DC_ChargeLoop_Response.CLResControlMode.BPT_Scheduled_DC_CLResControlMode.EVSEMaximumDischargeCurrent.Exponent = 0;
  
  //EVSEMinimumVoltage
  $EVSE.ISO20.DC_ChargeLoop_Response.CLResControlMode.BPT_Dynamic_DC_CLResControlMode.EVSEMinimumVoltage.Value = @sysvar::EVSE_Sim::SysEVSE_MinVoltage;
  $EVSE.ISO20.DC_ChargeLoop_Response.CLResControlMode.BPT_Dynamic_DC_CLResControlMode.EVSEMinimumVoltage.Exponent = 0;
  $EVSE.ISO20.DC_ChargeLoop_Response.CLResControlMode.BPT_Scheduled_DC_CLResControlMode.EVSEMinimumVoltage.Value = @sysvar::EVSE_Sim::SysEVSE_MinVoltage;
  $EVSE.ISO20.DC_ChargeLoop_Response.CLResControlMode.BPT_Scheduled_DC_CLResControlMode.EVSEMinimumVoltage.Exponent = 0;
}