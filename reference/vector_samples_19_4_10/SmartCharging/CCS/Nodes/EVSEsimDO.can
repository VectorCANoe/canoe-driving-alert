/*@!Encoding:1252*/
includes
{
  #include "EVSECommonFunctions.cin"
  #include "CharIn_HW_Interface_EVSE.cin"
  #include "SLACTests_EVSE.cin"
  #include "EVSESendFunctions.cin"
}

variables
{
  char gPanelName[5] = "EVSE";
  char gControlName[19] = "sw_ChargeDischarge";
  char gLabelControlMode[15] = "lblControlMode";
  char gCanvasDisableChargeDischarge[26] = "cv_DisableChargeDischarge";
  int EVSEProcessingLoopCounter = 0;
  int EVSESRProcessingLoopCounter = 0;
  char evseConnections[256];

  char responseCode[100];
  const int ProcessingLoopRepetitions = 10;

  int SessionId2[8];
  int SessionId[8];    // Session ID for first session, used throughout all CAPL functions
  
  int AutoFill_header = 0;
  
  msTimer tDelayedStart;
  const cStartAfterEthernetLinkUp = 1000; //[ms]
  msTimer tRestartAfterReset;
  const cRestartAfterReset = 100; //[ms]
  msTimer tResetAfterTCPClose;
  const cResetAfterTCPClose = 1000;
  
  enum eMode
  {
    Ready = 0,
    Charging = 1,
    Error = 2
  };
  
  enum eMode Mode = Ready;
  
  enum SmartChargingMessageIDs
  {
    //ScheduleRenegotiation
    SRACChargeParameterDiscoveryReq = 400,
    SRDCChargeParameterDiscoveryReq = 402,
    SRScheduleExchangeReq = 404,
    SRPowerDeliveryReq = 406,
    //MeteringConfirmation
    MeteringConfirmationReq = 450
  };  
  
  float previousCurrent = 0;
  
  const int cRestartAfterPauseTimeout = 4000;
  msTimer tRestartAfterPause;
  
  const cPreChargeMinimumCurrent = 2;
  msTimer tOpenContactors;
  const dword cOpenContactorsDelay = 500;
  msTimer tActionsAfterContactorOpen;
  const dword cActionsAfterContactorOpenDelay = 100;
  const dword cAdditionMeasurementStopDelay = 100;
  const dword cDeferStopDelay = 3 * cOpenContactorsDelay + cActionsAfterContactorOpenDelay + cAdditionMeasurementStopDelay;
  
  int gCntCableCheck = 0;
}

/**********************************************************************************************************************
 *  ON START/STOP
 *********************************************************************************************************************/
on preStart
{
  EVSE.SetAdHocSendingEnabled.Call(0);
  HV_source_set_U_DC(0); 
  HV_source_set_I_DC(0);
  HV_source_set_output(0);
}

on start
{  
  ST_Init();
  FUNC_Set_DepartureTimeDefaults();
  FUNC_Set_EVSEChargingMode();
  FUNC_Set_ChargeDischargeValues();
  @sysvar::EVSE_Sim::SysEVSE_SelectedControlMode = @sysvar::EVSE_Sim::SysEVSE_SelectedControlMode::NA;
  FUNC_CheckEVSE_BPT_Visibility();
  gSessionStopReqCounter = 0;
  if(isSimulated())
  {
    FUNC_EVSE_PrepareCommunication();
    SetEVSEPluggedInState();
  }
  else
  {
    setTimer(tDelayedStart, cStartAfterEthernetLinkUp); //start simulation after "cStartAfterEthernetLinkUp" to ensure ethernet link is up
  }
}

on timer tDelayedStart
{
  FUNC_EVSE_PrepareCommunication();
  SetEVSEPluggedInState();
}

on timer tRestartAfterReset
{
  @EVSE_Sim::Control::SysEVSE_Reset = 0;
  SetEVSEPluggedOutState();
}

on timer tRestartAfterPause
{
  gSessionStopReqCounter = 0;
  EVSE.StartSimulation.Call();
}

on timer tResetAfterTCPClose
{
  ResetAndRestartEVSE();
}

on preStop
{
  @sysvar::EVSE_Sim::SysEVSE_StopCharging = 0;
  CP_EVSE_set_open_circuit(0);
  PP_EVSE_set_open_circuit(0);
  CP_EVSE_set_Oscillator(0);
  HV_source_set_U_DC(0); 
  HV_source_set_I_DC(0);
  HV_set_AC_relays(0, 0, 0, 0);
  SetChargingStationPicturesVisibility(Ready);
  
  if(!isSimulated())
  {
    deferStop(cDeferStopDelay);
    HV_reduce_VoltageAndCurrent();
    setTimer(tOpenContactors, cOpenContactorsDelay);
  }
}

/**********************************************************************************************************************
 *  ON METHOD
 *********************************************************************************************************************/

on fct_returning EVSE.TransportLayerDisconnectInd
{
  // Execute 'Pause' logic, if it was requested and accepted
  if(gSessionStopReqCounter != 0 
     && $EVSE.ISO20.SessionStop_Request.ChargingSession == _CCS::DataTypes::parISO20ChargingSessionType::Pause
     && $EVSE.ISO20.SessionStop_Response.ResponseCode == _CCS::DataTypes::ISO20ResponseCodeType::OK)
  {
    setTimer(tRestartAfterPause, cRestartAfterPauseTimeout);
    EVSE.StopSimulation.Call();
  }
  else  //reset and restart
  {
    setTimer(tResetAfterTCPClose, cResetAfterTCPClose);
  }
  
  HV_reduce_VoltageAndCurrent();
  setTimer(tOpenContactors, cOpenContactorsDelay);
}

/**********************************************************************************************************************
 *  ON SYSVAR
 *********************************************************************************************************************/
on sysvar Common::SysUserBPTMode
{
  FUNC_Set_EVSEChargingMode();
  FUNC_CheckEVSE_BPT_Visibility();
}

on sysvar EVSE_Sim::SysEVSE_SelectedControlMode
{
  if(@this == @sysvar::EVSE_Sim::SysEVSE_SelectedControlMode::Scheduled)
    setControlProperty(gPanelName, gLabelControlMode, "Text", "Scheduled");
  else if (@this == @sysvar::EVSE_Sim::SysEVSE_SelectedControlMode::Dynamic)
    setControlProperty(gPanelName, gLabelControlMode, "Text", "Dynamic");
  else
    setControlProperty(gPanelName, gLabelControlMode, "Text", "N/A");
  
  SetControlVisibility(gPanelName, gControlName, 1);
  FUNC_CheckEVSE_BPT_Visibility();
}

on sysvar EVSE_Sim::Control::SysEVSE_Reset
{
  if (@this == 1)
  {
    HV_reduce_VoltageAndCurrent();
    setTimer(tOpenContactors, cOpenContactorsDelay);
    ResetAndRestartEVSE();
  }  
}

void ResetAndRestartEVSE()
{
  Reset_EVSE_Values(); 
  FUNC_EVSE_PrepareCommunication();
  @sysvar::EVSE_Sim::SysEVSE_SimState = 2;
  ST_Reset();
  SetEVSEPluggedOutState();
  // allow TCP shutdown to take place before restarting and setting new key
  setTimer(tRestartAfterReset, cRestartAfterReset);
  gCntCableCheck = 0;
}

void SetEVSEPluggedOutState()
{
  Reset_EVSE_Values();   
  FUNC_EVSE_PrepareCommunication();
  CP_EVSE_set_Oscillator(1);
    
  CP_EVSE_set_open_circuit(0);
  PP_EVSE_set_open_circuit(0);
}

void SetEVSEPluggedInState()
{
  FUNC_Set_Attributes();
  CP_EVSE_set_open_circuit(1);
  PP_EVSE_set_open_circuit(1); 
}

void FUNC_CheckEVSE_BPT_Visibility()
{
  if ((@Common::SysUserBPTMode == sysvar::Common::SysUserBPTMode::BPT) 
        && (( @sysvar::EVSE_Sim::SysEVSE_SelectedControlMode == @sysvar::EVSE_Sim::SysEVSE_SelectedControlMode::NA)
          || @sysvar::EVSE_Sim::SysEVSE_SelectedControlMode == @sysvar::EVSE_Sim::SysEVSE_SelectedControlMode::Dynamic))
  {
    /* We don't know yet who decides energy flow direction or EVSE decides */
    SetControlVisibility(gPanelName, gCanvasDisableChargeDischarge, 0);
  }
  else
  {
    /* EV decides energy flow direction or only charging allowed */
    SetControlVisibility(gPanelName, gCanvasDisableChargeDischarge, 1);
  }
}

on sysvar EVSE_Sim::Control::SysEVSE_WaitResume
{
  if (@this == 1)
  {
    EVSE.StopSimulation.Call();
    @sysvar::EVSE_Sim::SysEVSE_SimState = 2;
  }
}

on sysvar Common::SysUserACDERMode
{
  if(@this == 1)
    @Common::SysUserBPTMode = 0;
  
  FUNC_Set_EVSEChargingMode();
}

on sysVar Common::SysUserChargingMode
{
  FUNC_Set_EVSEChargingMode();
  FUNC_Set_ChargeDischargeValues();
}

on sysvar EVSE_Sim::SysEVSE_StopCharging
{
  if(@this == 1)
    EVSE.SetNextEVSENotification.Call(_CCS::DataTypes::EVSENotificationType::Terminate);
  @this = 0;
}

on sysvar EVSE_Sim::Control::SysEVSE_TriggerMeteringConfirmation
{
  if (@this == 1)
  {
    EVSE.SetNextEVSENotification.Call(_CCS::DataTypes::EVSENotificationType::MeteringConfirmation);
  }
  @this = 0;
}

on sysvar EVSE_Sim::Control::SysEVSE_ReturnFailed
{  
  if (@this == 1)
  {
    EVSE.SAP.SetNextResponseCode.Call(_CCS::DataTypes::SAPResponseCodeType::FAILED_NoNegotiation);
    EVSE.ISO20.SetNextResponseCode.Call(_CCS::DataTypes::ISO20ResponseCodeType::FAILED);
    SetChargingStationPicturesVisibility(Error);
  }
  @this = 0;
}

on sysvar EVSE_Sim::Control::SysEVSE_AbortConnection
{
  if (@this == 1)
  {
    Reset_EVSE_Values();
    FUNC_EVSE_PrepareCommunication();
    SetChargingStationPicturesVisibility(Error);
  }
  @this = 0;
}

on sysvar EVSE_Sim::Control::SysEVSE_ChargeDischarge
{
  FUNC_Set_ChargeDischargeValues();
}

on sysvar EVSE_Sim::Control::SysEVSE_TriggerScheduleRenegotiation
{
  EVSE.SetNextEVSENotification.Call(_CCS::DataTypes::parChargeProgressType::ScheduleRenegotiation);
}

on sysvar EVSE_Sim::Control::SysEVSE_PauseStandby
{
  EVSE.SetNextEVSENotification.Call(_CCS::DataTypes::EVSENotificationType::Pause); 
}

on sysvar EVSE_Sim::SysEVSE_PresentCurrent
{
  /* Check if the panels has to be adjusted according to the Presentcurrent value  */
  /* But only change setting if two consecutive values are positive or negative */
  if (@this < 0 && previousCurrent < 0)
  {
    /* negative values */
    if((@sysvar::Common::SysUserBPTMode == sysvar::Common::SysUserBPTMode::BPT) 
      && (@sysvar::EVSE_Sim::Control::SysEVSE_ChargeDischarge == @sysvar::EVSE_Sim::Control::SysEVSE_ChargeDischarge::Charge))
    {
      @sysvar::EVSE_Sim::Control::SysEVSE_ChargeDischarge = @sysvar::EVSE_Sim::Control::SysEVSE_ChargeDischarge::Discharge;
    }
  }
  else if( 0 < @this && 0 < previousCurrent )
  { 
    /* positive values */
    if((@sysvar::Common::SysUserBPTMode == sysvar::Common::SysUserBPTMode::BPT) 
      && (@sysvar::EVSE_Sim::Control::SysEVSE_ChargeDischarge == @sysvar::EVSE_Sim::Control::SysEVSE_ChargeDischarge::Discharge))
    {
      @sysvar::EVSE_Sim::Control::SysEVSE_ChargeDischarge = @sysvar::EVSE_Sim::Control::SysEVSE_ChargeDischarge::Charge;
    }
  }
  previousCurrent = @this;
}

/**********************************************************************************************************************
 *  ON V2G MESSAGE
 *********************************************************************************************************************/

on value_update EVSE.SLAC.CM_SLAC_PARM_REQ
{
  SetChargingStationPicturesVisibility(Charging); 
}

// Manual definition of the parameter set for ServiceDetail Response by the user
on value_change EVSE.ISO20.ServiceDetail_Request
{
  if(IsEVSERolePassive())
    return;
  
  FUNC_Set_ServiceDetailRes();
}

on value_change EVSE.ISO20.AuthorizationSetup_Request
{
  if(IsEVSERolePassive())
    return;
  
  FUNC_Set_AuthorizationSetupRes();
}

on value_update EVSE.ISO20.Authorization_Response
{
  if (EVSEProcessingLoopCounter < ProcessingLoopRepetitions)
  {
    EVSEProcessingLoopCounter++; 
  }
  else
  {
    EVSEProcessingLoopCounter = 0;
    EVSE.ISO20.FinishProcessing.Call();
  }
}

on value_update EVSE.ISO20.SessionSetup_Response
{
  long connectionCount;
  byte sessionIdTemp[8];
  int sessionIdTempInt[8];
  char sessionIdTempChar[17];
  long  lTemp;
  byte tmpByte;
  
  strncpy(evseConnections, "", 256);
  
  memcpy(sessionIdTemp, $EVSE.ISO20.SessionSetup_Response.Header.SessionID);
  
  WriteHex(sessionIdTempChar, sessionIdTemp);
  sessionIdTempChar[16] = '\0';
  strncat(evseConnections, sessionIdTempChar, 256);
  
  SysSetVariableString(sysvar::EVSE_Sim::SysEVSE_Connections, evseConnections);
}

on value_update EVSE.ISO20.DC_ChargeParameterDiscovery_Request
{
  if(IsEVSERolePassive())
    return;
  
  FUNC_Set_EVSEDCLimits_ChargeParameterDiscoveryRes(); 
}

on value_update EVSE.ISO20.AC_ChargeParameterDiscovery_Request
{
  if(IsEVSERolePassive())
    return;
  
  FUNC_Set_EVSEACLimits_ChargeParameterDiscoveryRes(); 
}

on value_update EVSE.ISO20.AC_DER_ChargeParameterDiscovery_Request
{
  if(IsEVSERolePassive())
    return;
  
  FUNC_Set_EVSEACDERLimits_ChargeParameterDiscoveryRes();
}

on fct_called EVSE.OnLastTransmittedMessageIdChanged 
{
  if ($EVSE.OnLastTransmittedMessageIdChanged.LatestCall.lastTxMessageId == _CCS::DataTypes::MessageIdType::ACDERChargeParameterDiscoveryRes)
  {
    EVSE.ISO20.EnableAutoBodyFill.Call(1); // re-enable auto body fill set in ChargeParameterDiscovery_Request
    AutoFill_body = 1;
  }
}

on value_update EVSE.ScheduleRenegotiation.DC_ChargeParameterDiscovery_Request
{
  FUNC_Set_EVSEDCLimits_ScheduleRenegotiationChargeParameterDiscoveryRes(); 
}

on value_update EVSE.ScheduleRenegotiation.AC_ChargeParameterDiscovery_Request
{
  FUNC_Set_EVSEACLimits_ScheduleRenegotiationChargeParameterDiscoveryRes(); 
}

on value_update EVSE.ISO20.ScheduleExchange_Request
{
  if(IsEVSERolePassive())
    return;
  
  FUNC_Set_ScheduleExchangeRes();

  if($EVSE.ISO20.ScheduleExchange_Request.SEReqControlModeElementId == _CCS::DataTypes::parISO20SEReqMode::Dynamic_SEReq)
    @sysvar::EVSE_Sim::SysEVSE_SelectedControlMode = @sysvar::EVSE_Sim::SysEVSE_SelectedControlMode::Dynamic;
  // Scheduled Mode
  else
  {
    @sysvar::EVSE_Sim::SysEVSE_SelectedControlMode = @sysvar::EVSE_Sim::SysEVSE_SelectedControlMode::Scheduled;
  }
}

on value_update EVSE.ScheduleRenegotiation.ScheduleExchange_Request
{
  if($EVSE.ScheduleRenegotiation.ScheduleExchange_Request.SEReqControlModeElementId == _CCS::DataTypes::parISO20SEReqMode::Dynamic_SEReq)
    @sysvar::EVSE_Sim::SysEVSE_SelectedControlMode = @sysvar::EVSE_Sim::SysEVSE_SelectedControlMode::Dynamic;
  else
    @sysvar::EVSE_Sim::SysEVSE_SelectedControlMode = @sysvar::EVSE_Sim::SysEVSE_SelectedControlMode::Scheduled;
  
  if (EVSESRProcessingLoopCounter < ProcessingLoopRepetitions)
  {
    EVSESRProcessingLoopCounter++; 
  }
  else
  {
    EVSESRProcessingLoopCounter = 0;
    EVSE.ScheduleRenegotiation.FinishProcessing.Call();
  }
}

on value_update EVSE.ISO20.ScheduleExchange_Response
{
  if (EVSEProcessingLoopCounter < ProcessingLoopRepetitions)
  {
    EVSEProcessingLoopCounter++; 
  }
  else
  {
    EVSEProcessingLoopCounter = 0;
    EVSE.ISO20.FinishProcessing.Call();
  }
  gCntCableCheck = 0; // Reset for potentially incremented counter
}

on value_update EVSE.ISO20.DC_CableCheck_Request
{
  gCntCableCheck++;
  
  if((HV_measure_DC_U_VeriVolt() < 10) && (gCntCableCheck == 1))
  {
    HV_source_set_output(1); // Close switches of DC power supply
    HV_source_set_I_DC(cPreChargeMinimumCurrent);
    HV_source_set_U_DC(@EVSE_Sim::SysEVSE_MaxVoltage);
  }
  else if(gCntCableCheck == 1)
  {
    WriteLineEx(0, 3, "EVSE: Voltage on cable > 10V. EV contactors appear to be closed.");
    return;
  }
}

on value_update EVSE.ISO20.DC_CableCheck_Response
{
  if(isSimulated())
  {
    if (EVSEProcessingLoopCounter < ProcessingLoopRepetitions)
    {
      EVSEProcessingLoopCounter++;
    }
    else
    {
      EVSEProcessingLoopCounter = 0;
      EVSE.ISO20.FinishProcessing.Call();
    }
  }
  else
  {
    stack long isoState = HV_get_isolation_state(1, 0, 0);
    if(isoState == 1) // valid
    {
      HV_source_set_U_DC(0);
      EVSE.ISO20.FinishProcessing.Call(); // Set EVSE Processing to Finished
    }
    else if(isoState == 2) // fault
    {
      HV_source_set_I_DC(0);
      HV_source_set_U_DC(0);
      HV_source_set_output(0); // Open switches of DC power supply
      
      WriteLineEx(0, 3, "EVSE: Fault result of cable check insulation test.");
      
      @EVSE_Sim::Control::SysEVSE_ReturnFailed = 1;
      EVSE.ISO20.FinishProcessing.Call(); // Set EVSE Processing to Finished
    }
    else // ongoing
    {
      EVSEProcessingLoopCounter++; // Set EVSE Processing to OnGoing
    }
  }
}

on value_update EVSE.ISO20.DC_PreCharge_Request
{
  float evTargetVoltage;
  if(IsEVSERolePassive())
    return;
  
  /* Set requested voltage from EV */
  evTargetVoltage = getValueConsideringExponent($EVSE.ISO20.DC_PreCharge_Request.EVTargetVoltage.Value,$EVSE.ISO20.DC_PreCharge_Request.EVTargetVoltage.Exponent);
  HV_source_set_U_DC(evTargetVoltage < @EVSE_Sim::SysEVSE_MaxVoltage ? evTargetVoltage : @EVSE_Sim::SysEVSE_MaxVoltage);
  HV_source_set_I_DC(cPreChargeMinimumCurrent);
  FUNC_Set_PreChargeRes();
}

on value_update EVSE.ISO20.PowerDelivery_Request
{
  if ($EVSE.ISO20.PowerDelivery_Request.ChargeProgress == _CCS::DataTypes::parChargeProgressType::`Stop
            || $EVSE.ISO20.PowerDelivery_Request.ChargeProgress == _CCS::DataTypes::parChargeProgressType::Standby)
  {
    HV_reduce_VoltageAndCurrent();
  }
}

on value_update EVSE.ISO20.AC_ChargeLoop_Response
{
  if(IsEVSERolePassive())
    return;
  
  FUNC_Set_EVSE_ACChargeLoopValues();
}

on value_update EVSE.ISO20.DC_ChargeLoop_Request
{
  if(IsEVSERolePassive())
    return;
  
  //Mark EVSEStatus as a missing optional element
  ($EVSE.ISO20.DC_ChargeLoop_Response.EVSEStatus).SetInvalid();
  FUNC_Get_EVSE_DCChargeLoopValues();
  
  if( $this.CLReqControlModeElementId == 2 ){
    HV_source_set_U_DC(getValueConsideringExponent($this.CLReqControlMode.Scheduled_DC_CLReqControlMode.EVTargetVoltage.Value, $this.CLReqControlMode.Scheduled_DC_CLReqControlMode.EVTargetVoltage.Exponent));
    HV_source_set_I_DC(getValueConsideringExponent($this.CLReqControlMode.Scheduled_DC_CLReqControlMode.EVTargetCurrent.Value, $this.CLReqControlMode.Scheduled_DC_CLReqControlMode.EVTargetCurrent.Exponent));
  }
  else if($this.CLReqControlModeElementId == 3){
    HV_source_set_U_DC(getValueConsideringExponent($this.CLReqControlMode.BPT_Scheduled_DC_CLReqControlMode.EVTargetVoltage.Value, $this.CLReqControlMode.BPT_Scheduled_DC_CLReqControlMode.EVTargetVoltage.Exponent));
    HV_source_set_I_DC(getValueConsideringExponent($this.CLReqControlMode.BPT_Scheduled_DC_CLReqControlMode.EVTargetCurrent.Value, $this.CLReqControlMode.BPT_Scheduled_DC_CLReqControlMode.EVTargetCurrent.Exponent));
  }
  else{ //Dynamic
    HV_source_set_U_DC(@EVSE_Sim::SysEVSE_PresentVoltage);
    HV_source_set_I_DC(@EVSE_Sim::SysEVSE_PresentCurrent);
  }
}

on value_update EVSE.ISO20.AC_ChargeLoop_Request
{
  if(IsEVSERolePassive())
    return;
  
  FUNC_Get_EVSE_ACChargeLoopValues();
}

on value_update EVSE.ISO20.AC_DER_ChargeLoop_Request
{
  if(IsEVSERolePassive())
    return;
  FUNC_Get_EVSE_ACDERChargeLoopValues();
}

on value_update EVSE.ISO20.DC_ChargeLoop_Response
{
  if(IsEVSERolePassive())
    return;
  
  FUNC_Set_EVSE_DCChargeLoopValues();
}

on value_update EVSE.ISO20.DC_WeldingDetection_Request
{
  HV_reduce_VoltageAndCurrent();
  setTimer(tOpenContactors, cOpenContactorsDelay);  
  HV_source_perform_welding();
}

on value_update EVSE.ISO20.SessionStop_Request
{
  HV_reduce_VoltageAndCurrent();
  setTimer(tOpenContactors, cOpenContactorsDelay);  
  gSessionStopReqCounter++;
}

on value_update EVSE.ISO20.SessionStop_Response
{
  SetChargingStationPicturesVisibility(Ready); 
}

/**********************************************************************************************************************
 *  ON DATA
 *********************************************************************************************************************/
on value_update EVSE.CurrentLinkStatus
{
  if ($EVSE.CurrentLinkStatus == _CCS::DataTypes::Connected)
  {
    @sysvar::EVSE_Sim::SysEVSE_LinkStatus = 1;
  }
  else if ($EVSE.CurrentLinkStatus == _CCS::DataTypes::ReadyToJoin)
  {
    @sysvar::EVSE_Sim::SysEVSE_LinkStatus = 2;
  }
  else
  {
    @sysvar::EVSE_Sim::SysEVSE_LinkStatus = 0;
  }
}

on value_update EVSE.ExpectedCPState
{
  if ($this ==  _CCS::DataTypes::CPStateType::State_B)
   SetChargingStationPicturesVisibility(Charging);
}

on value_update EVSE.Reporting.CCSError
{
  if($EVSE.Reporting.CCSError.LastReceivedMessage.IsValid){
     if(!IsSideStreamMessageReceived())
       SetChargingStationPicturesVisibility(Error);
    }
}

on value_update EVSE.Reporting.EXIError
{
  SetChargingStationPicturesVisibility(Error);
}

/**********************************************************************************************************************
 *  HELPER FUNCTIONS
 *********************************************************************************************************************/
void FUNC_Set_DepartureTimeDefaults()
{
  const int DepartureTimeDefault = 900; //15 min

  $CCS::Simulation::EVSE.ISO20.ScheduleExchange_Response.SEResControlMode.Dynamic_SEResControlMode.DepartureTime =  DepartureTimeDefault;

  $CCS::Simulation::EVSE.ISO20.DC_ChargeLoop_Response.CLResControlMode.Dynamic_DC_CLResControlMode.DepartureTime =  DepartureTimeDefault;
  $CCS::Simulation::EVSE.ISO20.DC_ChargeLoop_Response.CLResControlMode.BPT_Dynamic_DC_CLResControlMode.DepartureTime =  DepartureTimeDefault;
  
  $CCS::Simulation::EVSE.ISO20.AC_ChargeLoop_Response.CLResControlMode.Dynamic_AC_CLResControlMode.DepartureTime =  DepartureTimeDefault;
  $CCS::Simulation::EVSE.ISO20.AC_ChargeLoop_Response.CLResControlMode.BPT_Dynamic_AC_CLResControlMode.DepartureTime =  DepartureTimeDefault;
}

void FUNC_Set_EVSEChargingMode()
{
  if (@sysvar::Common::SysUserChargingMode == sysvar::Common::SysUserChargingMode::AC) 
  {
    /* AC */
    if (@sysvar::Common::SysUserBPTMode == sysvar::Common::SysUserBPTMode::No_BPT) 
    {
      /* No BPT */
      if(@Common::SysUserACDERMode == 1){
        setAttribute(CCS::Simulation::EVSE, CCSBinding::EnergyTransferService, CCSBinding::AC_DER);  
      }
      else{
        setAttribute(CCS::Simulation::EVSE, CCSBinding::EnergyTransferService, CCSBinding::AC);
      }
    }
    else
    {
      /* BPT */
      setAttribute(CCS::Simulation::EVSE, CCSBinding::EnergyTransferService, CCSBinding::AC_BPT);
    }
  }
  else 
  {
    /* DC */
    if (@sysvar::Common::SysUserBPTMode == sysvar::Common::SysUserBPTMode::No_BPT)
    {
      /* No BPT */
      setAttribute(CCS::Simulation::EVSE, CCSBinding::EnergyTransferService, CCSBinding::DC);  
    }
    else
    {
      /* BPT */
      setAttribute(CCS::Simulation::EVSE, CCSBinding::EnergyTransferService, CCSBinding::DC_BPT);
    }
  }  
}

void FUNC_Set_EVSEDCLimits_ScheduleRenegotiationChargeParameterDiscoveryRes()
{
  /* EVSEMaximumChargePower */
  $EVSE.ScheduleRenegotiation.DC_ChargeParameterDiscovery_Response.CPDResEnergyTransferMode.DC_CPDResEnergyTransferMode.EVSEMaximumChargePower.Value = @sysvar::EVSE_Sim::SysEVSE_MaxPowerDC;
  $EVSE.ScheduleRenegotiation.DC_ChargeParameterDiscovery_Response.CPDResEnergyTransferMode.DC_CPDResEnergyTransferMode.EVSEMaximumChargePower.Exponent = 3; //Unit: kW
  $EVSE.ScheduleRenegotiation.DC_ChargeParameterDiscovery_Response.CPDResEnergyTransferMode.BPT_DC_CPDResEnergyTransferMode.EVSEMaximumChargePower.Value = @sysvar::EVSE_Sim::SysEVSE_MaxPowerDC;
  $EVSE.ScheduleRenegotiation.DC_ChargeParameterDiscovery_Response.CPDResEnergyTransferMode.BPT_DC_CPDResEnergyTransferMode.EVSEMaximumChargePower.Exponent = 3; //Unit: kW
  
  /* EVSEMinimumChargePower */
  $EVSE.ScheduleRenegotiation.DC_ChargeParameterDiscovery_Response.CPDResEnergyTransferMode.DC_CPDResEnergyTransferMode.EVSEMinimumChargePower.Value = @sysvar::EVSE_Sim::SysEVSE_MinPowerDC;
  $EVSE.ScheduleRenegotiation.DC_ChargeParameterDiscovery_Response.CPDResEnergyTransferMode.DC_CPDResEnergyTransferMode.EVSEMinimumChargePower.Exponent = 3; //Unit: kW
  $EVSE.ScheduleRenegotiation.DC_ChargeParameterDiscovery_Response.CPDResEnergyTransferMode.BPT_DC_CPDResEnergyTransferMode.EVSEMinimumChargePower.Value = @sysvar::EVSE_Sim::SysEVSE_MinPowerDC;
  $EVSE.ScheduleRenegotiation.DC_ChargeParameterDiscovery_Response.CPDResEnergyTransferMode.BPT_DC_CPDResEnergyTransferMode.EVSEMinimumChargePower.Exponent = 3; //Unit: kW
  
  /* EVSEMaximumChargeCurrent */
  $EVSE.ScheduleRenegotiation.DC_ChargeParameterDiscovery_Response.CPDResEnergyTransferMode.DC_CPDResEnergyTransferMode.EVSEMaximumChargeCurrent.Value = @sysvar::EVSE_Sim::SysEVSE_MaxCurrent;
  $EVSE.ScheduleRenegotiation.DC_ChargeParameterDiscovery_Response.CPDResEnergyTransferMode.DC_CPDResEnergyTransferMode.EVSEMaximumChargeCurrent.Exponent = 0;
  $EVSE.ScheduleRenegotiation.DC_ChargeParameterDiscovery_Response.CPDResEnergyTransferMode.BPT_DC_CPDResEnergyTransferMode.EVSEMaximumChargeCurrent.Value = @sysvar::EVSE_Sim::SysEVSE_MaxCurrent;
  $EVSE.ScheduleRenegotiation.DC_ChargeParameterDiscovery_Response.CPDResEnergyTransferMode.BPT_DC_CPDResEnergyTransferMode.EVSEMaximumChargeCurrent.Exponent = 0;
  
  /* EVSEMaximumVoltage */
  $EVSE.ScheduleRenegotiation.DC_ChargeParameterDiscovery_Response.CPDResEnergyTransferMode.DC_CPDResEnergyTransferMode.EVSEMaximumVoltage.Value = @sysvar::EVSE_Sim::SysEVSE_MaxVoltage;
  $EVSE.ScheduleRenegotiation.DC_ChargeParameterDiscovery_Response.CPDResEnergyTransferMode.DC_CPDResEnergyTransferMode.EVSEMaximumVoltage.Exponent = 0;
  $EVSE.ScheduleRenegotiation.DC_ChargeParameterDiscovery_Response.CPDResEnergyTransferMode.BPT_DC_CPDResEnergyTransferMode.EVSEMaximumVoltage.Value = @sysvar::EVSE_Sim::SysEVSE_MaxVoltage;
  $EVSE.ScheduleRenegotiation.DC_ChargeParameterDiscovery_Response.CPDResEnergyTransferMode.BPT_DC_CPDResEnergyTransferMode.EVSEMaximumVoltage.Exponent = 0;
  
  /* EVSEMinimumVoltage */
  $EVSE.ScheduleRenegotiation.DC_ChargeParameterDiscovery_Response.CPDResEnergyTransferMode.DC_CPDResEnergyTransferMode.EVSEMinimumVoltage.Value = @sysvar::EVSE_Sim::SysEVSE_MinVoltage;
  $EVSE.ScheduleRenegotiation.DC_ChargeParameterDiscovery_Response.CPDResEnergyTransferMode.DC_CPDResEnergyTransferMode.EVSEMinimumVoltage.Exponent = 0;
  $EVSE.ScheduleRenegotiation.DC_ChargeParameterDiscovery_Response.CPDResEnergyTransferMode.BPT_DC_CPDResEnergyTransferMode.EVSEMinimumVoltage.Value = @sysvar::EVSE_Sim::SysEVSE_MinVoltage;
  $EVSE.ScheduleRenegotiation.DC_ChargeParameterDiscovery_Response.CPDResEnergyTransferMode.BPT_DC_CPDResEnergyTransferMode.EVSEMinimumVoltage.Exponent = 0;
  
  /* EVSEMaximumDischargePower */
  $EVSE.ScheduleRenegotiation.DC_ChargeParameterDiscovery_Response.CPDResEnergyTransferMode.BPT_DC_CPDResEnergyTransferMode.EVSEMaximumDischargePower.Value = - abs(@sysvar::EVSE_Sim::SysEVSE_MaxPowerDC);
  $EVSE.ScheduleRenegotiation.DC_ChargeParameterDiscovery_Response.CPDResEnergyTransferMode.BPT_DC_CPDResEnergyTransferMode.EVSEMaximumDischargePower.Exponent = 3; //Unit: kW
  
  /* EVSEMinimumDischargePower */
  $EVSE.ScheduleRenegotiation.DC_ChargeParameterDiscovery_Response.CPDResEnergyTransferMode.BPT_DC_CPDResEnergyTransferMode.EVSEMinimumDischargePower.Value =  - abs(@sysvar::EVSE_Sim::SysEVSE_MinPowerDC);
  $EVSE.ScheduleRenegotiation.DC_ChargeParameterDiscovery_Response.CPDResEnergyTransferMode.BPT_DC_CPDResEnergyTransferMode.EVSEMinimumDischargePower.Exponent = 3; //Unit: kW
  
  /* EVSEMaximumDischargeCurrent */
  $EVSE.ScheduleRenegotiation.DC_ChargeParameterDiscovery_Response.CPDResEnergyTransferMode.BPT_DC_CPDResEnergyTransferMode.EVSEMaximumDischargeCurrent.Value =  - abs(@sysvar::EVSE_Sim::SysEVSE_MaxCurrent);
  $EVSE.ScheduleRenegotiation.DC_ChargeParameterDiscovery_Response.CPDResEnergyTransferMode.BPT_DC_CPDResEnergyTransferMode.EVSEMaximumDischargeCurrent.Exponent = 0;
}

void FUNC_Set_EVSEACLimits_ScheduleRenegotiationChargeParameterDiscoveryRes()
{
  /* EVSEMaximumChargePower */
  $EVSE.ScheduleRenegotiation.AC_ChargeParameterDiscovery_Response.CPDResEnergyTransferMode.AC_CPDResEnergyTransferMode.EVSEMaximumChargePower.Value = @sysvar::EVSE_Sim::SysEVSE_MaxPowerAC;
  $EVSE.ScheduleRenegotiation.AC_ChargeParameterDiscovery_Response.CPDResEnergyTransferMode.AC_CPDResEnergyTransferMode.EVSEMaximumChargePower.Exponent = 3; //Unit: kW
  $EVSE.ScheduleRenegotiation.AC_ChargeParameterDiscovery_Response.CPDResEnergyTransferMode.BPT_AC_CPDResEnergyTransferMode.EVSEMaximumChargePower.Value = @sysvar::EVSE_Sim::SysEVSE_MaxPowerAC;
  $EVSE.ScheduleRenegotiation.AC_ChargeParameterDiscovery_Response.CPDResEnergyTransferMode.BPT_AC_CPDResEnergyTransferMode.EVSEMaximumChargePower.Exponent = 3; //Unit: kW
  
  /* EVSEMaximumChargePower L2 */
  $EVSE.ScheduleRenegotiation.AC_ChargeParameterDiscovery_Response.CPDResEnergyTransferMode.AC_CPDResEnergyTransferMode.EVSEMaximumChargePower_L2.Value = @sysvar::EVSE_Sim::SysEVSE_MaxPowerAC;
  $EVSE.ScheduleRenegotiation.AC_ChargeParameterDiscovery_Response.CPDResEnergyTransferMode.AC_CPDResEnergyTransferMode.EVSEMaximumChargePower_L2.Exponent = 3; //Unit: kW
  $EVSE.ScheduleRenegotiation.AC_ChargeParameterDiscovery_Response.CPDResEnergyTransferMode.BPT_AC_CPDResEnergyTransferMode.EVSEMaximumChargePower_L2.Value = @sysvar::EVSE_Sim::SysEVSE_MaxPowerAC;
  $EVSE.ScheduleRenegotiation.AC_ChargeParameterDiscovery_Response.CPDResEnergyTransferMode.BPT_AC_CPDResEnergyTransferMode.EVSEMaximumChargePower_L2.Exponent = 3; //Unit: kW
  
  /* EVSEMaximumChargePower L3 */
  $EVSE.ScheduleRenegotiation.AC_ChargeParameterDiscovery_Response.CPDResEnergyTransferMode.AC_CPDResEnergyTransferMode.EVSEMaximumChargePower_L3.Value = @sysvar::EVSE_Sim::SysEVSE_MaxPowerAC;
  $EVSE.ScheduleRenegotiation.AC_ChargeParameterDiscovery_Response.CPDResEnergyTransferMode.AC_CPDResEnergyTransferMode.EVSEMaximumChargePower_L3.Exponent = 3; //Unit: kW
  $EVSE.ScheduleRenegotiation.AC_ChargeParameterDiscovery_Response.CPDResEnergyTransferMode.BPT_AC_CPDResEnergyTransferMode.EVSEMaximumChargePower_L3.Value = @sysvar::EVSE_Sim::SysEVSE_MaxPowerAC;
  $EVSE.ScheduleRenegotiation.AC_ChargeParameterDiscovery_Response.CPDResEnergyTransferMode.BPT_AC_CPDResEnergyTransferMode.EVSEMaximumChargePower_L3.Exponent = 3; //Unit: kW
  
  /* EVSEMinimumChargePower */
  $EVSE.ScheduleRenegotiation.AC_ChargeParameterDiscovery_Response.CPDResEnergyTransferMode.AC_CPDResEnergyTransferMode.EVSEMinimumChargePower.Value = @sysvar::EVSE_Sim::SysEVSE_MinPowerAC;
  $EVSE.ScheduleRenegotiation.AC_ChargeParameterDiscovery_Response.CPDResEnergyTransferMode.AC_CPDResEnergyTransferMode.EVSEMinimumChargePower.Exponent = 3; //Unit: kW
  $EVSE.ScheduleRenegotiation.AC_ChargeParameterDiscovery_Response.CPDResEnergyTransferMode.BPT_AC_CPDResEnergyTransferMode.EVSEMinimumChargePower.Value = @sysvar::EVSE_Sim::SysEVSE_MinPowerAC;
  $EVSE.ScheduleRenegotiation.AC_ChargeParameterDiscovery_Response.CPDResEnergyTransferMode.BPT_AC_CPDResEnergyTransferMode.EVSEMinimumChargePower.Exponent = 3; //Unit: kW
  
  /* EVSEMinimumChargePower L2 */
  $EVSE.ScheduleRenegotiation.AC_ChargeParameterDiscovery_Response.CPDResEnergyTransferMode.AC_CPDResEnergyTransferMode.EVSEMinimumChargePower_L2.Value = @sysvar::EVSE_Sim::SysEVSE_MinPowerAC;
  $EVSE.ScheduleRenegotiation.AC_ChargeParameterDiscovery_Response.CPDResEnergyTransferMode.AC_CPDResEnergyTransferMode.EVSEMinimumChargePower_L2.Exponent = 3; //Unit: kW
  $EVSE.ScheduleRenegotiation.AC_ChargeParameterDiscovery_Response.CPDResEnergyTransferMode.BPT_AC_CPDResEnergyTransferMode.EVSEMinimumChargePower_L2.Value = @sysvar::EVSE_Sim::SysEVSE_MinPowerAC;
  $EVSE.ScheduleRenegotiation.AC_ChargeParameterDiscovery_Response.CPDResEnergyTransferMode.BPT_AC_CPDResEnergyTransferMode.EVSEMinimumChargePower_L2.Exponent = 3; //Unit: kW
  
  /* EVSEMinimumChargePower L3 */
  $EVSE.ScheduleRenegotiation.AC_ChargeParameterDiscovery_Response.CPDResEnergyTransferMode.AC_CPDResEnergyTransferMode.EVSEMinimumChargePower_L3.Value = @sysvar::EVSE_Sim::SysEVSE_MinPowerAC;
  $EVSE.ScheduleRenegotiation.AC_ChargeParameterDiscovery_Response.CPDResEnergyTransferMode.AC_CPDResEnergyTransferMode.EVSEMinimumChargePower_L3.Exponent = 3; //Unit: kW
  $EVSE.ScheduleRenegotiation.AC_ChargeParameterDiscovery_Response.CPDResEnergyTransferMode.BPT_AC_CPDResEnergyTransferMode.EVSEMinimumChargePower_L3.Value = @sysvar::EVSE_Sim::SysEVSE_MinPowerAC;
  $EVSE.ScheduleRenegotiation.AC_ChargeParameterDiscovery_Response.CPDResEnergyTransferMode.BPT_AC_CPDResEnergyTransferMode.EVSEMinimumChargePower_L3.Exponent = 3; //Unit: kW

  /* EVSEMaximumDischargePower */
  $EVSE.ScheduleRenegotiation.AC_ChargeParameterDiscovery_Response.CPDResEnergyTransferMode.BPT_AC_CPDResEnergyTransferMode.EVSEMaximumDischargePower.Value = - abs(@sysvar::EVSE_Sim::SysEVSE_MaxPowerAC);
  $EVSE.ScheduleRenegotiation.AC_ChargeParameterDiscovery_Response.CPDResEnergyTransferMode.BPT_AC_CPDResEnergyTransferMode.EVSEMaximumDischargePower.Exponent = 3; //Unit: kW
  
  /* EVSEMaximumDischargePower L2 */
  $EVSE.ScheduleRenegotiation.AC_ChargeParameterDiscovery_Response.CPDResEnergyTransferMode.BPT_AC_CPDResEnergyTransferMode.EVSEMaximumDischargePower_L2.Value = - abs(@sysvar::EVSE_Sim::SysEVSE_MaxPowerAC);
  $EVSE.ScheduleRenegotiation.AC_ChargeParameterDiscovery_Response.CPDResEnergyTransferMode.BPT_AC_CPDResEnergyTransferMode.EVSEMaximumDischargePower_L2.Exponent = 3; //Unit: kW
  
  /* EVSEMaximumDischargePower L3 */
  $EVSE.ScheduleRenegotiation.AC_ChargeParameterDiscovery_Response.CPDResEnergyTransferMode.BPT_AC_CPDResEnergyTransferMode.EVSEMaximumDischargePower_L3.Value = - abs(@sysvar::EVSE_Sim::SysEVSE_MaxPowerAC);
  $EVSE.ScheduleRenegotiation.AC_ChargeParameterDiscovery_Response.CPDResEnergyTransferMode.BPT_AC_CPDResEnergyTransferMode.EVSEMaximumDischargePower_L3.Exponent = 3; //Unit: kW
  
  /* EVSEMinimumDischargePower */
  $EVSE.ScheduleRenegotiation.AC_ChargeParameterDiscovery_Response.CPDResEnergyTransferMode.BPT_AC_CPDResEnergyTransferMode.EVSEMinimumDischargePower.Value = - abs(@sysvar::EVSE_Sim::SysEVSE_MinPowerAC);
  $EVSE.ScheduleRenegotiation.AC_ChargeParameterDiscovery_Response.CPDResEnergyTransferMode.BPT_AC_CPDResEnergyTransferMode.EVSEMinimumDischargePower.Exponent = 3; //Unit: kW
  
  /* EVSEMinimumDischargePower L2 */
  $EVSE.ScheduleRenegotiation.AC_ChargeParameterDiscovery_Response.CPDResEnergyTransferMode.BPT_AC_CPDResEnergyTransferMode.EVSEMinimumDischargePower_L2.Value = - abs(@sysvar::EVSE_Sim::SysEVSE_MinPowerAC);
  $EVSE.ScheduleRenegotiation.AC_ChargeParameterDiscovery_Response.CPDResEnergyTransferMode.BPT_AC_CPDResEnergyTransferMode.EVSEMinimumDischargePower_L2.Exponent = 3; //Unit: kW
  
  /* EVSEMinimumDischargePower L3 */
  $EVSE.ScheduleRenegotiation.AC_ChargeParameterDiscovery_Response.CPDResEnergyTransferMode.BPT_AC_CPDResEnergyTransferMode.EVSEMinimumDischargePower_L3.Value = - abs(@sysvar::EVSE_Sim::SysEVSE_MinPowerAC);
  $EVSE.ScheduleRenegotiation.AC_ChargeParameterDiscovery_Response.CPDResEnergyTransferMode.BPT_AC_CPDResEnergyTransferMode.EVSEMinimumDischargePower_L3.Exponent = 3; //Unit: kW
}

void FUNC_Set_EVSE_ACChargeLoopValues()
{
  if($EVSE.ISO20.AC_ChargeLoop_Response.EVSEStatus.IsValid)
  {
    switch ($EVSE.ISO20.AC_ChargeLoop_Response.EVSEStatus.EVSENotification)
    {
      case _CCS::DataTypes::EVSENotificationType::Pause:
        sysSetVariableString(sysvar::EVSE_Sim::SysEVSE_DCStatusCode, "Pause"); break;
        
      case _CCS::DataTypes::EVSENotificationType::ExitStandby:
         sysSetVariableString(sysvar::EVSE_Sim::SysEVSE_DCStatusCode, "ExitStandby"); break;
        
      case _CCS::DataTypes::EVSENotificationType::Terminate:
        sysSetVariableString(sysvar::EVSE_Sim::SysEVSE_DCStatusCode, "Terminate"); break;
        
      case _CCS::DataTypes::EVSENotificationType::ScheduleRenegotiation:
        sysSetVariableString(sysvar::EVSE_Sim::SysEVSE_DCStatusCode, "ScheduleRenegotiation"); break;
        
      case _CCS::DataTypes::EVSENotificationType::ServiceRenegotiation:
        sysSetVariableString(sysvar::EVSE_Sim::SysEVSE_DCStatusCode, "ServiceRenegotiation"); break;
        
      case _CCS::DataTypes::EVSENotificationType::MeteringConfirmation:
        sysSetVariableString(sysvar::EVSE_Sim::SysEVSE_DCStatusCode, "MeteringConfirmation"); break;     
      
      default:
        sysSetVariableString(sysvar::EVSE_Sim::SysEVSE_DCStatusCode, "unknown StatusCode"); 
    }
  }
}

void FUNC_Set_EVSE_DCChargeLoopValues()
{
  if ($EVSE.ISO20.DC_ChargeLoop_Response.EVSEStatus.IsValid)
  {
    switch ($EVSE.ISO20.DC_ChargeLoop_Response.EVSEStatus.EVSENotification)
    {
      case _CCS::DataTypes::EVSENotificationType::Pause:
        sysSetVariableString(sysvar::EVSE_Sim::SysEVSE_DCStatusCode, "Pause"); break;
        
      case _CCS::DataTypes::EVSENotificationType::ExitStandby:
         sysSetVariableString(sysvar::EVSE_Sim::SysEVSE_DCStatusCode, "ExitStandby"); break;
        
      case _CCS::DataTypes::EVSENotificationType::Terminate:
        sysSetVariableString(sysvar::EVSE_Sim::SysEVSE_DCStatusCode, "Terminate"); break;
        
      case _CCS::DataTypes::EVSENotificationType::ScheduleRenegotiation:
        sysSetVariableString(sysvar::EVSE_Sim::SysEVSE_DCStatusCode, "ScheduleRenegotiation"); break;
        
      case _CCS::DataTypes::EVSENotificationType::ServiceRenegotiation:
        sysSetVariableString(sysvar::EVSE_Sim::SysEVSE_DCStatusCode, "ServiceRenegotiation"); break;
        
      case _CCS::DataTypes::EVSENotificationType::MeteringConfirmation:
        sysSetVariableString(sysvar::EVSE_Sim::SysEVSE_DCStatusCode, "MeteringConfirmation"); break;     
      
      default:
        sysSetVariableString(sysvar::EVSE_Sim::SysEVSE_DCStatusCode, "unknown StatusCode"); 
    }
  }
}

void FUNC_EVSE_PrepareCommunication()
{
  FUNC_Set_Attributes();
     
  // Start Simulation
  FUNC_Set_ChargeDischargeValues();
  EVSE.StartSimulation.Call();
  PP_EVSE_set_resistance(getPPResistance());
  @sysvar::EVSE_Sim::SysEVSE_SimState = 0;
  strncpy(evseConnections, "", 256);
  SysSetVariableString(sysvar::EVSE_Sim::SysEVSE_Connections, evseConnections); 
}

void WriteHex(char outText[], byte data[])
{
  WriteHex(outText, data, elcount(data), "", 0);
}

void WriteHex(char outText[], byte data[], int length)
{
  WriteHex(outText, data, length, "", length);
}

void WriteHexMacId(char outText[], byte data[])
{
  if (elcount(data) < 6)
    return;
  
  WriteHex(outText, data, 6, ":", 1);
}

void WriteHexIPv6(char outText[], byte data[])
{
  if (elcount(data) < 16) return;
  
  WriteHex(outText, data, 16, ":", 2);
}

void WriteHex(char outText[], byte data[], int dataLength, char sep[], int sepEveryXChars)
{
  int i, sepCnt;
  
  if (dataLength <= 0) return;
  if (elcount(outText) <= 0) return;
  
  sepCnt = (sepEveryXChars < 1 ? 1 : sepEveryXChars);
    
  // Clear string
  snprintf(outText, 1, "");
  
  for (i=0; i< dataLength; i++)
  {
    // Append Byte as Hex
    snprintf(outText, elcount(outText), "%s%02X", outText, data[i]); 
    
    // Append Separator
    if (i < dataLength-1)
    {
      if (((i+1)%sepCnt) == 0)
      {
        snprintf(outText, elcount(outText), "%s%s", outText, sep);
      }
    }
  }       
}

void FUNC_Set_ChargeDischargeValues()
{
  int leadingSign;
  leadingSign = 1;
  
  //If BPT enabled (ChargeDischarge button shown) and Discharge selected
  if((@sysvar::Common::SysUserBPTMode == sysvar::Common::SysUserBPTMode::BPT) 
    && (@sysvar::EVSE_Sim::Control::SysEVSE_ChargeDischarge == @sysvar::EVSE_Sim::Control::SysEVSE_ChargeDischarge::Discharge))
  {
    leadingSign = -1;
  }
  
  //Make sure that the correct leading sign is used
  if ((@sysvar::Common::SysUserChargingMode == sysvar::Common::SysUserChargingMode::AC)) 
  {
    /* AC_BPT */
    @sysvar::EVSE_Sim::SysEVSE_PresentPower = abs(@sysvar::EVSE_Sim::SysEVSE_PresentPower) * leadingSign;
    @sysvar::EVSE_Sim::SysEVSE_PresentPower_L2 = abs(@sysvar::EVSE_Sim::SysEVSE_PresentPower_L2) * leadingSign;
    @sysvar::EVSE_Sim::SysEVSE_PresentPower_L3 = abs(@sysvar::EVSE_Sim::SysEVSE_PresentPower_L3) * leadingSign;    
  }
  
  if ((@sysvar::Common::SysUserChargingMode == sysvar::Common::SysUserChargingMode::DC)) 
  {   
    /* DC_BPT */
    double current;     
    current = HV_measure_DC_I();
    HV_source_set_I_DC( abs(current) * leadingSign );    
  } 
}

void FUNC_Set_Attributes()
{
  reReadSharedAttributes();
  
  // Set Processing    
  if (@sysvar::Common::SysUseProcessing == 1){
    setAttribute(CCS::Simulation::EVSE, CCSBinding::ProcessingLooping, CCSBinding::Enabled); 
    SetControlForeColor(gPanelName, "TProcessing",  MakeRGB(0, 0, 255)); 
  }
  else{
    setAttribute(CCS::Simulation::EVSE, CCSBinding::ProcessingLooping, CCSBinding::Disabled); 
  }
}

void SetChargingStationPicturesVisibility(int Mode)
{
  If(Mode == Ready)
  {
   SetControlVisibility(gPanelName, "pictureChargingStationReady", 1);
   SetControlVisibility(gPanelName, "pictureChargingStationCharging", 0);
   SetControlVisibility(gPanelName, "pictureChargingStationError", 0);
  }
  else If(Mode == Charging)
  {
   SetControlVisibility(gPanelName, "pictureChargingStationReady", 0);
   SetControlVisibility(gPanelName, "pictureChargingStationCharging", 1);
   SetControlVisibility(gPanelName, "pictureChargingStationError", 0);
  }
  else If(Mode == Error)
  {
   SetControlVisibility(gPanelName, "pictureChargingStationReady", 0);
   SetControlVisibility(gPanelName, "pictureChargingStationCharging", 0);
   SetControlVisibility(gPanelName, "pictureChargingStationError", 1);
  }
}

int IsSideStreamMessageReceived()
{
 if(($EVSE.Reporting.CCSError.LastReceivedMessage == SRACChargeParameterDiscoveryReq)||
 ($EVSE.Reporting.CCSError.LastReceivedMessage == SRDCChargeParameterDiscoveryReq)||
 ($EVSE.Reporting.CCSError.LastReceivedMessage == SRScheduleExchangeReq)||
 ($EVSE.Reporting.CCSError.LastReceivedMessage == SRPowerDeliveryReq)||
 ($EVSE.Reporting.CCSError.LastReceivedMessage == MeteringConfirmationReq))
  return 1;
 
  return 0;
}

on value_update EVSE.StimDutyCycle
{
  CP_EVSE_set_Dutycycle($EVSE.StimDutyCycle);
}

on value_update EVSE.StimCPState
{
  switch ($EVSE.StimCPState)
  {
    case _CCS::DataTypes::CPStateType::State_A:
      CP_EVSE_set_Voltage(12);
      SetChargingStationPicturesVisibility(Ready);     
      break;
    case _CCS::DataTypes::CPStateType::State_B:
      SetChargingStationPicturesVisibility(Charging);
      break;
    case _CCS::DataTypes::CPStateType::State_E:
      CP_EVSE_set_Voltage(0);
      CP_EVSE_set_Dutycycle(100);
      break;
    case _CCS::DataTypes::CPStateType::State_F:
      CP_EVSE_set_Voltage(-12);
      CP_EVSE_set_Dutycycle(0);
      break;
    default:
      // Output.WriteLine("EVSE: 'OnStimCPStateChanged' called wih invalid value!");
      // other states not supported (set by EV)
      break;
  }
}

/**********************************************************************************************************************
 *  HV control
 *********************************************************************************************************************/

on timer tActionsAfterContactorOpen
{
  HV_ActionsAfterContactorOpen();
}

on timer tOpenContactors
{
  if(abs(HV_measure_DC_I()) > 5)
  {
    HV_reduce_VoltageAndCurrent();
    setTimer(tOpenContactors, cOpenContactorsDelay);
  }
  else
  {
    HV_OpenContactors();
    setTimer(tActionsAfterContactorOpen, cActionsAfterContactorOpenDelay);
  }
}

void HV_reduce_VoltageAndCurrent()
{
  if(abs(HV_measure_DC_I()) > 5)
    HV_source_set_I_DC(cPreChargeMinimumCurrent);
  HV_source_set_U_DC(HV_measure_DC_U_VeriVolt());
}

void HV_OpenContactors()
{
  HV_source_set_output(0); // Open switches of DC power supply
}

void HV_ActionsAfterContactorOpen()
{
  HV_source_set_I_DC(0);
  HV_source_set_U_DC(0);
  
  ST_Reset();
}

double getValueConsideringExponent(int value, int exponent)
{
  return (value * _pow(10, exponent)); 
}