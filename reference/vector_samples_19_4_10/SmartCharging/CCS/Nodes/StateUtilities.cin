/*@!Encoding:1252*/

// Helper function to check if User selected ISO-15118-20 schema
int IsSchemaISO_20_Selected()
{
  if(@sysvar::Common::SysUserSchema == @sysvar::Common::SysUserSchema::ISO_20)
  {
    return 1;
  }

  return 0;
}

// Helper function to check if User selected ISO-15118-2 schema
int IsSchemaISO_2_Selected()
{
  if(@sysvar::Common::SysUserSchema == @sysvar::Common::SysUserSchema::ISO_2)
  {
    return 1;
  }

  return 0;
}
