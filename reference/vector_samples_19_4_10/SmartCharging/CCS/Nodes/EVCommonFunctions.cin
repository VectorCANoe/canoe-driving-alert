/*@!Encoding:1252*/
variables
{
  int isPassive = 0;
  
  const SystemPageOfWriteWindow = 0;
  const Warning = 2;
  int gSessionStopResCounter = 0;
  int matchingParameterSetID_BPT = -1;
  int AutoFill_body = 0;
  const long cBatteryCapacityInWh = 80000;
  const float cTargetSOC = 80.0;
  const float cMinimumSOC = 20.0;
  const int cRationalNumberMaxValue = 32767; // sint16 MaxValue
}

on sysvar Common::SysTLSEnabled
{
  setTLSAttribute();
}

on sysvar Common::SysUserAuthorizationMode
{
  setAuthorizationMode(); 
}

int IsEVRolePassive()
{
  if((@sysVar::Test::SysTestControlledEntity != 1) && (@Test::SysTestApplyControlMode == 1))
    return 1;
  
  return 0;
}

void ResetVariables()
{
  gSessionStopResCounter = 0;
  matchingParameterSetID_BPT = -1;
  EVProcessingLoopCounter = 0;
  EVSRProcessingLoopCounter = 0;
}

reReadAttributes()
{
  setControlMode();
  setTLSAttribute();
  setAuthorizationMode();
  setCertHandlingAttribute();
}

setControlMode()
{
  if (@sysvar::EV_Sim::Control::SysEV_ControlModeDynamic == @sysvar::EV_Sim::Control::SysEV_ControlModeDynamic::Dynamic){
    setAttribute(CCS::Simulation::EV, CCSBinding::EV::ControlMode, CCSBinding::Dynamic);
  }
  else
  {
    setAttribute(CCS::Simulation::EV, CCSBinding::EV::ControlMode, CCSBinding::Scheduled);
  }
}

setAuthorizationMode()
{
  if (@sysvar::Common::SysUserAuthorizationMode == sysvar::Common::SysUserAuthorizationMode::EIM){
    setAttribute(CCS::Simulation::EV, CCSBinding::EV::AuthorizationMode, 0);
  }
  else{
    setAttribute(CCS::Simulation::EV, CCSBinding::EV::AuthorizationMode, 1); //PnC
  }
}

setTLSAttribute()
{
  if (@sysVar::Common::SysTLSEnabled == @sysvar::Common::SysTLSEnabled::TLSEnabled){
    setAttribute(CCS::Simulation::EV, CCSBinding::TLS, CCSBinding::TLSEnabled); 
  }
  else{
    setAttribute(CCS::Simulation::EV, CCSBinding::TLS, CCSBinding::TLSDisabled); 
  }
}

setCertHandlingAttribute()
{
  if (@sysvar::EV_Sim::Control::SysEV_CertificateInstallation == 1){
    setAttribute(CCS::Simulation::EV, CCSBinding::EV::CertificateHandling, CCSBinding::Installation);
  }
  else{
    setAttribute(CCS::Simulation::EV, CCSBinding::EV::CertificateHandling, CCSBinding::None);
  }
}

int GetCorrespondingMessageControlModeForSelectedControlMode()
{
  if (@sysvar::EV_Sim::Control::SysEV_ControlModeDynamic == @sysvar::EV_Sim::Control::SysEV_ControlModeDynamic::Dynamic){
    return _CCS::DataTypes::ControlModeType::Dynamic;
  }
  else{
    return _CCS::DataTypes::ControlModeType::Scheduled;
  }
}

int GetCorrespondingMessageServiceIDForSelectedChargingMode_Downgraded()
{
  return _GetCorrespondingMessageServiceIDForSelectedChargingMode(@sysvar::Common::SysUserChargingMode, @sysvar::Common::SysUserBPTMode::No_BPT);
}

int GetCorrespondingMessageServiceIDForSelectedChargingMode()
{
  return _GetCorrespondingMessageServiceIDForSelectedChargingMode(@sysvar::Common::SysUserChargingMode, @sysvar::Common::SysUserBPTMode);
}

int _GetCorrespondingMessageServiceIDForSelectedChargingMode(int chargingMode, int bptMode)
{
  if (chargingMode == sysvar::Common::SysUserChargingMode::AC) 
  {
    /* AC */
    if (bptMode == sysvar::Common::SysUserBPTMode::No_BPT)
    {
      /* NO BPT */
      if(@Common::SysUserACDERMode == 1)
        /* AC_DER */
        return _CCS::DataTypes::ServiceIDType::AC_DER; 
      else
        return _CCS::DataTypes::ServiceIDType::AC;
    }
    else
    {
      /* BPT */
      return _CCS::DataTypes::ServiceIDType::AC_BPT;
    }
  }
  else 
  {
    /* DC */
    if (bptMode == sysvar::Common::SysUserBPTMode::No_BPT)
    {
      /* No BPT */
      return _CCS::DataTypes::ServiceIDType::DC;
    }
    else
    {
      /* BPT */
      return _CCS::DataTypes::ServiceIDType::DC_BPT;
    }
  }
}

on fct_called EV.OnPreSendMessageIdChanged
{
  if(this.txMessageId == _CCS::DataTypes::MessageIdType::ServiceSelectionReq)
  {
    // Disable AutoBodyFill for manual definition of the selected parameter set and EnergyTransferService
    if (AutoFill_body == 1)
    {
      EV.EnableAutoBodyFill.Call(0);
      AutoFill_body = 0;
    }
  }
}

ServiceSelection()
{
  int it;
  int selectedControlMode;
  int selectedServiceID;
  int selectedServiceIDDowngraded;
  
  selectedControlMode = GetCorrespondingMessageControlModeForSelectedControlMode();
  selectedServiceID = GetCorrespondingMessageServiceIDForSelectedChargingMode();
  selectedServiceIDDowngraded = GetCorrespondingMessageServiceIDForSelectedChargingMode_Downgraded();

  if ($EV.ISO20.ServiceDetail_Response.ServiceID == selectedServiceID 
        || $EV.ISO20.ServiceDetail_Response.ServiceID == selectedServiceIDDowngraded)
  {
    switch($EV.ISO20.ServiceDetail_Response.ServiceID)
    {
      case 1: //AC
        {
          if(matchingParameterSetID_BPT < 0) // Only overwrite if matching BPT has not been found (yet)
          {
            for(it = 0; it <= $EV.ISO20.ServiceDetail_Response.ServiceParameterList.ParameterSet.length; it++)
            {
              if($EV.ISO20.ServiceDetail_Response.ServiceParameterList.ParameterSet[it].Parameter.AC.ControlMode == selectedControlMode) 
              {
                $EV.ISO20.ServiceSelection_Request.SelectedEnergyTransferService.ServiceID = $EV.ISO20.ServiceDetail_Response.ServiceID;
                $EV.ISO20.ServiceSelection_Request.SelectedEnergyTransferService.ParameterSetID = $EV.ISO20.ServiceDetail_Response.ServiceParameterList.ParameterSet[it].ParameterSetID;
                break;
              }
            }
          }
        }
        break;
      case 2: //DC
        {
          if(matchingParameterSetID_BPT < 0) // Only overwrite if matching BPT has not been found (yet)
          {
            for(it = 0; it < $EV.ISO20.ServiceDetail_Response.ServiceParameterList.ParameterSet.length; it++)
            {
              if($EV.ISO20.ServiceDetail_Response.ServiceParameterList.ParameterSet[it].Parameter.DC.ControlMode == selectedControlMode) 
              {
                $EV.ISO20.ServiceSelection_Request.SelectedEnergyTransferService.ServiceID = $EV.ISO20.ServiceDetail_Response.ServiceID;
                $EV.ISO20.ServiceSelection_Request.SelectedEnergyTransferService.ParameterSetID = $EV.ISO20.ServiceDetail_Response.ServiceParameterList.ParameterSet[it].ParameterSetID;
                break;
              }
            }
          }
        }
        break;
      case 5: //AC_BPT
        {
          for(it = 0; it < $EV.ISO20.ServiceDetail_Response.ServiceParameterList.ParameterSet.length; it++)
          {
            if($EV.ISO20.ServiceDetail_Response.ServiceParameterList.ParameterSet[it].Parameter.AC_BPT.ControlMode == selectedControlMode) 
            {
              $EV.ISO20.ServiceSelection_Request.SelectedEnergyTransferService.ServiceID = $EV.ISO20.ServiceDetail_Response.ServiceID;
              $EV.ISO20.ServiceSelection_Request.SelectedEnergyTransferService.ParameterSetID = $EV.ISO20.ServiceDetail_Response.ServiceParameterList.ParameterSet[it].ParameterSetID;
              matchingParameterSetID_BPT = $EV.ISO20.ServiceDetail_Response.ServiceParameterList.ParameterSet[it].ParameterSetID;
              break;
            }
          }
        }
        break;
      case 6: //DC_BPT
        {
          for(it = 0; it < $EV.ISO20.ServiceDetail_Response.ServiceParameterList.ParameterSet.length; it++)
          {
            if($EV.ISO20.ServiceDetail_Response.ServiceParameterList.ParameterSet[it].Parameter.DC_BPT.ControlMode == selectedControlMode)
            {
              $EV.ISO20.ServiceSelection_Request.SelectedEnergyTransferService.ServiceID = $EV.ISO20.ServiceDetail_Response.ServiceID;
              $EV.ISO20.ServiceSelection_Request.SelectedEnergyTransferService.ParameterSetID = $EV.ISO20.ServiceDetail_Response.ServiceParameterList.ParameterSet[it].ParameterSetID;
              break;
            }
          }
        }
        break;
      case 10: //AC_DER
        {
          for(it = 0; it < $EV.ISO20.ServiceDetail_Response.ServiceParameterList.ParameterSet.length; it++)
          {
            if($EV.ISO20.ServiceDetail_Response.ServiceParameterList.ParameterSet[it].Parameter.AC_DER.ControlMode == selectedControlMode)
            {
              $EV.ISO20.ServiceSelection_Request.SelectedEnergyTransferService.ServiceID = $EV.ISO20.ServiceDetail_Response.ServiceID;
              $EV.ISO20.ServiceSelection_Request.SelectedEnergyTransferService.ParameterSetID = $EV.ISO20.ServiceDetail_Response.ServiceParameterList.ParameterSet[it].ParameterSetID;
              matchingParameterSetID_BPT = $EV.ISO20.ServiceDetail_Response.ServiceParameterList.ParameterSet[it].ParameterSetID;
              break;
            }
          }
        }
        break;
      default:// no charge mode
        {
          writeLineEx(SystemPageOfWriteWindow , Warning,"EV: No matching ParameterSetID was found. The default ParameterSetID value is used in the ServiceSelectionReq.");
        }
        break;
    }
  }
}

void FUNC_Set_EVDCLimits_ChargeParameterDiscoveryReq()
{  
  /* EVMaximumChargePower */
  $EV.ISO20.DC_ChargeParameterDiscovery_Request.CPDReqEnergyTransferMode.DC_CPDReqEnergyTransferMode.EVMaximumChargePower.Value = @sysvar::EV_Sim::SysEV_MaxPowerDC;
  $EV.ISO20.DC_ChargeParameterDiscovery_Request.CPDReqEnergyTransferMode.DC_CPDReqEnergyTransferMode.EVMaximumChargePower.Exponent = 3; //Unit: kW
  $EV.ISO20.DC_ChargeParameterDiscovery_Request.CPDReqEnergyTransferMode.BPT_DC_CPDReqEnergyTransferMode.EVMaximumChargePower.Value = @sysvar::EV_Sim::SysEV_MaxPowerDC;
  $EV.ISO20.DC_ChargeParameterDiscovery_Request.CPDReqEnergyTransferMode.BPT_DC_CPDReqEnergyTransferMode.EVMaximumChargePower.Exponent = 3; //Unit: kW
  
  /* EVMaximumVoltage */
  $EV.ISO20.DC_ChargeParameterDiscovery_Request.CPDReqEnergyTransferMode.DC_CPDReqEnergyTransferMode.EVMaximumVoltage.Value = @sysvar::EV_Sim::SysEV_MaxVoltage;
  $EV.ISO20.DC_ChargeParameterDiscovery_Request.CPDReqEnergyTransferMode.DC_CPDReqEnergyTransferMode.EVMaximumVoltage.Exponent = 0;
  $EV.ISO20.DC_ChargeParameterDiscovery_Request.CPDReqEnergyTransferMode.BPT_DC_CPDReqEnergyTransferMode.EVMaximumVoltage.Value= @sysvar::EV_Sim::SysEV_MaxVoltage;
  $EV.ISO20.DC_ChargeParameterDiscovery_Request.CPDReqEnergyTransferMode.BPT_DC_CPDReqEnergyTransferMode.EVMaximumVoltage.Exponent = 0;
  
  /* EVMaximumChargeCurrent */
  $EV.ISO20.DC_ChargeParameterDiscovery_Request.CPDReqEnergyTransferMode.DC_CPDReqEnergyTransferMode.EVMaximumChargeCurrent.Value = @sysvar::EV_Sim::SysEV_MaxCurrent;
  $EV.ISO20.DC_ChargeParameterDiscovery_Request.CPDReqEnergyTransferMode.DC_CPDReqEnergyTransferMode.EVMaximumChargeCurrent.Exponent = 0;
  $EV.ISO20.DC_ChargeParameterDiscovery_Request.CPDReqEnergyTransferMode.BPT_DC_CPDReqEnergyTransferMode.EVMaximumChargeCurrent.Value = @sysvar::EV_Sim::SysEV_MaxCurrent;
  $EV.ISO20.DC_ChargeParameterDiscovery_Request.CPDReqEnergyTransferMode.BPT_DC_CPDReqEnergyTransferMode.EVMaximumChargeCurrent.Exponent = 0;
  
  /* EVMinimumChargeCurrent */
  $EV.ISO20.DC_ChargeParameterDiscovery_Request.CPDReqEnergyTransferMode.DC_CPDReqEnergyTransferMode.EVMinimumChargeCurrent.Value = @sysvar::EV_Sim::SysEV_MinCurrent;
  $EV.ISO20.DC_ChargeParameterDiscovery_Request.CPDReqEnergyTransferMode.DC_CPDReqEnergyTransferMode.EVMinimumChargeCurrent.Exponent = 0;
  $EV.ISO20.DC_ChargeParameterDiscovery_Request.CPDReqEnergyTransferMode.BPT_DC_CPDReqEnergyTransferMode.EVMinimumChargeCurrent.Value = @sysvar::EV_Sim::SysEV_MinCurrent;
  $EV.ISO20.DC_ChargeParameterDiscovery_Request.CPDReqEnergyTransferMode.BPT_DC_CPDReqEnergyTransferMode.EVMinimumChargeCurrent.Exponent = 0;
  
  /* EVMaximumDischargePower */
  $EV.ISO20.DC_ChargeParameterDiscovery_Request.CPDReqEnergyTransferMode.BPT_DC_CPDReqEnergyTransferMode.EVMaximumDischargePower.Value = - abs(@sysvar::EV_Sim::SysEV_MaxPowerDC);
  $EV.ISO20.DC_ChargeParameterDiscovery_Request.CPDReqEnergyTransferMode.BPT_DC_CPDReqEnergyTransferMode.EVMaximumDischargePower.Exponent = 3; //Unit: kW

  /* EVMaximumDischargeCurrent */
  $EV.ISO20.DC_ChargeParameterDiscovery_Request.CPDReqEnergyTransferMode.BPT_DC_CPDReqEnergyTransferMode.EVMaximumDischargeCurrent.Value = - abs(@sysvar::EV_Sim::SysEV_MaxCurrent);
  $EV.ISO20.DC_ChargeParameterDiscovery_Request.CPDReqEnergyTransferMode.BPT_DC_CPDReqEnergyTransferMode.EVMaximumDischargeCurrent.Exponent = 0;  
  
  /* EVMinimumDischargeCurrent */
  $EV.ISO20.DC_ChargeParameterDiscovery_Request.CPDReqEnergyTransferMode.BPT_DC_CPDReqEnergyTransferMode.EVMinimumDischargeCurrent.Value = - abs(@sysvar::EV_Sim::SysEV_MinCurrent);
  $EV.ISO20.DC_ChargeParameterDiscovery_Request.CPDReqEnergyTransferMode.BPT_DC_CPDReqEnergyTransferMode.EVMinimumDischargeCurrent.Exponent = 0;
}

void FUNC_Set_EVACLimits_ChargeParameterDiscoveryReq()
{  
  /* EVMaximumChargePower */
  $EV.ISO20.AC_ChargeParameterDiscovery_Request.CPDReqEnergyTransferMode.AC_CPDReqEnergyTransferMode.EVMaximumChargePower.Value = @sysvar::EV_Sim::SysEV_MaxPowerAC;
  $EV.ISO20.AC_ChargeParameterDiscovery_Request.CPDReqEnergyTransferMode.AC_CPDReqEnergyTransferMode.EVMaximumChargePower.Exponent = 3; //Unit: kW
  $EV.ISO20.AC_ChargeParameterDiscovery_Request.CPDReqEnergyTransferMode.BPT_AC_CPDReqEnergyTransferMode.EVMaximumChargePower.Value = @sysvar::EV_Sim::SysEV_MaxPowerAC;
  $EV.ISO20.AC_ChargeParameterDiscovery_Request.CPDReqEnergyTransferMode.BPT_AC_CPDReqEnergyTransferMode.EVMaximumChargePower.Exponent = 3; //Unit: kW
    
  /* EVMaximumChargePower L2 */
  $EV.ISO20.AC_ChargeParameterDiscovery_Request.CPDReqEnergyTransferMode.AC_CPDReqEnergyTransferMode.EVMaximumChargePower_L2.Value = @sysvar::EV_Sim::SysEV_MaxPowerAC;
  $EV.ISO20.AC_ChargeParameterDiscovery_Request.CPDReqEnergyTransferMode.AC_CPDReqEnergyTransferMode.EVMaximumChargePower_L2.Exponent = 3; //Unit: kW
  $EV.ISO20.AC_ChargeParameterDiscovery_Request.CPDReqEnergyTransferMode.BPT_AC_CPDReqEnergyTransferMode.EVMaximumChargePower_L2.Value = @sysvar::EV_Sim::SysEV_MaxPowerAC;
  $EV.ISO20.AC_ChargeParameterDiscovery_Request.CPDReqEnergyTransferMode.BPT_AC_CPDReqEnergyTransferMode.EVMaximumChargePower_L2.Exponent = 3; //Unit: kW
  
  /* EVMaximumChargePower L3 */
  $EV.ISO20.AC_ChargeParameterDiscovery_Request.CPDReqEnergyTransferMode.AC_CPDReqEnergyTransferMode.EVMaximumChargePower_L3.Value = @sysvar::EV_Sim::SysEV_MaxPowerAC;
  $EV.ISO20.AC_ChargeParameterDiscovery_Request.CPDReqEnergyTransferMode.AC_CPDReqEnergyTransferMode.EVMaximumChargePower_L3.Exponent = 3; //Unit: kW
  $EV.ISO20.AC_ChargeParameterDiscovery_Request.CPDReqEnergyTransferMode.BPT_AC_CPDReqEnergyTransferMode.EVMaximumChargePower_L3.Value = @sysvar::EV_Sim::SysEV_MaxPowerAC;
  $EV.ISO20.AC_ChargeParameterDiscovery_Request.CPDReqEnergyTransferMode.BPT_AC_CPDReqEnergyTransferMode.EVMaximumChargePower_L3.Exponent = 3; //Unit: kW
  
  /* EVMaximumDischargePower */
  $EV.ISO20.AC_ChargeParameterDiscovery_Request.CPDReqEnergyTransferMode.BPT_AC_CPDReqEnergyTransferMode.EVMaximumDischargePower.Value = - abs(@sysvar::EV_Sim::SysEV_MaxPowerAC);
  $EV.ISO20.AC_ChargeParameterDiscovery_Request.CPDReqEnergyTransferMode.BPT_AC_CPDReqEnergyTransferMode.EVMaximumDischargePower.Exponent = 3; //Unit: kW

  /* EVMaximumDischargePower L2 */
  $EV.ISO20.AC_ChargeParameterDiscovery_Request.CPDReqEnergyTransferMode.BPT_AC_CPDReqEnergyTransferMode.EVMaximumDischargePower_L2.Value = - abs(@sysvar::EV_Sim::SysEV_MaxPowerAC);
  $EV.ISO20.AC_ChargeParameterDiscovery_Request.CPDReqEnergyTransferMode.BPT_AC_CPDReqEnergyTransferMode.EVMaximumDischargePower_L2.Exponent = 3; //Unit: kW
  
  /* EVMaximumDischargePower L3 */
  $EV.ISO20.AC_ChargeParameterDiscovery_Request.CPDReqEnergyTransferMode.BPT_AC_CPDReqEnergyTransferMode.EVMaximumDischargePower_L3.Value = - abs(@sysvar::EV_Sim::SysEV_MaxPowerAC);
  $EV.ISO20.AC_ChargeParameterDiscovery_Request.CPDReqEnergyTransferMode.BPT_AC_CPDReqEnergyTransferMode.EVMaximumDischargePower_L3.Exponent = 3; //Unit: kW
  
  /* EVMinimumChargePower */
  $EV.ISO20.AC_ChargeParameterDiscovery_Request.CPDReqEnergyTransferMode.AC_CPDReqEnergyTransferMode.EVMinimumChargePower.Value = @sysvar::EV_Sim::SysEV_MinPowerAC;
  $EV.ISO20.AC_ChargeParameterDiscovery_Request.CPDReqEnergyTransferMode.AC_CPDReqEnergyTransferMode.EVMinimumChargePower.Exponent = 3; //Unit: kW
  $EV.ISO20.AC_ChargeParameterDiscovery_Request.CPDReqEnergyTransferMode.BPT_AC_CPDReqEnergyTransferMode.EVMinimumChargePower.Value = @sysvar::EV_Sim::SysEV_MinPowerAC;
  $EV.ISO20.AC_ChargeParameterDiscovery_Request.CPDReqEnergyTransferMode.BPT_AC_CPDReqEnergyTransferMode.EVMinimumChargePower.Exponent = 3; //Unit: kW
  
  /* EVMinimumChargePower L2 */
  $EV.ISO20.AC_ChargeParameterDiscovery_Request.CPDReqEnergyTransferMode.AC_CPDReqEnergyTransferMode.EVMinimumChargePower_L2.Value = @sysvar::EV_Sim::SysEV_MinPowerAC;
  $EV.ISO20.AC_ChargeParameterDiscovery_Request.CPDReqEnergyTransferMode.AC_CPDReqEnergyTransferMode.EVMinimumChargePower_L2.Exponent = 3; //Unit: kW
  $EV.ISO20.AC_ChargeParameterDiscovery_Request.CPDReqEnergyTransferMode.BPT_AC_CPDReqEnergyTransferMode.EVMinimumChargePower_L2.Value = @sysvar::EV_Sim::SysEV_MinPowerAC;
  $EV.ISO20.AC_ChargeParameterDiscovery_Request.CPDReqEnergyTransferMode.BPT_AC_CPDReqEnergyTransferMode.EVMinimumChargePower_L2.Exponent = 3; //Unit: kW
  
  /* EVMinimumChargePower L3 */
  $EV.ISO20.AC_ChargeParameterDiscovery_Request.CPDReqEnergyTransferMode.AC_CPDReqEnergyTransferMode.EVMinimumChargePower_L3.Value = @sysvar::EV_Sim::SysEV_MinPowerAC;
  $EV.ISO20.AC_ChargeParameterDiscovery_Request.CPDReqEnergyTransferMode.AC_CPDReqEnergyTransferMode.EVMinimumChargePower_L3.Exponent = 3; //Unit: kW
  $EV.ISO20.AC_ChargeParameterDiscovery_Request.CPDReqEnergyTransferMode.BPT_AC_CPDReqEnergyTransferMode.EVMinimumChargePower_L3.Value = @sysvar::EV_Sim::SysEV_MinPowerAC;
  $EV.ISO20.AC_ChargeParameterDiscovery_Request.CPDReqEnergyTransferMode.BPT_AC_CPDReqEnergyTransferMode.EVMinimumChargePower_L3.Exponent = 3; //Unit: kW
  
  /* EVMinimumDischargePower */
  $EV.ISO20.AC_ChargeParameterDiscovery_Request.CPDReqEnergyTransferMode.BPT_AC_CPDReqEnergyTransferMode.EVMinimumDischargePower.Value = - abs(@sysvar::EV_Sim::SysEV_MinPowerAC);
  $EV.ISO20.AC_ChargeParameterDiscovery_Request.CPDReqEnergyTransferMode.BPT_AC_CPDReqEnergyTransferMode.EVMinimumDischargePower.Exponent = 3; //Unit: kW
  
  /* EVMinimumDischargePower L2 */
  $EV.ISO20.AC_ChargeParameterDiscovery_Request.CPDReqEnergyTransferMode.BPT_AC_CPDReqEnergyTransferMode.EVMinimumDischargePower_L2.Value = - abs(@sysvar::EV_Sim::SysEV_MinPowerAC);
  $EV.ISO20.AC_ChargeParameterDiscovery_Request.CPDReqEnergyTransferMode.BPT_AC_CPDReqEnergyTransferMode.EVMinimumDischargePower_L2.Exponent = 3; //Unit: kW
  
  /* EVMinimumDischargePower L3 */
  $EV.ISO20.AC_ChargeParameterDiscovery_Request.CPDReqEnergyTransferMode.BPT_AC_CPDReqEnergyTransferMode.EVMinimumDischargePower_L3.Value = - abs(@sysvar::EV_Sim::SysEV_MinPowerAC);
  $EV.ISO20.AC_ChargeParameterDiscovery_Request.CPDReqEnergyTransferMode.BPT_AC_CPDReqEnergyTransferMode.EVMinimumDischargePower_L3.Exponent = 3; //Unit: kW
}

void FUNC_Set_EVDERACLimits_ChargeParameterDiscoveryReq()
{
  EV.ISO20.EnableAutoBodyFill.Call(0);
  AutoFill_body = 0;
  
  if((@Common::SysUserACDERMode == 0) && (@Common::SysUserBPTMode == 0))
    UseACElement();
  else if(@Common::SysUserBPTMode == 1)
    UseACBPTElement();
  else
    UseACDERElement();
}

void UseACElement()
{
  /* EVMaximumChargePower */
  $EV.ISO20.AC_DER_ChargeParameterDiscovery_Request.CPDReqEnergyTransferMode.AC_CPDReqEnergyTransferMode.EVMaximumChargePower.Value = @sysvar::EV_Sim::SysEV_MaxPowerAC;
  $EV.ISO20.AC_DER_ChargeParameterDiscovery_Request.CPDReqEnergyTransferMode.AC_CPDReqEnergyTransferMode.EVMaximumChargePower.Exponent = 3; //Unit: kW
}

void UseACBPTElement()
{
  /* EVMaximumChargePower */
  $EV.ISO20.AC_DER_ChargeParameterDiscovery_Request.CPDReqEnergyTransferMode.BPT_AC_CPDReqEnergyTransferMode.EVMaximumChargePower.Value = @sysvar::EV_Sim::SysEV_MaxPowerAC;
  $EV.ISO20.AC_DER_ChargeParameterDiscovery_Request.CPDReqEnergyTransferMode.BPT_AC_CPDReqEnergyTransferMode.EVMaximumChargePower.Exponent = 3; //Unit: kW
}

void UseACDERElement()
{
  /* EVMaximumChargePower */
  $EV.ISO20.AC_DER_ChargeParameterDiscovery_Request.CPDReqEnergyTransferMode.DER_AC_CPDReqEnergyTransferMode.EVMaximumChargePower.Value = @sysvar::EV_Sim::SysEV_MaxPowerAC;
  $EV.ISO20.AC_DER_ChargeParameterDiscovery_Request.CPDReqEnergyTransferMode.DER_AC_CPDReqEnergyTransferMode.EVMaximumChargePower.Exponent = 3; //Unit: kW
}

void FUNC_Set_RationalNumberValue(struct _CCS::DataTypes::RationalNumber_Type rationalNumber, long valueToBeSet)
{
  int sign;
  int exponent;
  long value;
  
  sign = 1;
  exponent = 0;
  value = valueToBeSet;
  
  // Remember sign
  if(value < 0)
  {
    sign = -1; 
    value = abs(value);
  }
  
  while((value > cRationalNumberMaxValue)
          && (exponent < 3))
  {
    value /= 10;
    exponent++;
  }
  
  if(exponent == 3 && value > cRationalNumberMaxValue)
  {
    writeLineEx(0, 3, "Error: Value '%d' is too big or small and cannot be represented as a RationalNumber element", valueToBeSet);
    exponent = 0;
    value = 0;
  }
  else
  {
    // Apply sign again
    value *= sign;
  }
  
  rationalNumber.Value = value;
  rationalNumber.Exponent = exponent;
}

void FUNC_Set_EVEnergyValues_ScheduleExchangeReq()
{
  stack long PresentSOC = _round(@sysvar::EV_Sim::SysEV_BatteryState);
  
  // float helpers for calculations
  stack float remainingPercentageUntilTargetSOC = (cTargetSOC - PresentSOC) / 100;
  stack float remainingPercentageUntilFull = (100.0 - PresentSOC) / 100;
  stack float remainingPercentageUntilMinSOC = (PresentSOC - cMinimumSOC) / 100;
  
  // values to be set in message
  stack long EVTargetEnergyRequest = _round(cBatteryCapacityInWh * remainingPercentageUntilTargetSOC);
  stack long EVMaximumEnergyRequest = _round(cBatteryCapacityInWh * remainingPercentageUntilFull);
  stack long EVMinimumEnergyRequest = _round(cBatteryCapacityInWh * remainingPercentageUntilMinSOC);
  stack long EVMaximumV2XEnergyRequest = 0;
  stack long EVMinimumV2XEnergyRequest = 0;
  
  // already above target, so we would need to discharge
  if(PresentSOC > cTargetSOC)
  {
    EVTargetEnergyRequest *= -1;
  }
  
  // already above minimum, so we could discharge
  if(PresentSOC > cMinimumSOC)
  {
    EVMinimumEnergyRequest *= -1;
  }
  
  if(@sysvar::EV_Sim::Control::SysEV_ControlModeDynamic == @sysvar::EV_Sim::Control::SysEV_ControlModeDynamic::Dynamic)
  {
    // Common charging values
    $EV.ISO20.ScheduleExchange_Request.SEReqControlModeElementId = _CCS::DataTypes::parISO20SEReqMode::Dynamic_SEReq;
    FUNC_Set_RationalNumberValue($EV.ISO20.ScheduleExchange_Request.SEReqControlMode.Dynamic_SEReqControlMode.EVTargetEnergyRequest, EVTargetEnergyRequest);
    FUNC_Set_RationalNumberValue($EV.ISO20.ScheduleExchange_Request.SEReqControlMode.Dynamic_SEReqControlMode.EVMaximumEnergyRequest, EVMaximumEnergyRequest);
    FUNC_Set_RationalNumberValue($EV.ISO20.ScheduleExchange_Request.SEReqControlMode.Dynamic_SEReqControlMode.EVMinimumEnergyRequest, EVMinimumEnergyRequest);
    $EV.ISO20.ScheduleExchange_Request.SEReqControlMode.Dynamic_SEReqControlMode.MinimumSOC = cMinimumSOC;
    $EV.ISO20.ScheduleExchange_Request.SEReqControlMode.Dynamic_SEReqControlMode.TargetSOC = cTargetSOC;
    
    // BPT specific discharging values
    if(@sysvar::Common::SysUserBPTMode == @sysvar::Common::SysUserBPTMode::BPT)
    {
      FUNC_Set_RationalNumberValue($EV.ISO20.ScheduleExchange_Request.SEReqControlMode.Dynamic_SEReqControlMode.EVMaximumV2XEnergyRequest, EVMaximumV2XEnergyRequest);
      FUNC_Set_RationalNumberValue($EV.ISO20.ScheduleExchange_Request.SEReqControlMode.Dynamic_SEReqControlMode.EVMinimumV2XEnergyRequest, EVMinimumV2XEnergyRequest);
    }
    else
    {
      $EV.ISO20.ScheduleExchange_Request.SEReqControlMode.Dynamic_SEReqControlMode.EVMaximumV2XEnergyRequest.SetInvalid();
      $EV.ISO20.ScheduleExchange_Request.SEReqControlMode.Dynamic_SEReqControlMode.EVMinimumV2XEnergyRequest.SetInvalid();
    }
  }
  else
  {
    // Common charging values
    $EV.ISO20.ScheduleExchange_Request.SEReqControlModeElementId = _CCS::DataTypes::parISO20SEReqMode::Scheduled_SEReq;
    FUNC_Set_RationalNumberValue($EV.ISO20.ScheduleExchange_Request.SEReqControlMode.Scheduled_SEReqControlMode.EVTargetEnergyRequest, EVTargetEnergyRequest);
    FUNC_Set_RationalNumberValue($EV.ISO20.ScheduleExchange_Request.SEReqControlMode.Scheduled_SEReqControlMode.EVMaximumEnergyRequest, EVMaximumEnergyRequest);
    FUNC_Set_RationalNumberValue($EV.ISO20.ScheduleExchange_Request.SEReqControlMode.Scheduled_SEReqControlMode.EVMinimumEnergyRequest, EVMinimumEnergyRequest);    
    
    // BPT specific discharging values
    if(@sysvar::Common::SysUserBPTMode == @sysvar::Common::SysUserBPTMode::BPT)
    {
      FUNC_SET_EVEnergyOffer_ScheduleExchangeReq();
    }
    else
    {
      $EV.ISO20.ScheduleExchange_Request.SEReqControlMode.Scheduled_SEReqControlMode.EVEnergyOffer.SetInvalid();
    }
  }
}

void FUNC_SET_EVEnergyOffer_ScheduleExchangeReq()
{
  int i;
  
  $EV.ISO20.ScheduleExchange_Request.SEReqControlModeElementId = _CCS::DataTypes::parISO20SEReqMode::Scheduled_SEReq;
  $EV.ISO20.ScheduleExchange_Request.SEReqControlMode.Scheduled_SEReqControlMode.EVEnergyOffer.EVPowerSchedule.EVPowerScheduleEntries.EVPowerScheduleEntry.Length = 3;
  $EV.ISO20.ScheduleExchange_Request.SEReqControlMode.Scheduled_SEReqControlMode.EVEnergyOffer.EVAbsolutePriceSchedule.EVPriceRuleStacks.EVPriceRuleStack.Length = 3;
  for(i = 0; i < 3; i++)
  {
    $EV.ISO20.ScheduleExchange_Request.SEReqControlMode.Scheduled_SEReqControlMode.EVEnergyOffer.EVPowerSchedule.EVPowerScheduleEntries.EVPowerScheduleEntry[i].Duration = 100 + i * 100;
    $EV.ISO20.ScheduleExchange_Request.SEReqControlMode.Scheduled_SEReqControlMode.EVEnergyOffer.EVPowerSchedule.EVPowerScheduleEntries.EVPowerScheduleEntry[i].Power.Value = 100 + i * 100;
    $EV.ISO20.ScheduleExchange_Request.SEReqControlMode.Scheduled_SEReqControlMode.EVEnergyOffer.EVPowerSchedule.EVPowerScheduleEntries.EVPowerScheduleEntry[i].Power.Exponent = 1;
    
    $EV.ISO20.ScheduleExchange_Request.SEReqControlMode.Scheduled_SEReqControlMode.EVEnergyOffer.EVAbsolutePriceSchedule.EVPriceRuleStacks.EVPriceRuleStack[i].Duration = 100 + i * 100;
    $EV.ISO20.ScheduleExchange_Request.SEReqControlMode.Scheduled_SEReqControlMode.EVEnergyOffer.EVAbsolutePriceSchedule.EVPriceRuleStacks.EVPriceRuleStack[i].EVPriceRule.Length = 1;
    $EV.ISO20.ScheduleExchange_Request.SEReqControlMode.Scheduled_SEReqControlMode.EVEnergyOffer.EVAbsolutePriceSchedule.EVPriceRuleStacks.EVPriceRuleStack[i].EVPriceRule[0].EnergyFee.Value = 50;
    $EV.ISO20.ScheduleExchange_Request.SEReqControlMode.Scheduled_SEReqControlMode.EVEnergyOffer.EVAbsolutePriceSchedule.EVPriceRuleStacks.EVPriceRuleStack[i].EVPriceRule[0].EnergyFee.Exponent = 0;
    $EV.ISO20.ScheduleExchange_Request.SEReqControlMode.Scheduled_SEReqControlMode.EVEnergyOffer.EVAbsolutePriceSchedule.EVPriceRuleStacks.EVPriceRuleStack[i].EVPriceRule[0].PowerRangeStart.Value = 200;
    $EV.ISO20.ScheduleExchange_Request.SEReqControlMode.Scheduled_SEReqControlMode.EVEnergyOffer.EVAbsolutePriceSchedule.EVPriceRuleStacks.EVPriceRuleStack[i].EVPriceRule[0].PowerRangeStart.Exponent = 1;
  }
  $EV.ISO20.ScheduleExchange_Request.SEReqControlMode.Scheduled_SEReqControlMode.EVEnergyOffer.EVPowerSchedule.TimeAnchor = 200;
  $EV.ISO20.ScheduleExchange_Request.SEReqControlMode.Scheduled_SEReqControlMode.EVEnergyOffer.EVAbsolutePriceSchedule.TimeAnchor = 200;
  $EV.ISO20.ScheduleExchange_Request.SEReqControlMode.Scheduled_SEReqControlMode.EVEnergyOffer.EVAbsolutePriceSchedule.Currency = "EUR";
  $EV.ISO20.ScheduleExchange_Request.SEReqControlMode.Scheduled_SEReqControlMode.EVEnergyOffer.EVAbsolutePriceSchedule.PriceAlgorithm = "PriceAlgorithm";    
}

void FUNC_Set_EVDCLimits_PreChargeReq()
{
  $CCS::Simulation::EV.ISO20.DC_PreCharge_Request.EVTargetVoltage.Value = @sysvar::EV_Sim::SysEV_TargetVoltage;
  $CCS::Simulation::EV.ISO20.DC_PreCharge_Request.EVTargetVoltage.Exponent = 0;
}

void FUNC_Set_EVDCLimits_ChargeLoopReq()
{
  /* EVMaximumVoltage */
  $EV.ISO20.DC_ChargeLoop_Request.CLReqControlMode.Dynamic_DC_CLReqControlMode.EVMaximumVoltage.Value = @sysvar::EV_Sim::SysEV_MaxVoltage;
  $EV.ISO20.DC_ChargeLoop_Request.CLReqControlMode.Dynamic_DC_CLReqControlMode.EVMaximumVoltage.Exponent = 0;
  $EV.ISO20.DC_ChargeLoop_Request.CLReqControlMode.BPT_Dynamic_DC_CLReqControlMode.EVMaximumVoltage.Value = @sysvar::EV_Sim::SysEV_MaxVoltage;
  $EV.ISO20.DC_ChargeLoop_Request.CLReqControlMode.BPT_Dynamic_DC_CLReqControlMode.EVMaximumVoltage.Exponent = 0;
  $EV.ISO20.DC_ChargeLoop_Request.CLReqControlMode.Scheduled_DC_CLReqControlMode.EVMaximumVoltage.Value = @sysvar::EV_Sim::SysEV_MaxVoltage;
  $EV.ISO20.DC_ChargeLoop_Request.CLReqControlMode.Scheduled_DC_CLReqControlMode.EVMaximumVoltage.Exponent = 0;
  $EV.ISO20.DC_ChargeLoop_Request.CLReqControlMode.BPT_Scheduled_DC_CLReqControlMode.EVMaximumVoltage.Value = @sysvar::EV_Sim::SysEV_MaxVoltage;
  $EV.ISO20.DC_ChargeLoop_Request.CLReqControlMode.BPT_Scheduled_DC_CLReqControlMode.EVMaximumVoltage.Exponent = 0;
  
  /* EVMaximumChargePower */
  $EV.ISO20.DC_ChargeLoop_Request.CLReqControlMode.Scheduled_DC_CLReqControlMode.EVMaximumChargePower.Value = @sysvar::EV_Sim::SysEV_MaxPowerDC;
  $EV.ISO20.DC_ChargeLoop_Request.CLReqControlMode.Scheduled_DC_CLReqControlMode.EVMaximumChargePower.Exponent = 3; //Unit: kW  
  $EV.ISO20.DC_ChargeLoop_Request.CLReqControlMode.BPT_Scheduled_DC_CLReqControlMode.EVMaximumChargePower.Value = @sysvar::EV_Sim::SysEV_MaxPowerDC;
  $EV.ISO20.DC_ChargeLoop_Request.CLReqControlMode.BPT_Scheduled_DC_CLReqControlMode.EVMaximumChargePower.Exponent = 3; //Unit: kW
  $EV.ISO20.DC_ChargeLoop_Request.CLReqControlMode.Dynamic_DC_CLReqControlMode.EVMaximumChargePower.Value = @sysvar::EV_Sim::SysEV_MaxPowerDC;
  $EV.ISO20.DC_ChargeLoop_Request.CLReqControlMode.Dynamic_DC_CLReqControlMode.EVMaximumChargePower.Exponent = 3; //Unit: kW
  $EV.ISO20.DC_ChargeLoop_Request.CLReqControlMode.BPT_Dynamic_DC_CLReqControlMode.EVMaximumChargePower.Value = @sysvar::EV_Sim::SysEV_MaxPowerDC;
  $EV.ISO20.DC_ChargeLoop_Request.CLReqControlMode.BPT_Dynamic_DC_CLReqControlMode.EVMaximumChargePower.Exponent = 3; //Unit: kW

  /* EVMaximumChargeCurrent */
  $EV.ISO20.DC_ChargeLoop_Request.CLReqControlMode.Scheduled_DC_CLReqControlMode.EVMaximumChargeCurrent.Value = @sysvar::EV_Sim::SysEV_MaxCurrent;
  $EV.ISO20.DC_ChargeLoop_Request.CLReqControlMode.Scheduled_DC_CLReqControlMode.EVMaximumChargeCurrent.Exponent = 0;
  $EV.ISO20.DC_ChargeLoop_Request.CLReqControlMode.BPT_Scheduled_DC_CLReqControlMode.EVMaximumChargeCurrent.Value = @sysvar::EV_Sim::SysEV_MaxCurrent;
  $EV.ISO20.DC_ChargeLoop_Request.CLReqControlMode.BPT_Scheduled_DC_CLReqControlMode.EVMaximumChargeCurrent.Exponent = 0;
  $EV.ISO20.DC_ChargeLoop_Request.CLReqControlMode.Dynamic_DC_CLReqControlMode.EVMaximumChargeCurrent.Value = @sysvar::EV_Sim::SysEV_MaxCurrent;
  $EV.ISO20.DC_ChargeLoop_Request.CLReqControlMode.Dynamic_DC_CLReqControlMode.EVMaximumChargeCurrent.Exponent = 0;
  $EV.ISO20.DC_ChargeLoop_Request.CLReqControlMode.BPT_Dynamic_DC_CLReqControlMode.EVMaximumChargeCurrent.Value = @sysvar::EV_Sim::SysEV_MaxCurrent;
  $EV.ISO20.DC_ChargeLoop_Request.CLReqControlMode.BPT_Dynamic_DC_CLReqControlMode.EVMaximumChargeCurrent.Exponent = 0;
  
  /* EVMaximumDischargePower */
  $EV.ISO20.DC_ChargeLoop_Request.CLReqControlMode.BPT_Scheduled_DC_CLReqControlMode.EVMaximumDischargePower.Value = - abs(@sysvar::EV_Sim::SysEV_MaxPowerDC);
  $EV.ISO20.DC_ChargeLoop_Request.CLReqControlMode.BPT_Scheduled_DC_CLReqControlMode.EVMaximumDischargePower.Exponent = 3; //Unit: kW
  $EV.ISO20.DC_ChargeLoop_Request.CLReqControlMode.BPT_Dynamic_DC_CLReqControlMode.EVMaximumDischargePower.Value = - abs(@sysvar::EV_Sim::SysEV_MaxPowerDC);
  $EV.ISO20.DC_ChargeLoop_Request.CLReqControlMode.BPT_Dynamic_DC_CLReqControlMode.EVMaximumDischargePower.Exponent = 3; //Unit: kW
  
  /* EVMaximumDischargeCurrent */
  $EV.ISO20.DC_ChargeLoop_Request.CLReqControlMode.BPT_Scheduled_DC_CLReqControlMode.EVMaximumDischargeCurrent.Value = - abs(@sysvar::EV_Sim::SysEV_MaxCurrent);
  $EV.ISO20.DC_ChargeLoop_Request.CLReqControlMode.BPT_Scheduled_DC_CLReqControlMode.EVMaximumDischargeCurrent.Exponent = 0;
  $EV.ISO20.DC_ChargeLoop_Request.CLReqControlMode.BPT_Dynamic_DC_CLReqControlMode.EVMaximumDischargeCurrent.Value = - abs(@sysvar::EV_Sim::SysEV_MaxCurrent);
  $EV.ISO20.DC_ChargeLoop_Request.CLReqControlMode.BPT_Dynamic_DC_CLReqControlMode.EVMaximumDischargeCurrent.Exponent = 0;
}


void FUNC_Set_EVDCChargeLoopValues()
{
  stack word TargetSOC = $EV.ISO20.DC_ChargeLoop_Request.DisplayParameters.TargetSOC;
  stack word PresentSOC = @sysvar::EV_Sim::SysEV_BatteryState;
  
  $EV.ISO20.DC_ChargeLoop_Request.EVPresentVoltage.Value = HV_measure_DC_U();  
  $EV.ISO20.DC_ChargeLoop_Request.EVPresentVoltage.Exponent = 0;
  
  if (@sysvar::EV_Sim::Control::SysEV_ControlModeDynamic == @sysvar::EV_Sim::Control::SysEV_ControlModeDynamic::Dynamic)
  {
    if (@sysvar::Common::SysUserBPTMode == sysvar::Common::SysUserBPTMode::BPT) 
    { 
      stack word EVMaximumEnergyRequest;
      $EV.ISO20.DC_ChargeLoop_Request.CLReqControlModeElementId = 1; /* 1 for BPT_Dynamic_DC_CLReqControlMode */
      EVMaximumEnergyRequest = $EV.ISO20.DC_ChargeLoop_Request.CLReqControlMode.BPT_Dynamic_DC_CLReqControlMode.EVMaximumEnergyRequest.Value;
      $EV.ISO20.DC_ChargeLoop_Request.CLReqControlMode.BPT_Dynamic_DC_CLReqControlMode.EVTargetEnergyRequest.Value = EVMaximumEnergyRequest * (TargetSOC - PresentSOC)/100;
    }
    else
    {
      stack word EVMaximumEnergyRequest;
      $EV.ISO20.DC_ChargeLoop_Request.CLReqControlModeElementId = 0; /* 0 for Dynamic_DC_CLReqControlMode */
      EVMaximumEnergyRequest = $EV.ISO20.DC_ChargeLoop_Request.CLReqControlMode.Dynamic_DC_CLReqControlMode.EVMaximumEnergyRequest.Value;
      $EV.ISO20.DC_ChargeLoop_Request.CLReqControlMode.Dynamic_DC_CLReqControlMode.EVTargetEnergyRequest.Value = EVMaximumEnergyRequest * (TargetSOC - PresentSOC)/100;
    }
  }
  else
  {
    if (@sysvar::Common::SysUserBPTMode == sysvar::Common::SysUserBPTMode::BPT) 
    {
      $EV.ISO20.DC_ChargeLoop_Request.CLReqControlModeElementId = 3; /* 3 for BPT_Scheduled_DC_CLReqControlMode */
      if($EV.ISO20.DC_ChargeLoop_Request.CLReqControlMode.BPT_Scheduled_DC_CLReqControlMode.EVMaximumEnergyRequest.IsValid){
        stack word EVMaximumEnergyRequest = $EV.ISO20.DC_ChargeLoop_Request.CLReqControlMode.BPT_Scheduled_DC_CLReqControlMode.EVMaximumEnergyRequest.Value;
        $EV.ISO20.DC_ChargeLoop_Request.CLReqControlMode.BPT_Scheduled_DC_CLReqControlMode.EVTargetEnergyRequest.Value = EVMaximumEnergyRequest * (TargetSOC - PresentSOC)/100;
      }
      $EV.ISO20.DC_ChargeLoop_Request.CLReqControlModeElementId = 3; /* 3 for BPT_Scheduled_DC_CLReqControlMode */
      if (@sysvar::EV_Sim::Control::SysEV_ChargeDischarge == sysvar::EV_Sim::Control::SysEV_ChargeDischarge::Charge)
        $EV.ISO20.DC_ChargeLoop_Request.CLReqControlMode.BPT_Scheduled_DC_CLReqControlMode.EVTargetCurrent.Value = @sysvar::EV_Sim::SysEV_TargetCurrent;
      else
        $EV.ISO20.DC_ChargeLoop_Request.CLReqControlMode.BPT_Scheduled_DC_CLReqControlMode.EVTargetCurrent.Value = - abs(@sysvar::EV_Sim::SysEV_TargetCurrent);
      $EV.ISO20.DC_ChargeLoop_Request.CLReqControlMode.BPT_Scheduled_DC_CLReqControlMode.EVTargetCurrent.Exponent = 0;
      $EV.ISO20.DC_ChargeLoop_Request.CLReqControlMode.BPT_Scheduled_DC_CLReqControlMode.EVTargetVoltage.Value = @sysvar::EV_Sim::SysEV_TargetVoltage;
      $EV.ISO20.DC_ChargeLoop_Request.CLReqControlMode.BPT_Scheduled_DC_CLReqControlMode.EVTargetVoltage.Exponent = 0;
    }
    else
    {
      $EV.ISO20.DC_ChargeLoop_Request.CLReqControlModeElementId = 2; /* 2 for Scheduled_DC_CLReqControlMode */
      if($EV.ISO20.DC_ChargeLoop_Request.CLReqControlMode.Scheduled_DC_CLReqControlMode.EVMaximumEnergyRequest.isValid){
        stack word EVMaximumEnergyRequest = $EV.ISO20.DC_ChargeLoop_Request.CLReqControlMode.Scheduled_DC_CLReqControlMode.EVMaximumEnergyRequest.Value;
        $EV.ISO20.DC_ChargeLoop_Request.CLReqControlMode.Scheduled_DC_CLReqControlMode.EVTargetEnergyRequest.Value = EVMaximumEnergyRequest * (TargetSOC - PresentSOC)/100;
      }
      $EV.ISO20.DC_ChargeLoop_Request.CLReqControlModeElementId = 2; /* 2 for Scheduled_DC_CLReqControlMode */
      $EV.ISO20.DC_ChargeLoop_Request.CLReqControlMode.Scheduled_DC_CLReqControlMode.EVTargetCurrent.Value = @sysvar::EV_Sim::SysEV_TargetCurrent;
      $EV.ISO20.DC_ChargeLoop_Request.CLReqControlMode.Scheduled_DC_CLReqControlMode.EVTargetCurrent.Exponent = 0;
      $EV.ISO20.DC_ChargeLoop_Request.CLReqControlMode.Scheduled_DC_CLReqControlMode.EVTargetVoltage.Value = @sysvar::EV_Sim::SysEV_TargetVoltage;
      $EV.ISO20.DC_ChargeLoop_Request.CLReqControlMode.Scheduled_DC_CLReqControlMode.EVTargetVoltage.Exponent = 0;
    }
  }
}

void FUNC_Set_EVACLimits_ChargeLoopReq()
{
  /* EVMaximumChargePower */
  $EV.ISO20.AC_ChargeLoop_Request.CLReqControlMode.Scheduled_AC_CLReqControlMode.EVMaximumChargePower.Value = @sysvar::EV_Sim::SysEV_MaxPowerAC;
  $EV.ISO20.AC_ChargeLoop_Request.CLReqControlMode.Scheduled_AC_CLReqControlMode.EVMaximumChargePower.Exponent = 3; //Unit: kW
  $EV.ISO20.AC_ChargeLoop_Request.CLReqControlMode.Scheduled_AC_CLReqControlMode.EVMaximumChargePower_L2.Value = @sysvar::EV_Sim::SysEV_MaxPowerAC;
  $EV.ISO20.AC_ChargeLoop_Request.CLReqControlMode.Scheduled_AC_CLReqControlMode.EVMaximumChargePower_L2.Exponent = 3; //Unit: kW
  $EV.ISO20.AC_ChargeLoop_Request.CLReqControlMode.Scheduled_AC_CLReqControlMode.EVMaximumChargePower_L3.Value = @sysvar::EV_Sim::SysEV_MaxPowerAC;
  $EV.ISO20.AC_ChargeLoop_Request.CLReqControlMode.Scheduled_AC_CLReqControlMode.EVMaximumChargePower_L3.Exponent = 3; //Unit: kW
  
  $EV.ISO20.AC_ChargeLoop_Request.CLReqControlMode.BPT_Scheduled_AC_CLReqControlMode.EVMaximumChargePower.Value = @sysvar::EV_Sim::SysEV_MaxPowerAC;
  $EV.ISO20.AC_ChargeLoop_Request.CLReqControlMode.BPT_Scheduled_AC_CLReqControlMode.EVMaximumChargePower.Exponent = 3; //Unit: kW
  $EV.ISO20.AC_ChargeLoop_Request.CLReqControlMode.BPT_Scheduled_AC_CLReqControlMode.EVMaximumChargePower_L2.Value = @sysvar::EV_Sim::SysEV_MaxPowerAC;
  $EV.ISO20.AC_ChargeLoop_Request.CLReqControlMode.BPT_Scheduled_AC_CLReqControlMode.EVMaximumChargePower_L2.Exponent = 3; //Unit: kW
  $EV.ISO20.AC_ChargeLoop_Request.CLReqControlMode.BPT_Scheduled_AC_CLReqControlMode.EVMaximumChargePower_L3.Value = @sysvar::EV_Sim::SysEV_MaxPowerAC;
  $EV.ISO20.AC_ChargeLoop_Request.CLReqControlMode.BPT_Scheduled_AC_CLReqControlMode.EVMaximumChargePower_L3.Exponent = 3; //Unit: kW
 
  $EV.ISO20.AC_ChargeLoop_Request.CLReqControlMode.Dynamic_AC_CLReqControlMode.EVMaximumChargePower.Value = @sysvar::EV_Sim::SysEV_MaxPowerAC;
  $EV.ISO20.AC_ChargeLoop_Request.CLReqControlMode.Dynamic_AC_CLReqControlMode.EVMaximumChargePower.Exponent = 3; //Unit: kW
  $EV.ISO20.AC_ChargeLoop_Request.CLReqControlMode.Dynamic_AC_CLReqControlMode.EVMaximumChargePower_L2.Value = @sysvar::EV_Sim::SysEV_MaxPowerAC;
  $EV.ISO20.AC_ChargeLoop_Request.CLReqControlMode.Dynamic_AC_CLReqControlMode.EVMaximumChargePower_L2.Exponent = 3; //Unit: kW
  $EV.ISO20.AC_ChargeLoop_Request.CLReqControlMode.Dynamic_AC_CLReqControlMode.EVMaximumChargePower_L3.Value = @sysvar::EV_Sim::SysEV_MaxPowerAC;
  $EV.ISO20.AC_ChargeLoop_Request.CLReqControlMode.Dynamic_AC_CLReqControlMode.EVMaximumChargePower_L3.Exponent = 3; //Unit: kW
  
  $EV.ISO20.AC_ChargeLoop_Request.CLReqControlMode.BPT_Dynamic_AC_CLReqControlMode.EVMaximumChargePower.Value = @sysvar::EV_Sim::SysEV_MaxPowerAC;
  $EV.ISO20.AC_ChargeLoop_Request.CLReqControlMode.BPT_Dynamic_AC_CLReqControlMode.EVMaximumChargePower.Exponent = 3; //Unit: kW
  $EV.ISO20.AC_ChargeLoop_Request.CLReqControlMode.BPT_Dynamic_AC_CLReqControlMode.EVMaximumChargePower_L2.Value = @sysvar::EV_Sim::SysEV_MaxPowerAC;
  $EV.ISO20.AC_ChargeLoop_Request.CLReqControlMode.BPT_Dynamic_AC_CLReqControlMode.EVMaximumChargePower_L2.Exponent = 3; //Unit: kW
  $EV.ISO20.AC_ChargeLoop_Request.CLReqControlMode.BPT_Dynamic_AC_CLReqControlMode.EVMaximumChargePower_L3.Value = @sysvar::EV_Sim::SysEV_MaxPowerAC;
  $EV.ISO20.AC_ChargeLoop_Request.CLReqControlMode.BPT_Dynamic_AC_CLReqControlMode.EVMaximumChargePower_L3.Exponent = 3; //Unit: kW
  
  /* EVMinimumChargePower */
  $EV.ISO20.AC_ChargeLoop_Request.CLReqControlMode.Dynamic_AC_CLReqControlMode.EVMinimumChargePower.Value = @sysvar::EV_Sim::SysEV_MinPowerAC;
  $EV.ISO20.AC_ChargeLoop_Request.CLReqControlMode.Dynamic_AC_CLReqControlMode.EVMinimumChargePower.Exponent = 3; //Unit: kW
  $EV.ISO20.AC_ChargeLoop_Request.CLReqControlMode.Dynamic_AC_CLReqControlMode.EVMinimumChargePower_L2.Value = @sysvar::EV_Sim::SysEV_MinPowerAC;
  $EV.ISO20.AC_ChargeLoop_Request.CLReqControlMode.Dynamic_AC_CLReqControlMode.EVMinimumChargePower_L2.Exponent = 3; //Unit: kW
  $EV.ISO20.AC_ChargeLoop_Request.CLReqControlMode.Dynamic_AC_CLReqControlMode.EVMinimumChargePower_L3.Value = @sysvar::EV_Sim::SysEV_MinPowerAC;
  $EV.ISO20.AC_ChargeLoop_Request.CLReqControlMode.Dynamic_AC_CLReqControlMode.EVMinimumChargePower_L3.Exponent = 3; //Unit: kW
  
  $EV.ISO20.AC_ChargeLoop_Request.CLReqControlMode.BPT_Dynamic_AC_CLReqControlMode.EVMinimumChargePower.Value = @sysvar::EV_Sim::SysEV_MinPowerAC;
  $EV.ISO20.AC_ChargeLoop_Request.CLReqControlMode.BPT_Dynamic_AC_CLReqControlMode.EVMinimumChargePower.Exponent = 3; //Unit: kW
  $EV.ISO20.AC_ChargeLoop_Request.CLReqControlMode.BPT_Dynamic_AC_CLReqControlMode.EVMinimumChargePower_L2.Value = @sysvar::EV_Sim::SysEV_MinPowerAC;
  $EV.ISO20.AC_ChargeLoop_Request.CLReqControlMode.BPT_Dynamic_AC_CLReqControlMode.EVMinimumChargePower_L2.Exponent = 3; //Unit: kW
  $EV.ISO20.AC_ChargeLoop_Request.CLReqControlMode.BPT_Dynamic_AC_CLReqControlMode.EVMinimumChargePower_L3.Value = @sysvar::EV_Sim::SysEV_MinPowerAC;
  $EV.ISO20.AC_ChargeLoop_Request.CLReqControlMode.BPT_Dynamic_AC_CLReqControlMode.EVMinimumChargePower_L3.Exponent = 3; //Unit: kW
  
  /* EVMaximumDischargePower */                                                 
  $EV.ISO20.AC_ChargeLoop_Request.CLReqControlMode.BPT_Scheduled_AC_CLReqControlMode.EVMaximumDischargePower.Value = - abs(@sysvar::EV_Sim::SysEV_MaxPowerAC);
  $EV.ISO20.AC_ChargeLoop_Request.CLReqControlMode.BPT_Scheduled_AC_CLReqControlMode.EVMaximumDischargePower.Exponent = 3; //Unit: kW
  $EV.ISO20.AC_ChargeLoop_Request.CLReqControlMode.BPT_Scheduled_AC_CLReqControlMode.EVMaximumDischargePower_L2.Value = - abs(@sysvar::EV_Sim::SysEV_MaxPowerAC);
  $EV.ISO20.AC_ChargeLoop_Request.CLReqControlMode.BPT_Scheduled_AC_CLReqControlMode.EVMaximumDischargePower_L2.Exponent = 3; //Unit: kW
  $EV.ISO20.AC_ChargeLoop_Request.CLReqControlMode.BPT_Scheduled_AC_CLReqControlMode.EVMaximumDischargePower_L3.Value = - abs(@sysvar::EV_Sim::SysEV_MaxPowerAC);
  $EV.ISO20.AC_ChargeLoop_Request.CLReqControlMode.BPT_Scheduled_AC_CLReqControlMode.EVMaximumDischargePower_L3.Exponent = 3; //Unit: kW
  
  $EV.ISO20.AC_ChargeLoop_Request.CLReqControlMode.BPT_Dynamic_AC_CLReqControlMode.EVMaximumDischargePower.Value = - abs(@sysvar::EV_Sim::SysEV_MaxPowerAC);
  $EV.ISO20.AC_ChargeLoop_Request.CLReqControlMode.BPT_Dynamic_AC_CLReqControlMode.EVMaximumDischargePower.Exponent = 3; //Unit: kW
  $EV.ISO20.AC_ChargeLoop_Request.CLReqControlMode.BPT_Dynamic_AC_CLReqControlMode.EVMaximumDischargePower_L2.Value = - abs(@sysvar::EV_Sim::SysEV_MaxPowerAC);
  $EV.ISO20.AC_ChargeLoop_Request.CLReqControlMode.BPT_Dynamic_AC_CLReqControlMode.EVMaximumDischargePower_L2.Exponent = 3; //Unit: kW
  $EV.ISO20.AC_ChargeLoop_Request.CLReqControlMode.BPT_Dynamic_AC_CLReqControlMode.EVMaximumDischargePower_L3.Value = - abs(@sysvar::EV_Sim::SysEV_MaxPowerAC);
  $EV.ISO20.AC_ChargeLoop_Request.CLReqControlMode.BPT_Dynamic_AC_CLReqControlMode.EVMaximumDischargePower_L3.Exponent = 3; //Unit: kW
  
  /* EVMinimumDischargePower */                                                 
  $EV.ISO20.AC_ChargeLoop_Request.CLReqControlMode.BPT_Scheduled_AC_CLReqControlMode.EVMinimumDischargePower.Value = - abs(@sysvar::EV_Sim::SysEV_MinPowerAC);
  $EV.ISO20.AC_ChargeLoop_Request.CLReqControlMode.BPT_Scheduled_AC_CLReqControlMode.EVMinimumDischargePower.Exponent = 3; //Unit: kW
  $EV.ISO20.AC_ChargeLoop_Request.CLReqControlMode.BPT_Scheduled_AC_CLReqControlMode.EVMinimumDischargePower_L2.Value = - abs(@sysvar::EV_Sim::SysEV_MinPowerAC);
  $EV.ISO20.AC_ChargeLoop_Request.CLReqControlMode.BPT_Scheduled_AC_CLReqControlMode.EVMinimumDischargePower_L2.Exponent = 3; //Unit: kW
  $EV.ISO20.AC_ChargeLoop_Request.CLReqControlMode.BPT_Scheduled_AC_CLReqControlMode.EVMinimumDischargePower_L3.Value = - abs(@sysvar::EV_Sim::SysEV_MinPowerAC);
  $EV.ISO20.AC_ChargeLoop_Request.CLReqControlMode.BPT_Scheduled_AC_CLReqControlMode.EVMinimumDischargePower_L3.Exponent = 3; //Unit: kW
  
  $EV.ISO20.AC_ChargeLoop_Request.CLReqControlMode.BPT_Dynamic_AC_CLReqControlMode.EVMinimumDischargePower.Value = - abs(@sysvar::EV_Sim::SysEV_MinPowerAC);
  $EV.ISO20.AC_ChargeLoop_Request.CLReqControlMode.BPT_Dynamic_AC_CLReqControlMode.EVMinimumDischargePower.Exponent = 3; //Unit: kW
  $EV.ISO20.AC_ChargeLoop_Request.CLReqControlMode.BPT_Dynamic_AC_CLReqControlMode.EVMinimumDischargePower_L2.Value = - abs(@sysvar::EV_Sim::SysEV_MinPowerAC);
  $EV.ISO20.AC_ChargeLoop_Request.CLReqControlMode.BPT_Dynamic_AC_CLReqControlMode.EVMinimumDischargePower_L2.Exponent = 3; //Unit: kW
  $EV.ISO20.AC_ChargeLoop_Request.CLReqControlMode.BPT_Dynamic_AC_CLReqControlMode.EVMinimumDischargePower_L3.Value = - abs(@sysvar::EV_Sim::SysEV_MinPowerAC);
  $EV.ISO20.AC_ChargeLoop_Request.CLReqControlMode.BPT_Dynamic_AC_CLReqControlMode.EVMinimumDischargePower_L3.Exponent = 3; //Unit: kW

  FUNC_Set_EVACDERLimits_ChargeLoopReq();
}

void FUNC_Set_EVACDERLimits_ChargeLoopReq()
{
  $EV.ISO20.AC_DER_ChargeLoop_Request.CLReqControlMode.DER_Scheduled_AC_CLReqControlMode.EVTargetEnergyRequest.Value = 1;
  $EV.ISO20.AC_DER_ChargeLoop_Request.CLReqControlMode.DER_Scheduled_AC_CLReqControlMode.EVTargetEnergyRequest.Exponent = 3; //Unit: kW
  $EV.ISO20.AC_DER_ChargeLoop_Request.CLReqControlMode.DER_Scheduled_AC_CLReqControlMode.EVMaximumEnergyRequest.Value = 1;
  $EV.ISO20.AC_DER_ChargeLoop_Request.CLReqControlMode.DER_Scheduled_AC_CLReqControlMode.EVMaximumEnergyRequest.Exponent = 3; //Unit: kW
  $EV.ISO20.AC_DER_ChargeLoop_Request.CLReqControlMode.DER_Scheduled_AC_CLReqControlMode.EVMinimumEnergyRequest.Value = 1;
  $EV.ISO20.AC_DER_ChargeLoop_Request.CLReqControlMode.DER_Scheduled_AC_CLReqControlMode.EVMinimumEnergyRequest.Exponent = 3; //Unit: kW
  /* EVMaximumChargePower */
  $EV.ISO20.AC_DER_ChargeLoop_Request.CLReqControlMode.DER_Scheduled_AC_CLReqControlMode.EVMaximumChargePower.Value = @sysvar::EV_Sim::SysEV_MaxPowerAC;
  $EV.ISO20.AC_DER_ChargeLoop_Request.CLReqControlMode.DER_Scheduled_AC_CLReqControlMode.EVMaximumChargePower.Exponent = 3; //Unit: kW
  $EV.ISO20.AC_DER_ChargeLoop_Request.CLReqControlMode.DER_Scheduled_AC_CLReqControlMode.EVMaximumChargePower_L2.Value = @sysvar::EV_Sim::SysEV_MaxPowerAC;
  $EV.ISO20.AC_DER_ChargeLoop_Request.CLReqControlMode.DER_Scheduled_AC_CLReqControlMode.EVMaximumChargePower_L2.Exponent = 3; //Unit: kW
  $EV.ISO20.AC_DER_ChargeLoop_Request.CLReqControlMode.DER_Scheduled_AC_CLReqControlMode.EVMaximumChargePower_L3.Value = @sysvar::EV_Sim::SysEV_MaxPowerAC;
  $EV.ISO20.AC_DER_ChargeLoop_Request.CLReqControlMode.DER_Scheduled_AC_CLReqControlMode.EVMaximumChargePower_L3.Exponent = 3; //Unit: kW
  $EV.ISO20.AC_DER_ChargeLoop_Request.CLReqControlMode.DER_Dynamic_AC_CLReqControlMode.EVMaximumChargePower.Value = @sysvar::EV_Sim::SysEV_MaxPowerAC;
  $EV.ISO20.AC_DER_ChargeLoop_Request.CLReqControlMode.DER_Dynamic_AC_CLReqControlMode.EVMaximumChargePower.Exponent = 3; //Unit: kW
  $EV.ISO20.AC_DER_ChargeLoop_Request.CLReqControlMode.DER_Dynamic_AC_CLReqControlMode.EVMaximumChargePower_L2.Value = @sysvar::EV_Sim::SysEV_MaxPowerAC;
  $EV.ISO20.AC_DER_ChargeLoop_Request.CLReqControlMode.DER_Dynamic_AC_CLReqControlMode.EVMaximumChargePower_L2.Exponent = 3; //Unit: kW
  $EV.ISO20.AC_DER_ChargeLoop_Request.CLReqControlMode.DER_Dynamic_AC_CLReqControlMode.EVMaximumChargePower_L3.Value = @sysvar::EV_Sim::SysEV_MaxPowerAC;
  $EV.ISO20.AC_DER_ChargeLoop_Request.CLReqControlMode.DER_Dynamic_AC_CLReqControlMode.EVMaximumChargePower_L3.Exponent = 3; //Unit: kW

  /* EVMinimumChargePower */
  $EV.ISO20.AC_DER_ChargeLoop_Request.CLReqControlMode.DER_Dynamic_AC_CLReqControlMode.EVMinimumChargePower.Value = @sysvar::EV_Sim::SysEV_MinPowerAC;
  $EV.ISO20.AC_DER_ChargeLoop_Request.CLReqControlMode.DER_Dynamic_AC_CLReqControlMode.EVMinimumChargePower.Exponent = 3; //Unit: kW
  $EV.ISO20.AC_DER_ChargeLoop_Request.CLReqControlMode.DER_Dynamic_AC_CLReqControlMode.EVMinimumChargePower_L2.Value = @sysvar::EV_Sim::SysEV_MinPowerAC;
  $EV.ISO20.AC_DER_ChargeLoop_Request.CLReqControlMode.DER_Dynamic_AC_CLReqControlMode.EVMinimumChargePower_L2.Exponent = 3; //Unit: kW
  $EV.ISO20.AC_DER_ChargeLoop_Request.CLReqControlMode.DER_Dynamic_AC_CLReqControlMode.EVMinimumChargePower_L3.Value = @sysvar::EV_Sim::SysEV_MinPowerAC;
  $EV.ISO20.AC_DER_ChargeLoop_Request.CLReqControlMode.DER_Dynamic_AC_CLReqControlMode.EVMinimumChargePower_L3.Exponent = 3; //Unit: kW
  $EV.ISO20.AC_DER_ChargeLoop_Request.CLReqControlMode.DER_Scheduled_AC_CLReqControlMode.EVMinimumChargePower.Value = @sysvar::EV_Sim::SysEV_MinPowerAC;
  $EV.ISO20.AC_DER_ChargeLoop_Request.CLReqControlMode.DER_Scheduled_AC_CLReqControlMode.EVMinimumChargePower.Exponent = 3; //Unit: kW
  $EV.ISO20.AC_DER_ChargeLoop_Request.CLReqControlMode.DER_Scheduled_AC_CLReqControlMode.EVMinimumChargePower_L2.Value = @sysvar::EV_Sim::SysEV_MinPowerAC;
  $EV.ISO20.AC_DER_ChargeLoop_Request.CLReqControlMode.DER_Scheduled_AC_CLReqControlMode.EVMinimumChargePower_L2.Exponent = 3; //Unit: kW
  $EV.ISO20.AC_DER_ChargeLoop_Request.CLReqControlMode.DER_Scheduled_AC_CLReqControlMode.EVMinimumChargePower_L3.Value = @sysvar::EV_Sim::SysEV_MinPowerAC;
  $EV.ISO20.AC_DER_ChargeLoop_Request.CLReqControlMode.DER_Scheduled_AC_CLReqControlMode.EVMinimumChargePower_L3.Exponent = 3; //Unit: kW
 }

void FUNC_Set_EVACChargeLoopValues()
{
  $EV.ISO20.AC_ChargeLoop_Request.CLReqControlMode.Dynamic_AC_CLReqControlMode.EVPresentActivePower.Value = @sysvar::EV_Sim::SysEV_PresentPower;
  $EV.ISO20.AC_ChargeLoop_Request.CLReqControlMode.Dynamic_AC_CLReqControlMode.EVPresentActivePower.Exponent = 0;
 
  $EV.ISO20.AC_ChargeLoop_Request.CLReqControlMode.Dynamic_AC_CLReqControlMode.EVPresentActivePower_L2.Value = @sysvar::EV_Sim::SysEV_PresentPower_L2;
  $EV.ISO20.AC_ChargeLoop_Request.CLReqControlMode.Dynamic_AC_CLReqControlMode.EVPresentActivePower_L2.Exponent = 0;
  
  $EV.ISO20.AC_ChargeLoop_Request.CLReqControlMode.Dynamic_AC_CLReqControlMode.EVPresentActivePower_L3.Value = @sysvar::EV_Sim::SysEV_PresentPower_L3;
  $EV.ISO20.AC_ChargeLoop_Request.CLReqControlMode.Dynamic_AC_CLReqControlMode.EVPresentActivePower_L3.Exponent = 0;
  
  $EV.ISO20.AC_ChargeLoop_Request.CLReqControlMode.BPT_Dynamic_AC_CLReqControlMode.EVPresentActivePower.Value = @sysvar::EV_Sim::SysEV_PresentPower;
  $EV.ISO20.AC_ChargeLoop_Request.CLReqControlMode.BPT_Dynamic_AC_CLReqControlMode.EVPresentActivePower.Exponent = 0;
 
  $EV.ISO20.AC_ChargeLoop_Request.CLReqControlMode.BPT_Dynamic_AC_CLReqControlMode.EVPresentActivePower_L2.Value = @sysvar::EV_Sim::SysEV_PresentPower_L2;
  $EV.ISO20.AC_ChargeLoop_Request.CLReqControlMode.BPT_Dynamic_AC_CLReqControlMode.EVPresentActivePower_L2.Exponent = 0;  
  
  $EV.ISO20.AC_ChargeLoop_Request.CLReqControlMode.BPT_Dynamic_AC_CLReqControlMode.EVPresentActivePower_L3.Value = @sysvar::EV_Sim::SysEV_PresentPower_L3;
  $EV.ISO20.AC_ChargeLoop_Request.CLReqControlMode.BPT_Dynamic_AC_CLReqControlMode.EVPresentActivePower_L3.Exponent = 0;

  FUNC_Set_EVACDERChargeLoopValues();
}

void FUNC_Set_EVACDERChargeLoopValues()
{
  $EV.ISO20.AC_DER_ChargeLoop_Request.CLReqControlMode.DER_Dynamic_AC_CLReqControlMode.EVPresentActivePower.Value = @sysvar::EV_Sim::SysEV_PresentPower;
  $EV.ISO20.AC_DER_ChargeLoop_Request.CLReqControlMode.DER_Dynamic_AC_CLReqControlMode.EVPresentActivePower.Exponent = 0;
 
  $EV.ISO20.AC_DER_ChargeLoop_Request.CLReqControlMode.DER_Dynamic_AC_CLReqControlMode.EVPresentActivePower_L2.Value = @sysvar::EV_Sim::SysEV_PresentPower_L2;
  $EV.ISO20.AC_DER_ChargeLoop_Request.CLReqControlMode.DER_Dynamic_AC_CLReqControlMode.EVPresentActivePower_L2.Exponent = 0;  
  
  $EV.ISO20.AC_DER_ChargeLoop_Request.CLReqControlMode.DER_Dynamic_AC_CLReqControlMode.EVPresentActivePower_L3.Value = @sysvar::EV_Sim::SysEV_PresentPower_L3;
  $EV.ISO20.AC_DER_ChargeLoop_Request.CLReqControlMode.DER_Dynamic_AC_CLReqControlMode.EVPresentActivePower_L3.Exponent = 0;

  $EV.ISO20.AC_DER_ChargeLoop_Request.CLReqControlMode.DER_Scheduled_AC_CLReqControlMode.EVPresentActivePower.Value = 2;
  $EV.ISO20.AC_DER_ChargeLoop_Request.CLReqControlMode.DER_Scheduled_AC_CLReqControlMode.EVPresentActivePower.Exponent = 0;
  $EV.ISO20.AC_DER_ChargeLoop_Request.CLReqControlMode.DER_Scheduled_AC_CLReqControlMode.EVPresentActivePower_L2.Value = 2;
  $EV.ISO20.AC_DER_ChargeLoop_Request.CLReqControlMode.DER_Scheduled_AC_CLReqControlMode.EVPresentActivePower_L2.Exponent = 0;  
  $EV.ISO20.AC_DER_ChargeLoop_Request.CLReqControlMode.DER_Scheduled_AC_CLReqControlMode.EVPresentActivePower_L3.Value = 2;
  $EV.ISO20.AC_DER_ChargeLoop_Request.CLReqControlMode.DER_Scheduled_AC_CLReqControlMode.EVPresentActivePower_L3.Exponent = 0;


  $EV.ISO20.AC_DER_ChargeLoop_Request.CLReqControlMode.DER_Scheduled_AC_CLReqControlMode.EVPresentReactivePower.Value = 2;
  $EV.ISO20.AC_DER_ChargeLoop_Request.CLReqControlMode.DER_Scheduled_AC_CLReqControlMode.EVPresentReactivePower.Exponent = 0;
  $EV.ISO20.AC_DER_ChargeLoop_Request.CLReqControlMode.DER_Scheduled_AC_CLReqControlMode.EVPresentReactivePower_L2.Value = 2;
  $EV.ISO20.AC_DER_ChargeLoop_Request.CLReqControlMode.DER_Scheduled_AC_CLReqControlMode.EVPresentReactivePower_L2.Exponent = 0;  
  $EV.ISO20.AC_DER_ChargeLoop_Request.CLReqControlMode.DER_Scheduled_AC_CLReqControlMode.EVPresentReactivePower_L3.Value = 2;
  $EV.ISO20.AC_DER_ChargeLoop_Request.CLReqControlMode.DER_Scheduled_AC_CLReqControlMode.EVPresentReactivePower_L3.Exponent = 0;

  $EV.ISO20.AC_DER_ChargeLoop_Request.CLReqControlMode.DER_Scheduled_AC_CLReqControlMode.EVMaximumDischargePower.AnyPhase.Value = 3;
  $EV.ISO20.AC_DER_ChargeLoop_Request.CLReqControlMode.DER_Scheduled_AC_CLReqControlMode.EVMaximumDischargePower.AnyPhase.Exponent = 0;

  $EV.ISO20.AC_DER_ChargeLoop_Request.CLReqControlMode.DER_Scheduled_AC_CLReqControlMode.EVMinimumDischargePower.AnyPhase.Value = 3;
  $EV.ISO20.AC_DER_ChargeLoop_Request.CLReqControlMode.DER_Scheduled_AC_CLReqControlMode.EVMinimumDischargePower.AnyPhase.Exponent = 0;

  $EV.ISO20.AC_DER_ChargeLoop_Request.CLReqControlMode.DER_Scheduled_AC_CLReqControlMode.EVSessionTotalDischargeEnergyAvailable.Value = 3;
  $EV.ISO20.AC_DER_ChargeLoop_Request.CLReqControlMode.DER_Scheduled_AC_CLReqControlMode.EVSessionTotalDischargeEnergyAvailable.Exponent = 0;

  // EVApparentPower
  $EV.ISO20.AC_DER_ChargeLoop_Request.CLReqControlMode.DER_Scheduled_AC_CLReqControlMode.EVApparentPower.EVMaximumChargeApparentPower.AnyPhase.Value = 3;
  $EV.ISO20.AC_DER_ChargeLoop_Request.CLReqControlMode.DER_Scheduled_AC_CLReqControlMode.EVApparentPower.EVMaximumChargeApparentPower.AnyPhase.Exponent = 0;
  $EV.ISO20.AC_DER_ChargeLoop_Request.CLReqControlMode.DER_Scheduled_AC_CLReqControlMode.EVApparentPower.EVMaximumDischargeApparentPower.AnyPhase.Value = 3;
  $EV.ISO20.AC_DER_ChargeLoop_Request.CLReqControlMode.DER_Scheduled_AC_CLReqControlMode.EVApparentPower.EVMaximumDischargeApparentPower.AnyPhase.Exponent = 0;

  //EVReactivePower
  $EV.ISO20.AC_DER_ChargeLoop_Request.CLReqControlMode.DER_Scheduled_AC_CLReqControlMode.EVReactivePower.EVMaximumChargeReactivePower.AnyPhase.Value = 3;
  $EV.ISO20.AC_DER_ChargeLoop_Request.CLReqControlMode.DER_Scheduled_AC_CLReqControlMode.EVReactivePower.EVMaximumChargeReactivePower.AnyPhase.Exponent = 0;
  $EV.ISO20.AC_DER_ChargeLoop_Request.CLReqControlMode.DER_Scheduled_AC_CLReqControlMode.EVReactivePower.EVMinimumChargeReactivePower.AnyPhase.Value = 3;
  $EV.ISO20.AC_DER_ChargeLoop_Request.CLReqControlMode.DER_Scheduled_AC_CLReqControlMode.EVReactivePower.EVMinimumChargeReactivePower.AnyPhase.Exponent = 0;
  $EV.ISO20.AC_DER_ChargeLoop_Request.CLReqControlMode.DER_Scheduled_AC_CLReqControlMode.EVReactivePower.EVMaximumDischargeReactivePower.AnyPhase.Value = 3;
  $EV.ISO20.AC_DER_ChargeLoop_Request.CLReqControlMode.DER_Scheduled_AC_CLReqControlMode.EVReactivePower.EVMaximumDischargeReactivePower.AnyPhase.Exponent = 0;
  $EV.ISO20.AC_DER_ChargeLoop_Request.CLReqControlMode.DER_Scheduled_AC_CLReqControlMode.EVReactivePower.EVMinimumDischargeReactivePower.AnyPhase.Value = 3;
  $EV.ISO20.AC_DER_ChargeLoop_Request.CLReqControlMode.DER_Scheduled_AC_CLReqControlMode.EVReactivePower.EVMinimumDischargeReactivePower.AnyPhase.Exponent = 0;
  
  //EVExcitation
  $EV.ISO20.AC_DER_ChargeLoop_Request.CLReqControlMode.DER_Scheduled_AC_CLReqControlMode.EVExcitation.EVOverExcitedMaximumDischargePower.Value = 3;
  $EV.ISO20.AC_DER_ChargeLoop_Request.CLReqControlMode.DER_Scheduled_AC_CLReqControlMode.EVExcitation.EVOverExcitedMaximumDischargePower.Exponent = 0;
  $EV.ISO20.AC_DER_ChargeLoop_Request.CLReqControlMode.DER_Scheduled_AC_CLReqControlMode.EVExcitation.EVOverExcitedPowerFactor.Value = 3;
  $EV.ISO20.AC_DER_ChargeLoop_Request.CLReqControlMode.DER_Scheduled_AC_CLReqControlMode.EVExcitation.EVOverExcitedPowerFactor.Exponent = 0;
  $EV.ISO20.AC_DER_ChargeLoop_Request.CLReqControlMode.DER_Scheduled_AC_CLReqControlMode.EVExcitation.EVUnderExcitedMaximumDischargePower.Value = 3;
  $EV.ISO20.AC_DER_ChargeLoop_Request.CLReqControlMode.DER_Scheduled_AC_CLReqControlMode.EVExcitation.EVUnderExcitedMaximumDischargePower.Exponent = 0;
  $EV.ISO20.AC_DER_ChargeLoop_Request.CLReqControlMode.DER_Scheduled_AC_CLReqControlMode.EVExcitation.EVUnderExcitedPowerFactor.Value = 3;
  $EV.ISO20.AC_DER_ChargeLoop_Request.CLReqControlMode.DER_Scheduled_AC_CLReqControlMode.EVExcitation.EVUnderExcitedPowerFactor.Exponent = 0;

  //EVSetPoints
  $EV.ISO20.AC_DER_ChargeLoop_Request.CLReqControlMode.DER_Scheduled_AC_CLReqControlMode.EVSetPoints.EVSetNominalVoltage.Value = 3;
  $EV.ISO20.AC_DER_ChargeLoop_Request.CLReqControlMode.DER_Scheduled_AC_CLReqControlMode.EVSetPoints.EVSetNominalVoltage.Exponent = 0;
  $EV.ISO20.AC_DER_ChargeLoop_Request.CLReqControlMode.DER_Scheduled_AC_CLReqControlMode.EVSetPoints.EVSetNominalVoltageOffset.Value = 3;
  $EV.ISO20.AC_DER_ChargeLoop_Request.CLReqControlMode.DER_Scheduled_AC_CLReqControlMode.EVSetPoints.EVSetNominalVoltageOffset.Exponent = 0;
  $EV.ISO20.AC_DER_ChargeLoop_Request.CLReqControlMode.DER_Scheduled_AC_CLReqControlMode.EVSetPoints.EVSetMaximumNominalVoltage.Value = 3;
  $EV.ISO20.AC_DER_ChargeLoop_Request.CLReqControlMode.DER_Scheduled_AC_CLReqControlMode.EVSetPoints.EVSetMaximumNominalVoltage.Exponent = 0;
  $EV.ISO20.AC_DER_ChargeLoop_Request.CLReqControlMode.DER_Scheduled_AC_CLReqControlMode.EVSetPoints.EVSetMinimumNominalVoltage.Value = 3;
  $EV.ISO20.AC_DER_ChargeLoop_Request.CLReqControlMode.DER_Scheduled_AC_CLReqControlMode.EVSetPoints.EVSetMinimumNominalVoltage.Exponent = 0;

  $EV.ISO20.AC_DER_ChargeLoop_Request.CLReqControlMode.DER_Scheduled_AC_CLReqControlMode.EVPresentVoltage.AnyPhase.Value = 3;
  $EV.ISO20.AC_DER_ChargeLoop_Request.CLReqControlMode.DER_Scheduled_AC_CLReqControlMode.EVPresentVoltage.AnyPhase.Exponent = 0;

  $EV.ISO20.AC_DER_ChargeLoop_Request.CLReqControlMode.DER_Scheduled_AC_CLReqControlMode.EVPresentFrequency.AnyPhase.Value = 3;
  $EV.ISO20.AC_DER_ChargeLoop_Request.CLReqControlMode.DER_Scheduled_AC_CLReqControlMode.EVPresentFrequency.AnyPhase.Exponent = 0;

  //DERGridSupportActiveInfo
  $EV.ISO20.AC_DER_ChargeLoop_Request.CLReqControlMode.DER_Scheduled_AC_CLReqControlMode.DERGridSupportActiveInfo.DERFunctionName = 2;
  $EV.ISO20.AC_DER_ChargeLoop_Request.CLReqControlMode.DER_Scheduled_AC_CLReqControlMode.DERGridSupportActiveInfo.GridEventFault = 2;
  $EV.ISO20.AC_DER_ChargeLoop_Request.CLReqControlMode.DER_Scheduled_AC_CLReqControlMode.DERGridSupportActiveInfo.ExtraInfo = "Info";
  $EV.ISO20.AC_DER_ChargeLoop_Request.CLReqControlMode.DER_Scheduled_AC_CLReqControlMode.DERGridSupportActiveInfo.EventCondition = 1;

  $EV.ISO20.AC_DER_ChargeLoop_Request.CLReqControlMode.DER_Dynamic_AC_CLReqControlMode.EVPresentActivePower.Value = 2;
  $EV.ISO20.AC_DER_ChargeLoop_Request.CLReqControlMode.DER_Dynamic_AC_CLReqControlMode.EVPresentActivePower.Exponent = 0;
  $EV.ISO20.AC_DER_ChargeLoop_Request.CLReqControlMode.DER_Dynamic_AC_CLReqControlMode.EVPresentActivePower_L2.Value = 2;
  $EV.ISO20.AC_DER_ChargeLoop_Request.CLReqControlMode.DER_Dynamic_AC_CLReqControlMode.EVPresentActivePower_L2.Exponent = 0;  
  $EV.ISO20.AC_DER_ChargeLoop_Request.CLReqControlMode.DER_Dynamic_AC_CLReqControlMode.EVPresentActivePower_L3.Value = 2;
  $EV.ISO20.AC_DER_ChargeLoop_Request.CLReqControlMode.DER_Dynamic_AC_CLReqControlMode.EVPresentActivePower_L3.Exponent = 0;


  $EV.ISO20.AC_DER_ChargeLoop_Request.CLReqControlMode.DER_Dynamic_AC_CLReqControlMode.EVPresentReactivePower.Value = 2;
  $EV.ISO20.AC_DER_ChargeLoop_Request.CLReqControlMode.DER_Dynamic_AC_CLReqControlMode.EVPresentReactivePower.Exponent = 0;
  $EV.ISO20.AC_DER_ChargeLoop_Request.CLReqControlMode.DER_Dynamic_AC_CLReqControlMode.EVPresentReactivePower_L2.Value = 2;
  $EV.ISO20.AC_DER_ChargeLoop_Request.CLReqControlMode.DER_Dynamic_AC_CLReqControlMode.EVPresentReactivePower_L2.Exponent = 0;  
  $EV.ISO20.AC_DER_ChargeLoop_Request.CLReqControlMode.DER_Dynamic_AC_CLReqControlMode.EVPresentReactivePower_L3.Value = 2;
  $EV.ISO20.AC_DER_ChargeLoop_Request.CLReqControlMode.DER_Dynamic_AC_CLReqControlMode.EVPresentReactivePower_L3.Exponent = 0;

  $EV.ISO20.AC_DER_ChargeLoop_Request.CLReqControlMode.DER_Dynamic_AC_CLReqControlMode.EVMaximumDischargePower.AnyPhase.Value = 3;
  $EV.ISO20.AC_DER_ChargeLoop_Request.CLReqControlMode.DER_Dynamic_AC_CLReqControlMode.EVMaximumDischargePower.AnyPhase.Exponent = 0;

  $EV.ISO20.AC_DER_ChargeLoop_Request.CLReqControlMode.DER_Dynamic_AC_CLReqControlMode.EVMinimumDischargePower.AnyPhase.Value = 3;
  $EV.ISO20.AC_DER_ChargeLoop_Request.CLReqControlMode.DER_Dynamic_AC_CLReqControlMode.EVMinimumDischargePower.AnyPhase.Exponent = 0;

  $EV.ISO20.AC_DER_ChargeLoop_Request.CLReqControlMode.DER_Dynamic_AC_CLReqControlMode.EVSessionTotalDischargeEnergyAvailable.Value = 3;
  $EV.ISO20.AC_DER_ChargeLoop_Request.CLReqControlMode.DER_Dynamic_AC_CLReqControlMode.EVSessionTotalDischargeEnergyAvailable.Exponent = 0;

  // EVApparentPower
  $EV.ISO20.AC_DER_ChargeLoop_Request.CLReqControlMode.DER_Dynamic_AC_CLReqControlMode.EVApparentPower.EVMaximumChargeApparentPower.AnyPhase.Value = 3;
  $EV.ISO20.AC_DER_ChargeLoop_Request.CLReqControlMode.DER_Dynamic_AC_CLReqControlMode.EVApparentPower.EVMaximumChargeApparentPower.AnyPhase.Exponent = 0;
  $EV.ISO20.AC_DER_ChargeLoop_Request.CLReqControlMode.DER_Dynamic_AC_CLReqControlMode.EVApparentPower.EVMaximumDischargeApparentPower.AnyPhase.Value = 3;
  $EV.ISO20.AC_DER_ChargeLoop_Request.CLReqControlMode.DER_Dynamic_AC_CLReqControlMode.EVApparentPower.EVMaximumDischargeApparentPower.AnyPhase.Exponent = 0;

  //EVReactivePower
  $EV.ISO20.AC_DER_ChargeLoop_Request.CLReqControlMode.DER_Dynamic_AC_CLReqControlMode.EVReactivePower.EVMaximumChargeReactivePower.AnyPhase.Value = 3;
  $EV.ISO20.AC_DER_ChargeLoop_Request.CLReqControlMode.DER_Dynamic_AC_CLReqControlMode.EVReactivePower.EVMaximumChargeReactivePower.AnyPhase.Exponent = 0;
  $EV.ISO20.AC_DER_ChargeLoop_Request.CLReqControlMode.DER_Dynamic_AC_CLReqControlMode.EVReactivePower.EVMinimumChargeReactivePower.AnyPhase.Value = 3;
  $EV.ISO20.AC_DER_ChargeLoop_Request.CLReqControlMode.DER_Dynamic_AC_CLReqControlMode.EVReactivePower.EVMinimumChargeReactivePower.AnyPhase.Exponent = 0;
  $EV.ISO20.AC_DER_ChargeLoop_Request.CLReqControlMode.DER_Dynamic_AC_CLReqControlMode.EVReactivePower.EVMaximumDischargeReactivePower.AnyPhase.Value = 3;
  $EV.ISO20.AC_DER_ChargeLoop_Request.CLReqControlMode.DER_Dynamic_AC_CLReqControlMode.EVReactivePower.EVMaximumDischargeReactivePower.AnyPhase.Exponent = 0;
  $EV.ISO20.AC_DER_ChargeLoop_Request.CLReqControlMode.DER_Dynamic_AC_CLReqControlMode.EVReactivePower.EVMinimumDischargeReactivePower.AnyPhase.Value = 3;
  $EV.ISO20.AC_DER_ChargeLoop_Request.CLReqControlMode.DER_Dynamic_AC_CLReqControlMode.EVReactivePower.EVMinimumDischargeReactivePower.AnyPhase.Exponent = 0;
  
  //EVExcitation
  $EV.ISO20.AC_DER_ChargeLoop_Request.CLReqControlMode.DER_Dynamic_AC_CLReqControlMode.EVExcitation.EVOverExcitedMaximumDischargePower.Value = 3;
  $EV.ISO20.AC_DER_ChargeLoop_Request.CLReqControlMode.DER_Dynamic_AC_CLReqControlMode.EVExcitation.EVOverExcitedMaximumDischargePower.Exponent = 0;
  $EV.ISO20.AC_DER_ChargeLoop_Request.CLReqControlMode.DER_Dynamic_AC_CLReqControlMode.EVExcitation.EVOverExcitedPowerFactor.Value = 3;
  $EV.ISO20.AC_DER_ChargeLoop_Request.CLReqControlMode.DER_Dynamic_AC_CLReqControlMode.EVExcitation.EVOverExcitedPowerFactor.Exponent = 0;
  $EV.ISO20.AC_DER_ChargeLoop_Request.CLReqControlMode.DER_Dynamic_AC_CLReqControlMode.EVExcitation.EVUnderExcitedMaximumDischargePower.Value = 3;
  $EV.ISO20.AC_DER_ChargeLoop_Request.CLReqControlMode.DER_Dynamic_AC_CLReqControlMode.EVExcitation.EVUnderExcitedMaximumDischargePower.Exponent = 0;
  $EV.ISO20.AC_DER_ChargeLoop_Request.CLReqControlMode.DER_Dynamic_AC_CLReqControlMode.EVExcitation.EVUnderExcitedPowerFactor.Value = 3;
  $EV.ISO20.AC_DER_ChargeLoop_Request.CLReqControlMode.DER_Dynamic_AC_CLReqControlMode.EVExcitation.EVUnderExcitedPowerFactor.Exponent = 0;

  //EVSetPoints
  $EV.ISO20.AC_DER_ChargeLoop_Request.CLReqControlMode.DER_Dynamic_AC_CLReqControlMode.EVSetPoints.EVSetNominalVoltage.Value = 3;
  $EV.ISO20.AC_DER_ChargeLoop_Request.CLReqControlMode.DER_Dynamic_AC_CLReqControlMode.EVSetPoints.EVSetNominalVoltage.Exponent = 0;
  $EV.ISO20.AC_DER_ChargeLoop_Request.CLReqControlMode.DER_Dynamic_AC_CLReqControlMode.EVSetPoints.EVSetNominalVoltageOffset.Value = 3;
  $EV.ISO20.AC_DER_ChargeLoop_Request.CLReqControlMode.DER_Dynamic_AC_CLReqControlMode.EVSetPoints.EVSetNominalVoltageOffset.Exponent = 0;
  $EV.ISO20.AC_DER_ChargeLoop_Request.CLReqControlMode.DER_Dynamic_AC_CLReqControlMode.EVSetPoints.EVSetMaximumNominalVoltage.Value = 3;
  $EV.ISO20.AC_DER_ChargeLoop_Request.CLReqControlMode.DER_Dynamic_AC_CLReqControlMode.EVSetPoints.EVSetMaximumNominalVoltage.Exponent = 0;
  $EV.ISO20.AC_DER_ChargeLoop_Request.CLReqControlMode.DER_Dynamic_AC_CLReqControlMode.EVSetPoints.EVSetMinimumNominalVoltage.Value = 3;
  $EV.ISO20.AC_DER_ChargeLoop_Request.CLReqControlMode.DER_Dynamic_AC_CLReqControlMode.EVSetPoints.EVSetMinimumNominalVoltage.Exponent = 0;

  $EV.ISO20.AC_DER_ChargeLoop_Request.CLReqControlMode.DER_Dynamic_AC_CLReqControlMode.EVPresentVoltage.AnyPhase.Value = 3;
  $EV.ISO20.AC_DER_ChargeLoop_Request.CLReqControlMode.DER_Dynamic_AC_CLReqControlMode.EVPresentVoltage.AnyPhase.Exponent = 0;

  $EV.ISO20.AC_DER_ChargeLoop_Request.CLReqControlMode.DER_Dynamic_AC_CLReqControlMode.EVPresentFrequency.AnyPhase.Value = 3;
  $EV.ISO20.AC_DER_ChargeLoop_Request.CLReqControlMode.DER_Dynamic_AC_CLReqControlMode.EVPresentFrequency.AnyPhase.Exponent = 0;

  //DERGridSupportActiveInfo
  $EV.ISO20.AC_DER_ChargeLoop_Request.CLReqControlMode.DER_Dynamic_AC_CLReqControlMode.DERGridSupportActiveInfo.DERFunctionName = 2;
  $EV.ISO20.AC_DER_ChargeLoop_Request.CLReqControlMode.DER_Dynamic_AC_CLReqControlMode.DERGridSupportActiveInfo.GridEventFault = 2;
  $EV.ISO20.AC_DER_ChargeLoop_Request.CLReqControlMode.DER_Dynamic_AC_CLReqControlMode.DERGridSupportActiveInfo.ExtraInfo = "Info";
  $EV.ISO20.AC_DER_ChargeLoop_Request.CLReqControlMode.DER_Dynamic_AC_CLReqControlMode.DERGridSupportActiveInfo.EventCondition = 1;
} 