/*@!Encoding:1252*/

//////////////////////////////////////////////////////////////////////////////////////////
//
// Node1.can
//
// Copyright 2022, Vector Informatik GmbH - All right reserved
//
// This node uses the J1939 Interaction Layer to send the messages CycleTime1000 and
// CycleTime2000 cylcically (configuration is done in J1939.dbc). If you activate
// diagnostics support then message DM1 is sent. You can request some messages.
//
//////////////////////////////////////////////////////////////////////////////////////////

includes
{
  
}

variables
{
  
}

on preStart
{
  char buffer[50];

  // initialize system variables with values of database
  @Node1::MultiPgSizeThreshold = Node1.J1939MultiPgSizeThreshold;
  strncpy(buffer, Node1.J1939MultiPgBroadcastType, elcount(buffer) - 1);
  if (strncmp(buffer, "FBFF", elCount(buffer)) == 0)
  {
    @Node1::MultiPgBroadcastType = sysvar::Node1::MultiPgBroadcastType::FBFF;
  }
  else
  {
    @Node1::MultiPgBroadcastType = sysvar::Node1::MultiPgBroadcastType::FEFF;    
  }
}

// Set property "MultiPgBroadcastType" of Node1
on sysvar_update sysvar::Node1::MultiPgBroadcastType
{
  J1939ILSetNodeProperty("MultiPgBroadcastType", @this); 
}

// Set property "MultiPgSizeThreshold" of Node1
on sysvar_update sysvar::Node1::MultiPgSizeThreshold
{
  J1939ILSetNodeProperty("MultiPgSizeThreshold", @this); 
}

// Enable or disable cyclic messages
on sysvar_update sysvar::Node1::EnableCyclicCPGs
{
  if (@this > 0)
  {
    J1939ILEnableMsg(CPgCyclic1000);
    J1939ILEnableMsg(CPgCyclic2000);
  }
  else
  {
    J1939ILDisableMsg(CPgCyclic1000);
    J1939ILDisableMsg(CPgCyclic2000);
  }
}

// Activate or deactivate Diagnostic Trouble Code (SPN 12, FMI 1)
on sysvar_update sysvar::Node1::ActivateDiagnosticsSupport
{ 
  J1939ILActivateDiagnosticsSupport(@this);
  EnableControl("Node1", "Check Box Activate DTC", @this);
}

// Activate or deactivate Diagnostic Trouble Code (SPN 12, FMI 1)
on sysvar_update sysvar::Node1::ActivateDTC
{
  dword spn = 12, fmi = 1; 
  if (@this > 0)
  {
    J1939ILActivateDTC(spn, fmi, 0);
  }
  else
  {
    J1939ILDeactivateDTC(spn, fmi, 0);    
  }
}

// Request a message from  another node
on sysvar_update sysvar::Node1::RequestCPG1OfNode2
{
  pg RQST request;
  
  if (@this)
  {
    request.sa = J1939ILGetAddress();
    request.da = J1939GetAddress(Node2);
    request.ParameterGroupNumber  = CPg1.pgn;
    output(request);
  }
}

// Request a message from  another node
on sysvar_update sysvar::Node1::RequestAddressClaimed
{
  pg RQST request;
  
  if (@this)
  {
    request.sa = J1939ILGetAddress();
    request.da = 255;
    request.ParameterGroupNumber  = AC.pgn;
    output(request);
  }
}