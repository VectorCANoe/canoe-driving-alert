/*@!Encoding:1252*/

//////////////////////////////////////////////////////////////////////////////////////////
//
// Node2.can
//
// Copyright 2022, Vector Informatik GmbH - All right reserved
//
// This node uses CAPL functions J1939ILSetNodeProperty and J1939ILSetMessageProperty to
// set CAN-FD specific properties of node Node1 and message CPG1 according to J1939-22. 
// The message is triggered by CAPL function J1939ILSetMsgEvent. In callback J1939ILOnTxPrepare
// an optional assurance data is added to CPG1.  
//
//////////////////////////////////////////////////////////////////////////////////////////

includes
{
}

variables
{
  // constants
  const byte DataLengthOfMessage1WithoutAssuranceData = 8;
  const byte TransmissionMethodCPG = 1;
  enum WriteSink
  {
    SinkWriteWindowPageCAPL = 1,
    SinkTraceWindow = -3
  };
  enum WriteSeverity
  {
    SeveritySuccess = 0,
    SeverityInformation = 1,
    SeverityWarning = 2,
    SeverityError = 3
  };
}

on preStart
{
  char buffer[50];
  
  // initialize system variables with values of database
  @Node2::MultiPgSizeThreshold = Node2.J1939MultiPgSizeThreshold;
  @Node2::MultiPgSendTimeout   = Node2.J1939MultiPgSendTimeout;
  
  strncpy(buffer, CPg1.J1939PgAppearanceOnBus, elcount(buffer) - 1);
  if (strncmp(buffer, "CAN_Extended", elCount(buffer)) == 0)
  {
    @Node2::CPG1::AppearanceOnBus = sysvar::Node2::CPG1::AppearanceOnBus::ClassicExtended;
  }
  else if (strncmp(buffer, "CANFD_Extended", elCount(buffer)) == 0)
  {
    @Node2::CPG1::AppearanceOnBus = sysvar::Node2::CPG1::AppearanceOnBus::FdExtended;
  } 
  else
  {
    @Node2::CPG1::AppearanceOnBus = sysvar::Node2::CPG1::AppearanceOnBus::ContainedPG;
  }
  @Node2::CPG1::SendTimeout         = CPg1.J1939CPgSendTimeout;
  @Node2::CPG1::TypeOfSerice        = CPg1.J1939CPgTOS;
  @Node2::CPG1::TrailerFormatValue  = CPg1.J1939CPgTF;
}


// Trigger CPG1
on sysvar_update sysvar::Node2::TriggerCPG1
{
  if (@this) 
  {
    writeEx(SinkTraceWindow, SeverityInformation, "Trigger CPG1" );
    J1939ILSetMsgEvent(CPg1);
  }
}

// Set Multi-PG Send Timeout of Node2
on sysvar_update sysvar::Node2::MultiPgSendTimeout
{
  J1939ILSetNodeProperty("MultiPgSendTimeout", @this);
}

// Set Multi-PG Size Threshold of Node2
on sysvar_update sysvar::Node2::MultiPgSizeThreshold
{
  J1939ILSetNodeProperty("MultiPgSizeThreshold", @this);
}

// Set C-PG Send Timeout of CPG1
on sysvar_update sysvar::Node2::CPG1::SendTimeout
{
  J1939ILSetMessageProperty(CPg1, "CPgSendTimeout", @this);
}

// Set C-PG Type of Service of CPG1 
on sysvar_update sysvar::Node2::CPG1::TypeOfSerice
{
  J1939ILSetMessageProperty(CPg1, "CPgTOS", @this);
}

// Set C-PG Trailer Format Value of CPG1
on sysvar_update sysvar::Node2::CPG1::TrailerFormatValue
{
  J1939ILSetMessageProperty(CPg1, "CPgTF", @this);
}

// Set appearnce type of CPG1 on the bus   
on sysvar_update sysvar::Node2::CPG1::AppearanceOnBus
{
  J1939ILSetMessageProperty(CPg1, "PgAppearanceOnBus", @this);
}

// In the callback J1939ILOnTxPrepare we check if we had to add assurance data to CPG1
long J1939ILOnTxPrepare(pg* txPG)
{
  long sendMessage;
  
  sendMessage = 1; // by default all messages are sent
  
  if (txPG.pgn == CPg1.pgn)
  {
    // set default length
    txPG.dlc = DataLengthOfMessage1WithoutAssuranceData;

    // if message is not transmitted as Contained PG we can stop here
    if (txPG.tm != TransmissionMethodCPG) 
    {
      @Node2::CPG1::AssuranceDataLength = 0;
      return 1;
    }
   
    // check if we have to add assurance data
    switch (txPG.tos)
    {
      case 1:
        switch (txPG.tf)
        {
          case 1:
            writeEx(SinkWriteWindowPageCAPL, SeverityInformation, "\n<Node2> Trigger CPG1 with 32-bit cybersecurity assurance data" );
            sendMessage = AddAssuranceDataAndTransmitMessage1(txPG, 4);
            break;
          case 2:
            writeEx(SinkWriteWindowPageCAPL, SeverityInformation, "\n<Node2> Trigger CPG1 with 32-bit functional safety assurance data" );
            sendMessage = AddAssuranceDataAndTransmitMessage1(txPG, 4);
            break;
          case 3:
            writeEx(SinkWriteWindowPageCAPL, SeverityInformation, "\n<Node2> Trigger CPG1 with 32-bit cybersecurity followed by a 32-bit functional safety assurance data" );
            sendMessage = AddAssuranceDataAndTransmitMessage1(txPG, 8);
            break;
          case 5:
            writeEx(SinkWriteWindowPageCAPL, SeverityInformation, "\n<Node2> Trigger CPG1 with 64-bit cybersecurity assurance data" );
            sendMessage = AddAssuranceDataAndTransmitMessage1(txPG, 8);
            break;
          case 6:
            writeEx(SinkWriteWindowPageCAPL, SeverityInformation, "\n<Node2> Trigger CPG1 with 64-bit functional safety assurance data" );
            sendMessage = AddAssuranceDataAndTransmitMessage1(txPG, 8);
            break;
          default:
            writeEx(SinkWriteWindowPageCAPL, SeverityError, "\n<Node2> Failed to send CPG1 because it uses reserved TF/TOS combination (TF %u / TOS %u)", txPG.tf, txPG.tos );
            sendMessage = 0;
            break;
        }
        break;
      case 2:
        if (txPG.tf == 0)
        {
          writeEx(SinkWriteWindowPageCAPL, SeverityInformation, "\n<Node2> Trigger CPG1 with no assurance data" );
          sendMessage = 1;
        }
        else 
        {
          writeEx(SinkWriteWindowPageCAPL, SeverityError, "\n<Node2> Failed to send CPG1 because it uses reserved TF/TOS combination (TF %u / TOS %u)", txPG.tf, txPG.tos );
          sendMessage = 0;
        }
        break;
      default:
        writeEx(SinkWriteWindowPageCAPL, SeverityError, "\n<Node2> Failed to send CPG1 because it uses reserved TF/TOS combination (TF %u / TOS %u)", txPG.tf, txPG.tos );
        sendMessage= 0;
        break;     
    }
  }
  
  return sendMessage;
}

// This function adds the assurance data of system variable 
// sysvar::Node2::CPG1::AssuranceData to the end of CPG1
long AddAssuranceDataAndTransmitMessage1(pg* message1, byte assuranceDataLength)
{
  byte assuranceData[8];
  long copiedBytes;
  byte position;
  
  if (assuranceDataLength > 8)
  {
    message1.dlc = DataLengthOfMessage1WithoutAssuranceData;
    writeEx(SinkWriteWindowPageCAPL, SeverityError, "\n<Node2> AddAssuranceDataToMessage1 is called with invalid length %u", assuranceDataLength);
    return 0;    
  }
 
  
  // set new data length of the message
  message1.dlc = DataLengthOfMessage1WithoutAssuranceData + assuranceDataLength;
  @Node2::CPG1::AssuranceDataLength = assuranceDataLength;
  
  // add assurance data to the message
  // (in this example we only set assurance data to 00 01 02 03....)
  for (position=0; position<assuranceDataLength; ++position)
  {
    message1.byte(8+position) = position;
  }

  return 1; // send message
}