/*@!Encoding:1252*/
includes
{
  
}

variables
{
  
}

on start
{
  J1939ILDisableMsg(Message2);
}

on sysvar_update sysvar::Producer::Message1::Send
{
  if (@this > 0)
  {
    J1939ILEnableMsg(Message1);
  }
  else
  {
    J1939ILDisableMsg(Message1);
  }
}

on sysvar_update sysvar::Producer::Message2::Send
{
  if (@this > 0)
  {
    J1939ILEnableMsg(Message2);
  }
  else
  {
    J1939ILDisableMsg(Message2);
  }
}

on sysvar Producer::Message1::FaultInjection
{
  // reset all fault injection
  J1939ILResetBlockedTxMessage(SHM.pgn, Consumer.NmStationAddress, 0xFFFFFF03, 0xEFFDFE03);  
  J1939ILResetManipulatedMessage(SHM.pgn, Consumer.NmStationAddress, 0xFFFFFF03, 0xEFFDFE03);  

  // fault injection
  switch (@this)
  {
    case sysvar::Producer::Message1::FaultInjection::BlockSHM:
      J1939ILBlockTxMessage(SHM.pgn, Consumer.NmStationAddress, 0xFFFFFF03, 0xEFFDFE03);  
      break;
    case sysvar::Producer::Message1::FaultInjection::DisturbSHMSequenceNumber:
      // set SDG Sequence Number to 0
      J1939ILManipulateMessage(SHM.pgn, Consumer.NmStationAddress, 0xFFFFFF03, 0xEFFDFE03, 0xF8, 0x00);  
      break;
    case sysvar::Producer::Message1::FaultInjection::DisturbSHMCRC:
      // set SDM Data CRC to 0
      J1939ILManipulateMessage(SHM.pgn, Consumer.NmStationAddress, 0xFFFFFF03, 0xEFFDFE03, 0xFFFFFFFF00000000LL, 0x0);  
      break;
    case sysvar::Producer::Message1::FaultInjection::DisturbSHMCANID:
      // set Inverted SDM Source Address to 0
      J1939ILManipulateMessage(SHM.pgn, Consumer.NmStationAddress, 0xFFFFFF03, 0xEFFDFE03, 0xFF00, 0x0);  
      break;
    case sysvar::Producer::Message1::FaultInjection::NoFaultInjection:
    default:
      break;
  }
}


