/*@!Encoding:1252*/
/*
 * TPMS - Tire Pressure Monitor System Test Library
 *
 * Copyright Vector Informatik GmbH - All right reserved
 *
 */
variables
{
  // Constants
  const int  NullAddress    = 0xfe;   // Null address
  const int  GlobalAddress  = 0xff;   // Global address

  //Constants for diagnostics
  const BYTE kFMI_AboveNormalCritical = 0;    // DATA VALID BUT ABOVE NORMAL OPERATIONAL RANGE
  const BYTE kFMI_BelowNormalCritical = 1;    // DATA VALID BUT BELOW NORMAL OPERATIONAL RANGE
  const BYTE kFMI_AboveNormalWarn     = 0x0f; // DATA VALID BUT ABOVE NORMAL OPERATIONAL RANGE
  const BYTE kFMI_BelowNormalWarn     = 0x11; // DATA VALID BUT BELOW NORMAL OPERATIONAL RANGE
  const BYTE kFMI_DataErratic         = 2;    // DATA ERRATIC, INTERMITTENT OR INCORRECT
  const BYTE kFMI_CauseUnknown        = 11;   // ROOT CAUSE NOT KNOWN

  // Tester Control Variables
  char textBuffer[512];
  
  // Buffer to save time
  dword timeBuffer;
}

////////////////////////////////////////////////////////
//
// Test functions
//
////////////////////////////////////////////////////////

/*
 * Stores current time in a buffer
 */
export testfunction SaveCurrentTime()
{
  timeBuffer = timeNow();
}

/*
 * Check if current time is bigger than saved time + timeDifference
 */
export testfunction CheckCurrentTime(dword minDifferenceToSaveTimeMS)
{
  if (timeNow() < (timeBuffer + (minDifferenceToSaveTimeMS*100)))
  {
    snprintf( textBuffer, elCount(textBuffer), "Time difference is %dms but minimum allowed difference is %dms", (timeNow() - timeBuffer) / 100, minDifferenceToSaveTimeMS);
    testStepFail( textBuffer );
  }
  else
  {
    testStepPass();   
  }
}


////////////////////////////////////////////////////////
//
// Test cases
//
////////////////////////////////////////////////////////

/*
 * Test case 2.1 - Request PGs from DUT
 *
 * Send request for all parameter groups which the DUT can transmit.
 */
export testcase TC2_1_RequestAllPGs()
{
  DWORD pgns[6]   = { SOFT.pgn, DM12.pgn, TPRI.pgn, DM02.pgn, DM04.pgn, DM05.pgn };
  DWORD global[6] = { 0x0000, 0x0000, 0x0000, 0x0001, 0x0001, 0x0000 };
  int i;
  pg RQST txRQST;
  BYTE sourceAddr;

  TestCaseComment( "Send request for all parameter groups which the DUT can transmit and wait for response.");
  
  sourceAddr = Tester.NmStationAddress;

  for( i = 0; i < elCount(pgns); i++ ) 
  {
    // send request
    txRQST.SA                   = sourceAddr;
    txRQST.DA                   = (global[i] == 1) ? GlobalAddress : TirePressureController.NmStationAddress;
    txRQST.ParameterGroupNumber = pgns[i];
    output( txRQST );

    if (((pgns[i] >> 8) & 0xff) >= 0xf0) //global PGN
    { 
      // wait for a Global response             
      switch(TestWaitForJ1939PG( pgns[i], TirePressureController.NmStationAddress, GlobalAddress, 1250 )) 
      {
        case 0: // timeout
          snprintf( textBuffer, elCount(textBuffer), "Timeout. Requested PGN 0x%x not received.", pgns[i] );
          TestStepFail( textBuffer );
          break;        
        case 1: // ok: message has occurred
          break;
        default: // Failed
          TestStepFail( "WaitForMessage: General error occurred. ");
          break;
      }
    }
    else // Specific PGN
    {
      // wait for a Specific response
      switch(TestWaitForJ1939PG( pgns[i], TirePressureController.NmStationAddress, Tester.NmStationAddress, 1250 )) 
      {
        case 0: // timeout
          snprintf( textBuffer, elCount(textBuffer), "Timeout. Requested PGN 0x%x not received.", pgns[i] );
          TestStepFail( textBuffer );
          break;
        case 1: // ok: message has occurred
          break;
        default: // Failed
          TestStepFail( "WaitForMessage: General error occurred. ");
          break;
      }
    }
  }

  testWaitForTimeout( 10 );
  TestStepPass();
}

/*
 * Test case 2.3 - Request TIRE
 *
 * Request TIRE message from DUT.
 */
export testcase TC2_2_RequestTIRE()
{
  pg RQST txRQST;
  pg TIRE1 rxTIRE;

  TestCaseComment( "Request TIRE from the DUT. The DUT must respond with 6 TIRE messages. One for each tire.");
  
  // send request
  txRQST.SA                   = Tester.NmStationAddress;
  txRQST.DA                   = TirePressureController.NmStationAddress;
  txRQST.ParameterGroupNumber = TIRE1.pgn;
  output( txRQST );

  // check responses
  WaitForTIRE1AndCheckPressure(0x00);
  WaitForTIRE1AndCheckPressure(0x01);
  WaitForTIRE1AndCheckPressure(0x10);
  WaitForTIRE1AndCheckPressure(0x11);
  WaitForTIRE1AndCheckPressure(0x20);
  WaitForTIRE1AndCheckPressure(0x21);

  testWaitForTimeout( 10 );
}

/*
 * Test case 2.4 - Request TPRI
 *
 * Request TIRE message from DUT.
 */
export testcase TC2_3_RequestTPRI()
{
  pg RQST txRQST;
  pg TPRI rxTPRI;

  TestCaseComment( "Request TPRI from the DUT. The DUT must respond with 6 TPRI messages. One for each tire.");

  // send request
  txRQST.SA                   = Tester.NmStationAddress;
  txRQST.DA                   = TirePressureController.NmStationAddress;
  txRQST.ParameterGroupNumber = 0xFDB9; // TPRI PGN
  output( txRQST );
 
  WaitForTPRI(0x00);
  WaitForTPRI(0x01);
  WaitForTPRI(0x10);
  WaitForTPRI(0x11);
  WaitForTPRI(0x20);
  WaitForTPRI(0x21);

  testWaitForTimeout( 10 );
}

/*
 * Test case 3.1 - Set reference pressure with TPRS
 */
export testcase TC3_1_SetRefPressureWithTPRS()
{
  long result;
  pg RQST txRQST;
  pg TPRI rxTPRI;
  pg TPRS txTPRS;
  float diff;
		
  TestCaseComment( "Set reference pressure by sending TPRS and check actual pressure by requesting TPRI .");

	txTPRS.DWORD(0) = txTPRS.DWORD(4) = 0xFFFFFFFF; //init datafield
  diff = 8;

  // Step 1 

  TestStep("3.1.1", "Send TPRS for each Tire." );

  //send first TPRS
  txTPRS.SA = Tester.NmStationAddress;
  txTPRS.DA = TirePressureController.NmStationAddress;
  txTPRS.TireLocation = 0x00;
  txTPRS.ReferenceTirePressSetting_00.phys = @TPMS::FrontLeftPressure + diff;
  output( txTPRS );

  //send second TPRS
  txTPRS.TireLocation = 0x01;
  txTPRS.ReferenceTirePressSetting_01.phys = @TPMS::FrontRightPressure + diff;
  output( txTPRS );

  //send third TPRS
  txTPRS.TireLocation = 0x10;
  txTPRS.ReferenceTirePressSetting_10.phys = @TPMS::Rear1LeftPressure + diff;
  output( txTPRS );

  //send fourth TPRS
  txTPRS.TireLocation = 0x11;
  txTPRS.ReferenceTirePressSetting_11.phys = @TPMS::Rear1RightPressure + diff;
  output( txTPRS );

  //send fifth TPRS
  txTPRS.TireLocation = 0x20;
  txTPRS.ReferenceTirePressSetting_20.phys = @TPMS::Rear2LeftPressure + diff;
  output( txTPRS );

  //send sixth TPRS
  txTPRS.TireLocation = 0x21;
  txTPRS.ReferenceTirePressSetting_21.phys = @TPMS::Rear2RightPressure + diff;
  output( txTPRS );
  
  // Step 2 

  TestStep("3.1.2", "Send requests for TPRI and wait for responses." );

  //send request
  txRQST.SA                   = Tester.NmStationAddress;
  txRQST.DA                   = TirePressureController.NmStationAddress;
  txRQST.ParameterGroupNumber = 0xFDB9; // TPRI PGN
  output( txRQST );

  WaitForTPRIAndCheckPressure(0x00, diff);
  WaitForTPRIAndCheckPressure(0x01, diff);
  WaitForTPRIAndCheckPressure(0x10, diff);
  WaitForTPRIAndCheckPressure(0x11, diff);
  WaitForTPRIAndCheckPressure(0x20, diff);
  WaitForTPRIAndCheckPressure(0x21, diff);

  /* Cleanup test case */

  TestStep("3.1.3", "Clean up" );
 
  //send first TPRS
  txTPRS.SA = Tester.NmStationAddress;
  txTPRS.DA = TirePressureController.NmStationAddress;
  txTPRS.ReferenceTirePressSetting_00.phys = 724;
  txTPRS.TireLocation = 0x00;
  output( txTPRS );

  //send second TPRS
  txTPRS.TireLocation = 0x01;
  output( txTPRS );

  //send third TPRS
  txTPRS.TireLocation = 0x10;
  txTPRS.ReferenceTirePressSetting_10.phys = 800;
  output( txTPRS );

  //send fourth TPRS
  txTPRS.TireLocation = 0x11;
  output( txTPRS );

  //send fifth TPRS
  txTPRS.TireLocation = 0x20;
  output( txTPRS );

  //send sixth TPRS
  txTPRS.TireLocation = 0x21;
  output( txTPRS );
}

/*
 * Test case 3.2 - Reduce tire pressure and wait for DM1
 */
export testcase TC3_2_ReduceTirePressue()
{
  long result;

  TestCaseComment( "Reduce tire pressure and wait for DM1.");

  // Step 1 

  TestStep("3.2.1", "Reduce tire pressue front/left to warning level and wait for DM1. " );

  @TPMS::FrontLeftPressure = 644;

  if (TpmsWaitForDM1( TirePressureController.NmStationAddress, 241, kFMI_BelowNormalWarn, 3 ) != 0) 
  {
    TestStepFail( "DM1 missing or has wrong values." );
  }
  else
  {
    TestStepPass( "DM1 received with correct values." );
  }

  @TPMS::FrontLeftPressure = 728;
  testWaitForTimeout( 500 );

  // Step 2 

  TestStep("3.2.2", "Reduce tire pressue front/left to critical level and wait for DM1. " );

  @TPMS::FrontLeftPressure = 608;

  if (TpmsWaitForDM1( TirePressureController.NmStationAddress, 241, kFMI_BelowNormalCritical, 2 ) != 0) 
  {
    TestStepFail( "DM1 missing or has wrong values. " );
  }
  else
  {
    TestStepPass( "DM1 received with correct values." );
  }

  @TPMS::FrontLeftPressure = 728;
  testWaitForTimeout( 500 );

  // Step 3 
  
  TestStep("3.2.3", "Reduce tire pressue front/right to warning level and wait for DM1. " );

  @TPMS::FrontRightPressure = 644;

  if (TpmsWaitForDM1( TirePressureController.NmStationAddress, 241, kFMI_BelowNormalWarn, 3 ) != 0) 
  {
    TestStepFail( "DM1 missing or has wrong values. " );
  }
  else
  {
    TestStepPass( "DM1 received with correct values." );
  }

  @TPMS::FrontRightPressure = 728;
  testWaitForTimeout( 500 );

  // Step 4 

  TestStep("3.2.4", "Reduce tire pressue front/right to critical level and wait for DM1. " );

  @TPMS::FrontRightPressure = 608;

  if (TpmsWaitForDM1( TirePressureController.NmStationAddress, 241, kFMI_BelowNormalCritical, 2 ) != 0) 
  {
    TestStepFail( "DM1 missing or has wrong values. " );
  }
  else
  {
    TestStepPass( "DM1 received with correct values." );
  }
  
  @TPMS::FrontRightPressure = 728;
  testWaitForTimeout( 500 );
  
  // Step 5 

  TestStep("3.2.5", "Reduce tire pressue rear1/left to warning level and wait for DM1. " );

  @TPMS::Rear1LeftPressure = 712;

  if (TpmsWaitForDM1( TirePressureController.NmStationAddress, 241, kFMI_BelowNormalWarn, 3 ) != 0) 
  {
    TestStepFail( "DM1 missing or has wrong values. " );
  }
  else
  {
    TestStepPass( "DM1 received with correct values." );  
  }
  
  @TPMS::Rear1LeftPressure =  800;
  testWaitForTimeout( 500 );

  // Step 6 

  TestStep("3.2.6", "Reduce tire pressue rear1/left to critical level and wait for DM1. " );

  @TPMS::Rear1LeftPressure = 672;

  if (TpmsWaitForDM1( TirePressureController.NmStationAddress, 241, kFMI_BelowNormalCritical, 2 ) != 0) 
  {
    TestStepFail( "DM1 missing or has wrong values. " );
  } 
  else
  {
    TestStepPass( "DM1 received with correct values." );  
  }
  
  @TPMS::Rear1LeftPressure = 800;
  testWaitForTimeout( 500 );

  // Step 7 

  TestStep("3.2.7", "Reduce tire pressue rear1/keft to warning level and wait for DM1. " );

  @TPMS::Rear1RightPressure = 712;

  if (TpmsWaitForDM1( TirePressureController.NmStationAddress, 241, kFMI_BelowNormalWarn, 3 ) != 0) 
  {
      TestStepFail( "DM1 missing or has wrong values. " );
  }
  else
  {
    TestStepPass("", "DM1 received with correct values." );  
  }
  
  @TPMS::Rear1RightPressure = 800;
  testWaitForTimeout( 500 );

  // Step 8 

  TestStep("3.2.8", "Reduce tire pressue rear1/right to critical level and wait for DM1. " );

  @TPMS::Rear1RightPressure = 672;

  if (TpmsWaitForDM1( TirePressureController.NmStationAddress, 241, kFMI_BelowNormalCritical, 2 ) != 0) 
  {
    TestStepFail( "DM1 missing or has wrong values. " );
  }
  else
  {
    TestStepPass( "DM1 received with correct values." );    
  }

  @TPMS::Rear1RightPressure = 800;
  testWaitForTimeout( 500 );

  // Step 9 

  TestStep("3.2.9", "Reduce tire pressue rear2/left to warning level and wait for DM1. " );

  @TPMS::Rear2LeftPressure = 716;

  if (TpmsWaitForDM1( TirePressureController.NmStationAddress, 241, kFMI_BelowNormalWarn, 3 ) != 0) 
  {
      TestStepFail( "DM1 missing or has wrong values. " );
  }
  else
  {  
    TestStepPass( "DM1 received with correct values." );
  }

  @TPMS::Rear2LeftPressure = 800;
  testWaitForTimeout( 500 );

  // Step 10 

  TestStep("3.2.10", "Reduce tire pressue rear2/left to critical level and wait for DM1. " );

  @TPMS::Rear2LeftPressure = 676;

  if (TpmsWaitForDM1( TirePressureController.NmStationAddress, 241, kFMI_BelowNormalCritical, 2 ) != 0) 
  {
      TestStepFail( "DM1 missing or has wrong values. " );
  }
  else
  {  
    TestStepPass( "DM1 received with correct values." );
  }

  @TPMS::Rear2LeftPressure = 800;
  testWaitForTimeout( 500 );

  // Step 11 

  TestStep("Step 11", "Reduce tire pressue rear2/left to warning level and wait for DM1. " );

  @TPMS::Rear2RightPressure = 716;

  if (TpmsWaitForDM1( TirePressureController.NmStationAddress, 241, kFMI_BelowNormalWarn, 3 ) != 0) 
  {
      TestStepFail( "DM1 missing or has wrong values. " );
  }
  else
  {  
    TestStepPass( "DM1 received with correct values." );
  }

  @TPMS::Rear2RightPressure = 800;
  testWaitForTimeout( 500 );

  // Step 12 

  TestStep("Step 12", "Reduce tire pressue rear2/right to critical level and wait for DM1. " );

  @TPMS::Rear2RightPressure = 676;

  if (TpmsWaitForDM1( TirePressureController.NmStationAddress, 241, kFMI_BelowNormalCritical, 2 ) != 0) 
  {
    TestStepFail( "DM1 missing or has wrong values. " );
  }
  else
  {  
    TestStepPass( "DM1 received with correct values." );
  }

  @TPMS::Rear2RightPressure = 800;
  testWaitForTimeout( 500 );
}

/*
 * Test case 3.3 - Increase tire pressure and wait for DM1
 */
export testcase TC3_3_IncreaseTirePressue()
{
  long result;

  TestCaseComment( "Increase tire pressure and wait for DM1.");

  // Step 1 

  TestStep("3.3.1", "Increase tire pressue front/left to warning level and wait for DM1. " );

  @TPMS::FrontLeftPressure = 808;

  if (TpmsWaitForDM1( TirePressureController.NmStationAddress, 241, kFMI_AboveNormalWarn, 3 ) != 0) 
  {
    TestStepFail( "DM1 missing or has wrong values. " );
  }
  else
  {  
    TestStepPass( "DM1 received with correct values." );
  }

  @TPMS::FrontLeftPressure = 728;
  testWaitForTimeout( 500 );

  // Step 2 

  TestStep("3.3.2", "Increase tire pressue front/left to critical level and wait for DM1. " );

  @TPMS::FrontLeftPressure = 840;

  if (TpmsWaitForDM1( TirePressureController.NmStationAddress, 241, kFMI_AboveNormalCritical, 2 ) != 0) 
  {
    TestStepFail( "DM1 missing or has wrong values. " );
  }
  else
  {  
    TestStepPass( "DM1 received with correct values." );
  }

  @TPMS::FrontLeftPressure = 728;
  testWaitForTimeout( 500 );

  // Step 3 

  TestStep("3.3.3", "Increase tire pressue front/right to warning level and wait for DM1. " );

  @TPMS::FrontRightPressure = 808;

  if (TpmsWaitForDM1( TirePressureController.NmStationAddress, 241, kFMI_AboveNormalWarn, 3 ) != 0) 
  {
    TestStepFail( "DM1 missing or has wrong values. " );
  }
  else
  {  
    TestStepPass( "DM1 received with correct values." );
  }

  @TPMS::FrontRightPressure = 728;
  testWaitForTimeout( 500 );

  // Step 4 

  TestStep("3.3.4", "Increase tire pressue front/right to critical level and wait for DM1. " );

  @TPMS::FrontRightPressure = 840;

  if (TpmsWaitForDM1( TirePressureController.NmStationAddress, 241, kFMI_AboveNormalCritical, 2 ) != 0) 
  {
    TestStepFail( "DM1 missing or has wrong values. " );
  }
  else
  {  
    TestStepPass( "DM1 received with correct values." );
  }

  @TPMS::FrontRightPressure = 728;
  testWaitForTimeout( 500 );

  // Step 5 

  TestStep("3.3.5", "Increase tire pressue rear1/left to warning level and wait for DM1. " );

  @TPMS::Rear1LeftPressure = 888;

  if (TpmsWaitForDM1( TirePressureController.NmStationAddress, 241, kFMI_AboveNormalWarn, 3 ) != 0) 
  {
    TestStepFail( "DM1 missing or has wrong values. " );
  }
  else
  {  
    TestStepPass( "DM1 received with correct values." );
  }

  @TPMS::Rear1LeftPressure = 800;
  testWaitForTimeout( 500 );

  // Step 6 

  TestStep("3.3.6", "Increase tire pressue rear1/left to critical level and wait for DM1. " );

  @TPMS::Rear1LeftPressure = 928;

  if (TpmsWaitForDM1( TirePressureController.NmStationAddress, 241, kFMI_AboveNormalCritical, 2 ) != 0) 
  {
    TestStepFail( "DM1 missing or has wrong values. " );
  }
  else
  {  
    TestStepPass( "DM1 received with correct values." );
  }

  @TPMS::Rear1LeftPressure = 800;
  testWaitForTimeout( 500 );

  // Step 7 

  TestStep("3.3.7", "Increase tire pressue rear1/right to warning level and wait for DM1. " );

  @TPMS::Rear1RightPressure = 888;

  if (TpmsWaitForDM1( TirePressureController.NmStationAddress, 241, kFMI_AboveNormalWarn, 3 ) != 0) 
  {
    TestStepFail( "DM1 missing or has wrong values. " );
  }
  else
  {  
    TestStepPass( "DM1 received with correct values." );
  }

  @TPMS::Rear1RightPressure = 800;
  testWaitForTimeout( 500 );

  // Step 8 

  TestStep("3.3.8", "Increase tire pressue rear1/right to critical level and wait for DM1. " );

  @TPMS::Rear1RightPressure = 928;

  if (TpmsWaitForDM1( TirePressureController.NmStationAddress, 241, kFMI_AboveNormalCritical, 2 ) != 0) 
  {
    TestStepFail( "DM1 missing or has wrong values. " );
  }
  else
  {  
    TestStepPass( "DM1 received with correct values." );
  }

  @TPMS::Rear1RightPressure = 800;
  testWaitForTimeout( 500 );

  // Step 9 

  TestStep("3.3.9", "Increase tire pressue rear2/left to warning level and wait for DM1. " );

  @TPMS::Rear2LeftPressure = 888;

  if (TpmsWaitForDM1( TirePressureController.NmStationAddress, 241, kFMI_AboveNormalWarn, 3 ) != 0) 
  {
    TestStepFail( "DM1 missing or has wrong values. " );
  }
  else
  {  
    TestStepPass( "DM1 received with correct values." );
  }

  @TPMS::Rear2LeftPressure = 800;
  testWaitForTimeout( 500 );

  // Step 10 

  TestStep("3.3.10", "Increase tire pressue rear2/left to critical level and wait for DM1. " );

  @TPMS::Rear2LeftPressure = 928;

  if (TpmsWaitForDM1( TirePressureController.NmStationAddress, 241, kFMI_AboveNormalCritical, 2 ) != 0) 
  {
    TestStepFail( "DM1 missing or has wrong values. " );
  }
  else
  {  
    TestStepPass( "DM1 received with correct values." );
  }

  @TPMS::Rear2LeftPressure = 800;
  testWaitForTimeout( 500 );

  // Step 11 

  TestStep("3.3.11", "Increase tire pressue rear2/right to warning level and wait for DM1. " );

  @TPMS::Rear2RightPressure = 888;

  if (TpmsWaitForDM1( TirePressureController.NmStationAddress, 241, kFMI_AboveNormalWarn, 3 ) != 0) 
  {
    TestStepFail( "DM1 missing or has wrong values. " );
  }
  else
  {  
    TestStepPass( "DM1 received with correct values." );
  }

  @TPMS::Rear2RightPressure = 800;
  testWaitForTimeout( 500 );

  // Step 12 

  TestStep("3.3.12", "Increase tire pressue rear2/right to critical level and wait for DM1. " );

  @TPMS::Rear2RightPressure = 928;

  if (TpmsWaitForDM1( TirePressureController.NmStationAddress, 241, kFMI_AboveNormalCritical, 2 ) != 0) 
  {
    TestStepFail( "DM1 missing or has wrong values. " );
  }
  else
  {  
    TestStepPass( "DM1 received with correct values." );
  }

  @TPMS::Rear2RightPressure = 800;
  testWaitForTimeout( 500 );
}


////////////////////////////////////////////////////////
//
// Functions
//
////////////////////////////////////////////////////////

/*
 * Check if TPRI message is sent and if it contains expected pressure
 *
 * tireLocation - Location of the tire
 * diff         - Pressure difference which is used to calculate the current reference pressure 
*/
void WaitForTPRIAndCheckPressure(int tireLocation, float diff)
{
  pg TPRI rxTPRI;
  float expectedPressure, actualPressure;

  // wait for TPRI response
  switch(TestWaitForJ1939PG( TPRI.pgn, TirePressureController.NmStationAddress, GlobalAddress, 1250 )) 
  {
    case 0: // timeout
      snprintf( textBuffer, elCount(textBuffer), "Message TPRI (tire location 0x%X) is missing (timeout).", tireLocation );
      TestStepFail( textBuffer ); 
      return;
    case 1: // ok: message has occurred
      TestGetWaitJ1939PGData( rxTPRI );
      break;
    default: // failed
      snprintf( textBuffer, elCount(textBuffer), "Message TPRI (tire location 0x%X) is missing (WaitForMessage: General error occurred).", tireLocation );
      TestStepFail( textBuffer ); 
      return;
  }
  
  if (rxTPRI.TireLocation != tireLocation) 
  {
    snprintf( textBuffer, elCount(textBuffer), "Wrong TPRI.TireLocation received 0x%X, but must be 0x%X. ", rxTPRI.TireLocation, tireLocation );
    TestStepFail( textBuffer );
  }
  else 
  {
    switch (tireLocation)
    {
      case 0x00:
        expectedPressure = @TPMS::FrontLeftPressure + diff;
        actualPressure   = rxTPRI.ReferenceTirePress_00.phys;
        break;
      case 0x01:
        expectedPressure = @TPMS::FrontRightPressure + diff;
        actualPressure   = rxTPRI.ReferenceTirePress_01.phys;
        break;
      case 0x10:
        expectedPressure = @TPMS::Rear1LeftPressure + diff;
        actualPressure   = rxTPRI.ReferenceTirePress_10.phys;
        break;
      case 0x11:
        expectedPressure = @TPMS::Rear1RightPressure + diff;
        actualPressure   = rxTPRI.ReferenceTirePress_11.phys;
        break;
      case 0x20:
        expectedPressure = @TPMS::Rear2LeftPressure + diff;
        actualPressure   = rxTPRI.ReferenceTirePress_20.phys;
        break;
      case 021:
        expectedPressure = @TPMS::Rear2RightPressure + diff;
        actualPressure   = rxTPRI.ReferenceTirePress_21.phys;
        break;
      default:
        break;
    }
 
    if (expectedPressure != actualPressure) 
    {
      snprintf( textBuffer, elCount(textBuffer), "Wrong TPRI.ReferenceTirePress (tire location 0x%X) received %f, but must be %f. ", tireLocation, rxTPRI.ReferenceTirePress_21.phys, @TPMS::Rear2RightPressure + diff );
      TestStepFail( textBuffer );
    } 
    else
    {
      snprintf( textBuffer, elCount(textBuffer), "Message TPRI (tire location 0x%X) received.", tireLocation );
      TestStepPass( textBuffer ); 
    }
  }
}

/*
 * Check if TIRE1 message is sent and if it contains expected pressure
 *
 * tireLocation - Location of the tire
 */
void WaitForTIRE1AndCheckPressure(int tireLocation)
{
  pg TIRE1 rxTIRE;
  float expectedPressure, actualPressure;
  
  // wait for TIRE response
  switch(TestWaitForJ1939PG( TIRE1.pgn, TirePressureController.NmStationAddress, GlobalAddress, 1250 )) 
  {
    case 0: // timeout
      snprintf( textBuffer, elCount(textBuffer), "Message TIRE1 (tire location 0x%X) is missing (timeout).", tireLocation );
      TestStepFail( textBuffer ); 
      return;
    case 1: // ok: message has occurred
      TestGetWaitJ1939PGData( rxTIRE );
      break;
    default: // failed
      snprintf( textBuffer, elCount(textBuffer), "Message TIRE1  (tire location 0x%X) is missing (WaitForMessage: General error occurred).", tireLocation );
      TestStepFail( textBuffer ); 
      return;
  }

  // check TIRE response
  if (rxTIRE.TireLocation != tireLocation) 
  {
    snprintf( textBuffer, elCount(textBuffer), "Wrong TIRE.TireLocation received 0x%X, but must be 0x%X. ", rxTIRE.TireLocation, tireLocation );
    TestStepFail( textBuffer );
  }
  else
  {
    switch (tireLocation)
    {
      case 0x00:
        expectedPressure = @TPMS::FrontLeftPressure;
        actualPressure   = rxTIRE.TirePress_00.phys;
        break;
      case 0x01:
        expectedPressure = @TPMS::FrontRightPressure;
        actualPressure   = rxTIRE.TirePress_01.phys;
        break;
      case 0x10:
        expectedPressure = @TPMS::Rear1LeftPressure;
        actualPressure   = rxTIRE.TirePress_10.phys;
        break;
      case 0x11:
        expectedPressure = @TPMS::Rear1RightPressure;
        actualPressure   = rxTIRE.TirePress_11.phys;
        break;
      case 0x20:
        expectedPressure = @TPMS::Rear2LeftPressure;
        actualPressure   = rxTIRE.TirePress_01.phys;
        break;
      case 021:
        expectedPressure = @TPMS::Rear2RightPressure;
        actualPressure   = rxTIRE.TirePress_21.phys;
        break;
      default:
        break;
    }
    
    if (expectedPressure != actualPressure) 
    {
      snprintf( textBuffer, elCount(textBuffer), "Wrong TIRE.TirePress received %f (must be %f).", actualPressure, expectedPressure );
      TestStepFail( textBuffer );
    }
    
    snprintf( textBuffer, elCount(textBuffer), "Response for TIRE 0x%X received.", tireLocation );
    TestStepPass( textBuffer ); 
  }
}

/*
* Check if TPRI message is sent and if it contains expected pressure
*
* tireLocation - Location of the tire
*/
void WaitForTPRI(int tireLocation)
{
  pg TPRI rxTPRI;

  // wait for TPRI response
  switch(TestWaitForJ1939PG( TPRI.pgn, TirePressureController.NmStationAddress, GlobalAddress, 1250 )) 
  {
    case 0: // timeout
      snprintf( textBuffer, elCount(textBuffer), "Message TPRI (tire location 0x%X) is missing (timeout).", tireLocation );
      TestStepFail( textBuffer ); 
      return;
    case 1: // ok: message has occurred
      TestGetWaitJ1939PGData( rxTPRI );
      break;
    default: // failed
      snprintf( textBuffer, elCount(textBuffer), "Message TPRI (tire location 0x%X) is missing (WaitForMessage: General error occurred).", tireLocation );
      TestStepFail( textBuffer ); 
      return;
  }
  
  if (rxTPRI.TireLocation != tireLocation) 
  {
    snprintf( textBuffer, elCount(textBuffer), "Wrong TPRI.TireLocation received 0x%X, but must be 0x%X. ", rxTPRI.TireLocation, tireLocation );
    TestStepFail( textBuffer );
  }
  else
  {
    snprintf( textBuffer, elCount(textBuffer), "Message TPRI (tire location 0x%X) received.", tireLocation );
    TestStepPass( textBuffer ); 
  }
}

/*
 * Wait for DM1 message
 */
int TpmsWaitForDM1( BYTE tpmsAddr, DWORD spn, WORD fmi, BYTE led )
{
  dword dtc;
  pg DM01 dm1;

  // wait for the response
  switch(TestWaitForJ1939PG( DM01.pgn, tpmsAddr, GlobalAddress, 2000 )) 
  {
    case 0: // timeout 
      TestStepFail( "Timeout, DM1 response not received."); 
      return -1;
    case 1: // ok: message has occurred 
      TestGetWaitJ1939PGData( dm1 );

      switch(led) 
      {
        case 1:
          if (dm1.ProtectLampStatus != 1) 
          {
            TestStepFail( "Protecion Lamp is off." );
            return -2;
          }
          break;
        case 2:
          if (dm1.RedStopLampState != 1) 
          {
            TestStepFail( "Ret stop Lamp is off." );
            return -2;
          }
          break;
        case 3:
          if (dm1.AmberWarningLampStatus != 1) 
          {
            TestStepFail( "Amber warning Lamp is off." );
            return -2;
          }
          break;
        case 4:
          if (dm1.MalfunctionIndicatorLampStatus != 1) 
          {
            TestStepFail( "Malfunction indicator lamp off." );
            return -2;
          }
          break;
        }

      J1939GetDTC(dm1, spn, fmi, 0xFFFF, dtc);
      if (J1939GetSpnFromDTC(dtc) != spn)
      {
        snprintf( textBuffer, elCount(textBuffer), "SPN is %d but must be %d. ", J1939GetSpnFromDTC(dtc), spn );
        TestStepFail( textBuffer );
        return -3;
      }
      
      if (J1939GetFmiFromDTC(dtc) != fmi) 
      {
        snprintf( textBuffer, elCount(textBuffer), "FMI is %d but must be %d. ", J1939GetFmiFromDTC(dtc), fmi );
        TestStepFail( textBuffer );
        return -4;
      }
      return 0;
    default: // Failed 
      TestStepFail( "WaitForMessage: General error occurred. ");
      return -5;
  }
}
