/*@!Encoding:1252*/
/*
 * J1939DTC - Diagnostic Trouble Code CAPL Library Version 1.1
 *
 * Copyright 2007, Vector Informatik GmbH - All right reserved
 *
 * This CAPL Library provides function for DM1, DM2, DM12, DM22, DM23.
 * It needs the J1939 Interaction layer.
 *
 * History:
 * 1.0 (Jr)  Created 
 * 1.1 (Jr)  Send DM1 always with dtcActivate(1)
 * 1.2 (Wfk) dtcActivate and dtcCopyToPgBuffer extended by parameter 'node'
 * 1.3 (Gw)  Correct flags of DM24
 * 1.4 (Rio) Moved diagnostics functionality to Interaction Layer
 */

variables
{
  struct DTC
  {
    dword spn;
    word fmi;
    byte occurrenceCount;
    byte isEmissionRelated;
    byte isActive;
  };
  
  // Diagnostics
  const int kFMIBitMask = 0x1F;
  const int kSPNBitMask = 0x7FFFF;
    
  struct DTC gDTCTable[long];     // Table with active DTCs

  // Constants for nodes
  const BYTE k_Node_TPMS =0x51;
  
  enum DM //PGNs of Diagnostic Messages by J1939-73 specification 
  {
    kDM1   = 0xFECA,
    kDM2   = 0xFECB,
    kDM3   = 0xFECC,
    kDM6   = 0xFECF,
    kDM12  = 0xFED4,
    kDM22  = 0xC300,
    kDM23  = 0xFDB5,
    kDM27  = 0xFD82,
    kDM28  = 0xFD80,
    kDM35  = 0x9F00
  };
  
  enum FMI //Failure Mode Identification by J1939-73 specification
  {
    kDataValidButAboveNormalMostSevere        = 0,
    kDataValidButBelowNormalMostSevere        = 1,
    kDataErratic                              = 2,
    kVoltageAboveNormal                       = 3,
    kVoltageBelowNormal                       = 4,
    kCurrentBelowNormal                       = 5,
    kCurrentAboveNormal                       = 6,
    kMechanicalSystemNotResponding            = 7,
    kAbnormalFrequencyPulseWidthPeriod        = 8,
    kAbnormalUpdateRate                       = 9,
    kAbnormalRateOfChange                     = 10,
    kRootCauseNotKnown                        = 11,
    kBadIntelligentDeviceOrComponent          = 12,
    kOutOfCalibration                         = 13,
    kSpecialInstuctions                       = 14,
    kDataValidButAboveNormalLeastSevere       = 15,
    kDataValidButAboveNormalModeratelySevere  = 16,
    kDataValidButBelowNormalLeastSevere       = 17,
    kDataValidButBelowNormalModeratelySevere  = 18,
    kReceivedNetowrkDataInError               = 19,
    kDataDriftedHigh                          = 20,
    kDataDriftedLow                           = 21
  }; 
}

/*
 * Activate a DTC (diagnostic trouble code)
 *
 * spn - Suspect Parameter Number, length 19 Bit
 * fmi - Failure Mode Indentifier, length 5 Bit
 */
void DTCActivate( dword spn, word fmi )
{
  dword dtcKey;
  struct DTC dtc;
  dtcKey = 0;
  spn |= (spn & kSPNBitMask); //Trim to specified length of 19 bit
  fmi |= (fmi & kFMIBitMask); //Trim to specified length of 5 bit
  dtc.spn = spn;
  dtc.fmi = fmi;
  dtcKey |= (dtc.spn << 19) | dtc.fmi; //Unique key by combining spn and fmi
  if(gDTCTable.containsKey(dtcKey)) //DTC was used before. Only update parameters.
  {
    gDTCTable[dtcKey].isActive = 1;
    gDTCTable[dtcKey].occurrenceCount++;
  }
  else //DTC is new, create the struct and init the parameters
  {
    dtc.isActive = 1;
    dtc.occurrenceCount = 1;
    dtc.isEmissionRelated = DTCIsEmmisionRelated(dtc.spn); 
    memcpy(gDTCTable[dtcKey], dtc); //Add the newly created DTC to the list of known DTCs
  }
  UpdateDMs();
}

/*
 * Deactivate a DTC (diagnostic trouble code)
 *
 * spn - Suspect Parameter Number, length 19 Bit
 * fmi - Failure Mode Indentifier, length 5 Bit
 */
void DTCDeactivate(dword spn, word fmi)
{
  dword dtcKey;
  struct DTC dtc;
  dtcKey = 0;
  spn |= (spn & kSPNBitMask); //Trim to specified length of 19 bit
  fmi |= (fmi & kFMIBitMask); //Trim to specified length of 5 bit
  dtcKey |= (spn << 19) | fmi; //Unique key by combining spn and fmi
  if(gDTCTable.containsKey(dtcKey))
  {
    gDTCTable[dtcKey].isActive = 0;
  }
  UpdateDMs();
}

/*
* Since the TPMS node uses this callback already we need
* to call this function from the real callback in TPMS.can.
* (Callback - called by the IL when a request is received.
* The IL only clears DM2 messages when a DM3 is received.
* Other DMs must be cleared manually. In this example we 
* clear DM23 messages containing previously active emission
* related DTCs.)
*/
long _J1939ILOnRequest( long _pgn, long _sa )
{
  struct DTC dtc;

  switch(_pgn)
  {
    case kDM3: //DM2 is managed by IL
      for(long dtcKey : gDTCTable)
      {
        memcpy(dtc, gDTCTable[dtcKey]);
        if(!dtc.isEmissionRelated)
        {
          gDTCTable[dtcKey].occurrenceCount = gDTCTable[dtcKey].isActive;
          continue; //The IL will remove the DTC from DM2 by itself.
        }
        //If the DTC is emission related we need to remove it from DM23 manually
        if( gDTCTable[dtcKey].occurrenceCount > 0 && 
            !gDTCTable[dtcKey].isActive) //Indicates that the message was inactive before
        {
          J1939ILRemoveDTC(kDM23, dtc.spn, dtc.fmi); //Clear DM23
        }
        gDTCTable[dtcKey].occurrenceCount = gDTCTable[dtcKey].isActive;
      }
      break;
    default:
      break;
  }
  return 1; //IL responds to the request as usual
}

/*
 * Individual clear/reset of active or previsouly active DTC
 */
on pg DM22
{
  DWORD   spn;
  DWORD   fmi;
  pg DM22 dm22;
  dword dtcKey;
  struct DTC dtc;
  dtcKey = 0;

  if (!J1939ILAcceptRxPG( this )) return;

  spn = this.SPN1;
  fmi = this.FailureModeIdentifier1;
  dtcKey |= (spn << 19) | fmi;
  
  switch(this.IndividualDTCClearControlByte) 
  {
    case 1:  // Request to clear previously active DTC
      memcpy(dtc, gDTCTable[dtcKey]);
      if(!dtc.isEmissionRelated)
      {
        J1939ILRemoveDTC(kDM2, dtc.spn, dtc.fmi); //Clear DM2
        gDTCTable[dtcKey].occurrenceCount = gDTCTable[dtcKey].isActive;
        break;
      }
      //If the DTC is emission related we need to remove it from DM23 manually
      if( gDTCTable[dtcKey].occurrenceCount > 0 && 
          !gDTCTable[dtcKey].isActive) //Indicates that the message was inactive before
      {
        J1939ILRemoveDTC(kDM2, dtc.spn, dtc.fmi); //Clear DM2
        J1939ILRemoveDTC(kDM23, dtc.spn, dtc.fmi); //Clear DM23
      }
      gDTCTable[dtcKey].occurrenceCount = gDTCTable[dtcKey].isActive;
      break;
    case 17: // Request to clear active DTC
      if(gDTCTable.containsKey(dtcKey))
      {
        gDTCTable[dtcKey].isActive = 0;
      } 
      break;
  }
  UpdateDMs();
}

/*
 * Returns the lamp state for DM messages
 */
WORD DTCGetLampState()
{
  WORD  result;
  struct DTC dtc;
  result = 0xff00;
  for(long dtcKey : gDTCTable)
  {
    memcpy(dtc, gDTCTable[dtcKey]);
    if(!dtc.isActive)
    {
      continue; //Not active --> keep lamp state
    }
    switch(dtc.fmi) 
    {
      case kDataValidButAboveNormalMostSevere:
      case kDataValidButBelowNormalMostSevere:
        result |= 0x0010; // enable red stop lamp
        result &= 0xffdf;
        break;
      case kDataValidButAboveNormalLeastSevere:
      case kDataValidButBelowNormalLeastSevere:
        result |= 0x0004; // enable malfunction indicator lamp
        result &= 0xfff7;
        break;
      case kRootCauseNotKnown:
      default:
        result |= 0x0040; // enable malfunction indicator lamp
        break;
    }
  }
  return result;
}

/*
 * Returns 1, if SPN is emmission related
 */
BYTE DTCIsEmmisionRelated( DWORD spn )
{
  switch(spn) 
  {
    case 110:  // Engine coolant temp.
    case 190:  // EngSpeed
    case 1119: // Engine Actual Exhaust Oxygen
      return 1;
  }
  return 0;
}

/*
* Apply all changes to 
*/
void UpdateDMs()
{
  struct DTC dtc;
  dword state;
  dword oc;
  state = 0;
  oc = 0;
  
  for(long dtcKey : gDTCTable)
  {
    memcpy(dtc, gDTCTable[dtcKey]);
    J1939ILGetDTCStatus(dtc.spn, dtc.fmi, state, oc);
    if((state == 1 && dtc.isActive == 1) || (state != 1 && dtc.isActive == 0))
    {
      continue;
    }
    if(!dtc.isActive) 
    {
      // In the list are only DTCs that have been activ before or are active now.
      // So we can be sure the DTC can be deactivated.
      J1939ILDeactivateDTC(dtc.spn, dtc.fmi, 1);
      if(dtc.isEmissionRelated)
      {
        J1939ILRemoveDTC(kDM12, dtc.spn, dtc.fmi);
        J1939ILAddDTC(kDM23, dtc.spn, dtc.fmi, dtc.occurrenceCount);
      }
    }
    else
    {
      J1939ILActivateDTC(dtc.spn, dtc.fmi, 1);
      if(dtc.isEmissionRelated)
      {
        J1939ILAddDTC(kDM12, dtc.spn, dtc.fmi, dtc.occurrenceCount);
        if(dtc.occurrenceCount > 1) // Only remove from previous active if the DTC was active before
        {
          J1939ILRemoveDTC(kDM23, dtc.spn, dtc.fmi);
        }
      }
    }
  }
  J1939ILSetLampStatus(kDM1, DTCGetLampState());
}