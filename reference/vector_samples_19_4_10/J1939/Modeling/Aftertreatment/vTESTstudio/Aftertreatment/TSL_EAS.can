/*@!Encoding:1252*/
variables
{
  char textBuffer[512];

  int     gWait = 1;  // > 0 if we are waiting for the wait timer elapsed
  msTimer gWaitTimer; // this timer is used to wait within a test function
}

on timer gWaitTimer
{
  gWait = 0; // stop waiting
}

//
// Set the accelerator postion of the EMS
//
export testfunction SetAcceleratorPosition(dword position)
{
  if (position <= position)
  {
    @EMS::Accelerator = position;
  }
}


export testfunction CheckReactionOfEmptyFluidTank()
{
  pg PROB_2_EAS pROB_2_EAS;
  pg DM1 dM1 = {dlc = 22};
  int testFailedFlag=1;
  int i = 0;

  setTimer(gWaitTimer,100000);
  gWait = 1;
 
  while (gWait == 1)
  {
    if (TestWaitForJ1939PG(PROB_2_EAS.pgn, EAS.NmStationAddress,0xFF,2000) >= 0)
    {
      // PG received of timeout
      TestGetWaitJ1939PGData(pROB_2_EAS);

      //write ("pROB_2_EAS.ReductionFluidTankLevel: %f",pROB_2_EAS.ReductionFluidTankLevel.phys);

      if (pROB_2_EAS.ReductionFluidTankLevel.phys <=20)
      {
        if (TestWaitForJ1939PG(DM1.pgn, EAS.NmStationAddress,0xFF,10000) > 0)
        {
          
          TestGetWaitJ1939PGData(dM1);

          // check if one of the DTCs is the right one
          if ((dM1.SPN1 == 0xF004 && dM1.SPN1High == 0x7) ||
              (dM1.SPN2 == 0xF004 && dM1.SPN2High == 0x7) ||
              (dM1.SPN3 == 0xF004 && dM1.SPN3High == 0x7) ||
              (dM1.SPN4 == 0xF004 && dM1.SPN4High == 0x7))
          {
            // check if there is at least on error
            snprintf( textBuffer, elCount(textBuffer), "DM1 message received, DTC reported.");
            TestStepPass( textBuffer );
            gWait=0;
            testFailedFlag = 0;
          }
          else
          {
            write ("data not ok");
          }
        }
        else
        {
          // failed
          snprintf( textBuffer, elCount(textBuffer), "DM1 PG not received");
          TestStepFail( textBuffer );
        }
      }
    }
  }

  if (testFailedFlag)
  {
    // check if there is at least on error
    snprintf( textBuffer, elCount(textBuffer), "DM1 message received, but no DTC available");
    TestStepFail( textBuffer );
  } 
}

export testfunction CheckStopSendingDTC ()
{
  pg PROB_1_EAS pROB_1_EAS;
  pg DM1 dM1 = { dlc = 22 };

  setTimer(gWaitTimer,100000);

  gWait = 1;

  while (gWait == 1)
  {
    if (TestWaitForJ1939PG(PROB_1_EAS.pgn, EAS.NmStationAddress,0xFF,2000) >= 0)
    {
      // PG received of timeout
      TestGetWaitJ1939PGData(pROB_1_EAS);

      if (pROB_1_EAS.CatalystUpstreamTemperature.phys < 149)
      {
        // DM1
        if (TestWaitForJ1939PG(DM1.pgn,EAS.NmStationAddress,0xFF,10000) > 0)
        {
          TestGetWaitJ1939PGData(dM1);
          if ((dM1.SPN1 == 0xF004 && dM1.SPN1High == 0x7) ||
              (dM1.SPN2 == 0xF004 && dM1.SPN2High == 0x7) ||
              (dM1.SPN3 == 0xF004 && dM1.SPN3High == 0x7) ||
              (dM1.SPN1 == 0xF004 && dM1.SPN4High == 0x7))
          {
            // check if there is at least on error
            snprintf( textBuffer, elCount(textBuffer), "DM1 message received and DTC is reported.");
            TestStepPass( textBuffer );
          }
          else
          {
            // check if there is at least on error
            snprintf( textBuffer, elCount(textBuffer), "DM1 message received, but DTC is not reported.");
            TestStepFail( textBuffer );
          }

          // failed
          //snprintf( textBuffer, elCount(textBuffer), "DM1 PG received although not temperature below 150");
          //TestStepFail( textBuffer );
        }
        else
        {
          // PG received
          snprintf( textBuffer, elCount(textBuffer), "DM1 PG not received -> OK.");
          TestStepPass( textBuffer );
        }
        gWait=0;
      }
    }
  }
}

