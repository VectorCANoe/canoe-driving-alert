/*@!Encoding:1252*/
variables
{
  // Constants
  const float kMaxEngineSpeed          = 2800.0; // Max. engine speed [rpm]
  const float kIdleEngineSpeed         = 500.0;  // Idle engine speed [rpm]
  const float kMaxTorque               = 2000.0; // Max. engine torque [Nm]
  const float kMaxUreaQuantity         = 6000.0; // Max. Urea quantity [g/h]
  const float kInitAmbientTemperature  = 20.0;   // Init Ambient temperature [°C]
  const float kInitBarometricPressure  = 101.5;  // Init Barometric pressure [kPa]
  const float kInitNOxSensor           = 200;    // Init NOx Sensor [ppm]

  // Global
  float gPedalPosition         = 0.0;    // Accelerator pedal position in [%]
  float gActualSpeed           = 0.0;    // Actual engine speed in [rpm]
  float gActualTorque          = 0.0;    // Actual engine torque [Nm]
  float gActualCoolantTemp     = 0.0;    // Coolant Temperature in [°C]
  float gActualOilTemp         = 0.0;    // Oil Temperature in [°C]
  float gRequestedUreaQuantity = 0.0;    // Requested Urea Quantity in [g/h]

  // Timers
  const int   kSystemTime      = 100;                  // System time in [ms]
  const float kSystemTimeSec   = kSystemTime / 1000.0; // System time in [sec]
  msTimer     SystemTimer;                             // System timer
}

on start
{
  setTimer(SystemTimer, kSystemTime);
}

on timer SystemTimer
{
  CalculateAndUpdateValues();
  
  // update message signals
  UpdateATO1();
  UpateET1();
  UpdateAMB();
  UpdatePROA_1();
  UpdateEEC1();
  
  setTimer(SystemTimer, kSystemTime); 
}

on sysvar EMS::Accelerator
{
  gPedalPosition  = @this;
}

//
// Calculate values
//
void CalculateAndUpdateValues()
{
  gPedalPosition          = @EMS::Accelerator;
  gActualSpeed            = kIdleEngineSpeed + (kMaxEngineSpeed - kIdleEngineSpeed) * (gPedalPosition / 100.0);
  gActualTorque           = kMaxTorque * (gPedalPosition / 100.0);
  gRequestedUreaQuantity  = kMaxUreaQuantity * (gPedalPosition / 100.0);
  gActualCoolantTemp      = utilRange( gActualCoolantTemp + (gActualSpeed - kIdleEngineSpeed) * 0.0001, 20, 90 );
  gActualOilTemp          = utilRange( gActualOilTemp + (gActualSpeed - kIdleEngineSpeed * 6/5) * 0.00005, 20, 120 );
  
  J1939ILSetSignal( Aftertreatment::EEC1_EMS::EngSpeed, gActualSpeed);
  J1939ILSetSignal( Aftertreatment::EEC1_EMS::ActualEngPercentTorque, (gActualTorque / kMaxTorque) * 100);
}

//
// Updates signals of message ATO1_EMS
//
void UpdateATO1()
{
  J1939ILSetSignalRaw( Aftertreatment::ATO1_EMS::AftrTrtmntOtltOxygnSnsrPrlmnryFM, 0xFF);
  J1939ILSetSignalRaw( Aftertreatment::ATO1_EMS::AftrTrtmntOtltNOxSnsrPrlmnryFMI, 0xFF);
  J1939ILSetSignalRaw( Aftertreatment::ATO1_EMS::AftrTrtmntOtltGsSnsorHeaterCtrl, 0x3);
  J1939ILSetSignalRaw( Aftertreatment::ATO1_EMS::AftrTrtmntOtltGsSnsrHtrPrlmnryFM, 0xFF);
  J1939ILSetSignalRaw( Aftertreatment::ATO1_EMS::AftrTrtmntOtltWdRngO2RdngStable, 0x3);
  J1939ILSetSignalRaw( Aftertreatment::ATO1_EMS::AftrTrtmntOtletNOxReadingStable, 0x3);
  J1939ILSetSignalRaw( Aftertreatment::ATO1_EMS::AftrTrtmntOutletGasSensorAtTemp, 0x3);
  J1939ILSetSignalRaw( Aftertreatment::ATO1_EMS::AftrTrtmntOtltGsSnsrPwerInRange, 0x3);
  J1939ILSetSignalRaw( Aftertreatment::ATO1_EMS::AfterTreatmentOutletO2, 0xFFFF);
  J1939ILSetSignal   ( Aftertreatment::ATO1_EMS::AfterTreatmentOutletNOx, kInitNOxSensor);
}

//
// Updates signals of message ET1_EMS
//
void UpateET1()
{
  J1939ILSetSignalRaw( Aftertreatment::ET1_EMS::EngIntercoolerThermostatOpening, 0xFF);
  J1939ILSetSignalRaw( Aftertreatment::ET1_EMS::EngIntercoolerTemp, 0xFF);
  J1939ILSetSignalRaw( Aftertreatment::ET1_EMS::EngTurboOilTemp, 0xFFFF);
  J1939ILSetSignal   ( Aftertreatment::ET1_EMS::EngOilTemp1, gActualOilTemp);
  J1939ILSetSignalRaw( Aftertreatment::ET1_EMS::EngFuelTemp, 0xFF);
  J1939ILSetSignal   ( Aftertreatment::ET1_EMS::EngCoolantTemp, gActualCoolantTemp);
}

//
// Updates signals of message AMB_EMS
//
void UpdateAMB()
{
  J1939ILSetSignalRaw( Aftertreatment::AMB_EMS::RoadSurfaceTemp, 0xFFFF);
  J1939ILSetSignalRaw( Aftertreatment::AMB_EMS::EngAirInletTemp, 0xFF);
  J1939ILSetSignal   ( Aftertreatment::AMB_EMS::AmbientAirTemp, kInitAmbientTemperature);
  J1939ILSetSignalRaw( Aftertreatment::AMB_EMS::CabInteriorTemp, 0xFFFF);
  J1939ILSetSignal   ( Aftertreatment::AMB_EMS::BarometricPress, kInitBarometricPressure);
}

//
// Updates signals of message PROA_1_EMS
//
void UpdatePROA_1()
{
  J1939ILSetSignal( Aftertreatment::PROA_1_EMS::RequestedUreaQuantity, gRequestedUreaQuantity);
}

//
// Updates signals of message EEC1_EMS
//
void UpdateEEC1()
{
  J1939ILSetSignalRaw( Aftertreatment::EEC1_EMS::EngDemandPercentTorque, 0xFF);
  J1939ILSetSignalRaw( Aftertreatment::EEC1_EMS::EngStarterMode, 0x3);
  J1939ILSetSignalRaw( Aftertreatment::EEC1_EMS::SrcAddrssOfCtrllngDvcForEngCtrl, 0xFF);
  J1939ILSetSignal   ( Aftertreatment::EEC1_EMS::EngSpeed, gActualSpeed);
  J1939ILSetSignal   ( Aftertreatment::EEC1_EMS::ActualEngPercentTorque, (gActualTorque / kMaxTorque) * 100);
  J1939ILSetSignalRaw( Aftertreatment::EEC1_EMS::DriversDemandEngPercentTorque, 0xFF);
  J1939ILSetSignalRaw( Aftertreatment::EEC1_EMS::EngTorqueMode, 0x3);
}

//
// Clip the value to the range of min and max
//
float utilRange( float value, float min, float max )
{
  if (value < min) return min;
  if (value > max) return max;

  return value;
}

