includes
{
  // Import required CAPL include files
  //--- begin generated part --- Block start #Hdr_Includes#; do not delete this line and do not add application code in this code block!
  /* #ChannelStart# |CAN1| #BusStart# |J1939| */
  /* #ChannelEnd# |CAN1| #BusEnd# |J1939| */
  //--- end generated part --- Block end #Hdr_Includes#; do not delete this line! Add application code below this line.
  //--- begin generated part --- Block start #Body_Includes#; do not delete this line and do not add application code in this code block!
  /* #ChannelStart# |CAN1| #BusStart# |J1939| */
  #include "..\CAPL\Vector-J1939-IL-Helper_CAN1.cin"
  /* #ChannelEnd# |CAN1| #BusEnd# |J1939| */
  //--- end generated part --- Block end #Body_Includes#; do not delete this line! Add application code below this line.
}

variables
{
  // Define global variables for this CAPL file

  /*--- #GenHeader Begin# --- begin generated comment ---
  | Generated on Thursday, August 26, 2021, 12:38:12
  | By ModelGenerator for J1939 1.5.4.10, ModelGeneratorJ1939DLL 1.5.4.10
  | Package J1939 4.0.20
  | Target Bus: J1939; Channel: CAN1; DB Cluster: J1939;
  | From Database: J1939.dbc
  | CANoe Version 15.3.54.0
    --- #GenHeader End  # --- end generated comment --- */

  char gECU[256] = "Sender";
  //--- begin generated part --- Block start #Hdr_GlobalVariables#; do not delete this line and do not add application code in this code block!
  /* #ChannelStart# |CAN1| #BusStart# |J1939| */
  /* #ChannelEnd# |CAN1| #BusEnd# |J1939| */
  //--- end generated part --- Block end #Hdr_GlobalVariables#; do not delete this line! Add application code below this line.
  //--- begin generated part --- Block start #Body_GlobalVariables#; do not delete this line and do not add application code in this code block!
  /* #ChannelStart# |CAN1| #BusStart# |J1939| */
  char gCAN1BusName[256] = "J1939";
  int gCAN1Channel = 1; //// The channel the bus is attached to

  long gCAN1DisturbanceMode;
  long gCAN1DisturbanceCount;
  long gCAN1DisturbanceValue;
  long gCAN1DisturbanceContinueMode;
  double gCAN1DisturbancePeriod;
  /* #ChannelEnd# |CAN1| #BusEnd# |J1939| */
  //--- end generated part --- Block end #Body_GlobalVariables#; do not delete this line! Add application code below this line.
}

on preStart
{
  // Initialize CAPL includes and node's modules/DLLs
  //--- begin generated part --- Block start #Hdr_OnInit#; do not delete this line and do not add application code in this code block!
  /* #ChannelStart# |CAN1| #BusStart# |J1939| */
  /* #ChannelEnd# |CAN1| #BusEnd# |J1939| */
  //--- end generated part --- Block end #Hdr_OnInit#; do not delete this line! Add application code below this line.
  //--- begin generated part --- Block start #Body_OnInit#; do not delete this line and do not add application code in this code block!
  /* #ChannelStart# |CAN1| #BusStart# |J1939| */
  ILCAN1_OnInit();
  /* #ChannelEnd# |CAN1| #BusEnd# |J1939| */
  //--- end generated part --- Block end #Body_OnInit#; do not delete this line! Add application code below this line.
}

on start
{
  // Start CAPL includes and node's modules/DLLs
  //--- begin generated part --- Block start #Hdr_OnStart#; do not delete this line and do not add application code in this code block!
  /* #ChannelStart# |CAN1| #BusStart# |J1939| */
  /* #ChannelEnd# |CAN1| #BusEnd# |J1939| */
  //--- end generated part --- Block end #Hdr_OnStart#; do not delete this line! Add application code below this line.
  //--- begin generated part --- Block start #Body_OnStart#; do not delete this line and do not add application code in this code block!
  /* #ChannelStart# |CAN1| #BusStart# |J1939| */
  ILCAN1_OnStart();
  /* #ChannelEnd# |CAN1| #BusEnd# |J1939| */
  //--- end generated part --- Block end #Body_OnStart#; do not delete this line! Add application code below this line.
}

on preStop
{
  // Prepare stopping
  //--- begin generated part --- Block start #Hdr_OnStopping#; do not delete this line and do not add application code in this code block!
  /* #ChannelStart# |CAN1| #BusStart# |J1939| */
  /* #ChannelEnd# |CAN1| #BusEnd# |J1939| */
  //--- end generated part --- Block end #Hdr_OnStopping#; do not delete this line! Add application code below this line.
  //--- begin generated part --- Block start #Body_OnStopping#; do not delete this line and do not add application code in this code block!
  /* #ChannelStart# |CAN1| #BusStart# |J1939| */
  /* #ChannelEnd# |CAN1| #BusEnd# |J1939| */
  //--- end generated part --- Block end #Body_OnStopping#; do not delete this line! Add application code below this line.
}

on stopMeasurement
{
  // Stop actions
  //--- begin generated part --- Block start #Hdr_OnStop#; do not delete this line and do not add application code in this code block!
  /* #ChannelStart# |CAN1| #BusStart# |J1939| */
  /* #ChannelEnd# |CAN1| #BusEnd# |J1939| */
  //--- end generated part --- Block end #Hdr_OnStop#; do not delete this line! Add application code below this line.
  //--- begin generated part --- Block start #Body_OnStop#; do not delete this line and do not add application code in this code block!
  /* #ChannelStart# |CAN1| #BusStart# |J1939| */
  /* #ChannelEnd# |CAN1| #BusEnd# |J1939| */
  //--- end generated part --- Block end #Body_OnStop#; do not delete this line! Add application code below this line.
}

void StartSim(dword busContext, int busActive, int mode)
{
  // Called when ... due to ...
  //   mode == 1: ILControlResume
  //   mode == 2: ILControlStart
  //   mode == 3: ILControlSimulationOn
  //--- begin generated part --- Block start #Hdr_StartSim#; do not delete this line and do not add application code in this code block!
  /* #ChannelStart# |CAN1| #BusStart# |J1939| */
  /* #ChannelEnd# |CAN1| #BusEnd# |J1939| */
  //--- end generated part --- Block end #Hdr_StartSim#; do not delete this line! Add application code below this line.
  //write("[%.6f %NODE_NAME%] StartSim(0x%X, %d, %d)", TimeNowNS()/1e9, busContext, busActive, mode);
  //--- begin generated part --- Block start #Body_StartSim#; do not delete this line and do not add application code in this code block!
  /* #ChannelStart# |CAN1| #BusStart# |J1939| */
  /* #ChannelEnd# |CAN1| #BusEnd# |J1939| */
  //--- end generated part --- Block end #Body_StartSim#; do not delete this line! Add application code below this line.
}

void StopSim(dword busContext, int busActive, int mode)
{
  // Called when ... due to ...
  //   mode == 1: ILControlWait
  //   mode == 2: ILControlStop
  //   mode == 3: ILControlSimulationOff
  //--- begin generated part --- Block start #Hdr_StopSim#; do not delete this line and do not add application code in this code block!
  /* #ChannelStart# |CAN1| #BusStart# |J1939| */
  /* #ChannelEnd# |CAN1| #BusEnd# |J1939| */
  //--- end generated part --- Block end #Hdr_StopSim#; do not delete this line! Add application code below this line.
  //write("[%.6f %NODE_NAME%] StopSim(0x%X, %d, %d)", TimeNowNS()/1e9, busContext, busActive, mode);
  //--- begin generated part --- Block start #Body_StopSim#; do not delete this line and do not add application code in this code block!
  /* #ChannelStart# |CAN1| #BusStart# |J1939| */
  /* #ChannelEnd# |CAN1| #BusEnd# |J1939| */
  //--- end generated part --- Block end #Body_StopSim#; do not delete this line! Add application code below this line.
}

//--- begin generated part --- Block start <#Helper_Functions#> do not delete this line and do not add application code in this code block!
/* #ChannelStart# |CAN1| #BusStart# |J1939| */
/* #ChannelEnd# |CAN1| #BusEnd# |J1939| */
//--- end generated part --- Block end <#Helper_Functions#> do not delete this line! Add application code below this line.

//--- begin generated part --- Block start <#SysVar_Handler#> do not delete this line and do not add application code in this code block!
/* #ChannelStart# |CAN1| #BusStart# |J1939| */
on sysvar_update sysvar::IL_CAN1::NODES::N_Sender::EnableNode
{
  ILCAN1_Enable(@this && @sysvar::IL_CAN1::enable_AllNodes);
}

on sysvar_update sysvar::IL_CAN1::enable_AllNodes
{
  ILCAN1_Enable(@this && @sysvar::IL_CAN1::NODES::N_Sender::EnableNode);
}

on sysvar_update sysvar::IL_CAN1::NODES::N_Sender::MESSAGES::ACKM::TIMINGS::EnableCyclic
{
  if (@this == 1)
  {
    SetBusContext(gILCAN1_BusContext);
    J1939ILEnableMsg  (J1939::Sender::ACKM);
  }
  else
  {
    SetBusContext(gILCAN1_BusContext);
    J1939ILDisableMsg (J1939::Sender::ACKM);
  }
}

on sysvar_update sysvar::IL_CAN1::NODES::N_Sender::MESSAGES::ACKM::TIMINGS::SetNormalCycle
{
  if (@this == 1 && @sysvar::IL_CAN1::NODES::N_Sender::MESSAGES::ACKM::TIMINGS::EnableCyclic)
  {
    @sysvar::IL_CAN1::NODES::N_Sender::MESSAGES::ACKM::TIMINGS::SelectedPeriod = 0;
  }
}

on sysvar_update sysvar::IL_CAN1::NODES::N_Sender::MESSAGES::ACKM::TIMINGS::SetNewCycleContinously
{
  if (@this == 1 && @sysvar::IL_CAN1::NODES::N_Sender::MESSAGES::ACKM::TIMINGS::EnableCyclic)
  {
    @sysvar::IL_CAN1::NODES::N_Sender::MESSAGES::ACKM::TIMINGS::SelectedPeriod = -1;
  }
}

on sysvar_update sysvar::IL_CAN1::NODES::N_Sender::MESSAGES::ACKM::TIMINGS::SelectedPeriod
{
  if (@this == 0 && @sysvar::IL_CAN1::NODES::N_Sender::MESSAGES::ACKM::TIMINGS::EnableCyclic)
  {
    SetBusContext(gILCAN1_BusContext);
    gCAN1DisturbancePeriod = @sysvar::IL_CAN1::NODES::N_Sender::MESSAGES::ACKM::TIMINGS::NormalCyclePeriod;
    J1939ILSetMsgCycleTime(J1939::Sender::ACKM, 0);
  }
  else if (@this == 1 && @sysvar::IL_CAN1::NODES::N_Sender::MESSAGES::ACKM::TIMINGS::EnableCyclic)
  {
    SetBusContext(gILCAN1_BusContext);
    gCAN1DisturbancePeriod = @sysvar::IL_CAN1::NODES::N_Sender::MESSAGES::ACKM::TIMINGS::ActiveCyclePeriod;
    J1939ILSetMsgCycleTime(J1939::Sender::ACKM, gCAN1DisturbancePeriod);
  }
  else if (@this == -1 && @sysvar::IL_CAN1::NODES::N_Sender::MESSAGES::ACKM::TIMINGS::EnableCyclic)
  {
    SetBusContext(gILCAN1_BusContext);
    gCAN1DisturbancePeriod = @sysvar::IL_CAN1::NODES::N_Sender::MESSAGES::ACKM::TIMINGS::CyclePeriod;
    J1939ILSetMsgCycleTime(J1939::Sender::ACKM, gCAN1DisturbancePeriod);
  }
}

on sysvar_update sysvar::IL_CAN1::NODES::N_Sender::MESSAGES::ACKM::TIMINGS::SendOnce
{
  if (@this == 1)
  {
    SetBusContext(gILCAN1_BusContext);
    J1939ILSetMsgEvent(J1939::Sender::ACKM);
  }
}

on sysvar_update sysvar::IL_CAN1::NODES::N_Sender::MESSAGES::ACL::TIMINGS::EnableCyclic
{
  if (@this == 1)
  {
    SetBusContext(gILCAN1_BusContext);
    J1939ILEnableMsg  (J1939::Sender::ACL);
  }
  else
  {
    SetBusContext(gILCAN1_BusContext);
    J1939ILDisableMsg (J1939::Sender::ACL);
  }
}

on sysvar_update sysvar::IL_CAN1::NODES::N_Sender::MESSAGES::ACL::TIMINGS::SetNormalCycle
{
  if (@this == 1 && @sysvar::IL_CAN1::NODES::N_Sender::MESSAGES::ACL::TIMINGS::EnableCyclic)
  {
    @sysvar::IL_CAN1::NODES::N_Sender::MESSAGES::ACL::TIMINGS::SelectedPeriod = 0;
  }
}

on sysvar_update sysvar::IL_CAN1::NODES::N_Sender::MESSAGES::ACL::TIMINGS::SetNewCycleContinously
{
  if (@this == 1 && @sysvar::IL_CAN1::NODES::N_Sender::MESSAGES::ACL::TIMINGS::EnableCyclic)
  {
    @sysvar::IL_CAN1::NODES::N_Sender::MESSAGES::ACL::TIMINGS::SelectedPeriod = -1;
  }
}

on sysvar_update sysvar::IL_CAN1::NODES::N_Sender::MESSAGES::ACL::TIMINGS::SelectedPeriod
{
  if (@this == 0 && @sysvar::IL_CAN1::NODES::N_Sender::MESSAGES::ACL::TIMINGS::EnableCyclic)
  {
    SetBusContext(gILCAN1_BusContext);
    gCAN1DisturbancePeriod = @sysvar::IL_CAN1::NODES::N_Sender::MESSAGES::ACL::TIMINGS::NormalCyclePeriod;
    J1939ILSetMsgCycleTime(J1939::Sender::ACL, 0);
  }
  else if (@this == 1 && @sysvar::IL_CAN1::NODES::N_Sender::MESSAGES::ACL::TIMINGS::EnableCyclic)
  {
    SetBusContext(gILCAN1_BusContext);
    gCAN1DisturbancePeriod = @sysvar::IL_CAN1::NODES::N_Sender::MESSAGES::ACL::TIMINGS::ActiveCyclePeriod;
    J1939ILSetMsgCycleTime(J1939::Sender::ACL, gCAN1DisturbancePeriod);
  }
  else if (@this == -1 && @sysvar::IL_CAN1::NODES::N_Sender::MESSAGES::ACL::TIMINGS::EnableCyclic)
  {
    SetBusContext(gILCAN1_BusContext);
    gCAN1DisturbancePeriod = @sysvar::IL_CAN1::NODES::N_Sender::MESSAGES::ACL::TIMINGS::CyclePeriod;
    J1939ILSetMsgCycleTime(J1939::Sender::ACL, gCAN1DisturbancePeriod);
  }
}

on sysvar_update sysvar::IL_CAN1::NODES::N_Sender::MESSAGES::ACL::TIMINGS::SendOnce
{
  if (@this == 1)
  {
    SetBusContext(gILCAN1_BusContext);
    J1939ILSetMsgEvent(J1939::Sender::ACL);
  }
}

on sysvar_update sysvar::IL_CAN1::NODES::N_Sender::MESSAGES::AMB::TIMINGS::EnableCyclic
{
  if (@this == 1)
  {
    SetBusContext(gILCAN1_BusContext);
    J1939ILEnableMsg  (J1939::Sender::AMB);
  }
  else
  {
    SetBusContext(gILCAN1_BusContext);
    J1939ILDisableMsg (J1939::Sender::AMB);
  }
}

on sysvar_update sysvar::IL_CAN1::NODES::N_Sender::MESSAGES::AMB::TIMINGS::SetNormalCycle
{
  if (@this == 1 && @sysvar::IL_CAN1::NODES::N_Sender::MESSAGES::AMB::TIMINGS::EnableCyclic)
  {
    @sysvar::IL_CAN1::NODES::N_Sender::MESSAGES::AMB::TIMINGS::SelectedPeriod = 0;
  }
}

on sysvar_update sysvar::IL_CAN1::NODES::N_Sender::MESSAGES::AMB::TIMINGS::SetNewCycleContinously
{
  if (@this == 1 && @sysvar::IL_CAN1::NODES::N_Sender::MESSAGES::AMB::TIMINGS::EnableCyclic)
  {
    @sysvar::IL_CAN1::NODES::N_Sender::MESSAGES::AMB::TIMINGS::SelectedPeriod = -1;
  }
}

on sysvar_update sysvar::IL_CAN1::NODES::N_Sender::MESSAGES::AMB::TIMINGS::SelectedPeriod
{
  if (@this == 0 && @sysvar::IL_CAN1::NODES::N_Sender::MESSAGES::AMB::TIMINGS::EnableCyclic)
  {
    SetBusContext(gILCAN1_BusContext);
    gCAN1DisturbancePeriod = @sysvar::IL_CAN1::NODES::N_Sender::MESSAGES::AMB::TIMINGS::NormalCyclePeriod;
    J1939ILSetMsgCycleTime(J1939::Sender::AMB, 1000);
  }
  else if (@this == 1 && @sysvar::IL_CAN1::NODES::N_Sender::MESSAGES::AMB::TIMINGS::EnableCyclic)
  {
    SetBusContext(gILCAN1_BusContext);
    gCAN1DisturbancePeriod = @sysvar::IL_CAN1::NODES::N_Sender::MESSAGES::AMB::TIMINGS::ActiveCyclePeriod;
    J1939ILSetMsgCycleTime(J1939::Sender::AMB, gCAN1DisturbancePeriod);
  }
  else if (@this == -1 && @sysvar::IL_CAN1::NODES::N_Sender::MESSAGES::AMB::TIMINGS::EnableCyclic)
  {
    SetBusContext(gILCAN1_BusContext);
    gCAN1DisturbancePeriod = @sysvar::IL_CAN1::NODES::N_Sender::MESSAGES::AMB::TIMINGS::CyclePeriod;
    J1939ILSetMsgCycleTime(J1939::Sender::AMB, gCAN1DisturbancePeriod);
  }
}

on sysvar_update sysvar::IL_CAN1::NODES::N_Sender::MESSAGES::AMB::TIMINGS::SendOnce
{
  if (@this == 1)
  {
    SetBusContext(gILCAN1_BusContext);
    J1939ILSetMsgEvent(J1939::Sender::AMB);
  }
}

on sysvar_update sysvar::IL_CAN1::NODES::N_Sender::MESSAGES::ASC1::TIMINGS::EnableCyclic
{
  if (@this == 1)
  {
    SetBusContext(gILCAN1_BusContext);
    J1939ILEnableMsg  (J1939::Sender::ASC1);
  }
  else
  {
    SetBusContext(gILCAN1_BusContext);
    J1939ILDisableMsg (J1939::Sender::ASC1);
  }
}

on sysvar_update sysvar::IL_CAN1::NODES::N_Sender::MESSAGES::ASC1::TIMINGS::SetNormalCycle
{
  if (@this == 1 && @sysvar::IL_CAN1::NODES::N_Sender::MESSAGES::ASC1::TIMINGS::EnableCyclic)
  {
    @sysvar::IL_CAN1::NODES::N_Sender::MESSAGES::ASC1::TIMINGS::SelectedPeriod = 0;
  }
}

on sysvar_update sysvar::IL_CAN1::NODES::N_Sender::MESSAGES::ASC1::TIMINGS::SetNewCycleContinously
{
  if (@this == 1 && @sysvar::IL_CAN1::NODES::N_Sender::MESSAGES::ASC1::TIMINGS::EnableCyclic)
  {
    @sysvar::IL_CAN1::NODES::N_Sender::MESSAGES::ASC1::TIMINGS::SelectedPeriod = -1;
  }
}

on sysvar_update sysvar::IL_CAN1::NODES::N_Sender::MESSAGES::ASC1::TIMINGS::SelectedPeriod
{
  if (@this == 0 && @sysvar::IL_CAN1::NODES::N_Sender::MESSAGES::ASC1::TIMINGS::EnableCyclic)
  {
    SetBusContext(gILCAN1_BusContext);
    gCAN1DisturbancePeriod = @sysvar::IL_CAN1::NODES::N_Sender::MESSAGES::ASC1::TIMINGS::NormalCyclePeriod;
    J1939ILSetMsgCycleTime(J1939::Sender::ASC1, 100);
  }
  else if (@this == 1 && @sysvar::IL_CAN1::NODES::N_Sender::MESSAGES::ASC1::TIMINGS::EnableCyclic)
  {
    SetBusContext(gILCAN1_BusContext);
    gCAN1DisturbancePeriod = @sysvar::IL_CAN1::NODES::N_Sender::MESSAGES::ASC1::TIMINGS::ActiveCyclePeriod;
    J1939ILSetMsgCycleTime(J1939::Sender::ASC1, gCAN1DisturbancePeriod);
  }
  else if (@this == -1 && @sysvar::IL_CAN1::NODES::N_Sender::MESSAGES::ASC1::TIMINGS::EnableCyclic)
  {
    SetBusContext(gILCAN1_BusContext);
    gCAN1DisturbancePeriod = @sysvar::IL_CAN1::NODES::N_Sender::MESSAGES::ASC1::TIMINGS::CyclePeriod;
    J1939ILSetMsgCycleTime(J1939::Sender::ASC1, gCAN1DisturbancePeriod);
  }
}

on sysvar_update sysvar::IL_CAN1::NODES::N_Sender::MESSAGES::ASC1::TIMINGS::SendOnce
{
  if (@this == 1)
  {
    SetBusContext(gILCAN1_BusContext);
    J1939ILSetMsgEvent(J1939::Sender::ASC1);
  }
}

on sysvar_update sysvar::IL_CAN1::NODES::N_Sender::MESSAGES::ASC3::TIMINGS::EnableCyclic
{
  if (@this == 1)
  {
    SetBusContext(gILCAN1_BusContext);
    J1939ILEnableMsg  (J1939::Sender::ASC3);
  }
  else
  {
    SetBusContext(gILCAN1_BusContext);
    J1939ILDisableMsg (J1939::Sender::ASC3);
  }
}

on sysvar_update sysvar::IL_CAN1::NODES::N_Sender::MESSAGES::ASC3::TIMINGS::SetNormalCycle
{
  if (@this == 1 && @sysvar::IL_CAN1::NODES::N_Sender::MESSAGES::ASC3::TIMINGS::EnableCyclic)
  {
    @sysvar::IL_CAN1::NODES::N_Sender::MESSAGES::ASC3::TIMINGS::SelectedPeriod = 0;
  }
}

on sysvar_update sysvar::IL_CAN1::NODES::N_Sender::MESSAGES::ASC3::TIMINGS::SetNewCycleContinously
{
  if (@this == 1 && @sysvar::IL_CAN1::NODES::N_Sender::MESSAGES::ASC3::TIMINGS::EnableCyclic)
  {
    @sysvar::IL_CAN1::NODES::N_Sender::MESSAGES::ASC3::TIMINGS::SelectedPeriod = -1;
  }
}

on sysvar_update sysvar::IL_CAN1::NODES::N_Sender::MESSAGES::ASC3::TIMINGS::SelectedPeriod
{
  if (@this == 0 && @sysvar::IL_CAN1::NODES::N_Sender::MESSAGES::ASC3::TIMINGS::EnableCyclic)
  {
    SetBusContext(gILCAN1_BusContext);
    gCAN1DisturbancePeriod = @sysvar::IL_CAN1::NODES::N_Sender::MESSAGES::ASC3::TIMINGS::NormalCyclePeriod;
    J1939ILSetMsgCycleTime(J1939::Sender::ASC3, 100);
  }
  else if (@this == 1 && @sysvar::IL_CAN1::NODES::N_Sender::MESSAGES::ASC3::TIMINGS::EnableCyclic)
  {
    SetBusContext(gILCAN1_BusContext);
    gCAN1DisturbancePeriod = @sysvar::IL_CAN1::NODES::N_Sender::MESSAGES::ASC3::TIMINGS::ActiveCyclePeriod;
    J1939ILSetMsgCycleTime(J1939::Sender::ASC3, gCAN1DisturbancePeriod);
  }
  else if (@this == -1 && @sysvar::IL_CAN1::NODES::N_Sender::MESSAGES::ASC3::TIMINGS::EnableCyclic)
  {
    SetBusContext(gILCAN1_BusContext);
    gCAN1DisturbancePeriod = @sysvar::IL_CAN1::NODES::N_Sender::MESSAGES::ASC3::TIMINGS::CyclePeriod;
    J1939ILSetMsgCycleTime(J1939::Sender::ASC3, gCAN1DisturbancePeriod);
  }
}

on sysvar_update sysvar::IL_CAN1::NODES::N_Sender::MESSAGES::ASC3::TIMINGS::SendOnce
{
  if (@this == 1)
  {
    SetBusContext(gILCAN1_BusContext);
    J1939ILSetMsgEvent(J1939::Sender::ASC3);
  }
}

on sysvar_update sysvar::IL_CAN1::NODES::N_Sender::MESSAGES::CACI::TIMINGS::EnableCyclic
{
  if (@this == 1)
  {
    SetBusContext(gILCAN1_BusContext);
    J1939ILEnableMsg  (J1939::Sender::CACI);
  }
  else
  {
    SetBusContext(gILCAN1_BusContext);
    J1939ILDisableMsg (J1939::Sender::CACI);
  }
}

on sysvar_update sysvar::IL_CAN1::NODES::N_Sender::MESSAGES::CACI::TIMINGS::SetNormalCycle
{
  if (@this == 1 && @sysvar::IL_CAN1::NODES::N_Sender::MESSAGES::CACI::TIMINGS::EnableCyclic)
  {
    @sysvar::IL_CAN1::NODES::N_Sender::MESSAGES::CACI::TIMINGS::SelectedPeriod = 0;
  }
}

on sysvar_update sysvar::IL_CAN1::NODES::N_Sender::MESSAGES::CACI::TIMINGS::SetNewCycleContinously
{
  if (@this == 1 && @sysvar::IL_CAN1::NODES::N_Sender::MESSAGES::CACI::TIMINGS::EnableCyclic)
  {
    @sysvar::IL_CAN1::NODES::N_Sender::MESSAGES::CACI::TIMINGS::SelectedPeriod = -1;
  }
}

on sysvar_update sysvar::IL_CAN1::NODES::N_Sender::MESSAGES::CACI::TIMINGS::SelectedPeriod
{
  if (@this == 0 && @sysvar::IL_CAN1::NODES::N_Sender::MESSAGES::CACI::TIMINGS::EnableCyclic)
  {
    SetBusContext(gILCAN1_BusContext);
    gCAN1DisturbancePeriod = @sysvar::IL_CAN1::NODES::N_Sender::MESSAGES::CACI::TIMINGS::NormalCyclePeriod;
    J1939ILSetMsgCycleTime(J1939::Sender::CACI, 1000);
  }
  else if (@this == 1 && @sysvar::IL_CAN1::NODES::N_Sender::MESSAGES::CACI::TIMINGS::EnableCyclic)
  {
    SetBusContext(gILCAN1_BusContext);
    gCAN1DisturbancePeriod = @sysvar::IL_CAN1::NODES::N_Sender::MESSAGES::CACI::TIMINGS::ActiveCyclePeriod;
    J1939ILSetMsgCycleTime(J1939::Sender::CACI, gCAN1DisturbancePeriod);
  }
  else if (@this == -1 && @sysvar::IL_CAN1::NODES::N_Sender::MESSAGES::CACI::TIMINGS::EnableCyclic)
  {
    SetBusContext(gILCAN1_BusContext);
    gCAN1DisturbancePeriod = @sysvar::IL_CAN1::NODES::N_Sender::MESSAGES::CACI::TIMINGS::CyclePeriod;
    J1939ILSetMsgCycleTime(J1939::Sender::CACI, gCAN1DisturbancePeriod);
  }
}

on sysvar_update sysvar::IL_CAN1::NODES::N_Sender::MESSAGES::CACI::TIMINGS::SendOnce
{
  if (@this == 1)
  {
    SetBusContext(gILCAN1_BusContext);
    J1939ILSetMsgEvent(J1939::Sender::CACI);
  }
}

on sysvar_update sysvar::IL_CAN1::NODES::N_Sender::MESSAGES::CAPL_MSG::TIMINGS::EnableCyclic
{
  if (@this == 1)
  {
    SetBusContext(gILCAN1_BusContext);
    J1939ILEnableMsg  (J1939::Sender::CAPL_MSG);
  }
  else
  {
    SetBusContext(gILCAN1_BusContext);
    J1939ILDisableMsg (J1939::Sender::CAPL_MSG);
  }
}

on sysvar_update sysvar::IL_CAN1::NODES::N_Sender::MESSAGES::CAPL_MSG::TIMINGS::SetNormalCycle
{
  if (@this == 1 && @sysvar::IL_CAN1::NODES::N_Sender::MESSAGES::CAPL_MSG::TIMINGS::EnableCyclic)
  {
    @sysvar::IL_CAN1::NODES::N_Sender::MESSAGES::CAPL_MSG::TIMINGS::SelectedPeriod = 0;
  }
}

on sysvar_update sysvar::IL_CAN1::NODES::N_Sender::MESSAGES::CAPL_MSG::TIMINGS::SetNewCycleContinously
{
  if (@this == 1 && @sysvar::IL_CAN1::NODES::N_Sender::MESSAGES::CAPL_MSG::TIMINGS::EnableCyclic)
  {
    @sysvar::IL_CAN1::NODES::N_Sender::MESSAGES::CAPL_MSG::TIMINGS::SelectedPeriod = -1;
  }
}

on sysvar_update sysvar::IL_CAN1::NODES::N_Sender::MESSAGES::CAPL_MSG::TIMINGS::SelectedPeriod
{
  if (@this == 0 && @sysvar::IL_CAN1::NODES::N_Sender::MESSAGES::CAPL_MSG::TIMINGS::EnableCyclic)
  {
    SetBusContext(gILCAN1_BusContext);
    gCAN1DisturbancePeriod = @sysvar::IL_CAN1::NODES::N_Sender::MESSAGES::CAPL_MSG::TIMINGS::NormalCyclePeriod;
    J1939ILSetMsgCycleTime(J1939::Sender::CAPL_MSG, 0);
  }
  else if (@this == 1 && @sysvar::IL_CAN1::NODES::N_Sender::MESSAGES::CAPL_MSG::TIMINGS::EnableCyclic)
  {
    SetBusContext(gILCAN1_BusContext);
    gCAN1DisturbancePeriod = @sysvar::IL_CAN1::NODES::N_Sender::MESSAGES::CAPL_MSG::TIMINGS::ActiveCyclePeriod;
    J1939ILSetMsgCycleTime(J1939::Sender::CAPL_MSG, gCAN1DisturbancePeriod);
  }
  else if (@this == -1 && @sysvar::IL_CAN1::NODES::N_Sender::MESSAGES::CAPL_MSG::TIMINGS::EnableCyclic)
  {
    SetBusContext(gILCAN1_BusContext);
    gCAN1DisturbancePeriod = @sysvar::IL_CAN1::NODES::N_Sender::MESSAGES::CAPL_MSG::TIMINGS::CyclePeriod;
    J1939ILSetMsgCycleTime(J1939::Sender::CAPL_MSG, gCAN1DisturbancePeriod);
  }
}

on sysvar_update sysvar::IL_CAN1::NODES::N_Sender::MESSAGES::CAPL_MSG::TIMINGS::SendOnce
{
  if (@this == 1)
  {
    SetBusContext(gILCAN1_BusContext);
    J1939ILSetMsgEvent(J1939::Sender::CAPL_MSG);
  }
}

on sysvar_update sysvar::IL_CAN1::NODES::N_Sender::MESSAGES::CCVS::TIMINGS::EnableCyclic
{
  if (@this == 1)
  {
    SetBusContext(gILCAN1_BusContext);
    J1939ILEnableMsg  (J1939::Sender::CCVS);
  }
  else
  {
    SetBusContext(gILCAN1_BusContext);
    J1939ILDisableMsg (J1939::Sender::CCVS);
  }
}

on sysvar_update sysvar::IL_CAN1::NODES::N_Sender::MESSAGES::CCVS::TIMINGS::SetNormalCycle
{
  if (@this == 1 && @sysvar::IL_CAN1::NODES::N_Sender::MESSAGES::CCVS::TIMINGS::EnableCyclic)
  {
    @sysvar::IL_CAN1::NODES::N_Sender::MESSAGES::CCVS::TIMINGS::SelectedPeriod = 0;
  }
}

on sysvar_update sysvar::IL_CAN1::NODES::N_Sender::MESSAGES::CCVS::TIMINGS::SetNewCycleContinously
{
  if (@this == 1 && @sysvar::IL_CAN1::NODES::N_Sender::MESSAGES::CCVS::TIMINGS::EnableCyclic)
  {
    @sysvar::IL_CAN1::NODES::N_Sender::MESSAGES::CCVS::TIMINGS::SelectedPeriod = -1;
  }
}

on sysvar_update sysvar::IL_CAN1::NODES::N_Sender::MESSAGES::CCVS::TIMINGS::SelectedPeriod
{
  if (@this == 0 && @sysvar::IL_CAN1::NODES::N_Sender::MESSAGES::CCVS::TIMINGS::EnableCyclic)
  {
    SetBusContext(gILCAN1_BusContext);
    gCAN1DisturbancePeriod = @sysvar::IL_CAN1::NODES::N_Sender::MESSAGES::CCVS::TIMINGS::NormalCyclePeriod;
    J1939ILSetMsgCycleTime(J1939::Sender::CCVS, 100);
  }
  else if (@this == 1 && @sysvar::IL_CAN1::NODES::N_Sender::MESSAGES::CCVS::TIMINGS::EnableCyclic)
  {
    SetBusContext(gILCAN1_BusContext);
    gCAN1DisturbancePeriod = @sysvar::IL_CAN1::NODES::N_Sender::MESSAGES::CCVS::TIMINGS::ActiveCyclePeriod;
    J1939ILSetMsgCycleTime(J1939::Sender::CCVS, gCAN1DisturbancePeriod);
  }
  else if (@this == -1 && @sysvar::IL_CAN1::NODES::N_Sender::MESSAGES::CCVS::TIMINGS::EnableCyclic)
  {
    SetBusContext(gILCAN1_BusContext);
    gCAN1DisturbancePeriod = @sysvar::IL_CAN1::NODES::N_Sender::MESSAGES::CCVS::TIMINGS::CyclePeriod;
    J1939ILSetMsgCycleTime(J1939::Sender::CCVS, gCAN1DisturbancePeriod);
  }
}

on sysvar_update sysvar::IL_CAN1::NODES::N_Sender::MESSAGES::CCVS::TIMINGS::SendOnce
{
  if (@this == 1)
  {
    SetBusContext(gILCAN1_BusContext);
    J1939ILSetMsgEvent(J1939::Sender::CCVS);
  }
}

on sysvar_update sysvar::IL_CAN1::NODES::N_Sender::MESSAGES::CL::TIMINGS::EnableCyclic
{
  if (@this == 1)
  {
    SetBusContext(gILCAN1_BusContext);
    J1939ILEnableMsg  (J1939::Sender::CL);
  }
  else
  {
    SetBusContext(gILCAN1_BusContext);
    J1939ILDisableMsg (J1939::Sender::CL);
  }
}

on sysvar_update sysvar::IL_CAN1::NODES::N_Sender::MESSAGES::CL::TIMINGS::SetNormalCycle
{
  if (@this == 1 && @sysvar::IL_CAN1::NODES::N_Sender::MESSAGES::CL::TIMINGS::EnableCyclic)
  {
    @sysvar::IL_CAN1::NODES::N_Sender::MESSAGES::CL::TIMINGS::SelectedPeriod = 0;
  }
}

on sysvar_update sysvar::IL_CAN1::NODES::N_Sender::MESSAGES::CL::TIMINGS::SetNewCycleContinously
{
  if (@this == 1 && @sysvar::IL_CAN1::NODES::N_Sender::MESSAGES::CL::TIMINGS::EnableCyclic)
  {
    @sysvar::IL_CAN1::NODES::N_Sender::MESSAGES::CL::TIMINGS::SelectedPeriod = -1;
  }
}

on sysvar_update sysvar::IL_CAN1::NODES::N_Sender::MESSAGES::CL::TIMINGS::SelectedPeriod
{
  if (@this == 0 && @sysvar::IL_CAN1::NODES::N_Sender::MESSAGES::CL::TIMINGS::EnableCyclic)
  {
    SetBusContext(gILCAN1_BusContext);
    gCAN1DisturbancePeriod = @sysvar::IL_CAN1::NODES::N_Sender::MESSAGES::CL::TIMINGS::NormalCyclePeriod;
    J1939ILSetMsgCycleTime(J1939::Sender::CL, 0);
  }
  else if (@this == 1 && @sysvar::IL_CAN1::NODES::N_Sender::MESSAGES::CL::TIMINGS::EnableCyclic)
  {
    SetBusContext(gILCAN1_BusContext);
    gCAN1DisturbancePeriod = @sysvar::IL_CAN1::NODES::N_Sender::MESSAGES::CL::TIMINGS::ActiveCyclePeriod;
    J1939ILSetMsgCycleTime(J1939::Sender::CL, gCAN1DisturbancePeriod);
  }
  else if (@this == -1 && @sysvar::IL_CAN1::NODES::N_Sender::MESSAGES::CL::TIMINGS::EnableCyclic)
  {
    SetBusContext(gILCAN1_BusContext);
    gCAN1DisturbancePeriod = @sysvar::IL_CAN1::NODES::N_Sender::MESSAGES::CL::TIMINGS::CyclePeriod;
    J1939ILSetMsgCycleTime(J1939::Sender::CL, gCAN1DisturbancePeriod);
  }
}

on sysvar_update sysvar::IL_CAN1::NODES::N_Sender::MESSAGES::CL::TIMINGS::SendOnce
{
  if (@this == 1)
  {
    SetBusContext(gILCAN1_BusContext);
    J1939ILSetMsgEvent(J1939::Sender::CL);
  }
}

on sysvar_update sysvar::IL_CAN1::NODES::N_Sender::MESSAGES::CM1::TIMINGS::EnableCyclic
{
  if (@this == 1)
  {
    SetBusContext(gILCAN1_BusContext);
    J1939ILEnableMsg  (J1939::Sender::CM1);
  }
  else
  {
    SetBusContext(gILCAN1_BusContext);
    J1939ILDisableMsg (J1939::Sender::CM1);
  }
}

on sysvar_update sysvar::IL_CAN1::NODES::N_Sender::MESSAGES::CM1::TIMINGS::SetNormalCycle
{
  if (@this == 1 && @sysvar::IL_CAN1::NODES::N_Sender::MESSAGES::CM1::TIMINGS::EnableCyclic)
  {
    @sysvar::IL_CAN1::NODES::N_Sender::MESSAGES::CM1::TIMINGS::SelectedPeriod = 0;
  }
}

on sysvar_update sysvar::IL_CAN1::NODES::N_Sender::MESSAGES::CM1::TIMINGS::SetNewCycleContinously
{
  if (@this == 1 && @sysvar::IL_CAN1::NODES::N_Sender::MESSAGES::CM1::TIMINGS::EnableCyclic)
  {
    @sysvar::IL_CAN1::NODES::N_Sender::MESSAGES::CM1::TIMINGS::SelectedPeriod = -1;
  }
}

on sysvar_update sysvar::IL_CAN1::NODES::N_Sender::MESSAGES::CM1::TIMINGS::SelectedPeriod
{
  if (@this == 0 && @sysvar::IL_CAN1::NODES::N_Sender::MESSAGES::CM1::TIMINGS::EnableCyclic)
  {
    SetBusContext(gILCAN1_BusContext);
    gCAN1DisturbancePeriod = @sysvar::IL_CAN1::NODES::N_Sender::MESSAGES::CM1::TIMINGS::NormalCyclePeriod;
    J1939ILSetMsgCycleTime(J1939::Sender::CM1, 1000);
  }
  else if (@this == 1 && @sysvar::IL_CAN1::NODES::N_Sender::MESSAGES::CM1::TIMINGS::EnableCyclic)
  {
    SetBusContext(gILCAN1_BusContext);
    gCAN1DisturbancePeriod = @sysvar::IL_CAN1::NODES::N_Sender::MESSAGES::CM1::TIMINGS::ActiveCyclePeriod;
    J1939ILSetMsgCycleTime(J1939::Sender::CM1, gCAN1DisturbancePeriod);
  }
  else if (@this == -1 && @sysvar::IL_CAN1::NODES::N_Sender::MESSAGES::CM1::TIMINGS::EnableCyclic)
  {
    SetBusContext(gILCAN1_BusContext);
    gCAN1DisturbancePeriod = @sysvar::IL_CAN1::NODES::N_Sender::MESSAGES::CM1::TIMINGS::CyclePeriod;
    J1939ILSetMsgCycleTime(J1939::Sender::CM1, gCAN1DisturbancePeriod);
  }
}

on sysvar_update sysvar::IL_CAN1::NODES::N_Sender::MESSAGES::CM1::TIMINGS::SendOnce
{
  if (@this == 1)
  {
    SetBusContext(gILCAN1_BusContext);
    J1939ILSetMsgEvent(J1939::Sender::CM1);
  }
}

on sysvar_update sysvar::IL_CAN1::NODES::N_Sender::MESSAGES::DD::TIMINGS::EnableCyclic
{
  if (@this == 1)
  {
    SetBusContext(gILCAN1_BusContext);
    J1939ILEnableMsg  (J1939::Sender::DD);
  }
  else
  {
    SetBusContext(gILCAN1_BusContext);
    J1939ILDisableMsg (J1939::Sender::DD);
  }
}

on sysvar_update sysvar::IL_CAN1::NODES::N_Sender::MESSAGES::DD::TIMINGS::SetNormalCycle
{
  if (@this == 1 && @sysvar::IL_CAN1::NODES::N_Sender::MESSAGES::DD::TIMINGS::EnableCyclic)
  {
    @sysvar::IL_CAN1::NODES::N_Sender::MESSAGES::DD::TIMINGS::SelectedPeriod = 0;
  }
}

on sysvar_update sysvar::IL_CAN1::NODES::N_Sender::MESSAGES::DD::TIMINGS::SetNewCycleContinously
{
  if (@this == 1 && @sysvar::IL_CAN1::NODES::N_Sender::MESSAGES::DD::TIMINGS::EnableCyclic)
  {
    @sysvar::IL_CAN1::NODES::N_Sender::MESSAGES::DD::TIMINGS::SelectedPeriod = -1;
  }
}

on sysvar_update sysvar::IL_CAN1::NODES::N_Sender::MESSAGES::DD::TIMINGS::SelectedPeriod
{
  if (@this == 0 && @sysvar::IL_CAN1::NODES::N_Sender::MESSAGES::DD::TIMINGS::EnableCyclic)
  {
    SetBusContext(gILCAN1_BusContext);
    gCAN1DisturbancePeriod = @sysvar::IL_CAN1::NODES::N_Sender::MESSAGES::DD::TIMINGS::NormalCyclePeriod;
    J1939ILSetMsgCycleTime(J1939::Sender::DD, 1000);
  }
  else if (@this == 1 && @sysvar::IL_CAN1::NODES::N_Sender::MESSAGES::DD::TIMINGS::EnableCyclic)
  {
    SetBusContext(gILCAN1_BusContext);
    gCAN1DisturbancePeriod = @sysvar::IL_CAN1::NODES::N_Sender::MESSAGES::DD::TIMINGS::ActiveCyclePeriod;
    J1939ILSetMsgCycleTime(J1939::Sender::DD, gCAN1DisturbancePeriod);
  }
  else if (@this == -1 && @sysvar::IL_CAN1::NODES::N_Sender::MESSAGES::DD::TIMINGS::EnableCyclic)
  {
    SetBusContext(gILCAN1_BusContext);
    gCAN1DisturbancePeriod = @sysvar::IL_CAN1::NODES::N_Sender::MESSAGES::DD::TIMINGS::CyclePeriod;
    J1939ILSetMsgCycleTime(J1939::Sender::DD, gCAN1DisturbancePeriod);
  }
}

on sysvar_update sysvar::IL_CAN1::NODES::N_Sender::MESSAGES::DD::TIMINGS::SendOnce
{
  if (@this == 1)
  {
    SetBusContext(gILCAN1_BusContext);
    J1939ILSetMsgEvent(J1939::Sender::DD);
  }
}

on sysvar_update sysvar::IL_CAN1::NODES::N_Sender::MESSAGES::DI::TIMINGS::EnableCyclic
{
  if (@this == 1)
  {
    SetBusContext(gILCAN1_BusContext);
    J1939ILEnableMsg  (J1939::Sender::DI);
  }
  else
  {
    SetBusContext(gILCAN1_BusContext);
    J1939ILDisableMsg (J1939::Sender::DI);
  }
}

on sysvar_update sysvar::IL_CAN1::NODES::N_Sender::MESSAGES::DI::TIMINGS::SetNormalCycle
{
  if (@this == 1 && @sysvar::IL_CAN1::NODES::N_Sender::MESSAGES::DI::TIMINGS::EnableCyclic)
  {
    @sysvar::IL_CAN1::NODES::N_Sender::MESSAGES::DI::TIMINGS::SelectedPeriod = 0;
  }
}

on sysvar_update sysvar::IL_CAN1::NODES::N_Sender::MESSAGES::DI::TIMINGS::SetNewCycleContinously
{
  if (@this == 1 && @sysvar::IL_CAN1::NODES::N_Sender::MESSAGES::DI::TIMINGS::EnableCyclic)
  {
    @sysvar::IL_CAN1::NODES::N_Sender::MESSAGES::DI::TIMINGS::SelectedPeriod = -1;
  }
}

on sysvar_update sysvar::IL_CAN1::NODES::N_Sender::MESSAGES::DI::TIMINGS::SelectedPeriod
{
  if (@this == 0 && @sysvar::IL_CAN1::NODES::N_Sender::MESSAGES::DI::TIMINGS::EnableCyclic)
  {
    SetBusContext(gILCAN1_BusContext);
    gCAN1DisturbancePeriod = @sysvar::IL_CAN1::NODES::N_Sender::MESSAGES::DI::TIMINGS::NormalCyclePeriod;
    J1939ILSetMsgCycleTime(J1939::Sender::DI, 0);
  }
  else if (@this == 1 && @sysvar::IL_CAN1::NODES::N_Sender::MESSAGES::DI::TIMINGS::EnableCyclic)
  {
    SetBusContext(gILCAN1_BusContext);
    gCAN1DisturbancePeriod = @sysvar::IL_CAN1::NODES::N_Sender::MESSAGES::DI::TIMINGS::ActiveCyclePeriod;
    J1939ILSetMsgCycleTime(J1939::Sender::DI, gCAN1DisturbancePeriod);
  }
  else if (@this == -1 && @sysvar::IL_CAN1::NODES::N_Sender::MESSAGES::DI::TIMINGS::EnableCyclic)
  {
    SetBusContext(gILCAN1_BusContext);
    gCAN1DisturbancePeriod = @sysvar::IL_CAN1::NODES::N_Sender::MESSAGES::DI::TIMINGS::CyclePeriod;
    J1939ILSetMsgCycleTime(J1939::Sender::DI, gCAN1DisturbancePeriod);
  }
}

on sysvar_update sysvar::IL_CAN1::NODES::N_Sender::MESSAGES::DI::TIMINGS::SendOnce
{
  if (@this == 1)
  {
    SetBusContext(gILCAN1_BusContext);
    J1939ILSetMsgEvent(J1939::Sender::DI);
  }
}

on sysvar_update sysvar::IL_CAN1::NODES::N_Sender::MESSAGES::DM1::TIMINGS::EnableCyclic
{
  if (@this == 1)
  {
    SetBusContext(gILCAN1_BusContext);
    J1939ILEnableMsg  (J1939::Sender::DM1);
  }
  else
  {
    SetBusContext(gILCAN1_BusContext);
    J1939ILDisableMsg (J1939::Sender::DM1);
  }
}

on sysvar_update sysvar::IL_CAN1::NODES::N_Sender::MESSAGES::DM1::TIMINGS::SetNormalCycle
{
  if (@this == 1 && @sysvar::IL_CAN1::NODES::N_Sender::MESSAGES::DM1::TIMINGS::EnableCyclic)
  {
    @sysvar::IL_CAN1::NODES::N_Sender::MESSAGES::DM1::TIMINGS::SelectedPeriod = 0;
  }
}

on sysvar_update sysvar::IL_CAN1::NODES::N_Sender::MESSAGES::DM1::TIMINGS::SetNewCycleContinously
{
  if (@this == 1 && @sysvar::IL_CAN1::NODES::N_Sender::MESSAGES::DM1::TIMINGS::EnableCyclic)
  {
    @sysvar::IL_CAN1::NODES::N_Sender::MESSAGES::DM1::TIMINGS::SelectedPeriod = -1;
  }
}

on sysvar_update sysvar::IL_CAN1::NODES::N_Sender::MESSAGES::DM1::TIMINGS::SelectedPeriod
{
  if (@this == 0 && @sysvar::IL_CAN1::NODES::N_Sender::MESSAGES::DM1::TIMINGS::EnableCyclic)
  {
    SetBusContext(gILCAN1_BusContext);
    gCAN1DisturbancePeriod = @sysvar::IL_CAN1::NODES::N_Sender::MESSAGES::DM1::TIMINGS::NormalCyclePeriod;
    J1939ILSetMsgCycleTime(J1939::Sender::DM1, 0);
  }
  else if (@this == 1 && @sysvar::IL_CAN1::NODES::N_Sender::MESSAGES::DM1::TIMINGS::EnableCyclic)
  {
    SetBusContext(gILCAN1_BusContext);
    gCAN1DisturbancePeriod = @sysvar::IL_CAN1::NODES::N_Sender::MESSAGES::DM1::TIMINGS::ActiveCyclePeriod;
    J1939ILSetMsgCycleTime(J1939::Sender::DM1, gCAN1DisturbancePeriod);
  }
  else if (@this == -1 && @sysvar::IL_CAN1::NODES::N_Sender::MESSAGES::DM1::TIMINGS::EnableCyclic)
  {
    SetBusContext(gILCAN1_BusContext);
    gCAN1DisturbancePeriod = @sysvar::IL_CAN1::NODES::N_Sender::MESSAGES::DM1::TIMINGS::CyclePeriod;
    J1939ILSetMsgCycleTime(J1939::Sender::DM1, gCAN1DisturbancePeriod);
  }
}

on sysvar_update sysvar::IL_CAN1::NODES::N_Sender::MESSAGES::DM1::TIMINGS::SendOnce
{
  if (@this == 1)
  {
    SetBusContext(gILCAN1_BusContext);
    J1939ILSetMsgEvent(J1939::Sender::DM1);
  }
}

on sysvar_update sysvar::IL_CAN1::NODES::N_Sender::MESSAGES::DM12::TIMINGS::EnableCyclic
{
  if (@this == 1)
  {
    SetBusContext(gILCAN1_BusContext);
    J1939ILEnableMsg  (J1939::Sender::DM12);
  }
  else
  {
    SetBusContext(gILCAN1_BusContext);
    J1939ILDisableMsg (J1939::Sender::DM12);
  }
}

on sysvar_update sysvar::IL_CAN1::NODES::N_Sender::MESSAGES::DM12::TIMINGS::SetNormalCycle
{
  if (@this == 1 && @sysvar::IL_CAN1::NODES::N_Sender::MESSAGES::DM12::TIMINGS::EnableCyclic)
  {
    @sysvar::IL_CAN1::NODES::N_Sender::MESSAGES::DM12::TIMINGS::SelectedPeriod = 0;
  }
}

on sysvar_update sysvar::IL_CAN1::NODES::N_Sender::MESSAGES::DM12::TIMINGS::SetNewCycleContinously
{
  if (@this == 1 && @sysvar::IL_CAN1::NODES::N_Sender::MESSAGES::DM12::TIMINGS::EnableCyclic)
  {
    @sysvar::IL_CAN1::NODES::N_Sender::MESSAGES::DM12::TIMINGS::SelectedPeriod = -1;
  }
}

on sysvar_update sysvar::IL_CAN1::NODES::N_Sender::MESSAGES::DM12::TIMINGS::SelectedPeriod
{
  if (@this == 0 && @sysvar::IL_CAN1::NODES::N_Sender::MESSAGES::DM12::TIMINGS::EnableCyclic)
  {
    SetBusContext(gILCAN1_BusContext);
    gCAN1DisturbancePeriod = @sysvar::IL_CAN1::NODES::N_Sender::MESSAGES::DM12::TIMINGS::NormalCyclePeriod;
    J1939ILSetMsgCycleTime(J1939::Sender::DM12, 0);
  }
  else if (@this == 1 && @sysvar::IL_CAN1::NODES::N_Sender::MESSAGES::DM12::TIMINGS::EnableCyclic)
  {
    SetBusContext(gILCAN1_BusContext);
    gCAN1DisturbancePeriod = @sysvar::IL_CAN1::NODES::N_Sender::MESSAGES::DM12::TIMINGS::ActiveCyclePeriod;
    J1939ILSetMsgCycleTime(J1939::Sender::DM12, gCAN1DisturbancePeriod);
  }
  else if (@this == -1 && @sysvar::IL_CAN1::NODES::N_Sender::MESSAGES::DM12::TIMINGS::EnableCyclic)
  {
    SetBusContext(gILCAN1_BusContext);
    gCAN1DisturbancePeriod = @sysvar::IL_CAN1::NODES::N_Sender::MESSAGES::DM12::TIMINGS::CyclePeriod;
    J1939ILSetMsgCycleTime(J1939::Sender::DM12, gCAN1DisturbancePeriod);
  }
}

on sysvar_update sysvar::IL_CAN1::NODES::N_Sender::MESSAGES::DM12::TIMINGS::SendOnce
{
  if (@this == 1)
  {
    SetBusContext(gILCAN1_BusContext);
    J1939ILSetMsgEvent(J1939::Sender::DM12);
  }
}

on sysvar_update sysvar::IL_CAN1::NODES::N_Sender::MESSAGES::DM19::TIMINGS::EnableCyclic
{
  if (@this == 1)
  {
    SetBusContext(gILCAN1_BusContext);
    J1939ILEnableMsg  (J1939::Sender::DM19);
  }
  else
  {
    SetBusContext(gILCAN1_BusContext);
    J1939ILDisableMsg (J1939::Sender::DM19);
  }
}

on sysvar_update sysvar::IL_CAN1::NODES::N_Sender::MESSAGES::DM19::TIMINGS::SetNormalCycle
{
  if (@this == 1 && @sysvar::IL_CAN1::NODES::N_Sender::MESSAGES::DM19::TIMINGS::EnableCyclic)
  {
    @sysvar::IL_CAN1::NODES::N_Sender::MESSAGES::DM19::TIMINGS::SelectedPeriod = 0;
  }
}

on sysvar_update sysvar::IL_CAN1::NODES::N_Sender::MESSAGES::DM19::TIMINGS::SetNewCycleContinously
{
  if (@this == 1 && @sysvar::IL_CAN1::NODES::N_Sender::MESSAGES::DM19::TIMINGS::EnableCyclic)
  {
    @sysvar::IL_CAN1::NODES::N_Sender::MESSAGES::DM19::TIMINGS::SelectedPeriod = -1;
  }
}

on sysvar_update sysvar::IL_CAN1::NODES::N_Sender::MESSAGES::DM19::TIMINGS::SelectedPeriod
{
  if (@this == 0 && @sysvar::IL_CAN1::NODES::N_Sender::MESSAGES::DM19::TIMINGS::EnableCyclic)
  {
    SetBusContext(gILCAN1_BusContext);
    gCAN1DisturbancePeriod = @sysvar::IL_CAN1::NODES::N_Sender::MESSAGES::DM19::TIMINGS::NormalCyclePeriod;
    J1939ILSetMsgCycleTime(J1939::Sender::DM19, 0);
  }
  else if (@this == 1 && @sysvar::IL_CAN1::NODES::N_Sender::MESSAGES::DM19::TIMINGS::EnableCyclic)
  {
    SetBusContext(gILCAN1_BusContext);
    gCAN1DisturbancePeriod = @sysvar::IL_CAN1::NODES::N_Sender::MESSAGES::DM19::TIMINGS::ActiveCyclePeriod;
    J1939ILSetMsgCycleTime(J1939::Sender::DM19, gCAN1DisturbancePeriod);
  }
  else if (@this == -1 && @sysvar::IL_CAN1::NODES::N_Sender::MESSAGES::DM19::TIMINGS::EnableCyclic)
  {
    SetBusContext(gILCAN1_BusContext);
    gCAN1DisturbancePeriod = @sysvar::IL_CAN1::NODES::N_Sender::MESSAGES::DM19::TIMINGS::CyclePeriod;
    J1939ILSetMsgCycleTime(J1939::Sender::DM19, gCAN1DisturbancePeriod);
  }
}

on sysvar_update sysvar::IL_CAN1::NODES::N_Sender::MESSAGES::DM19::TIMINGS::SendOnce
{
  if (@this == 1)
  {
    SetBusContext(gILCAN1_BusContext);
    J1939ILSetMsgEvent(J1939::Sender::DM19);
  }
}

on sysvar_update sysvar::IL_CAN1::NODES::N_Sender::MESSAGES::DM2::TIMINGS::EnableCyclic
{
  if (@this == 1)
  {
    SetBusContext(gILCAN1_BusContext);
    J1939ILEnableMsg  (J1939::Sender::DM2);
  }
  else
  {
    SetBusContext(gILCAN1_BusContext);
    J1939ILDisableMsg (J1939::Sender::DM2);
  }
}

on sysvar_update sysvar::IL_CAN1::NODES::N_Sender::MESSAGES::DM2::TIMINGS::SetNormalCycle
{
  if (@this == 1 && @sysvar::IL_CAN1::NODES::N_Sender::MESSAGES::DM2::TIMINGS::EnableCyclic)
  {
    @sysvar::IL_CAN1::NODES::N_Sender::MESSAGES::DM2::TIMINGS::SelectedPeriod = 0;
  }
}

on sysvar_update sysvar::IL_CAN1::NODES::N_Sender::MESSAGES::DM2::TIMINGS::SetNewCycleContinously
{
  if (@this == 1 && @sysvar::IL_CAN1::NODES::N_Sender::MESSAGES::DM2::TIMINGS::EnableCyclic)
  {
    @sysvar::IL_CAN1::NODES::N_Sender::MESSAGES::DM2::TIMINGS::SelectedPeriod = -1;
  }
}

on sysvar_update sysvar::IL_CAN1::NODES::N_Sender::MESSAGES::DM2::TIMINGS::SelectedPeriod
{
  if (@this == 0 && @sysvar::IL_CAN1::NODES::N_Sender::MESSAGES::DM2::TIMINGS::EnableCyclic)
  {
    SetBusContext(gILCAN1_BusContext);
    gCAN1DisturbancePeriod = @sysvar::IL_CAN1::NODES::N_Sender::MESSAGES::DM2::TIMINGS::NormalCyclePeriod;
    J1939ILSetMsgCycleTime(J1939::Sender::DM2, 0);
  }
  else if (@this == 1 && @sysvar::IL_CAN1::NODES::N_Sender::MESSAGES::DM2::TIMINGS::EnableCyclic)
  {
    SetBusContext(gILCAN1_BusContext);
    gCAN1DisturbancePeriod = @sysvar::IL_CAN1::NODES::N_Sender::MESSAGES::DM2::TIMINGS::ActiveCyclePeriod;
    J1939ILSetMsgCycleTime(J1939::Sender::DM2, gCAN1DisturbancePeriod);
  }
  else if (@this == -1 && @sysvar::IL_CAN1::NODES::N_Sender::MESSAGES::DM2::TIMINGS::EnableCyclic)
  {
    SetBusContext(gILCAN1_BusContext);
    gCAN1DisturbancePeriod = @sysvar::IL_CAN1::NODES::N_Sender::MESSAGES::DM2::TIMINGS::CyclePeriod;
    J1939ILSetMsgCycleTime(J1939::Sender::DM2, gCAN1DisturbancePeriod);
  }
}

on sysvar_update sysvar::IL_CAN1::NODES::N_Sender::MESSAGES::DM2::TIMINGS::SendOnce
{
  if (@this == 1)
  {
    SetBusContext(gILCAN1_BusContext);
    J1939ILSetMsgEvent(J1939::Sender::DM2);
  }
}

on sysvar_update sysvar::IL_CAN1::NODES::N_Sender::MESSAGES::DM22::TIMINGS::EnableCyclic
{
  if (@this == 1)
  {
    SetBusContext(gILCAN1_BusContext);
    J1939ILEnableMsg  (J1939::Sender::DM22);
  }
  else
  {
    SetBusContext(gILCAN1_BusContext);
    J1939ILDisableMsg (J1939::Sender::DM22);
  }
}

on sysvar_update sysvar::IL_CAN1::NODES::N_Sender::MESSAGES::DM22::TIMINGS::SetNormalCycle
{
  if (@this == 1 && @sysvar::IL_CAN1::NODES::N_Sender::MESSAGES::DM22::TIMINGS::EnableCyclic)
  {
    @sysvar::IL_CAN1::NODES::N_Sender::MESSAGES::DM22::TIMINGS::SelectedPeriod = 0;
  }
}

on sysvar_update sysvar::IL_CAN1::NODES::N_Sender::MESSAGES::DM22::TIMINGS::SetNewCycleContinously
{
  if (@this == 1 && @sysvar::IL_CAN1::NODES::N_Sender::MESSAGES::DM22::TIMINGS::EnableCyclic)
  {
    @sysvar::IL_CAN1::NODES::N_Sender::MESSAGES::DM22::TIMINGS::SelectedPeriod = -1;
  }
}

on sysvar_update sysvar::IL_CAN1::NODES::N_Sender::MESSAGES::DM22::TIMINGS::SelectedPeriod
{
  if (@this == 0 && @sysvar::IL_CAN1::NODES::N_Sender::MESSAGES::DM22::TIMINGS::EnableCyclic)
  {
    SetBusContext(gILCAN1_BusContext);
    gCAN1DisturbancePeriod = @sysvar::IL_CAN1::NODES::N_Sender::MESSAGES::DM22::TIMINGS::NormalCyclePeriod;
    J1939ILSetMsgCycleTime(J1939::Sender::DM22, 0);
  }
  else if (@this == 1 && @sysvar::IL_CAN1::NODES::N_Sender::MESSAGES::DM22::TIMINGS::EnableCyclic)
  {
    SetBusContext(gILCAN1_BusContext);
    gCAN1DisturbancePeriod = @sysvar::IL_CAN1::NODES::N_Sender::MESSAGES::DM22::TIMINGS::ActiveCyclePeriod;
    J1939ILSetMsgCycleTime(J1939::Sender::DM22, gCAN1DisturbancePeriod);
  }
  else if (@this == -1 && @sysvar::IL_CAN1::NODES::N_Sender::MESSAGES::DM22::TIMINGS::EnableCyclic)
  {
    SetBusContext(gILCAN1_BusContext);
    gCAN1DisturbancePeriod = @sysvar::IL_CAN1::NODES::N_Sender::MESSAGES::DM22::TIMINGS::CyclePeriod;
    J1939ILSetMsgCycleTime(J1939::Sender::DM22, gCAN1DisturbancePeriod);
  }
}

on sysvar_update sysvar::IL_CAN1::NODES::N_Sender::MESSAGES::DM22::TIMINGS::SendOnce
{
  if (@this == 1)
  {
    SetBusContext(gILCAN1_BusContext);
    J1939ILSetMsgEvent(J1939::Sender::DM22);
  }
}

on sysvar_update sysvar::IL_CAN1::NODES::N_Sender::MESSAGES::DM24::TIMINGS::EnableCyclic
{
  if (@this == 1)
  {
    SetBusContext(gILCAN1_BusContext);
    J1939ILEnableMsg  (J1939::Sender::DM24);
  }
  else
  {
    SetBusContext(gILCAN1_BusContext);
    J1939ILDisableMsg (J1939::Sender::DM24);
  }
}

on sysvar_update sysvar::IL_CAN1::NODES::N_Sender::MESSAGES::DM24::TIMINGS::SetNormalCycle
{
  if (@this == 1 && @sysvar::IL_CAN1::NODES::N_Sender::MESSAGES::DM24::TIMINGS::EnableCyclic)
  {
    @sysvar::IL_CAN1::NODES::N_Sender::MESSAGES::DM24::TIMINGS::SelectedPeriod = 0;
  }
}

on sysvar_update sysvar::IL_CAN1::NODES::N_Sender::MESSAGES::DM24::TIMINGS::SetNewCycleContinously
{
  if (@this == 1 && @sysvar::IL_CAN1::NODES::N_Sender::MESSAGES::DM24::TIMINGS::EnableCyclic)
  {
    @sysvar::IL_CAN1::NODES::N_Sender::MESSAGES::DM24::TIMINGS::SelectedPeriod = -1;
  }
}

on sysvar_update sysvar::IL_CAN1::NODES::N_Sender::MESSAGES::DM24::TIMINGS::SelectedPeriod
{
  if (@this == 0 && @sysvar::IL_CAN1::NODES::N_Sender::MESSAGES::DM24::TIMINGS::EnableCyclic)
  {
    SetBusContext(gILCAN1_BusContext);
    gCAN1DisturbancePeriod = @sysvar::IL_CAN1::NODES::N_Sender::MESSAGES::DM24::TIMINGS::NormalCyclePeriod;
    J1939ILSetMsgCycleTime(J1939::Sender::DM24, 0);
  }
  else if (@this == 1 && @sysvar::IL_CAN1::NODES::N_Sender::MESSAGES::DM24::TIMINGS::EnableCyclic)
  {
    SetBusContext(gILCAN1_BusContext);
    gCAN1DisturbancePeriod = @sysvar::IL_CAN1::NODES::N_Sender::MESSAGES::DM24::TIMINGS::ActiveCyclePeriod;
    J1939ILSetMsgCycleTime(J1939::Sender::DM24, gCAN1DisturbancePeriod);
  }
  else if (@this == -1 && @sysvar::IL_CAN1::NODES::N_Sender::MESSAGES::DM24::TIMINGS::EnableCyclic)
  {
    SetBusContext(gILCAN1_BusContext);
    gCAN1DisturbancePeriod = @sysvar::IL_CAN1::NODES::N_Sender::MESSAGES::DM24::TIMINGS::CyclePeriod;
    J1939ILSetMsgCycleTime(J1939::Sender::DM24, gCAN1DisturbancePeriod);
  }
}

on sysvar_update sysvar::IL_CAN1::NODES::N_Sender::MESSAGES::DM24::TIMINGS::SendOnce
{
  if (@this == 1)
  {
    SetBusContext(gILCAN1_BusContext);
    J1939ILSetMsgEvent(J1939::Sender::DM24);
  }
}

on sysvar_update sysvar::IL_CAN1::NODES::N_Sender::MESSAGES::DM25::TIMINGS::EnableCyclic
{
  if (@this == 1)
  {
    SetBusContext(gILCAN1_BusContext);
    J1939ILEnableMsg  (J1939::Sender::DM25);
  }
  else
  {
    SetBusContext(gILCAN1_BusContext);
    J1939ILDisableMsg (J1939::Sender::DM25);
  }
}

on sysvar_update sysvar::IL_CAN1::NODES::N_Sender::MESSAGES::DM25::TIMINGS::SetNormalCycle
{
  if (@this == 1 && @sysvar::IL_CAN1::NODES::N_Sender::MESSAGES::DM25::TIMINGS::EnableCyclic)
  {
    @sysvar::IL_CAN1::NODES::N_Sender::MESSAGES::DM25::TIMINGS::SelectedPeriod = 0;
  }
}

on sysvar_update sysvar::IL_CAN1::NODES::N_Sender::MESSAGES::DM25::TIMINGS::SetNewCycleContinously
{
  if (@this == 1 && @sysvar::IL_CAN1::NODES::N_Sender::MESSAGES::DM25::TIMINGS::EnableCyclic)
  {
    @sysvar::IL_CAN1::NODES::N_Sender::MESSAGES::DM25::TIMINGS::SelectedPeriod = -1;
  }
}

on sysvar_update sysvar::IL_CAN1::NODES::N_Sender::MESSAGES::DM25::TIMINGS::SelectedPeriod
{
  if (@this == 0 && @sysvar::IL_CAN1::NODES::N_Sender::MESSAGES::DM25::TIMINGS::EnableCyclic)
  {
    SetBusContext(gILCAN1_BusContext);
    gCAN1DisturbancePeriod = @sysvar::IL_CAN1::NODES::N_Sender::MESSAGES::DM25::TIMINGS::NormalCyclePeriod;
    J1939ILSetMsgCycleTime(J1939::Sender::DM25, 0);
  }
  else if (@this == 1 && @sysvar::IL_CAN1::NODES::N_Sender::MESSAGES::DM25::TIMINGS::EnableCyclic)
  {
    SetBusContext(gILCAN1_BusContext);
    gCAN1DisturbancePeriod = @sysvar::IL_CAN1::NODES::N_Sender::MESSAGES::DM25::TIMINGS::ActiveCyclePeriod;
    J1939ILSetMsgCycleTime(J1939::Sender::DM25, gCAN1DisturbancePeriod);
  }
  else if (@this == -1 && @sysvar::IL_CAN1::NODES::N_Sender::MESSAGES::DM25::TIMINGS::EnableCyclic)
  {
    SetBusContext(gILCAN1_BusContext);
    gCAN1DisturbancePeriod = @sysvar::IL_CAN1::NODES::N_Sender::MESSAGES::DM25::TIMINGS::CyclePeriod;
    J1939ILSetMsgCycleTime(J1939::Sender::DM25, gCAN1DisturbancePeriod);
  }
}

on sysvar_update sysvar::IL_CAN1::NODES::N_Sender::MESSAGES::DM25::TIMINGS::SendOnce
{
  if (@this == 1)
  {
    SetBusContext(gILCAN1_BusContext);
    J1939ILSetMsgEvent(J1939::Sender::DM25);
  }
}

on sysvar_update sysvar::IL_CAN1::NODES::N_Sender::MESSAGES::DM3::TIMINGS::EnableCyclic
{
  if (@this == 1)
  {
    SetBusContext(gILCAN1_BusContext);
    J1939ILEnableMsg  (J1939::Sender::DM3);
  }
  else
  {
    SetBusContext(gILCAN1_BusContext);
    J1939ILDisableMsg (J1939::Sender::DM3);
  }
}

on sysvar_update sysvar::IL_CAN1::NODES::N_Sender::MESSAGES::DM3::TIMINGS::SetNormalCycle
{
  if (@this == 1 && @sysvar::IL_CAN1::NODES::N_Sender::MESSAGES::DM3::TIMINGS::EnableCyclic)
  {
    @sysvar::IL_CAN1::NODES::N_Sender::MESSAGES::DM3::TIMINGS::SelectedPeriod = 0;
  }
}

on sysvar_update sysvar::IL_CAN1::NODES::N_Sender::MESSAGES::DM3::TIMINGS::SetNewCycleContinously
{
  if (@this == 1 && @sysvar::IL_CAN1::NODES::N_Sender::MESSAGES::DM3::TIMINGS::EnableCyclic)
  {
    @sysvar::IL_CAN1::NODES::N_Sender::MESSAGES::DM3::TIMINGS::SelectedPeriod = -1;
  }
}

on sysvar_update sysvar::IL_CAN1::NODES::N_Sender::MESSAGES::DM3::TIMINGS::SelectedPeriod
{
  if (@this == 0 && @sysvar::IL_CAN1::NODES::N_Sender::MESSAGES::DM3::TIMINGS::EnableCyclic)
  {
    SetBusContext(gILCAN1_BusContext);
    gCAN1DisturbancePeriod = @sysvar::IL_CAN1::NODES::N_Sender::MESSAGES::DM3::TIMINGS::NormalCyclePeriod;
    J1939ILSetMsgCycleTime(J1939::Sender::DM3, 0);
  }
  else if (@this == 1 && @sysvar::IL_CAN1::NODES::N_Sender::MESSAGES::DM3::TIMINGS::EnableCyclic)
  {
    SetBusContext(gILCAN1_BusContext);
    gCAN1DisturbancePeriod = @sysvar::IL_CAN1::NODES::N_Sender::MESSAGES::DM3::TIMINGS::ActiveCyclePeriod;
    J1939ILSetMsgCycleTime(J1939::Sender::DM3, gCAN1DisturbancePeriod);
  }
  else if (@this == -1 && @sysvar::IL_CAN1::NODES::N_Sender::MESSAGES::DM3::TIMINGS::EnableCyclic)
  {
    SetBusContext(gILCAN1_BusContext);
    gCAN1DisturbancePeriod = @sysvar::IL_CAN1::NODES::N_Sender::MESSAGES::DM3::TIMINGS::CyclePeriod;
    J1939ILSetMsgCycleTime(J1939::Sender::DM3, gCAN1DisturbancePeriod);
  }
}

on sysvar_update sysvar::IL_CAN1::NODES::N_Sender::MESSAGES::DM3::TIMINGS::SendOnce
{
  if (@this == 1)
  {
    SetBusContext(gILCAN1_BusContext);
    J1939ILSetMsgEvent(J1939::Sender::DM3);
  }
}

on sysvar_update sysvar::IL_CAN1::NODES::N_Sender::MESSAGES::DM30::TIMINGS::EnableCyclic
{
  if (@this == 1)
  {
    SetBusContext(gILCAN1_BusContext);
    J1939ILEnableMsg  (J1939::Sender::DM30);
  }
  else
  {
    SetBusContext(gILCAN1_BusContext);
    J1939ILDisableMsg (J1939::Sender::DM30);
  }
}

on sysvar_update sysvar::IL_CAN1::NODES::N_Sender::MESSAGES::DM30::TIMINGS::SetNormalCycle
{
  if (@this == 1 && @sysvar::IL_CAN1::NODES::N_Sender::MESSAGES::DM30::TIMINGS::EnableCyclic)
  {
    @sysvar::IL_CAN1::NODES::N_Sender::MESSAGES::DM30::TIMINGS::SelectedPeriod = 0;
  }
}

on sysvar_update sysvar::IL_CAN1::NODES::N_Sender::MESSAGES::DM30::TIMINGS::SetNewCycleContinously
{
  if (@this == 1 && @sysvar::IL_CAN1::NODES::N_Sender::MESSAGES::DM30::TIMINGS::EnableCyclic)
  {
    @sysvar::IL_CAN1::NODES::N_Sender::MESSAGES::DM30::TIMINGS::SelectedPeriod = -1;
  }
}

on sysvar_update sysvar::IL_CAN1::NODES::N_Sender::MESSAGES::DM30::TIMINGS::SelectedPeriod
{
  if (@this == 0 && @sysvar::IL_CAN1::NODES::N_Sender::MESSAGES::DM30::TIMINGS::EnableCyclic)
  {
    SetBusContext(gILCAN1_BusContext);
    gCAN1DisturbancePeriod = @sysvar::IL_CAN1::NODES::N_Sender::MESSAGES::DM30::TIMINGS::NormalCyclePeriod;
    J1939ILSetMsgCycleTime(J1939::Sender::DM30, 0);
  }
  else if (@this == 1 && @sysvar::IL_CAN1::NODES::N_Sender::MESSAGES::DM30::TIMINGS::EnableCyclic)
  {
    SetBusContext(gILCAN1_BusContext);
    gCAN1DisturbancePeriod = @sysvar::IL_CAN1::NODES::N_Sender::MESSAGES::DM30::TIMINGS::ActiveCyclePeriod;
    J1939ILSetMsgCycleTime(J1939::Sender::DM30, gCAN1DisturbancePeriod);
  }
  else if (@this == -1 && @sysvar::IL_CAN1::NODES::N_Sender::MESSAGES::DM30::TIMINGS::EnableCyclic)
  {
    SetBusContext(gILCAN1_BusContext);
    gCAN1DisturbancePeriod = @sysvar::IL_CAN1::NODES::N_Sender::MESSAGES::DM30::TIMINGS::CyclePeriod;
    J1939ILSetMsgCycleTime(J1939::Sender::DM30, gCAN1DisturbancePeriod);
  }
}

on sysvar_update sysvar::IL_CAN1::NODES::N_Sender::MESSAGES::DM30::TIMINGS::SendOnce
{
  if (@this == 1)
  {
    SetBusContext(gILCAN1_BusContext);
    J1939ILSetMsgEvent(J1939::Sender::DM30);
  }
}

on sysvar_update sysvar::IL_CAN1::NODES::N_Sender::MESSAGES::DM4::TIMINGS::EnableCyclic
{
  if (@this == 1)
  {
    SetBusContext(gILCAN1_BusContext);
    J1939ILEnableMsg  (J1939::Sender::DM4);
  }
  else
  {
    SetBusContext(gILCAN1_BusContext);
    J1939ILDisableMsg (J1939::Sender::DM4);
  }
}

on sysvar_update sysvar::IL_CAN1::NODES::N_Sender::MESSAGES::DM4::TIMINGS::SetNormalCycle
{
  if (@this == 1 && @sysvar::IL_CAN1::NODES::N_Sender::MESSAGES::DM4::TIMINGS::EnableCyclic)
  {
    @sysvar::IL_CAN1::NODES::N_Sender::MESSAGES::DM4::TIMINGS::SelectedPeriod = 0;
  }
}

on sysvar_update sysvar::IL_CAN1::NODES::N_Sender::MESSAGES::DM4::TIMINGS::SetNewCycleContinously
{
  if (@this == 1 && @sysvar::IL_CAN1::NODES::N_Sender::MESSAGES::DM4::TIMINGS::EnableCyclic)
  {
    @sysvar::IL_CAN1::NODES::N_Sender::MESSAGES::DM4::TIMINGS::SelectedPeriod = -1;
  }
}

on sysvar_update sysvar::IL_CAN1::NODES::N_Sender::MESSAGES::DM4::TIMINGS::SelectedPeriod
{
  if (@this == 0 && @sysvar::IL_CAN1::NODES::N_Sender::MESSAGES::DM4::TIMINGS::EnableCyclic)
  {
    SetBusContext(gILCAN1_BusContext);
    gCAN1DisturbancePeriod = @sysvar::IL_CAN1::NODES::N_Sender::MESSAGES::DM4::TIMINGS::NormalCyclePeriod;
    J1939ILSetMsgCycleTime(J1939::Sender::DM4, 0);
  }
  else if (@this == 1 && @sysvar::IL_CAN1::NODES::N_Sender::MESSAGES::DM4::TIMINGS::EnableCyclic)
  {
    SetBusContext(gILCAN1_BusContext);
    gCAN1DisturbancePeriod = @sysvar::IL_CAN1::NODES::N_Sender::MESSAGES::DM4::TIMINGS::ActiveCyclePeriod;
    J1939ILSetMsgCycleTime(J1939::Sender::DM4, gCAN1DisturbancePeriod);
  }
  else if (@this == -1 && @sysvar::IL_CAN1::NODES::N_Sender::MESSAGES::DM4::TIMINGS::EnableCyclic)
  {
    SetBusContext(gILCAN1_BusContext);
    gCAN1DisturbancePeriod = @sysvar::IL_CAN1::NODES::N_Sender::MESSAGES::DM4::TIMINGS::CyclePeriod;
    J1939ILSetMsgCycleTime(J1939::Sender::DM4, gCAN1DisturbancePeriod);
  }
}

on sysvar_update sysvar::IL_CAN1::NODES::N_Sender::MESSAGES::DM4::TIMINGS::SendOnce
{
  if (@this == 1)
  {
    SetBusContext(gILCAN1_BusContext);
    J1939ILSetMsgEvent(J1939::Sender::DM4);
  }
}

on sysvar_update sysvar::IL_CAN1::NODES::N_Sender::MESSAGES::DM5::TIMINGS::EnableCyclic
{
  if (@this == 1)
  {
    SetBusContext(gILCAN1_BusContext);
    J1939ILEnableMsg  (J1939::Sender::DM5);
  }
  else
  {
    SetBusContext(gILCAN1_BusContext);
    J1939ILDisableMsg (J1939::Sender::DM5);
  }
}

on sysvar_update sysvar::IL_CAN1::NODES::N_Sender::MESSAGES::DM5::TIMINGS::SetNormalCycle
{
  if (@this == 1 && @sysvar::IL_CAN1::NODES::N_Sender::MESSAGES::DM5::TIMINGS::EnableCyclic)
  {
    @sysvar::IL_CAN1::NODES::N_Sender::MESSAGES::DM5::TIMINGS::SelectedPeriod = 0;
  }
}

on sysvar_update sysvar::IL_CAN1::NODES::N_Sender::MESSAGES::DM5::TIMINGS::SetNewCycleContinously
{
  if (@this == 1 && @sysvar::IL_CAN1::NODES::N_Sender::MESSAGES::DM5::TIMINGS::EnableCyclic)
  {
    @sysvar::IL_CAN1::NODES::N_Sender::MESSAGES::DM5::TIMINGS::SelectedPeriod = -1;
  }
}

on sysvar_update sysvar::IL_CAN1::NODES::N_Sender::MESSAGES::DM5::TIMINGS::SelectedPeriod
{
  if (@this == 0 && @sysvar::IL_CAN1::NODES::N_Sender::MESSAGES::DM5::TIMINGS::EnableCyclic)
  {
    SetBusContext(gILCAN1_BusContext);
    gCAN1DisturbancePeriod = @sysvar::IL_CAN1::NODES::N_Sender::MESSAGES::DM5::TIMINGS::NormalCyclePeriod;
    J1939ILSetMsgCycleTime(J1939::Sender::DM5, 0);
  }
  else if (@this == 1 && @sysvar::IL_CAN1::NODES::N_Sender::MESSAGES::DM5::TIMINGS::EnableCyclic)
  {
    SetBusContext(gILCAN1_BusContext);
    gCAN1DisturbancePeriod = @sysvar::IL_CAN1::NODES::N_Sender::MESSAGES::DM5::TIMINGS::ActiveCyclePeriod;
    J1939ILSetMsgCycleTime(J1939::Sender::DM5, gCAN1DisturbancePeriod);
  }
  else if (@this == -1 && @sysvar::IL_CAN1::NODES::N_Sender::MESSAGES::DM5::TIMINGS::EnableCyclic)
  {
    SetBusContext(gILCAN1_BusContext);
    gCAN1DisturbancePeriod = @sysvar::IL_CAN1::NODES::N_Sender::MESSAGES::DM5::TIMINGS::CyclePeriod;
    J1939ILSetMsgCycleTime(J1939::Sender::DM5, gCAN1DisturbancePeriod);
  }
}

on sysvar_update sysvar::IL_CAN1::NODES::N_Sender::MESSAGES::DM5::TIMINGS::SendOnce
{
  if (@this == 1)
  {
    SetBusContext(gILCAN1_BusContext);
    J1939ILSetMsgEvent(J1939::Sender::DM5);
  }
}

on sysvar_update sysvar::IL_CAN1::NODES::N_Sender::MESSAGES::DM6::TIMINGS::EnableCyclic
{
  if (@this == 1)
  {
    SetBusContext(gILCAN1_BusContext);
    J1939ILEnableMsg  (J1939::Sender::DM6);
  }
  else
  {
    SetBusContext(gILCAN1_BusContext);
    J1939ILDisableMsg (J1939::Sender::DM6);
  }
}

on sysvar_update sysvar::IL_CAN1::NODES::N_Sender::MESSAGES::DM6::TIMINGS::SetNormalCycle
{
  if (@this == 1 && @sysvar::IL_CAN1::NODES::N_Sender::MESSAGES::DM6::TIMINGS::EnableCyclic)
  {
    @sysvar::IL_CAN1::NODES::N_Sender::MESSAGES::DM6::TIMINGS::SelectedPeriod = 0;
  }
}

on sysvar_update sysvar::IL_CAN1::NODES::N_Sender::MESSAGES::DM6::TIMINGS::SetNewCycleContinously
{
  if (@this == 1 && @sysvar::IL_CAN1::NODES::N_Sender::MESSAGES::DM6::TIMINGS::EnableCyclic)
  {
    @sysvar::IL_CAN1::NODES::N_Sender::MESSAGES::DM6::TIMINGS::SelectedPeriod = -1;
  }
}

on sysvar_update sysvar::IL_CAN1::NODES::N_Sender::MESSAGES::DM6::TIMINGS::SelectedPeriod
{
  if (@this == 0 && @sysvar::IL_CAN1::NODES::N_Sender::MESSAGES::DM6::TIMINGS::EnableCyclic)
  {
    SetBusContext(gILCAN1_BusContext);
    gCAN1DisturbancePeriod = @sysvar::IL_CAN1::NODES::N_Sender::MESSAGES::DM6::TIMINGS::NormalCyclePeriod;
    J1939ILSetMsgCycleTime(J1939::Sender::DM6, 0);
  }
  else if (@this == 1 && @sysvar::IL_CAN1::NODES::N_Sender::MESSAGES::DM6::TIMINGS::EnableCyclic)
  {
    SetBusContext(gILCAN1_BusContext);
    gCAN1DisturbancePeriod = @sysvar::IL_CAN1::NODES::N_Sender::MESSAGES::DM6::TIMINGS::ActiveCyclePeriod;
    J1939ILSetMsgCycleTime(J1939::Sender::DM6, gCAN1DisturbancePeriod);
  }
  else if (@this == -1 && @sysvar::IL_CAN1::NODES::N_Sender::MESSAGES::DM6::TIMINGS::EnableCyclic)
  {
    SetBusContext(gILCAN1_BusContext);
    gCAN1DisturbancePeriod = @sysvar::IL_CAN1::NODES::N_Sender::MESSAGES::DM6::TIMINGS::CyclePeriod;
    J1939ILSetMsgCycleTime(J1939::Sender::DM6, gCAN1DisturbancePeriod);
  }
}

on sysvar_update sysvar::IL_CAN1::NODES::N_Sender::MESSAGES::DM6::TIMINGS::SendOnce
{
  if (@this == 1)
  {
    SetBusContext(gILCAN1_BusContext);
    J1939ILSetMsgEvent(J1939::Sender::DM6);
  }
}

on sysvar_update sysvar::IL_CAN1::NODES::N_Sender::MESSAGES::DM7::TIMINGS::EnableCyclic
{
  if (@this == 1)
  {
    SetBusContext(gILCAN1_BusContext);
    J1939ILEnableMsg  (J1939::Sender::DM7);
  }
  else
  {
    SetBusContext(gILCAN1_BusContext);
    J1939ILDisableMsg (J1939::Sender::DM7);
  }
}

on sysvar_update sysvar::IL_CAN1::NODES::N_Sender::MESSAGES::DM7::TIMINGS::SetNormalCycle
{
  if (@this == 1 && @sysvar::IL_CAN1::NODES::N_Sender::MESSAGES::DM7::TIMINGS::EnableCyclic)
  {
    @sysvar::IL_CAN1::NODES::N_Sender::MESSAGES::DM7::TIMINGS::SelectedPeriod = 0;
  }
}

on sysvar_update sysvar::IL_CAN1::NODES::N_Sender::MESSAGES::DM7::TIMINGS::SetNewCycleContinously
{
  if (@this == 1 && @sysvar::IL_CAN1::NODES::N_Sender::MESSAGES::DM7::TIMINGS::EnableCyclic)
  {
    @sysvar::IL_CAN1::NODES::N_Sender::MESSAGES::DM7::TIMINGS::SelectedPeriod = -1;
  }
}

on sysvar_update sysvar::IL_CAN1::NODES::N_Sender::MESSAGES::DM7::TIMINGS::SelectedPeriod
{
  if (@this == 0 && @sysvar::IL_CAN1::NODES::N_Sender::MESSAGES::DM7::TIMINGS::EnableCyclic)
  {
    SetBusContext(gILCAN1_BusContext);
    gCAN1DisturbancePeriod = @sysvar::IL_CAN1::NODES::N_Sender::MESSAGES::DM7::TIMINGS::NormalCyclePeriod;
    J1939ILSetMsgCycleTime(J1939::Sender::DM7, 0);
  }
  else if (@this == 1 && @sysvar::IL_CAN1::NODES::N_Sender::MESSAGES::DM7::TIMINGS::EnableCyclic)
  {
    SetBusContext(gILCAN1_BusContext);
    gCAN1DisturbancePeriod = @sysvar::IL_CAN1::NODES::N_Sender::MESSAGES::DM7::TIMINGS::ActiveCyclePeriod;
    J1939ILSetMsgCycleTime(J1939::Sender::DM7, gCAN1DisturbancePeriod);
  }
  else if (@this == -1 && @sysvar::IL_CAN1::NODES::N_Sender::MESSAGES::DM7::TIMINGS::EnableCyclic)
  {
    SetBusContext(gILCAN1_BusContext);
    gCAN1DisturbancePeriod = @sysvar::IL_CAN1::NODES::N_Sender::MESSAGES::DM7::TIMINGS::CyclePeriod;
    J1939ILSetMsgCycleTime(J1939::Sender::DM7, gCAN1DisturbancePeriod);
  }
}

on sysvar_update sysvar::IL_CAN1::NODES::N_Sender::MESSAGES::DM7::TIMINGS::SendOnce
{
  if (@this == 1)
  {
    SetBusContext(gILCAN1_BusContext);
    J1939ILSetMsgEvent(J1939::Sender::DM7);
  }
}

on sysvar_update sysvar::IL_CAN1::NODES::N_Sender::MESSAGES::DM8::TIMINGS::EnableCyclic
{
  if (@this == 1)
  {
    SetBusContext(gILCAN1_BusContext);
    J1939ILEnableMsg  (J1939::Sender::DM8);
  }
  else
  {
    SetBusContext(gILCAN1_BusContext);
    J1939ILDisableMsg (J1939::Sender::DM8);
  }
}

on sysvar_update sysvar::IL_CAN1::NODES::N_Sender::MESSAGES::DM8::TIMINGS::SetNormalCycle
{
  if (@this == 1 && @sysvar::IL_CAN1::NODES::N_Sender::MESSAGES::DM8::TIMINGS::EnableCyclic)
  {
    @sysvar::IL_CAN1::NODES::N_Sender::MESSAGES::DM8::TIMINGS::SelectedPeriod = 0;
  }
}

on sysvar_update sysvar::IL_CAN1::NODES::N_Sender::MESSAGES::DM8::TIMINGS::SetNewCycleContinously
{
  if (@this == 1 && @sysvar::IL_CAN1::NODES::N_Sender::MESSAGES::DM8::TIMINGS::EnableCyclic)
  {
    @sysvar::IL_CAN1::NODES::N_Sender::MESSAGES::DM8::TIMINGS::SelectedPeriod = -1;
  }
}

on sysvar_update sysvar::IL_CAN1::NODES::N_Sender::MESSAGES::DM8::TIMINGS::SelectedPeriod
{
  if (@this == 0 && @sysvar::IL_CAN1::NODES::N_Sender::MESSAGES::DM8::TIMINGS::EnableCyclic)
  {
    SetBusContext(gILCAN1_BusContext);
    gCAN1DisturbancePeriod = @sysvar::IL_CAN1::NODES::N_Sender::MESSAGES::DM8::TIMINGS::NormalCyclePeriod;
    J1939ILSetMsgCycleTime(J1939::Sender::DM8, 0);
  }
  else if (@this == 1 && @sysvar::IL_CAN1::NODES::N_Sender::MESSAGES::DM8::TIMINGS::EnableCyclic)
  {
    SetBusContext(gILCAN1_BusContext);
    gCAN1DisturbancePeriod = @sysvar::IL_CAN1::NODES::N_Sender::MESSAGES::DM8::TIMINGS::ActiveCyclePeriod;
    J1939ILSetMsgCycleTime(J1939::Sender::DM8, gCAN1DisturbancePeriod);
  }
  else if (@this == -1 && @sysvar::IL_CAN1::NODES::N_Sender::MESSAGES::DM8::TIMINGS::EnableCyclic)
  {
    SetBusContext(gILCAN1_BusContext);
    gCAN1DisturbancePeriod = @sysvar::IL_CAN1::NODES::N_Sender::MESSAGES::DM8::TIMINGS::CyclePeriod;
    J1939ILSetMsgCycleTime(J1939::Sender::DM8, gCAN1DisturbancePeriod);
  }
}

on sysvar_update sysvar::IL_CAN1::NODES::N_Sender::MESSAGES::DM8::TIMINGS::SendOnce
{
  if (@this == 1)
  {
    SetBusContext(gILCAN1_BusContext);
    J1939ILSetMsgEvent(J1939::Sender::DM8);
  }
}

on sysvar_update sysvar::IL_CAN1::NODES::N_Sender::MESSAGES::EBC1::TIMINGS::EnableCyclic
{
  if (@this == 1)
  {
    SetBusContext(gILCAN1_BusContext);
    J1939ILEnableMsg  (J1939::Sender::EBC1);
  }
  else
  {
    SetBusContext(gILCAN1_BusContext);
    J1939ILDisableMsg (J1939::Sender::EBC1);
  }
}

on sysvar_update sysvar::IL_CAN1::NODES::N_Sender::MESSAGES::EBC1::TIMINGS::SetNormalCycle
{
  if (@this == 1 && @sysvar::IL_CAN1::NODES::N_Sender::MESSAGES::EBC1::TIMINGS::EnableCyclic)
  {
    @sysvar::IL_CAN1::NODES::N_Sender::MESSAGES::EBC1::TIMINGS::SelectedPeriod = 0;
  }
}

on sysvar_update sysvar::IL_CAN1::NODES::N_Sender::MESSAGES::EBC1::TIMINGS::SetNewCycleContinously
{
  if (@this == 1 && @sysvar::IL_CAN1::NODES::N_Sender::MESSAGES::EBC1::TIMINGS::EnableCyclic)
  {
    @sysvar::IL_CAN1::NODES::N_Sender::MESSAGES::EBC1::TIMINGS::SelectedPeriod = -1;
  }
}

on sysvar_update sysvar::IL_CAN1::NODES::N_Sender::MESSAGES::EBC1::TIMINGS::SelectedPeriod
{
  if (@this == 0 && @sysvar::IL_CAN1::NODES::N_Sender::MESSAGES::EBC1::TIMINGS::EnableCyclic)
  {
    SetBusContext(gILCAN1_BusContext);
    gCAN1DisturbancePeriod = @sysvar::IL_CAN1::NODES::N_Sender::MESSAGES::EBC1::TIMINGS::NormalCyclePeriod;
    J1939ILSetMsgCycleTime(J1939::Sender::EBC1, 100);
  }
  else if (@this == 1 && @sysvar::IL_CAN1::NODES::N_Sender::MESSAGES::EBC1::TIMINGS::EnableCyclic)
  {
    SetBusContext(gILCAN1_BusContext);
    gCAN1DisturbancePeriod = @sysvar::IL_CAN1::NODES::N_Sender::MESSAGES::EBC1::TIMINGS::ActiveCyclePeriod;
    J1939ILSetMsgCycleTime(J1939::Sender::EBC1, gCAN1DisturbancePeriod);
  }
  else if (@this == -1 && @sysvar::IL_CAN1::NODES::N_Sender::MESSAGES::EBC1::TIMINGS::EnableCyclic)
  {
    SetBusContext(gILCAN1_BusContext);
    gCAN1DisturbancePeriod = @sysvar::IL_CAN1::NODES::N_Sender::MESSAGES::EBC1::TIMINGS::CyclePeriod;
    J1939ILSetMsgCycleTime(J1939::Sender::EBC1, gCAN1DisturbancePeriod);
  }
}

on sysvar_update sysvar::IL_CAN1::NODES::N_Sender::MESSAGES::EBC1::TIMINGS::SendOnce
{
  if (@this == 1)
  {
    SetBusContext(gILCAN1_BusContext);
    J1939ILSetMsgEvent(J1939::Sender::EBC1);
  }
}

on sysvar_update sysvar::IL_CAN1::NODES::N_Sender::MESSAGES::EBC2::TIMINGS::EnableCyclic
{
  if (@this == 1)
  {
    SetBusContext(gILCAN1_BusContext);
    J1939ILEnableMsg  (J1939::Sender::EBC2);
  }
  else
  {
    SetBusContext(gILCAN1_BusContext);
    J1939ILDisableMsg (J1939::Sender::EBC2);
  }
}

on sysvar_update sysvar::IL_CAN1::NODES::N_Sender::MESSAGES::EBC2::TIMINGS::SetNormalCycle
{
  if (@this == 1 && @sysvar::IL_CAN1::NODES::N_Sender::MESSAGES::EBC2::TIMINGS::EnableCyclic)
  {
    @sysvar::IL_CAN1::NODES::N_Sender::MESSAGES::EBC2::TIMINGS::SelectedPeriod = 0;
  }
}

on sysvar_update sysvar::IL_CAN1::NODES::N_Sender::MESSAGES::EBC2::TIMINGS::SetNewCycleContinously
{
  if (@this == 1 && @sysvar::IL_CAN1::NODES::N_Sender::MESSAGES::EBC2::TIMINGS::EnableCyclic)
  {
    @sysvar::IL_CAN1::NODES::N_Sender::MESSAGES::EBC2::TIMINGS::SelectedPeriod = -1;
  }
}

on sysvar_update sysvar::IL_CAN1::NODES::N_Sender::MESSAGES::EBC2::TIMINGS::SelectedPeriod
{
  if (@this == 0 && @sysvar::IL_CAN1::NODES::N_Sender::MESSAGES::EBC2::TIMINGS::EnableCyclic)
  {
    SetBusContext(gILCAN1_BusContext);
    gCAN1DisturbancePeriod = @sysvar::IL_CAN1::NODES::N_Sender::MESSAGES::EBC2::TIMINGS::NormalCyclePeriod;
    J1939ILSetMsgCycleTime(J1939::Sender::EBC2, 100);
  }
  else if (@this == 1 && @sysvar::IL_CAN1::NODES::N_Sender::MESSAGES::EBC2::TIMINGS::EnableCyclic)
  {
    SetBusContext(gILCAN1_BusContext);
    gCAN1DisturbancePeriod = @sysvar::IL_CAN1::NODES::N_Sender::MESSAGES::EBC2::TIMINGS::ActiveCyclePeriod;
    J1939ILSetMsgCycleTime(J1939::Sender::EBC2, gCAN1DisturbancePeriod);
  }
  else if (@this == -1 && @sysvar::IL_CAN1::NODES::N_Sender::MESSAGES::EBC2::TIMINGS::EnableCyclic)
  {
    SetBusContext(gILCAN1_BusContext);
    gCAN1DisturbancePeriod = @sysvar::IL_CAN1::NODES::N_Sender::MESSAGES::EBC2::TIMINGS::CyclePeriod;
    J1939ILSetMsgCycleTime(J1939::Sender::EBC2, gCAN1DisturbancePeriod);
  }
}

on sysvar_update sysvar::IL_CAN1::NODES::N_Sender::MESSAGES::EBC2::TIMINGS::SendOnce
{
  if (@this == 1)
  {
    SetBusContext(gILCAN1_BusContext);
    J1939ILSetMsgEvent(J1939::Sender::EBC2);
  }
}

on sysvar_update sysvar::IL_CAN1::NODES::N_Sender::MESSAGES::EBC3::TIMINGS::EnableCyclic
{
  if (@this == 1)
  {
    SetBusContext(gILCAN1_BusContext);
    J1939ILEnableMsg  (J1939::Sender::EBC3);
  }
  else
  {
    SetBusContext(gILCAN1_BusContext);
    J1939ILDisableMsg (J1939::Sender::EBC3);
  }
}

on sysvar_update sysvar::IL_CAN1::NODES::N_Sender::MESSAGES::EBC3::TIMINGS::SetNormalCycle
{
  if (@this == 1 && @sysvar::IL_CAN1::NODES::N_Sender::MESSAGES::EBC3::TIMINGS::EnableCyclic)
  {
    @sysvar::IL_CAN1::NODES::N_Sender::MESSAGES::EBC3::TIMINGS::SelectedPeriod = 0;
  }
}

on sysvar_update sysvar::IL_CAN1::NODES::N_Sender::MESSAGES::EBC3::TIMINGS::SetNewCycleContinously
{
  if (@this == 1 && @sysvar::IL_CAN1::NODES::N_Sender::MESSAGES::EBC3::TIMINGS::EnableCyclic)
  {
    @sysvar::IL_CAN1::NODES::N_Sender::MESSAGES::EBC3::TIMINGS::SelectedPeriod = -1;
  }
}

on sysvar_update sysvar::IL_CAN1::NODES::N_Sender::MESSAGES::EBC3::TIMINGS::SelectedPeriod
{
  if (@this == 0 && @sysvar::IL_CAN1::NODES::N_Sender::MESSAGES::EBC3::TIMINGS::EnableCyclic)
  {
    SetBusContext(gILCAN1_BusContext);
    gCAN1DisturbancePeriod = @sysvar::IL_CAN1::NODES::N_Sender::MESSAGES::EBC3::TIMINGS::NormalCyclePeriod;
    J1939ILSetMsgCycleTime(J1939::Sender::EBC3, 100);
  }
  else if (@this == 1 && @sysvar::IL_CAN1::NODES::N_Sender::MESSAGES::EBC3::TIMINGS::EnableCyclic)
  {
    SetBusContext(gILCAN1_BusContext);
    gCAN1DisturbancePeriod = @sysvar::IL_CAN1::NODES::N_Sender::MESSAGES::EBC3::TIMINGS::ActiveCyclePeriod;
    J1939ILSetMsgCycleTime(J1939::Sender::EBC3, gCAN1DisturbancePeriod);
  }
  else if (@this == -1 && @sysvar::IL_CAN1::NODES::N_Sender::MESSAGES::EBC3::TIMINGS::EnableCyclic)
  {
    SetBusContext(gILCAN1_BusContext);
    gCAN1DisturbancePeriod = @sysvar::IL_CAN1::NODES::N_Sender::MESSAGES::EBC3::TIMINGS::CyclePeriod;
    J1939ILSetMsgCycleTime(J1939::Sender::EBC3, gCAN1DisturbancePeriod);
  }
}

on sysvar_update sysvar::IL_CAN1::NODES::N_Sender::MESSAGES::EBC3::TIMINGS::SendOnce
{
  if (@this == 1)
  {
    SetBusContext(gILCAN1_BusContext);
    J1939ILSetMsgEvent(J1939::Sender::EBC3);
  }
}

on sysvar_update sysvar::IL_CAN1::NODES::N_Sender::MESSAGES::EBC4::TIMINGS::EnableCyclic
{
  if (@this == 1)
  {
    SetBusContext(gILCAN1_BusContext);
    J1939ILEnableMsg  (J1939::Sender::EBC4);
  }
  else
  {
    SetBusContext(gILCAN1_BusContext);
    J1939ILDisableMsg (J1939::Sender::EBC4);
  }
}

on sysvar_update sysvar::IL_CAN1::NODES::N_Sender::MESSAGES::EBC4::TIMINGS::SetNormalCycle
{
  if (@this == 1 && @sysvar::IL_CAN1::NODES::N_Sender::MESSAGES::EBC4::TIMINGS::EnableCyclic)
  {
    @sysvar::IL_CAN1::NODES::N_Sender::MESSAGES::EBC4::TIMINGS::SelectedPeriod = 0;
  }
}

on sysvar_update sysvar::IL_CAN1::NODES::N_Sender::MESSAGES::EBC4::TIMINGS::SetNewCycleContinously
{
  if (@this == 1 && @sysvar::IL_CAN1::NODES::N_Sender::MESSAGES::EBC4::TIMINGS::EnableCyclic)
  {
    @sysvar::IL_CAN1::NODES::N_Sender::MESSAGES::EBC4::TIMINGS::SelectedPeriod = -1;
  }
}

on sysvar_update sysvar::IL_CAN1::NODES::N_Sender::MESSAGES::EBC4::TIMINGS::SelectedPeriod
{
  if (@this == 0 && @sysvar::IL_CAN1::NODES::N_Sender::MESSAGES::EBC4::TIMINGS::EnableCyclic)
  {
    SetBusContext(gILCAN1_BusContext);
    gCAN1DisturbancePeriod = @sysvar::IL_CAN1::NODES::N_Sender::MESSAGES::EBC4::TIMINGS::NormalCyclePeriod;
    J1939ILSetMsgCycleTime(J1939::Sender::EBC4, 0);
  }
  else if (@this == 1 && @sysvar::IL_CAN1::NODES::N_Sender::MESSAGES::EBC4::TIMINGS::EnableCyclic)
  {
    SetBusContext(gILCAN1_BusContext);
    gCAN1DisturbancePeriod = @sysvar::IL_CAN1::NODES::N_Sender::MESSAGES::EBC4::TIMINGS::ActiveCyclePeriod;
    J1939ILSetMsgCycleTime(J1939::Sender::EBC4, gCAN1DisturbancePeriod);
  }
  else if (@this == -1 && @sysvar::IL_CAN1::NODES::N_Sender::MESSAGES::EBC4::TIMINGS::EnableCyclic)
  {
    SetBusContext(gILCAN1_BusContext);
    gCAN1DisturbancePeriod = @sysvar::IL_CAN1::NODES::N_Sender::MESSAGES::EBC4::TIMINGS::CyclePeriod;
    J1939ILSetMsgCycleTime(J1939::Sender::EBC4, gCAN1DisturbancePeriod);
  }
}

on sysvar_update sysvar::IL_CAN1::NODES::N_Sender::MESSAGES::EBC4::TIMINGS::SendOnce
{
  if (@this == 1)
  {
    SetBusContext(gILCAN1_BusContext);
    J1939ILSetMsgEvent(J1939::Sender::EBC4);
  }
}

on sysvar_update sysvar::IL_CAN1::NODES::N_Sender::MESSAGES::EBC5::TIMINGS::EnableCyclic
{
  if (@this == 1)
  {
    SetBusContext(gILCAN1_BusContext);
    J1939ILEnableMsg  (J1939::Sender::EBC5);
  }
  else
  {
    SetBusContext(gILCAN1_BusContext);
    J1939ILDisableMsg (J1939::Sender::EBC5);
  }
}

on sysvar_update sysvar::IL_CAN1::NODES::N_Sender::MESSAGES::EBC5::TIMINGS::SetNormalCycle
{
  if (@this == 1 && @sysvar::IL_CAN1::NODES::N_Sender::MESSAGES::EBC5::TIMINGS::EnableCyclic)
  {
    @sysvar::IL_CAN1::NODES::N_Sender::MESSAGES::EBC5::TIMINGS::SelectedPeriod = 0;
  }
}

on sysvar_update sysvar::IL_CAN1::NODES::N_Sender::MESSAGES::EBC5::TIMINGS::SetNewCycleContinously
{
  if (@this == 1 && @sysvar::IL_CAN1::NODES::N_Sender::MESSAGES::EBC5::TIMINGS::EnableCyclic)
  {
    @sysvar::IL_CAN1::NODES::N_Sender::MESSAGES::EBC5::TIMINGS::SelectedPeriod = -1;
  }
}

on sysvar_update sysvar::IL_CAN1::NODES::N_Sender::MESSAGES::EBC5::TIMINGS::SelectedPeriod
{
  if (@this == 0 && @sysvar::IL_CAN1::NODES::N_Sender::MESSAGES::EBC5::TIMINGS::EnableCyclic)
  {
    SetBusContext(gILCAN1_BusContext);
    gCAN1DisturbancePeriod = @sysvar::IL_CAN1::NODES::N_Sender::MESSAGES::EBC5::TIMINGS::NormalCyclePeriod;
    J1939ILSetMsgCycleTime(J1939::Sender::EBC5, 100);
  }
  else if (@this == 1 && @sysvar::IL_CAN1::NODES::N_Sender::MESSAGES::EBC5::TIMINGS::EnableCyclic)
  {
    SetBusContext(gILCAN1_BusContext);
    gCAN1DisturbancePeriod = @sysvar::IL_CAN1::NODES::N_Sender::MESSAGES::EBC5::TIMINGS::ActiveCyclePeriod;
    J1939ILSetMsgCycleTime(J1939::Sender::EBC5, gCAN1DisturbancePeriod);
  }
  else if (@this == -1 && @sysvar::IL_CAN1::NODES::N_Sender::MESSAGES::EBC5::TIMINGS::EnableCyclic)
  {
    SetBusContext(gILCAN1_BusContext);
    gCAN1DisturbancePeriod = @sysvar::IL_CAN1::NODES::N_Sender::MESSAGES::EBC5::TIMINGS::CyclePeriod;
    J1939ILSetMsgCycleTime(J1939::Sender::EBC5, gCAN1DisturbancePeriod);
  }
}

on sysvar_update sysvar::IL_CAN1::NODES::N_Sender::MESSAGES::EBC5::TIMINGS::SendOnce
{
  if (@this == 1)
  {
    SetBusContext(gILCAN1_BusContext);
    J1939ILSetMsgEvent(J1939::Sender::EBC5);
  }
}

on sysvar_update sysvar::IL_CAN1::NODES::N_Sender::MESSAGES::EC::TIMINGS::EnableCyclic
{
  if (@this == 1)
  {
    SetBusContext(gILCAN1_BusContext);
    J1939ILEnableMsg  (J1939::Sender::EC);
  }
  else
  {
    SetBusContext(gILCAN1_BusContext);
    J1939ILDisableMsg (J1939::Sender::EC);
  }
}

on sysvar_update sysvar::IL_CAN1::NODES::N_Sender::MESSAGES::EC::TIMINGS::SetNormalCycle
{
  if (@this == 1 && @sysvar::IL_CAN1::NODES::N_Sender::MESSAGES::EC::TIMINGS::EnableCyclic)
  {
    @sysvar::IL_CAN1::NODES::N_Sender::MESSAGES::EC::TIMINGS::SelectedPeriod = 0;
  }
}

on sysvar_update sysvar::IL_CAN1::NODES::N_Sender::MESSAGES::EC::TIMINGS::SetNewCycleContinously
{
  if (@this == 1 && @sysvar::IL_CAN1::NODES::N_Sender::MESSAGES::EC::TIMINGS::EnableCyclic)
  {
    @sysvar::IL_CAN1::NODES::N_Sender::MESSAGES::EC::TIMINGS::SelectedPeriod = -1;
  }
}

on sysvar_update sysvar::IL_CAN1::NODES::N_Sender::MESSAGES::EC::TIMINGS::SelectedPeriod
{
  if (@this == 0 && @sysvar::IL_CAN1::NODES::N_Sender::MESSAGES::EC::TIMINGS::EnableCyclic)
  {
    SetBusContext(gILCAN1_BusContext);
    gCAN1DisturbancePeriod = @sysvar::IL_CAN1::NODES::N_Sender::MESSAGES::EC::TIMINGS::NormalCyclePeriod;
    J1939ILSetMsgCycleTime(J1939::Sender::EC, 0);
  }
  else if (@this == 1 && @sysvar::IL_CAN1::NODES::N_Sender::MESSAGES::EC::TIMINGS::EnableCyclic)
  {
    SetBusContext(gILCAN1_BusContext);
    gCAN1DisturbancePeriod = @sysvar::IL_CAN1::NODES::N_Sender::MESSAGES::EC::TIMINGS::ActiveCyclePeriod;
    J1939ILSetMsgCycleTime(J1939::Sender::EC, gCAN1DisturbancePeriod);
  }
  else if (@this == -1 && @sysvar::IL_CAN1::NODES::N_Sender::MESSAGES::EC::TIMINGS::EnableCyclic)
  {
    SetBusContext(gILCAN1_BusContext);
    gCAN1DisturbancePeriod = @sysvar::IL_CAN1::NODES::N_Sender::MESSAGES::EC::TIMINGS::CyclePeriod;
    J1939ILSetMsgCycleTime(J1939::Sender::EC, gCAN1DisturbancePeriod);
  }
}

on sysvar_update sysvar::IL_CAN1::NODES::N_Sender::MESSAGES::EC::TIMINGS::SendOnce
{
  if (@this == 1)
  {
    SetBusContext(gILCAN1_BusContext);
    J1939ILSetMsgEvent(J1939::Sender::EC);
  }
}

on sysvar_update sysvar::IL_CAN1::NODES::N_Sender::MESSAGES::ECUID::TIMINGS::EnableCyclic
{
  if (@this == 1)
  {
    SetBusContext(gILCAN1_BusContext);
    J1939ILEnableMsg  (J1939::Sender::ECUID);
  }
  else
  {
    SetBusContext(gILCAN1_BusContext);
    J1939ILDisableMsg (J1939::Sender::ECUID);
  }
}

on sysvar_update sysvar::IL_CAN1::NODES::N_Sender::MESSAGES::ECUID::TIMINGS::SetNormalCycle
{
  if (@this == 1 && @sysvar::IL_CAN1::NODES::N_Sender::MESSAGES::ECUID::TIMINGS::EnableCyclic)
  {
    @sysvar::IL_CAN1::NODES::N_Sender::MESSAGES::ECUID::TIMINGS::SelectedPeriod = 0;
  }
}

on sysvar_update sysvar::IL_CAN1::NODES::N_Sender::MESSAGES::ECUID::TIMINGS::SetNewCycleContinously
{
  if (@this == 1 && @sysvar::IL_CAN1::NODES::N_Sender::MESSAGES::ECUID::TIMINGS::EnableCyclic)
  {
    @sysvar::IL_CAN1::NODES::N_Sender::MESSAGES::ECUID::TIMINGS::SelectedPeriod = -1;
  }
}

on sysvar_update sysvar::IL_CAN1::NODES::N_Sender::MESSAGES::ECUID::TIMINGS::SelectedPeriod
{
  if (@this == 0 && @sysvar::IL_CAN1::NODES::N_Sender::MESSAGES::ECUID::TIMINGS::EnableCyclic)
  {
    SetBusContext(gILCAN1_BusContext);
    gCAN1DisturbancePeriod = @sysvar::IL_CAN1::NODES::N_Sender::MESSAGES::ECUID::TIMINGS::NormalCyclePeriod;
    J1939ILSetMsgCycleTime(J1939::Sender::ECUID, 0);
  }
  else if (@this == 1 && @sysvar::IL_CAN1::NODES::N_Sender::MESSAGES::ECUID::TIMINGS::EnableCyclic)
  {
    SetBusContext(gILCAN1_BusContext);
    gCAN1DisturbancePeriod = @sysvar::IL_CAN1::NODES::N_Sender::MESSAGES::ECUID::TIMINGS::ActiveCyclePeriod;
    J1939ILSetMsgCycleTime(J1939::Sender::ECUID, gCAN1DisturbancePeriod);
  }
  else if (@this == -1 && @sysvar::IL_CAN1::NODES::N_Sender::MESSAGES::ECUID::TIMINGS::EnableCyclic)
  {
    SetBusContext(gILCAN1_BusContext);
    gCAN1DisturbancePeriod = @sysvar::IL_CAN1::NODES::N_Sender::MESSAGES::ECUID::TIMINGS::CyclePeriod;
    J1939ILSetMsgCycleTime(J1939::Sender::ECUID, gCAN1DisturbancePeriod);
  }
}

on sysvar_update sysvar::IL_CAN1::NODES::N_Sender::MESSAGES::ECUID::TIMINGS::SendOnce
{
  if (@this == 1)
  {
    SetBusContext(gILCAN1_BusContext);
    J1939ILSetMsgEvent(J1939::Sender::ECUID);
  }
}

on sysvar_update sysvar::IL_CAN1::NODES::N_Sender::MESSAGES::EEC1::TIMINGS::EnableCyclic
{
  if (@this == 1)
  {
    SetBusContext(gILCAN1_BusContext);
    J1939ILEnableMsg  (J1939::Sender::EEC1);
  }
  else
  {
    SetBusContext(gILCAN1_BusContext);
    J1939ILDisableMsg (J1939::Sender::EEC1);
  }
}

on sysvar_update sysvar::IL_CAN1::NODES::N_Sender::MESSAGES::EEC1::TIMINGS::SetNormalCycle
{
  if (@this == 1 && @sysvar::IL_CAN1::NODES::N_Sender::MESSAGES::EEC1::TIMINGS::EnableCyclic)
  {
    @sysvar::IL_CAN1::NODES::N_Sender::MESSAGES::EEC1::TIMINGS::SelectedPeriod = 0;
  }
}

on sysvar_update sysvar::IL_CAN1::NODES::N_Sender::MESSAGES::EEC1::TIMINGS::SetNewCycleContinously
{
  if (@this == 1 && @sysvar::IL_CAN1::NODES::N_Sender::MESSAGES::EEC1::TIMINGS::EnableCyclic)
  {
    @sysvar::IL_CAN1::NODES::N_Sender::MESSAGES::EEC1::TIMINGS::SelectedPeriod = -1;
  }
}

on sysvar_update sysvar::IL_CAN1::NODES::N_Sender::MESSAGES::EEC1::TIMINGS::SelectedPeriod
{
  if (@this == 0 && @sysvar::IL_CAN1::NODES::N_Sender::MESSAGES::EEC1::TIMINGS::EnableCyclic)
  {
    SetBusContext(gILCAN1_BusContext);
    gCAN1DisturbancePeriod = @sysvar::IL_CAN1::NODES::N_Sender::MESSAGES::EEC1::TIMINGS::NormalCyclePeriod;
    J1939ILSetMsgCycleTime(J1939::Sender::EEC1, 100);
  }
  else if (@this == 1 && @sysvar::IL_CAN1::NODES::N_Sender::MESSAGES::EEC1::TIMINGS::EnableCyclic)
  {
    SetBusContext(gILCAN1_BusContext);
    gCAN1DisturbancePeriod = @sysvar::IL_CAN1::NODES::N_Sender::MESSAGES::EEC1::TIMINGS::ActiveCyclePeriod;
    J1939ILSetMsgCycleTime(J1939::Sender::EEC1, gCAN1DisturbancePeriod);
  }
  else if (@this == -1 && @sysvar::IL_CAN1::NODES::N_Sender::MESSAGES::EEC1::TIMINGS::EnableCyclic)
  {
    SetBusContext(gILCAN1_BusContext);
    gCAN1DisturbancePeriod = @sysvar::IL_CAN1::NODES::N_Sender::MESSAGES::EEC1::TIMINGS::CyclePeriod;
    J1939ILSetMsgCycleTime(J1939::Sender::EEC1, gCAN1DisturbancePeriod);
  }
}

on sysvar_update sysvar::IL_CAN1::NODES::N_Sender::MESSAGES::EEC1::TIMINGS::SendOnce
{
  if (@this == 1)
  {
    SetBusContext(gILCAN1_BusContext);
    J1939ILSetMsgEvent(J1939::Sender::EEC1);
  }
}

on sysvar_update sysvar::IL_CAN1::NODES::N_Sender::MESSAGES::EEC2::TIMINGS::EnableCyclic
{
  if (@this == 1)
  {
    SetBusContext(gILCAN1_BusContext);
    J1939ILEnableMsg  (J1939::Sender::EEC2);
  }
  else
  {
    SetBusContext(gILCAN1_BusContext);
    J1939ILDisableMsg (J1939::Sender::EEC2);
  }
}

on sysvar_update sysvar::IL_CAN1::NODES::N_Sender::MESSAGES::EEC2::TIMINGS::SetNormalCycle
{
  if (@this == 1 && @sysvar::IL_CAN1::NODES::N_Sender::MESSAGES::EEC2::TIMINGS::EnableCyclic)
  {
    @sysvar::IL_CAN1::NODES::N_Sender::MESSAGES::EEC2::TIMINGS::SelectedPeriod = 0;
  }
}

on sysvar_update sysvar::IL_CAN1::NODES::N_Sender::MESSAGES::EEC2::TIMINGS::SetNewCycleContinously
{
  if (@this == 1 && @sysvar::IL_CAN1::NODES::N_Sender::MESSAGES::EEC2::TIMINGS::EnableCyclic)
  {
    @sysvar::IL_CAN1::NODES::N_Sender::MESSAGES::EEC2::TIMINGS::SelectedPeriod = -1;
  }
}

on sysvar_update sysvar::IL_CAN1::NODES::N_Sender::MESSAGES::EEC2::TIMINGS::SelectedPeriod
{
  if (@this == 0 && @sysvar::IL_CAN1::NODES::N_Sender::MESSAGES::EEC2::TIMINGS::EnableCyclic)
  {
    SetBusContext(gILCAN1_BusContext);
    gCAN1DisturbancePeriod = @sysvar::IL_CAN1::NODES::N_Sender::MESSAGES::EEC2::TIMINGS::NormalCyclePeriod;
    J1939ILSetMsgCycleTime(J1939::Sender::EEC2, 50);
  }
  else if (@this == 1 && @sysvar::IL_CAN1::NODES::N_Sender::MESSAGES::EEC2::TIMINGS::EnableCyclic)
  {
    SetBusContext(gILCAN1_BusContext);
    gCAN1DisturbancePeriod = @sysvar::IL_CAN1::NODES::N_Sender::MESSAGES::EEC2::TIMINGS::ActiveCyclePeriod;
    J1939ILSetMsgCycleTime(J1939::Sender::EEC2, gCAN1DisturbancePeriod);
  }
  else if (@this == -1 && @sysvar::IL_CAN1::NODES::N_Sender::MESSAGES::EEC2::TIMINGS::EnableCyclic)
  {
    SetBusContext(gILCAN1_BusContext);
    gCAN1DisturbancePeriod = @sysvar::IL_CAN1::NODES::N_Sender::MESSAGES::EEC2::TIMINGS::CyclePeriod;
    J1939ILSetMsgCycleTime(J1939::Sender::EEC2, gCAN1DisturbancePeriod);
  }
}

on sysvar_update sysvar::IL_CAN1::NODES::N_Sender::MESSAGES::EEC2::TIMINGS::SendOnce
{
  if (@this == 1)
  {
    SetBusContext(gILCAN1_BusContext);
    J1939ILSetMsgEvent(J1939::Sender::EEC2);
  }
}

on sysvar_update sysvar::IL_CAN1::NODES::N_Sender::MESSAGES::EEC3::TIMINGS::EnableCyclic
{
  if (@this == 1)
  {
    SetBusContext(gILCAN1_BusContext);
    J1939ILEnableMsg  (J1939::Sender::EEC3);
  }
  else
  {
    SetBusContext(gILCAN1_BusContext);
    J1939ILDisableMsg (J1939::Sender::EEC3);
  }
}

on sysvar_update sysvar::IL_CAN1::NODES::N_Sender::MESSAGES::EEC3::TIMINGS::SetNormalCycle
{
  if (@this == 1 && @sysvar::IL_CAN1::NODES::N_Sender::MESSAGES::EEC3::TIMINGS::EnableCyclic)
  {
    @sysvar::IL_CAN1::NODES::N_Sender::MESSAGES::EEC3::TIMINGS::SelectedPeriod = 0;
  }
}

on sysvar_update sysvar::IL_CAN1::NODES::N_Sender::MESSAGES::EEC3::TIMINGS::SetNewCycleContinously
{
  if (@this == 1 && @sysvar::IL_CAN1::NODES::N_Sender::MESSAGES::EEC3::TIMINGS::EnableCyclic)
  {
    @sysvar::IL_CAN1::NODES::N_Sender::MESSAGES::EEC3::TIMINGS::SelectedPeriod = -1;
  }
}

on sysvar_update sysvar::IL_CAN1::NODES::N_Sender::MESSAGES::EEC3::TIMINGS::SelectedPeriod
{
  if (@this == 0 && @sysvar::IL_CAN1::NODES::N_Sender::MESSAGES::EEC3::TIMINGS::EnableCyclic)
  {
    SetBusContext(gILCAN1_BusContext);
    gCAN1DisturbancePeriod = @sysvar::IL_CAN1::NODES::N_Sender::MESSAGES::EEC3::TIMINGS::NormalCyclePeriod;
    J1939ILSetMsgCycleTime(J1939::Sender::EEC3, 250);
  }
  else if (@this == 1 && @sysvar::IL_CAN1::NODES::N_Sender::MESSAGES::EEC3::TIMINGS::EnableCyclic)
  {
    SetBusContext(gILCAN1_BusContext);
    gCAN1DisturbancePeriod = @sysvar::IL_CAN1::NODES::N_Sender::MESSAGES::EEC3::TIMINGS::ActiveCyclePeriod;
    J1939ILSetMsgCycleTime(J1939::Sender::EEC3, gCAN1DisturbancePeriod);
  }
  else if (@this == -1 && @sysvar::IL_CAN1::NODES::N_Sender::MESSAGES::EEC3::TIMINGS::EnableCyclic)
  {
    SetBusContext(gILCAN1_BusContext);
    gCAN1DisturbancePeriod = @sysvar::IL_CAN1::NODES::N_Sender::MESSAGES::EEC3::TIMINGS::CyclePeriod;
    J1939ILSetMsgCycleTime(J1939::Sender::EEC3, gCAN1DisturbancePeriod);
  }
}

on sysvar_update sysvar::IL_CAN1::NODES::N_Sender::MESSAGES::EEC3::TIMINGS::SendOnce
{
  if (@this == 1)
  {
    SetBusContext(gILCAN1_BusContext);
    J1939ILSetMsgEvent(J1939::Sender::EEC3);
  }
}

on sysvar_update sysvar::IL_CAN1::NODES::N_Sender::MESSAGES::EFL_P1::TIMINGS::EnableCyclic
{
  if (@this == 1)
  {
    SetBusContext(gILCAN1_BusContext);
    J1939ILEnableMsg  (J1939::Sender::EFL_P1);
  }
  else
  {
    SetBusContext(gILCAN1_BusContext);
    J1939ILDisableMsg (J1939::Sender::EFL_P1);
  }
}

on sysvar_update sysvar::IL_CAN1::NODES::N_Sender::MESSAGES::EFL_P1::TIMINGS::SetNormalCycle
{
  if (@this == 1 && @sysvar::IL_CAN1::NODES::N_Sender::MESSAGES::EFL_P1::TIMINGS::EnableCyclic)
  {
    @sysvar::IL_CAN1::NODES::N_Sender::MESSAGES::EFL_P1::TIMINGS::SelectedPeriod = 0;
  }
}

on sysvar_update sysvar::IL_CAN1::NODES::N_Sender::MESSAGES::EFL_P1::TIMINGS::SetNewCycleContinously
{
  if (@this == 1 && @sysvar::IL_CAN1::NODES::N_Sender::MESSAGES::EFL_P1::TIMINGS::EnableCyclic)
  {
    @sysvar::IL_CAN1::NODES::N_Sender::MESSAGES::EFL_P1::TIMINGS::SelectedPeriod = -1;
  }
}

on sysvar_update sysvar::IL_CAN1::NODES::N_Sender::MESSAGES::EFL_P1::TIMINGS::SelectedPeriod
{
  if (@this == 0 && @sysvar::IL_CAN1::NODES::N_Sender::MESSAGES::EFL_P1::TIMINGS::EnableCyclic)
  {
    SetBusContext(gILCAN1_BusContext);
    gCAN1DisturbancePeriod = @sysvar::IL_CAN1::NODES::N_Sender::MESSAGES::EFL_P1::TIMINGS::NormalCyclePeriod;
    J1939ILSetMsgCycleTime(J1939::Sender::EFL_P1, 500);
  }
  else if (@this == 1 && @sysvar::IL_CAN1::NODES::N_Sender::MESSAGES::EFL_P1::TIMINGS::EnableCyclic)
  {
    SetBusContext(gILCAN1_BusContext);
    gCAN1DisturbancePeriod = @sysvar::IL_CAN1::NODES::N_Sender::MESSAGES::EFL_P1::TIMINGS::ActiveCyclePeriod;
    J1939ILSetMsgCycleTime(J1939::Sender::EFL_P1, gCAN1DisturbancePeriod);
  }
  else if (@this == -1 && @sysvar::IL_CAN1::NODES::N_Sender::MESSAGES::EFL_P1::TIMINGS::EnableCyclic)
  {
    SetBusContext(gILCAN1_BusContext);
    gCAN1DisturbancePeriod = @sysvar::IL_CAN1::NODES::N_Sender::MESSAGES::EFL_P1::TIMINGS::CyclePeriod;
    J1939ILSetMsgCycleTime(J1939::Sender::EFL_P1, gCAN1DisturbancePeriod);
  }
}

on sysvar_update sysvar::IL_CAN1::NODES::N_Sender::MESSAGES::EFL_P1::TIMINGS::SendOnce
{
  if (@this == 1)
  {
    SetBusContext(gILCAN1_BusContext);
    J1939ILSetMsgEvent(J1939::Sender::EFL_P1);
  }
}

on sysvar_update sysvar::IL_CAN1::NODES::N_Sender::MESSAGES::EO1::TIMINGS::EnableCyclic
{
  if (@this == 1)
  {
    SetBusContext(gILCAN1_BusContext);
    J1939ILEnableMsg  (J1939::Sender::EO1);
  }
  else
  {
    SetBusContext(gILCAN1_BusContext);
    J1939ILDisableMsg (J1939::Sender::EO1);
  }
}

on sysvar_update sysvar::IL_CAN1::NODES::N_Sender::MESSAGES::EO1::TIMINGS::SetNormalCycle
{
  if (@this == 1 && @sysvar::IL_CAN1::NODES::N_Sender::MESSAGES::EO1::TIMINGS::EnableCyclic)
  {
    @sysvar::IL_CAN1::NODES::N_Sender::MESSAGES::EO1::TIMINGS::SelectedPeriod = 0;
  }
}

on sysvar_update sysvar::IL_CAN1::NODES::N_Sender::MESSAGES::EO1::TIMINGS::SetNewCycleContinously
{
  if (@this == 1 && @sysvar::IL_CAN1::NODES::N_Sender::MESSAGES::EO1::TIMINGS::EnableCyclic)
  {
    @sysvar::IL_CAN1::NODES::N_Sender::MESSAGES::EO1::TIMINGS::SelectedPeriod = -1;
  }
}

on sysvar_update sysvar::IL_CAN1::NODES::N_Sender::MESSAGES::EO1::TIMINGS::SelectedPeriod
{
  if (@this == 0 && @sysvar::IL_CAN1::NODES::N_Sender::MESSAGES::EO1::TIMINGS::EnableCyclic)
  {
    SetBusContext(gILCAN1_BusContext);
    gCAN1DisturbancePeriod = @sysvar::IL_CAN1::NODES::N_Sender::MESSAGES::EO1::TIMINGS::NormalCyclePeriod;
    J1939ILSetMsgCycleTime(J1939::Sender::EO1, 0);
  }
  else if (@this == 1 && @sysvar::IL_CAN1::NODES::N_Sender::MESSAGES::EO1::TIMINGS::EnableCyclic)
  {
    SetBusContext(gILCAN1_BusContext);
    gCAN1DisturbancePeriod = @sysvar::IL_CAN1::NODES::N_Sender::MESSAGES::EO1::TIMINGS::ActiveCyclePeriod;
    J1939ILSetMsgCycleTime(J1939::Sender::EO1, gCAN1DisturbancePeriod);
  }
  else if (@this == -1 && @sysvar::IL_CAN1::NODES::N_Sender::MESSAGES::EO1::TIMINGS::EnableCyclic)
  {
    SetBusContext(gILCAN1_BusContext);
    gCAN1DisturbancePeriod = @sysvar::IL_CAN1::NODES::N_Sender::MESSAGES::EO1::TIMINGS::CyclePeriod;
    J1939ILSetMsgCycleTime(J1939::Sender::EO1, gCAN1DisturbancePeriod);
  }
}

on sysvar_update sysvar::IL_CAN1::NODES::N_Sender::MESSAGES::EO1::TIMINGS::SendOnce
{
  if (@this == 1)
  {
    SetBusContext(gILCAN1_BusContext);
    J1939ILSetMsgEvent(J1939::Sender::EO1);
  }
}

on sysvar_update sysvar::IL_CAN1::NODES::N_Sender::MESSAGES::ERC1::TIMINGS::EnableCyclic
{
  if (@this == 1)
  {
    SetBusContext(gILCAN1_BusContext);
    J1939ILEnableMsg  (J1939::Sender::ERC1);
  }
  else
  {
    SetBusContext(gILCAN1_BusContext);
    J1939ILDisableMsg (J1939::Sender::ERC1);
  }
}

on sysvar_update sysvar::IL_CAN1::NODES::N_Sender::MESSAGES::ERC1::TIMINGS::SetNormalCycle
{
  if (@this == 1 && @sysvar::IL_CAN1::NODES::N_Sender::MESSAGES::ERC1::TIMINGS::EnableCyclic)
  {
    @sysvar::IL_CAN1::NODES::N_Sender::MESSAGES::ERC1::TIMINGS::SelectedPeriod = 0;
  }
}

on sysvar_update sysvar::IL_CAN1::NODES::N_Sender::MESSAGES::ERC1::TIMINGS::SetNewCycleContinously
{
  if (@this == 1 && @sysvar::IL_CAN1::NODES::N_Sender::MESSAGES::ERC1::TIMINGS::EnableCyclic)
  {
    @sysvar::IL_CAN1::NODES::N_Sender::MESSAGES::ERC1::TIMINGS::SelectedPeriod = -1;
  }
}

on sysvar_update sysvar::IL_CAN1::NODES::N_Sender::MESSAGES::ERC1::TIMINGS::SelectedPeriod
{
  if (@this == 0 && @sysvar::IL_CAN1::NODES::N_Sender::MESSAGES::ERC1::TIMINGS::EnableCyclic)
  {
    SetBusContext(gILCAN1_BusContext);
    gCAN1DisturbancePeriod = @sysvar::IL_CAN1::NODES::N_Sender::MESSAGES::ERC1::TIMINGS::NormalCyclePeriod;
    J1939ILSetMsgCycleTime(J1939::Sender::ERC1, 100);
  }
  else if (@this == 1 && @sysvar::IL_CAN1::NODES::N_Sender::MESSAGES::ERC1::TIMINGS::EnableCyclic)
  {
    SetBusContext(gILCAN1_BusContext);
    gCAN1DisturbancePeriod = @sysvar::IL_CAN1::NODES::N_Sender::MESSAGES::ERC1::TIMINGS::ActiveCyclePeriod;
    J1939ILSetMsgCycleTime(J1939::Sender::ERC1, gCAN1DisturbancePeriod);
  }
  else if (@this == -1 && @sysvar::IL_CAN1::NODES::N_Sender::MESSAGES::ERC1::TIMINGS::EnableCyclic)
  {
    SetBusContext(gILCAN1_BusContext);
    gCAN1DisturbancePeriod = @sysvar::IL_CAN1::NODES::N_Sender::MESSAGES::ERC1::TIMINGS::CyclePeriod;
    J1939ILSetMsgCycleTime(J1939::Sender::ERC1, gCAN1DisturbancePeriod);
  }
}

on sysvar_update sysvar::IL_CAN1::NODES::N_Sender::MESSAGES::ERC1::TIMINGS::SendOnce
{
  if (@this == 1)
  {
    SetBusContext(gILCAN1_BusContext);
    J1939ILSetMsgEvent(J1939::Sender::ERC1);
  }
}

on sysvar_update sysvar::IL_CAN1::NODES::N_Sender::MESSAGES::ET1::TIMINGS::EnableCyclic
{
  if (@this == 1)
  {
    SetBusContext(gILCAN1_BusContext);
    J1939ILEnableMsg  (J1939::Sender::ET1);
  }
  else
  {
    SetBusContext(gILCAN1_BusContext);
    J1939ILDisableMsg (J1939::Sender::ET1);
  }
}

on sysvar_update sysvar::IL_CAN1::NODES::N_Sender::MESSAGES::ET1::TIMINGS::SetNormalCycle
{
  if (@this == 1 && @sysvar::IL_CAN1::NODES::N_Sender::MESSAGES::ET1::TIMINGS::EnableCyclic)
  {
    @sysvar::IL_CAN1::NODES::N_Sender::MESSAGES::ET1::TIMINGS::SelectedPeriod = 0;
  }
}

on sysvar_update sysvar::IL_CAN1::NODES::N_Sender::MESSAGES::ET1::TIMINGS::SetNewCycleContinously
{
  if (@this == 1 && @sysvar::IL_CAN1::NODES::N_Sender::MESSAGES::ET1::TIMINGS::EnableCyclic)
  {
    @sysvar::IL_CAN1::NODES::N_Sender::MESSAGES::ET1::TIMINGS::SelectedPeriod = -1;
  }
}

on sysvar_update sysvar::IL_CAN1::NODES::N_Sender::MESSAGES::ET1::TIMINGS::SelectedPeriod
{
  if (@this == 0 && @sysvar::IL_CAN1::NODES::N_Sender::MESSAGES::ET1::TIMINGS::EnableCyclic)
  {
    SetBusContext(gILCAN1_BusContext);
    gCAN1DisturbancePeriod = @sysvar::IL_CAN1::NODES::N_Sender::MESSAGES::ET1::TIMINGS::NormalCyclePeriod;
    J1939ILSetMsgCycleTime(J1939::Sender::ET1, 1000);
  }
  else if (@this == 1 && @sysvar::IL_CAN1::NODES::N_Sender::MESSAGES::ET1::TIMINGS::EnableCyclic)
  {
    SetBusContext(gILCAN1_BusContext);
    gCAN1DisturbancePeriod = @sysvar::IL_CAN1::NODES::N_Sender::MESSAGES::ET1::TIMINGS::ActiveCyclePeriod;
    J1939ILSetMsgCycleTime(J1939::Sender::ET1, gCAN1DisturbancePeriod);
  }
  else if (@this == -1 && @sysvar::IL_CAN1::NODES::N_Sender::MESSAGES::ET1::TIMINGS::EnableCyclic)
  {
    SetBusContext(gILCAN1_BusContext);
    gCAN1DisturbancePeriod = @sysvar::IL_CAN1::NODES::N_Sender::MESSAGES::ET1::TIMINGS::CyclePeriod;
    J1939ILSetMsgCycleTime(J1939::Sender::ET1, gCAN1DisturbancePeriod);
  }
}

on sysvar_update sysvar::IL_CAN1::NODES::N_Sender::MESSAGES::ET1::TIMINGS::SendOnce
{
  if (@this == 1)
  {
    SetBusContext(gILCAN1_BusContext);
    J1939ILSetMsgEvent(J1939::Sender::ET1);
  }
}

on sysvar_update sysvar::IL_CAN1::NODES::N_Sender::MESSAGES::ET2::TIMINGS::EnableCyclic
{
  if (@this == 1)
  {
    SetBusContext(gILCAN1_BusContext);
    J1939ILEnableMsg  (J1939::Sender::ET2);
  }
  else
  {
    SetBusContext(gILCAN1_BusContext);
    J1939ILDisableMsg (J1939::Sender::ET2);
  }
}

on sysvar_update sysvar::IL_CAN1::NODES::N_Sender::MESSAGES::ET2::TIMINGS::SetNormalCycle
{
  if (@this == 1 && @sysvar::IL_CAN1::NODES::N_Sender::MESSAGES::ET2::TIMINGS::EnableCyclic)
  {
    @sysvar::IL_CAN1::NODES::N_Sender::MESSAGES::ET2::TIMINGS::SelectedPeriod = 0;
  }
}

on sysvar_update sysvar::IL_CAN1::NODES::N_Sender::MESSAGES::ET2::TIMINGS::SetNewCycleContinously
{
  if (@this == 1 && @sysvar::IL_CAN1::NODES::N_Sender::MESSAGES::ET2::TIMINGS::EnableCyclic)
  {
    @sysvar::IL_CAN1::NODES::N_Sender::MESSAGES::ET2::TIMINGS::SelectedPeriod = -1;
  }
}

on sysvar_update sysvar::IL_CAN1::NODES::N_Sender::MESSAGES::ET2::TIMINGS::SelectedPeriod
{
  if (@this == 0 && @sysvar::IL_CAN1::NODES::N_Sender::MESSAGES::ET2::TIMINGS::EnableCyclic)
  {
    SetBusContext(gILCAN1_BusContext);
    gCAN1DisturbancePeriod = @sysvar::IL_CAN1::NODES::N_Sender::MESSAGES::ET2::TIMINGS::NormalCyclePeriod;
    J1939ILSetMsgCycleTime(J1939::Sender::ET2, 1000);
  }
  else if (@this == 1 && @sysvar::IL_CAN1::NODES::N_Sender::MESSAGES::ET2::TIMINGS::EnableCyclic)
  {
    SetBusContext(gILCAN1_BusContext);
    gCAN1DisturbancePeriod = @sysvar::IL_CAN1::NODES::N_Sender::MESSAGES::ET2::TIMINGS::ActiveCyclePeriod;
    J1939ILSetMsgCycleTime(J1939::Sender::ET2, gCAN1DisturbancePeriod);
  }
  else if (@this == -1 && @sysvar::IL_CAN1::NODES::N_Sender::MESSAGES::ET2::TIMINGS::EnableCyclic)
  {
    SetBusContext(gILCAN1_BusContext);
    gCAN1DisturbancePeriod = @sysvar::IL_CAN1::NODES::N_Sender::MESSAGES::ET2::TIMINGS::CyclePeriod;
    J1939ILSetMsgCycleTime(J1939::Sender::ET2, gCAN1DisturbancePeriod);
  }
}

on sysvar_update sysvar::IL_CAN1::NODES::N_Sender::MESSAGES::ET2::TIMINGS::SendOnce
{
  if (@this == 1)
  {
    SetBusContext(gILCAN1_BusContext);
    J1939ILSetMsgEvent(J1939::Sender::ET2);
  }
}

on sysvar_update sysvar::IL_CAN1::NODES::N_Sender::MESSAGES::ETC1::TIMINGS::EnableCyclic
{
  if (@this == 1)
  {
    SetBusContext(gILCAN1_BusContext);
    J1939ILEnableMsg  (J1939::Sender::ETC1);
  }
  else
  {
    SetBusContext(gILCAN1_BusContext);
    J1939ILDisableMsg (J1939::Sender::ETC1);
  }
}

on sysvar_update sysvar::IL_CAN1::NODES::N_Sender::MESSAGES::ETC1::TIMINGS::SetNormalCycle
{
  if (@this == 1 && @sysvar::IL_CAN1::NODES::N_Sender::MESSAGES::ETC1::TIMINGS::EnableCyclic)
  {
    @sysvar::IL_CAN1::NODES::N_Sender::MESSAGES::ETC1::TIMINGS::SelectedPeriod = 0;
  }
}

on sysvar_update sysvar::IL_CAN1::NODES::N_Sender::MESSAGES::ETC1::TIMINGS::SetNewCycleContinously
{
  if (@this == 1 && @sysvar::IL_CAN1::NODES::N_Sender::MESSAGES::ETC1::TIMINGS::EnableCyclic)
  {
    @sysvar::IL_CAN1::NODES::N_Sender::MESSAGES::ETC1::TIMINGS::SelectedPeriod = -1;
  }
}

on sysvar_update sysvar::IL_CAN1::NODES::N_Sender::MESSAGES::ETC1::TIMINGS::SelectedPeriod
{
  if (@this == 0 && @sysvar::IL_CAN1::NODES::N_Sender::MESSAGES::ETC1::TIMINGS::EnableCyclic)
  {
    SetBusContext(gILCAN1_BusContext);
    gCAN1DisturbancePeriod = @sysvar::IL_CAN1::NODES::N_Sender::MESSAGES::ETC1::TIMINGS::NormalCyclePeriod;
    J1939ILSetMsgCycleTime(J1939::Sender::ETC1, 10);
  }
  else if (@this == 1 && @sysvar::IL_CAN1::NODES::N_Sender::MESSAGES::ETC1::TIMINGS::EnableCyclic)
  {
    SetBusContext(gILCAN1_BusContext);
    gCAN1DisturbancePeriod = @sysvar::IL_CAN1::NODES::N_Sender::MESSAGES::ETC1::TIMINGS::ActiveCyclePeriod;
    J1939ILSetMsgCycleTime(J1939::Sender::ETC1, gCAN1DisturbancePeriod);
  }
  else if (@this == -1 && @sysvar::IL_CAN1::NODES::N_Sender::MESSAGES::ETC1::TIMINGS::EnableCyclic)
  {
    SetBusContext(gILCAN1_BusContext);
    gCAN1DisturbancePeriod = @sysvar::IL_CAN1::NODES::N_Sender::MESSAGES::ETC1::TIMINGS::CyclePeriod;
    J1939ILSetMsgCycleTime(J1939::Sender::ETC1, gCAN1DisturbancePeriod);
  }
}

on sysvar_update sysvar::IL_CAN1::NODES::N_Sender::MESSAGES::ETC1::TIMINGS::SendOnce
{
  if (@this == 1)
  {
    SetBusContext(gILCAN1_BusContext);
    J1939ILSetMsgEvent(J1939::Sender::ETC1);
  }
}

on sysvar_update sysvar::IL_CAN1::NODES::N_Sender::MESSAGES::ETC2::TIMINGS::EnableCyclic
{
  if (@this == 1)
  {
    SetBusContext(gILCAN1_BusContext);
    J1939ILEnableMsg  (J1939::Sender::ETC2);
  }
  else
  {
    SetBusContext(gILCAN1_BusContext);
    J1939ILDisableMsg (J1939::Sender::ETC2);
  }
}

on sysvar_update sysvar::IL_CAN1::NODES::N_Sender::MESSAGES::ETC2::TIMINGS::SetNormalCycle
{
  if (@this == 1 && @sysvar::IL_CAN1::NODES::N_Sender::MESSAGES::ETC2::TIMINGS::EnableCyclic)
  {
    @sysvar::IL_CAN1::NODES::N_Sender::MESSAGES::ETC2::TIMINGS::SelectedPeriod = 0;
  }
}

on sysvar_update sysvar::IL_CAN1::NODES::N_Sender::MESSAGES::ETC2::TIMINGS::SetNewCycleContinously
{
  if (@this == 1 && @sysvar::IL_CAN1::NODES::N_Sender::MESSAGES::ETC2::TIMINGS::EnableCyclic)
  {
    @sysvar::IL_CAN1::NODES::N_Sender::MESSAGES::ETC2::TIMINGS::SelectedPeriod = -1;
  }
}

on sysvar_update sysvar::IL_CAN1::NODES::N_Sender::MESSAGES::ETC2::TIMINGS::SelectedPeriod
{
  if (@this == 0 && @sysvar::IL_CAN1::NODES::N_Sender::MESSAGES::ETC2::TIMINGS::EnableCyclic)
  {
    SetBusContext(gILCAN1_BusContext);
    gCAN1DisturbancePeriod = @sysvar::IL_CAN1::NODES::N_Sender::MESSAGES::ETC2::TIMINGS::NormalCyclePeriod;
    J1939ILSetMsgCycleTime(J1939::Sender::ETC2, 100);
  }
  else if (@this == 1 && @sysvar::IL_CAN1::NODES::N_Sender::MESSAGES::ETC2::TIMINGS::EnableCyclic)
  {
    SetBusContext(gILCAN1_BusContext);
    gCAN1DisturbancePeriod = @sysvar::IL_CAN1::NODES::N_Sender::MESSAGES::ETC2::TIMINGS::ActiveCyclePeriod;
    J1939ILSetMsgCycleTime(J1939::Sender::ETC2, gCAN1DisturbancePeriod);
  }
  else if (@this == -1 && @sysvar::IL_CAN1::NODES::N_Sender::MESSAGES::ETC2::TIMINGS::EnableCyclic)
  {
    SetBusContext(gILCAN1_BusContext);
    gCAN1DisturbancePeriod = @sysvar::IL_CAN1::NODES::N_Sender::MESSAGES::ETC2::TIMINGS::CyclePeriod;
    J1939ILSetMsgCycleTime(J1939::Sender::ETC2, gCAN1DisturbancePeriod);
  }
}

on sysvar_update sysvar::IL_CAN1::NODES::N_Sender::MESSAGES::ETC2::TIMINGS::SendOnce
{
  if (@this == 1)
  {
    SetBusContext(gILCAN1_BusContext);
    J1939ILSetMsgEvent(J1939::Sender::ETC2);
  }
}

on sysvar_update sysvar::IL_CAN1::NODES::N_Sender::MESSAGES::ETC7::TIMINGS::EnableCyclic
{
  if (@this == 1)
  {
    SetBusContext(gILCAN1_BusContext);
    J1939ILEnableMsg  (J1939::Sender::ETC7);
  }
  else
  {
    SetBusContext(gILCAN1_BusContext);
    J1939ILDisableMsg (J1939::Sender::ETC7);
  }
}

on sysvar_update sysvar::IL_CAN1::NODES::N_Sender::MESSAGES::ETC7::TIMINGS::SetNormalCycle
{
  if (@this == 1 && @sysvar::IL_CAN1::NODES::N_Sender::MESSAGES::ETC7::TIMINGS::EnableCyclic)
  {
    @sysvar::IL_CAN1::NODES::N_Sender::MESSAGES::ETC7::TIMINGS::SelectedPeriod = 0;
  }
}

on sysvar_update sysvar::IL_CAN1::NODES::N_Sender::MESSAGES::ETC7::TIMINGS::SetNewCycleContinously
{
  if (@this == 1 && @sysvar::IL_CAN1::NODES::N_Sender::MESSAGES::ETC7::TIMINGS::EnableCyclic)
  {
    @sysvar::IL_CAN1::NODES::N_Sender::MESSAGES::ETC7::TIMINGS::SelectedPeriod = -1;
  }
}

on sysvar_update sysvar::IL_CAN1::NODES::N_Sender::MESSAGES::ETC7::TIMINGS::SelectedPeriod
{
  if (@this == 0 && @sysvar::IL_CAN1::NODES::N_Sender::MESSAGES::ETC7::TIMINGS::EnableCyclic)
  {
    SetBusContext(gILCAN1_BusContext);
    gCAN1DisturbancePeriod = @sysvar::IL_CAN1::NODES::N_Sender::MESSAGES::ETC7::TIMINGS::NormalCyclePeriod;
    J1939ILSetMsgCycleTime(J1939::Sender::ETC7, 100);
  }
  else if (@this == 1 && @sysvar::IL_CAN1::NODES::N_Sender::MESSAGES::ETC7::TIMINGS::EnableCyclic)
  {
    SetBusContext(gILCAN1_BusContext);
    gCAN1DisturbancePeriod = @sysvar::IL_CAN1::NODES::N_Sender::MESSAGES::ETC7::TIMINGS::ActiveCyclePeriod;
    J1939ILSetMsgCycleTime(J1939::Sender::ETC7, gCAN1DisturbancePeriod);
  }
  else if (@this == -1 && @sysvar::IL_CAN1::NODES::N_Sender::MESSAGES::ETC7::TIMINGS::EnableCyclic)
  {
    SetBusContext(gILCAN1_BusContext);
    gCAN1DisturbancePeriod = @sysvar::IL_CAN1::NODES::N_Sender::MESSAGES::ETC7::TIMINGS::CyclePeriod;
    J1939ILSetMsgCycleTime(J1939::Sender::ETC7, gCAN1DisturbancePeriod);
  }
}

on sysvar_update sysvar::IL_CAN1::NODES::N_Sender::MESSAGES::ETC7::TIMINGS::SendOnce
{
  if (@this == 1)
  {
    SetBusContext(gILCAN1_BusContext);
    J1939ILSetMsgEvent(J1939::Sender::ETC7);
  }
}

on sysvar_update sysvar::IL_CAN1::NODES::N_Sender::MESSAGES::FD::TIMINGS::EnableCyclic
{
  if (@this == 1)
  {
    SetBusContext(gILCAN1_BusContext);
    J1939ILEnableMsg  (J1939::Sender::FD);
  }
  else
  {
    SetBusContext(gILCAN1_BusContext);
    J1939ILDisableMsg (J1939::Sender::FD);
  }
}

on sysvar_update sysvar::IL_CAN1::NODES::N_Sender::MESSAGES::FD::TIMINGS::SetNormalCycle
{
  if (@this == 1 && @sysvar::IL_CAN1::NODES::N_Sender::MESSAGES::FD::TIMINGS::EnableCyclic)
  {
    @sysvar::IL_CAN1::NODES::N_Sender::MESSAGES::FD::TIMINGS::SelectedPeriod = 0;
  }
}

on sysvar_update sysvar::IL_CAN1::NODES::N_Sender::MESSAGES::FD::TIMINGS::SetNewCycleContinously
{
  if (@this == 1 && @sysvar::IL_CAN1::NODES::N_Sender::MESSAGES::FD::TIMINGS::EnableCyclic)
  {
    @sysvar::IL_CAN1::NODES::N_Sender::MESSAGES::FD::TIMINGS::SelectedPeriod = -1;
  }
}

on sysvar_update sysvar::IL_CAN1::NODES::N_Sender::MESSAGES::FD::TIMINGS::SelectedPeriod
{
  if (@this == 0 && @sysvar::IL_CAN1::NODES::N_Sender::MESSAGES::FD::TIMINGS::EnableCyclic)
  {
    SetBusContext(gILCAN1_BusContext);
    gCAN1DisturbancePeriod = @sysvar::IL_CAN1::NODES::N_Sender::MESSAGES::FD::TIMINGS::NormalCyclePeriod;
    J1939ILSetMsgCycleTime(J1939::Sender::FD, 1000);
  }
  else if (@this == 1 && @sysvar::IL_CAN1::NODES::N_Sender::MESSAGES::FD::TIMINGS::EnableCyclic)
  {
    SetBusContext(gILCAN1_BusContext);
    gCAN1DisturbancePeriod = @sysvar::IL_CAN1::NODES::N_Sender::MESSAGES::FD::TIMINGS::ActiveCyclePeriod;
    J1939ILSetMsgCycleTime(J1939::Sender::FD, gCAN1DisturbancePeriod);
  }
  else if (@this == -1 && @sysvar::IL_CAN1::NODES::N_Sender::MESSAGES::FD::TIMINGS::EnableCyclic)
  {
    SetBusContext(gILCAN1_BusContext);
    gCAN1DisturbancePeriod = @sysvar::IL_CAN1::NODES::N_Sender::MESSAGES::FD::TIMINGS::CyclePeriod;
    J1939ILSetMsgCycleTime(J1939::Sender::FD, gCAN1DisturbancePeriod);
  }
}

on sysvar_update sysvar::IL_CAN1::NODES::N_Sender::MESSAGES::FD::TIMINGS::SendOnce
{
  if (@this == 1)
  {
    SetBusContext(gILCAN1_BusContext);
    J1939ILSetMsgEvent(J1939::Sender::FD);
  }
}

on sysvar_update sysvar::IL_CAN1::NODES::N_Sender::MESSAGES::HOURS::TIMINGS::EnableCyclic
{
  if (@this == 1)
  {
    SetBusContext(gILCAN1_BusContext);
    J1939ILEnableMsg  (J1939::Sender::HOURS);
  }
  else
  {
    SetBusContext(gILCAN1_BusContext);
    J1939ILDisableMsg (J1939::Sender::HOURS);
  }
}

on sysvar_update sysvar::IL_CAN1::NODES::N_Sender::MESSAGES::HOURS::TIMINGS::SetNormalCycle
{
  if (@this == 1 && @sysvar::IL_CAN1::NODES::N_Sender::MESSAGES::HOURS::TIMINGS::EnableCyclic)
  {
    @sysvar::IL_CAN1::NODES::N_Sender::MESSAGES::HOURS::TIMINGS::SelectedPeriod = 0;
  }
}

on sysvar_update sysvar::IL_CAN1::NODES::N_Sender::MESSAGES::HOURS::TIMINGS::SetNewCycleContinously
{
  if (@this == 1 && @sysvar::IL_CAN1::NODES::N_Sender::MESSAGES::HOURS::TIMINGS::EnableCyclic)
  {
    @sysvar::IL_CAN1::NODES::N_Sender::MESSAGES::HOURS::TIMINGS::SelectedPeriod = -1;
  }
}

on sysvar_update sysvar::IL_CAN1::NODES::N_Sender::MESSAGES::HOURS::TIMINGS::SelectedPeriod
{
  if (@this == 0 && @sysvar::IL_CAN1::NODES::N_Sender::MESSAGES::HOURS::TIMINGS::EnableCyclic)
  {
    SetBusContext(gILCAN1_BusContext);
    gCAN1DisturbancePeriod = @sysvar::IL_CAN1::NODES::N_Sender::MESSAGES::HOURS::TIMINGS::NormalCyclePeriod;
    J1939ILSetMsgCycleTime(J1939::Sender::HOURS, 0);
  }
  else if (@this == 1 && @sysvar::IL_CAN1::NODES::N_Sender::MESSAGES::HOURS::TIMINGS::EnableCyclic)
  {
    SetBusContext(gILCAN1_BusContext);
    gCAN1DisturbancePeriod = @sysvar::IL_CAN1::NODES::N_Sender::MESSAGES::HOURS::TIMINGS::ActiveCyclePeriod;
    J1939ILSetMsgCycleTime(J1939::Sender::HOURS, gCAN1DisturbancePeriod);
  }
  else if (@this == -1 && @sysvar::IL_CAN1::NODES::N_Sender::MESSAGES::HOURS::TIMINGS::EnableCyclic)
  {
    SetBusContext(gILCAN1_BusContext);
    gCAN1DisturbancePeriod = @sysvar::IL_CAN1::NODES::N_Sender::MESSAGES::HOURS::TIMINGS::CyclePeriod;
    J1939ILSetMsgCycleTime(J1939::Sender::HOURS, gCAN1DisturbancePeriod);
  }
}

on sysvar_update sysvar::IL_CAN1::NODES::N_Sender::MESSAGES::HOURS::TIMINGS::SendOnce
{
  if (@this == 1)
  {
    SetBusContext(gILCAN1_BusContext);
    J1939ILSetMsgEvent(J1939::Sender::HOURS);
  }
}

on sysvar_update sysvar::IL_CAN1::NODES::N_Sender::MESSAGES::IC1::TIMINGS::EnableCyclic
{
  if (@this == 1)
  {
    SetBusContext(gILCAN1_BusContext);
    J1939ILEnableMsg  (J1939::Sender::IC1);
  }
  else
  {
    SetBusContext(gILCAN1_BusContext);
    J1939ILDisableMsg (J1939::Sender::IC1);
  }
}

on sysvar_update sysvar::IL_CAN1::NODES::N_Sender::MESSAGES::IC1::TIMINGS::SetNormalCycle
{
  if (@this == 1 && @sysvar::IL_CAN1::NODES::N_Sender::MESSAGES::IC1::TIMINGS::EnableCyclic)
  {
    @sysvar::IL_CAN1::NODES::N_Sender::MESSAGES::IC1::TIMINGS::SelectedPeriod = 0;
  }
}

on sysvar_update sysvar::IL_CAN1::NODES::N_Sender::MESSAGES::IC1::TIMINGS::SetNewCycleContinously
{
  if (@this == 1 && @sysvar::IL_CAN1::NODES::N_Sender::MESSAGES::IC1::TIMINGS::EnableCyclic)
  {
    @sysvar::IL_CAN1::NODES::N_Sender::MESSAGES::IC1::TIMINGS::SelectedPeriod = -1;
  }
}

on sysvar_update sysvar::IL_CAN1::NODES::N_Sender::MESSAGES::IC1::TIMINGS::SelectedPeriod
{
  if (@this == 0 && @sysvar::IL_CAN1::NODES::N_Sender::MESSAGES::IC1::TIMINGS::EnableCyclic)
  {
    SetBusContext(gILCAN1_BusContext);
    gCAN1DisturbancePeriod = @sysvar::IL_CAN1::NODES::N_Sender::MESSAGES::IC1::TIMINGS::NormalCyclePeriod;
    J1939ILSetMsgCycleTime(J1939::Sender::IC1, 500);
  }
  else if (@this == 1 && @sysvar::IL_CAN1::NODES::N_Sender::MESSAGES::IC1::TIMINGS::EnableCyclic)
  {
    SetBusContext(gILCAN1_BusContext);
    gCAN1DisturbancePeriod = @sysvar::IL_CAN1::NODES::N_Sender::MESSAGES::IC1::TIMINGS::ActiveCyclePeriod;
    J1939ILSetMsgCycleTime(J1939::Sender::IC1, gCAN1DisturbancePeriod);
  }
  else if (@this == -1 && @sysvar::IL_CAN1::NODES::N_Sender::MESSAGES::IC1::TIMINGS::EnableCyclic)
  {
    SetBusContext(gILCAN1_BusContext);
    gCAN1DisturbancePeriod = @sysvar::IL_CAN1::NODES::N_Sender::MESSAGES::IC1::TIMINGS::CyclePeriod;
    J1939ILSetMsgCycleTime(J1939::Sender::IC1, gCAN1DisturbancePeriod);
  }
}

on sysvar_update sysvar::IL_CAN1::NODES::N_Sender::MESSAGES::IC1::TIMINGS::SendOnce
{
  if (@this == 1)
  {
    SetBusContext(gILCAN1_BusContext);
    J1939ILSetMsgEvent(J1939::Sender::IC1);
  }
}

on sysvar_update sysvar::IL_CAN1::NODES::N_Sender::MESSAGES::LFC::TIMINGS::EnableCyclic
{
  if (@this == 1)
  {
    SetBusContext(gILCAN1_BusContext);
    J1939ILEnableMsg  (J1939::Sender::LFC);
  }
  else
  {
    SetBusContext(gILCAN1_BusContext);
    J1939ILDisableMsg (J1939::Sender::LFC);
  }
}

on sysvar_update sysvar::IL_CAN1::NODES::N_Sender::MESSAGES::LFC::TIMINGS::SetNormalCycle
{
  if (@this == 1 && @sysvar::IL_CAN1::NODES::N_Sender::MESSAGES::LFC::TIMINGS::EnableCyclic)
  {
    @sysvar::IL_CAN1::NODES::N_Sender::MESSAGES::LFC::TIMINGS::SelectedPeriod = 0;
  }
}

on sysvar_update sysvar::IL_CAN1::NODES::N_Sender::MESSAGES::LFC::TIMINGS::SetNewCycleContinously
{
  if (@this == 1 && @sysvar::IL_CAN1::NODES::N_Sender::MESSAGES::LFC::TIMINGS::EnableCyclic)
  {
    @sysvar::IL_CAN1::NODES::N_Sender::MESSAGES::LFC::TIMINGS::SelectedPeriod = -1;
  }
}

on sysvar_update sysvar::IL_CAN1::NODES::N_Sender::MESSAGES::LFC::TIMINGS::SelectedPeriod
{
  if (@this == 0 && @sysvar::IL_CAN1::NODES::N_Sender::MESSAGES::LFC::TIMINGS::EnableCyclic)
  {
    SetBusContext(gILCAN1_BusContext);
    gCAN1DisturbancePeriod = @sysvar::IL_CAN1::NODES::N_Sender::MESSAGES::LFC::TIMINGS::NormalCyclePeriod;
    J1939ILSetMsgCycleTime(J1939::Sender::LFC, 0);
  }
  else if (@this == 1 && @sysvar::IL_CAN1::NODES::N_Sender::MESSAGES::LFC::TIMINGS::EnableCyclic)
  {
    SetBusContext(gILCAN1_BusContext);
    gCAN1DisturbancePeriod = @sysvar::IL_CAN1::NODES::N_Sender::MESSAGES::LFC::TIMINGS::ActiveCyclePeriod;
    J1939ILSetMsgCycleTime(J1939::Sender::LFC, gCAN1DisturbancePeriod);
  }
  else if (@this == -1 && @sysvar::IL_CAN1::NODES::N_Sender::MESSAGES::LFC::TIMINGS::EnableCyclic)
  {
    SetBusContext(gILCAN1_BusContext);
    gCAN1DisturbancePeriod = @sysvar::IL_CAN1::NODES::N_Sender::MESSAGES::LFC::TIMINGS::CyclePeriod;
    J1939ILSetMsgCycleTime(J1939::Sender::LFC, gCAN1DisturbancePeriod);
  }
}

on sysvar_update sysvar::IL_CAN1::NODES::N_Sender::MESSAGES::LFC::TIMINGS::SendOnce
{
  if (@this == 1)
  {
    SetBusContext(gILCAN1_BusContext);
    J1939ILSetMsgEvent(J1939::Sender::LFC);
  }
}

on sysvar_update sysvar::IL_CAN1::NODES::N_Sender::MESSAGES::LFE::TIMINGS::EnableCyclic
{
  if (@this == 1)
  {
    SetBusContext(gILCAN1_BusContext);
    J1939ILEnableMsg  (J1939::Sender::LFE);
  }
  else
  {
    SetBusContext(gILCAN1_BusContext);
    J1939ILDisableMsg (J1939::Sender::LFE);
  }
}

on sysvar_update sysvar::IL_CAN1::NODES::N_Sender::MESSAGES::LFE::TIMINGS::SetNormalCycle
{
  if (@this == 1 && @sysvar::IL_CAN1::NODES::N_Sender::MESSAGES::LFE::TIMINGS::EnableCyclic)
  {
    @sysvar::IL_CAN1::NODES::N_Sender::MESSAGES::LFE::TIMINGS::SelectedPeriod = 0;
  }
}

on sysvar_update sysvar::IL_CAN1::NODES::N_Sender::MESSAGES::LFE::TIMINGS::SetNewCycleContinously
{
  if (@this == 1 && @sysvar::IL_CAN1::NODES::N_Sender::MESSAGES::LFE::TIMINGS::EnableCyclic)
  {
    @sysvar::IL_CAN1::NODES::N_Sender::MESSAGES::LFE::TIMINGS::SelectedPeriod = -1;
  }
}

on sysvar_update sysvar::IL_CAN1::NODES::N_Sender::MESSAGES::LFE::TIMINGS::SelectedPeriod
{
  if (@this == 0 && @sysvar::IL_CAN1::NODES::N_Sender::MESSAGES::LFE::TIMINGS::EnableCyclic)
  {
    SetBusContext(gILCAN1_BusContext);
    gCAN1DisturbancePeriod = @sysvar::IL_CAN1::NODES::N_Sender::MESSAGES::LFE::TIMINGS::NormalCyclePeriod;
    J1939ILSetMsgCycleTime(J1939::Sender::LFE, 100);
  }
  else if (@this == 1 && @sysvar::IL_CAN1::NODES::N_Sender::MESSAGES::LFE::TIMINGS::EnableCyclic)
  {
    SetBusContext(gILCAN1_BusContext);
    gCAN1DisturbancePeriod = @sysvar::IL_CAN1::NODES::N_Sender::MESSAGES::LFE::TIMINGS::ActiveCyclePeriod;
    J1939ILSetMsgCycleTime(J1939::Sender::LFE, gCAN1DisturbancePeriod);
  }
  else if (@this == -1 && @sysvar::IL_CAN1::NODES::N_Sender::MESSAGES::LFE::TIMINGS::EnableCyclic)
  {
    SetBusContext(gILCAN1_BusContext);
    gCAN1DisturbancePeriod = @sysvar::IL_CAN1::NODES::N_Sender::MESSAGES::LFE::TIMINGS::CyclePeriod;
    J1939ILSetMsgCycleTime(J1939::Sender::LFE, gCAN1DisturbancePeriod);
  }
}

on sysvar_update sysvar::IL_CAN1::NODES::N_Sender::MESSAGES::LFE::TIMINGS::SendOnce
{
  if (@this == 1)
  {
    SetBusContext(gILCAN1_BusContext);
    J1939ILSetMsgEvent(J1939::Sender::LFE);
  }
}

on sysvar_update sysvar::IL_CAN1::NODES::N_Sender::MESSAGES::PTO::TIMINGS::EnableCyclic
{
  if (@this == 1)
  {
    SetBusContext(gILCAN1_BusContext);
    J1939ILEnableMsg  (J1939::Sender::PTO);
  }
  else
  {
    SetBusContext(gILCAN1_BusContext);
    J1939ILDisableMsg (J1939::Sender::PTO);
  }
}

on sysvar_update sysvar::IL_CAN1::NODES::N_Sender::MESSAGES::PTO::TIMINGS::SetNormalCycle
{
  if (@this == 1 && @sysvar::IL_CAN1::NODES::N_Sender::MESSAGES::PTO::TIMINGS::EnableCyclic)
  {
    @sysvar::IL_CAN1::NODES::N_Sender::MESSAGES::PTO::TIMINGS::SelectedPeriod = 0;
  }
}

on sysvar_update sysvar::IL_CAN1::NODES::N_Sender::MESSAGES::PTO::TIMINGS::SetNewCycleContinously
{
  if (@this == 1 && @sysvar::IL_CAN1::NODES::N_Sender::MESSAGES::PTO::TIMINGS::EnableCyclic)
  {
    @sysvar::IL_CAN1::NODES::N_Sender::MESSAGES::PTO::TIMINGS::SelectedPeriod = -1;
  }
}

on sysvar_update sysvar::IL_CAN1::NODES::N_Sender::MESSAGES::PTO::TIMINGS::SelectedPeriod
{
  if (@this == 0 && @sysvar::IL_CAN1::NODES::N_Sender::MESSAGES::PTO::TIMINGS::EnableCyclic)
  {
    SetBusContext(gILCAN1_BusContext);
    gCAN1DisturbancePeriod = @sysvar::IL_CAN1::NODES::N_Sender::MESSAGES::PTO::TIMINGS::NormalCyclePeriod;
    J1939ILSetMsgCycleTime(J1939::Sender::PTO, 100);
  }
  else if (@this == 1 && @sysvar::IL_CAN1::NODES::N_Sender::MESSAGES::PTO::TIMINGS::EnableCyclic)
  {
    SetBusContext(gILCAN1_BusContext);
    gCAN1DisturbancePeriod = @sysvar::IL_CAN1::NODES::N_Sender::MESSAGES::PTO::TIMINGS::ActiveCyclePeriod;
    J1939ILSetMsgCycleTime(J1939::Sender::PTO, gCAN1DisturbancePeriod);
  }
  else if (@this == -1 && @sysvar::IL_CAN1::NODES::N_Sender::MESSAGES::PTO::TIMINGS::EnableCyclic)
  {
    SetBusContext(gILCAN1_BusContext);
    gCAN1DisturbancePeriod = @sysvar::IL_CAN1::NODES::N_Sender::MESSAGES::PTO::TIMINGS::CyclePeriod;
    J1939ILSetMsgCycleTime(J1939::Sender::PTO, gCAN1DisturbancePeriod);
  }
}

on sysvar_update sysvar::IL_CAN1::NODES::N_Sender::MESSAGES::PTO::TIMINGS::SendOnce
{
  if (@this == 1)
  {
    SetBusContext(gILCAN1_BusContext);
    J1939ILSetMsgEvent(J1939::Sender::PTO);
  }
}

on sysvar_update sysvar::IL_CAN1::NODES::N_Sender::MESSAGES::RC::TIMINGS::EnableCyclic
{
  if (@this == 1)
  {
    SetBusContext(gILCAN1_BusContext);
    J1939ILEnableMsg  (J1939::Sender::RC);
  }
  else
  {
    SetBusContext(gILCAN1_BusContext);
    J1939ILDisableMsg (J1939::Sender::RC);
  }
}

on sysvar_update sysvar::IL_CAN1::NODES::N_Sender::MESSAGES::RC::TIMINGS::SetNormalCycle
{
  if (@this == 1 && @sysvar::IL_CAN1::NODES::N_Sender::MESSAGES::RC::TIMINGS::EnableCyclic)
  {
    @sysvar::IL_CAN1::NODES::N_Sender::MESSAGES::RC::TIMINGS::SelectedPeriod = 0;
  }
}

on sysvar_update sysvar::IL_CAN1::NODES::N_Sender::MESSAGES::RC::TIMINGS::SetNewCycleContinously
{
  if (@this == 1 && @sysvar::IL_CAN1::NODES::N_Sender::MESSAGES::RC::TIMINGS::EnableCyclic)
  {
    @sysvar::IL_CAN1::NODES::N_Sender::MESSAGES::RC::TIMINGS::SelectedPeriod = -1;
  }
}

on sysvar_update sysvar::IL_CAN1::NODES::N_Sender::MESSAGES::RC::TIMINGS::SelectedPeriod
{
  if (@this == 0 && @sysvar::IL_CAN1::NODES::N_Sender::MESSAGES::RC::TIMINGS::EnableCyclic)
  {
    SetBusContext(gILCAN1_BusContext);
    gCAN1DisturbancePeriod = @sysvar::IL_CAN1::NODES::N_Sender::MESSAGES::RC::TIMINGS::NormalCyclePeriod;
    J1939ILSetMsgCycleTime(J1939::Sender::RC, 0);
  }
  else if (@this == 1 && @sysvar::IL_CAN1::NODES::N_Sender::MESSAGES::RC::TIMINGS::EnableCyclic)
  {
    SetBusContext(gILCAN1_BusContext);
    gCAN1DisturbancePeriod = @sysvar::IL_CAN1::NODES::N_Sender::MESSAGES::RC::TIMINGS::ActiveCyclePeriod;
    J1939ILSetMsgCycleTime(J1939::Sender::RC, gCAN1DisturbancePeriod);
  }
  else if (@this == -1 && @sysvar::IL_CAN1::NODES::N_Sender::MESSAGES::RC::TIMINGS::EnableCyclic)
  {
    SetBusContext(gILCAN1_BusContext);
    gCAN1DisturbancePeriod = @sysvar::IL_CAN1::NODES::N_Sender::MESSAGES::RC::TIMINGS::CyclePeriod;
    J1939ILSetMsgCycleTime(J1939::Sender::RC, gCAN1DisturbancePeriod);
  }
}

on sysvar_update sysvar::IL_CAN1::NODES::N_Sender::MESSAGES::RC::TIMINGS::SendOnce
{
  if (@this == 1)
  {
    SetBusContext(gILCAN1_BusContext);
    J1939ILSetMsgEvent(J1939::Sender::RC);
  }
}

on sysvar_update sysvar::IL_CAN1::NODES::N_Sender::MESSAGES::RESET::TIMINGS::EnableCyclic
{
  if (@this == 1)
  {
    SetBusContext(gILCAN1_BusContext);
    J1939ILEnableMsg  (J1939::Sender::RESET);
  }
  else
  {
    SetBusContext(gILCAN1_BusContext);
    J1939ILDisableMsg (J1939::Sender::RESET);
  }
}

on sysvar_update sysvar::IL_CAN1::NODES::N_Sender::MESSAGES::RESET::TIMINGS::SetNormalCycle
{
  if (@this == 1 && @sysvar::IL_CAN1::NODES::N_Sender::MESSAGES::RESET::TIMINGS::EnableCyclic)
  {
    @sysvar::IL_CAN1::NODES::N_Sender::MESSAGES::RESET::TIMINGS::SelectedPeriod = 0;
  }
}

on sysvar_update sysvar::IL_CAN1::NODES::N_Sender::MESSAGES::RESET::TIMINGS::SetNewCycleContinously
{
  if (@this == 1 && @sysvar::IL_CAN1::NODES::N_Sender::MESSAGES::RESET::TIMINGS::EnableCyclic)
  {
    @sysvar::IL_CAN1::NODES::N_Sender::MESSAGES::RESET::TIMINGS::SelectedPeriod = -1;
  }
}

on sysvar_update sysvar::IL_CAN1::NODES::N_Sender::MESSAGES::RESET::TIMINGS::SelectedPeriod
{
  if (@this == 0 && @sysvar::IL_CAN1::NODES::N_Sender::MESSAGES::RESET::TIMINGS::EnableCyclic)
  {
    SetBusContext(gILCAN1_BusContext);
    gCAN1DisturbancePeriod = @sysvar::IL_CAN1::NODES::N_Sender::MESSAGES::RESET::TIMINGS::NormalCyclePeriod;
    J1939ILSetMsgCycleTime(J1939::Sender::RESET, 0);
  }
  else if (@this == 1 && @sysvar::IL_CAN1::NODES::N_Sender::MESSAGES::RESET::TIMINGS::EnableCyclic)
  {
    SetBusContext(gILCAN1_BusContext);
    gCAN1DisturbancePeriod = @sysvar::IL_CAN1::NODES::N_Sender::MESSAGES::RESET::TIMINGS::ActiveCyclePeriod;
    J1939ILSetMsgCycleTime(J1939::Sender::RESET, gCAN1DisturbancePeriod);
  }
  else if (@this == -1 && @sysvar::IL_CAN1::NODES::N_Sender::MESSAGES::RESET::TIMINGS::EnableCyclic)
  {
    SetBusContext(gILCAN1_BusContext);
    gCAN1DisturbancePeriod = @sysvar::IL_CAN1::NODES::N_Sender::MESSAGES::RESET::TIMINGS::CyclePeriod;
    J1939ILSetMsgCycleTime(J1939::Sender::RESET, gCAN1DisturbancePeriod);
  }
}

on sysvar_update sysvar::IL_CAN1::NODES::N_Sender::MESSAGES::RESET::TIMINGS::SendOnce
{
  if (@this == 1)
  {
    SetBusContext(gILCAN1_BusContext);
    J1939ILSetMsgEvent(J1939::Sender::RESET);
  }
}

on sysvar_update sysvar::IL_CAN1::NODES::N_Sender::MESSAGES::RF::TIMINGS::EnableCyclic
{
  if (@this == 1)
  {
    SetBusContext(gILCAN1_BusContext);
    J1939ILEnableMsg  (J1939::Sender::RF);
  }
  else
  {
    SetBusContext(gILCAN1_BusContext);
    J1939ILDisableMsg (J1939::Sender::RF);
  }
}

on sysvar_update sysvar::IL_CAN1::NODES::N_Sender::MESSAGES::RF::TIMINGS::SetNormalCycle
{
  if (@this == 1 && @sysvar::IL_CAN1::NODES::N_Sender::MESSAGES::RF::TIMINGS::EnableCyclic)
  {
    @sysvar::IL_CAN1::NODES::N_Sender::MESSAGES::RF::TIMINGS::SelectedPeriod = 0;
  }
}

on sysvar_update sysvar::IL_CAN1::NODES::N_Sender::MESSAGES::RF::TIMINGS::SetNewCycleContinously
{
  if (@this == 1 && @sysvar::IL_CAN1::NODES::N_Sender::MESSAGES::RF::TIMINGS::EnableCyclic)
  {
    @sysvar::IL_CAN1::NODES::N_Sender::MESSAGES::RF::TIMINGS::SelectedPeriod = -1;
  }
}

on sysvar_update sysvar::IL_CAN1::NODES::N_Sender::MESSAGES::RF::TIMINGS::SelectedPeriod
{
  if (@this == 0 && @sysvar::IL_CAN1::NODES::N_Sender::MESSAGES::RF::TIMINGS::EnableCyclic)
  {
    SetBusContext(gILCAN1_BusContext);
    gCAN1DisturbancePeriod = @sysvar::IL_CAN1::NODES::N_Sender::MESSAGES::RF::TIMINGS::NormalCyclePeriod;
    J1939ILSetMsgCycleTime(J1939::Sender::RF, 1000);
  }
  else if (@this == 1 && @sysvar::IL_CAN1::NODES::N_Sender::MESSAGES::RF::TIMINGS::EnableCyclic)
  {
    SetBusContext(gILCAN1_BusContext);
    gCAN1DisturbancePeriod = @sysvar::IL_CAN1::NODES::N_Sender::MESSAGES::RF::TIMINGS::ActiveCyclePeriod;
    J1939ILSetMsgCycleTime(J1939::Sender::RF, gCAN1DisturbancePeriod);
  }
  else if (@this == -1 && @sysvar::IL_CAN1::NODES::N_Sender::MESSAGES::RF::TIMINGS::EnableCyclic)
  {
    SetBusContext(gILCAN1_BusContext);
    gCAN1DisturbancePeriod = @sysvar::IL_CAN1::NODES::N_Sender::MESSAGES::RF::TIMINGS::CyclePeriod;
    J1939ILSetMsgCycleTime(J1939::Sender::RF, gCAN1DisturbancePeriod);
  }
}

on sysvar_update sysvar::IL_CAN1::NODES::N_Sender::MESSAGES::RF::TIMINGS::SendOnce
{
  if (@this == 1)
  {
    SetBusContext(gILCAN1_BusContext);
    J1939ILSetMsgEvent(J1939::Sender::RF);
  }
}

on sysvar_update sysvar::IL_CAN1::NODES::N_Sender::MESSAGES::RQST::TIMINGS::EnableCyclic
{
  if (@this == 1)
  {
    SetBusContext(gILCAN1_BusContext);
    J1939ILEnableMsg  (J1939::Sender::RQST);
  }
  else
  {
    SetBusContext(gILCAN1_BusContext);
    J1939ILDisableMsg (J1939::Sender::RQST);
  }
}

on sysvar_update sysvar::IL_CAN1::NODES::N_Sender::MESSAGES::RQST::TIMINGS::SetNormalCycle
{
  if (@this == 1 && @sysvar::IL_CAN1::NODES::N_Sender::MESSAGES::RQST::TIMINGS::EnableCyclic)
  {
    @sysvar::IL_CAN1::NODES::N_Sender::MESSAGES::RQST::TIMINGS::SelectedPeriod = 0;
  }
}

on sysvar_update sysvar::IL_CAN1::NODES::N_Sender::MESSAGES::RQST::TIMINGS::SetNewCycleContinously
{
  if (@this == 1 && @sysvar::IL_CAN1::NODES::N_Sender::MESSAGES::RQST::TIMINGS::EnableCyclic)
  {
    @sysvar::IL_CAN1::NODES::N_Sender::MESSAGES::RQST::TIMINGS::SelectedPeriod = -1;
  }
}

on sysvar_update sysvar::IL_CAN1::NODES::N_Sender::MESSAGES::RQST::TIMINGS::SelectedPeriod
{
  if (@this == 0 && @sysvar::IL_CAN1::NODES::N_Sender::MESSAGES::RQST::TIMINGS::EnableCyclic)
  {
    SetBusContext(gILCAN1_BusContext);
    gCAN1DisturbancePeriod = @sysvar::IL_CAN1::NODES::N_Sender::MESSAGES::RQST::TIMINGS::NormalCyclePeriod;
    J1939ILSetMsgCycleTime(J1939::Sender::RQST, 0);
  }
  else if (@this == 1 && @sysvar::IL_CAN1::NODES::N_Sender::MESSAGES::RQST::TIMINGS::EnableCyclic)
  {
    SetBusContext(gILCAN1_BusContext);
    gCAN1DisturbancePeriod = @sysvar::IL_CAN1::NODES::N_Sender::MESSAGES::RQST::TIMINGS::ActiveCyclePeriod;
    J1939ILSetMsgCycleTime(J1939::Sender::RQST, gCAN1DisturbancePeriod);
  }
  else if (@this == -1 && @sysvar::IL_CAN1::NODES::N_Sender::MESSAGES::RQST::TIMINGS::EnableCyclic)
  {
    SetBusContext(gILCAN1_BusContext);
    gCAN1DisturbancePeriod = @sysvar::IL_CAN1::NODES::N_Sender::MESSAGES::RQST::TIMINGS::CyclePeriod;
    J1939ILSetMsgCycleTime(J1939::Sender::RQST, gCAN1DisturbancePeriod);
  }
}

on sysvar_update sysvar::IL_CAN1::NODES::N_Sender::MESSAGES::RQST::TIMINGS::SendOnce
{
  if (@this == 1)
  {
    SetBusContext(gILCAN1_BusContext);
    J1939ILSetMsgEvent(J1939::Sender::RQST);
  }
}

on sysvar_update sysvar::IL_CAN1::NODES::N_Sender::MESSAGES::RQST2::TIMINGS::EnableCyclic
{
  if (@this == 1)
  {
    SetBusContext(gILCAN1_BusContext);
    J1939ILEnableMsg  (J1939::Sender::RQST2);
  }
  else
  {
    SetBusContext(gILCAN1_BusContext);
    J1939ILDisableMsg (J1939::Sender::RQST2);
  }
}

on sysvar_update sysvar::IL_CAN1::NODES::N_Sender::MESSAGES::RQST2::TIMINGS::SetNormalCycle
{
  if (@this == 1 && @sysvar::IL_CAN1::NODES::N_Sender::MESSAGES::RQST2::TIMINGS::EnableCyclic)
  {
    @sysvar::IL_CAN1::NODES::N_Sender::MESSAGES::RQST2::TIMINGS::SelectedPeriod = 0;
  }
}

on sysvar_update sysvar::IL_CAN1::NODES::N_Sender::MESSAGES::RQST2::TIMINGS::SetNewCycleContinously
{
  if (@this == 1 && @sysvar::IL_CAN1::NODES::N_Sender::MESSAGES::RQST2::TIMINGS::EnableCyclic)
  {
    @sysvar::IL_CAN1::NODES::N_Sender::MESSAGES::RQST2::TIMINGS::SelectedPeriod = -1;
  }
}

on sysvar_update sysvar::IL_CAN1::NODES::N_Sender::MESSAGES::RQST2::TIMINGS::SelectedPeriod
{
  if (@this == 0 && @sysvar::IL_CAN1::NODES::N_Sender::MESSAGES::RQST2::TIMINGS::EnableCyclic)
  {
    SetBusContext(gILCAN1_BusContext);
    gCAN1DisturbancePeriod = @sysvar::IL_CAN1::NODES::N_Sender::MESSAGES::RQST2::TIMINGS::NormalCyclePeriod;
    J1939ILSetMsgCycleTime(J1939::Sender::RQST2, 0);
  }
  else if (@this == 1 && @sysvar::IL_CAN1::NODES::N_Sender::MESSAGES::RQST2::TIMINGS::EnableCyclic)
  {
    SetBusContext(gILCAN1_BusContext);
    gCAN1DisturbancePeriod = @sysvar::IL_CAN1::NODES::N_Sender::MESSAGES::RQST2::TIMINGS::ActiveCyclePeriod;
    J1939ILSetMsgCycleTime(J1939::Sender::RQST2, gCAN1DisturbancePeriod);
  }
  else if (@this == -1 && @sysvar::IL_CAN1::NODES::N_Sender::MESSAGES::RQST2::TIMINGS::EnableCyclic)
  {
    SetBusContext(gILCAN1_BusContext);
    gCAN1DisturbancePeriod = @sysvar::IL_CAN1::NODES::N_Sender::MESSAGES::RQST2::TIMINGS::CyclePeriod;
    J1939ILSetMsgCycleTime(J1939::Sender::RQST2, gCAN1DisturbancePeriod);
  }
}

on sysvar_update sysvar::IL_CAN1::NODES::N_Sender::MESSAGES::RQST2::TIMINGS::SendOnce
{
  if (@this == 1)
  {
    SetBusContext(gILCAN1_BusContext);
    J1939ILSetMsgEvent(J1939::Sender::RQST2);
  }
}

on sysvar_update sysvar::IL_CAN1::NODES::N_Sender::MESSAGES::SERV::TIMINGS::EnableCyclic
{
  if (@this == 1)
  {
    SetBusContext(gILCAN1_BusContext);
    J1939ILEnableMsg  (J1939::Sender::SERV);
  }
  else
  {
    SetBusContext(gILCAN1_BusContext);
    J1939ILDisableMsg (J1939::Sender::SERV);
  }
}

on sysvar_update sysvar::IL_CAN1::NODES::N_Sender::MESSAGES::SERV::TIMINGS::SetNormalCycle
{
  if (@this == 1 && @sysvar::IL_CAN1::NODES::N_Sender::MESSAGES::SERV::TIMINGS::EnableCyclic)
  {
    @sysvar::IL_CAN1::NODES::N_Sender::MESSAGES::SERV::TIMINGS::SelectedPeriod = 0;
  }
}

on sysvar_update sysvar::IL_CAN1::NODES::N_Sender::MESSAGES::SERV::TIMINGS::SetNewCycleContinously
{
  if (@this == 1 && @sysvar::IL_CAN1::NODES::N_Sender::MESSAGES::SERV::TIMINGS::EnableCyclic)
  {
    @sysvar::IL_CAN1::NODES::N_Sender::MESSAGES::SERV::TIMINGS::SelectedPeriod = -1;
  }
}

on sysvar_update sysvar::IL_CAN1::NODES::N_Sender::MESSAGES::SERV::TIMINGS::SelectedPeriod
{
  if (@this == 0 && @sysvar::IL_CAN1::NODES::N_Sender::MESSAGES::SERV::TIMINGS::EnableCyclic)
  {
    SetBusContext(gILCAN1_BusContext);
    gCAN1DisturbancePeriod = @sysvar::IL_CAN1::NODES::N_Sender::MESSAGES::SERV::TIMINGS::NormalCyclePeriod;
    J1939ILSetMsgCycleTime(J1939::Sender::SERV, 0);
  }
  else if (@this == 1 && @sysvar::IL_CAN1::NODES::N_Sender::MESSAGES::SERV::TIMINGS::EnableCyclic)
  {
    SetBusContext(gILCAN1_BusContext);
    gCAN1DisturbancePeriod = @sysvar::IL_CAN1::NODES::N_Sender::MESSAGES::SERV::TIMINGS::ActiveCyclePeriod;
    J1939ILSetMsgCycleTime(J1939::Sender::SERV, gCAN1DisturbancePeriod);
  }
  else if (@this == -1 && @sysvar::IL_CAN1::NODES::N_Sender::MESSAGES::SERV::TIMINGS::EnableCyclic)
  {
    SetBusContext(gILCAN1_BusContext);
    gCAN1DisturbancePeriod = @sysvar::IL_CAN1::NODES::N_Sender::MESSAGES::SERV::TIMINGS::CyclePeriod;
    J1939ILSetMsgCycleTime(J1939::Sender::SERV, gCAN1DisturbancePeriod);
  }
}

on sysvar_update sysvar::IL_CAN1::NODES::N_Sender::MESSAGES::SERV::TIMINGS::SendOnce
{
  if (@this == 1)
  {
    SetBusContext(gILCAN1_BusContext);
    J1939ILSetMsgEvent(J1939::Sender::SERV);
  }
}

on sysvar_update sysvar::IL_CAN1::NODES::N_Sender::MESSAGES::SHUTDOW::TIMINGS::EnableCyclic
{
  if (@this == 1)
  {
    SetBusContext(gILCAN1_BusContext);
    J1939ILEnableMsg  (J1939::Sender::SHUTDOW);
  }
  else
  {
    SetBusContext(gILCAN1_BusContext);
    J1939ILDisableMsg (J1939::Sender::SHUTDOW);
  }
}

on sysvar_update sysvar::IL_CAN1::NODES::N_Sender::MESSAGES::SHUTDOW::TIMINGS::SetNormalCycle
{
  if (@this == 1 && @sysvar::IL_CAN1::NODES::N_Sender::MESSAGES::SHUTDOW::TIMINGS::EnableCyclic)
  {
    @sysvar::IL_CAN1::NODES::N_Sender::MESSAGES::SHUTDOW::TIMINGS::SelectedPeriod = 0;
  }
}

on sysvar_update sysvar::IL_CAN1::NODES::N_Sender::MESSAGES::SHUTDOW::TIMINGS::SetNewCycleContinously
{
  if (@this == 1 && @sysvar::IL_CAN1::NODES::N_Sender::MESSAGES::SHUTDOW::TIMINGS::EnableCyclic)
  {
    @sysvar::IL_CAN1::NODES::N_Sender::MESSAGES::SHUTDOW::TIMINGS::SelectedPeriod = -1;
  }
}

on sysvar_update sysvar::IL_CAN1::NODES::N_Sender::MESSAGES::SHUTDOW::TIMINGS::SelectedPeriod
{
  if (@this == 0 && @sysvar::IL_CAN1::NODES::N_Sender::MESSAGES::SHUTDOW::TIMINGS::EnableCyclic)
  {
    SetBusContext(gILCAN1_BusContext);
    gCAN1DisturbancePeriod = @sysvar::IL_CAN1::NODES::N_Sender::MESSAGES::SHUTDOW::TIMINGS::NormalCyclePeriod;
    J1939ILSetMsgCycleTime(J1939::Sender::SHUTDOW, 1000);
  }
  else if (@this == 1 && @sysvar::IL_CAN1::NODES::N_Sender::MESSAGES::SHUTDOW::TIMINGS::EnableCyclic)
  {
    SetBusContext(gILCAN1_BusContext);
    gCAN1DisturbancePeriod = @sysvar::IL_CAN1::NODES::N_Sender::MESSAGES::SHUTDOW::TIMINGS::ActiveCyclePeriod;
    J1939ILSetMsgCycleTime(J1939::Sender::SHUTDOW, gCAN1DisturbancePeriod);
  }
  else if (@this == -1 && @sysvar::IL_CAN1::NODES::N_Sender::MESSAGES::SHUTDOW::TIMINGS::EnableCyclic)
  {
    SetBusContext(gILCAN1_BusContext);
    gCAN1DisturbancePeriod = @sysvar::IL_CAN1::NODES::N_Sender::MESSAGES::SHUTDOW::TIMINGS::CyclePeriod;
    J1939ILSetMsgCycleTime(J1939::Sender::SHUTDOW, gCAN1DisturbancePeriod);
  }
}

on sysvar_update sysvar::IL_CAN1::NODES::N_Sender::MESSAGES::SHUTDOW::TIMINGS::SendOnce
{
  if (@this == 1)
  {
    SetBusContext(gILCAN1_BusContext);
    J1939ILSetMsgEvent(J1939::Sender::SHUTDOW);
  }
}

on sysvar_update sysvar::IL_CAN1::NODES::N_Sender::MESSAGES::SOFT::TIMINGS::EnableCyclic
{
  if (@this == 1)
  {
    SetBusContext(gILCAN1_BusContext);
    J1939ILEnableMsg  (J1939::Sender::SOFT);
  }
  else
  {
    SetBusContext(gILCAN1_BusContext);
    J1939ILDisableMsg (J1939::Sender::SOFT);
  }
}

on sysvar_update sysvar::IL_CAN1::NODES::N_Sender::MESSAGES::SOFT::TIMINGS::SetNormalCycle
{
  if (@this == 1 && @sysvar::IL_CAN1::NODES::N_Sender::MESSAGES::SOFT::TIMINGS::EnableCyclic)
  {
    @sysvar::IL_CAN1::NODES::N_Sender::MESSAGES::SOFT::TIMINGS::SelectedPeriod = 0;
  }
}

on sysvar_update sysvar::IL_CAN1::NODES::N_Sender::MESSAGES::SOFT::TIMINGS::SetNewCycleContinously
{
  if (@this == 1 && @sysvar::IL_CAN1::NODES::N_Sender::MESSAGES::SOFT::TIMINGS::EnableCyclic)
  {
    @sysvar::IL_CAN1::NODES::N_Sender::MESSAGES::SOFT::TIMINGS::SelectedPeriod = -1;
  }
}

on sysvar_update sysvar::IL_CAN1::NODES::N_Sender::MESSAGES::SOFT::TIMINGS::SelectedPeriod
{
  if (@this == 0 && @sysvar::IL_CAN1::NODES::N_Sender::MESSAGES::SOFT::TIMINGS::EnableCyclic)
  {
    SetBusContext(gILCAN1_BusContext);
    gCAN1DisturbancePeriod = @sysvar::IL_CAN1::NODES::N_Sender::MESSAGES::SOFT::TIMINGS::NormalCyclePeriod;
    J1939ILSetMsgCycleTime(J1939::Sender::SOFT, 0);
  }
  else if (@this == 1 && @sysvar::IL_CAN1::NODES::N_Sender::MESSAGES::SOFT::TIMINGS::EnableCyclic)
  {
    SetBusContext(gILCAN1_BusContext);
    gCAN1DisturbancePeriod = @sysvar::IL_CAN1::NODES::N_Sender::MESSAGES::SOFT::TIMINGS::ActiveCyclePeriod;
    J1939ILSetMsgCycleTime(J1939::Sender::SOFT, gCAN1DisturbancePeriod);
  }
  else if (@this == -1 && @sysvar::IL_CAN1::NODES::N_Sender::MESSAGES::SOFT::TIMINGS::EnableCyclic)
  {
    SetBusContext(gILCAN1_BusContext);
    gCAN1DisturbancePeriod = @sysvar::IL_CAN1::NODES::N_Sender::MESSAGES::SOFT::TIMINGS::CyclePeriod;
    J1939ILSetMsgCycleTime(J1939::Sender::SOFT, gCAN1DisturbancePeriod);
  }
}

on sysvar_update sysvar::IL_CAN1::NODES::N_Sender::MESSAGES::SOFT::TIMINGS::SendOnce
{
  if (@this == 1)
  {
    SetBusContext(gILCAN1_BusContext);
    J1939ILSetMsgEvent(J1939::Sender::SOFT);
  }
}

on sysvar_update sysvar::IL_CAN1::NODES::N_Sender::MESSAGES::SPR::TIMINGS::EnableCyclic
{
  if (@this == 1)
  {
    SetBusContext(gILCAN1_BusContext);
    J1939ILEnableMsg  (J1939::Sender::SPR);
  }
  else
  {
    SetBusContext(gILCAN1_BusContext);
    J1939ILDisableMsg (J1939::Sender::SPR);
  }
}

on sysvar_update sysvar::IL_CAN1::NODES::N_Sender::MESSAGES::SPR::TIMINGS::SetNormalCycle
{
  if (@this == 1 && @sysvar::IL_CAN1::NODES::N_Sender::MESSAGES::SPR::TIMINGS::EnableCyclic)
  {
    @sysvar::IL_CAN1::NODES::N_Sender::MESSAGES::SPR::TIMINGS::SelectedPeriod = 0;
  }
}

on sysvar_update sysvar::IL_CAN1::NODES::N_Sender::MESSAGES::SPR::TIMINGS::SetNewCycleContinously
{
  if (@this == 1 && @sysvar::IL_CAN1::NODES::N_Sender::MESSAGES::SPR::TIMINGS::EnableCyclic)
  {
    @sysvar::IL_CAN1::NODES::N_Sender::MESSAGES::SPR::TIMINGS::SelectedPeriod = -1;
  }
}

on sysvar_update sysvar::IL_CAN1::NODES::N_Sender::MESSAGES::SPR::TIMINGS::SelectedPeriod
{
  if (@this == 0 && @sysvar::IL_CAN1::NODES::N_Sender::MESSAGES::SPR::TIMINGS::EnableCyclic)
  {
    SetBusContext(gILCAN1_BusContext);
    gCAN1DisturbancePeriod = @sysvar::IL_CAN1::NODES::N_Sender::MESSAGES::SPR::TIMINGS::NormalCyclePeriod;
    J1939ILSetMsgCycleTime(J1939::Sender::SPR, 1000);
  }
  else if (@this == 1 && @sysvar::IL_CAN1::NODES::N_Sender::MESSAGES::SPR::TIMINGS::EnableCyclic)
  {
    SetBusContext(gILCAN1_BusContext);
    gCAN1DisturbancePeriod = @sysvar::IL_CAN1::NODES::N_Sender::MESSAGES::SPR::TIMINGS::ActiveCyclePeriod;
    J1939ILSetMsgCycleTime(J1939::Sender::SPR, gCAN1DisturbancePeriod);
  }
  else if (@this == -1 && @sysvar::IL_CAN1::NODES::N_Sender::MESSAGES::SPR::TIMINGS::EnableCyclic)
  {
    SetBusContext(gILCAN1_BusContext);
    gCAN1DisturbancePeriod = @sysvar::IL_CAN1::NODES::N_Sender::MESSAGES::SPR::TIMINGS::CyclePeriod;
    J1939ILSetMsgCycleTime(J1939::Sender::SPR, gCAN1DisturbancePeriod);
  }
}

on sysvar_update sysvar::IL_CAN1::NODES::N_Sender::MESSAGES::SPR::TIMINGS::SendOnce
{
  if (@this == 1)
  {
    SetBusContext(gILCAN1_BusContext);
    J1939ILSetMsgEvent(J1939::Sender::SPR);
  }
}

on sysvar_update sysvar::IL_CAN1::NODES::N_Sender::MESSAGES::TC::TIMINGS::EnableCyclic
{
  if (@this == 1)
  {
    SetBusContext(gILCAN1_BusContext);
    J1939ILEnableMsg  (J1939::Sender::TC);
  }
  else
  {
    SetBusContext(gILCAN1_BusContext);
    J1939ILDisableMsg (J1939::Sender::TC);
  }
}

on sysvar_update sysvar::IL_CAN1::NODES::N_Sender::MESSAGES::TC::TIMINGS::SetNormalCycle
{
  if (@this == 1 && @sysvar::IL_CAN1::NODES::N_Sender::MESSAGES::TC::TIMINGS::EnableCyclic)
  {
    @sysvar::IL_CAN1::NODES::N_Sender::MESSAGES::TC::TIMINGS::SelectedPeriod = 0;
  }
}

on sysvar_update sysvar::IL_CAN1::NODES::N_Sender::MESSAGES::TC::TIMINGS::SetNewCycleContinously
{
  if (@this == 1 && @sysvar::IL_CAN1::NODES::N_Sender::MESSAGES::TC::TIMINGS::EnableCyclic)
  {
    @sysvar::IL_CAN1::NODES::N_Sender::MESSAGES::TC::TIMINGS::SelectedPeriod = -1;
  }
}

on sysvar_update sysvar::IL_CAN1::NODES::N_Sender::MESSAGES::TC::TIMINGS::SelectedPeriod
{
  if (@this == 0 && @sysvar::IL_CAN1::NODES::N_Sender::MESSAGES::TC::TIMINGS::EnableCyclic)
  {
    SetBusContext(gILCAN1_BusContext);
    gCAN1DisturbancePeriod = @sysvar::IL_CAN1::NODES::N_Sender::MESSAGES::TC::TIMINGS::NormalCyclePeriod;
    J1939ILSetMsgCycleTime(J1939::Sender::TC, 1000);
  }
  else if (@this == 1 && @sysvar::IL_CAN1::NODES::N_Sender::MESSAGES::TC::TIMINGS::EnableCyclic)
  {
    SetBusContext(gILCAN1_BusContext);
    gCAN1DisturbancePeriod = @sysvar::IL_CAN1::NODES::N_Sender::MESSAGES::TC::TIMINGS::ActiveCyclePeriod;
    J1939ILSetMsgCycleTime(J1939::Sender::TC, gCAN1DisturbancePeriod);
  }
  else if (@this == -1 && @sysvar::IL_CAN1::NODES::N_Sender::MESSAGES::TC::TIMINGS::EnableCyclic)
  {
    SetBusContext(gILCAN1_BusContext);
    gCAN1DisturbancePeriod = @sysvar::IL_CAN1::NODES::N_Sender::MESSAGES::TC::TIMINGS::CyclePeriod;
    J1939ILSetMsgCycleTime(J1939::Sender::TC, gCAN1DisturbancePeriod);
  }
}

on sysvar_update sysvar::IL_CAN1::NODES::N_Sender::MESSAGES::TC::TIMINGS::SendOnce
{
  if (@this == 1)
  {
    SetBusContext(gILCAN1_BusContext);
    J1939ILSetMsgEvent(J1939::Sender::TC);
  }
}

on sysvar_update sysvar::IL_CAN1::NODES::N_Sender::MESSAGES::TC1::TIMINGS::EnableCyclic
{
  if (@this == 1)
  {
    SetBusContext(gILCAN1_BusContext);
    J1939ILEnableMsg  (J1939::Sender::TC1);
  }
  else
  {
    SetBusContext(gILCAN1_BusContext);
    J1939ILDisableMsg (J1939::Sender::TC1);
  }
}

on sysvar_update sysvar::IL_CAN1::NODES::N_Sender::MESSAGES::TC1::TIMINGS::SetNormalCycle
{
  if (@this == 1 && @sysvar::IL_CAN1::NODES::N_Sender::MESSAGES::TC1::TIMINGS::EnableCyclic)
  {
    @sysvar::IL_CAN1::NODES::N_Sender::MESSAGES::TC1::TIMINGS::SelectedPeriod = 0;
  }
}

on sysvar_update sysvar::IL_CAN1::NODES::N_Sender::MESSAGES::TC1::TIMINGS::SetNewCycleContinously
{
  if (@this == 1 && @sysvar::IL_CAN1::NODES::N_Sender::MESSAGES::TC1::TIMINGS::EnableCyclic)
  {
    @sysvar::IL_CAN1::NODES::N_Sender::MESSAGES::TC1::TIMINGS::SelectedPeriod = -1;
  }
}

on sysvar_update sysvar::IL_CAN1::NODES::N_Sender::MESSAGES::TC1::TIMINGS::SelectedPeriod
{
  if (@this == 0 && @sysvar::IL_CAN1::NODES::N_Sender::MESSAGES::TC1::TIMINGS::EnableCyclic)
  {
    SetBusContext(gILCAN1_BusContext);
    gCAN1DisturbancePeriod = @sysvar::IL_CAN1::NODES::N_Sender::MESSAGES::TC1::TIMINGS::NormalCyclePeriod;
    J1939ILSetMsgCycleTime(J1939::Sender::TC1, 0);
  }
  else if (@this == 1 && @sysvar::IL_CAN1::NODES::N_Sender::MESSAGES::TC1::TIMINGS::EnableCyclic)
  {
    SetBusContext(gILCAN1_BusContext);
    gCAN1DisturbancePeriod = @sysvar::IL_CAN1::NODES::N_Sender::MESSAGES::TC1::TIMINGS::ActiveCyclePeriod;
    J1939ILSetMsgCycleTime(J1939::Sender::TC1, gCAN1DisturbancePeriod);
  }
  else if (@this == -1 && @sysvar::IL_CAN1::NODES::N_Sender::MESSAGES::TC1::TIMINGS::EnableCyclic)
  {
    SetBusContext(gILCAN1_BusContext);
    gCAN1DisturbancePeriod = @sysvar::IL_CAN1::NODES::N_Sender::MESSAGES::TC1::TIMINGS::CyclePeriod;
    J1939ILSetMsgCycleTime(J1939::Sender::TC1, gCAN1DisturbancePeriod);
  }
}

on sysvar_update sysvar::IL_CAN1::NODES::N_Sender::MESSAGES::TC1::TIMINGS::SendOnce
{
  if (@this == 1)
  {
    SetBusContext(gILCAN1_BusContext);
    J1939ILSetMsgEvent(J1939::Sender::TC1);
  }
}

on sysvar_update sysvar::IL_CAN1::NODES::N_Sender::MESSAGES::TCFG::TIMINGS::EnableCyclic
{
  if (@this == 1)
  {
    SetBusContext(gILCAN1_BusContext);
    J1939ILEnableMsg  (J1939::Sender::TCFG);
  }
  else
  {
    SetBusContext(gILCAN1_BusContext);
    J1939ILDisableMsg (J1939::Sender::TCFG);
  }
}

on sysvar_update sysvar::IL_CAN1::NODES::N_Sender::MESSAGES::TCFG::TIMINGS::SetNormalCycle
{
  if (@this == 1 && @sysvar::IL_CAN1::NODES::N_Sender::MESSAGES::TCFG::TIMINGS::EnableCyclic)
  {
    @sysvar::IL_CAN1::NODES::N_Sender::MESSAGES::TCFG::TIMINGS::SelectedPeriod = 0;
  }
}

on sysvar_update sysvar::IL_CAN1::NODES::N_Sender::MESSAGES::TCFG::TIMINGS::SetNewCycleContinously
{
  if (@this == 1 && @sysvar::IL_CAN1::NODES::N_Sender::MESSAGES::TCFG::TIMINGS::EnableCyclic)
  {
    @sysvar::IL_CAN1::NODES::N_Sender::MESSAGES::TCFG::TIMINGS::SelectedPeriod = -1;
  }
}

on sysvar_update sysvar::IL_CAN1::NODES::N_Sender::MESSAGES::TCFG::TIMINGS::SelectedPeriod
{
  if (@this == 0 && @sysvar::IL_CAN1::NODES::N_Sender::MESSAGES::TCFG::TIMINGS::EnableCyclic)
  {
    SetBusContext(gILCAN1_BusContext);
    gCAN1DisturbancePeriod = @sysvar::IL_CAN1::NODES::N_Sender::MESSAGES::TCFG::TIMINGS::NormalCyclePeriod;
    J1939ILSetMsgCycleTime(J1939::Sender::TCFG, 0);
  }
  else if (@this == 1 && @sysvar::IL_CAN1::NODES::N_Sender::MESSAGES::TCFG::TIMINGS::EnableCyclic)
  {
    SetBusContext(gILCAN1_BusContext);
    gCAN1DisturbancePeriod = @sysvar::IL_CAN1::NODES::N_Sender::MESSAGES::TCFG::TIMINGS::ActiveCyclePeriod;
    J1939ILSetMsgCycleTime(J1939::Sender::TCFG, gCAN1DisturbancePeriod);
  }
  else if (@this == -1 && @sysvar::IL_CAN1::NODES::N_Sender::MESSAGES::TCFG::TIMINGS::EnableCyclic)
  {
    SetBusContext(gILCAN1_BusContext);
    gCAN1DisturbancePeriod = @sysvar::IL_CAN1::NODES::N_Sender::MESSAGES::TCFG::TIMINGS::CyclePeriod;
    J1939ILSetMsgCycleTime(J1939::Sender::TCFG, gCAN1DisturbancePeriod);
  }
}

on sysvar_update sysvar::IL_CAN1::NODES::N_Sender::MESSAGES::TCFG::TIMINGS::SendOnce
{
  if (@this == 1)
  {
    SetBusContext(gILCAN1_BusContext);
    J1939ILSetMsgEvent(J1939::Sender::TCFG);
  }
}

on sysvar_update sysvar::IL_CAN1::NODES::N_Sender::MESSAGES::TCFG2::TIMINGS::EnableCyclic
{
  if (@this == 1)
  {
    SetBusContext(gILCAN1_BusContext);
    J1939ILEnableMsg  (J1939::Sender::TCFG2);
  }
  else
  {
    SetBusContext(gILCAN1_BusContext);
    J1939ILDisableMsg (J1939::Sender::TCFG2);
  }
}

on sysvar_update sysvar::IL_CAN1::NODES::N_Sender::MESSAGES::TCFG2::TIMINGS::SetNormalCycle
{
  if (@this == 1 && @sysvar::IL_CAN1::NODES::N_Sender::MESSAGES::TCFG2::TIMINGS::EnableCyclic)
  {
    @sysvar::IL_CAN1::NODES::N_Sender::MESSAGES::TCFG2::TIMINGS::SelectedPeriod = 0;
  }
}

on sysvar_update sysvar::IL_CAN1::NODES::N_Sender::MESSAGES::TCFG2::TIMINGS::SetNewCycleContinously
{
  if (@this == 1 && @sysvar::IL_CAN1::NODES::N_Sender::MESSAGES::TCFG2::TIMINGS::EnableCyclic)
  {
    @sysvar::IL_CAN1::NODES::N_Sender::MESSAGES::TCFG2::TIMINGS::SelectedPeriod = -1;
  }
}

on sysvar_update sysvar::IL_CAN1::NODES::N_Sender::MESSAGES::TCFG2::TIMINGS::SelectedPeriod
{
  if (@this == 0 && @sysvar::IL_CAN1::NODES::N_Sender::MESSAGES::TCFG2::TIMINGS::EnableCyclic)
  {
    SetBusContext(gILCAN1_BusContext);
    gCAN1DisturbancePeriod = @sysvar::IL_CAN1::NODES::N_Sender::MESSAGES::TCFG2::TIMINGS::NormalCyclePeriod;
    J1939ILSetMsgCycleTime(J1939::Sender::TCFG2, 0);
  }
  else if (@this == 1 && @sysvar::IL_CAN1::NODES::N_Sender::MESSAGES::TCFG2::TIMINGS::EnableCyclic)
  {
    SetBusContext(gILCAN1_BusContext);
    gCAN1DisturbancePeriod = @sysvar::IL_CAN1::NODES::N_Sender::MESSAGES::TCFG2::TIMINGS::ActiveCyclePeriod;
    J1939ILSetMsgCycleTime(J1939::Sender::TCFG2, gCAN1DisturbancePeriod);
  }
  else if (@this == -1 && @sysvar::IL_CAN1::NODES::N_Sender::MESSAGES::TCFG2::TIMINGS::EnableCyclic)
  {
    SetBusContext(gILCAN1_BusContext);
    gCAN1DisturbancePeriod = @sysvar::IL_CAN1::NODES::N_Sender::MESSAGES::TCFG2::TIMINGS::CyclePeriod;
    J1939ILSetMsgCycleTime(J1939::Sender::TCFG2, gCAN1DisturbancePeriod);
  }
}

on sysvar_update sysvar::IL_CAN1::NODES::N_Sender::MESSAGES::TCFG2::TIMINGS::SendOnce
{
  if (@this == 1)
  {
    SetBusContext(gILCAN1_BusContext);
    J1939ILSetMsgEvent(J1939::Sender::TCFG2);
  }
}

on sysvar_update sysvar::IL_CAN1::NODES::N_Sender::MESSAGES::TCO1::TIMINGS::EnableCyclic
{
  if (@this == 1)
  {
    SetBusContext(gILCAN1_BusContext);
    J1939ILEnableMsg  (J1939::Sender::TCO1);
  }
  else
  {
    SetBusContext(gILCAN1_BusContext);
    J1939ILDisableMsg (J1939::Sender::TCO1);
  }
}

on sysvar_update sysvar::IL_CAN1::NODES::N_Sender::MESSAGES::TCO1::TIMINGS::SetNormalCycle
{
  if (@this == 1 && @sysvar::IL_CAN1::NODES::N_Sender::MESSAGES::TCO1::TIMINGS::EnableCyclic)
  {
    @sysvar::IL_CAN1::NODES::N_Sender::MESSAGES::TCO1::TIMINGS::SelectedPeriod = 0;
  }
}

on sysvar_update sysvar::IL_CAN1::NODES::N_Sender::MESSAGES::TCO1::TIMINGS::SetNewCycleContinously
{
  if (@this == 1 && @sysvar::IL_CAN1::NODES::N_Sender::MESSAGES::TCO1::TIMINGS::EnableCyclic)
  {
    @sysvar::IL_CAN1::NODES::N_Sender::MESSAGES::TCO1::TIMINGS::SelectedPeriod = -1;
  }
}

on sysvar_update sysvar::IL_CAN1::NODES::N_Sender::MESSAGES::TCO1::TIMINGS::SelectedPeriod
{
  if (@this == 0 && @sysvar::IL_CAN1::NODES::N_Sender::MESSAGES::TCO1::TIMINGS::EnableCyclic)
  {
    SetBusContext(gILCAN1_BusContext);
    gCAN1DisturbancePeriod = @sysvar::IL_CAN1::NODES::N_Sender::MESSAGES::TCO1::TIMINGS::NormalCyclePeriod;
    J1939ILSetMsgCycleTime(J1939::Sender::TCO1, 50);
  }
  else if (@this == 1 && @sysvar::IL_CAN1::NODES::N_Sender::MESSAGES::TCO1::TIMINGS::EnableCyclic)
  {
    SetBusContext(gILCAN1_BusContext);
    gCAN1DisturbancePeriod = @sysvar::IL_CAN1::NODES::N_Sender::MESSAGES::TCO1::TIMINGS::ActiveCyclePeriod;
    J1939ILSetMsgCycleTime(J1939::Sender::TCO1, gCAN1DisturbancePeriod);
  }
  else if (@this == -1 && @sysvar::IL_CAN1::NODES::N_Sender::MESSAGES::TCO1::TIMINGS::EnableCyclic)
  {
    SetBusContext(gILCAN1_BusContext);
    gCAN1DisturbancePeriod = @sysvar::IL_CAN1::NODES::N_Sender::MESSAGES::TCO1::TIMINGS::CyclePeriod;
    J1939ILSetMsgCycleTime(J1939::Sender::TCO1, gCAN1DisturbancePeriod);
  }
}

on sysvar_update sysvar::IL_CAN1::NODES::N_Sender::MESSAGES::TCO1::TIMINGS::SendOnce
{
  if (@this == 1)
  {
    SetBusContext(gILCAN1_BusContext);
    J1939ILSetMsgEvent(J1939::Sender::TCO1);
  }
}

on sysvar_update sysvar::IL_CAN1::NODES::N_Sender::MESSAGES::TD::TIMINGS::EnableCyclic
{
  if (@this == 1)
  {
    SetBusContext(gILCAN1_BusContext);
    J1939ILEnableMsg  (J1939::Sender::TD);
  }
  else
  {
    SetBusContext(gILCAN1_BusContext);
    J1939ILDisableMsg (J1939::Sender::TD);
  }
}

on sysvar_update sysvar::IL_CAN1::NODES::N_Sender::MESSAGES::TD::TIMINGS::SetNormalCycle
{
  if (@this == 1 && @sysvar::IL_CAN1::NODES::N_Sender::MESSAGES::TD::TIMINGS::EnableCyclic)
  {
    @sysvar::IL_CAN1::NODES::N_Sender::MESSAGES::TD::TIMINGS::SelectedPeriod = 0;
  }
}

on sysvar_update sysvar::IL_CAN1::NODES::N_Sender::MESSAGES::TD::TIMINGS::SetNewCycleContinously
{
  if (@this == 1 && @sysvar::IL_CAN1::NODES::N_Sender::MESSAGES::TD::TIMINGS::EnableCyclic)
  {
    @sysvar::IL_CAN1::NODES::N_Sender::MESSAGES::TD::TIMINGS::SelectedPeriod = -1;
  }
}

on sysvar_update sysvar::IL_CAN1::NODES::N_Sender::MESSAGES::TD::TIMINGS::SelectedPeriod
{
  if (@this == 0 && @sysvar::IL_CAN1::NODES::N_Sender::MESSAGES::TD::TIMINGS::EnableCyclic)
  {
    SetBusContext(gILCAN1_BusContext);
    gCAN1DisturbancePeriod = @sysvar::IL_CAN1::NODES::N_Sender::MESSAGES::TD::TIMINGS::NormalCyclePeriod;
    J1939ILSetMsgCycleTime(J1939::Sender::TD, 0);
  }
  else if (@this == 1 && @sysvar::IL_CAN1::NODES::N_Sender::MESSAGES::TD::TIMINGS::EnableCyclic)
  {
    SetBusContext(gILCAN1_BusContext);
    gCAN1DisturbancePeriod = @sysvar::IL_CAN1::NODES::N_Sender::MESSAGES::TD::TIMINGS::ActiveCyclePeriod;
    J1939ILSetMsgCycleTime(J1939::Sender::TD, gCAN1DisturbancePeriod);
  }
  else if (@this == -1 && @sysvar::IL_CAN1::NODES::N_Sender::MESSAGES::TD::TIMINGS::EnableCyclic)
  {
    SetBusContext(gILCAN1_BusContext);
    gCAN1DisturbancePeriod = @sysvar::IL_CAN1::NODES::N_Sender::MESSAGES::TD::TIMINGS::CyclePeriod;
    J1939ILSetMsgCycleTime(J1939::Sender::TD, gCAN1DisturbancePeriod);
  }
}

on sysvar_update sysvar::IL_CAN1::NODES::N_Sender::MESSAGES::TD::TIMINGS::SendOnce
{
  if (@this == 1)
  {
    SetBusContext(gILCAN1_BusContext);
    J1939ILSetMsgEvent(J1939::Sender::TD);
  }
}

on sysvar_update sysvar::IL_CAN1::NODES::N_Sender::MESSAGES::TIRE::TIMINGS::EnableCyclic
{
  if (@this == 1)
  {
    SetBusContext(gILCAN1_BusContext);
    J1939ILEnableMsg  (J1939::Sender::TIRE);
  }
  else
  {
    SetBusContext(gILCAN1_BusContext);
    J1939ILDisableMsg (J1939::Sender::TIRE);
  }
}

on sysvar_update sysvar::IL_CAN1::NODES::N_Sender::MESSAGES::TIRE::TIMINGS::SetNormalCycle
{
  if (@this == 1 && @sysvar::IL_CAN1::NODES::N_Sender::MESSAGES::TIRE::TIMINGS::EnableCyclic)
  {
    @sysvar::IL_CAN1::NODES::N_Sender::MESSAGES::TIRE::TIMINGS::SelectedPeriod = 0;
  }
}

on sysvar_update sysvar::IL_CAN1::NODES::N_Sender::MESSAGES::TIRE::TIMINGS::SetNewCycleContinously
{
  if (@this == 1 && @sysvar::IL_CAN1::NODES::N_Sender::MESSAGES::TIRE::TIMINGS::EnableCyclic)
  {
    @sysvar::IL_CAN1::NODES::N_Sender::MESSAGES::TIRE::TIMINGS::SelectedPeriod = -1;
  }
}

on sysvar_update sysvar::IL_CAN1::NODES::N_Sender::MESSAGES::TIRE::TIMINGS::SelectedPeriod
{
  if (@this == 0 && @sysvar::IL_CAN1::NODES::N_Sender::MESSAGES::TIRE::TIMINGS::EnableCyclic)
  {
    SetBusContext(gILCAN1_BusContext);
    gCAN1DisturbancePeriod = @sysvar::IL_CAN1::NODES::N_Sender::MESSAGES::TIRE::TIMINGS::NormalCyclePeriod;
    J1939ILSetMsgCycleTime(J1939::Sender::TIRE, 100);
  }
  else if (@this == 1 && @sysvar::IL_CAN1::NODES::N_Sender::MESSAGES::TIRE::TIMINGS::EnableCyclic)
  {
    SetBusContext(gILCAN1_BusContext);
    gCAN1DisturbancePeriod = @sysvar::IL_CAN1::NODES::N_Sender::MESSAGES::TIRE::TIMINGS::ActiveCyclePeriod;
    J1939ILSetMsgCycleTime(J1939::Sender::TIRE, gCAN1DisturbancePeriod);
  }
  else if (@this == -1 && @sysvar::IL_CAN1::NODES::N_Sender::MESSAGES::TIRE::TIMINGS::EnableCyclic)
  {
    SetBusContext(gILCAN1_BusContext);
    gCAN1DisturbancePeriod = @sysvar::IL_CAN1::NODES::N_Sender::MESSAGES::TIRE::TIMINGS::CyclePeriod;
    J1939ILSetMsgCycleTime(J1939::Sender::TIRE, gCAN1DisturbancePeriod);
  }
}

on sysvar_update sysvar::IL_CAN1::NODES::N_Sender::MESSAGES::TIRE::TIMINGS::SendOnce
{
  if (@this == 1)
  {
    SetBusContext(gILCAN1_BusContext);
    J1939ILSetMsgEvent(J1939::Sender::TIRE);
  }
}

on sysvar_update sysvar::IL_CAN1::NODES::N_Sender::MESSAGES::TPCM::TIMINGS::EnableCyclic
{
  if (@this == 1)
  {
    SetBusContext(gILCAN1_BusContext);
    J1939ILEnableMsg  (J1939::Sender::TPCM);
  }
  else
  {
    SetBusContext(gILCAN1_BusContext);
    J1939ILDisableMsg (J1939::Sender::TPCM);
  }
}

on sysvar_update sysvar::IL_CAN1::NODES::N_Sender::MESSAGES::TPCM::TIMINGS::SetNormalCycle
{
  if (@this == 1 && @sysvar::IL_CAN1::NODES::N_Sender::MESSAGES::TPCM::TIMINGS::EnableCyclic)
  {
    @sysvar::IL_CAN1::NODES::N_Sender::MESSAGES::TPCM::TIMINGS::SelectedPeriod = 0;
  }
}

on sysvar_update sysvar::IL_CAN1::NODES::N_Sender::MESSAGES::TPCM::TIMINGS::SetNewCycleContinously
{
  if (@this == 1 && @sysvar::IL_CAN1::NODES::N_Sender::MESSAGES::TPCM::TIMINGS::EnableCyclic)
  {
    @sysvar::IL_CAN1::NODES::N_Sender::MESSAGES::TPCM::TIMINGS::SelectedPeriod = -1;
  }
}

on sysvar_update sysvar::IL_CAN1::NODES::N_Sender::MESSAGES::TPCM::TIMINGS::SelectedPeriod
{
  if (@this == 0 && @sysvar::IL_CAN1::NODES::N_Sender::MESSAGES::TPCM::TIMINGS::EnableCyclic)
  {
    SetBusContext(gILCAN1_BusContext);
    gCAN1DisturbancePeriod = @sysvar::IL_CAN1::NODES::N_Sender::MESSAGES::TPCM::TIMINGS::NormalCyclePeriod;
    J1939ILSetMsgCycleTime(J1939::Sender::TPCM, 0);
  }
  else if (@this == 1 && @sysvar::IL_CAN1::NODES::N_Sender::MESSAGES::TPCM::TIMINGS::EnableCyclic)
  {
    SetBusContext(gILCAN1_BusContext);
    gCAN1DisturbancePeriod = @sysvar::IL_CAN1::NODES::N_Sender::MESSAGES::TPCM::TIMINGS::ActiveCyclePeriod;
    J1939ILSetMsgCycleTime(J1939::Sender::TPCM, gCAN1DisturbancePeriod);
  }
  else if (@this == -1 && @sysvar::IL_CAN1::NODES::N_Sender::MESSAGES::TPCM::TIMINGS::EnableCyclic)
  {
    SetBusContext(gILCAN1_BusContext);
    gCAN1DisturbancePeriod = @sysvar::IL_CAN1::NODES::N_Sender::MESSAGES::TPCM::TIMINGS::CyclePeriod;
    J1939ILSetMsgCycleTime(J1939::Sender::TPCM, gCAN1DisturbancePeriod);
  }
}

on sysvar_update sysvar::IL_CAN1::NODES::N_Sender::MESSAGES::TPCM::TIMINGS::SendOnce
{
  if (@this == 1)
  {
    SetBusContext(gILCAN1_BusContext);
    J1939ILSetMsgEvent(J1939::Sender::TPCM);
  }
}

on sysvar_update sysvar::IL_CAN1::NODES::N_Sender::MESSAGES::TPDT::TIMINGS::EnableCyclic
{
  if (@this == 1)
  {
    SetBusContext(gILCAN1_BusContext);
    J1939ILEnableMsg  (J1939::Sender::TPDT);
  }
  else
  {
    SetBusContext(gILCAN1_BusContext);
    J1939ILDisableMsg (J1939::Sender::TPDT);
  }
}

on sysvar_update sysvar::IL_CAN1::NODES::N_Sender::MESSAGES::TPDT::TIMINGS::SetNormalCycle
{
  if (@this == 1 && @sysvar::IL_CAN1::NODES::N_Sender::MESSAGES::TPDT::TIMINGS::EnableCyclic)
  {
    @sysvar::IL_CAN1::NODES::N_Sender::MESSAGES::TPDT::TIMINGS::SelectedPeriod = 0;
  }
}

on sysvar_update sysvar::IL_CAN1::NODES::N_Sender::MESSAGES::TPDT::TIMINGS::SetNewCycleContinously
{
  if (@this == 1 && @sysvar::IL_CAN1::NODES::N_Sender::MESSAGES::TPDT::TIMINGS::EnableCyclic)
  {
    @sysvar::IL_CAN1::NODES::N_Sender::MESSAGES::TPDT::TIMINGS::SelectedPeriod = -1;
  }
}

on sysvar_update sysvar::IL_CAN1::NODES::N_Sender::MESSAGES::TPDT::TIMINGS::SelectedPeriod
{
  if (@this == 0 && @sysvar::IL_CAN1::NODES::N_Sender::MESSAGES::TPDT::TIMINGS::EnableCyclic)
  {
    SetBusContext(gILCAN1_BusContext);
    gCAN1DisturbancePeriod = @sysvar::IL_CAN1::NODES::N_Sender::MESSAGES::TPDT::TIMINGS::NormalCyclePeriod;
    J1939ILSetMsgCycleTime(J1939::Sender::TPDT, 0);
  }
  else if (@this == 1 && @sysvar::IL_CAN1::NODES::N_Sender::MESSAGES::TPDT::TIMINGS::EnableCyclic)
  {
    SetBusContext(gILCAN1_BusContext);
    gCAN1DisturbancePeriod = @sysvar::IL_CAN1::NODES::N_Sender::MESSAGES::TPDT::TIMINGS::ActiveCyclePeriod;
    J1939ILSetMsgCycleTime(J1939::Sender::TPDT, gCAN1DisturbancePeriod);
  }
  else if (@this == -1 && @sysvar::IL_CAN1::NODES::N_Sender::MESSAGES::TPDT::TIMINGS::EnableCyclic)
  {
    SetBusContext(gILCAN1_BusContext);
    gCAN1DisturbancePeriod = @sysvar::IL_CAN1::NODES::N_Sender::MESSAGES::TPDT::TIMINGS::CyclePeriod;
    J1939ILSetMsgCycleTime(J1939::Sender::TPDT, gCAN1DisturbancePeriod);
  }
}

on sysvar_update sysvar::IL_CAN1::NODES::N_Sender::MESSAGES::TPDT::TIMINGS::SendOnce
{
  if (@this == 1)
  {
    SetBusContext(gILCAN1_BusContext);
    J1939ILSetMsgEvent(J1939::Sender::TPDT);
  }
}

on sysvar_update sysvar::IL_CAN1::NODES::N_Sender::MESSAGES::TPRI::TIMINGS::EnableCyclic
{
  if (@this == 1)
  {
    SetBusContext(gILCAN1_BusContext);
    J1939ILEnableMsg  (J1939::Sender::TPRI);
  }
  else
  {
    SetBusContext(gILCAN1_BusContext);
    J1939ILDisableMsg (J1939::Sender::TPRI);
  }
}

on sysvar_update sysvar::IL_CAN1::NODES::N_Sender::MESSAGES::TPRI::TIMINGS::SetNormalCycle
{
  if (@this == 1 && @sysvar::IL_CAN1::NODES::N_Sender::MESSAGES::TPRI::TIMINGS::EnableCyclic)
  {
    @sysvar::IL_CAN1::NODES::N_Sender::MESSAGES::TPRI::TIMINGS::SelectedPeriod = 0;
  }
}

on sysvar_update sysvar::IL_CAN1::NODES::N_Sender::MESSAGES::TPRI::TIMINGS::SetNewCycleContinously
{
  if (@this == 1 && @sysvar::IL_CAN1::NODES::N_Sender::MESSAGES::TPRI::TIMINGS::EnableCyclic)
  {
    @sysvar::IL_CAN1::NODES::N_Sender::MESSAGES::TPRI::TIMINGS::SelectedPeriod = -1;
  }
}

on sysvar_update sysvar::IL_CAN1::NODES::N_Sender::MESSAGES::TPRI::TIMINGS::SelectedPeriod
{
  if (@this == 0 && @sysvar::IL_CAN1::NODES::N_Sender::MESSAGES::TPRI::TIMINGS::EnableCyclic)
  {
    SetBusContext(gILCAN1_BusContext);
    gCAN1DisturbancePeriod = @sysvar::IL_CAN1::NODES::N_Sender::MESSAGES::TPRI::TIMINGS::NormalCyclePeriod;
    J1939ILSetMsgCycleTime(J1939::Sender::TPRI, 0);
  }
  else if (@this == 1 && @sysvar::IL_CAN1::NODES::N_Sender::MESSAGES::TPRI::TIMINGS::EnableCyclic)
  {
    SetBusContext(gILCAN1_BusContext);
    gCAN1DisturbancePeriod = @sysvar::IL_CAN1::NODES::N_Sender::MESSAGES::TPRI::TIMINGS::ActiveCyclePeriod;
    J1939ILSetMsgCycleTime(J1939::Sender::TPRI, gCAN1DisturbancePeriod);
  }
  else if (@this == -1 && @sysvar::IL_CAN1::NODES::N_Sender::MESSAGES::TPRI::TIMINGS::EnableCyclic)
  {
    SetBusContext(gILCAN1_BusContext);
    gCAN1DisturbancePeriod = @sysvar::IL_CAN1::NODES::N_Sender::MESSAGES::TPRI::TIMINGS::CyclePeriod;
    J1939ILSetMsgCycleTime(J1939::Sender::TPRI, gCAN1DisturbancePeriod);
  }
}

on sysvar_update sysvar::IL_CAN1::NODES::N_Sender::MESSAGES::TPRI::TIMINGS::SendOnce
{
  if (@this == 1)
  {
    SetBusContext(gILCAN1_BusContext);
    J1939ILSetMsgEvent(J1939::Sender::TPRI);
  }
}

on sysvar_update sysvar::IL_CAN1::NODES::N_Sender::MESSAGES::TPRS::TIMINGS::EnableCyclic
{
  if (@this == 1)
  {
    SetBusContext(gILCAN1_BusContext);
    J1939ILEnableMsg  (J1939::Sender::TPRS);
  }
  else
  {
    SetBusContext(gILCAN1_BusContext);
    J1939ILDisableMsg (J1939::Sender::TPRS);
  }
}

on sysvar_update sysvar::IL_CAN1::NODES::N_Sender::MESSAGES::TPRS::TIMINGS::SetNormalCycle
{
  if (@this == 1 && @sysvar::IL_CAN1::NODES::N_Sender::MESSAGES::TPRS::TIMINGS::EnableCyclic)
  {
    @sysvar::IL_CAN1::NODES::N_Sender::MESSAGES::TPRS::TIMINGS::SelectedPeriod = 0;
  }
}

on sysvar_update sysvar::IL_CAN1::NODES::N_Sender::MESSAGES::TPRS::TIMINGS::SetNewCycleContinously
{
  if (@this == 1 && @sysvar::IL_CAN1::NODES::N_Sender::MESSAGES::TPRS::TIMINGS::EnableCyclic)
  {
    @sysvar::IL_CAN1::NODES::N_Sender::MESSAGES::TPRS::TIMINGS::SelectedPeriod = -1;
  }
}

on sysvar_update sysvar::IL_CAN1::NODES::N_Sender::MESSAGES::TPRS::TIMINGS::SelectedPeriod
{
  if (@this == 0 && @sysvar::IL_CAN1::NODES::N_Sender::MESSAGES::TPRS::TIMINGS::EnableCyclic)
  {
    SetBusContext(gILCAN1_BusContext);
    gCAN1DisturbancePeriod = @sysvar::IL_CAN1::NODES::N_Sender::MESSAGES::TPRS::TIMINGS::NormalCyclePeriod;
    J1939ILSetMsgCycleTime(J1939::Sender::TPRS, 0);
  }
  else if (@this == 1 && @sysvar::IL_CAN1::NODES::N_Sender::MESSAGES::TPRS::TIMINGS::EnableCyclic)
  {
    SetBusContext(gILCAN1_BusContext);
    gCAN1DisturbancePeriod = @sysvar::IL_CAN1::NODES::N_Sender::MESSAGES::TPRS::TIMINGS::ActiveCyclePeriod;
    J1939ILSetMsgCycleTime(J1939::Sender::TPRS, gCAN1DisturbancePeriod);
  }
  else if (@this == -1 && @sysvar::IL_CAN1::NODES::N_Sender::MESSAGES::TPRS::TIMINGS::EnableCyclic)
  {
    SetBusContext(gILCAN1_BusContext);
    gCAN1DisturbancePeriod = @sysvar::IL_CAN1::NODES::N_Sender::MESSAGES::TPRS::TIMINGS::CyclePeriod;
    J1939ILSetMsgCycleTime(J1939::Sender::TPRS, gCAN1DisturbancePeriod);
  }
}

on sysvar_update sysvar::IL_CAN1::NODES::N_Sender::MESSAGES::TPRS::TIMINGS::SendOnce
{
  if (@this == 1)
  {
    SetBusContext(gILCAN1_BusContext);
    J1939ILSetMsgEvent(J1939::Sender::TPRS);
  }
}

on sysvar_update sysvar::IL_CAN1::NODES::N_Sender::MESSAGES::TRF1::TIMINGS::EnableCyclic
{
  if (@this == 1)
  {
    SetBusContext(gILCAN1_BusContext);
    J1939ILEnableMsg  (J1939::Sender::TRF1);
  }
  else
  {
    SetBusContext(gILCAN1_BusContext);
    J1939ILDisableMsg (J1939::Sender::TRF1);
  }
}

on sysvar_update sysvar::IL_CAN1::NODES::N_Sender::MESSAGES::TRF1::TIMINGS::SetNormalCycle
{
  if (@this == 1 && @sysvar::IL_CAN1::NODES::N_Sender::MESSAGES::TRF1::TIMINGS::EnableCyclic)
  {
    @sysvar::IL_CAN1::NODES::N_Sender::MESSAGES::TRF1::TIMINGS::SelectedPeriod = 0;
  }
}

on sysvar_update sysvar::IL_CAN1::NODES::N_Sender::MESSAGES::TRF1::TIMINGS::SetNewCycleContinously
{
  if (@this == 1 && @sysvar::IL_CAN1::NODES::N_Sender::MESSAGES::TRF1::TIMINGS::EnableCyclic)
  {
    @sysvar::IL_CAN1::NODES::N_Sender::MESSAGES::TRF1::TIMINGS::SelectedPeriod = -1;
  }
}

on sysvar_update sysvar::IL_CAN1::NODES::N_Sender::MESSAGES::TRF1::TIMINGS::SelectedPeriod
{
  if (@this == 0 && @sysvar::IL_CAN1::NODES::N_Sender::MESSAGES::TRF1::TIMINGS::EnableCyclic)
  {
    SetBusContext(gILCAN1_BusContext);
    gCAN1DisturbancePeriod = @sysvar::IL_CAN1::NODES::N_Sender::MESSAGES::TRF1::TIMINGS::NormalCyclePeriod;
    J1939ILSetMsgCycleTime(J1939::Sender::TRF1, 1000);
  }
  else if (@this == 1 && @sysvar::IL_CAN1::NODES::N_Sender::MESSAGES::TRF1::TIMINGS::EnableCyclic)
  {
    SetBusContext(gILCAN1_BusContext);
    gCAN1DisturbancePeriod = @sysvar::IL_CAN1::NODES::N_Sender::MESSAGES::TRF1::TIMINGS::ActiveCyclePeriod;
    J1939ILSetMsgCycleTime(J1939::Sender::TRF1, gCAN1DisturbancePeriod);
  }
  else if (@this == -1 && @sysvar::IL_CAN1::NODES::N_Sender::MESSAGES::TRF1::TIMINGS::EnableCyclic)
  {
    SetBusContext(gILCAN1_BusContext);
    gCAN1DisturbancePeriod = @sysvar::IL_CAN1::NODES::N_Sender::MESSAGES::TRF1::TIMINGS::CyclePeriod;
    J1939ILSetMsgCycleTime(J1939::Sender::TRF1, gCAN1DisturbancePeriod);
  }
}

on sysvar_update sysvar::IL_CAN1::NODES::N_Sender::MESSAGES::TRF1::TIMINGS::SendOnce
{
  if (@this == 1)
  {
    SetBusContext(gILCAN1_BusContext);
    J1939ILSetMsgEvent(J1939::Sender::TRF1);
  }
}

on sysvar_update sysvar::IL_CAN1::NODES::N_Sender::MESSAGES::TSC1::TIMINGS::EnableCyclic
{
  if (@this == 1)
  {
    SetBusContext(gILCAN1_BusContext);
    J1939ILEnableMsg  (J1939::Sender::TSC1);
  }
  else
  {
    SetBusContext(gILCAN1_BusContext);
    J1939ILDisableMsg (J1939::Sender::TSC1);
  }
}

on sysvar_update sysvar::IL_CAN1::NODES::N_Sender::MESSAGES::TSC1::TIMINGS::SetNormalCycle
{
  if (@this == 1 && @sysvar::IL_CAN1::NODES::N_Sender::MESSAGES::TSC1::TIMINGS::EnableCyclic)
  {
    @sysvar::IL_CAN1::NODES::N_Sender::MESSAGES::TSC1::TIMINGS::SelectedPeriod = 0;
  }
}

on sysvar_update sysvar::IL_CAN1::NODES::N_Sender::MESSAGES::TSC1::TIMINGS::SetNewCycleContinously
{
  if (@this == 1 && @sysvar::IL_CAN1::NODES::N_Sender::MESSAGES::TSC1::TIMINGS::EnableCyclic)
  {
    @sysvar::IL_CAN1::NODES::N_Sender::MESSAGES::TSC1::TIMINGS::SelectedPeriod = -1;
  }
}

on sysvar_update sysvar::IL_CAN1::NODES::N_Sender::MESSAGES::TSC1::TIMINGS::SelectedPeriod
{
  if (@this == 0 && @sysvar::IL_CAN1::NODES::N_Sender::MESSAGES::TSC1::TIMINGS::EnableCyclic)
  {
    SetBusContext(gILCAN1_BusContext);
    gCAN1DisturbancePeriod = @sysvar::IL_CAN1::NODES::N_Sender::MESSAGES::TSC1::TIMINGS::NormalCyclePeriod;
    J1939ILSetMsgCycleTime(J1939::Sender::TSC1, 0);
  }
  else if (@this == 1 && @sysvar::IL_CAN1::NODES::N_Sender::MESSAGES::TSC1::TIMINGS::EnableCyclic)
  {
    SetBusContext(gILCAN1_BusContext);
    gCAN1DisturbancePeriod = @sysvar::IL_CAN1::NODES::N_Sender::MESSAGES::TSC1::TIMINGS::ActiveCyclePeriod;
    J1939ILSetMsgCycleTime(J1939::Sender::TSC1, gCAN1DisturbancePeriod);
  }
  else if (@this == -1 && @sysvar::IL_CAN1::NODES::N_Sender::MESSAGES::TSC1::TIMINGS::EnableCyclic)
  {
    SetBusContext(gILCAN1_BusContext);
    gCAN1DisturbancePeriod = @sysvar::IL_CAN1::NODES::N_Sender::MESSAGES::TSC1::TIMINGS::CyclePeriod;
    J1939ILSetMsgCycleTime(J1939::Sender::TSC1, gCAN1DisturbancePeriod);
  }
}

on sysvar_update sysvar::IL_CAN1::NODES::N_Sender::MESSAGES::TSC1::TIMINGS::SendOnce
{
  if (@this == 1)
  {
    SetBusContext(gILCAN1_BusContext);
    J1939ILSetMsgEvent(J1939::Sender::TSC1);
  }
}

on sysvar_update sysvar::IL_CAN1::NODES::N_Sender::MESSAGES::VD::TIMINGS::EnableCyclic
{
  if (@this == 1)
  {
    SetBusContext(gILCAN1_BusContext);
    J1939ILEnableMsg  (J1939::Sender::VD);
  }
  else
  {
    SetBusContext(gILCAN1_BusContext);
    J1939ILDisableMsg (J1939::Sender::VD);
  }
}

on sysvar_update sysvar::IL_CAN1::NODES::N_Sender::MESSAGES::VD::TIMINGS::SetNormalCycle
{
  if (@this == 1 && @sysvar::IL_CAN1::NODES::N_Sender::MESSAGES::VD::TIMINGS::EnableCyclic)
  {
    @sysvar::IL_CAN1::NODES::N_Sender::MESSAGES::VD::TIMINGS::SelectedPeriod = 0;
  }
}

on sysvar_update sysvar::IL_CAN1::NODES::N_Sender::MESSAGES::VD::TIMINGS::SetNewCycleContinously
{
  if (@this == 1 && @sysvar::IL_CAN1::NODES::N_Sender::MESSAGES::VD::TIMINGS::EnableCyclic)
  {
    @sysvar::IL_CAN1::NODES::N_Sender::MESSAGES::VD::TIMINGS::SelectedPeriod = -1;
  }
}

on sysvar_update sysvar::IL_CAN1::NODES::N_Sender::MESSAGES::VD::TIMINGS::SelectedPeriod
{
  if (@this == 0 && @sysvar::IL_CAN1::NODES::N_Sender::MESSAGES::VD::TIMINGS::EnableCyclic)
  {
    SetBusContext(gILCAN1_BusContext);
    gCAN1DisturbancePeriod = @sysvar::IL_CAN1::NODES::N_Sender::MESSAGES::VD::TIMINGS::NormalCyclePeriod;
    J1939ILSetMsgCycleTime(J1939::Sender::VD, 100);
  }
  else if (@this == 1 && @sysvar::IL_CAN1::NODES::N_Sender::MESSAGES::VD::TIMINGS::EnableCyclic)
  {
    SetBusContext(gILCAN1_BusContext);
    gCAN1DisturbancePeriod = @sysvar::IL_CAN1::NODES::N_Sender::MESSAGES::VD::TIMINGS::ActiveCyclePeriod;
    J1939ILSetMsgCycleTime(J1939::Sender::VD, gCAN1DisturbancePeriod);
  }
  else if (@this == -1 && @sysvar::IL_CAN1::NODES::N_Sender::MESSAGES::VD::TIMINGS::EnableCyclic)
  {
    SetBusContext(gILCAN1_BusContext);
    gCAN1DisturbancePeriod = @sysvar::IL_CAN1::NODES::N_Sender::MESSAGES::VD::TIMINGS::CyclePeriod;
    J1939ILSetMsgCycleTime(J1939::Sender::VD, gCAN1DisturbancePeriod);
  }
}

on sysvar_update sysvar::IL_CAN1::NODES::N_Sender::MESSAGES::VD::TIMINGS::SendOnce
{
  if (@this == 1)
  {
    SetBusContext(gILCAN1_BusContext);
    J1939ILSetMsgEvent(J1939::Sender::VD);
  }
}

on sysvar_update sysvar::IL_CAN1::NODES::N_Sender::MESSAGES::VDC1::TIMINGS::EnableCyclic
{
  if (@this == 1)
  {
    SetBusContext(gILCAN1_BusContext);
    J1939ILEnableMsg  (J1939::Sender::VDC1);
  }
  else
  {
    SetBusContext(gILCAN1_BusContext);
    J1939ILDisableMsg (J1939::Sender::VDC1);
  }
}

on sysvar_update sysvar::IL_CAN1::NODES::N_Sender::MESSAGES::VDC1::TIMINGS::SetNormalCycle
{
  if (@this == 1 && @sysvar::IL_CAN1::NODES::N_Sender::MESSAGES::VDC1::TIMINGS::EnableCyclic)
  {
    @sysvar::IL_CAN1::NODES::N_Sender::MESSAGES::VDC1::TIMINGS::SelectedPeriod = 0;
  }
}

on sysvar_update sysvar::IL_CAN1::NODES::N_Sender::MESSAGES::VDC1::TIMINGS::SetNewCycleContinously
{
  if (@this == 1 && @sysvar::IL_CAN1::NODES::N_Sender::MESSAGES::VDC1::TIMINGS::EnableCyclic)
  {
    @sysvar::IL_CAN1::NODES::N_Sender::MESSAGES::VDC1::TIMINGS::SelectedPeriod = -1;
  }
}

on sysvar_update sysvar::IL_CAN1::NODES::N_Sender::MESSAGES::VDC1::TIMINGS::SelectedPeriod
{
  if (@this == 0 && @sysvar::IL_CAN1::NODES::N_Sender::MESSAGES::VDC1::TIMINGS::EnableCyclic)
  {
    SetBusContext(gILCAN1_BusContext);
    gCAN1DisturbancePeriod = @sysvar::IL_CAN1::NODES::N_Sender::MESSAGES::VDC1::TIMINGS::NormalCyclePeriod;
    J1939ILSetMsgCycleTime(J1939::Sender::VDC1, 100);
  }
  else if (@this == 1 && @sysvar::IL_CAN1::NODES::N_Sender::MESSAGES::VDC1::TIMINGS::EnableCyclic)
  {
    SetBusContext(gILCAN1_BusContext);
    gCAN1DisturbancePeriod = @sysvar::IL_CAN1::NODES::N_Sender::MESSAGES::VDC1::TIMINGS::ActiveCyclePeriod;
    J1939ILSetMsgCycleTime(J1939::Sender::VDC1, gCAN1DisturbancePeriod);
  }
  else if (@this == -1 && @sysvar::IL_CAN1::NODES::N_Sender::MESSAGES::VDC1::TIMINGS::EnableCyclic)
  {
    SetBusContext(gILCAN1_BusContext);
    gCAN1DisturbancePeriod = @sysvar::IL_CAN1::NODES::N_Sender::MESSAGES::VDC1::TIMINGS::CyclePeriod;
    J1939ILSetMsgCycleTime(J1939::Sender::VDC1, gCAN1DisturbancePeriod);
  }
}

on sysvar_update sysvar::IL_CAN1::NODES::N_Sender::MESSAGES::VDC1::TIMINGS::SendOnce
{
  if (@this == 1)
  {
    SetBusContext(gILCAN1_BusContext);
    J1939ILSetMsgEvent(J1939::Sender::VDC1);
  }
}

on sysvar_update sysvar::IL_CAN1::NODES::N_Sender::MESSAGES::VDC2::TIMINGS::EnableCyclic
{
  if (@this == 1)
  {
    SetBusContext(gILCAN1_BusContext);
    J1939ILEnableMsg  (J1939::Sender::VDC2);
  }
  else
  {
    SetBusContext(gILCAN1_BusContext);
    J1939ILDisableMsg (J1939::Sender::VDC2);
  }
}

on sysvar_update sysvar::IL_CAN1::NODES::N_Sender::MESSAGES::VDC2::TIMINGS::SetNormalCycle
{
  if (@this == 1 && @sysvar::IL_CAN1::NODES::N_Sender::MESSAGES::VDC2::TIMINGS::EnableCyclic)
  {
    @sysvar::IL_CAN1::NODES::N_Sender::MESSAGES::VDC2::TIMINGS::SelectedPeriod = 0;
  }
}

on sysvar_update sysvar::IL_CAN1::NODES::N_Sender::MESSAGES::VDC2::TIMINGS::SetNewCycleContinously
{
  if (@this == 1 && @sysvar::IL_CAN1::NODES::N_Sender::MESSAGES::VDC2::TIMINGS::EnableCyclic)
  {
    @sysvar::IL_CAN1::NODES::N_Sender::MESSAGES::VDC2::TIMINGS::SelectedPeriod = -1;
  }
}

on sysvar_update sysvar::IL_CAN1::NODES::N_Sender::MESSAGES::VDC2::TIMINGS::SelectedPeriod
{
  if (@this == 0 && @sysvar::IL_CAN1::NODES::N_Sender::MESSAGES::VDC2::TIMINGS::EnableCyclic)
  {
    SetBusContext(gILCAN1_BusContext);
    gCAN1DisturbancePeriod = @sysvar::IL_CAN1::NODES::N_Sender::MESSAGES::VDC2::TIMINGS::NormalCyclePeriod;
    J1939ILSetMsgCycleTime(J1939::Sender::VDC2, 10);
  }
  else if (@this == 1 && @sysvar::IL_CAN1::NODES::N_Sender::MESSAGES::VDC2::TIMINGS::EnableCyclic)
  {
    SetBusContext(gILCAN1_BusContext);
    gCAN1DisturbancePeriod = @sysvar::IL_CAN1::NODES::N_Sender::MESSAGES::VDC2::TIMINGS::ActiveCyclePeriod;
    J1939ILSetMsgCycleTime(J1939::Sender::VDC2, gCAN1DisturbancePeriod);
  }
  else if (@this == -1 && @sysvar::IL_CAN1::NODES::N_Sender::MESSAGES::VDC2::TIMINGS::EnableCyclic)
  {
    SetBusContext(gILCAN1_BusContext);
    gCAN1DisturbancePeriod = @sysvar::IL_CAN1::NODES::N_Sender::MESSAGES::VDC2::TIMINGS::CyclePeriod;
    J1939ILSetMsgCycleTime(J1939::Sender::VDC2, gCAN1DisturbancePeriod);
  }
}

on sysvar_update sysvar::IL_CAN1::NODES::N_Sender::MESSAGES::VDC2::TIMINGS::SendOnce
{
  if (@this == 1)
  {
    SetBusContext(gILCAN1_BusContext);
    J1939ILSetMsgEvent(J1939::Sender::VDC2);
  }
}

on sysvar_update sysvar::IL_CAN1::NODES::N_Sender::MESSAGES::VDHR::TIMINGS::EnableCyclic
{
  if (@this == 1)
  {
    SetBusContext(gILCAN1_BusContext);
    J1939ILEnableMsg  (J1939::Sender::VDHR);
  }
  else
  {
    SetBusContext(gILCAN1_BusContext);
    J1939ILDisableMsg (J1939::Sender::VDHR);
  }
}

on sysvar_update sysvar::IL_CAN1::NODES::N_Sender::MESSAGES::VDHR::TIMINGS::SetNormalCycle
{
  if (@this == 1 && @sysvar::IL_CAN1::NODES::N_Sender::MESSAGES::VDHR::TIMINGS::EnableCyclic)
  {
    @sysvar::IL_CAN1::NODES::N_Sender::MESSAGES::VDHR::TIMINGS::SelectedPeriod = 0;
  }
}

on sysvar_update sysvar::IL_CAN1::NODES::N_Sender::MESSAGES::VDHR::TIMINGS::SetNewCycleContinously
{
  if (@this == 1 && @sysvar::IL_CAN1::NODES::N_Sender::MESSAGES::VDHR::TIMINGS::EnableCyclic)
  {
    @sysvar::IL_CAN1::NODES::N_Sender::MESSAGES::VDHR::TIMINGS::SelectedPeriod = -1;
  }
}

on sysvar_update sysvar::IL_CAN1::NODES::N_Sender::MESSAGES::VDHR::TIMINGS::SelectedPeriod
{
  if (@this == 0 && @sysvar::IL_CAN1::NODES::N_Sender::MESSAGES::VDHR::TIMINGS::EnableCyclic)
  {
    SetBusContext(gILCAN1_BusContext);
    gCAN1DisturbancePeriod = @sysvar::IL_CAN1::NODES::N_Sender::MESSAGES::VDHR::TIMINGS::NormalCyclePeriod;
    J1939ILSetMsgCycleTime(J1939::Sender::VDHR, 1000);
  }
  else if (@this == 1 && @sysvar::IL_CAN1::NODES::N_Sender::MESSAGES::VDHR::TIMINGS::EnableCyclic)
  {
    SetBusContext(gILCAN1_BusContext);
    gCAN1DisturbancePeriod = @sysvar::IL_CAN1::NODES::N_Sender::MESSAGES::VDHR::TIMINGS::ActiveCyclePeriod;
    J1939ILSetMsgCycleTime(J1939::Sender::VDHR, gCAN1DisturbancePeriod);
  }
  else if (@this == -1 && @sysvar::IL_CAN1::NODES::N_Sender::MESSAGES::VDHR::TIMINGS::EnableCyclic)
  {
    SetBusContext(gILCAN1_BusContext);
    gCAN1DisturbancePeriod = @sysvar::IL_CAN1::NODES::N_Sender::MESSAGES::VDHR::TIMINGS::CyclePeriod;
    J1939ILSetMsgCycleTime(J1939::Sender::VDHR, gCAN1DisturbancePeriod);
  }
}

on sysvar_update sysvar::IL_CAN1::NODES::N_Sender::MESSAGES::VDHR::TIMINGS::SendOnce
{
  if (@this == 1)
  {
    SetBusContext(gILCAN1_BusContext);
    J1939ILSetMsgEvent(J1939::Sender::VDHR);
  }
}

on sysvar_update sysvar::IL_CAN1::NODES::N_Sender::MESSAGES::VEP1::TIMINGS::EnableCyclic
{
  if (@this == 1)
  {
    SetBusContext(gILCAN1_BusContext);
    J1939ILEnableMsg  (J1939::Sender::VEP1);
  }
  else
  {
    SetBusContext(gILCAN1_BusContext);
    J1939ILDisableMsg (J1939::Sender::VEP1);
  }
}

on sysvar_update sysvar::IL_CAN1::NODES::N_Sender::MESSAGES::VEP1::TIMINGS::SetNormalCycle
{
  if (@this == 1 && @sysvar::IL_CAN1::NODES::N_Sender::MESSAGES::VEP1::TIMINGS::EnableCyclic)
  {
    @sysvar::IL_CAN1::NODES::N_Sender::MESSAGES::VEP1::TIMINGS::SelectedPeriod = 0;
  }
}

on sysvar_update sysvar::IL_CAN1::NODES::N_Sender::MESSAGES::VEP1::TIMINGS::SetNewCycleContinously
{
  if (@this == 1 && @sysvar::IL_CAN1::NODES::N_Sender::MESSAGES::VEP1::TIMINGS::EnableCyclic)
  {
    @sysvar::IL_CAN1::NODES::N_Sender::MESSAGES::VEP1::TIMINGS::SelectedPeriod = -1;
  }
}

on sysvar_update sysvar::IL_CAN1::NODES::N_Sender::MESSAGES::VEP1::TIMINGS::SelectedPeriod
{
  if (@this == 0 && @sysvar::IL_CAN1::NODES::N_Sender::MESSAGES::VEP1::TIMINGS::EnableCyclic)
  {
    SetBusContext(gILCAN1_BusContext);
    gCAN1DisturbancePeriod = @sysvar::IL_CAN1::NODES::N_Sender::MESSAGES::VEP1::TIMINGS::NormalCyclePeriod;
    J1939ILSetMsgCycleTime(J1939::Sender::VEP1, 1000);
  }
  else if (@this == 1 && @sysvar::IL_CAN1::NODES::N_Sender::MESSAGES::VEP1::TIMINGS::EnableCyclic)
  {
    SetBusContext(gILCAN1_BusContext);
    gCAN1DisturbancePeriod = @sysvar::IL_CAN1::NODES::N_Sender::MESSAGES::VEP1::TIMINGS::ActiveCyclePeriod;
    J1939ILSetMsgCycleTime(J1939::Sender::VEP1, gCAN1DisturbancePeriod);
  }
  else if (@this == -1 && @sysvar::IL_CAN1::NODES::N_Sender::MESSAGES::VEP1::TIMINGS::EnableCyclic)
  {
    SetBusContext(gILCAN1_BusContext);
    gCAN1DisturbancePeriod = @sysvar::IL_CAN1::NODES::N_Sender::MESSAGES::VEP1::TIMINGS::CyclePeriod;
    J1939ILSetMsgCycleTime(J1939::Sender::VEP1, gCAN1DisturbancePeriod);
  }
}

on sysvar_update sysvar::IL_CAN1::NODES::N_Sender::MESSAGES::VEP1::TIMINGS::SendOnce
{
  if (@this == 1)
  {
    SetBusContext(gILCAN1_BusContext);
    J1939ILSetMsgEvent(J1939::Sender::VEP1);
  }
}

on sysvar_update sysvar::IL_CAN1::NODES::N_Sender::MESSAGES::VI::TIMINGS::EnableCyclic
{
  if (@this == 1)
  {
    SetBusContext(gILCAN1_BusContext);
    J1939ILEnableMsg  (J1939::Sender::VI);
  }
  else
  {
    SetBusContext(gILCAN1_BusContext);
    J1939ILDisableMsg (J1939::Sender::VI);
  }
}

on sysvar_update sysvar::IL_CAN1::NODES::N_Sender::MESSAGES::VI::TIMINGS::SetNormalCycle
{
  if (@this == 1 && @sysvar::IL_CAN1::NODES::N_Sender::MESSAGES::VI::TIMINGS::EnableCyclic)
  {
    @sysvar::IL_CAN1::NODES::N_Sender::MESSAGES::VI::TIMINGS::SelectedPeriod = 0;
  }
}

on sysvar_update sysvar::IL_CAN1::NODES::N_Sender::MESSAGES::VI::TIMINGS::SetNewCycleContinously
{
  if (@this == 1 && @sysvar::IL_CAN1::NODES::N_Sender::MESSAGES::VI::TIMINGS::EnableCyclic)
  {
    @sysvar::IL_CAN1::NODES::N_Sender::MESSAGES::VI::TIMINGS::SelectedPeriod = -1;
  }
}

on sysvar_update sysvar::IL_CAN1::NODES::N_Sender::MESSAGES::VI::TIMINGS::SelectedPeriod
{
  if (@this == 0 && @sysvar::IL_CAN1::NODES::N_Sender::MESSAGES::VI::TIMINGS::EnableCyclic)
  {
    SetBusContext(gILCAN1_BusContext);
    gCAN1DisturbancePeriod = @sysvar::IL_CAN1::NODES::N_Sender::MESSAGES::VI::TIMINGS::NormalCyclePeriod;
    J1939ILSetMsgCycleTime(J1939::Sender::VI, 0);
  }
  else if (@this == 1 && @sysvar::IL_CAN1::NODES::N_Sender::MESSAGES::VI::TIMINGS::EnableCyclic)
  {
    SetBusContext(gILCAN1_BusContext);
    gCAN1DisturbancePeriod = @sysvar::IL_CAN1::NODES::N_Sender::MESSAGES::VI::TIMINGS::ActiveCyclePeriod;
    J1939ILSetMsgCycleTime(J1939::Sender::VI, gCAN1DisturbancePeriod);
  }
  else if (@this == -1 && @sysvar::IL_CAN1::NODES::N_Sender::MESSAGES::VI::TIMINGS::EnableCyclic)
  {
    SetBusContext(gILCAN1_BusContext);
    gCAN1DisturbancePeriod = @sysvar::IL_CAN1::NODES::N_Sender::MESSAGES::VI::TIMINGS::CyclePeriod;
    J1939ILSetMsgCycleTime(J1939::Sender::VI, gCAN1DisturbancePeriod);
  }
}

on sysvar_update sysvar::IL_CAN1::NODES::N_Sender::MESSAGES::VI::TIMINGS::SendOnce
{
  if (@this == 1)
  {
    SetBusContext(gILCAN1_BusContext);
    J1939ILSetMsgEvent(J1939::Sender::VI);
  }
}

on sysvar_update sysvar::IL_CAN1::NODES::N_Sender::MESSAGES::VW::TIMINGS::EnableCyclic
{
  if (@this == 1)
  {
    SetBusContext(gILCAN1_BusContext);
    J1939ILEnableMsg  (J1939::Sender::VW);
  }
  else
  {
    SetBusContext(gILCAN1_BusContext);
    J1939ILDisableMsg (J1939::Sender::VW);
  }
}

on sysvar_update sysvar::IL_CAN1::NODES::N_Sender::MESSAGES::VW::TIMINGS::SetNormalCycle
{
  if (@this == 1 && @sysvar::IL_CAN1::NODES::N_Sender::MESSAGES::VW::TIMINGS::EnableCyclic)
  {
    @sysvar::IL_CAN1::NODES::N_Sender::MESSAGES::VW::TIMINGS::SelectedPeriod = 0;
  }
}

on sysvar_update sysvar::IL_CAN1::NODES::N_Sender::MESSAGES::VW::TIMINGS::SetNewCycleContinously
{
  if (@this == 1 && @sysvar::IL_CAN1::NODES::N_Sender::MESSAGES::VW::TIMINGS::EnableCyclic)
  {
    @sysvar::IL_CAN1::NODES::N_Sender::MESSAGES::VW::TIMINGS::SelectedPeriod = -1;
  }
}

on sysvar_update sysvar::IL_CAN1::NODES::N_Sender::MESSAGES::VW::TIMINGS::SelectedPeriod
{
  if (@this == 0 && @sysvar::IL_CAN1::NODES::N_Sender::MESSAGES::VW::TIMINGS::EnableCyclic)
  {
    SetBusContext(gILCAN1_BusContext);
    gCAN1DisturbancePeriod = @sysvar::IL_CAN1::NODES::N_Sender::MESSAGES::VW::TIMINGS::NormalCyclePeriod;
    J1939ILSetMsgCycleTime(J1939::Sender::VW, 0);
  }
  else if (@this == 1 && @sysvar::IL_CAN1::NODES::N_Sender::MESSAGES::VW::TIMINGS::EnableCyclic)
  {
    SetBusContext(gILCAN1_BusContext);
    gCAN1DisturbancePeriod = @sysvar::IL_CAN1::NODES::N_Sender::MESSAGES::VW::TIMINGS::ActiveCyclePeriod;
    J1939ILSetMsgCycleTime(J1939::Sender::VW, gCAN1DisturbancePeriod);
  }
  else if (@this == -1 && @sysvar::IL_CAN1::NODES::N_Sender::MESSAGES::VW::TIMINGS::EnableCyclic)
  {
    SetBusContext(gILCAN1_BusContext);
    gCAN1DisturbancePeriod = @sysvar::IL_CAN1::NODES::N_Sender::MESSAGES::VW::TIMINGS::CyclePeriod;
    J1939ILSetMsgCycleTime(J1939::Sender::VW, gCAN1DisturbancePeriod);
  }
}

on sysvar_update sysvar::IL_CAN1::NODES::N_Sender::MESSAGES::VW::TIMINGS::SendOnce
{
  if (@this == 1)
  {
    SetBusContext(gILCAN1_BusContext);
    J1939ILSetMsgEvent(J1939::Sender::VW);
  }
}

on sysvar_update sysvar::IL_CAN1::NODES::N_Sender::MESSAGES::XFER::TIMINGS::EnableCyclic
{
  if (@this == 1)
  {
    SetBusContext(gILCAN1_BusContext);
    J1939ILEnableMsg  (J1939::Sender::XFER);
  }
  else
  {
    SetBusContext(gILCAN1_BusContext);
    J1939ILDisableMsg (J1939::Sender::XFER);
  }
}

on sysvar_update sysvar::IL_CAN1::NODES::N_Sender::MESSAGES::XFER::TIMINGS::SetNormalCycle
{
  if (@this == 1 && @sysvar::IL_CAN1::NODES::N_Sender::MESSAGES::XFER::TIMINGS::EnableCyclic)
  {
    @sysvar::IL_CAN1::NODES::N_Sender::MESSAGES::XFER::TIMINGS::SelectedPeriod = 0;
  }
}

on sysvar_update sysvar::IL_CAN1::NODES::N_Sender::MESSAGES::XFER::TIMINGS::SetNewCycleContinously
{
  if (@this == 1 && @sysvar::IL_CAN1::NODES::N_Sender::MESSAGES::XFER::TIMINGS::EnableCyclic)
  {
    @sysvar::IL_CAN1::NODES::N_Sender::MESSAGES::XFER::TIMINGS::SelectedPeriod = -1;
  }
}

on sysvar_update sysvar::IL_CAN1::NODES::N_Sender::MESSAGES::XFER::TIMINGS::SelectedPeriod
{
  if (@this == 0 && @sysvar::IL_CAN1::NODES::N_Sender::MESSAGES::XFER::TIMINGS::EnableCyclic)
  {
    SetBusContext(gILCAN1_BusContext);
    gCAN1DisturbancePeriod = @sysvar::IL_CAN1::NODES::N_Sender::MESSAGES::XFER::TIMINGS::NormalCyclePeriod;
    J1939ILSetMsgCycleTime(J1939::Sender::XFER, 0);
  }
  else if (@this == 1 && @sysvar::IL_CAN1::NODES::N_Sender::MESSAGES::XFER::TIMINGS::EnableCyclic)
  {
    SetBusContext(gILCAN1_BusContext);
    gCAN1DisturbancePeriod = @sysvar::IL_CAN1::NODES::N_Sender::MESSAGES::XFER::TIMINGS::ActiveCyclePeriod;
    J1939ILSetMsgCycleTime(J1939::Sender::XFER, gCAN1DisturbancePeriod);
  }
  else if (@this == -1 && @sysvar::IL_CAN1::NODES::N_Sender::MESSAGES::XFER::TIMINGS::EnableCyclic)
  {
    SetBusContext(gILCAN1_BusContext);
    gCAN1DisturbancePeriod = @sysvar::IL_CAN1::NODES::N_Sender::MESSAGES::XFER::TIMINGS::CyclePeriod;
    J1939ILSetMsgCycleTime(J1939::Sender::XFER, gCAN1DisturbancePeriod);
  }
}

on sysvar_update sysvar::IL_CAN1::NODES::N_Sender::MESSAGES::XFER::TIMINGS::SendOnce
{
  if (@this == 1)
  {
    SetBusContext(gILCAN1_BusContext);
    J1939ILSetMsgEvent(J1939::Sender::XFER);
  }
}

on sysvar_update sysvar::NM_CAN1::NODES::N_Sender::OpenNodePanel
{
  OpenNodePanel("J1939::Sender", 1);
}

on sysvar_update sysvar::NM_CAN1::StateControl::CloseNodePanels
{
  OpenNodePanel("J1939::Sender", 0);
}

/* #ChannelEnd# |CAN1| #BusEnd# |J1939| */
//--- end generated part --- Block end <#SysVar_Handler#> do not delete this line! Add application code below this line.

//--- begin generated part --- Block start <#MsgUpdateFcns#> do not delete this line and do not add application code in this code block!
/* #ChannelStart# |CAN1| #BusStart# |J1939| */
/* #ChannelEnd# |CAN1| #BusEnd# |J1939| */
//--- end generated part --- Block end <#MsgUpdateFcns#> do not delete this line! Add application code below this line.

