/*@!Encoding:1252*/
/*
 * FMS Gateway ECU                                 Version 1.1
 *
 * Copyright 2005, Vector Informatik GmbH - All right reserved
 *
 * History:
 * 1.0 (Jr) Created 
 * 1.1 (Jr) Minor changes, fixed initialization issue
 */
variables
{
  // Constants
  const int  kNullAddr    = 0xfe;   // Null address
  const int  kGlobalAddr  = 0xff;   // Global address
  const byte kCAN_Channel = 1;
  const byte kFMS_Channel = 2;
}



on start
{
}

on stopMeasurement
{
}

on pg J1939::EEC1
{
  if ((this.dir == RX) && (this.can == kCAN_Channel)) {
    J1939ILSetSignalRaw(FMS::EEC1::EngineSpeed, this.EngSpeed);
    J1939ILSetSignalRaw(FMS::EEC1::ActualEngine, this.ActualEngPercentTorque);
  }
}

on pg J1939::EEC2
{
  if ((this.dir == RX) && (this.can == kCAN_Channel)) {
    J1939ILSetSignalRaw(FMS::EEC2::AcceleratorPedalPosition1, this.AccelPedalPos1);
    J1939ILSetSignalRaw(FMS::EEC2::EnginePercentLoadAtCurrentSpeed, this.EngPercentLoadAtCurrentSpeed);
  }
}

on pg J1939::TCO1
{
  if ((this.dir == RX) && (this.can == kCAN_Channel)) {
    J1939ILSetSignalRaw(FMS::TCO1::DirectionIndicator, this.DirectionIndicator);
    J1939ILSetSignalRaw(FMS::TCO1::Driv1TimeRelStates, this.Driver1TimeRelatedStates);
    J1939ILSetSignalRaw(FMS::TCO1::Driv1WorkingState, this.Driver1WorkingState);
    J1939ILSetSignalRaw(FMS::TCO1::Driv2TimeRelState, this.Driver2TimeRelatedStates);
    J1939ILSetSignalRaw(FMS::TCO1::Driv2WorkingState, this.Driver2WorkingState);
    J1939ILSetSignalRaw(FMS::TCO1::Driver1Card, this.DriverCardDriver1);
    J1939ILSetSignalRaw(FMS::TCO1::Driver2Card, this.DriverCardDriver2);
    J1939ILSetSignalRaw(FMS::TCO1::HandlingInformation, this.HandlingInformation);
    J1939ILSetSignalRaw(FMS::TCO1::SystemEvent, this.SystemEvent);
    J1939ILSetSignalRaw(FMS::TCO1::TachographPerformance, this.TachographPerformance);
    J1939ILSetSignalRaw(FMS::TCO1::TachographVehicleSpeed, this.TachographVehicleSpeed);  
    J1939ILSetSignalRaw(FMS::TCO1::VehicleOverspeed, this.Overspeed);  
    J1939ILSetSignalRaw(FMS::TCO1::VehicleMotion, this.DriveRecognize);
  }
}

on pg J1939::CCVS
{
  if ((this.dir == RX) && (this.can == kCAN_Channel)) {
    J1939ILSetSignalRaw(FMS::CCVS::WheelBasedSpeed, this.WheelBasedVehicleSpeed);
    J1939ILSetSignalRaw(FMS::CCVS::BrakeSwitch, this.BrakeSwitch);
    J1939ILSetSignalRaw(FMS::CCVS::ClutchSwitch, this.ClutchSwitch);
    J1939ILSetSignalRaw(FMS::CCVS::CruiseControlActive, this.CruiseCtrlActive);
    J1939ILSetSignalRaw(FMS::CCVS::PTOstate, this.PTOState);
  }
}

on pg J1939::ET1
{
  if ((this.dir == RX) && (this.can == kCAN_Channel)) {
    J1939ILSetSignalRaw(FMS::ET1::EngineCoolantTemperature, this.EngCoolantTemp);
  }
}

on pg J1939::HOURS
{
  if ((this.dir == RX) && (this.can == kCAN_Channel)) {
    J1939ILSetSignalRaw(FMS::HOURS::EngineTotalHoursOfOperation, this.EngTotalHoursOfOperation);
  }
}

on pg J1939::LFC
{
  if ((this.dir == RX) && (this.can == kCAN_Channel)) {
    J1939ILSetSignalRaw(FMS::LFC::EngineTotalFuelUsed, this.EngTotalFuelUsed);
  }
}

on pg J1939::SERV
{
  if ((this.dir == RX) && (this.can == kCAN_Channel)) {
    J1939ILSetSignalRaw(FMS::SERV::ServiceDistance, this.ServiceDistance);    
  }
}


on pg J1939::VW
{
  if ((this.dir == RX) && (this.can == kCAN_Channel)) {
    J1939ILSetSignalRaw(FMS::VW::AxleLocation, this.AxleLocation);
    J1939ILSetSignalRaw(FMS::VW::AxleWeight, this.AxleWeight);
  }
}

on pg J1939::VI
{
  J1939ILSetMsgRawData(FMS::VI, this);
}

