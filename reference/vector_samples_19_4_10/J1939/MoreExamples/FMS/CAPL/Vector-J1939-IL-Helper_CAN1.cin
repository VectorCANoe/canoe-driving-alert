/*@@var:*/
/* ------- Sendmodul --- begin generated Comment ----
| CAPL include for CANoe J1939 IL models
| Functionality is done in CANoe and IL directly
   ---------- end generated Comment---- */

variables
{
  const dword cILCAN1_NSToS = 1000000000;

  // Internally used variables and timers:
  dword   gILCAN1_BusContext = 0;
}
/*@@end*/

void ILCAN1_OnInit()
{
  gILCAN1_BusContext = GetBusNameContext(gCAN1BusName);
  if (gILCAN1_BusContext == 0)
  {
    write("[%.6f %NODE_NAME%] ERROR: cannot determine bus context of CAN bus '%s'!", TimeNowNS()/cILCAN1_NSToS, gCAN1BusName);
  }
}

void ILCAN1_OnStart()
{
}

void ILCAN1_Enable(int enable)
{
  SetBusContext(gILCAN1_BusContext);
  if (enable == 0)
  {
    J1939ILControlStop();
  }
  else
  {
    J1939ILControlStart();
  }
}
