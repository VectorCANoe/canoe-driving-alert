/*@!Encoding:1252*/
includes
{
  #include "Common.cin"
}

///////////////////////////////////////////////////////////////////////////////
// 
// This node is using the extended address claimed support 
//
// It uses the the callback J1939ILOnAddressClaimConflict to suppress the 
// Address Claimed message if is losing the address arbitration
//
///////////////////////////////////////////////////////////////////////////////

variables
{
}

on preStart
{
  J1939ILSetNodeProperty("AddressClaimSupport", ExtendedAddressClaimSupport);
}

on sysvar svChangeAddress_Node2
{
  if(@this == 1)
  {
    @sysvar::J1939AddressClaimingDemo::Node2::ILAddress = @svNewAddress_Node2;
  }
}

// this callback is called if an address claim confict happens
dword J1939ILOnAddressClaimConflict(dword addressArbitrationIsLost, dword newAddress, dword& suppressAddressClaimed)
{
  ReportAddressClaimConflict("Node2", addressArbitrationIsLost, newAddress);
  
  // avoid sending Address Claimed message with address 254 ('Cannot Claim Source Address')
  if ((addressArbitrationIsLost>0) && (newAddress == AddressNull))
  {
    writeEx(SinkWriteWindowCAPL, SeverityWarning, "\nNode2 suppreses Cannot Claim Source Address message");
    suppressAddressClaimed = 1;
  }
  
  return newAddress;
}
