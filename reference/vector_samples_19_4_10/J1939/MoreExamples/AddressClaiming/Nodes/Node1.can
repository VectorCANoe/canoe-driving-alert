/*@!Encoding:1252*/
includes
{
  #include "Common.cin"
}

///////////////////////////////////////////////////////////////////////////////
// 
// This node is using the extended address claimed support 
//
// It uses the the callback J1939ILOnAddressClaimConflict to report address conflicts
//
///////////////////////////////////////////////////////////////////////////////

variables
{
}

on preStart
{
  J1939ILSetNodeProperty("AddressClaimSupport", ExtendedAddressClaimSupport);
}

on sysvar svChangeAddress_Node1
{
  if(@this == 1)
  {
    @sysvar::J1939AddressClaimingDemo::Node1::ILAddress = @svNewAddress_Node1;
  }
}

// this callback is called if an address claim confict happens
dword J1939ILOnAddressClaimConflict(dword addressArbitrationIsLost, dword newAddress, dword& suppressAddressClaimed)
{
  ReportAddressClaimConflict("Node1", addressArbitrationIsLost, newAddress);
  return newAddress;
}