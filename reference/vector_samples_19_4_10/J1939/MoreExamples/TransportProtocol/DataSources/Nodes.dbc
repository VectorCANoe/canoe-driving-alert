VERSION ""

NS_ :

BS_:

BU_: Node2 Node1

BO_ 2632711934 TPDT: 8 Vector__XXX
 SG_ SequenceNumber : 0|8@1+ (1,0) [0|255] "" Vector__XXX

BO_ 2632777470 TPCM: 8 Vector__XXX
 SG_ TotalNumberOfPacketsEoMA m19 : 24|8@1+ (1,0) [0|255] "" Vector__XXX
 SG_ TotalMessageSizeEoMA m19 : 8|16@1+ (1,0) [0|64255] "counts" Vector__XXX
 SG_ TotalMessageSizeBAM m32 : 8|16@1+ (1,0) [0|64255] "counts" Vector__XXX
 SG_ TotalNumberOfPacketsBAM m32 : 24|8@1+ (1,0) [0|255] "" Vector__XXX
 SG_ ConnectionAbortReason m255 : 8|8@1+ (1,0) [0|255] "" Vector__XXX
 SG_ NextPacketNumberToBeSent m17 : 16|8@1+ (1,0) [0|255] "" Vector__XXX
 SG_ NumberOfPacketsThatCanBeSent m17 : 8|8@1+ (1,0) [0|255] "" Vector__XXX
 SG_ PGNumber : 40|24@1+ (1,0) [0|16777200] "" Vector__XXX
 SG_ MaximumNumberOfPackets m16 : 32|8@1+ (1,0) [0|255] "" Vector__XXX
 SG_ TotalNumberOfPackets m16 : 24|8@1+ (1,0) [0|255] "" Vector__XXX
 SG_ TotalMessageSize m16 : 8|16@1+ (1,0) [0|64255] "counts" Vector__XXX
 SG_ ControlByte M : 0|8@1+ (1,0) [0|255] "" Vector__XXX

BO_ 2565800194 ProprietaryA_Node2: 8 Node2
 SG_ N2PropA_Counter : 0|8@1+ (1,0) [0|255] "" Vector__XXX

BO_ 2565800449 ProprietaryA_Node1: 8 Node1
 SG_ N1PropA_Counter : 0|8@1+ (1,0) [0|255] "" Vector__XXX

BO_ 2566849026 ProprietaryB_Node2: 8 Node2
 SG_ N2PropB_Counter : 0|8@1+ (1,0) [0|255] "" Vector__XXX

BO_ 2566848769 ProprietaryB_Node1: 8 Node1
 SG_ N1PropB_Counter : 0|8@1+ (1,0) [0|255] "" Vector__XXX

CM_ BO_ 2632711934 "Transport Protocol - Data Transfer";
CM_ BO_ 2632777470 "Transport Protocol - Connection Management";
CM_ SG_ 2632777470 TotalNumberOfPacketsEoMA "Total number of packets for BAM message.Total number of packets received for RTS/CTS message.Total number of packets for RTS/CTS message.";
CM_ SG_ 2632777470 TotalMessageSizeEoMA "Total message size (in bytes) for BAM message.Total message size (in bytes) for RTS/CTS message.Total message size (in bytes) for RTS/CTS message.";
CM_ SG_ 2632777470 TotalMessageSizeBAM "Total message size (in bytes) for BAM message.Total message size (in bytes) for RTS/CTS message.Total message size (in bytes) for RTS/CTS message.";
CM_ SG_ 2632777470 TotalNumberOfPacketsBAM "Total number of packets for BAM message.Total number of packets received for RTS/CTS message.Total number of packets for RTS/CTS message.";
CM_ SG_ 2632777470 ConnectionAbortReason "Reason for connection abort message.";
CM_ SG_ 2632777470 NextPacketNumberToBeSent "Next Packet Number to be sent (TP.CM_CTS)";
CM_ SG_ 2632777470 NumberOfPacketsThatCanBeSent "Number of Packets that can be sent (TP.CM_CTS)";
CM_ SG_ 2632777470 MaximumNumberOfPackets "Maximum number of packets for RTS/CTS message.";
CM_ SG_ 2632777470 TotalNumberOfPackets "Total number of packets for BAM message.Total number of packets received for RTS/CTS message.Total number of packets for RTS/CTS message.";
CM_ SG_ 2632777470 TotalMessageSize "Total message size (in bytes) for BAM message.Total message size (in bytes) for RTS/CTS message.Total message size (in bytes) for RTS/CTS message.";
BA_DEF_ SG_  "SAEDocument" STRING ;
BA_DEF_ SG_  "GenSigEVName" STRING ;
BA_DEF_ SG_  "GenSigILSupport" ENUM  "No","Yes";
BA_DEF_ SG_  "GenSigSendType" ENUM  "Cyclic","OnWrite","OnWriteWithRepetition","OnChange","OnChangeWithRepetition","IfActive","IfActiveWithRepetition","NoSigSendType";
BA_DEF_ BO_  "SAE_Document" STRING ;
BA_DEF_ BO_  "SingleFrame" INT 0 1;
BA_DEF_ BO_  "GenMsgILSupport" ENUM  "No","Yes";
BA_DEF_ BO_  "VFrameFormat" ENUM  "StandardCAN","ExtendedCAN","reserved","J1939PG";
BA_DEF_ BU_  "NodeLayerModules" STRING ;
BA_DEF_ SG_  "SPN" INT 0 524287;
BA_DEF_ BO_  "GenMsgSendType" ENUM  "cyclic","NotUsed","NotUsed","NotUsed","NotUsed","NotUsed","NotUsed","IfActive","noMsgSendType";
BA_DEF_ BO_  "GenMsgRequestable" INT 0 1;
BA_DEF_ BU_  "NmStationAddress" INT 0 255;
BA_DEF_ BU_  "NmJ1939AAC" INT 0 1;
BA_DEF_ BU_  "NmJ1939IndustryGroup" INT 0 7;
BA_DEF_ BU_  "NmJ1939System" INT 0 127;
BA_DEF_ BU_  "NmJ1939SystemInstance" INT 0 15;
BA_DEF_ BU_  "NmJ1939Function" INT 0 255;
BA_DEF_ BU_  "NmJ1939FunctionInstance" INT 0 7;
BA_DEF_ BU_  "NmJ1939ECUInstance" INT 0 7;
BA_DEF_ BU_  "NmJ1939ManufacturerCode" INT 0 2047;
BA_DEF_ BU_  "NmJ1939IdentityNumber" INT 0 2097151;
BA_DEF_ BU_  "ECU" STRING ;
BA_DEF_  "ProtocolType" STRING ;
BA_DEF_  "BusType" STRING ;
BA_DEF_DEF_  "SAEDocument" "";
BA_DEF_DEF_  "GenSigEVName" "Env@Nodename_@Signame";
BA_DEF_DEF_  "GenSigILSupport" "Yes";
BA_DEF_DEF_  "GenSigSendType" "NoSigSendType";
BA_DEF_DEF_  "SAE_Document" "";
BA_DEF_DEF_  "SingleFrame" 1;
BA_DEF_DEF_  "GenMsgILSupport" "Yes";
BA_DEF_DEF_  "VFrameFormat" "J1939PG";
BA_DEF_DEF_  "NodeLayerModules" "";
BA_DEF_DEF_  "SPN" 0;
BA_DEF_DEF_  "GenMsgSendType" "noMsgSendType";
BA_DEF_DEF_  "GenMsgRequestable" 1;
BA_DEF_DEF_  "NmStationAddress" 254;
BA_DEF_DEF_  "NmJ1939AAC" 0;
BA_DEF_DEF_  "NmJ1939IndustryGroup" 0;
BA_DEF_DEF_  "NmJ1939System" 0;
BA_DEF_DEF_  "NmJ1939SystemInstance" 0;
BA_DEF_DEF_  "NmJ1939Function" 0;
BA_DEF_DEF_  "NmJ1939FunctionInstance" 0;
BA_DEF_DEF_  "NmJ1939ECUInstance" 0;
BA_DEF_DEF_  "NmJ1939ManufacturerCode" 0;
BA_DEF_DEF_  "NmJ1939IdentityNumber" 0;
BA_DEF_DEF_  "ECU" "";
BA_DEF_DEF_  "ProtocolType" "";
BA_DEF_DEF_  "BusType" "CAN";
BA_ "ProtocolType" "J1939";
BA_ "NodeLayerModules" BU_ Node2 "J1939_IL.vmodule";
BA_ "NmStationAddress" BU_ Node2 2;
BA_ "NmJ1939Function" BU_ Node2 128;
BA_ "NmJ1939ManufacturerCode" BU_ Node2 1861;
BA_ "NmJ1939IdentityNumber" BU_ Node2 2;
BA_ "ECU" BU_ Node2 "Node2";
BA_ "NodeLayerModules" BU_ Node1 "J1939_IL.vmodule";
BA_ "NmJ1939Function" BU_ Node1 128;
BA_ "NmJ1939ManufacturerCode" BU_ Node1 1861;
BA_ "NmJ1939IdentityNumber" BU_ Node1 1;
BA_ "ECU" BU_ Node1 "Node1";
BA_ "NmStationAddress" BU_ Node1 1;
BA_ "SAE_Document" BO_ 2632711934 "J1939-21";
BA_ "SAE_Document" BO_ 2632777470 "J1939-21";
BA_ "SAEDocument" SG_ 2632711934 SequenceNumber "J1939-21";
BA_ "SPN" SG_ 2632711934 SequenceNumber 2572;
BA_ "SAEDocument" SG_ 2632777470 TotalNumberOfPacketsEoMA "J1939-21";
BA_ "SAEDocument" SG_ 2632777470 TotalMessageSizeEoMA "J1939-21";
BA_ "SAEDocument" SG_ 2632777470 TotalMessageSizeBAM "J1939-21";
BA_ "SAEDocument" SG_ 2632777470 TotalNumberOfPacketsBAM "J1939-21";
BA_ "SAEDocument" SG_ 2632777470 ConnectionAbortReason "J1939-21";
BA_ "SPN" SG_ 2632777470 ConnectionAbortReason 2570;
BA_ "SAEDocument" SG_ 2632777470 NextPacketNumberToBeSent "J1939-21";
BA_ "SPN" SG_ 2632777470 NextPacketNumberToBeSent 2562;
BA_ "SAEDocument" SG_ 2632777470 NumberOfPacketsThatCanBeSent "J1939-21";
BA_ "SPN" SG_ 2632777470 NumberOfPacketsThatCanBeSent 2561;
BA_ "SAEDocument" SG_ 2632777470 PGNumber "J1939-21";
BA_ "SPN" SG_ 2632777470 PGNumber 2560;
BA_ "SAEDocument" SG_ 2632777470 MaximumNumberOfPackets "J1939-21";
BA_ "SPN" SG_ 2632777470 MaximumNumberOfPackets 2559;
BA_ "SAEDocument" SG_ 2632777470 TotalNumberOfPackets "J1939-21";
BA_ "SPN" SG_ 2632777470 TotalNumberOfPackets 2558;
BA_ "SAEDocument" SG_ 2632777470 TotalMessageSize "J1939-21";
BA_ "SPN" SG_ 2632777470 TotalMessageSize 2557;
BA_ "SAEDocument" SG_ 2632777470 ControlByte "J1939-21";
BA_ "SPN" SG_ 2632777470 ControlByte 2556;
VAL_ 2632777470 PGNumber 255 "NotAvailable" ;
VAL_ 2632777470 ControlByte 255 "Abort" 32 "BAM" 19 "EoMA" 17 "CTS" 16 "RTS" ;
