/*@!Encoding:1252*/
includes
{
  #include "Common.cin"
}

variables
{
  byte Counter;
}

on preStart
{
  Counter = 0;
}

on sysvar_update sysvar::CAN3::ECU31::SendPDU2_DLC08
{
  if (@this > 0)
  {
    J1939ILSetSignal(CAN3::PDU2_DLC08_ECU31::Signal1, Counter++ );
    J1939ILSetMsgEvent(CAN3::PDU2_DLC08_ECU31); 
    
    InitCalculationOfTransmissionTime();
  }
}

on sysvar_update sysvar::CAN3::ECU31::SendPDU2_DLC23
{
  if (@this > 0)
  {
    J1939ILSetSignal(CAN3::PDU2_DLC23_ECU31::Signal1, Counter++ );
    J1939ILSetMsgEvent(CAN3::PDU2_DLC23_ECU31); 

    InitCalculationOfTransmissionTime();
  }
}

on pg CAN3::PDU1_DLC08_ECU10
{
  CalculateTransmissionTime();
}

on pg CAN3::PDU1_DLC23_ECU10
{
  CalculateTransmissionTime();
}

on pg CAN3::PDU2_DLC08_ECU11
{
  CalculateTransmissionTime();
}

on pg CAN3::PDU2_DLC23_ECU11
{
  CalculateTransmissionTime();
}