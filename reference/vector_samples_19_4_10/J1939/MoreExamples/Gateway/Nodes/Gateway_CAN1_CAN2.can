/*@!Encoding:1252*/
includes
{
  #include "Common.cin"
}

//
// This gateway handles transport protocol messages on one channel
// and forwards the complete PGs on the other channel 
//

variables
{
  byte TP_IsActive;             // > 0 if a transport protocol is currently active
  pg * TP_Message = {DLC=1785}; // Message which is currently transferred via transport protocol
  byte AddressOfNode10 = 10;
  byte AddressOfNode11 = 11;
  byte AddressOfNode20 = 20;
  byte AddressOfNode21 = 21;

  struct TPSession
  {
    byte  isActive;
    dword pgn;      // PGN to transmit
    byte  numberOfPackets;  // 
    word  numberOfBytes;
  };
  
  struct TPSession TPSessions[int64]; 
}

dword GetSessionKey(byte sourceAddress, byte destinationAddress, byte channel)
{
  return sourceAddress | (destinationAddress << 8) | (channel << 16);
}

//
// Flow control for the CMDT transport protocol
//
on pg CAN1::TPCMxx, CAN1::TPDT
{
  if (this.dir == Tx) return;
  
  HandleCMDTMessages(this.can, this);
}

//
// Flow control for the CMDT transport protocol
//
on pg CAN2::TPCMxx, CAN2::TPDT
{
  if (this.dir == Tx) return;
  
  HandleCMDTMessages(this.can, this);
}

//
// To receive the complete PG this functions responds received 
// RTS and DT messages with CTS and EoMA messages to handle 
// the current transport session (on the channel of the sender) 
//
// The parameter groups TPCMxx and TPDT are not forwarded to the other
// channel. Only the complete PG is forwared in event procedure 'on pg' 
//
void HandleCMDTMessages(byte channel, pg * tpMsg)
{
  struct TPSession session;
  pg CAN1::TPCMxx cmPG;

  if (tpMsg.dir == Tx) return;
  
  if ((tpMsg.sa != AddressOfNode10) &&
      (tpMsg.sa != AddressOfNode11) &&
      (tpMsg.sa != AddressOfNode20) &&
      (tpMsg.sa != AddressOfNode21))
  {
    return;
  }
  
  if ((tpMsg.da != AddressOfNode10) &&
      (tpMsg.da != AddressOfNode11) &&
      (tpMsg.da != AddressOfNode20) &&
      (tpMsg.da != AddressOfNode21))
  {
    return;
  }

  cmPG.SA  = tpMsg.DA;
  cmPG.DA  = tpMsg.SA;
  cmPG.CAN = tpMsg.CAN;
  cmPG.dword(0) = cmPG.dword(4) = 0xffffffff;
 
  if (tpMsg.PF == 0xec) // TPCMxx
  { 
    if (tpMsg.byte(0) == 0x10) // RTS
    {      
      // new session
      if (TPSessions[GetSessionKey(tpMsg.sa, tpMsg.da, channel)].isActive == 0)
      {
        TPSessions[GetSessionKey(tpMsg.sa, tpMsg.da, channel)].numberOfPackets = tpMsg.byte(3);
        TPSessions[GetSessionKey(tpMsg.sa, tpMsg.da, channel)].numberOfBytes   = tpMsg.word(1);
        TPSessions[GetSessionKey(tpMsg.sa, tpMsg.da, channel)].pgn             = (tpMsg.byte(5)) | (tpMsg.byte(6) << 8) | (tpMsg.byte(7) << 16);
        TPSessions[GetSessionKey(tpMsg.sa, tpMsg.da, channel)].isActive        = 1;
        
        // send CTS
        cmPG.ControlByte                  = cmPG.ControlByte::CTS;
        cmPG.NumberOfPacketsThatCanBeSent = 1;
        cmPG.NextPacketNumberToBeSent     = 1;
        cmPG.PGNumber                     = TPSessions[GetSessionKey(tpMsg.sa, tpMsg.da, channel)].pgn;
        output( cmPG );
      }
    }
  }
  else if (tpMsg.PF == 0xeb) // TPDT
  { 
    if (TPSessions[GetSessionKey(tpMsg.sa, tpMsg.da, channel)].isActive > 0)
    {
      if(tpMsg.byte(0) < TPSessions[GetSessionKey(tpMsg.sa, tpMsg.da, channel)].numberOfPackets) 
      {
        //send CTS
        cmPG.ControlByte                  = cmPG.ControlByte::CTS;
        cmPG.NumberOfPacketsThatCanBeSent = 1;
        cmPG.NextPacketNumberToBeSent     = tpMsg.byte(0) + 1;
        cmPG.PGNumber                     = TPSessions[GetSessionKey(tpMsg.sa, tpMsg.da, channel)].pgn;
        output( cmPG );
      }
      else // last packet
      { 
        // send CTS
        cmPG.ControlByte          = cmPG.ControlByte::EoMA;
        cmPG.TotalMessageSize     = TPSessions[GetSessionKey(tpMsg.sa, tpMsg.da, channel)].numberOfBytes;
        cmPG.TotalNumberOfPackets = TPSessions[GetSessionKey(tpMsg.sa, tpMsg.da, channel)].numberOfPackets;
        cmPG.PGNumber             = TPSessions[GetSessionKey(tpMsg.sa, tpMsg.da, channel)].pgn;
        output( cmPG );
        TPSessions[GetSessionKey(tpMsg.sa, tpMsg.da, channel)].isActive = 0;  // close session
      }
    }
  }
}

//
// Forward received paramter groups to CAN2 which
// - do not handle transport protocol (TPCMxx, TPDT)
// - are sent to Node20, Node21 or the global address
//
on pg CAN1.*
{
  dword i;
  pg * forwardMessage = {DLC=1785}; 
  byte destinationAddress;
  
  if (this.dir == Tx) return;
  if (this.pgn == TPCMxx.pgn) return;
  if (this.pgn == TPDT.pgn) return;
  
  destinationAddress = GetDestinationAddressOfPgn(this.pgn, this.da);
  if ((destinationAddress != AddressOfNode20) && 
      (destinationAddress != AddressOfNode21) && 
      (destinationAddress != GlobalAddress))
  {
    return;
  }
  
  // forward all other messages
  forwardMessage = this;
  forwardMessage.can = 2;
  
  // here you can filter the PG, modify its content or else
  // (in this demo configuration we modify the PGNs)
  if (@sysvar::Gateway_CAN1_CAN2::ExchangePGN > 0)
  {
    switch (this.pgn)
    {
      case PDU1_DLC08_ECU10.pgn: forwardMessage.pgn = PDU1_DLC08_ECU20.pgn; break;
      case PDU1_DLC23_ECU10.pgn: forwardMessage.pgn = PDU1_DLC23_ECU20.pgn; break;
      case PDU2_DLC08_ECU11.pgn: forwardMessage.pgn = PDU2_DLC08_ECU21.pgn; break;
      case PDU2_DLC23_ECU11.pgn: forwardMessage.pgn = PDU2_DLC23_ECU21.pgn; break;
      default: break;      
    }
  }
  
  output(forwardMessage);
}

//
// Forward received paramter groups to CAN2 which
// - do not handle transport protocol (TPCMxx, TPDT)
// - are sent to Node10, Node11 or the global address
//
on pg CAN2.*
{
  dword i;
  pg * forwardMessage = {DLC=1785}; 
  byte destinationAddress;
  
  
  if (this.dir == Tx) return;
  if (this.pgn == TPCMxx.pgn) return;
  if (this.pgn == TPDT.pgn) return;
  
  destinationAddress = GetDestinationAddressOfPgn(this.pgn, this.da);
  if ((destinationAddress != AddressOfNode10) && 
      (destinationAddress != AddressOfNode11) && 
      (destinationAddress != GlobalAddress))
  {
    return;
  }
     
  // forward all other messages
  forwardMessage = this;
  forwardMessage.can = 1;
  
  // here you can filter the PG, modify its content or else
  // (in this demo configuration we modify the PGNs)
  if (@sysvar::Gateway_CAN1_CAN2::ExchangePGN > 0)
  {
    switch (this.pgn)
    {
      case PDU1_DLC08_ECU20.pgn: forwardMessage.pgn = PDU1_DLC08_ECU10.pgn; break;
      case PDU1_DLC23_ECU20.pgn: forwardMessage.pgn = PDU1_DLC23_ECU10.pgn; break;
      case PDU2_DLC08_ECU21.pgn: forwardMessage.pgn = PDU2_DLC08_ECU11.pgn; break;
      case PDU2_DLC23_ECU21.pgn: forwardMessage.pgn = PDU2_DLC23_ECU11.pgn; break;
      default: break;      
    }   
  }

  output(forwardMessage);
}