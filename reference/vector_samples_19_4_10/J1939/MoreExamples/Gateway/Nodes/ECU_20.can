/*@!Encoding:1252*/
includes
{
  #include "Common.cin"
}

variables
{
  byte Counter;
}

on preStart
{
  Counter = 0;
}

on sysvar_update sysvar::CAN2::ECU20::SendPDU1_DLC08
{
  if (@this > 0)
  {
    J1939ILSetMsgDA(CAN2::PDU1_DLC08_ECU20, @sysvar::CAN2::ECU20::DestinationAddress);
    J1939ILSetSignal(CAN2::PDU1_DLC08_ECU20::Signal1, Counter++ );
    J1939ILSetMsgEvent(CAN2::PDU1_DLC08_ECU20); 
    
    InitCalculationOfTransmissionTime();
  }
}

on sysvar_update sysvar::CAN2::ECU20::SendPDU1_DLC23
{
  if (@this > 0)
  {
    J1939ILSetMsgDA(CAN2::PDU1_DLC23_ECU20, @sysvar::CAN2::ECU20::DestinationAddress);
    J1939ILSetSignal(CAN2::PDU1_DLC23_ECU20::Signal1, Counter++ );
    J1939ILSetMsgEvent(CAN2::PDU1_DLC23_ECU20); 

    InitCalculationOfTransmissionTime();
  }
}

on pg CAN2::PDU1_DLC08_ECU10
{
  CalculateTransmissionTime();
}

on pg CAN2::PDU1_DLC23_ECU10
{
  CalculateTransmissionTime();
}

on pg CAN2::PDU2_DLC08_ECU11
{
  CalculateTransmissionTime();
}

on pg CAN2::PDU2_DLC23_ECU11
{
  CalculateTransmissionTime();
}