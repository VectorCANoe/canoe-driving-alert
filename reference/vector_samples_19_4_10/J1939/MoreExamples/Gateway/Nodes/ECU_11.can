/*@!Encoding:1252*/
includes
{
  #include "Common.cin"
}

variables
{
  byte Counter;
}

on preStart
{
  Counter = 0;
}

on sysvar_update sysvar::CAN1::ECU11::SendPDU2_DLC08
{
  if (@this > 0)
  {
    J1939ILSetSignal(CAN1::PDU2_DLC08_ECU11::Signal1, Counter++ );
    J1939ILSetMsgEvent(CAN1::PDU2_DLC08_ECU11); 
    
    InitCalculationOfTransmissionTime();
  }
}

on sysvar_update sysvar::CAN1::ECU11::SendPDU2_DLC23
{
  if (@this > 0)
  {
    J1939ILSetSignal(CAN1::PDU2_DLC23_ECU11::Signal1, Counter++ );
    J1939ILSetMsgEvent(CAN1::PDU2_DLC23_ECU11); 
    
    InitCalculationOfTransmissionTime();
  }
}

on pg CAN1::PDU1_DLC08_ECU20
{
  CalculateTransmissionTime();
}

on pg CAN1::PDU1_DLC23_ECU20
{
  CalculateTransmissionTime();
}

on pg CAN1::PDU2_DLC08_ECU21
{
  CalculateTransmissionTime();
}

on pg CAN1::PDU2_DLC23_ECU21
{
  CalculateTransmissionTime();
}

on pg CAN1::PDU1_DLC08_ECU30
{
  CalculateTransmissionTime();
}

on pg CAN1::PDU1_DLC23_ECU30
{
  CalculateTransmissionTime();
}

on pg CAN1::PDU2_DLC08_ECU31
{
  CalculateTransmissionTime();
}

on pg CAN1::PDU2_DLC23_ECU31
{
  CalculateTransmissionTime();
}