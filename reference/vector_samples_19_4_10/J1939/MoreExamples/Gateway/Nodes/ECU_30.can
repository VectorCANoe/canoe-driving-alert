/*@!Encoding:1252*/
includes
{
  #include "Common.cin"
}

variables
{
  byte Counter;
}

on preStart
{
  Counter = 0;
}

on sysvar_update sysvar::CAN3::ECU30::SendPDU1_DLC08
{
  if (@this > 0)
  {
    J1939ILSetMsgDA(CAN3::PDU1_DLC08_ECU30, @sysvar::CAN3::ECU30::DestinationAddress);
    J1939ILSetSignal(CAN3::PDU1_DLC08_ECU30::Signal1, Counter++ );
    J1939ILSetMsgEvent(CAN3::PDU1_DLC08_ECU30); 
    
    InitCalculationOfTransmissionTime();
  }
}

on sysvar_update sysvar::CAN3::ECU30::SendPDU1_DLC23
{
  if (@this > 0)
  {
    J1939ILSetMsgDA(CAN3::PDU1_DLC23_ECU30, @sysvar::CAN3::ECU30::DestinationAddress);
    J1939ILSetSignal(CAN3::PDU1_DLC23_ECU30::Signal1, Counter++ );
    J1939ILSetMsgEvent(CAN3::PDU1_DLC23_ECU30); 
    
    InitCalculationOfTransmissionTime();
  }
}

on pg CAN3::PDU1_DLC08_ECU10
{
  CalculateTransmissionTime();
}

on pg CAN3::PDU1_DLC23_ECU10
{
  CalculateTransmissionTime();
}

on pg CAN3::PDU2_DLC08_ECU11
{
  CalculateTransmissionTime();
}

on pg CAN3::PDU2_DLC23_ECU11
{
  CalculateTransmissionTime();
}