VERSION ""

NS_ :

BS_:

BU_: EBS EMS

BO_ 2566705918 DM54: 22 Vector__XXX
 SG_ SPN_High4 : 133|3@1+ (1,0) [0|7] "" Vector__XXX
 SG_ SPN_High3 : 101|3@1+ (1,0) [0|7] "" Vector__XXX
 SG_ SPN_High5 : 165|3@1+ (1,0) [0|7] "" Vector__XXX
 SG_ SPN_High2 : 69|3@1+ (1,0) [0|7] "" Vector__XXX
 SG_ SPN_High1 : 37|3@1+ (1,0) [0|7] "" Vector__XXX
 SG_ SpnConversionMethod1 : 47|1@1+ (1,0) [0|1] "" Vector__XXX
 SG_ SpnConversionMethod5 : 175|1@1+ (1,0) [0|1] "" Vector__XXX
 SG_ SpnConversionMethod4 : 143|1@1+ (1,0) [0|1] "" Vector__XXX
 SG_ SpnConversionMethod3 : 111|1@1+ (1,0) [0|1] "" Vector__XXX
 SG_ SpnConversionMethod2 : 79|1@1+ (1,0) [0|1] "" Vector__XXX
 SG_ OccurenceCount5 : 168|7@1+ (1,0) [0|127] "" Vector__XXX
 SG_ OccurenceCount4 : 136|7@1+ (1,0) [0|127] "" Vector__XXX
 SG_ OccurenceCount3 : 104|7@1+ (1,0) [0|127] "" Vector__XXX
 SG_ OccurenceCount2 : 72|7@1+ (1,0) [0|127] "" Vector__XXX
 SG_ OccurenceCount1 : 40|7@1+ (1,0) [0|127] "" Vector__XXX
 SG_ FMI5 : 160|5@1+ (1,0) [0|31] "" Vector__XXX
 SG_ FMI4 : 128|5@1+ (1,0) [0|31] "" Vector__XXX
 SG_ FMI3 : 96|5@1+ (1,0) [0|31] "" Vector__XXX
 SG_ FMI2 : 64|5@1+ (1,0) [0|31] "" Vector__XXX
 SG_ FMI1 : 32|5@1+ (1,0) [0|31] "" Vector__XXX
 SG_ FlashRedStopLamp : 12|2@1+ (1,0) [0|3] "" Vector__XXX
 SG_ FlashProtectLamp : 8|2@1+ (1,0) [0|3] "" Vector__XXX
 SG_ FlashMalfuncIndicatorLamp : 14|2@1+ (1,0) [0|3] "" Vector__XXX
 SG_ FlashAmberWarningLamp : 10|2@1+ (1,0) [0|3] "" Vector__XXX
 SG_ MalfunctionIndLampStatus : 6|2@1+ (1,0) [0|3] "" Vector__XXX
 SG_ AmberWarningLampStatus : 2|2@1+ (1,0) [0|3] "" Vector__XXX
 SG_ RedStopLampState : 4|2@1+ (1,0) [0|3] "" Vector__XXX
 SG_ ProtectLampStatus : 0|2@1+ (1,0) [0|3] "" Vector__XXX
 SG_ SPN5 : 144|16@1+ (1,0) [0|524287] "" Vector__XXX
 SG_ SPN4 : 112|16@1+ (1,0) [0|524287] "" Vector__XXX
 SG_ SPN3 : 80|16@1+ (1,0) [0|524287] "" Vector__XXX
 SG_ SPN2 : 48|16@1+ (1,0) [0|524287] "" Vector__XXX
 SG_ SPN1 : 16|16@1+ (1,0) [0|524287] "" Vector__XXX

BO_ 2566705662 DM53: 22 Vector__XXX
 SG_ SPN_High4 : 133|3@1+ (1,0) [0|7] "" Vector__XXX
 SG_ SPN_High3 : 101|3@1+ (1,0) [0|7] "" Vector__XXX
 SG_ SPN_High5 : 165|3@1+ (1,0) [0|7] "" Vector__XXX
 SG_ SPN_High2 : 69|3@1+ (1,0) [0|7] "" Vector__XXX
 SG_ SPN_High1 : 37|3@1+ (1,0) [0|7] "" Vector__XXX
 SG_ SpnConversionMethod1 : 47|1@1+ (1,0) [0|1] "" Vector__XXX
 SG_ SpnConversionMethod5 : 175|1@1+ (1,0) [0|1] "" Vector__XXX
 SG_ SpnConversionMethod4 : 143|1@1+ (1,0) [0|1] "" Vector__XXX
 SG_ SpnConversionMethod3 : 111|1@1+ (1,0) [0|1] "" Vector__XXX
 SG_ SpnConversionMethod2 : 79|1@1+ (1,0) [0|1] "" Vector__XXX
 SG_ OccurenceCount5 : 168|7@1+ (1,0) [0|127] "" Vector__XXX
 SG_ OccurenceCount4 : 136|7@1+ (1,0) [0|127] "" Vector__XXX
 SG_ OccurenceCount3 : 104|7@1+ (1,0) [0|127] "" Vector__XXX
 SG_ OccurenceCount2 : 72|7@1+ (1,0) [0|127] "" Vector__XXX
 SG_ OccurenceCount1 : 40|7@1+ (1,0) [0|127] "" Vector__XXX
 SG_ FMI5 : 160|5@1+ (1,0) [0|31] "" Vector__XXX
 SG_ FMI4 : 128|5@1+ (1,0) [0|31] "" Vector__XXX
 SG_ FMI3 : 96|5@1+ (1,0) [0|31] "" Vector__XXX
 SG_ FMI2 : 64|5@1+ (1,0) [0|31] "" Vector__XXX
 SG_ FMI1 : 32|5@1+ (1,0) [0|31] "" Vector__XXX
 SG_ FlashRedStopLamp : 12|2@1+ (1,0) [0|3] "" Vector__XXX
 SG_ FlashProtectLamp : 8|2@1+ (1,0) [0|3] "" Vector__XXX
 SG_ FlashMalfuncIndicatorLamp : 14|2@1+ (1,0) [0|3] "" Vector__XXX
 SG_ FlashAmberWarningLamp : 10|2@1+ (1,0) [0|3] "" Vector__XXX
 SG_ MalfunctionIndLampStatus : 6|2@1+ (1,0) [0|3] "" Vector__XXX
 SG_ AmberWarningLampStatus : 2|2@1+ (1,0) [0|3] "" Vector__XXX
 SG_ RedStopLampState : 4|2@1+ (1,0) [0|3] "" Vector__XXX
 SG_ ProtectLampStatus : 0|2@1+ (1,0) [0|3] "" Vector__XXX
 SG_ SPN5 : 144|16@1+ (1,0) [0|524287] "" Vector__XXX
 SG_ SPN4 : 112|16@1+ (1,0) [0|524287] "" Vector__XXX
 SG_ SPN3 : 80|16@1+ (1,0) [0|524287] "" Vector__XXX
 SG_ SPN2 : 48|16@1+ (1,0) [0|524287] "" Vector__XXX
 SG_ SPN1 : 16|16@1+ (1,0) [0|524287] "" Vector__XXX

BO_ 2566739198 DM52: 22 Vector__XXX
 SG_ SPN_High4 : 133|3@1+ (1,0) [0|7] "" Vector__XXX
 SG_ SPN_High3 : 101|3@1+ (1,0) [0|7] "" Vector__XXX
 SG_ SPN_High5 : 165|3@1+ (1,0) [0|7] "" Vector__XXX
 SG_ SPN_High2 : 69|3@1+ (1,0) [0|7] "" Vector__XXX
 SG_ SPN_High1 : 37|3@1+ (1,0) [0|7] "" Vector__XXX
 SG_ SpnConversionMethod1 : 47|1@1+ (1,0) [0|1] "" Vector__XXX
 SG_ SpnConversionMethod5 : 175|1@1+ (1,0) [0|1] "" Vector__XXX
 SG_ SpnConversionMethod4 : 143|1@1+ (1,0) [0|1] "" Vector__XXX
 SG_ SpnConversionMethod3 : 111|1@1+ (1,0) [0|1] "" Vector__XXX
 SG_ SpnConversionMethod2 : 79|1@1+ (1,0) [0|1] "" Vector__XXX
 SG_ OccurenceCount5 : 168|7@1+ (1,0) [0|127] "" Vector__XXX
 SG_ OccurenceCount4 : 136|7@1+ (1,0) [0|127] "" Vector__XXX
 SG_ OccurenceCount3 : 104|7@1+ (1,0) [0|127] "" Vector__XXX
 SG_ OccurenceCount2 : 72|7@1+ (1,0) [0|127] "" Vector__XXX
 SG_ OccurenceCount1 : 40|7@1+ (1,0) [0|127] "" Vector__XXX
 SG_ FMI5 : 160|5@1+ (1,0) [0|31] "" Vector__XXX
 SG_ FMI4 : 128|5@1+ (1,0) [0|31] "" Vector__XXX
 SG_ FMI3 : 96|5@1+ (1,0) [0|31] "" Vector__XXX
 SG_ FMI2 : 64|5@1+ (1,0) [0|31] "" Vector__XXX
 SG_ FMI1 : 32|5@1+ (1,0) [0|31] "" Vector__XXX
 SG_ FlashRedStopLamp : 12|2@1+ (1,0) [0|3] "" Vector__XXX
 SG_ FlashProtectLamp : 8|2@1+ (1,0) [0|3] "" Vector__XXX
 SG_ FlashMalfuncIndicatorLamp : 14|2@1+ (1,0) [0|3] "" Vector__XXX
 SG_ FlashAmberWarningLamp : 10|2@1+ (1,0) [0|3] "" Vector__XXX
 SG_ MalfunctionIndLampStatus : 6|2@1+ (1,0) [0|3] "" Vector__XXX
 SG_ AmberWarningLampStatus : 2|2@1+ (1,0) [0|3] "" Vector__XXX
 SG_ RedStopLampState : 4|2@1+ (1,0) [0|3] "" Vector__XXX
 SG_ ProtectLampStatus : 0|2@1+ (1,0) [0|3] "" Vector__XXX
 SG_ SPN5 : 144|16@1+ (1,0) [0|524287] "" Vector__XXX
 SG_ SPN4 : 112|16@1+ (1,0) [0|524287] "" Vector__XXX
 SG_ SPN3 : 80|16@1+ (1,0) [0|524287] "" Vector__XXX
 SG_ SPN2 : 48|16@1+ (1,0) [0|524287] "" Vector__XXX
 SG_ SPN1 : 16|16@1+ (1,0) [0|524287] "" Vector__XXX

BO_ 2566739454 DM51: 22 Vector__XXX
 SG_ SPN_High4 : 133|3@1+ (1,0) [0|7] "" Vector__XXX
 SG_ SPN_High3 : 101|3@1+ (1,0) [0|7] "" Vector__XXX
 SG_ SPN_High5 : 165|3@1+ (1,0) [0|7] "" Vector__XXX
 SG_ SPN_High2 : 69|3@1+ (1,0) [0|7] "" Vector__XXX
 SG_ SPN_High1 : 37|3@1+ (1,0) [0|7] "" Vector__XXX
 SG_ SpnConversionMethod1 : 47|1@1+ (1,0) [0|1] "" Vector__XXX
 SG_ SpnConversionMethod5 : 175|1@1+ (1,0) [0|1] "" Vector__XXX
 SG_ SpnConversionMethod4 : 143|1@1+ (1,0) [0|1] "" Vector__XXX
 SG_ SpnConversionMethod3 : 111|1@1+ (1,0) [0|1] "" Vector__XXX
 SG_ SpnConversionMethod2 : 79|1@1+ (1,0) [0|1] "" Vector__XXX
 SG_ OccurenceCount5 : 168|7@1+ (1,0) [0|127] "" Vector__XXX
 SG_ OccurenceCount4 : 136|7@1+ (1,0) [0|127] "" Vector__XXX
 SG_ OccurenceCount3 : 104|7@1+ (1,0) [0|127] "" Vector__XXX
 SG_ OccurenceCount2 : 72|7@1+ (1,0) [0|127] "" Vector__XXX
 SG_ OccurenceCount1 : 40|7@1+ (1,0) [0|127] "" Vector__XXX
 SG_ FMI5 : 160|5@1+ (1,0) [0|31] "" Vector__XXX
 SG_ FMI4 : 128|5@1+ (1,0) [0|31] "" Vector__XXX
 SG_ FMI3 : 96|5@1+ (1,0) [0|31] "" Vector__XXX
 SG_ FMI2 : 64|5@1+ (1,0) [0|31] "" Vector__XXX
 SG_ FMI1 : 32|5@1+ (1,0) [0|31] "" Vector__XXX
 SG_ FlashRedStopLamp : 12|2@1+ (1,0) [0|3] "" Vector__XXX
 SG_ FlashProtectLamp : 8|2@1+ (1,0) [0|3] "" Vector__XXX
 SG_ FlashMalfuncIndicatorLamp : 14|2@1+ (1,0) [0|3] "" Vector__XXX
 SG_ FlashAmberWarningLamp : 10|2@1+ (1,0) [0|3] "" Vector__XXX
 SG_ MalfunctionIndLampStatus : 6|2@1+ (1,0) [0|3] "" Vector__XXX
 SG_ AmberWarningLampStatus : 2|2@1+ (1,0) [0|3] "" Vector__XXX
 SG_ RedStopLampState : 4|2@1+ (1,0) [0|3] "" Vector__XXX
 SG_ ProtectLampStatus : 0|2@1+ (1,0) [0|3] "" Vector__XXX
 SG_ SPN5 : 144|16@1+ (1,0) [0|524287] "" Vector__XXX
 SG_ SPN4 : 112|16@1+ (1,0) [0|524287] "" Vector__XXX
 SG_ SPN3 : 80|16@1+ (1,0) [0|524287] "" Vector__XXX
 SG_ SPN2 : 48|16@1+ (1,0) [0|524287] "" Vector__XXX
 SG_ SPN1 : 16|16@1+ (1,0) [0|524287] "" Vector__XXX

BO_ 2566739710 DM50: 22 Vector__XXX
 SG_ SPN_High4 : 133|3@1+ (1,0) [0|7] "" Vector__XXX
 SG_ SPN_High3 : 101|3@1+ (1,0) [0|7] "" Vector__XXX
 SG_ SPN_High5 : 165|3@1+ (1,0) [0|7] "" Vector__XXX
 SG_ SPN_High2 : 69|3@1+ (1,0) [0|7] "" Vector__XXX
 SG_ SPN_High1 : 37|3@1+ (1,0) [0|7] "" Vector__XXX
 SG_ SpnConversionMethod1 : 47|1@1+ (1,0) [0|1] "" Vector__XXX
 SG_ SpnConversionMethod5 : 175|1@1+ (1,0) [0|1] "" Vector__XXX
 SG_ SpnConversionMethod4 : 143|1@1+ (1,0) [0|1] "" Vector__XXX
 SG_ SpnConversionMethod3 : 111|1@1+ (1,0) [0|1] "" Vector__XXX
 SG_ SpnConversionMethod2 : 79|1@1+ (1,0) [0|1] "" Vector__XXX
 SG_ OccurenceCount5 : 168|7@1+ (1,0) [0|127] "" Vector__XXX
 SG_ OccurenceCount4 : 136|7@1+ (1,0) [0|127] "" Vector__XXX
 SG_ OccurenceCount3 : 104|7@1+ (1,0) [0|127] "" Vector__XXX
 SG_ OccurenceCount2 : 72|7@1+ (1,0) [0|127] "" Vector__XXX
 SG_ OccurenceCount1 : 40|7@1+ (1,0) [0|127] "" Vector__XXX
 SG_ FMI5 : 160|5@1+ (1,0) [0|31] "" Vector__XXX
 SG_ FMI4 : 128|5@1+ (1,0) [0|31] "" Vector__XXX
 SG_ FMI3 : 96|5@1+ (1,0) [0|31] "" Vector__XXX
 SG_ FMI2 : 64|5@1+ (1,0) [0|31] "" Vector__XXX
 SG_ FMI1 : 32|5@1+ (1,0) [0|31] "" Vector__XXX
 SG_ FlashRedStopLamp : 12|2@1+ (1,0) [0|3] "" Vector__XXX
 SG_ FlashProtectLamp : 8|2@1+ (1,0) [0|3] "" Vector__XXX
 SG_ FlashMalfuncIndicatorLamp : 14|2@1+ (1,0) [0|3] "" Vector__XXX
 SG_ FlashAmberWarningLamp : 10|2@1+ (1,0) [0|3] "" Vector__XXX
 SG_ MalfunctionIndLampStatus : 6|2@1+ (1,0) [0|3] "" Vector__XXX
 SG_ AmberWarningLampStatus : 2|2@1+ (1,0) [0|3] "" Vector__XXX
 SG_ RedStopLampState : 4|2@1+ (1,0) [0|3] "" Vector__XXX
 SG_ ProtectLampStatus : 0|2@1+ (1,0) [0|3] "" Vector__XXX
 SG_ SPN5 : 144|16@1+ (1,0) [0|524287] "" Vector__XXX
 SG_ SPN4 : 112|16@1+ (1,0) [0|524287] "" Vector__XXX
 SG_ SPN3 : 80|16@1+ (1,0) [0|524287] "" Vector__XXX
 SG_ SPN2 : 48|16@1+ (1,0) [0|524287] "" Vector__XXX
 SG_ SPN1 : 16|16@1+ (1,0) [0|524287] "" Vector__XXX

BO_ 2566739966 DM49: 22 Vector__XXX
 SG_ SPN_High4 : 133|3@1+ (1,0) [0|7] "" Vector__XXX
 SG_ SPN_High3 : 101|3@1+ (1,0) [0|7] "" Vector__XXX
 SG_ SPN_High5 : 165|3@1+ (1,0) [0|7] "" Vector__XXX
 SG_ SPN_High2 : 69|3@1+ (1,0) [0|7] "" Vector__XXX
 SG_ SPN_High1 : 37|3@1+ (1,0) [0|7] "" Vector__XXX
 SG_ SpnConversionMethod1 : 47|1@1+ (1,0) [0|1] "" Vector__XXX
 SG_ SpnConversionMethod5 : 175|1@1+ (1,0) [0|1] "" Vector__XXX
 SG_ SpnConversionMethod4 : 143|1@1+ (1,0) [0|1] "" Vector__XXX
 SG_ SpnConversionMethod3 : 111|1@1+ (1,0) [0|1] "" Vector__XXX
 SG_ SpnConversionMethod2 : 79|1@1+ (1,0) [0|1] "" Vector__XXX
 SG_ OccurenceCount5 : 168|7@1+ (1,0) [0|127] "" Vector__XXX
 SG_ OccurenceCount4 : 136|7@1+ (1,0) [0|127] "" Vector__XXX
 SG_ OccurenceCount3 : 104|7@1+ (1,0) [0|127] "" Vector__XXX
 SG_ OccurenceCount2 : 72|7@1+ (1,0) [0|127] "" Vector__XXX
 SG_ OccurenceCount1 : 40|7@1+ (1,0) [0|127] "" Vector__XXX
 SG_ FMI5 : 160|5@1+ (1,0) [0|31] "" Vector__XXX
 SG_ FMI4 : 128|5@1+ (1,0) [0|31] "" Vector__XXX
 SG_ FMI3 : 96|5@1+ (1,0) [0|31] "" Vector__XXX
 SG_ FMI2 : 64|5@1+ (1,0) [0|31] "" Vector__XXX
 SG_ FMI1 : 32|5@1+ (1,0) [0|31] "" Vector__XXX
 SG_ FlashRedStopLamp : 12|2@1+ (1,0) [0|3] "" Vector__XXX
 SG_ FlashProtectLamp : 8|2@1+ (1,0) [0|3] "" Vector__XXX
 SG_ FlashMalfuncIndicatorLamp : 14|2@1+ (1,0) [0|3] "" Vector__XXX
 SG_ FlashAmberWarningLamp : 10|2@1+ (1,0) [0|3] "" Vector__XXX
 SG_ MalfunctionIndLampStatus : 6|2@1+ (1,0) [0|3] "" Vector__XXX
 SG_ AmberWarningLampStatus : 2|2@1+ (1,0) [0|3] "" Vector__XXX
 SG_ RedStopLampState : 4|2@1+ (1,0) [0|3] "" Vector__XXX
 SG_ ProtectLampStatus : 0|2@1+ (1,0) [0|3] "" Vector__XXX
 SG_ SPN5 : 144|16@1+ (1,0) [0|524287] "" Vector__XXX
 SG_ SPN4 : 112|16@1+ (1,0) [0|524287] "" Vector__XXX
 SG_ SPN3 : 80|16@1+ (1,0) [0|524287] "" Vector__XXX
 SG_ SPN2 : 48|16@1+ (1,0) [0|524287] "" Vector__XXX
 SG_ SPN1 : 16|16@1+ (1,0) [0|524287] "" Vector__XXX

BO_ 2566740222 DM48: 22 Vector__XXX
 SG_ SPN_High4 : 133|3@1+ (1,0) [0|7] "" Vector__XXX
 SG_ SPN_High3 : 101|3@1+ (1,0) [0|7] "" Vector__XXX
 SG_ SPN_High5 : 165|3@1+ (1,0) [0|7] "" Vector__XXX
 SG_ SPN_High2 : 69|3@1+ (1,0) [0|7] "" Vector__XXX
 SG_ SPN_High1 : 37|3@1+ (1,0) [0|7] "" Vector__XXX
 SG_ SpnConversionMethod1 : 47|1@1+ (1,0) [0|1] "" Vector__XXX
 SG_ SpnConversionMethod5 : 175|1@1+ (1,0) [0|1] "" Vector__XXX
 SG_ SpnConversionMethod4 : 143|1@1+ (1,0) [0|1] "" Vector__XXX
 SG_ SpnConversionMethod3 : 111|1@1+ (1,0) [0|1] "" Vector__XXX
 SG_ SpnConversionMethod2 : 79|1@1+ (1,0) [0|1] "" Vector__XXX
 SG_ OccurenceCount5 : 168|7@1+ (1,0) [0|127] "" Vector__XXX
 SG_ OccurenceCount4 : 136|7@1+ (1,0) [0|127] "" Vector__XXX
 SG_ OccurenceCount3 : 104|7@1+ (1,0) [0|127] "" Vector__XXX
 SG_ OccurenceCount2 : 72|7@1+ (1,0) [0|127] "" Vector__XXX
 SG_ OccurenceCount1 : 40|7@1+ (1,0) [0|127] "" Vector__XXX
 SG_ FMI5 : 160|5@1+ (1,0) [0|31] "" Vector__XXX
 SG_ FMI4 : 128|5@1+ (1,0) [0|31] "" Vector__XXX
 SG_ FMI3 : 96|5@1+ (1,0) [0|31] "" Vector__XXX
 SG_ FMI2 : 64|5@1+ (1,0) [0|31] "" Vector__XXX
 SG_ FMI1 : 32|5@1+ (1,0) [0|31] "" Vector__XXX
 SG_ FlashRedStopLamp : 12|2@1+ (1,0) [0|3] "" Vector__XXX
 SG_ FlashProtectLamp : 8|2@1+ (1,0) [0|3] "" Vector__XXX
 SG_ FlashMalfuncIndicatorLamp : 14|2@1+ (1,0) [0|3] "" Vector__XXX
 SG_ FlashAmberWarningLamp : 10|2@1+ (1,0) [0|3] "" Vector__XXX
 SG_ MalfunctionIndLampStatus : 6|2@1+ (1,0) [0|3] "" Vector__XXX
 SG_ AmberWarningLampStatus : 2|2@1+ (1,0) [0|3] "" Vector__XXX
 SG_ RedStopLampState : 4|2@1+ (1,0) [0|3] "" Vector__XXX
 SG_ ProtectLampStatus : 0|2@1+ (1,0) [0|3] "" Vector__XXX
 SG_ SPN5 : 144|16@1+ (1,0) [0|524287] "" Vector__XXX
 SG_ SPN4 : 112|16@1+ (1,0) [0|524287] "" Vector__XXX
 SG_ SPN3 : 80|16@1+ (1,0) [0|524287] "" Vector__XXX
 SG_ SPN2 : 48|16@1+ (1,0) [0|524287] "" Vector__XXX
 SG_ SPN1 : 16|16@1+ (1,0) [0|524287] "" Vector__XXX

BO_ 2566740478 DM47: 22 Vector__XXX
 SG_ SPN_High4 : 133|3@1+ (1,0) [0|7] "" Vector__XXX
 SG_ SPN_High3 : 101|3@1+ (1,0) [0|7] "" Vector__XXX
 SG_ SPN_High5 : 165|3@1+ (1,0) [0|7] "" Vector__XXX
 SG_ SPN_High2 : 69|3@1+ (1,0) [0|7] "" Vector__XXX
 SG_ SPN_High1 : 37|3@1+ (1,0) [0|7] "" Vector__XXX
 SG_ SpnConversionMethod1 : 47|1@1+ (1,0) [0|1] "" Vector__XXX
 SG_ SpnConversionMethod5 : 175|1@1+ (1,0) [0|1] "" Vector__XXX
 SG_ SpnConversionMethod4 : 143|1@1+ (1,0) [0|1] "" Vector__XXX
 SG_ SpnConversionMethod3 : 111|1@1+ (1,0) [0|1] "" Vector__XXX
 SG_ SpnConversionMethod2 : 79|1@1+ (1,0) [0|1] "" Vector__XXX
 SG_ OccurenceCount5 : 168|7@1+ (1,0) [0|127] "" Vector__XXX
 SG_ OccurenceCount4 : 136|7@1+ (1,0) [0|127] "" Vector__XXX
 SG_ OccurenceCount3 : 104|7@1+ (1,0) [0|127] "" Vector__XXX
 SG_ OccurenceCount2 : 72|7@1+ (1,0) [0|127] "" Vector__XXX
 SG_ OccurenceCount1 : 40|7@1+ (1,0) [0|127] "" Vector__XXX
 SG_ FMI5 : 160|5@1+ (1,0) [0|31] "" Vector__XXX
 SG_ FMI4 : 128|5@1+ (1,0) [0|31] "" Vector__XXX
 SG_ FMI3 : 96|5@1+ (1,0) [0|31] "" Vector__XXX
 SG_ FMI2 : 64|5@1+ (1,0) [0|31] "" Vector__XXX
 SG_ FMI1 : 32|5@1+ (1,0) [0|31] "" Vector__XXX
 SG_ FlashRedStopLamp : 12|2@1+ (1,0) [0|3] "" Vector__XXX
 SG_ FlashProtectLamp : 8|2@1+ (1,0) [0|3] "" Vector__XXX
 SG_ FlashMalfuncIndicatorLamp : 14|2@1+ (1,0) [0|3] "" Vector__XXX
 SG_ FlashAmberWarningLamp : 10|2@1+ (1,0) [0|3] "" Vector__XXX
 SG_ MalfunctionIndLampStatus : 6|2@1+ (1,0) [0|3] "" Vector__XXX
 SG_ AmberWarningLampStatus : 2|2@1+ (1,0) [0|3] "" Vector__XXX
 SG_ RedStopLampState : 4|2@1+ (1,0) [0|3] "" Vector__XXX
 SG_ ProtectLampStatus : 0|2@1+ (1,0) [0|3] "" Vector__XXX
 SG_ SPN5 : 144|16@1+ (1,0) [0|524287] "" Vector__XXX
 SG_ SPN4 : 112|16@1+ (1,0) [0|524287] "" Vector__XXX
 SG_ SPN3 : 80|16@1+ (1,0) [0|524287] "" Vector__XXX
 SG_ SPN2 : 48|16@1+ (1,0) [0|524287] "" Vector__XXX
 SG_ SPN1 : 16|16@1+ (1,0) [0|524287] "" Vector__XXX

BO_ 2566740734 DM46: 22 Vector__XXX
 SG_ SPN_High4 : 133|3@1+ (1,0) [0|7] "" Vector__XXX
 SG_ SPN_High3 : 101|3@1+ (1,0) [0|7] "" Vector__XXX
 SG_ SPN_High5 : 165|3@1+ (1,0) [0|7] "" Vector__XXX
 SG_ SPN_High2 : 69|3@1+ (1,0) [0|7] "" Vector__XXX
 SG_ SPN_High1 : 37|3@1+ (1,0) [0|7] "" Vector__XXX
 SG_ SpnConversionMethod1 : 47|1@1+ (1,0) [0|1] "" Vector__XXX
 SG_ SpnConversionMethod5 : 175|1@1+ (1,0) [0|1] "" Vector__XXX
 SG_ SpnConversionMethod4 : 143|1@1+ (1,0) [0|1] "" Vector__XXX
 SG_ SpnConversionMethod3 : 111|1@1+ (1,0) [0|1] "" Vector__XXX
 SG_ SpnConversionMethod2 : 79|1@1+ (1,0) [0|1] "" Vector__XXX
 SG_ OccurenceCount5 : 168|7@1+ (1,0) [0|127] "" Vector__XXX
 SG_ OccurenceCount4 : 136|7@1+ (1,0) [0|127] "" Vector__XXX
 SG_ OccurenceCount3 : 104|7@1+ (1,0) [0|127] "" Vector__XXX
 SG_ OccurenceCount2 : 72|7@1+ (1,0) [0|127] "" Vector__XXX
 SG_ OccurenceCount1 : 40|7@1+ (1,0) [0|127] "" Vector__XXX
 SG_ FMI5 : 160|5@1+ (1,0) [0|31] "" Vector__XXX
 SG_ FMI4 : 128|5@1+ (1,0) [0|31] "" Vector__XXX
 SG_ FMI3 : 96|5@1+ (1,0) [0|31] "" Vector__XXX
 SG_ FMI2 : 64|5@1+ (1,0) [0|31] "" Vector__XXX
 SG_ FMI1 : 32|5@1+ (1,0) [0|31] "" Vector__XXX
 SG_ FlashRedStopLamp : 12|2@1+ (1,0) [0|3] "" Vector__XXX
 SG_ FlashProtectLamp : 8|2@1+ (1,0) [0|3] "" Vector__XXX
 SG_ FlashMalfuncIndicatorLamp : 14|2@1+ (1,0) [0|3] "" Vector__XXX
 SG_ FlashAmberWarningLamp : 10|2@1+ (1,0) [0|3] "" Vector__XXX
 SG_ MalfunctionIndLampStatus : 6|2@1+ (1,0) [0|3] "" Vector__XXX
 SG_ AmberWarningLampStatus : 2|2@1+ (1,0) [0|3] "" Vector__XXX
 SG_ RedStopLampState : 4|2@1+ (1,0) [0|3] "" Vector__XXX
 SG_ ProtectLampStatus : 0|2@1+ (1,0) [0|3] "" Vector__XXX
 SG_ SPN5 : 144|16@1+ (1,0) [0|524287] "" Vector__XXX
 SG_ SPN4 : 112|16@1+ (1,0) [0|524287] "" Vector__XXX
 SG_ SPN3 : 80|16@1+ (1,0) [0|524287] "" Vector__XXX
 SG_ SPN2 : 48|16@1+ (1,0) [0|524287] "" Vector__XXX
 SG_ SPN1 : 16|16@1+ (1,0) [0|524287] "" Vector__XXX

BO_ 2566740990 DM45: 22 Vector__XXX
 SG_ SPN_High4 : 133|3@1+ (1,0) [0|7] "" Vector__XXX
 SG_ SPN_High3 : 101|3@1+ (1,0) [0|7] "" Vector__XXX
 SG_ SPN_High5 : 165|3@1+ (1,0) [0|7] "" Vector__XXX
 SG_ SPN_High2 : 69|3@1+ (1,0) [0|7] "" Vector__XXX
 SG_ SPN_High1 : 37|3@1+ (1,0) [0|7] "" Vector__XXX
 SG_ SpnConversionMethod1 : 47|1@1+ (1,0) [0|1] "" Vector__XXX
 SG_ SpnConversionMethod5 : 175|1@1+ (1,0) [0|1] "" Vector__XXX
 SG_ SpnConversionMethod4 : 143|1@1+ (1,0) [0|1] "" Vector__XXX
 SG_ SpnConversionMethod3 : 111|1@1+ (1,0) [0|1] "" Vector__XXX
 SG_ SpnConversionMethod2 : 79|1@1+ (1,0) [0|1] "" Vector__XXX
 SG_ OccurenceCount5 : 168|7@1+ (1,0) [0|127] "" Vector__XXX
 SG_ OccurenceCount4 : 136|7@1+ (1,0) [0|127] "" Vector__XXX
 SG_ OccurenceCount3 : 104|7@1+ (1,0) [0|127] "" Vector__XXX
 SG_ OccurenceCount2 : 72|7@1+ (1,0) [0|127] "" Vector__XXX
 SG_ OccurenceCount1 : 40|7@1+ (1,0) [0|127] "" Vector__XXX
 SG_ FMI5 : 160|5@1+ (1,0) [0|31] "" Vector__XXX
 SG_ FMI4 : 128|5@1+ (1,0) [0|31] "" Vector__XXX
 SG_ FMI3 : 96|5@1+ (1,0) [0|31] "" Vector__XXX
 SG_ FMI2 : 64|5@1+ (1,0) [0|31] "" Vector__XXX
 SG_ FMI1 : 32|5@1+ (1,0) [0|31] "" Vector__XXX
 SG_ FlashRedStopLamp : 12|2@1+ (1,0) [0|3] "" Vector__XXX
 SG_ FlashProtectLamp : 8|2@1+ (1,0) [0|3] "" Vector__XXX
 SG_ FlashMalfuncIndicatorLamp : 14|2@1+ (1,0) [0|3] "" Vector__XXX
 SG_ FlashAmberWarningLamp : 10|2@1+ (1,0) [0|3] "" Vector__XXX
 SG_ MalfunctionIndLampStatus : 6|2@1+ (1,0) [0|3] "" Vector__XXX
 SG_ AmberWarningLampStatus : 2|2@1+ (1,0) [0|3] "" Vector__XXX
 SG_ RedStopLampState : 4|2@1+ (1,0) [0|3] "" Vector__XXX
 SG_ ProtectLampStatus : 0|2@1+ (1,0) [0|3] "" Vector__XXX
 SG_ SPN5 : 144|16@1+ (1,0) [0|524287] "" Vector__XXX
 SG_ SPN4 : 112|16@1+ (1,0) [0|524287] "" Vector__XXX
 SG_ SPN3 : 80|16@1+ (1,0) [0|524287] "" Vector__XXX
 SG_ SPN2 : 48|16@1+ (1,0) [0|524287] "" Vector__XXX
 SG_ SPN1 : 16|16@1+ (1,0) [0|524287] "" Vector__XXX

BO_ 2566741246 DM44: 22 Vector__XXX
 SG_ SPN_High4 : 133|3@1+ (1,0) [0|7] "" Vector__XXX
 SG_ SPN_High3 : 101|3@1+ (1,0) [0|7] "" Vector__XXX
 SG_ SPN_High5 : 165|3@1+ (1,0) [0|7] "" Vector__XXX
 SG_ SPN_High2 : 69|3@1+ (1,0) [0|7] "" Vector__XXX
 SG_ SPN_High1 : 37|3@1+ (1,0) [0|7] "" Vector__XXX
 SG_ SpnConversionMethod1 : 47|1@1+ (1,0) [0|1] "" Vector__XXX
 SG_ SpnConversionMethod5 : 175|1@1+ (1,0) [0|1] "" Vector__XXX
 SG_ SpnConversionMethod4 : 143|1@1+ (1,0) [0|1] "" Vector__XXX
 SG_ SpnConversionMethod3 : 111|1@1+ (1,0) [0|1] "" Vector__XXX
 SG_ SpnConversionMethod2 : 79|1@1+ (1,0) [0|1] "" Vector__XXX
 SG_ OccurenceCount5 : 168|7@1+ (1,0) [0|127] "" Vector__XXX
 SG_ OccurenceCount4 : 136|7@1+ (1,0) [0|127] "" Vector__XXX
 SG_ OccurenceCount3 : 104|7@1+ (1,0) [0|127] "" Vector__XXX
 SG_ OccurenceCount2 : 72|7@1+ (1,0) [0|127] "" Vector__XXX
 SG_ OccurenceCount1 : 40|7@1+ (1,0) [0|127] "" Vector__XXX
 SG_ FMI5 : 160|5@1+ (1,0) [0|31] "" Vector__XXX
 SG_ FMI4 : 128|5@1+ (1,0) [0|31] "" Vector__XXX
 SG_ FMI3 : 96|5@1+ (1,0) [0|31] "" Vector__XXX
 SG_ FMI2 : 64|5@1+ (1,0) [0|31] "" Vector__XXX
 SG_ FMI1 : 32|5@1+ (1,0) [0|31] "" Vector__XXX
 SG_ FlashRedStopLamp : 12|2@1+ (1,0) [0|3] "" Vector__XXX
 SG_ FlashProtectLamp : 8|2@1+ (1,0) [0|3] "" Vector__XXX
 SG_ FlashMalfuncIndicatorLamp : 14|2@1+ (1,0) [0|3] "" Vector__XXX
 SG_ FlashAmberWarningLamp : 10|2@1+ (1,0) [0|3] "" Vector__XXX
 SG_ MalfunctionIndLampStatus : 6|2@1+ (1,0) [0|3] "" Vector__XXX
 SG_ AmberWarningLampStatus : 2|2@1+ (1,0) [0|3] "" Vector__XXX
 SG_ RedStopLampState : 4|2@1+ (1,0) [0|3] "" Vector__XXX
 SG_ ProtectLampStatus : 0|2@1+ (1,0) [0|3] "" Vector__XXX
 SG_ SPN5 : 144|16@1+ (1,0) [0|524287] "" Vector__XXX
 SG_ SPN4 : 112|16@1+ (1,0) [0|524287] "" Vector__XXX
 SG_ SPN3 : 80|16@1+ (1,0) [0|524287] "" Vector__XXX
 SG_ SPN2 : 48|16@1+ (1,0) [0|524287] "" Vector__XXX
 SG_ SPN1 : 16|16@1+ (1,0) [0|524287] "" Vector__XXX

BO_ 2566741502 DM43: 22 Vector__XXX
 SG_ SPN_High4 : 133|3@1+ (1,0) [0|7] "" Vector__XXX
 SG_ SPN_High3 : 101|3@1+ (1,0) [0|7] "" Vector__XXX
 SG_ SPN_High5 : 165|3@1+ (1,0) [0|7] "" Vector__XXX
 SG_ SPN_High2 : 69|3@1+ (1,0) [0|7] "" Vector__XXX
 SG_ SPN_High1 : 37|3@1+ (1,0) [0|7] "" Vector__XXX
 SG_ SpnConversionMethod1 : 47|1@1+ (1,0) [0|1] "" Vector__XXX
 SG_ SpnConversionMethod5 : 175|1@1+ (1,0) [0|1] "" Vector__XXX
 SG_ SpnConversionMethod4 : 143|1@1+ (1,0) [0|1] "" Vector__XXX
 SG_ SpnConversionMethod3 : 111|1@1+ (1,0) [0|1] "" Vector__XXX
 SG_ SpnConversionMethod2 : 79|1@1+ (1,0) [0|1] "" Vector__XXX
 SG_ OccurenceCount5 : 168|7@1+ (1,0) [0|127] "" Vector__XXX
 SG_ OccurenceCount4 : 136|7@1+ (1,0) [0|127] "" Vector__XXX
 SG_ OccurenceCount3 : 104|7@1+ (1,0) [0|127] "" Vector__XXX
 SG_ OccurenceCount2 : 72|7@1+ (1,0) [0|127] "" Vector__XXX
 SG_ OccurenceCount1 : 40|7@1+ (1,0) [0|127] "" Vector__XXX
 SG_ FMI5 : 160|5@1+ (1,0) [0|31] "" Vector__XXX
 SG_ FMI4 : 128|5@1+ (1,0) [0|31] "" Vector__XXX
 SG_ FMI3 : 96|5@1+ (1,0) [0|31] "" Vector__XXX
 SG_ FMI2 : 64|5@1+ (1,0) [0|31] "" Vector__XXX
 SG_ FMI1 : 32|5@1+ (1,0) [0|31] "" Vector__XXX
 SG_ FlashRedStopLamp : 12|2@1+ (1,0) [0|3] "" Vector__XXX
 SG_ FlashProtectLamp : 8|2@1+ (1,0) [0|3] "" Vector__XXX
 SG_ FlashMalfuncIndicatorLamp : 14|2@1+ (1,0) [0|3] "" Vector__XXX
 SG_ FlashAmberWarningLamp : 10|2@1+ (1,0) [0|3] "" Vector__XXX
 SG_ MalfunctionIndLampStatus : 6|2@1+ (1,0) [0|3] "" Vector__XXX
 SG_ AmberWarningLampStatus : 2|2@1+ (1,0) [0|3] "" Vector__XXX
 SG_ RedStopLampState : 4|2@1+ (1,0) [0|3] "" Vector__XXX
 SG_ ProtectLampStatus : 0|2@1+ (1,0) [0|3] "" Vector__XXX
 SG_ SPN5 : 144|16@1+ (1,0) [0|524287] "" Vector__XXX
 SG_ SPN4 : 112|16@1+ (1,0) [0|524287] "" Vector__XXX
 SG_ SPN3 : 80|16@1+ (1,0) [0|524287] "" Vector__XXX
 SG_ SPN2 : 48|16@1+ (1,0) [0|524287] "" Vector__XXX
 SG_ SPN1 : 16|16@1+ (1,0) [0|524287] "" Vector__XXX

BO_ 2566741758 DM42: 22 Vector__XXX
 SG_ SPN_High4 : 133|3@1+ (1,0) [0|7] "" Vector__XXX
 SG_ SPN_High3 : 101|3@1+ (1,0) [0|7] "" Vector__XXX
 SG_ SPN_High5 : 165|3@1+ (1,0) [0|7] "" Vector__XXX
 SG_ SPN_High2 : 69|3@1+ (1,0) [0|7] "" Vector__XXX
 SG_ SPN_High1 : 37|3@1+ (1,0) [0|7] "" Vector__XXX
 SG_ SpnConversionMethod1 : 47|1@1+ (1,0) [0|1] "" Vector__XXX
 SG_ SpnConversionMethod5 : 175|1@1+ (1,0) [0|1] "" Vector__XXX
 SG_ SpnConversionMethod4 : 143|1@1+ (1,0) [0|1] "" Vector__XXX
 SG_ SpnConversionMethod3 : 111|1@1+ (1,0) [0|1] "" Vector__XXX
 SG_ SpnConversionMethod2 : 79|1@1+ (1,0) [0|1] "" Vector__XXX
 SG_ OccurenceCount5 : 168|7@1+ (1,0) [0|127] "" Vector__XXX
 SG_ OccurenceCount4 : 136|7@1+ (1,0) [0|127] "" Vector__XXX
 SG_ OccurenceCount3 : 104|7@1+ (1,0) [0|127] "" Vector__XXX
 SG_ OccurenceCount2 : 72|7@1+ (1,0) [0|127] "" Vector__XXX
 SG_ OccurenceCount1 : 40|7@1+ (1,0) [0|127] "" Vector__XXX
 SG_ FMI5 : 160|5@1+ (1,0) [0|31] "" Vector__XXX
 SG_ FMI4 : 128|5@1+ (1,0) [0|31] "" Vector__XXX
 SG_ FMI3 : 96|5@1+ (1,0) [0|31] "" Vector__XXX
 SG_ FMI2 : 64|5@1+ (1,0) [0|31] "" Vector__XXX
 SG_ FMI1 : 32|5@1+ (1,0) [0|31] "" Vector__XXX
 SG_ FlashRedStopLamp : 12|2@1+ (1,0) [0|3] "" Vector__XXX
 SG_ FlashProtectLamp : 8|2@1+ (1,0) [0|3] "" Vector__XXX
 SG_ FlashMalfuncIndicatorLamp : 14|2@1+ (1,0) [0|3] "" Vector__XXX
 SG_ FlashAmberWarningLamp : 10|2@1+ (1,0) [0|3] "" Vector__XXX
 SG_ MalfunctionIndLampStatus : 6|2@1+ (1,0) [0|3] "" Vector__XXX
 SG_ AmberWarningLampStatus : 2|2@1+ (1,0) [0|3] "" Vector__XXX
 SG_ RedStopLampState : 4|2@1+ (1,0) [0|3] "" Vector__XXX
 SG_ ProtectLampStatus : 0|2@1+ (1,0) [0|3] "" Vector__XXX
 SG_ SPN5 : 144|16@1+ (1,0) [0|524287] "" Vector__XXX
 SG_ SPN4 : 112|16@1+ (1,0) [0|524287] "" Vector__XXX
 SG_ SPN3 : 80|16@1+ (1,0) [0|524287] "" Vector__XXX
 SG_ SPN2 : 48|16@1+ (1,0) [0|524287] "" Vector__XXX
 SG_ SPN1 : 16|16@1+ (1,0) [0|524287] "" Vector__XXX

CM_ BO_ 2566705918 "Previously Active Service Only DTCs";
CM_ SG_ 2566705918 SPN_High4 "3 most significant bits of SPN (most significant at bit 8) ";
CM_ SG_ 2566705918 SPN_High3 "3 most significant bits of SPN (most significant at bit 8) ";
CM_ SG_ 2566705918 SPN_High5 "3 most significant bits of SPN (most significant at bit 8) ";
CM_ SG_ 2566705918 SPN_High2 "3 most significant bits of SPN (most significant at bit 8) ";
CM_ SG_ 2566705918 SPN_High1 "3 most significant bits of SPN (most significant at bit 8) ";
CM_ SG_ 2566705918 SpnConversionMethod1 "If set to '0', the document is converted according to version 4 of the J1939-73 document (February 1996); otherwise, it is converted according to one of the three earlier versions.";
CM_ SG_ 2566705918 SpnConversionMethod5 "If set to '0', the document is converted according to version 4 of the J1939-73 document (February 1996); otherwise, it is converted according to one of the three earlier versions.";
CM_ SG_ 2566705918 SpnConversionMethod4 "If set to '0', the document is converted according to version 4 of the J1939-73 document (February 1996); otherwise, it is converted according to one of the three earlier versions.";
CM_ SG_ 2566705918 SpnConversionMethod3 "If set to '0', the document is converted according to version 4 of the J1939-73 document (February 1996); otherwise, it is converted according to one of the three earlier versions.";
CM_ SG_ 2566705918 SpnConversionMethod2 "If set to '0', the document is converted according to version 4 of the J1939-73 document (February 1996); otherwise, it is converted according to one of the three earlier versions.";
CM_ SG_ 2566705918 OccurenceCount5 "Contains the number of times a fault has been independently detected.";
CM_ SG_ 2566705918 OccurenceCount4 "Contains the number of times a fault has been independently detected.";
CM_ SG_ 2566705918 OccurenceCount3 "Contains the number of times a fault has been independently detected.";
CM_ SG_ 2566705918 OccurenceCount2 "Contains the number of times a fault has been independently detected.";
CM_ SG_ 2566705918 OccurenceCount1 "Contains the number of times a fault has been independently detected.";
CM_ SG_ 2566705918 FMI5 "The FMI defines the type of failure detected in the subsystem identified by an SPN.";
CM_ SG_ 2566705918 FMI4 "The FMI defines the type of failure detected in the subsystem identified by an SPN.";
CM_ SG_ 2566705918 FMI3 "The FMI defines the type of failure detected in the subsystem identified by an SPN.";
CM_ SG_ 2566705918 FMI2 "The FMI defines the type of failure detected in the subsystem identified by an SPN.";
CM_ SG_ 2566705918 FMI1 "The FMI defines the type of failure detected in the subsystem identified by an SPN.";
CM_ SG_ 2566705918 FlashRedStopLamp "This parameter provides the capability to flash the RSL


00 - Slow Flash (1 Hz, 50 % duty cycle)
01 - Fast Flash (2 Hz or faster, 50% duty cycle)
10 - Reserved
11 - Unavailable / Do Not Flash";
CM_ SG_ 2566705918 FlashProtectLamp "This parameter provides the capability to flash the engine protect lamp


00 - Slow Flash (1 Hz, 50 % duty cycle)
01 - Fast Flash (2 Hz or faster, 50% duty cycle)
10 - Reserved
11 - Unavailable / Do Not Flash";
CM_ SG_ 2566705918 FlashMalfuncIndicatorLamp "This parameter provides the capability to flash the MIL
00 - Slow Flash (1 Hz, 50 % duty cycle)
01 - Fast Flash (2 Hz or faster, 50% duty cycle)
10 - Class C DTC
11 - Unavailable / Do Not Flash
Note:  State 10 is for WWH OBD discriminatory ...";
CM_ SG_ 2566705918 FlashAmberWarningLamp "This parameter provides the capability to flash the AWL

00 - Slow Flash (1 Hz, 50 % duty cycle)
01 - Fast Flash (2 Hz or faster, 50% duty cycle)
10 - Reserved
11 - Unavailable / Do Not Flash";
CM_ SG_ 2566705918 MalfunctionIndLampStatus "A lamp used to relay only emissions-related trouble code information. This lamp is only illuminated when there is an emission-related trouble code active.
00     Lamp Off
01     Lamp On
10     Short MIL for WWH OBD
11     Not available
Note ...";
CM_ SG_ 2566705918 AmberWarningLampStatus "This lamp is used to relay trouble code information that is reporting a problem with the vehicle system but the vehicle need not be immediately stopped. 

00     Lamp Off
01     Lamp On
10     Reserved
11     Not available";
CM_ SG_ 2566705918 RedStopLampState "This lamp is used to relay trouble code information that is of a severe enough condition that it warrants stopping the vehicle.

00     Lamp Off
01     Lamp On
10     Reserved
11     Not available";
CM_ SG_ 2566705918 ProtectLampStatus "This lamp is used to relay trouble code information that is reporting a problem with a vehicle system that is most probably not electronic subsystem related. For instance, engine coolant temperature is exceeding its prescribed temperature range.
00 ...";
CM_ SG_ 2566705918 SPN5 "16 least significant bits of SPN";
CM_ SG_ 2566705918 SPN4 "16 least significant bits of SPN";
CM_ SG_ 2566705918 SPN3 "16 least significant bits of SPN";
CM_ SG_ 2566705918 SPN2 "16 least significant bits of SPN";
CM_ SG_ 2566705918 SPN1 "16 least significant bits of SPN";
CM_ BO_ 2566705662 "Active Service Only DTCs";
CM_ SG_ 2566705662 SPN_High4 "3 most significant bits of SPN (most significant at bit 8) ";
CM_ SG_ 2566705662 SPN_High3 "3 most significant bits of SPN (most significant at bit 8) ";
CM_ SG_ 2566705662 SPN_High5 "3 most significant bits of SPN (most significant at bit 8) ";
CM_ SG_ 2566705662 SPN_High2 "3 most significant bits of SPN (most significant at bit 8) ";
CM_ SG_ 2566705662 SPN_High1 "3 most significant bits of SPN (most significant at bit 8) ";
CM_ SG_ 2566705662 SpnConversionMethod1 "If set to '0', the document is converted according to version 4 of the J1939-73 document (February 1996); otherwise, it is converted according to one of the three earlier versions.";
CM_ SG_ 2566705662 SpnConversionMethod5 "If set to '0', the document is converted according to version 4 of the J1939-73 document (February 1996); otherwise, it is converted according to one of the three earlier versions.";
CM_ SG_ 2566705662 SpnConversionMethod4 "If set to '0', the document is converted according to version 4 of the J1939-73 document (February 1996); otherwise, it is converted according to one of the three earlier versions.";
CM_ SG_ 2566705662 SpnConversionMethod3 "If set to '0', the document is converted according to version 4 of the J1939-73 document (February 1996); otherwise, it is converted according to one of the three earlier versions.";
CM_ SG_ 2566705662 SpnConversionMethod2 "If set to '0', the document is converted according to version 4 of the J1939-73 document (February 1996); otherwise, it is converted according to one of the three earlier versions.";
CM_ SG_ 2566705662 OccurenceCount5 "Contains the number of times a fault has been independently detected.";
CM_ SG_ 2566705662 OccurenceCount4 "Contains the number of times a fault has been independently detected.";
CM_ SG_ 2566705662 OccurenceCount3 "Contains the number of times a fault has been independently detected.";
CM_ SG_ 2566705662 OccurenceCount2 "Contains the number of times a fault has been independently detected.";
CM_ SG_ 2566705662 OccurenceCount1 "Contains the number of times a fault has been independently detected.";
CM_ SG_ 2566705662 FMI5 "The FMI defines the type of failure detected in the subsystem identified by an SPN.";
CM_ SG_ 2566705662 FMI4 "The FMI defines the type of failure detected in the subsystem identified by an SPN.";
CM_ SG_ 2566705662 FMI3 "The FMI defines the type of failure detected in the subsystem identified by an SPN.";
CM_ SG_ 2566705662 FMI2 "The FMI defines the type of failure detected in the subsystem identified by an SPN.";
CM_ SG_ 2566705662 FMI1 "The FMI defines the type of failure detected in the subsystem identified by an SPN.";
CM_ SG_ 2566705662 FlashRedStopLamp "This parameter provides the capability to flash the RSL


00 - Slow Flash (1 Hz, 50 % duty cycle)
01 - Fast Flash (2 Hz or faster, 50% duty cycle)
10 - Reserved
11 - Unavailable / Do Not Flash";
CM_ SG_ 2566705662 FlashProtectLamp "This parameter provides the capability to flash the engine protect lamp


00 - Slow Flash (1 Hz, 50 % duty cycle)
01 - Fast Flash (2 Hz or faster, 50% duty cycle)
10 - Reserved
11 - Unavailable / Do Not Flash";
CM_ SG_ 2566705662 FlashMalfuncIndicatorLamp "This parameter provides the capability to flash the MIL
00 - Slow Flash (1 Hz, 50 % duty cycle)
01 - Fast Flash (2 Hz or faster, 50% duty cycle)
10 - Class C DTC
11 - Unavailable / Do Not Flash
Note:  State 10 is for WWH OBD discriminatory ...";
CM_ SG_ 2566705662 FlashAmberWarningLamp "This parameter provides the capability to flash the AWL

00 - Slow Flash (1 Hz, 50 % duty cycle)
01 - Fast Flash (2 Hz or faster, 50% duty cycle)
10 - Reserved
11 - Unavailable / Do Not Flash";
CM_ SG_ 2566705662 MalfunctionIndLampStatus "A lamp used to relay only emissions-related trouble code information. This lamp is only illuminated when there is an emission-related trouble code active.
00     Lamp Off
01     Lamp On
10     Short MIL for WWH OBD
11     Not available
Note ...";
CM_ SG_ 2566705662 AmberWarningLampStatus "This lamp is used to relay trouble code information that is reporting a problem with the vehicle system but the vehicle need not be immediately stopped. 

00     Lamp Off
01     Lamp On
10     Reserved
11     Not available";
CM_ SG_ 2566705662 RedStopLampState "This lamp is used to relay trouble code information that is of a severe enough condition that it warrants stopping the vehicle.

00     Lamp Off
01     Lamp On
10     Reserved
11     Not available";
CM_ SG_ 2566705662 ProtectLampStatus "This lamp is used to relay trouble code information that is reporting a problem with a vehicle system that is most probably not electronic subsystem related. For instance, engine coolant temperature is exceeding its prescribed temperature range.
00 ...";
CM_ SG_ 2566705662 SPN5 "16 least significant bits of SPN";
CM_ SG_ 2566705662 SPN4 "16 least significant bits of SPN";
CM_ SG_ 2566705662 SPN3 "16 least significant bits of SPN";
CM_ SG_ 2566705662 SPN2 "16 least significant bits of SPN";
CM_ SG_ 2566705662 SPN1 "16 least significant bits of SPN";
CM_ BO_ 2566739198 "DTCs - C, Previously Active
Previously Active DTCs that are classified as class C severity.";
CM_ SG_ 2566739198 SPN_High4 "3 most significant bits of SPN (most significant at bit 8) ";
CM_ SG_ 2566739198 SPN_High3 "3 most significant bits of SPN (most significant at bit 8) ";
CM_ SG_ 2566739198 SPN_High5 "3 most significant bits of SPN (most significant at bit 8) ";
CM_ SG_ 2566739198 SPN_High2 "3 most significant bits of SPN (most significant at bit 8) ";
CM_ SG_ 2566739198 SPN_High1 "3 most significant bits of SPN (most significant at bit 8) ";
CM_ SG_ 2566739198 SpnConversionMethod1 "If set to '0', the document is converted according to version 4 of the J1939-73 document (February 1996); otherwise, it is converted according to one of the three earlier versions.";
CM_ SG_ 2566739198 SpnConversionMethod5 "If set to '0', the document is converted according to version 4 of the J1939-73 document (February 1996); otherwise, it is converted according to one of the three earlier versions.";
CM_ SG_ 2566739198 SpnConversionMethod4 "If set to '0', the document is converted according to version 4 of the J1939-73 document (February 1996); otherwise, it is converted according to one of the three earlier versions.";
CM_ SG_ 2566739198 SpnConversionMethod3 "If set to '0', the document is converted according to version 4 of the J1939-73 document (February 1996); otherwise, it is converted according to one of the three earlier versions.";
CM_ SG_ 2566739198 SpnConversionMethod2 "If set to '0', the document is converted according to version 4 of the J1939-73 document (February 1996); otherwise, it is converted according to one of the three earlier versions.";
CM_ SG_ 2566739198 OccurenceCount5 "Contains the number of times a fault has been independently detected.";
CM_ SG_ 2566739198 OccurenceCount4 "Contains the number of times a fault has been independently detected.";
CM_ SG_ 2566739198 OccurenceCount3 "Contains the number of times a fault has been independently detected.";
CM_ SG_ 2566739198 OccurenceCount2 "Contains the number of times a fault has been independently detected.";
CM_ SG_ 2566739198 OccurenceCount1 "Contains the number of times a fault has been independently detected.";
CM_ SG_ 2566739198 FMI5 "The FMI defines the type of failure detected in the subsystem identified by an SPN.";
CM_ SG_ 2566739198 FMI4 "The FMI defines the type of failure detected in the subsystem identified by an SPN.";
CM_ SG_ 2566739198 FMI3 "The FMI defines the type of failure detected in the subsystem identified by an SPN.";
CM_ SG_ 2566739198 FMI2 "The FMI defines the type of failure detected in the subsystem identified by an SPN.";
CM_ SG_ 2566739198 FMI1 "The FMI defines the type of failure detected in the subsystem identified by an SPN.";
CM_ SG_ 2566739198 FlashRedStopLamp "This parameter provides the capability to flash the RSL


00 - Slow Flash (1 Hz, 50 % duty cycle)
01 - Fast Flash (2 Hz or faster, 50% duty cycle)
10 - Reserved
11 - Unavailable / Do Not Flash";
CM_ SG_ 2566739198 FlashProtectLamp "This parameter provides the capability to flash the engine protect lamp


00 - Slow Flash (1 Hz, 50 % duty cycle)
01 - Fast Flash (2 Hz or faster, 50% duty cycle)
10 - Reserved
11 - Unavailable / Do Not Flash";
CM_ SG_ 2566739198 FlashMalfuncIndicatorLamp "This parameter provides the capability to flash the MIL
00 - Slow Flash (1 Hz, 50 % duty cycle)
01 - Fast Flash (2 Hz or faster, 50% duty cycle)
10 - Class C DTC
11 - Unavailable / Do Not Flash
Note:  State 10 is for WWH OBD discriminatory ...";
CM_ SG_ 2566739198 FlashAmberWarningLamp "This parameter provides the capability to flash the AWL

00 - Slow Flash (1 Hz, 50 % duty cycle)
01 - Fast Flash (2 Hz or faster, 50% duty cycle)
10 - Reserved
11 - Unavailable / Do Not Flash";
CM_ SG_ 2566739198 MalfunctionIndLampStatus "A lamp used to relay only emissions-related trouble code information. This lamp is only illuminated when there is an emission-related trouble code active.
00     Lamp Off
01     Lamp On
10     Short MIL for WWH OBD
11     Not available
Note ...";
CM_ SG_ 2566739198 AmberWarningLampStatus "This lamp is used to relay trouble code information that is reporting a problem with the vehicle system but the vehicle need not be immediately stopped. 

00     Lamp Off
01     Lamp On
10     Reserved
11     Not available";
CM_ SG_ 2566739198 RedStopLampState "This lamp is used to relay trouble code information that is of a severe enough condition that it warrants stopping the vehicle.

00     Lamp Off
01     Lamp On
10     Reserved
11     Not available";
CM_ SG_ 2566739198 ProtectLampStatus "This lamp is used to relay trouble code information that is reporting a problem with a vehicle system that is most probably not electronic subsystem related. For instance, engine coolant temperature is exceeding its prescribed temperature range.
00 ...";
CM_ SG_ 2566739198 SPN5 "16 least significant bits of SPN";
CM_ SG_ 2566739198 SPN4 "16 least significant bits of SPN";
CM_ SG_ 2566739198 SPN3 "16 least significant bits of SPN";
CM_ SG_ 2566739198 SPN2 "16 least significant bits of SPN";
CM_ SG_ 2566739198 SPN1 "16 least significant bits of SPN";
CM_ BO_ 2566739454 "DTCs - C, Confirmed and Active
Confirmed and Active DTCs that are classified as class C severity.";
CM_ SG_ 2566739454 SPN_High4 "3 most significant bits of SPN (most significant at bit 8) ";
CM_ SG_ 2566739454 SPN_High3 "3 most significant bits of SPN (most significant at bit 8) ";
CM_ SG_ 2566739454 SPN_High5 "3 most significant bits of SPN (most significant at bit 8) ";
CM_ SG_ 2566739454 SPN_High2 "3 most significant bits of SPN (most significant at bit 8) ";
CM_ SG_ 2566739454 SPN_High1 "3 most significant bits of SPN (most significant at bit 8) ";
CM_ SG_ 2566739454 SpnConversionMethod1 "If set to '0', the document is converted according to version 4 of the J1939-73 document (February 1996); otherwise, it is converted according to one of the three earlier versions.";
CM_ SG_ 2566739454 SpnConversionMethod5 "If set to '0', the document is converted according to version 4 of the J1939-73 document (February 1996); otherwise, it is converted according to one of the three earlier versions.";
CM_ SG_ 2566739454 SpnConversionMethod4 "If set to '0', the document is converted according to version 4 of the J1939-73 document (February 1996); otherwise, it is converted according to one of the three earlier versions.";
CM_ SG_ 2566739454 SpnConversionMethod3 "If set to '0', the document is converted according to version 4 of the J1939-73 document (February 1996); otherwise, it is converted according to one of the three earlier versions.";
CM_ SG_ 2566739454 SpnConversionMethod2 "If set to '0', the document is converted according to version 4 of the J1939-73 document (February 1996); otherwise, it is converted according to one of the three earlier versions.";
CM_ SG_ 2566739454 OccurenceCount5 "Contains the number of times a fault has been independently detected.";
CM_ SG_ 2566739454 OccurenceCount4 "Contains the number of times a fault has been independently detected.";
CM_ SG_ 2566739454 OccurenceCount3 "Contains the number of times a fault has been independently detected.";
CM_ SG_ 2566739454 OccurenceCount2 "Contains the number of times a fault has been independently detected.";
CM_ SG_ 2566739454 OccurenceCount1 "Contains the number of times a fault has been independently detected.";
CM_ SG_ 2566739454 FMI5 "The FMI defines the type of failure detected in the subsystem identified by an SPN.";
CM_ SG_ 2566739454 FMI4 "The FMI defines the type of failure detected in the subsystem identified by an SPN.";
CM_ SG_ 2566739454 FMI3 "The FMI defines the type of failure detected in the subsystem identified by an SPN.";
CM_ SG_ 2566739454 FMI2 "The FMI defines the type of failure detected in the subsystem identified by an SPN.";
CM_ SG_ 2566739454 FMI1 "The FMI defines the type of failure detected in the subsystem identified by an SPN.";
CM_ SG_ 2566739454 FlashRedStopLamp "This parameter provides the capability to flash the RSL


00 - Slow Flash (1 Hz, 50 % duty cycle)
01 - Fast Flash (2 Hz or faster, 50% duty cycle)
10 - Reserved
11 - Unavailable / Do Not Flash";
CM_ SG_ 2566739454 FlashProtectLamp "This parameter provides the capability to flash the engine protect lamp


00 - Slow Flash (1 Hz, 50 % duty cycle)
01 - Fast Flash (2 Hz or faster, 50% duty cycle)
10 - Reserved
11 - Unavailable / Do Not Flash";
CM_ SG_ 2566739454 FlashMalfuncIndicatorLamp "This parameter provides the capability to flash the MIL
00 - Slow Flash (1 Hz, 50 % duty cycle)
01 - Fast Flash (2 Hz or faster, 50% duty cycle)
10 - Class C DTC
11 - Unavailable / Do Not Flash
Note:  State 10 is for WWH OBD discriminatory ...";
CM_ SG_ 2566739454 FlashAmberWarningLamp "This parameter provides the capability to flash the AWL

00 - Slow Flash (1 Hz, 50 % duty cycle)
01 - Fast Flash (2 Hz or faster, 50% duty cycle)
10 - Reserved
11 - Unavailable / Do Not Flash";
CM_ SG_ 2566739454 MalfunctionIndLampStatus "A lamp used to relay only emissions-related trouble code information. This lamp is only illuminated when there is an emission-related trouble code active.
00     Lamp Off
01     Lamp On
10     Short MIL for WWH OBD
11     Not available
Note ...";
CM_ SG_ 2566739454 AmberWarningLampStatus "This lamp is used to relay trouble code information that is reporting a problem with the vehicle system but the vehicle need not be immediately stopped. 

00     Lamp Off
01     Lamp On
10     Reserved
11     Not available";
CM_ SG_ 2566739454 RedStopLampState "This lamp is used to relay trouble code information that is of a severe enough condition that it warrants stopping the vehicle.

00     Lamp Off
01     Lamp On
10     Reserved
11     Not available";
CM_ SG_ 2566739454 ProtectLampStatus "This lamp is used to relay trouble code information that is reporting a problem with a vehicle system that is most probably not electronic subsystem related. For instance, engine coolant temperature is exceeding its prescribed temperature range.
00 ...";
CM_ SG_ 2566739454 SPN5 "16 least significant bits of SPN";
CM_ SG_ 2566739454 SPN4 "16 least significant bits of SPN";
CM_ SG_ 2566739454 SPN3 "16 least significant bits of SPN";
CM_ SG_ 2566739454 SPN2 "16 least significant bits of SPN";
CM_ SG_ 2566739454 SPN1 "16 least significant bits of SPN";
CM_ BO_ 2566739710 "DTCs - C, Pending
Pending DTCs that are classified as class C severity.";
CM_ SG_ 2566739710 SPN_High4 "3 most significant bits of SPN (most significant at bit 8) ";
CM_ SG_ 2566739710 SPN_High3 "3 most significant bits of SPN (most significant at bit 8) ";
CM_ SG_ 2566739710 SPN_High5 "3 most significant bits of SPN (most significant at bit 8) ";
CM_ SG_ 2566739710 SPN_High2 "3 most significant bits of SPN (most significant at bit 8) ";
CM_ SG_ 2566739710 SPN_High1 "3 most significant bits of SPN (most significant at bit 8) ";
CM_ SG_ 2566739710 SpnConversionMethod1 "If set to '0', the document is converted according to version 4 of the J1939-73 document (February 1996); otherwise, it is converted according to one of the three earlier versions.";
CM_ SG_ 2566739710 SpnConversionMethod5 "If set to '0', the document is converted according to version 4 of the J1939-73 document (February 1996); otherwise, it is converted according to one of the three earlier versions.";
CM_ SG_ 2566739710 SpnConversionMethod4 "If set to '0', the document is converted according to version 4 of the J1939-73 document (February 1996); otherwise, it is converted according to one of the three earlier versions.";
CM_ SG_ 2566739710 SpnConversionMethod3 "If set to '0', the document is converted according to version 4 of the J1939-73 document (February 1996); otherwise, it is converted according to one of the three earlier versions.";
CM_ SG_ 2566739710 SpnConversionMethod2 "If set to '0', the document is converted according to version 4 of the J1939-73 document (February 1996); otherwise, it is converted according to one of the three earlier versions.";
CM_ SG_ 2566739710 OccurenceCount5 "Contains the number of times a fault has been independently detected.";
CM_ SG_ 2566739710 OccurenceCount4 "Contains the number of times a fault has been independently detected.";
CM_ SG_ 2566739710 OccurenceCount3 "Contains the number of times a fault has been independently detected.";
CM_ SG_ 2566739710 OccurenceCount2 "Contains the number of times a fault has been independently detected.";
CM_ SG_ 2566739710 OccurenceCount1 "Contains the number of times a fault has been independently detected.";
CM_ SG_ 2566739710 FMI5 "The FMI defines the type of failure detected in the subsystem identified by an SPN.";
CM_ SG_ 2566739710 FMI4 "The FMI defines the type of failure detected in the subsystem identified by an SPN.";
CM_ SG_ 2566739710 FMI3 "The FMI defines the type of failure detected in the subsystem identified by an SPN.";
CM_ SG_ 2566739710 FMI2 "The FMI defines the type of failure detected in the subsystem identified by an SPN.";
CM_ SG_ 2566739710 FMI1 "The FMI defines the type of failure detected in the subsystem identified by an SPN.";
CM_ SG_ 2566739710 FlashRedStopLamp "This parameter provides the capability to flash the RSL


00 - Slow Flash (1 Hz, 50 % duty cycle)
01 - Fast Flash (2 Hz or faster, 50% duty cycle)
10 - Reserved
11 - Unavailable / Do Not Flash";
CM_ SG_ 2566739710 FlashProtectLamp "This parameter provides the capability to flash the engine protect lamp


00 - Slow Flash (1 Hz, 50 % duty cycle)
01 - Fast Flash (2 Hz or faster, 50% duty cycle)
10 - Reserved
11 - Unavailable / Do Not Flash";
CM_ SG_ 2566739710 FlashMalfuncIndicatorLamp "This parameter provides the capability to flash the MIL
00 - Slow Flash (1 Hz, 50 % duty cycle)
01 - Fast Flash (2 Hz or faster, 50% duty cycle)
10 - Class C DTC
11 - Unavailable / Do Not Flash
Note:  State 10 is for WWH OBD discriminatory ...";
CM_ SG_ 2566739710 FlashAmberWarningLamp "This parameter provides the capability to flash the AWL

00 - Slow Flash (1 Hz, 50 % duty cycle)
01 - Fast Flash (2 Hz or faster, 50% duty cycle)
10 - Reserved
11 - Unavailable / Do Not Flash";
CM_ SG_ 2566739710 MalfunctionIndLampStatus "A lamp used to relay only emissions-related trouble code information. This lamp is only illuminated when there is an emission-related trouble code active.
00     Lamp Off
01     Lamp On
10     Short MIL for WWH OBD
11     Not available
Note ...";
CM_ SG_ 2566739710 AmberWarningLampStatus "This lamp is used to relay trouble code information that is reporting a problem with the vehicle system but the vehicle need not be immediately stopped. 

00     Lamp Off
01     Lamp On
10     Reserved
11     Not available";
CM_ SG_ 2566739710 RedStopLampState "This lamp is used to relay trouble code information that is of a severe enough condition that it warrants stopping the vehicle.

00     Lamp Off
01     Lamp On
10     Reserved
11     Not available";
CM_ SG_ 2566739710 ProtectLampStatus "This lamp is used to relay trouble code information that is reporting a problem with a vehicle system that is most probably not electronic subsystem related. For instance, engine coolant temperature is exceeding its prescribed temperature range.
00 ...";
CM_ SG_ 2566739710 SPN5 "16 least significant bits of SPN";
CM_ SG_ 2566739710 SPN4 "16 least significant bits of SPN";
CM_ SG_ 2566739710 SPN3 "16 least significant bits of SPN";
CM_ SG_ 2566739710 SPN2 "16 least significant bits of SPN";
CM_ SG_ 2566739710 SPN1 "16 least significant bits of SPN";
CM_ BO_ 2566739966 "DTCs - B2, Previously Active
Previously Active DTCs that are classified as class B2 severity.";
CM_ SG_ 2566739966 SPN_High4 "3 most significant bits of SPN (most significant at bit 8) ";
CM_ SG_ 2566739966 SPN_High3 "3 most significant bits of SPN (most significant at bit 8) ";
CM_ SG_ 2566739966 SPN_High5 "3 most significant bits of SPN (most significant at bit 8) ";
CM_ SG_ 2566739966 SPN_High2 "3 most significant bits of SPN (most significant at bit 8) ";
CM_ SG_ 2566739966 SPN_High1 "3 most significant bits of SPN (most significant at bit 8) ";
CM_ SG_ 2566739966 SpnConversionMethod1 "If set to '0', the document is converted according to version 4 of the J1939-73 document (February 1996); otherwise, it is converted according to one of the three earlier versions.";
CM_ SG_ 2566739966 SpnConversionMethod5 "If set to '0', the document is converted according to version 4 of the J1939-73 document (February 1996); otherwise, it is converted according to one of the three earlier versions.";
CM_ SG_ 2566739966 SpnConversionMethod4 "If set to '0', the document is converted according to version 4 of the J1939-73 document (February 1996); otherwise, it is converted according to one of the three earlier versions.";
CM_ SG_ 2566739966 SpnConversionMethod3 "If set to '0', the document is converted according to version 4 of the J1939-73 document (February 1996); otherwise, it is converted according to one of the three earlier versions.";
CM_ SG_ 2566739966 SpnConversionMethod2 "If set to '0', the document is converted according to version 4 of the J1939-73 document (February 1996); otherwise, it is converted according to one of the three earlier versions.";
CM_ SG_ 2566739966 OccurenceCount5 "Contains the number of times a fault has been independently detected.";
CM_ SG_ 2566739966 OccurenceCount4 "Contains the number of times a fault has been independently detected.";
CM_ SG_ 2566739966 OccurenceCount3 "Contains the number of times a fault has been independently detected.";
CM_ SG_ 2566739966 OccurenceCount2 "Contains the number of times a fault has been independently detected.";
CM_ SG_ 2566739966 OccurenceCount1 "Contains the number of times a fault has been independently detected.";
CM_ SG_ 2566739966 FMI5 "The FMI defines the type of failure detected in the subsystem identified by an SPN.";
CM_ SG_ 2566739966 FMI4 "The FMI defines the type of failure detected in the subsystem identified by an SPN.";
CM_ SG_ 2566739966 FMI3 "The FMI defines the type of failure detected in the subsystem identified by an SPN.";
CM_ SG_ 2566739966 FMI2 "The FMI defines the type of failure detected in the subsystem identified by an SPN.";
CM_ SG_ 2566739966 FMI1 "The FMI defines the type of failure detected in the subsystem identified by an SPN.";
CM_ SG_ 2566739966 FlashRedStopLamp "This parameter provides the capability to flash the RSL


00 - Slow Flash (1 Hz, 50 % duty cycle)
01 - Fast Flash (2 Hz or faster, 50% duty cycle)
10 - Reserved
11 - Unavailable / Do Not Flash";
CM_ SG_ 2566739966 FlashProtectLamp "This parameter provides the capability to flash the engine protect lamp


00 - Slow Flash (1 Hz, 50 % duty cycle)
01 - Fast Flash (2 Hz or faster, 50% duty cycle)
10 - Reserved
11 - Unavailable / Do Not Flash";
CM_ SG_ 2566739966 FlashMalfuncIndicatorLamp "This parameter provides the capability to flash the MIL
00 - Slow Flash (1 Hz, 50 % duty cycle)
01 - Fast Flash (2 Hz or faster, 50% duty cycle)
10 - Class C DTC
11 - Unavailable / Do Not Flash
Note:  State 10 is for WWH OBD discriminatory ...";
CM_ SG_ 2566739966 FlashAmberWarningLamp "This parameter provides the capability to flash the AWL

00 - Slow Flash (1 Hz, 50 % duty cycle)
01 - Fast Flash (2 Hz or faster, 50% duty cycle)
10 - Reserved
11 - Unavailable / Do Not Flash";
CM_ SG_ 2566739966 MalfunctionIndLampStatus "A lamp used to relay only emissions-related trouble code information. This lamp is only illuminated when there is an emission-related trouble code active.
00     Lamp Off
01     Lamp On
10     Short MIL for WWH OBD
11     Not available
Note ...";
CM_ SG_ 2566739966 AmberWarningLampStatus "This lamp is used to relay trouble code information that is reporting a problem with the vehicle system but the vehicle need not be immediately stopped. 

00     Lamp Off
01     Lamp On
10     Reserved
11     Not available";
CM_ SG_ 2566739966 RedStopLampState "This lamp is used to relay trouble code information that is of a severe enough condition that it warrants stopping the vehicle.

00     Lamp Off
01     Lamp On
10     Reserved
11     Not available";
CM_ SG_ 2566739966 ProtectLampStatus "This lamp is used to relay trouble code information that is reporting a problem with a vehicle system that is most probably not electronic subsystem related. For instance, engine coolant temperature is exceeding its prescribed temperature range.
00 ...";
CM_ SG_ 2566739966 SPN5 "16 least significant bits of SPN";
CM_ SG_ 2566739966 SPN4 "16 least significant bits of SPN";
CM_ SG_ 2566739966 SPN3 "16 least significant bits of SPN";
CM_ SG_ 2566739966 SPN2 "16 least significant bits of SPN";
CM_ SG_ 2566739966 SPN1 "16 least significant bits of SPN";
CM_ BO_ 2566740222 "DTCs - B2, Confirmed and Active
Confirmed and Active DTCs that are classified as class B2 severity.";
CM_ SG_ 2566740222 SPN_High4 "3 most significant bits of SPN (most significant at bit 8) ";
CM_ SG_ 2566740222 SPN_High3 "3 most significant bits of SPN (most significant at bit 8) ";
CM_ SG_ 2566740222 SPN_High5 "3 most significant bits of SPN (most significant at bit 8) ";
CM_ SG_ 2566740222 SPN_High2 "3 most significant bits of SPN (most significant at bit 8) ";
CM_ SG_ 2566740222 SPN_High1 "3 most significant bits of SPN (most significant at bit 8) ";
CM_ SG_ 2566740222 SpnConversionMethod1 "If set to '0', the document is converted according to version 4 of the J1939-73 document (February 1996); otherwise, it is converted according to one of the three earlier versions.";
CM_ SG_ 2566740222 SpnConversionMethod5 "If set to '0', the document is converted according to version 4 of the J1939-73 document (February 1996); otherwise, it is converted according to one of the three earlier versions.";
CM_ SG_ 2566740222 SpnConversionMethod4 "If set to '0', the document is converted according to version 4 of the J1939-73 document (February 1996); otherwise, it is converted according to one of the three earlier versions.";
CM_ SG_ 2566740222 SpnConversionMethod3 "If set to '0', the document is converted according to version 4 of the J1939-73 document (February 1996); otherwise, it is converted according to one of the three earlier versions.";
CM_ SG_ 2566740222 SpnConversionMethod2 "If set to '0', the document is converted according to version 4 of the J1939-73 document (February 1996); otherwise, it is converted according to one of the three earlier versions.";
CM_ SG_ 2566740222 OccurenceCount5 "Contains the number of times a fault has been independently detected.";
CM_ SG_ 2566740222 OccurenceCount4 "Contains the number of times a fault has been independently detected.";
CM_ SG_ 2566740222 OccurenceCount3 "Contains the number of times a fault has been independently detected.";
CM_ SG_ 2566740222 OccurenceCount2 "Contains the number of times a fault has been independently detected.";
CM_ SG_ 2566740222 OccurenceCount1 "Contains the number of times a fault has been independently detected.";
CM_ SG_ 2566740222 FMI5 "The FMI defines the type of failure detected in the subsystem identified by an SPN.";
CM_ SG_ 2566740222 FMI4 "The FMI defines the type of failure detected in the subsystem identified by an SPN.";
CM_ SG_ 2566740222 FMI3 "The FMI defines the type of failure detected in the subsystem identified by an SPN.";
CM_ SG_ 2566740222 FMI2 "The FMI defines the type of failure detected in the subsystem identified by an SPN.";
CM_ SG_ 2566740222 FMI1 "The FMI defines the type of failure detected in the subsystem identified by an SPN.";
CM_ SG_ 2566740222 FlashRedStopLamp "This parameter provides the capability to flash the RSL


00 - Slow Flash (1 Hz, 50 % duty cycle)
01 - Fast Flash (2 Hz or faster, 50% duty cycle)
10 - Reserved
11 - Unavailable / Do Not Flash";
CM_ SG_ 2566740222 FlashProtectLamp "This parameter provides the capability to flash the engine protect lamp


00 - Slow Flash (1 Hz, 50 % duty cycle)
01 - Fast Flash (2 Hz or faster, 50% duty cycle)
10 - Reserved
11 - Unavailable / Do Not Flash";
CM_ SG_ 2566740222 FlashMalfuncIndicatorLamp "This parameter provides the capability to flash the MIL
00 - Slow Flash (1 Hz, 50 % duty cycle)
01 - Fast Flash (2 Hz or faster, 50% duty cycle)
10 - Class C DTC
11 - Unavailable / Do Not Flash
Note:  State 10 is for WWH OBD discriminatory ...";
CM_ SG_ 2566740222 FlashAmberWarningLamp "This parameter provides the capability to flash the AWL

00 - Slow Flash (1 Hz, 50 % duty cycle)
01 - Fast Flash (2 Hz or faster, 50% duty cycle)
10 - Reserved
11 - Unavailable / Do Not Flash";
CM_ SG_ 2566740222 MalfunctionIndLampStatus "A lamp used to relay only emissions-related trouble code information. This lamp is only illuminated when there is an emission-related trouble code active.
00     Lamp Off
01     Lamp On
10     Short MIL for WWH OBD
11     Not available
Note ...";
CM_ SG_ 2566740222 AmberWarningLampStatus "This lamp is used to relay trouble code information that is reporting a problem with the vehicle system but the vehicle need not be immediately stopped. 

00     Lamp Off
01     Lamp On
10     Reserved
11     Not available";
CM_ SG_ 2566740222 RedStopLampState "This lamp is used to relay trouble code information that is of a severe enough condition that it warrants stopping the vehicle.

00     Lamp Off
01     Lamp On
10     Reserved
11     Not available";
CM_ SG_ 2566740222 ProtectLampStatus "This lamp is used to relay trouble code information that is reporting a problem with a vehicle system that is most probably not electronic subsystem related. For instance, engine coolant temperature is exceeding its prescribed temperature range.
00 ...";
CM_ SG_ 2566740222 SPN5 "16 least significant bits of SPN";
CM_ SG_ 2566740222 SPN4 "16 least significant bits of SPN";
CM_ SG_ 2566740222 SPN3 "16 least significant bits of SPN";
CM_ SG_ 2566740222 SPN2 "16 least significant bits of SPN";
CM_ SG_ 2566740222 SPN1 "16 least significant bits of SPN";
CM_ BO_ 2566740478 "DTCs - B2, Pending
Pending DTCs that are classified as class B2 severity.";
CM_ SG_ 2566740478 SPN_High4 "3 most significant bits of SPN (most significant at bit 8) ";
CM_ SG_ 2566740478 SPN_High3 "3 most significant bits of SPN (most significant at bit 8) ";
CM_ SG_ 2566740478 SPN_High5 "3 most significant bits of SPN (most significant at bit 8) ";
CM_ SG_ 2566740478 SPN_High2 "3 most significant bits of SPN (most significant at bit 8) ";
CM_ SG_ 2566740478 SPN_High1 "3 most significant bits of SPN (most significant at bit 8) ";
CM_ SG_ 2566740478 SpnConversionMethod1 "If set to '0', the document is converted according to version 4 of the J1939-73 document (February 1996); otherwise, it is converted according to one of the three earlier versions.";
CM_ SG_ 2566740478 SpnConversionMethod5 "If set to '0', the document is converted according to version 4 of the J1939-73 document (February 1996); otherwise, it is converted according to one of the three earlier versions.";
CM_ SG_ 2566740478 SpnConversionMethod4 "If set to '0', the document is converted according to version 4 of the J1939-73 document (February 1996); otherwise, it is converted according to one of the three earlier versions.";
CM_ SG_ 2566740478 SpnConversionMethod3 "If set to '0', the document is converted according to version 4 of the J1939-73 document (February 1996); otherwise, it is converted according to one of the three earlier versions.";
CM_ SG_ 2566740478 SpnConversionMethod2 "If set to '0', the document is converted according to version 4 of the J1939-73 document (February 1996); otherwise, it is converted according to one of the three earlier versions.";
CM_ SG_ 2566740478 OccurenceCount5 "Contains the number of times a fault has been independently detected.";
CM_ SG_ 2566740478 OccurenceCount4 "Contains the number of times a fault has been independently detected.";
CM_ SG_ 2566740478 OccurenceCount3 "Contains the number of times a fault has been independently detected.";
CM_ SG_ 2566740478 OccurenceCount2 "Contains the number of times a fault has been independently detected.";
CM_ SG_ 2566740478 OccurenceCount1 "Contains the number of times a fault has been independently detected.";
CM_ SG_ 2566740478 FMI5 "The FMI defines the type of failure detected in the subsystem identified by an SPN.";
CM_ SG_ 2566740478 FMI4 "The FMI defines the type of failure detected in the subsystem identified by an SPN.";
CM_ SG_ 2566740478 FMI3 "The FMI defines the type of failure detected in the subsystem identified by an SPN.";
CM_ SG_ 2566740478 FMI2 "The FMI defines the type of failure detected in the subsystem identified by an SPN.";
CM_ SG_ 2566740478 FMI1 "The FMI defines the type of failure detected in the subsystem identified by an SPN.";
CM_ SG_ 2566740478 FlashRedStopLamp "This parameter provides the capability to flash the RSL


00 - Slow Flash (1 Hz, 50 % duty cycle)
01 - Fast Flash (2 Hz or faster, 50% duty cycle)
10 - Reserved
11 - Unavailable / Do Not Flash";
CM_ SG_ 2566740478 FlashProtectLamp "This parameter provides the capability to flash the engine protect lamp


00 - Slow Flash (1 Hz, 50 % duty cycle)
01 - Fast Flash (2 Hz or faster, 50% duty cycle)
10 - Reserved
11 - Unavailable / Do Not Flash";
CM_ SG_ 2566740478 FlashMalfuncIndicatorLamp "This parameter provides the capability to flash the MIL
00 - Slow Flash (1 Hz, 50 % duty cycle)
01 - Fast Flash (2 Hz or faster, 50% duty cycle)
10 - Class C DTC
11 - Unavailable / Do Not Flash
Note:  State 10 is for WWH OBD discriminatory ...";
CM_ SG_ 2566740478 FlashAmberWarningLamp "This parameter provides the capability to flash the AWL

00 - Slow Flash (1 Hz, 50 % duty cycle)
01 - Fast Flash (2 Hz or faster, 50% duty cycle)
10 - Reserved
11 - Unavailable / Do Not Flash";
CM_ SG_ 2566740478 MalfunctionIndLampStatus "A lamp used to relay only emissions-related trouble code information. This lamp is only illuminated when there is an emission-related trouble code active.
00     Lamp Off
01     Lamp On
10     Short MIL for WWH OBD
11     Not available
Note ...";
CM_ SG_ 2566740478 AmberWarningLampStatus "This lamp is used to relay trouble code information that is reporting a problem with the vehicle system but the vehicle need not be immediately stopped. 

00     Lamp Off
01     Lamp On
10     Reserved
11     Not available";
CM_ SG_ 2566740478 RedStopLampState "This lamp is used to relay trouble code information that is of a severe enough condition that it warrants stopping the vehicle.

00     Lamp Off
01     Lamp On
10     Reserved
11     Not available";
CM_ SG_ 2566740478 ProtectLampStatus "This lamp is used to relay trouble code information that is reporting a problem with a vehicle system that is most probably not electronic subsystem related. For instance, engine coolant temperature is exceeding its prescribed temperature range.
00 ...";
CM_ SG_ 2566740478 SPN5 "16 least significant bits of SPN";
CM_ SG_ 2566740478 SPN4 "16 least significant bits of SPN";
CM_ SG_ 2566740478 SPN3 "16 least significant bits of SPN";
CM_ SG_ 2566740478 SPN2 "16 least significant bits of SPN";
CM_ SG_ 2566740478 SPN1 "16 least significant bits of SPN";
CM_ BO_ 2566740734 "DTCs - B1, Previously Active
Previously Active DTCs that are classified as class B1 severity.";
CM_ SG_ 2566740734 SPN_High4 "3 most significant bits of SPN (most significant at bit 8) ";
CM_ SG_ 2566740734 SPN_High3 "3 most significant bits of SPN (most significant at bit 8) ";
CM_ SG_ 2566740734 SPN_High5 "3 most significant bits of SPN (most significant at bit 8) ";
CM_ SG_ 2566740734 SPN_High2 "3 most significant bits of SPN (most significant at bit 8) ";
CM_ SG_ 2566740734 SPN_High1 "3 most significant bits of SPN (most significant at bit 8) ";
CM_ SG_ 2566740734 SpnConversionMethod1 "If set to '0', the document is converted according to version 4 of the J1939-73 document (February 1996); otherwise, it is converted according to one of the three earlier versions.";
CM_ SG_ 2566740734 SpnConversionMethod5 "If set to '0', the document is converted according to version 4 of the J1939-73 document (February 1996); otherwise, it is converted according to one of the three earlier versions.";
CM_ SG_ 2566740734 SpnConversionMethod4 "If set to '0', the document is converted according to version 4 of the J1939-73 document (February 1996); otherwise, it is converted according to one of the three earlier versions.";
CM_ SG_ 2566740734 SpnConversionMethod3 "If set to '0', the document is converted according to version 4 of the J1939-73 document (February 1996); otherwise, it is converted according to one of the three earlier versions.";
CM_ SG_ 2566740734 SpnConversionMethod2 "If set to '0', the document is converted according to version 4 of the J1939-73 document (February 1996); otherwise, it is converted according to one of the three earlier versions.";
CM_ SG_ 2566740734 OccurenceCount5 "Contains the number of times a fault has been independently detected.";
CM_ SG_ 2566740734 OccurenceCount4 "Contains the number of times a fault has been independently detected.";
CM_ SG_ 2566740734 OccurenceCount3 "Contains the number of times a fault has been independently detected.";
CM_ SG_ 2566740734 OccurenceCount2 "Contains the number of times a fault has been independently detected.";
CM_ SG_ 2566740734 OccurenceCount1 "Contains the number of times a fault has been independently detected.";
CM_ SG_ 2566740734 FMI5 "The FMI defines the type of failure detected in the subsystem identified by an SPN.";
CM_ SG_ 2566740734 FMI4 "The FMI defines the type of failure detected in the subsystem identified by an SPN.";
CM_ SG_ 2566740734 FMI3 "The FMI defines the type of failure detected in the subsystem identified by an SPN.";
CM_ SG_ 2566740734 FMI2 "The FMI defines the type of failure detected in the subsystem identified by an SPN.";
CM_ SG_ 2566740734 FMI1 "The FMI defines the type of failure detected in the subsystem identified by an SPN.";
CM_ SG_ 2566740734 FlashRedStopLamp "This parameter provides the capability to flash the RSL


00 - Slow Flash (1 Hz, 50 % duty cycle)
01 - Fast Flash (2 Hz or faster, 50% duty cycle)
10 - Reserved
11 - Unavailable / Do Not Flash";
CM_ SG_ 2566740734 FlashProtectLamp "This parameter provides the capability to flash the engine protect lamp


00 - Slow Flash (1 Hz, 50 % duty cycle)
01 - Fast Flash (2 Hz or faster, 50% duty cycle)
10 - Reserved
11 - Unavailable / Do Not Flash";
CM_ SG_ 2566740734 FlashMalfuncIndicatorLamp "This parameter provides the capability to flash the MIL
00 - Slow Flash (1 Hz, 50 % duty cycle)
01 - Fast Flash (2 Hz or faster, 50% duty cycle)
10 - Class C DTC
11 - Unavailable / Do Not Flash
Note:  State 10 is for WWH OBD discriminatory ...";
CM_ SG_ 2566740734 FlashAmberWarningLamp "This parameter provides the capability to flash the AWL

00 - Slow Flash (1 Hz, 50 % duty cycle)
01 - Fast Flash (2 Hz or faster, 50% duty cycle)
10 - Reserved
11 - Unavailable / Do Not Flash";
CM_ SG_ 2566740734 MalfunctionIndLampStatus "A lamp used to relay only emissions-related trouble code information. This lamp is only illuminated when there is an emission-related trouble code active.
00     Lamp Off
01     Lamp On
10     Short MIL for WWH OBD
11     Not available
Note ...";
CM_ SG_ 2566740734 AmberWarningLampStatus "This lamp is used to relay trouble code information that is reporting a problem with the vehicle system but the vehicle need not be immediately stopped. 

00     Lamp Off
01     Lamp On
10     Reserved
11     Not available";
CM_ SG_ 2566740734 RedStopLampState "This lamp is used to relay trouble code information that is of a severe enough condition that it warrants stopping the vehicle.

00     Lamp Off
01     Lamp On
10     Reserved
11     Not available";
CM_ SG_ 2566740734 ProtectLampStatus "This lamp is used to relay trouble code information that is reporting a problem with a vehicle system that is most probably not electronic subsystem related. For instance, engine coolant temperature is exceeding its prescribed temperature range.
00 ...";
CM_ SG_ 2566740734 SPN5 "16 least significant bits of SPN";
CM_ SG_ 2566740734 SPN4 "16 least significant bits of SPN";
CM_ SG_ 2566740734 SPN3 "16 least significant bits of SPN";
CM_ SG_ 2566740734 SPN2 "16 least significant bits of SPN";
CM_ SG_ 2566740734 SPN1 "16 least significant bits of SPN";
CM_ BO_ 2566740990 "DTCs - B1, Confirmed and Active
Confirmed and Active DTCs that are classified as class B1 severity.";
CM_ SG_ 2566740990 SPN_High4 "3 most significant bits of SPN (most significant at bit 8) ";
CM_ SG_ 2566740990 SPN_High3 "3 most significant bits of SPN (most significant at bit 8) ";
CM_ SG_ 2566740990 SPN_High5 "3 most significant bits of SPN (most significant at bit 8) ";
CM_ SG_ 2566740990 SPN_High2 "3 most significant bits of SPN (most significant at bit 8) ";
CM_ SG_ 2566740990 SPN_High1 "3 most significant bits of SPN (most significant at bit 8) ";
CM_ SG_ 2566740990 SpnConversionMethod1 "If set to '0', the document is converted according to version 4 of the J1939-73 document (February 1996); otherwise, it is converted according to one of the three earlier versions.";
CM_ SG_ 2566740990 SpnConversionMethod5 "If set to '0', the document is converted according to version 4 of the J1939-73 document (February 1996); otherwise, it is converted according to one of the three earlier versions.";
CM_ SG_ 2566740990 SpnConversionMethod4 "If set to '0', the document is converted according to version 4 of the J1939-73 document (February 1996); otherwise, it is converted according to one of the three earlier versions.";
CM_ SG_ 2566740990 SpnConversionMethod3 "If set to '0', the document is converted according to version 4 of the J1939-73 document (February 1996); otherwise, it is converted according to one of the three earlier versions.";
CM_ SG_ 2566740990 SpnConversionMethod2 "If set to '0', the document is converted according to version 4 of the J1939-73 document (February 1996); otherwise, it is converted according to one of the three earlier versions.";
CM_ SG_ 2566740990 OccurenceCount5 "Contains the number of times a fault has been independently detected.";
CM_ SG_ 2566740990 OccurenceCount4 "Contains the number of times a fault has been independently detected.";
CM_ SG_ 2566740990 OccurenceCount3 "Contains the number of times a fault has been independently detected.";
CM_ SG_ 2566740990 OccurenceCount2 "Contains the number of times a fault has been independently detected.";
CM_ SG_ 2566740990 OccurenceCount1 "Contains the number of times a fault has been independently detected.";
CM_ SG_ 2566740990 FMI5 "The FMI defines the type of failure detected in the subsystem identified by an SPN.";
CM_ SG_ 2566740990 FMI4 "The FMI defines the type of failure detected in the subsystem identified by an SPN.";
CM_ SG_ 2566740990 FMI3 "The FMI defines the type of failure detected in the subsystem identified by an SPN.";
CM_ SG_ 2566740990 FMI2 "The FMI defines the type of failure detected in the subsystem identified by an SPN.";
CM_ SG_ 2566740990 FMI1 "The FMI defines the type of failure detected in the subsystem identified by an SPN.";
CM_ SG_ 2566740990 FlashRedStopLamp "This parameter provides the capability to flash the RSL


00 - Slow Flash (1 Hz, 50 % duty cycle)
01 - Fast Flash (2 Hz or faster, 50% duty cycle)
10 - Reserved
11 - Unavailable / Do Not Flash";
CM_ SG_ 2566740990 FlashProtectLamp "This parameter provides the capability to flash the engine protect lamp


00 - Slow Flash (1 Hz, 50 % duty cycle)
01 - Fast Flash (2 Hz or faster, 50% duty cycle)
10 - Reserved
11 - Unavailable / Do Not Flash";
CM_ SG_ 2566740990 FlashMalfuncIndicatorLamp "This parameter provides the capability to flash the MIL
00 - Slow Flash (1 Hz, 50 % duty cycle)
01 - Fast Flash (2 Hz or faster, 50% duty cycle)
10 - Class C DTC
11 - Unavailable / Do Not Flash
Note:  State 10 is for WWH OBD discriminatory ...";
CM_ SG_ 2566740990 FlashAmberWarningLamp "This parameter provides the capability to flash the AWL

00 - Slow Flash (1 Hz, 50 % duty cycle)
01 - Fast Flash (2 Hz or faster, 50% duty cycle)
10 - Reserved
11 - Unavailable / Do Not Flash";
CM_ SG_ 2566740990 MalfunctionIndLampStatus "A lamp used to relay only emissions-related trouble code information. This lamp is only illuminated when there is an emission-related trouble code active.
00     Lamp Off
01     Lamp On
10     Short MIL for WWH OBD
11     Not available
Note ...";
CM_ SG_ 2566740990 AmberWarningLampStatus "This lamp is used to relay trouble code information that is reporting a problem with the vehicle system but the vehicle need not be immediately stopped. 

00     Lamp Off
01     Lamp On
10     Reserved
11     Not available";
CM_ SG_ 2566740990 RedStopLampState "This lamp is used to relay trouble code information that is of a severe enough condition that it warrants stopping the vehicle.

00     Lamp Off
01     Lamp On
10     Reserved
11     Not available";
CM_ SG_ 2566740990 ProtectLampStatus "This lamp is used to relay trouble code information that is reporting a problem with a vehicle system that is most probably not electronic subsystem related. For instance, engine coolant temperature is exceeding its prescribed temperature range.
00 ...";
CM_ SG_ 2566740990 SPN5 "16 least significant bits of SPN";
CM_ SG_ 2566740990 SPN4 "16 least significant bits of SPN";
CM_ SG_ 2566740990 SPN3 "16 least significant bits of SPN";
CM_ SG_ 2566740990 SPN2 "16 least significant bits of SPN";
CM_ SG_ 2566740990 SPN1 "16 least significant bits of SPN";
CM_ BO_ 2566741246 "DTCs - B1, Pending
Pending DTCs that are classified as class B1 severity.";
CM_ SG_ 2566741246 SPN_High4 "3 most significant bits of SPN (most significant at bit 8) ";
CM_ SG_ 2566741246 SPN_High3 "3 most significant bits of SPN (most significant at bit 8) ";
CM_ SG_ 2566741246 SPN_High5 "3 most significant bits of SPN (most significant at bit 8) ";
CM_ SG_ 2566741246 SPN_High2 "3 most significant bits of SPN (most significant at bit 8) ";
CM_ SG_ 2566741246 SPN_High1 "3 most significant bits of SPN (most significant at bit 8) ";
CM_ SG_ 2566741246 SpnConversionMethod1 "If set to '0', the document is converted according to version 4 of the J1939-73 document (February 1996); otherwise, it is converted according to one of the three earlier versions.";
CM_ SG_ 2566741246 SpnConversionMethod5 "If set to '0', the document is converted according to version 4 of the J1939-73 document (February 1996); otherwise, it is converted according to one of the three earlier versions.";
CM_ SG_ 2566741246 SpnConversionMethod4 "If set to '0', the document is converted according to version 4 of the J1939-73 document (February 1996); otherwise, it is converted according to one of the three earlier versions.";
CM_ SG_ 2566741246 SpnConversionMethod3 "If set to '0', the document is converted according to version 4 of the J1939-73 document (February 1996); otherwise, it is converted according to one of the three earlier versions.";
CM_ SG_ 2566741246 SpnConversionMethod2 "If set to '0', the document is converted according to version 4 of the J1939-73 document (February 1996); otherwise, it is converted according to one of the three earlier versions.";
CM_ SG_ 2566741246 OccurenceCount5 "Contains the number of times a fault has been independently detected.";
CM_ SG_ 2566741246 OccurenceCount4 "Contains the number of times a fault has been independently detected.";
CM_ SG_ 2566741246 OccurenceCount3 "Contains the number of times a fault has been independently detected.";
CM_ SG_ 2566741246 OccurenceCount2 "Contains the number of times a fault has been independently detected.";
CM_ SG_ 2566741246 OccurenceCount1 "Contains the number of times a fault has been independently detected.";
CM_ SG_ 2566741246 FMI5 "The FMI defines the type of failure detected in the subsystem identified by an SPN.";
CM_ SG_ 2566741246 FMI4 "The FMI defines the type of failure detected in the subsystem identified by an SPN.";
CM_ SG_ 2566741246 FMI3 "The FMI defines the type of failure detected in the subsystem identified by an SPN.";
CM_ SG_ 2566741246 FMI2 "The FMI defines the type of failure detected in the subsystem identified by an SPN.";
CM_ SG_ 2566741246 FMI1 "The FMI defines the type of failure detected in the subsystem identified by an SPN.";
CM_ SG_ 2566741246 FlashRedStopLamp "This parameter provides the capability to flash the RSL


00 - Slow Flash (1 Hz, 50 % duty cycle)
01 - Fast Flash (2 Hz or faster, 50% duty cycle)
10 - Reserved
11 - Unavailable / Do Not Flash";
CM_ SG_ 2566741246 FlashProtectLamp "This parameter provides the capability to flash the engine protect lamp


00 - Slow Flash (1 Hz, 50 % duty cycle)
01 - Fast Flash (2 Hz or faster, 50% duty cycle)
10 - Reserved
11 - Unavailable / Do Not Flash";
CM_ SG_ 2566741246 FlashMalfuncIndicatorLamp "This parameter provides the capability to flash the MIL
00 - Slow Flash (1 Hz, 50 % duty cycle)
01 - Fast Flash (2 Hz or faster, 50% duty cycle)
10 - Class C DTC
11 - Unavailable / Do Not Flash
Note:  State 10 is for WWH OBD discriminatory ...";
CM_ SG_ 2566741246 FlashAmberWarningLamp "This parameter provides the capability to flash the AWL

00 - Slow Flash (1 Hz, 50 % duty cycle)
01 - Fast Flash (2 Hz or faster, 50% duty cycle)
10 - Reserved
11 - Unavailable / Do Not Flash";
CM_ SG_ 2566741246 MalfunctionIndLampStatus "A lamp used to relay only emissions-related trouble code information. This lamp is only illuminated when there is an emission-related trouble code active.
00     Lamp Off
01     Lamp On
10     Short MIL for WWH OBD
11     Not available
Note ...";
CM_ SG_ 2566741246 AmberWarningLampStatus "This lamp is used to relay trouble code information that is reporting a problem with the vehicle system but the vehicle need not be immediately stopped. 

00     Lamp Off
01     Lamp On
10     Reserved
11     Not available";
CM_ SG_ 2566741246 RedStopLampState "This lamp is used to relay trouble code information that is of a severe enough condition that it warrants stopping the vehicle.

00     Lamp Off
01     Lamp On
10     Reserved
11     Not available";
CM_ SG_ 2566741246 ProtectLampStatus "This lamp is used to relay trouble code information that is reporting a problem with a vehicle system that is most probably not electronic subsystem related. For instance, engine coolant temperature is exceeding its prescribed temperature range.
00 ...";
CM_ SG_ 2566741246 SPN5 "16 least significant bits of SPN";
CM_ SG_ 2566741246 SPN4 "16 least significant bits of SPN";
CM_ SG_ 2566741246 SPN3 "16 least significant bits of SPN";
CM_ SG_ 2566741246 SPN2 "16 least significant bits of SPN";
CM_ SG_ 2566741246 SPN1 "16 least significant bits of SPN";
CM_ BO_ 2566741502 "DTCs - A, Previously Active
Previously Active DTCs that are classified as class A severity.";
CM_ SG_ 2566741502 SPN_High4 "3 most significant bits of SPN (most significant at bit 8) ";
CM_ SG_ 2566741502 SPN_High3 "3 most significant bits of SPN (most significant at bit 8) ";
CM_ SG_ 2566741502 SPN_High5 "3 most significant bits of SPN (most significant at bit 8) ";
CM_ SG_ 2566741502 SPN_High2 "3 most significant bits of SPN (most significant at bit 8) ";
CM_ SG_ 2566741502 SPN_High1 "3 most significant bits of SPN (most significant at bit 8) ";
CM_ SG_ 2566741502 SpnConversionMethod1 "If set to '0', the document is converted according to version 4 of the J1939-73 document (February 1996); otherwise, it is converted according to one of the three earlier versions.";
CM_ SG_ 2566741502 SpnConversionMethod5 "If set to '0', the document is converted according to version 4 of the J1939-73 document (February 1996); otherwise, it is converted according to one of the three earlier versions.";
CM_ SG_ 2566741502 SpnConversionMethod4 "If set to '0', the document is converted according to version 4 of the J1939-73 document (February 1996); otherwise, it is converted according to one of the three earlier versions.";
CM_ SG_ 2566741502 SpnConversionMethod3 "If set to '0', the document is converted according to version 4 of the J1939-73 document (February 1996); otherwise, it is converted according to one of the three earlier versions.";
CM_ SG_ 2566741502 SpnConversionMethod2 "If set to '0', the document is converted according to version 4 of the J1939-73 document (February 1996); otherwise, it is converted according to one of the three earlier versions.";
CM_ SG_ 2566741502 OccurenceCount5 "Contains the number of times a fault has been independently detected.";
CM_ SG_ 2566741502 OccurenceCount4 "Contains the number of times a fault has been independently detected.";
CM_ SG_ 2566741502 OccurenceCount3 "Contains the number of times a fault has been independently detected.";
CM_ SG_ 2566741502 OccurenceCount2 "Contains the number of times a fault has been independently detected.";
CM_ SG_ 2566741502 OccurenceCount1 "Contains the number of times a fault has been independently detected.";
CM_ SG_ 2566741502 FMI5 "The FMI defines the type of failure detected in the subsystem identified by an SPN.";
CM_ SG_ 2566741502 FMI4 "The FMI defines the type of failure detected in the subsystem identified by an SPN.";
CM_ SG_ 2566741502 FMI3 "The FMI defines the type of failure detected in the subsystem identified by an SPN.";
CM_ SG_ 2566741502 FMI2 "The FMI defines the type of failure detected in the subsystem identified by an SPN.";
CM_ SG_ 2566741502 FMI1 "The FMI defines the type of failure detected in the subsystem identified by an SPN.";
CM_ SG_ 2566741502 FlashRedStopLamp "This parameter provides the capability to flash the RSL


00 - Slow Flash (1 Hz, 50 % duty cycle)
01 - Fast Flash (2 Hz or faster, 50% duty cycle)
10 - Reserved
11 - Unavailable / Do Not Flash";
CM_ SG_ 2566741502 FlashProtectLamp "This parameter provides the capability to flash the engine protect lamp


00 - Slow Flash (1 Hz, 50 % duty cycle)
01 - Fast Flash (2 Hz or faster, 50% duty cycle)
10 - Reserved
11 - Unavailable / Do Not Flash";
CM_ SG_ 2566741502 FlashMalfuncIndicatorLamp "This parameter provides the capability to flash the MIL
00 - Slow Flash (1 Hz, 50 % duty cycle)
01 - Fast Flash (2 Hz or faster, 50% duty cycle)
10 - Class C DTC
11 - Unavailable / Do Not Flash
Note:  State 10 is for WWH OBD discriminatory ...";
CM_ SG_ 2566741502 FlashAmberWarningLamp "This parameter provides the capability to flash the AWL

00 - Slow Flash (1 Hz, 50 % duty cycle)
01 - Fast Flash (2 Hz or faster, 50% duty cycle)
10 - Reserved
11 - Unavailable / Do Not Flash";
CM_ SG_ 2566741502 MalfunctionIndLampStatus "A lamp used to relay only emissions-related trouble code information. This lamp is only illuminated when there is an emission-related trouble code active.
00     Lamp Off
01     Lamp On
10     Short MIL for WWH OBD
11     Not available
Note ...";
CM_ SG_ 2566741502 AmberWarningLampStatus "This lamp is used to relay trouble code information that is reporting a problem with the vehicle system but the vehicle need not be immediately stopped. 

00     Lamp Off
01     Lamp On
10     Reserved
11     Not available";
CM_ SG_ 2566741502 RedStopLampState "This lamp is used to relay trouble code information that is of a severe enough condition that it warrants stopping the vehicle.

00     Lamp Off
01     Lamp On
10     Reserved
11     Not available";
CM_ SG_ 2566741502 ProtectLampStatus "This lamp is used to relay trouble code information that is reporting a problem with a vehicle system that is most probably not electronic subsystem related. For instance, engine coolant temperature is exceeding its prescribed temperature range.
00 ...";
CM_ SG_ 2566741502 SPN5 "16 least significant bits of SPN";
CM_ SG_ 2566741502 SPN4 "16 least significant bits of SPN";
CM_ SG_ 2566741502 SPN3 "16 least significant bits of SPN";
CM_ SG_ 2566741502 SPN2 "16 least significant bits of SPN";
CM_ SG_ 2566741502 SPN1 "16 least significant bits of SPN";
CM_ BO_ 2566741758 "DTCs - A, Confirmed and Active
Confirmed and Active DTCs that are classified as class A severity.";
CM_ SG_ 2566741758 SPN_High4 "3 most significant bits of SPN (most significant at bit 8) ";
CM_ SG_ 2566741758 SPN_High3 "3 most significant bits of SPN (most significant at bit 8) ";
CM_ SG_ 2566741758 SPN_High5 "3 most significant bits of SPN (most significant at bit 8) ";
CM_ SG_ 2566741758 SPN_High2 "3 most significant bits of SPN (most significant at bit 8) ";
CM_ SG_ 2566741758 SPN_High1 "3 most significant bits of SPN (most significant at bit 8) ";
CM_ SG_ 2566741758 SpnConversionMethod1 "If set to '0', the document is converted according to version 4 of the J1939-73 document (February 1996); otherwise, it is converted according to one of the three earlier versions.";
CM_ SG_ 2566741758 SpnConversionMethod5 "If set to '0', the document is converted according to version 4 of the J1939-73 document (February 1996); otherwise, it is converted according to one of the three earlier versions.";
CM_ SG_ 2566741758 SpnConversionMethod4 "If set to '0', the document is converted according to version 4 of the J1939-73 document (February 1996); otherwise, it is converted according to one of the three earlier versions.";
CM_ SG_ 2566741758 SpnConversionMethod3 "If set to '0', the document is converted according to version 4 of the J1939-73 document (February 1996); otherwise, it is converted according to one of the three earlier versions.";
CM_ SG_ 2566741758 SpnConversionMethod2 "If set to '0', the document is converted according to version 4 of the J1939-73 document (February 1996); otherwise, it is converted according to one of the three earlier versions.";
CM_ SG_ 2566741758 OccurenceCount5 "Contains the number of times a fault has been independently detected.";
CM_ SG_ 2566741758 OccurenceCount4 "Contains the number of times a fault has been independently detected.";
CM_ SG_ 2566741758 OccurenceCount3 "Contains the number of times a fault has been independently detected.";
CM_ SG_ 2566741758 OccurenceCount2 "Contains the number of times a fault has been independently detected.";
CM_ SG_ 2566741758 OccurenceCount1 "Contains the number of times a fault has been independently detected.";
CM_ SG_ 2566741758 FMI5 "The FMI defines the type of failure detected in the subsystem identified by an SPN.";
CM_ SG_ 2566741758 FMI4 "The FMI defines the type of failure detected in the subsystem identified by an SPN.";
CM_ SG_ 2566741758 FMI3 "The FMI defines the type of failure detected in the subsystem identified by an SPN.";
CM_ SG_ 2566741758 FMI2 "The FMI defines the type of failure detected in the subsystem identified by an SPN.";
CM_ SG_ 2566741758 FMI1 "The FMI defines the type of failure detected in the subsystem identified by an SPN.";
CM_ SG_ 2566741758 FlashRedStopLamp "This parameter provides the capability to flash the RSL


00 - Slow Flash (1 Hz, 50 % duty cycle)
01 - Fast Flash (2 Hz or faster, 50% duty cycle)
10 - Reserved
11 - Unavailable / Do Not Flash";
CM_ SG_ 2566741758 FlashProtectLamp "This parameter provides the capability to flash the engine protect lamp


00 - Slow Flash (1 Hz, 50 % duty cycle)
01 - Fast Flash (2 Hz or faster, 50% duty cycle)
10 - Reserved
11 - Unavailable / Do Not Flash";
CM_ SG_ 2566741758 FlashMalfuncIndicatorLamp "This parameter provides the capability to flash the MIL
00 - Slow Flash (1 Hz, 50 % duty cycle)
01 - Fast Flash (2 Hz or faster, 50% duty cycle)
10 - Class C DTC
11 - Unavailable / Do Not Flash
Note:  State 10 is for WWH OBD discriminatory ...";
CM_ SG_ 2566741758 FlashAmberWarningLamp "This parameter provides the capability to flash the AWL

00 - Slow Flash (1 Hz, 50 % duty cycle)
01 - Fast Flash (2 Hz or faster, 50% duty cycle)
10 - Reserved
11 - Unavailable / Do Not Flash";
CM_ SG_ 2566741758 MalfunctionIndLampStatus "A lamp used to relay only emissions-related trouble code information. This lamp is only illuminated when there is an emission-related trouble code active.
00     Lamp Off
01     Lamp On
10     Short MIL for WWH OBD
11     Not available
Note ...";
CM_ SG_ 2566741758 AmberWarningLampStatus "This lamp is used to relay trouble code information that is reporting a problem with the vehicle system but the vehicle need not be immediately stopped. 

00     Lamp Off
01     Lamp On
10     Reserved
11     Not available";
CM_ SG_ 2566741758 RedStopLampState "This lamp is used to relay trouble code information that is of a severe enough condition that it warrants stopping the vehicle.

00     Lamp Off
01     Lamp On
10     Reserved
11     Not available";
CM_ SG_ 2566741758 ProtectLampStatus "This lamp is used to relay trouble code information that is reporting a problem with a vehicle system that is most probably not electronic subsystem related. For instance, engine coolant temperature is exceeding its prescribed temperature range.
00 ...";
CM_ SG_ 2566741758 SPN5 "16 least significant bits of SPN";
CM_ SG_ 2566741758 SPN4 "16 least significant bits of SPN";
CM_ SG_ 2566741758 SPN3 "16 least significant bits of SPN";
CM_ SG_ 2566741758 SPN2 "16 least significant bits of SPN";
CM_ SG_ 2566741758 SPN1 "16 least significant bits of SPN";
BA_DEF_ SG_  "SigType" ENUM  "Default","Range","RangeSigned","ASCII","Discrete","Control","ReferencePGN","DTC","StringDelimiter","StringLength","StringLengthControl","MessageCounter","MessageChecksum","LowerPartOfSPN";
BA_DEF_ SG_  "GenSigStartValue" INT 0 10000;
BA_DEF_ SG_  "GenSigSendType" ENUM  "Cyclic","OnWrite","OnWriteWithRepetition","OnChange","OnChangeWithRepetition","IfActive","IfActiveWithRepetition","NoSigSendType";
BA_DEF_ SG_  "GenSigILSupport" ENUM  "No","Yes";
BA_DEF_ SG_  "GenSigEVName" STRING ;
BA_DEF_ SG_  "SPN" INT 0 524287;
BA_DEF_ BO_  "GenMsgStartDelayTime" INT 0 100000;
BA_DEF_ BO_  "GenMsgILSupport" ENUM  "No","Yes";
BA_DEF_ BO_  "GenMsgDelayTime" INT 0 1000;
BA_DEF_ BO_  "GenMsgRequestable" INT 0 1;
BA_DEF_ BO_  "GenMsgSendType" ENUM  "cyclic","NotUsed","NotUsed","NotUsed","NotUsed","NotUsed","NotUsed","IfActive","noMsgSendType";
BA_DEF_ BO_  "VFrameFormat" ENUM  "StandardCAN","ExtendedCAN","reserved","J1939PG";
BA_DEF_ BO_  "GenMsgCycleTime" INT 0 3600000;
BA_DEF_ SG_  "SystemSignalLongSymbol" STRING ;
BA_DEF_DEF_  "SigType" "Default";
BA_DEF_DEF_  "GenSigStartValue" 0;
BA_DEF_DEF_  "GenSigSendType" "NoSigSendType";
BA_DEF_DEF_  "GenSigILSupport" "Yes";
BA_DEF_DEF_  "GenSigEVName" "Env@Nodename_@Signame";
BA_DEF_DEF_  "SPN" 0;
BA_DEF_DEF_  "GenMsgStartDelayTime" 0;
BA_DEF_DEF_  "GenMsgILSupport" "Yes";
BA_DEF_DEF_  "GenMsgDelayTime" 0;
BA_DEF_DEF_  "GenMsgRequestable" 1;
BA_DEF_DEF_  "GenMsgSendType" "noMsgSendType";
BA_DEF_DEF_  "VFrameFormat" "J1939PG";
BA_DEF_DEF_  "GenMsgCycleTime" 0;
BA_DEF_DEF_  "SystemSignalLongSymbol" "";
BA_ "SPN" SG_ 2566705918 SpnConversionMethod1 1706;
BA_ "SPN" SG_ 2566705918 SpnConversionMethod5 1706;
BA_ "SPN" SG_ 2566705918 SpnConversionMethod4 1706;
BA_ "SPN" SG_ 2566705918 SpnConversionMethod3 1706;
BA_ "SPN" SG_ 2566705918 SpnConversionMethod2 1706;
BA_ "SPN" SG_ 2566705918 OccurenceCount5 1216;
BA_ "SPN" SG_ 2566705918 OccurenceCount4 1216;
BA_ "SPN" SG_ 2566705918 OccurenceCount3 1216;
BA_ "SPN" SG_ 2566705918 OccurenceCount2 1216;
BA_ "SPN" SG_ 2566705918 OccurenceCount1 1216;
BA_ "SPN" SG_ 2566705918 FMI5 4149;
BA_ "SPN" SG_ 2566705918 FMI4 4149;
BA_ "SPN" SG_ 2566705918 FMI3 4149;
BA_ "SPN" SG_ 2566705918 FMI2 4149;
BA_ "SPN" SG_ 2566705918 FMI1 4149;
BA_ "SigType" SG_ 2566705918 FlashRedStopLamp 5;
BA_ "SPN" SG_ 2566705918 FlashRedStopLamp 3039;
BA_ "SigType" SG_ 2566705918 FlashProtectLamp 5;
BA_ "SPN" SG_ 2566705918 FlashProtectLamp 3041;
BA_ "SigType" SG_ 2566705918 FlashMalfuncIndicatorLamp 5;
BA_ "SPN" SG_ 2566705918 FlashMalfuncIndicatorLamp 3038;
BA_ "SigType" SG_ 2566705918 FlashAmberWarningLamp 5;
BA_ "SPN" SG_ 2566705918 FlashAmberWarningLamp 3040;
BA_ "SigType" SG_ 2566705918 MalfunctionIndLampStatus 5;
BA_ "SPN" SG_ 2566705918 MalfunctionIndLampStatus 1213;
BA_ "SigType" SG_ 2566705918 AmberWarningLampStatus 5;
BA_ "SPN" SG_ 2566705918 AmberWarningLampStatus 624;
BA_ "SigType" SG_ 2566705918 RedStopLampState 4;
BA_ "SPN" SG_ 2566705918 RedStopLampState 623;
BA_ "SigType" SG_ 2566705918 ProtectLampStatus 5;
BA_ "SPN" SG_ 2566705918 ProtectLampStatus 987;
BA_ "SigType" SG_ 2566705918 SPN5 13;
BA_ "SigType" SG_ 2566705918 SPN4 13;
BA_ "SigType" SG_ 2566705918 SPN3 13;
BA_ "SigType" SG_ 2566705918 SPN2 13;
BA_ "SigType" SG_ 2566705918 SPN1 13;
BA_ "SPN" SG_ 2566705662 SpnConversionMethod1 1706;
BA_ "SPN" SG_ 2566705662 SpnConversionMethod5 1706;
BA_ "SPN" SG_ 2566705662 SpnConversionMethod4 1706;
BA_ "SPN" SG_ 2566705662 SpnConversionMethod3 1706;
BA_ "SPN" SG_ 2566705662 SpnConversionMethod2 1706;
BA_ "SPN" SG_ 2566705662 OccurenceCount5 1216;
BA_ "SPN" SG_ 2566705662 OccurenceCount4 1216;
BA_ "SPN" SG_ 2566705662 OccurenceCount3 1216;
BA_ "SPN" SG_ 2566705662 OccurenceCount2 1216;
BA_ "SPN" SG_ 2566705662 OccurenceCount1 1216;
BA_ "SPN" SG_ 2566705662 FMI5 4149;
BA_ "SPN" SG_ 2566705662 FMI4 4149;
BA_ "SPN" SG_ 2566705662 FMI3 4149;
BA_ "SPN" SG_ 2566705662 FMI2 4149;
BA_ "SPN" SG_ 2566705662 FMI1 4149;
BA_ "SigType" SG_ 2566705662 FlashRedStopLamp 5;
BA_ "SPN" SG_ 2566705662 FlashRedStopLamp 3039;
BA_ "SigType" SG_ 2566705662 FlashProtectLamp 5;
BA_ "SPN" SG_ 2566705662 FlashProtectLamp 3041;
BA_ "SigType" SG_ 2566705662 FlashMalfuncIndicatorLamp 5;
BA_ "SPN" SG_ 2566705662 FlashMalfuncIndicatorLamp 3038;
BA_ "SigType" SG_ 2566705662 FlashAmberWarningLamp 5;
BA_ "SPN" SG_ 2566705662 FlashAmberWarningLamp 3040;
BA_ "SigType" SG_ 2566705662 MalfunctionIndLampStatus 5;
BA_ "SPN" SG_ 2566705662 MalfunctionIndLampStatus 1213;
BA_ "SigType" SG_ 2566705662 AmberWarningLampStatus 5;
BA_ "SPN" SG_ 2566705662 AmberWarningLampStatus 624;
BA_ "SigType" SG_ 2566705662 RedStopLampState 4;
BA_ "SPN" SG_ 2566705662 RedStopLampState 623;
BA_ "SigType" SG_ 2566705662 ProtectLampStatus 5;
BA_ "SPN" SG_ 2566705662 ProtectLampStatus 987;
BA_ "SigType" SG_ 2566705662 SPN5 13;
BA_ "SigType" SG_ 2566705662 SPN4 13;
BA_ "SigType" SG_ 2566705662 SPN3 13;
BA_ "SigType" SG_ 2566705662 SPN2 13;
BA_ "SigType" SG_ 2566705662 SPN1 13;
BA_ "SPN" SG_ 2566739198 SpnConversionMethod1 1706;
BA_ "SPN" SG_ 2566739198 SpnConversionMethod5 1706;
BA_ "SPN" SG_ 2566739198 SpnConversionMethod4 1706;
BA_ "SPN" SG_ 2566739198 SpnConversionMethod3 1706;
BA_ "SPN" SG_ 2566739198 SpnConversionMethod2 1706;
BA_ "SPN" SG_ 2566739198 OccurenceCount5 1216;
BA_ "SPN" SG_ 2566739198 OccurenceCount4 1216;
BA_ "SPN" SG_ 2566739198 OccurenceCount3 1216;
BA_ "SPN" SG_ 2566739198 OccurenceCount2 1216;
BA_ "SPN" SG_ 2566739198 OccurenceCount1 1216;
BA_ "SPN" SG_ 2566739198 FMI5 4149;
BA_ "SPN" SG_ 2566739198 FMI4 4149;
BA_ "SPN" SG_ 2566739198 FMI3 4149;
BA_ "SPN" SG_ 2566739198 FMI2 4149;
BA_ "SPN" SG_ 2566739198 FMI1 4149;
BA_ "SigType" SG_ 2566739198 FlashRedStopLamp 5;
BA_ "SPN" SG_ 2566739198 FlashRedStopLamp 3039;
BA_ "SigType" SG_ 2566739198 FlashProtectLamp 5;
BA_ "SPN" SG_ 2566739198 FlashProtectLamp 3041;
BA_ "SigType" SG_ 2566739198 FlashMalfuncIndicatorLamp 5;
BA_ "SPN" SG_ 2566739198 FlashMalfuncIndicatorLamp 3038;
BA_ "SigType" SG_ 2566739198 FlashAmberWarningLamp 5;
BA_ "SPN" SG_ 2566739198 FlashAmberWarningLamp 3040;
BA_ "SigType" SG_ 2566739198 MalfunctionIndLampStatus 5;
BA_ "SPN" SG_ 2566739198 MalfunctionIndLampStatus 1213;
BA_ "SigType" SG_ 2566739198 AmberWarningLampStatus 5;
BA_ "SPN" SG_ 2566739198 AmberWarningLampStatus 624;
BA_ "SigType" SG_ 2566739198 RedStopLampState 4;
BA_ "SPN" SG_ 2566739198 RedStopLampState 623;
BA_ "SigType" SG_ 2566739198 ProtectLampStatus 5;
BA_ "SPN" SG_ 2566739198 ProtectLampStatus 987;
BA_ "SigType" SG_ 2566739198 SPN5 13;
BA_ "SigType" SG_ 2566739198 SPN4 13;
BA_ "SigType" SG_ 2566739198 SPN3 13;
BA_ "SigType" SG_ 2566739198 SPN2 13;
BA_ "SigType" SG_ 2566739198 SPN1 13;
BA_ "SPN" SG_ 2566739454 SpnConversionMethod1 1706;
BA_ "SPN" SG_ 2566739454 SpnConversionMethod5 1706;
BA_ "SPN" SG_ 2566739454 SpnConversionMethod4 1706;
BA_ "SPN" SG_ 2566739454 SpnConversionMethod3 1706;
BA_ "SPN" SG_ 2566739454 SpnConversionMethod2 1706;
BA_ "SPN" SG_ 2566739454 OccurenceCount5 1216;
BA_ "SPN" SG_ 2566739454 OccurenceCount4 1216;
BA_ "SPN" SG_ 2566739454 OccurenceCount3 1216;
BA_ "SPN" SG_ 2566739454 OccurenceCount2 1216;
BA_ "SPN" SG_ 2566739454 OccurenceCount1 1216;
BA_ "SPN" SG_ 2566739454 FMI5 4149;
BA_ "SPN" SG_ 2566739454 FMI4 4149;
BA_ "SPN" SG_ 2566739454 FMI3 4149;
BA_ "SPN" SG_ 2566739454 FMI2 4149;
BA_ "SPN" SG_ 2566739454 FMI1 4149;
BA_ "SigType" SG_ 2566739454 FlashRedStopLamp 5;
BA_ "SPN" SG_ 2566739454 FlashRedStopLamp 3039;
BA_ "SigType" SG_ 2566739454 FlashProtectLamp 5;
BA_ "SPN" SG_ 2566739454 FlashProtectLamp 3041;
BA_ "SigType" SG_ 2566739454 FlashMalfuncIndicatorLamp 5;
BA_ "SPN" SG_ 2566739454 FlashMalfuncIndicatorLamp 3038;
BA_ "SigType" SG_ 2566739454 FlashAmberWarningLamp 5;
BA_ "SPN" SG_ 2566739454 FlashAmberWarningLamp 3040;
BA_ "SigType" SG_ 2566739454 MalfunctionIndLampStatus 5;
BA_ "SPN" SG_ 2566739454 MalfunctionIndLampStatus 1213;
BA_ "SigType" SG_ 2566739454 AmberWarningLampStatus 5;
BA_ "SPN" SG_ 2566739454 AmberWarningLampStatus 624;
BA_ "SigType" SG_ 2566739454 RedStopLampState 4;
BA_ "SPN" SG_ 2566739454 RedStopLampState 623;
BA_ "SigType" SG_ 2566739454 ProtectLampStatus 5;
BA_ "SPN" SG_ 2566739454 ProtectLampStatus 987;
BA_ "SigType" SG_ 2566739454 SPN5 13;
BA_ "SigType" SG_ 2566739454 SPN4 13;
BA_ "SigType" SG_ 2566739454 SPN3 13;
BA_ "SigType" SG_ 2566739454 SPN2 13;
BA_ "SigType" SG_ 2566739454 SPN1 13;
BA_ "SPN" SG_ 2566739710 SpnConversionMethod1 1706;
BA_ "SPN" SG_ 2566739710 SpnConversionMethod5 1706;
BA_ "SPN" SG_ 2566739710 SpnConversionMethod4 1706;
BA_ "SPN" SG_ 2566739710 SpnConversionMethod3 1706;
BA_ "SPN" SG_ 2566739710 SpnConversionMethod2 1706;
BA_ "SPN" SG_ 2566739710 OccurenceCount5 1216;
BA_ "SPN" SG_ 2566739710 OccurenceCount4 1216;
BA_ "SPN" SG_ 2566739710 OccurenceCount3 1216;
BA_ "SPN" SG_ 2566739710 OccurenceCount2 1216;
BA_ "SPN" SG_ 2566739710 OccurenceCount1 1216;
BA_ "SPN" SG_ 2566739710 FMI5 4149;
BA_ "SPN" SG_ 2566739710 FMI4 4149;
BA_ "SPN" SG_ 2566739710 FMI3 4149;
BA_ "SPN" SG_ 2566739710 FMI2 4149;
BA_ "SPN" SG_ 2566739710 FMI1 4149;
BA_ "SigType" SG_ 2566739710 FlashRedStopLamp 5;
BA_ "SPN" SG_ 2566739710 FlashRedStopLamp 3039;
BA_ "SigType" SG_ 2566739710 FlashProtectLamp 5;
BA_ "SPN" SG_ 2566739710 FlashProtectLamp 3041;
BA_ "SigType" SG_ 2566739710 FlashMalfuncIndicatorLamp 5;
BA_ "SPN" SG_ 2566739710 FlashMalfuncIndicatorLamp 3038;
BA_ "SigType" SG_ 2566739710 FlashAmberWarningLamp 5;
BA_ "SPN" SG_ 2566739710 FlashAmberWarningLamp 3040;
BA_ "SigType" SG_ 2566739710 MalfunctionIndLampStatus 5;
BA_ "SPN" SG_ 2566739710 MalfunctionIndLampStatus 1213;
BA_ "SigType" SG_ 2566739710 AmberWarningLampStatus 5;
BA_ "SPN" SG_ 2566739710 AmberWarningLampStatus 624;
BA_ "SigType" SG_ 2566739710 RedStopLampState 4;
BA_ "SPN" SG_ 2566739710 RedStopLampState 623;
BA_ "SigType" SG_ 2566739710 ProtectLampStatus 5;
BA_ "SPN" SG_ 2566739710 ProtectLampStatus 987;
BA_ "SigType" SG_ 2566739710 SPN5 13;
BA_ "SigType" SG_ 2566739710 SPN4 13;
BA_ "SigType" SG_ 2566739710 SPN3 13;
BA_ "SigType" SG_ 2566739710 SPN2 13;
BA_ "SigType" SG_ 2566739710 SPN1 13;
BA_ "SPN" SG_ 2566739966 SpnConversionMethod1 1706;
BA_ "SPN" SG_ 2566739966 SpnConversionMethod5 1706;
BA_ "SPN" SG_ 2566739966 SpnConversionMethod4 1706;
BA_ "SPN" SG_ 2566739966 SpnConversionMethod3 1706;
BA_ "SPN" SG_ 2566739966 SpnConversionMethod2 1706;
BA_ "SPN" SG_ 2566739966 OccurenceCount5 1216;
BA_ "SPN" SG_ 2566739966 OccurenceCount4 1216;
BA_ "SPN" SG_ 2566739966 OccurenceCount3 1216;
BA_ "SPN" SG_ 2566739966 OccurenceCount2 1216;
BA_ "SPN" SG_ 2566739966 OccurenceCount1 1216;
BA_ "SPN" SG_ 2566739966 FMI5 4149;
BA_ "SPN" SG_ 2566739966 FMI4 4149;
BA_ "SPN" SG_ 2566739966 FMI3 4149;
BA_ "SPN" SG_ 2566739966 FMI2 4149;
BA_ "SPN" SG_ 2566739966 FMI1 4149;
BA_ "SigType" SG_ 2566739966 FlashRedStopLamp 5;
BA_ "SPN" SG_ 2566739966 FlashRedStopLamp 3039;
BA_ "SigType" SG_ 2566739966 FlashProtectLamp 5;
BA_ "SPN" SG_ 2566739966 FlashProtectLamp 3041;
BA_ "SigType" SG_ 2566739966 FlashMalfuncIndicatorLamp 5;
BA_ "SPN" SG_ 2566739966 FlashMalfuncIndicatorLamp 3038;
BA_ "SigType" SG_ 2566739966 FlashAmberWarningLamp 5;
BA_ "SPN" SG_ 2566739966 FlashAmberWarningLamp 3040;
BA_ "SigType" SG_ 2566739966 MalfunctionIndLampStatus 5;
BA_ "SPN" SG_ 2566739966 MalfunctionIndLampStatus 1213;
BA_ "SigType" SG_ 2566739966 AmberWarningLampStatus 5;
BA_ "SPN" SG_ 2566739966 AmberWarningLampStatus 624;
BA_ "SigType" SG_ 2566739966 RedStopLampState 4;
BA_ "SPN" SG_ 2566739966 RedStopLampState 623;
BA_ "SigType" SG_ 2566739966 ProtectLampStatus 5;
BA_ "SPN" SG_ 2566739966 ProtectLampStatus 987;
BA_ "SigType" SG_ 2566739966 SPN5 13;
BA_ "SigType" SG_ 2566739966 SPN4 13;
BA_ "SigType" SG_ 2566739966 SPN3 13;
BA_ "SigType" SG_ 2566739966 SPN2 13;
BA_ "SigType" SG_ 2566739966 SPN1 13;
BA_ "SPN" SG_ 2566740222 SpnConversionMethod1 1706;
BA_ "SPN" SG_ 2566740222 SpnConversionMethod5 1706;
BA_ "SPN" SG_ 2566740222 SpnConversionMethod4 1706;
BA_ "SPN" SG_ 2566740222 SpnConversionMethod3 1706;
BA_ "SPN" SG_ 2566740222 SpnConversionMethod2 1706;
BA_ "SPN" SG_ 2566740222 OccurenceCount5 1216;
BA_ "SPN" SG_ 2566740222 OccurenceCount4 1216;
BA_ "SPN" SG_ 2566740222 OccurenceCount3 1216;
BA_ "SPN" SG_ 2566740222 OccurenceCount2 1216;
BA_ "SPN" SG_ 2566740222 OccurenceCount1 1216;
BA_ "SPN" SG_ 2566740222 FMI5 4149;
BA_ "SPN" SG_ 2566740222 FMI4 4149;
BA_ "SPN" SG_ 2566740222 FMI3 4149;
BA_ "SPN" SG_ 2566740222 FMI2 4149;
BA_ "SPN" SG_ 2566740222 FMI1 4149;
BA_ "SigType" SG_ 2566740222 FlashRedStopLamp 5;
BA_ "SPN" SG_ 2566740222 FlashRedStopLamp 3039;
BA_ "SigType" SG_ 2566740222 FlashProtectLamp 5;
BA_ "SPN" SG_ 2566740222 FlashProtectLamp 3041;
BA_ "SigType" SG_ 2566740222 FlashMalfuncIndicatorLamp 5;
BA_ "SPN" SG_ 2566740222 FlashMalfuncIndicatorLamp 3038;
BA_ "SigType" SG_ 2566740222 FlashAmberWarningLamp 5;
BA_ "SPN" SG_ 2566740222 FlashAmberWarningLamp 3040;
BA_ "SigType" SG_ 2566740222 MalfunctionIndLampStatus 5;
BA_ "SPN" SG_ 2566740222 MalfunctionIndLampStatus 1213;
BA_ "SigType" SG_ 2566740222 AmberWarningLampStatus 5;
BA_ "SPN" SG_ 2566740222 AmberWarningLampStatus 624;
BA_ "SigType" SG_ 2566740222 RedStopLampState 4;
BA_ "SPN" SG_ 2566740222 RedStopLampState 623;
BA_ "SigType" SG_ 2566740222 ProtectLampStatus 5;
BA_ "SPN" SG_ 2566740222 ProtectLampStatus 987;
BA_ "SigType" SG_ 2566740222 SPN5 13;
BA_ "SigType" SG_ 2566740222 SPN4 13;
BA_ "SigType" SG_ 2566740222 SPN3 13;
BA_ "SigType" SG_ 2566740222 SPN2 13;
BA_ "SigType" SG_ 2566740222 SPN1 13;
BA_ "SPN" SG_ 2566740478 SpnConversionMethod1 1706;
BA_ "SPN" SG_ 2566740478 SpnConversionMethod5 1706;
BA_ "SPN" SG_ 2566740478 SpnConversionMethod4 1706;
BA_ "SPN" SG_ 2566740478 SpnConversionMethod3 1706;
BA_ "SPN" SG_ 2566740478 SpnConversionMethod2 1706;
BA_ "SPN" SG_ 2566740478 OccurenceCount5 1216;
BA_ "SPN" SG_ 2566740478 OccurenceCount4 1216;
BA_ "SPN" SG_ 2566740478 OccurenceCount3 1216;
BA_ "SPN" SG_ 2566740478 OccurenceCount2 1216;
BA_ "SPN" SG_ 2566740478 OccurenceCount1 1216;
BA_ "SPN" SG_ 2566740478 FMI5 4149;
BA_ "SPN" SG_ 2566740478 FMI4 4149;
BA_ "SPN" SG_ 2566740478 FMI3 4149;
BA_ "SPN" SG_ 2566740478 FMI2 4149;
BA_ "SPN" SG_ 2566740478 FMI1 4149;
BA_ "SigType" SG_ 2566740478 FlashRedStopLamp 5;
BA_ "SPN" SG_ 2566740478 FlashRedStopLamp 3039;
BA_ "SigType" SG_ 2566740478 FlashProtectLamp 5;
BA_ "SPN" SG_ 2566740478 FlashProtectLamp 3041;
BA_ "SigType" SG_ 2566740478 FlashMalfuncIndicatorLamp 5;
BA_ "SPN" SG_ 2566740478 FlashMalfuncIndicatorLamp 3038;
BA_ "SigType" SG_ 2566740478 FlashAmberWarningLamp 5;
BA_ "SPN" SG_ 2566740478 FlashAmberWarningLamp 3040;
BA_ "SigType" SG_ 2566740478 MalfunctionIndLampStatus 5;
BA_ "SPN" SG_ 2566740478 MalfunctionIndLampStatus 1213;
BA_ "SigType" SG_ 2566740478 AmberWarningLampStatus 5;
BA_ "SPN" SG_ 2566740478 AmberWarningLampStatus 624;
BA_ "SigType" SG_ 2566740478 RedStopLampState 4;
BA_ "SPN" SG_ 2566740478 RedStopLampState 623;
BA_ "SigType" SG_ 2566740478 ProtectLampStatus 5;
BA_ "SPN" SG_ 2566740478 ProtectLampStatus 987;
BA_ "SigType" SG_ 2566740478 SPN5 13;
BA_ "SigType" SG_ 2566740478 SPN4 13;
BA_ "SigType" SG_ 2566740478 SPN3 13;
BA_ "SigType" SG_ 2566740478 SPN2 13;
BA_ "SigType" SG_ 2566740478 SPN1 13;
BA_ "SPN" SG_ 2566740734 SpnConversionMethod1 1706;
BA_ "SPN" SG_ 2566740734 SpnConversionMethod5 1706;
BA_ "SPN" SG_ 2566740734 SpnConversionMethod4 1706;
BA_ "SPN" SG_ 2566740734 SpnConversionMethod3 1706;
BA_ "SPN" SG_ 2566740734 SpnConversionMethod2 1706;
BA_ "SPN" SG_ 2566740734 OccurenceCount5 1216;
BA_ "SPN" SG_ 2566740734 OccurenceCount4 1216;
BA_ "SPN" SG_ 2566740734 OccurenceCount3 1216;
BA_ "SPN" SG_ 2566740734 OccurenceCount2 1216;
BA_ "SPN" SG_ 2566740734 OccurenceCount1 1216;
BA_ "SPN" SG_ 2566740734 FMI5 4149;
BA_ "SPN" SG_ 2566740734 FMI4 4149;
BA_ "SPN" SG_ 2566740734 FMI3 4149;
BA_ "SPN" SG_ 2566740734 FMI2 4149;
BA_ "SPN" SG_ 2566740734 FMI1 4149;
BA_ "SigType" SG_ 2566740734 FlashRedStopLamp 5;
BA_ "SPN" SG_ 2566740734 FlashRedStopLamp 3039;
BA_ "SigType" SG_ 2566740734 FlashProtectLamp 5;
BA_ "SPN" SG_ 2566740734 FlashProtectLamp 3041;
BA_ "SigType" SG_ 2566740734 FlashMalfuncIndicatorLamp 5;
BA_ "SPN" SG_ 2566740734 FlashMalfuncIndicatorLamp 3038;
BA_ "SigType" SG_ 2566740734 FlashAmberWarningLamp 5;
BA_ "SPN" SG_ 2566740734 FlashAmberWarningLamp 3040;
BA_ "SigType" SG_ 2566740734 MalfunctionIndLampStatus 5;
BA_ "SPN" SG_ 2566740734 MalfunctionIndLampStatus 1213;
BA_ "SigType" SG_ 2566740734 AmberWarningLampStatus 5;
BA_ "SPN" SG_ 2566740734 AmberWarningLampStatus 624;
BA_ "SigType" SG_ 2566740734 RedStopLampState 4;
BA_ "SPN" SG_ 2566740734 RedStopLampState 623;
BA_ "SigType" SG_ 2566740734 ProtectLampStatus 5;
BA_ "SPN" SG_ 2566740734 ProtectLampStatus 987;
BA_ "SigType" SG_ 2566740734 SPN5 13;
BA_ "SigType" SG_ 2566740734 SPN4 13;
BA_ "SigType" SG_ 2566740734 SPN3 13;
BA_ "SigType" SG_ 2566740734 SPN2 13;
BA_ "SigType" SG_ 2566740734 SPN1 13;
BA_ "SPN" SG_ 2566740990 SpnConversionMethod1 1706;
BA_ "SPN" SG_ 2566740990 SpnConversionMethod5 1706;
BA_ "SPN" SG_ 2566740990 SpnConversionMethod4 1706;
BA_ "SPN" SG_ 2566740990 SpnConversionMethod3 1706;
BA_ "SPN" SG_ 2566740990 SpnConversionMethod2 1706;
BA_ "SPN" SG_ 2566740990 OccurenceCount5 1216;
BA_ "SPN" SG_ 2566740990 OccurenceCount4 1216;
BA_ "SPN" SG_ 2566740990 OccurenceCount3 1216;
BA_ "SPN" SG_ 2566740990 OccurenceCount2 1216;
BA_ "SPN" SG_ 2566740990 OccurenceCount1 1216;
BA_ "SPN" SG_ 2566740990 FMI5 4149;
BA_ "SPN" SG_ 2566740990 FMI4 4149;
BA_ "SPN" SG_ 2566740990 FMI3 4149;
BA_ "SPN" SG_ 2566740990 FMI2 4149;
BA_ "SPN" SG_ 2566740990 FMI1 4149;
BA_ "SigType" SG_ 2566740990 FlashRedStopLamp 5;
BA_ "SPN" SG_ 2566740990 FlashRedStopLamp 3039;
BA_ "SigType" SG_ 2566740990 FlashProtectLamp 5;
BA_ "SPN" SG_ 2566740990 FlashProtectLamp 3041;
BA_ "SigType" SG_ 2566740990 FlashMalfuncIndicatorLamp 5;
BA_ "SPN" SG_ 2566740990 FlashMalfuncIndicatorLamp 3038;
BA_ "SigType" SG_ 2566740990 FlashAmberWarningLamp 5;
BA_ "SPN" SG_ 2566740990 FlashAmberWarningLamp 3040;
BA_ "SigType" SG_ 2566740990 MalfunctionIndLampStatus 5;
BA_ "SPN" SG_ 2566740990 MalfunctionIndLampStatus 1213;
BA_ "SigType" SG_ 2566740990 AmberWarningLampStatus 5;
BA_ "SPN" SG_ 2566740990 AmberWarningLampStatus 624;
BA_ "SigType" SG_ 2566740990 RedStopLampState 4;
BA_ "SPN" SG_ 2566740990 RedStopLampState 623;
BA_ "SigType" SG_ 2566740990 ProtectLampStatus 5;
BA_ "SPN" SG_ 2566740990 ProtectLampStatus 987;
BA_ "SigType" SG_ 2566740990 SPN5 13;
BA_ "SigType" SG_ 2566740990 SPN4 13;
BA_ "SigType" SG_ 2566740990 SPN3 13;
BA_ "SigType" SG_ 2566740990 SPN2 13;
BA_ "SigType" SG_ 2566740990 SPN1 13;
BA_ "SPN" SG_ 2566741246 SpnConversionMethod1 1706;
BA_ "SPN" SG_ 2566741246 SpnConversionMethod5 1706;
BA_ "SPN" SG_ 2566741246 SpnConversionMethod4 1706;
BA_ "SPN" SG_ 2566741246 SpnConversionMethod3 1706;
BA_ "SPN" SG_ 2566741246 SpnConversionMethod2 1706;
BA_ "SPN" SG_ 2566741246 OccurenceCount5 1216;
BA_ "SPN" SG_ 2566741246 OccurenceCount4 1216;
BA_ "SPN" SG_ 2566741246 OccurenceCount3 1216;
BA_ "SPN" SG_ 2566741246 OccurenceCount2 1216;
BA_ "SPN" SG_ 2566741246 OccurenceCount1 1216;
BA_ "SPN" SG_ 2566741246 FMI5 4149;
BA_ "SPN" SG_ 2566741246 FMI4 4149;
BA_ "SPN" SG_ 2566741246 FMI3 4149;
BA_ "SPN" SG_ 2566741246 FMI2 4149;
BA_ "SPN" SG_ 2566741246 FMI1 4149;
BA_ "SigType" SG_ 2566741246 FlashRedStopLamp 5;
BA_ "SPN" SG_ 2566741246 FlashRedStopLamp 3039;
BA_ "SigType" SG_ 2566741246 FlashProtectLamp 5;
BA_ "SPN" SG_ 2566741246 FlashProtectLamp 3041;
BA_ "SigType" SG_ 2566741246 FlashMalfuncIndicatorLamp 5;
BA_ "SPN" SG_ 2566741246 FlashMalfuncIndicatorLamp 3038;
BA_ "SigType" SG_ 2566741246 FlashAmberWarningLamp 5;
BA_ "SPN" SG_ 2566741246 FlashAmberWarningLamp 3040;
BA_ "SigType" SG_ 2566741246 MalfunctionIndLampStatus 5;
BA_ "SPN" SG_ 2566741246 MalfunctionIndLampStatus 1213;
BA_ "SigType" SG_ 2566741246 AmberWarningLampStatus 5;
BA_ "SPN" SG_ 2566741246 AmberWarningLampStatus 624;
BA_ "SigType" SG_ 2566741246 RedStopLampState 4;
BA_ "SPN" SG_ 2566741246 RedStopLampState 623;
BA_ "SigType" SG_ 2566741246 ProtectLampStatus 5;
BA_ "SPN" SG_ 2566741246 ProtectLampStatus 987;
BA_ "SigType" SG_ 2566741246 SPN5 13;
BA_ "SigType" SG_ 2566741246 SPN4 13;
BA_ "SigType" SG_ 2566741246 SPN3 13;
BA_ "SigType" SG_ 2566741246 SPN2 13;
BA_ "SigType" SG_ 2566741246 SPN1 13;
BA_ "SPN" SG_ 2566741502 SpnConversionMethod1 1706;
BA_ "SPN" SG_ 2566741502 SpnConversionMethod5 1706;
BA_ "SPN" SG_ 2566741502 SpnConversionMethod4 1706;
BA_ "SPN" SG_ 2566741502 SpnConversionMethod3 1706;
BA_ "SPN" SG_ 2566741502 SpnConversionMethod2 1706;
BA_ "SPN" SG_ 2566741502 OccurenceCount5 1216;
BA_ "SPN" SG_ 2566741502 OccurenceCount4 1216;
BA_ "SPN" SG_ 2566741502 OccurenceCount3 1216;
BA_ "SPN" SG_ 2566741502 OccurenceCount2 1216;
BA_ "SPN" SG_ 2566741502 OccurenceCount1 1216;
BA_ "SPN" SG_ 2566741502 FMI5 4149;
BA_ "SPN" SG_ 2566741502 FMI4 4149;
BA_ "SPN" SG_ 2566741502 FMI3 4149;
BA_ "SPN" SG_ 2566741502 FMI2 4149;
BA_ "SPN" SG_ 2566741502 FMI1 4149;
BA_ "SigType" SG_ 2566741502 FlashRedStopLamp 5;
BA_ "SPN" SG_ 2566741502 FlashRedStopLamp 3039;
BA_ "SigType" SG_ 2566741502 FlashProtectLamp 5;
BA_ "SPN" SG_ 2566741502 FlashProtectLamp 3041;
BA_ "SigType" SG_ 2566741502 FlashMalfuncIndicatorLamp 5;
BA_ "SPN" SG_ 2566741502 FlashMalfuncIndicatorLamp 3038;
BA_ "SigType" SG_ 2566741502 FlashAmberWarningLamp 5;
BA_ "SPN" SG_ 2566741502 FlashAmberWarningLamp 3040;
BA_ "SigType" SG_ 2566741502 MalfunctionIndLampStatus 5;
BA_ "SPN" SG_ 2566741502 MalfunctionIndLampStatus 1213;
BA_ "SigType" SG_ 2566741502 AmberWarningLampStatus 5;
BA_ "SPN" SG_ 2566741502 AmberWarningLampStatus 624;
BA_ "SigType" SG_ 2566741502 RedStopLampState 4;
BA_ "SPN" SG_ 2566741502 RedStopLampState 623;
BA_ "SigType" SG_ 2566741502 ProtectLampStatus 5;
BA_ "SPN" SG_ 2566741502 ProtectLampStatus 987;
BA_ "SigType" SG_ 2566741502 SPN5 13;
BA_ "SigType" SG_ 2566741502 SPN4 13;
BA_ "SigType" SG_ 2566741502 SPN3 13;
BA_ "SigType" SG_ 2566741502 SPN2 13;
BA_ "SigType" SG_ 2566741502 SPN1 13;
BA_ "SPN" SG_ 2566741758 SpnConversionMethod1 1706;
BA_ "SPN" SG_ 2566741758 SpnConversionMethod5 1706;
BA_ "SPN" SG_ 2566741758 SpnConversionMethod4 1706;
BA_ "SPN" SG_ 2566741758 SpnConversionMethod3 1706;
BA_ "SPN" SG_ 2566741758 SpnConversionMethod2 1706;
BA_ "SPN" SG_ 2566741758 OccurenceCount5 1216;
BA_ "SPN" SG_ 2566741758 OccurenceCount4 1216;
BA_ "SPN" SG_ 2566741758 OccurenceCount3 1216;
BA_ "SPN" SG_ 2566741758 OccurenceCount2 1216;
BA_ "SPN" SG_ 2566741758 OccurenceCount1 1216;
BA_ "SPN" SG_ 2566741758 FMI5 4149;
BA_ "SPN" SG_ 2566741758 FMI4 4149;
BA_ "SPN" SG_ 2566741758 FMI3 4149;
BA_ "SPN" SG_ 2566741758 FMI2 4149;
BA_ "SPN" SG_ 2566741758 FMI1 4149;
BA_ "SigType" SG_ 2566741758 FlashRedStopLamp 5;
BA_ "SPN" SG_ 2566741758 FlashRedStopLamp 3039;
BA_ "SigType" SG_ 2566741758 FlashProtectLamp 5;
BA_ "SPN" SG_ 2566741758 FlashProtectLamp 3041;
BA_ "SigType" SG_ 2566741758 FlashMalfuncIndicatorLamp 5;
BA_ "SPN" SG_ 2566741758 FlashMalfuncIndicatorLamp 3038;
BA_ "SigType" SG_ 2566741758 FlashAmberWarningLamp 5;
BA_ "SPN" SG_ 2566741758 FlashAmberWarningLamp 3040;
BA_ "SigType" SG_ 2566741758 MalfunctionIndLampStatus 5;
BA_ "SPN" SG_ 2566741758 MalfunctionIndLampStatus 1213;
BA_ "SigType" SG_ 2566741758 AmberWarningLampStatus 5;
BA_ "SPN" SG_ 2566741758 AmberWarningLampStatus 624;
BA_ "SigType" SG_ 2566741758 RedStopLampState 4;
BA_ "SPN" SG_ 2566741758 RedStopLampState 623;
BA_ "SigType" SG_ 2566741758 ProtectLampStatus 5;
BA_ "SPN" SG_ 2566741758 ProtectLampStatus 987;
BA_ "SigType" SG_ 2566741758 SPN5 13;
BA_ "SigType" SG_ 2566741758 SPN4 13;
BA_ "SigType" SG_ 2566741758 SPN3 13;
BA_ "SigType" SG_ 2566741758 SPN2 13;
BA_ "SigType" SG_ 2566741758 SPN1 13;
VAL_ 2566705918 FMI5 24 "Assurance Data Error" 23 "Request DM60 for more info" 22 "Special Instructions #2 " 21 "Data drifted low" 20 "Data drifted high" 31 "Condition exists" 19 "Received network data in error" 18 "Below normal (moderately severe)" 17 "Below normal (least severe)" 16 "Above normal (moderately severe)" 15 "Above normal (least severe)" 14 "Special intstructions" 13 "Out of calibration" 12 "Bad intelligent device" 11 "Root cause not known" 10 "Abnormal rate of change" 9 "Abnormal update rate" 8 "Abnormal frequency" 7 "Mechanical system not responding" 6 "Current above normal" 5 "Current below normal" 4 "Voltage below normal" 3 "Voltage above normal" 2 "Data erratic" 1 "Below normal (most severe)" 0 "Above normal (most severe)" ;
VAL_ 2566705918 FMI4 24 "Assurance Data Error" 23 "Request DM60 for more info" 22 "Special Instructions #2 " 21 "Data drifted low" 20 "Data drifted high" 31 "Condition exists" 19 "Received network data in error" 18 "Below normal (moderately severe)" 17 "Below normal (least severe)" 16 "Above normal (moderately severe)" 15 "Above normal (least severe)" 14 "Special intstructions" 13 "Out of calibration" 12 "Bad intelligent device" 11 "Root cause not known" 10 "Abnormal rate of change" 9 "Abnormal update rate" 8 "Abnormal frequency" 7 "Mechanical system not responding" 6 "Current above normal" 5 "Current below normal" 4 "Voltage below normal" 3 "Voltage above normal" 2 "Data erratic" 1 "Below normal (most severe)" 0 "Above normal (most severe)" ;
VAL_ 2566705918 FMI3 24 "Assurance Data Error" 23 "Request DM60 for more info" 22 "Special Instructions #2 " 21 "Data drifted low" 20 "Data drifted high" 31 "Condition exists" 19 "Received network data in error" 18 "Below normal (moderately severe)" 17 "Below normal (least severe)" 16 "Above normal (moderately severe)" 15 "Above normal (least severe)" 14 "Special intstructions" 13 "Out of calibration" 12 "Bad intelligent device" 11 "Root cause not known" 10 "Abnormal rate of change" 9 "Abnormal update rate" 8 "Abnormal frequency" 7 "Mechanical system not responding" 6 "Current above normal" 5 "Current below normal" 4 "Voltage below normal" 3 "Voltage above normal" 2 "Data erratic" 1 "Below normal (most severe)" 0 "Above normal (most severe)" ;
VAL_ 2566705918 FMI2 24 "Assurance Data Error" 23 "Request DM60 for more info" 22 "Special Instructions #2 " 21 "Data drifted low" 20 "Data drifted high" 31 "Condition exists" 19 "Received network data in error" 18 "Below normal (moderately severe)" 17 "Below normal (least severe)" 16 "Above normal (moderately severe)" 15 "Above normal (least severe)" 14 "Special intstructions" 13 "Out of calibration" 12 "Bad intelligent device" 11 "Root cause not known" 10 "Abnormal rate of change" 9 "Abnormal update rate" 8 "Abnormal frequency" 7 "Mechanical system not responding" 6 "Current above normal" 5 "Current below normal" 4 "Voltage below normal" 3 "Voltage above normal" 2 "Data erratic" 1 "Below normal (most severe)" 0 "Above normal (most severe)" ;
VAL_ 2566705918 FMI1 24 "Assurance Data Error" 23 "Request DM60 for more info" 22 "Special Instructions #2 " 21 "Data drifted low" 20 "Data drifted high" 31 "Condition exists" 19 "Received network data in error" 18 "Below normal (moderately severe)" 17 "Below normal (least severe)" 16 "Above normal (moderately severe)" 15 "Above normal (least severe)" 14 "Special intstructions" 13 "Out of calibration" 12 "Bad intelligent device" 11 "Root cause not known" 10 "Abnormal rate of change" 9 "Abnormal update rate" 8 "Abnormal frequency" 7 "Mechanical system not responding" 6 "Current above normal" 5 "Current below normal" 4 "Voltage below normal" 3 "Voltage above normal" 2 "Data erratic" 1 "Below normal (most severe)" 0 "Above normal (most severe)" ;
VAL_ 2566705918 FlashRedStopLamp 3 "Unavailable / Do Not Flash" 2 "Reserved" 1 "Fast Flash" 0 "Slow Flash" ;
VAL_ 2566705918 FlashProtectLamp 3 "Unavailable / Do Not Flash" 2 "Reserved" 1 "Fast Flash" 0 "Slow Flash" ;
VAL_ 2566705918 FlashMalfuncIndicatorLamp 3 "Unavailable / Do Not Flash" 2 "Class C DTC  " 1 "Fast Flash" 0 "Slow Flash" ;
VAL_ 2566705918 FlashAmberWarningLamp 3 "Unavailable / Do Not Flash" 2 "Reserved" 1 "Fast Flash" 0 "Slow Flash" ;
VAL_ 2566705918 MalfunctionIndLampStatus 3 "Not available" 2 "Short MIL for WWH OBD" 1 "Lamp On" 0 "Lamp Off" ;
VAL_ 2566705918 AmberWarningLampStatus 3 "Not available" 2 "Reserved" 1 "Lamp On" 0 "Lamp Off" ;
VAL_ 2566705918 RedStopLampState 3 "Not available" 2 "Reserved" 1 "Lamp On" 0 "Lamp Off" ;
VAL_ 2566705918 ProtectLampStatus 0 "Lamp Off" 3 "Not available" 2 "Reserved" 1 "Lamp On" ;
VAL_ 2566705662 FMI5 24 "Assurance Data Error" 23 "Request DM60 for more info" 22 "Special Instructions #2 " 21 "Data drifted low" 20 "Data drifted high" 31 "Condition exists" 19 "Received network data in error" 18 "Below normal (moderately severe)" 17 "Below normal (least severe)" 16 "Above normal (moderately severe)" 15 "Above normal (least severe)" 14 "Special intstructions" 13 "Out of calibration" 12 "Bad intelligent device" 11 "Root cause not known" 10 "Abnormal rate of change" 9 "Abnormal update rate" 8 "Abnormal frequency" 7 "Mechanical system not responding" 6 "Current above normal" 5 "Current below normal" 4 "Voltage below normal" 3 "Voltage above normal" 2 "Data erratic" 1 "Below normal (most severe)" 0 "Above normal (most severe)" ;
VAL_ 2566705662 FMI4 24 "Assurance Data Error" 23 "Request DM60 for more info" 22 "Special Instructions #2 " 21 "Data drifted low" 20 "Data drifted high" 31 "Condition exists" 19 "Received network data in error" 18 "Below normal (moderately severe)" 17 "Below normal (least severe)" 16 "Above normal (moderately severe)" 15 "Above normal (least severe)" 14 "Special intstructions" 13 "Out of calibration" 12 "Bad intelligent device" 11 "Root cause not known" 10 "Abnormal rate of change" 9 "Abnormal update rate" 8 "Abnormal frequency" 7 "Mechanical system not responding" 6 "Current above normal" 5 "Current below normal" 4 "Voltage below normal" 3 "Voltage above normal" 2 "Data erratic" 1 "Below normal (most severe)" 0 "Above normal (most severe)" ;
VAL_ 2566705662 FMI3 24 "Assurance Data Error" 23 "Request DM60 for more info" 22 "Special Instructions #2 " 21 "Data drifted low" 20 "Data drifted high" 31 "Condition exists" 19 "Received network data in error" 18 "Below normal (moderately severe)" 17 "Below normal (least severe)" 16 "Above normal (moderately severe)" 15 "Above normal (least severe)" 14 "Special intstructions" 13 "Out of calibration" 12 "Bad intelligent device" 11 "Root cause not known" 10 "Abnormal rate of change" 9 "Abnormal update rate" 8 "Abnormal frequency" 7 "Mechanical system not responding" 6 "Current above normal" 5 "Current below normal" 4 "Voltage below normal" 3 "Voltage above normal" 2 "Data erratic" 1 "Below normal (most severe)" 0 "Above normal (most severe)" ;
VAL_ 2566705662 FMI2 24 "Assurance Data Error" 23 "Request DM60 for more info" 22 "Special Instructions #2 " 21 "Data drifted low" 20 "Data drifted high" 31 "Condition exists" 19 "Received network data in error" 18 "Below normal (moderately severe)" 17 "Below normal (least severe)" 16 "Above normal (moderately severe)" 15 "Above normal (least severe)" 14 "Special intstructions" 13 "Out of calibration" 12 "Bad intelligent device" 11 "Root cause not known" 10 "Abnormal rate of change" 9 "Abnormal update rate" 8 "Abnormal frequency" 7 "Mechanical system not responding" 6 "Current above normal" 5 "Current below normal" 4 "Voltage below normal" 3 "Voltage above normal" 2 "Data erratic" 1 "Below normal (most severe)" 0 "Above normal (most severe)" ;
VAL_ 2566705662 FMI1 24 "Assurance Data Error" 23 "Request DM60 for more info" 22 "Special Instructions #2 " 21 "Data drifted low" 20 "Data drifted high" 31 "Condition exists" 19 "Received network data in error" 18 "Below normal (moderately severe)" 17 "Below normal (least severe)" 16 "Above normal (moderately severe)" 15 "Above normal (least severe)" 14 "Special intstructions" 13 "Out of calibration" 12 "Bad intelligent device" 11 "Root cause not known" 10 "Abnormal rate of change" 9 "Abnormal update rate" 8 "Abnormal frequency" 7 "Mechanical system not responding" 6 "Current above normal" 5 "Current below normal" 4 "Voltage below normal" 3 "Voltage above normal" 2 "Data erratic" 1 "Below normal (most severe)" 0 "Above normal (most severe)" ;
VAL_ 2566705662 FlashRedStopLamp 3 "Unavailable / Do Not Flash" 2 "Reserved" 1 "Fast Flash" 0 "Slow Flash" ;
VAL_ 2566705662 FlashProtectLamp 3 "Unavailable / Do Not Flash" 2 "Reserved" 1 "Fast Flash" 0 "Slow Flash" ;
VAL_ 2566705662 FlashMalfuncIndicatorLamp 3 "Unavailable / Do Not Flash" 2 "Class C DTC  " 1 "Fast Flash" 0 "Slow Flash" ;
VAL_ 2566705662 FlashAmberWarningLamp 3 "Unavailable / Do Not Flash" 2 "Reserved" 1 "Fast Flash" 0 "Slow Flash" ;
VAL_ 2566705662 MalfunctionIndLampStatus 3 "Not available" 2 "Short MIL for WWH OBD" 1 "Lamp On" 0 "Lamp Off" ;
VAL_ 2566705662 AmberWarningLampStatus 3 "Not available" 2 "Reserved" 1 "Lamp On" 0 "Lamp Off" ;
VAL_ 2566705662 RedStopLampState 3 "Not available" 2 "Reserved" 1 "Lamp On" 0 "Lamp Off" ;
VAL_ 2566705662 ProtectLampStatus 0 "Lamp Off" 3 "Not available" 2 "Reserved" 1 "Lamp On" ;
VAL_ 2566739198 FMI5 24 "Assurance Data Error" 23 "Request DM60 for more info" 22 "Special Instructions #2 " 21 "Data drifted low" 20 "Data drifted high" 31 "Condition exists" 19 "Received network data in error" 18 "Below normal (moderately severe)" 17 "Below normal (least severe)" 16 "Above normal (moderately severe)" 15 "Above normal (least severe)" 14 "Special intstructions" 13 "Out of calibration" 12 "Bad intelligent device" 11 "Root cause not known" 10 "Abnormal rate of change" 9 "Abnormal update rate" 8 "Abnormal frequency" 7 "Mechanical system not responding" 6 "Current above normal" 5 "Current below normal" 4 "Voltage below normal" 3 "Voltage above normal" 2 "Data erratic" 1 "Below normal (most severe)" 0 "Above normal (most severe)" ;
VAL_ 2566739198 FMI4 24 "Assurance Data Error" 23 "Request DM60 for more info" 22 "Special Instructions #2 " 21 "Data drifted low" 20 "Data drifted high" 31 "Condition exists" 19 "Received network data in error" 18 "Below normal (moderately severe)" 17 "Below normal (least severe)" 16 "Above normal (moderately severe)" 15 "Above normal (least severe)" 14 "Special intstructions" 13 "Out of calibration" 12 "Bad intelligent device" 11 "Root cause not known" 10 "Abnormal rate of change" 9 "Abnormal update rate" 8 "Abnormal frequency" 7 "Mechanical system not responding" 6 "Current above normal" 5 "Current below normal" 4 "Voltage below normal" 3 "Voltage above normal" 2 "Data erratic" 1 "Below normal (most severe)" 0 "Above normal (most severe)" ;
VAL_ 2566739198 FMI3 24 "Assurance Data Error" 23 "Request DM60 for more info" 22 "Special Instructions #2 " 21 "Data drifted low" 20 "Data drifted high" 31 "Condition exists" 19 "Received network data in error" 18 "Below normal (moderately severe)" 17 "Below normal (least severe)" 16 "Above normal (moderately severe)" 15 "Above normal (least severe)" 14 "Special intstructions" 13 "Out of calibration" 12 "Bad intelligent device" 11 "Root cause not known" 10 "Abnormal rate of change" 9 "Abnormal update rate" 8 "Abnormal frequency" 7 "Mechanical system not responding" 6 "Current above normal" 5 "Current below normal" 4 "Voltage below normal" 3 "Voltage above normal" 2 "Data erratic" 1 "Below normal (most severe)" 0 "Above normal (most severe)" ;
VAL_ 2566739198 FMI2 24 "Assurance Data Error" 23 "Request DM60 for more info" 22 "Special Instructions #2 " 21 "Data drifted low" 20 "Data drifted high" 31 "Condition exists" 19 "Received network data in error" 18 "Below normal (moderately severe)" 17 "Below normal (least severe)" 16 "Above normal (moderately severe)" 15 "Above normal (least severe)" 14 "Special intstructions" 13 "Out of calibration" 12 "Bad intelligent device" 11 "Root cause not known" 10 "Abnormal rate of change" 9 "Abnormal update rate" 8 "Abnormal frequency" 7 "Mechanical system not responding" 6 "Current above normal" 5 "Current below normal" 4 "Voltage below normal" 3 "Voltage above normal" 2 "Data erratic" 1 "Below normal (most severe)" 0 "Above normal (most severe)" ;
VAL_ 2566739198 FMI1 24 "Assurance Data Error" 23 "Request DM60 for more info" 22 "Special Instructions #2 " 21 "Data drifted low" 20 "Data drifted high" 31 "Condition exists" 19 "Received network data in error" 18 "Below normal (moderately severe)" 17 "Below normal (least severe)" 16 "Above normal (moderately severe)" 15 "Above normal (least severe)" 14 "Special intstructions" 13 "Out of calibration" 12 "Bad intelligent device" 11 "Root cause not known" 10 "Abnormal rate of change" 9 "Abnormal update rate" 8 "Abnormal frequency" 7 "Mechanical system not responding" 6 "Current above normal" 5 "Current below normal" 4 "Voltage below normal" 3 "Voltage above normal" 2 "Data erratic" 1 "Below normal (most severe)" 0 "Above normal (most severe)" ;
VAL_ 2566739198 FlashRedStopLamp 3 "Unavailable / Do Not Flash" 2 "Reserved" 1 "Fast Flash" 0 "Slow Flash" ;
VAL_ 2566739198 FlashProtectLamp 3 "Unavailable / Do Not Flash" 2 "Reserved" 1 "Fast Flash" 0 "Slow Flash" ;
VAL_ 2566739198 FlashMalfuncIndicatorLamp 3 "Unavailable / Do Not Flash" 2 "Class C DTC  " 1 "Fast Flash" 0 "Slow Flash" ;
VAL_ 2566739198 FlashAmberWarningLamp 3 "Unavailable / Do Not Flash" 2 "Reserved" 1 "Fast Flash" 0 "Slow Flash" ;
VAL_ 2566739198 MalfunctionIndLampStatus 3 "Not available" 2 "Short MIL for WWH OBD" 1 "Lamp On" 0 "Lamp Off" ;
VAL_ 2566739198 AmberWarningLampStatus 3 "Not available" 2 "Reserved" 1 "Lamp On" 0 "Lamp Off" ;
VAL_ 2566739198 RedStopLampState 3 "Not available" 2 "Reserved" 1 "Lamp On" 0 "Lamp Off" ;
VAL_ 2566739198 ProtectLampStatus 0 "Lamp Off" 3 "Not available" 2 "Reserved" 1 "Lamp On" ;
VAL_ 2566739454 FMI5 24 "Assurance Data Error" 23 "Request DM60 for more info" 22 "Special Instructions #2 " 21 "Data drifted low" 20 "Data drifted high" 31 "Condition exists" 19 "Received network data in error" 18 "Below normal (moderately severe)" 17 "Below normal (least severe)" 16 "Above normal (moderately severe)" 15 "Above normal (least severe)" 14 "Special intstructions" 13 "Out of calibration" 12 "Bad intelligent device" 11 "Root cause not known" 10 "Abnormal rate of change" 9 "Abnormal update rate" 8 "Abnormal frequency" 7 "Mechanical system not responding" 6 "Current above normal" 5 "Current below normal" 4 "Voltage below normal" 3 "Voltage above normal" 2 "Data erratic" 1 "Below normal (most severe)" 0 "Above normal (most severe)" ;
VAL_ 2566739454 FMI4 24 "Assurance Data Error" 23 "Request DM60 for more info" 22 "Special Instructions #2 " 21 "Data drifted low" 20 "Data drifted high" 31 "Condition exists" 19 "Received network data in error" 18 "Below normal (moderately severe)" 17 "Below normal (least severe)" 16 "Above normal (moderately severe)" 15 "Above normal (least severe)" 14 "Special intstructions" 13 "Out of calibration" 12 "Bad intelligent device" 11 "Root cause not known" 10 "Abnormal rate of change" 9 "Abnormal update rate" 8 "Abnormal frequency" 7 "Mechanical system not responding" 6 "Current above normal" 5 "Current below normal" 4 "Voltage below normal" 3 "Voltage above normal" 2 "Data erratic" 1 "Below normal (most severe)" 0 "Above normal (most severe)" ;
VAL_ 2566739454 FMI3 24 "Assurance Data Error" 23 "Request DM60 for more info" 22 "Special Instructions #2 " 21 "Data drifted low" 20 "Data drifted high" 31 "Condition exists" 19 "Received network data in error" 18 "Below normal (moderately severe)" 17 "Below normal (least severe)" 16 "Above normal (moderately severe)" 15 "Above normal (least severe)" 14 "Special intstructions" 13 "Out of calibration" 12 "Bad intelligent device" 11 "Root cause not known" 10 "Abnormal rate of change" 9 "Abnormal update rate" 8 "Abnormal frequency" 7 "Mechanical system not responding" 6 "Current above normal" 5 "Current below normal" 4 "Voltage below normal" 3 "Voltage above normal" 2 "Data erratic" 1 "Below normal (most severe)" 0 "Above normal (most severe)" ;
VAL_ 2566739454 FMI2 24 "Assurance Data Error" 23 "Request DM60 for more info" 22 "Special Instructions #2 " 21 "Data drifted low" 20 "Data drifted high" 31 "Condition exists" 19 "Received network data in error" 18 "Below normal (moderately severe)" 17 "Below normal (least severe)" 16 "Above normal (moderately severe)" 15 "Above normal (least severe)" 14 "Special intstructions" 13 "Out of calibration" 12 "Bad intelligent device" 11 "Root cause not known" 10 "Abnormal rate of change" 9 "Abnormal update rate" 8 "Abnormal frequency" 7 "Mechanical system not responding" 6 "Current above normal" 5 "Current below normal" 4 "Voltage below normal" 3 "Voltage above normal" 2 "Data erratic" 1 "Below normal (most severe)" 0 "Above normal (most severe)" ;
VAL_ 2566739454 FMI1 24 "Assurance Data Error" 23 "Request DM60 for more info" 22 "Special Instructions #2 " 21 "Data drifted low" 20 "Data drifted high" 31 "Condition exists" 19 "Received network data in error" 18 "Below normal (moderately severe)" 17 "Below normal (least severe)" 16 "Above normal (moderately severe)" 15 "Above normal (least severe)" 14 "Special intstructions" 13 "Out of calibration" 12 "Bad intelligent device" 11 "Root cause not known" 10 "Abnormal rate of change" 9 "Abnormal update rate" 8 "Abnormal frequency" 7 "Mechanical system not responding" 6 "Current above normal" 5 "Current below normal" 4 "Voltage below normal" 3 "Voltage above normal" 2 "Data erratic" 1 "Below normal (most severe)" 0 "Above normal (most severe)" ;
VAL_ 2566739454 FlashRedStopLamp 3 "Unavailable / Do Not Flash" 2 "Reserved" 1 "Fast Flash" 0 "Slow Flash" ;
VAL_ 2566739454 FlashProtectLamp 3 "Unavailable / Do Not Flash" 2 "Reserved" 1 "Fast Flash" 0 "Slow Flash" ;
VAL_ 2566739454 FlashMalfuncIndicatorLamp 3 "Unavailable / Do Not Flash" 2 "Class C DTC  " 1 "Fast Flash" 0 "Slow Flash" ;
VAL_ 2566739454 FlashAmberWarningLamp 3 "Unavailable / Do Not Flash" 2 "Reserved" 1 "Fast Flash" 0 "Slow Flash" ;
VAL_ 2566739454 MalfunctionIndLampStatus 3 "Not available" 2 "Short MIL for WWH OBD" 1 "Lamp On" 0 "Lamp Off" ;
VAL_ 2566739454 AmberWarningLampStatus 3 "Not available" 2 "Reserved" 1 "Lamp On" 0 "Lamp Off" ;
VAL_ 2566739454 RedStopLampState 3 "Not available" 2 "Reserved" 1 "Lamp On" 0 "Lamp Off" ;
VAL_ 2566739454 ProtectLampStatus 0 "Lamp Off" 3 "Not available" 2 "Reserved" 1 "Lamp On" ;
VAL_ 2566739710 FMI5 24 "Assurance Data Error" 23 "Request DM60 for more info" 22 "Special Instructions #2 " 21 "Data drifted low" 20 "Data drifted high" 31 "Condition exists" 19 "Received network data in error" 18 "Below normal (moderately severe)" 17 "Below normal (least severe)" 16 "Above normal (moderately severe)" 15 "Above normal (least severe)" 14 "Special intstructions" 13 "Out of calibration" 12 "Bad intelligent device" 11 "Root cause not known" 10 "Abnormal rate of change" 9 "Abnormal update rate" 8 "Abnormal frequency" 7 "Mechanical system not responding" 6 "Current above normal" 5 "Current below normal" 4 "Voltage below normal" 3 "Voltage above normal" 2 "Data erratic" 1 "Below normal (most severe)" 0 "Above normal (most severe)" ;
VAL_ 2566739710 FMI4 24 "Assurance Data Error" 23 "Request DM60 for more info" 22 "Special Instructions #2 " 21 "Data drifted low" 20 "Data drifted high" 31 "Condition exists" 19 "Received network data in error" 18 "Below normal (moderately severe)" 17 "Below normal (least severe)" 16 "Above normal (moderately severe)" 15 "Above normal (least severe)" 14 "Special intstructions" 13 "Out of calibration" 12 "Bad intelligent device" 11 "Root cause not known" 10 "Abnormal rate of change" 9 "Abnormal update rate" 8 "Abnormal frequency" 7 "Mechanical system not responding" 6 "Current above normal" 5 "Current below normal" 4 "Voltage below normal" 3 "Voltage above normal" 2 "Data erratic" 1 "Below normal (most severe)" 0 "Above normal (most severe)" ;
VAL_ 2566739710 FMI3 24 "Assurance Data Error" 23 "Request DM60 for more info" 22 "Special Instructions #2 " 21 "Data drifted low" 20 "Data drifted high" 31 "Condition exists" 19 "Received network data in error" 18 "Below normal (moderately severe)" 17 "Below normal (least severe)" 16 "Above normal (moderately severe)" 15 "Above normal (least severe)" 14 "Special intstructions" 13 "Out of calibration" 12 "Bad intelligent device" 11 "Root cause not known" 10 "Abnormal rate of change" 9 "Abnormal update rate" 8 "Abnormal frequency" 7 "Mechanical system not responding" 6 "Current above normal" 5 "Current below normal" 4 "Voltage below normal" 3 "Voltage above normal" 2 "Data erratic" 1 "Below normal (most severe)" 0 "Above normal (most severe)" ;
VAL_ 2566739710 FMI2 24 "Assurance Data Error" 23 "Request DM60 for more info" 22 "Special Instructions #2 " 21 "Data drifted low" 20 "Data drifted high" 31 "Condition exists" 19 "Received network data in error" 18 "Below normal (moderately severe)" 17 "Below normal (least severe)" 16 "Above normal (moderately severe)" 15 "Above normal (least severe)" 14 "Special intstructions" 13 "Out of calibration" 12 "Bad intelligent device" 11 "Root cause not known" 10 "Abnormal rate of change" 9 "Abnormal update rate" 8 "Abnormal frequency" 7 "Mechanical system not responding" 6 "Current above normal" 5 "Current below normal" 4 "Voltage below normal" 3 "Voltage above normal" 2 "Data erratic" 1 "Below normal (most severe)" 0 "Above normal (most severe)" ;
VAL_ 2566739710 FMI1 24 "Assurance Data Error" 23 "Request DM60 for more info" 22 "Special Instructions #2 " 21 "Data drifted low" 20 "Data drifted high" 31 "Condition exists" 19 "Received network data in error" 18 "Below normal (moderately severe)" 17 "Below normal (least severe)" 16 "Above normal (moderately severe)" 15 "Above normal (least severe)" 14 "Special intstructions" 13 "Out of calibration" 12 "Bad intelligent device" 11 "Root cause not known" 10 "Abnormal rate of change" 9 "Abnormal update rate" 8 "Abnormal frequency" 7 "Mechanical system not responding" 6 "Current above normal" 5 "Current below normal" 4 "Voltage below normal" 3 "Voltage above normal" 2 "Data erratic" 1 "Below normal (most severe)" 0 "Above normal (most severe)" ;
VAL_ 2566739710 FlashRedStopLamp 3 "Unavailable / Do Not Flash" 2 "Reserved" 1 "Fast Flash" 0 "Slow Flash" ;
VAL_ 2566739710 FlashProtectLamp 3 "Unavailable / Do Not Flash" 2 "Reserved" 1 "Fast Flash" 0 "Slow Flash" ;
VAL_ 2566739710 FlashMalfuncIndicatorLamp 3 "Unavailable / Do Not Flash" 2 "Class C DTC  " 1 "Fast Flash" 0 "Slow Flash" ;
VAL_ 2566739710 FlashAmberWarningLamp 3 "Unavailable / Do Not Flash" 2 "Reserved" 1 "Fast Flash" 0 "Slow Flash" ;
VAL_ 2566739710 MalfunctionIndLampStatus 3 "Not available" 2 "Short MIL for WWH OBD" 1 "Lamp On" 0 "Lamp Off" ;
VAL_ 2566739710 AmberWarningLampStatus 3 "Not available" 2 "Reserved" 1 "Lamp On" 0 "Lamp Off" ;
VAL_ 2566739710 RedStopLampState 3 "Not available" 2 "Reserved" 1 "Lamp On" 0 "Lamp Off" ;
VAL_ 2566739710 ProtectLampStatus 0 "Lamp Off" 3 "Not available" 2 "Reserved" 1 "Lamp On" ;
VAL_ 2566739966 FMI5 24 "Assurance Data Error" 23 "Request DM60 for more info" 22 "Special Instructions #2 " 21 "Data drifted low" 20 "Data drifted high" 31 "Condition exists" 19 "Received network data in error" 18 "Below normal (moderately severe)" 17 "Below normal (least severe)" 16 "Above normal (moderately severe)" 15 "Above normal (least severe)" 14 "Special intstructions" 13 "Out of calibration" 12 "Bad intelligent device" 11 "Root cause not known" 10 "Abnormal rate of change" 9 "Abnormal update rate" 8 "Abnormal frequency" 7 "Mechanical system not responding" 6 "Current above normal" 5 "Current below normal" 4 "Voltage below normal" 3 "Voltage above normal" 2 "Data erratic" 1 "Below normal (most severe)" 0 "Above normal (most severe)" ;
VAL_ 2566739966 FMI4 24 "Assurance Data Error" 23 "Request DM60 for more info" 22 "Special Instructions #2 " 21 "Data drifted low" 20 "Data drifted high" 31 "Condition exists" 19 "Received network data in error" 18 "Below normal (moderately severe)" 17 "Below normal (least severe)" 16 "Above normal (moderately severe)" 15 "Above normal (least severe)" 14 "Special intstructions" 13 "Out of calibration" 12 "Bad intelligent device" 11 "Root cause not known" 10 "Abnormal rate of change" 9 "Abnormal update rate" 8 "Abnormal frequency" 7 "Mechanical system not responding" 6 "Current above normal" 5 "Current below normal" 4 "Voltage below normal" 3 "Voltage above normal" 2 "Data erratic" 1 "Below normal (most severe)" 0 "Above normal (most severe)" ;
VAL_ 2566739966 FMI3 24 "Assurance Data Error" 23 "Request DM60 for more info" 22 "Special Instructions #2 " 21 "Data drifted low" 20 "Data drifted high" 31 "Condition exists" 19 "Received network data in error" 18 "Below normal (moderately severe)" 17 "Below normal (least severe)" 16 "Above normal (moderately severe)" 15 "Above normal (least severe)" 14 "Special intstructions" 13 "Out of calibration" 12 "Bad intelligent device" 11 "Root cause not known" 10 "Abnormal rate of change" 9 "Abnormal update rate" 8 "Abnormal frequency" 7 "Mechanical system not responding" 6 "Current above normal" 5 "Current below normal" 4 "Voltage below normal" 3 "Voltage above normal" 2 "Data erratic" 1 "Below normal (most severe)" 0 "Above normal (most severe)" ;
VAL_ 2566739966 FMI2 24 "Assurance Data Error" 23 "Request DM60 for more info" 22 "Special Instructions #2 " 21 "Data drifted low" 20 "Data drifted high" 31 "Condition exists" 19 "Received network data in error" 18 "Below normal (moderately severe)" 17 "Below normal (least severe)" 16 "Above normal (moderately severe)" 15 "Above normal (least severe)" 14 "Special intstructions" 13 "Out of calibration" 12 "Bad intelligent device" 11 "Root cause not known" 10 "Abnormal rate of change" 9 "Abnormal update rate" 8 "Abnormal frequency" 7 "Mechanical system not responding" 6 "Current above normal" 5 "Current below normal" 4 "Voltage below normal" 3 "Voltage above normal" 2 "Data erratic" 1 "Below normal (most severe)" 0 "Above normal (most severe)" ;
VAL_ 2566739966 FMI1 24 "Assurance Data Error" 23 "Request DM60 for more info" 22 "Special Instructions #2 " 21 "Data drifted low" 20 "Data drifted high" 31 "Condition exists" 19 "Received network data in error" 18 "Below normal (moderately severe)" 17 "Below normal (least severe)" 16 "Above normal (moderately severe)" 15 "Above normal (least severe)" 14 "Special intstructions" 13 "Out of calibration" 12 "Bad intelligent device" 11 "Root cause not known" 10 "Abnormal rate of change" 9 "Abnormal update rate" 8 "Abnormal frequency" 7 "Mechanical system not responding" 6 "Current above normal" 5 "Current below normal" 4 "Voltage below normal" 3 "Voltage above normal" 2 "Data erratic" 1 "Below normal (most severe)" 0 "Above normal (most severe)" ;
VAL_ 2566739966 FlashRedStopLamp 3 "Unavailable / Do Not Flash" 2 "Reserved" 1 "Fast Flash" 0 "Slow Flash" ;
VAL_ 2566739966 FlashProtectLamp 3 "Unavailable / Do Not Flash" 2 "Reserved" 1 "Fast Flash" 0 "Slow Flash" ;
VAL_ 2566739966 FlashMalfuncIndicatorLamp 3 "Unavailable / Do Not Flash" 2 "Class C DTC  " 1 "Fast Flash" 0 "Slow Flash" ;
VAL_ 2566739966 FlashAmberWarningLamp 3 "Unavailable / Do Not Flash" 2 "Reserved" 1 "Fast Flash" 0 "Slow Flash" ;
VAL_ 2566739966 MalfunctionIndLampStatus 3 "Not available" 2 "Short MIL for WWH OBD" 1 "Lamp On" 0 "Lamp Off" ;
VAL_ 2566739966 AmberWarningLampStatus 3 "Not available" 2 "Reserved" 1 "Lamp On" 0 "Lamp Off" ;
VAL_ 2566739966 RedStopLampState 3 "Not available" 2 "Reserved" 1 "Lamp On" 0 "Lamp Off" ;
VAL_ 2566739966 ProtectLampStatus 0 "Lamp Off" 3 "Not available" 2 "Reserved" 1 "Lamp On" ;
VAL_ 2566740222 FMI5 24 "Assurance Data Error" 23 "Request DM60 for more info" 22 "Special Instructions #2 " 21 "Data drifted low" 20 "Data drifted high" 31 "Condition exists" 19 "Received network data in error" 18 "Below normal (moderately severe)" 17 "Below normal (least severe)" 16 "Above normal (moderately severe)" 15 "Above normal (least severe)" 14 "Special intstructions" 13 "Out of calibration" 12 "Bad intelligent device" 11 "Root cause not known" 10 "Abnormal rate of change" 9 "Abnormal update rate" 8 "Abnormal frequency" 7 "Mechanical system not responding" 6 "Current above normal" 5 "Current below normal" 4 "Voltage below normal" 3 "Voltage above normal" 2 "Data erratic" 1 "Below normal (most severe)" 0 "Above normal (most severe)" ;
VAL_ 2566740222 FMI4 24 "Assurance Data Error" 23 "Request DM60 for more info" 22 "Special Instructions #2 " 21 "Data drifted low" 20 "Data drifted high" 31 "Condition exists" 19 "Received network data in error" 18 "Below normal (moderately severe)" 17 "Below normal (least severe)" 16 "Above normal (moderately severe)" 15 "Above normal (least severe)" 14 "Special intstructions" 13 "Out of calibration" 12 "Bad intelligent device" 11 "Root cause not known" 10 "Abnormal rate of change" 9 "Abnormal update rate" 8 "Abnormal frequency" 7 "Mechanical system not responding" 6 "Current above normal" 5 "Current below normal" 4 "Voltage below normal" 3 "Voltage above normal" 2 "Data erratic" 1 "Below normal (most severe)" 0 "Above normal (most severe)" ;
VAL_ 2566740222 FMI3 24 "Assurance Data Error" 23 "Request DM60 for more info" 22 "Special Instructions #2 " 21 "Data drifted low" 20 "Data drifted high" 31 "Condition exists" 19 "Received network data in error" 18 "Below normal (moderately severe)" 17 "Below normal (least severe)" 16 "Above normal (moderately severe)" 15 "Above normal (least severe)" 14 "Special intstructions" 13 "Out of calibration" 12 "Bad intelligent device" 11 "Root cause not known" 10 "Abnormal rate of change" 9 "Abnormal update rate" 8 "Abnormal frequency" 7 "Mechanical system not responding" 6 "Current above normal" 5 "Current below normal" 4 "Voltage below normal" 3 "Voltage above normal" 2 "Data erratic" 1 "Below normal (most severe)" 0 "Above normal (most severe)" ;
VAL_ 2566740222 FMI2 24 "Assurance Data Error" 23 "Request DM60 for more info" 22 "Special Instructions #2 " 21 "Data drifted low" 20 "Data drifted high" 31 "Condition exists" 19 "Received network data in error" 18 "Below normal (moderately severe)" 17 "Below normal (least severe)" 16 "Above normal (moderately severe)" 15 "Above normal (least severe)" 14 "Special intstructions" 13 "Out of calibration" 12 "Bad intelligent device" 11 "Root cause not known" 10 "Abnormal rate of change" 9 "Abnormal update rate" 8 "Abnormal frequency" 7 "Mechanical system not responding" 6 "Current above normal" 5 "Current below normal" 4 "Voltage below normal" 3 "Voltage above normal" 2 "Data erratic" 1 "Below normal (most severe)" 0 "Above normal (most severe)" ;
VAL_ 2566740222 FMI1 24 "Assurance Data Error" 23 "Request DM60 for more info" 22 "Special Instructions #2 " 21 "Data drifted low" 20 "Data drifted high" 31 "Condition exists" 19 "Received network data in error" 18 "Below normal (moderately severe)" 17 "Below normal (least severe)" 16 "Above normal (moderately severe)" 15 "Above normal (least severe)" 14 "Special intstructions" 13 "Out of calibration" 12 "Bad intelligent device" 11 "Root cause not known" 10 "Abnormal rate of change" 9 "Abnormal update rate" 8 "Abnormal frequency" 7 "Mechanical system not responding" 6 "Current above normal" 5 "Current below normal" 4 "Voltage below normal" 3 "Voltage above normal" 2 "Data erratic" 1 "Below normal (most severe)" 0 "Above normal (most severe)" ;
VAL_ 2566740222 FlashRedStopLamp 3 "Unavailable / Do Not Flash" 2 "Reserved" 1 "Fast Flash" 0 "Slow Flash" ;
VAL_ 2566740222 FlashProtectLamp 3 "Unavailable / Do Not Flash" 2 "Reserved" 1 "Fast Flash" 0 "Slow Flash" ;
VAL_ 2566740222 FlashMalfuncIndicatorLamp 3 "Unavailable / Do Not Flash" 2 "Class C DTC  " 1 "Fast Flash" 0 "Slow Flash" ;
VAL_ 2566740222 FlashAmberWarningLamp 3 "Unavailable / Do Not Flash" 2 "Reserved" 1 "Fast Flash" 0 "Slow Flash" ;
VAL_ 2566740222 MalfunctionIndLampStatus 3 "Not available" 2 "Short MIL for WWH OBD" 1 "Lamp On" 0 "Lamp Off" ;
VAL_ 2566740222 AmberWarningLampStatus 3 "Not available" 2 "Reserved" 1 "Lamp On" 0 "Lamp Off" ;
VAL_ 2566740222 RedStopLampState 3 "Not available" 2 "Reserved" 1 "Lamp On" 0 "Lamp Off" ;
VAL_ 2566740222 ProtectLampStatus 0 "Lamp Off" 3 "Not available" 2 "Reserved" 1 "Lamp On" ;
VAL_ 2566740478 FMI5 24 "Assurance Data Error" 23 "Request DM60 for more info" 22 "Special Instructions #2 " 21 "Data drifted low" 20 "Data drifted high" 31 "Condition exists" 19 "Received network data in error" 18 "Below normal (moderately severe)" 17 "Below normal (least severe)" 16 "Above normal (moderately severe)" 15 "Above normal (least severe)" 14 "Special intstructions" 13 "Out of calibration" 12 "Bad intelligent device" 11 "Root cause not known" 10 "Abnormal rate of change" 9 "Abnormal update rate" 8 "Abnormal frequency" 7 "Mechanical system not responding" 6 "Current above normal" 5 "Current below normal" 4 "Voltage below normal" 3 "Voltage above normal" 2 "Data erratic" 1 "Below normal (most severe)" 0 "Above normal (most severe)" ;
VAL_ 2566740478 FMI4 24 "Assurance Data Error" 23 "Request DM60 for more info" 22 "Special Instructions #2 " 21 "Data drifted low" 20 "Data drifted high" 31 "Condition exists" 19 "Received network data in error" 18 "Below normal (moderately severe)" 17 "Below normal (least severe)" 16 "Above normal (moderately severe)" 15 "Above normal (least severe)" 14 "Special intstructions" 13 "Out of calibration" 12 "Bad intelligent device" 11 "Root cause not known" 10 "Abnormal rate of change" 9 "Abnormal update rate" 8 "Abnormal frequency" 7 "Mechanical system not responding" 6 "Current above normal" 5 "Current below normal" 4 "Voltage below normal" 3 "Voltage above normal" 2 "Data erratic" 1 "Below normal (most severe)" 0 "Above normal (most severe)" ;
VAL_ 2566740478 FMI3 24 "Assurance Data Error" 23 "Request DM60 for more info" 22 "Special Instructions #2 " 21 "Data drifted low" 20 "Data drifted high" 31 "Condition exists" 19 "Received network data in error" 18 "Below normal (moderately severe)" 17 "Below normal (least severe)" 16 "Above normal (moderately severe)" 15 "Above normal (least severe)" 14 "Special intstructions" 13 "Out of calibration" 12 "Bad intelligent device" 11 "Root cause not known" 10 "Abnormal rate of change" 9 "Abnormal update rate" 8 "Abnormal frequency" 7 "Mechanical system not responding" 6 "Current above normal" 5 "Current below normal" 4 "Voltage below normal" 3 "Voltage above normal" 2 "Data erratic" 1 "Below normal (most severe)" 0 "Above normal (most severe)" ;
VAL_ 2566740478 FMI2 24 "Assurance Data Error" 23 "Request DM60 for more info" 22 "Special Instructions #2 " 21 "Data drifted low" 20 "Data drifted high" 31 "Condition exists" 19 "Received network data in error" 18 "Below normal (moderately severe)" 17 "Below normal (least severe)" 16 "Above normal (moderately severe)" 15 "Above normal (least severe)" 14 "Special intstructions" 13 "Out of calibration" 12 "Bad intelligent device" 11 "Root cause not known" 10 "Abnormal rate of change" 9 "Abnormal update rate" 8 "Abnormal frequency" 7 "Mechanical system not responding" 6 "Current above normal" 5 "Current below normal" 4 "Voltage below normal" 3 "Voltage above normal" 2 "Data erratic" 1 "Below normal (most severe)" 0 "Above normal (most severe)" ;
VAL_ 2566740478 FMI1 24 "Assurance Data Error" 23 "Request DM60 for more info" 22 "Special Instructions #2 " 21 "Data drifted low" 20 "Data drifted high" 31 "Condition exists" 19 "Received network data in error" 18 "Below normal (moderately severe)" 17 "Below normal (least severe)" 16 "Above normal (moderately severe)" 15 "Above normal (least severe)" 14 "Special intstructions" 13 "Out of calibration" 12 "Bad intelligent device" 11 "Root cause not known" 10 "Abnormal rate of change" 9 "Abnormal update rate" 8 "Abnormal frequency" 7 "Mechanical system not responding" 6 "Current above normal" 5 "Current below normal" 4 "Voltage below normal" 3 "Voltage above normal" 2 "Data erratic" 1 "Below normal (most severe)" 0 "Above normal (most severe)" ;
VAL_ 2566740478 FlashRedStopLamp 3 "Unavailable / Do Not Flash" 2 "Reserved" 1 "Fast Flash" 0 "Slow Flash" ;
VAL_ 2566740478 FlashProtectLamp 3 "Unavailable / Do Not Flash" 2 "Reserved" 1 "Fast Flash" 0 "Slow Flash" ;
VAL_ 2566740478 FlashMalfuncIndicatorLamp 3 "Unavailable / Do Not Flash" 2 "Class C DTC  " 1 "Fast Flash" 0 "Slow Flash" ;
VAL_ 2566740478 FlashAmberWarningLamp 3 "Unavailable / Do Not Flash" 2 "Reserved" 1 "Fast Flash" 0 "Slow Flash" ;
VAL_ 2566740478 MalfunctionIndLampStatus 3 "Not available" 2 "Short MIL for WWH OBD" 1 "Lamp On" 0 "Lamp Off" ;
VAL_ 2566740478 AmberWarningLampStatus 3 "Not available" 2 "Reserved" 1 "Lamp On" 0 "Lamp Off" ;
VAL_ 2566740478 RedStopLampState 3 "Not available" 2 "Reserved" 1 "Lamp On" 0 "Lamp Off" ;
VAL_ 2566740478 ProtectLampStatus 0 "Lamp Off" 3 "Not available" 2 "Reserved" 1 "Lamp On" ;
VAL_ 2566740734 FMI5 24 "Assurance Data Error" 23 "Request DM60 for more info" 22 "Special Instructions #2 " 21 "Data drifted low" 20 "Data drifted high" 31 "Condition exists" 19 "Received network data in error" 18 "Below normal (moderately severe)" 17 "Below normal (least severe)" 16 "Above normal (moderately severe)" 15 "Above normal (least severe)" 14 "Special intstructions" 13 "Out of calibration" 12 "Bad intelligent device" 11 "Root cause not known" 10 "Abnormal rate of change" 9 "Abnormal update rate" 8 "Abnormal frequency" 7 "Mechanical system not responding" 6 "Current above normal" 5 "Current below normal" 4 "Voltage below normal" 3 "Voltage above normal" 2 "Data erratic" 1 "Below normal (most severe)" 0 "Above normal (most severe)" ;
VAL_ 2566740734 FMI4 24 "Assurance Data Error" 23 "Request DM60 for more info" 22 "Special Instructions #2 " 21 "Data drifted low" 20 "Data drifted high" 31 "Condition exists" 19 "Received network data in error" 18 "Below normal (moderately severe)" 17 "Below normal (least severe)" 16 "Above normal (moderately severe)" 15 "Above normal (least severe)" 14 "Special intstructions" 13 "Out of calibration" 12 "Bad intelligent device" 11 "Root cause not known" 10 "Abnormal rate of change" 9 "Abnormal update rate" 8 "Abnormal frequency" 7 "Mechanical system not responding" 6 "Current above normal" 5 "Current below normal" 4 "Voltage below normal" 3 "Voltage above normal" 2 "Data erratic" 1 "Below normal (most severe)" 0 "Above normal (most severe)" ;
VAL_ 2566740734 FMI3 24 "Assurance Data Error" 23 "Request DM60 for more info" 22 "Special Instructions #2 " 21 "Data drifted low" 20 "Data drifted high" 31 "Condition exists" 19 "Received network data in error" 18 "Below normal (moderately severe)" 17 "Below normal (least severe)" 16 "Above normal (moderately severe)" 15 "Above normal (least severe)" 14 "Special intstructions" 13 "Out of calibration" 12 "Bad intelligent device" 11 "Root cause not known" 10 "Abnormal rate of change" 9 "Abnormal update rate" 8 "Abnormal frequency" 7 "Mechanical system not responding" 6 "Current above normal" 5 "Current below normal" 4 "Voltage below normal" 3 "Voltage above normal" 2 "Data erratic" 1 "Below normal (most severe)" 0 "Above normal (most severe)" ;
VAL_ 2566740734 FMI2 24 "Assurance Data Error" 23 "Request DM60 for more info" 22 "Special Instructions #2 " 21 "Data drifted low" 20 "Data drifted high" 31 "Condition exists" 19 "Received network data in error" 18 "Below normal (moderately severe)" 17 "Below normal (least severe)" 16 "Above normal (moderately severe)" 15 "Above normal (least severe)" 14 "Special intstructions" 13 "Out of calibration" 12 "Bad intelligent device" 11 "Root cause not known" 10 "Abnormal rate of change" 9 "Abnormal update rate" 8 "Abnormal frequency" 7 "Mechanical system not responding" 6 "Current above normal" 5 "Current below normal" 4 "Voltage below normal" 3 "Voltage above normal" 2 "Data erratic" 1 "Below normal (most severe)" 0 "Above normal (most severe)" ;
VAL_ 2566740734 FMI1 24 "Assurance Data Error" 23 "Request DM60 for more info" 22 "Special Instructions #2 " 21 "Data drifted low" 20 "Data drifted high" 31 "Condition exists" 19 "Received network data in error" 18 "Below normal (moderately severe)" 17 "Below normal (least severe)" 16 "Above normal (moderately severe)" 15 "Above normal (least severe)" 14 "Special intstructions" 13 "Out of calibration" 12 "Bad intelligent device" 11 "Root cause not known" 10 "Abnormal rate of change" 9 "Abnormal update rate" 8 "Abnormal frequency" 7 "Mechanical system not responding" 6 "Current above normal" 5 "Current below normal" 4 "Voltage below normal" 3 "Voltage above normal" 2 "Data erratic" 1 "Below normal (most severe)" 0 "Above normal (most severe)" ;
VAL_ 2566740734 FlashRedStopLamp 3 "Unavailable / Do Not Flash" 2 "Reserved" 1 "Fast Flash" 0 "Slow Flash" ;
VAL_ 2566740734 FlashProtectLamp 3 "Unavailable / Do Not Flash" 2 "Reserved" 1 "Fast Flash" 0 "Slow Flash" ;
VAL_ 2566740734 FlashMalfuncIndicatorLamp 3 "Unavailable / Do Not Flash" 2 "Class C DTC  " 1 "Fast Flash" 0 "Slow Flash" ;
VAL_ 2566740734 FlashAmberWarningLamp 3 "Unavailable / Do Not Flash" 2 "Reserved" 1 "Fast Flash" 0 "Slow Flash" ;
VAL_ 2566740734 MalfunctionIndLampStatus 3 "Not available" 2 "Short MIL for WWH OBD" 1 "Lamp On" 0 "Lamp Off" ;
VAL_ 2566740734 AmberWarningLampStatus 3 "Not available" 2 "Reserved" 1 "Lamp On" 0 "Lamp Off" ;
VAL_ 2566740734 RedStopLampState 3 "Not available" 2 "Reserved" 1 "Lamp On" 0 "Lamp Off" ;
VAL_ 2566740734 ProtectLampStatus 0 "Lamp Off" 3 "Not available" 2 "Reserved" 1 "Lamp On" ;
VAL_ 2566740990 FMI5 24 "Assurance Data Error" 23 "Request DM60 for more info" 22 "Special Instructions #2 " 21 "Data drifted low" 20 "Data drifted high" 31 "Condition exists" 19 "Received network data in error" 18 "Below normal (moderately severe)" 17 "Below normal (least severe)" 16 "Above normal (moderately severe)" 15 "Above normal (least severe)" 14 "Special intstructions" 13 "Out of calibration" 12 "Bad intelligent device" 11 "Root cause not known" 10 "Abnormal rate of change" 9 "Abnormal update rate" 8 "Abnormal frequency" 7 "Mechanical system not responding" 6 "Current above normal" 5 "Current below normal" 4 "Voltage below normal" 3 "Voltage above normal" 2 "Data erratic" 1 "Below normal (most severe)" 0 "Above normal (most severe)" ;
VAL_ 2566740990 FMI4 24 "Assurance Data Error" 23 "Request DM60 for more info" 22 "Special Instructions #2 " 21 "Data drifted low" 20 "Data drifted high" 31 "Condition exists" 19 "Received network data in error" 18 "Below normal (moderately severe)" 17 "Below normal (least severe)" 16 "Above normal (moderately severe)" 15 "Above normal (least severe)" 14 "Special intstructions" 13 "Out of calibration" 12 "Bad intelligent device" 11 "Root cause not known" 10 "Abnormal rate of change" 9 "Abnormal update rate" 8 "Abnormal frequency" 7 "Mechanical system not responding" 6 "Current above normal" 5 "Current below normal" 4 "Voltage below normal" 3 "Voltage above normal" 2 "Data erratic" 1 "Below normal (most severe)" 0 "Above normal (most severe)" ;
VAL_ 2566740990 FMI3 24 "Assurance Data Error" 23 "Request DM60 for more info" 22 "Special Instructions #2 " 21 "Data drifted low" 20 "Data drifted high" 31 "Condition exists" 19 "Received network data in error" 18 "Below normal (moderately severe)" 17 "Below normal (least severe)" 16 "Above normal (moderately severe)" 15 "Above normal (least severe)" 14 "Special intstructions" 13 "Out of calibration" 12 "Bad intelligent device" 11 "Root cause not known" 10 "Abnormal rate of change" 9 "Abnormal update rate" 8 "Abnormal frequency" 7 "Mechanical system not responding" 6 "Current above normal" 5 "Current below normal" 4 "Voltage below normal" 3 "Voltage above normal" 2 "Data erratic" 1 "Below normal (most severe)" 0 "Above normal (most severe)" ;
VAL_ 2566740990 FMI2 24 "Assurance Data Error" 23 "Request DM60 for more info" 22 "Special Instructions #2 " 21 "Data drifted low" 20 "Data drifted high" 31 "Condition exists" 19 "Received network data in error" 18 "Below normal (moderately severe)" 17 "Below normal (least severe)" 16 "Above normal (moderately severe)" 15 "Above normal (least severe)" 14 "Special intstructions" 13 "Out of calibration" 12 "Bad intelligent device" 11 "Root cause not known" 10 "Abnormal rate of change" 9 "Abnormal update rate" 8 "Abnormal frequency" 7 "Mechanical system not responding" 6 "Current above normal" 5 "Current below normal" 4 "Voltage below normal" 3 "Voltage above normal" 2 "Data erratic" 1 "Below normal (most severe)" 0 "Above normal (most severe)" ;
VAL_ 2566740990 FMI1 24 "Assurance Data Error" 23 "Request DM60 for more info" 22 "Special Instructions #2 " 21 "Data drifted low" 20 "Data drifted high" 31 "Condition exists" 19 "Received network data in error" 18 "Below normal (moderately severe)" 17 "Below normal (least severe)" 16 "Above normal (moderately severe)" 15 "Above normal (least severe)" 14 "Special intstructions" 13 "Out of calibration" 12 "Bad intelligent device" 11 "Root cause not known" 10 "Abnormal rate of change" 9 "Abnormal update rate" 8 "Abnormal frequency" 7 "Mechanical system not responding" 6 "Current above normal" 5 "Current below normal" 4 "Voltage below normal" 3 "Voltage above normal" 2 "Data erratic" 1 "Below normal (most severe)" 0 "Above normal (most severe)" ;
VAL_ 2566740990 FlashRedStopLamp 3 "Unavailable / Do Not Flash" 2 "Reserved" 1 "Fast Flash" 0 "Slow Flash" ;
VAL_ 2566740990 FlashProtectLamp 3 "Unavailable / Do Not Flash" 2 "Reserved" 1 "Fast Flash" 0 "Slow Flash" ;
VAL_ 2566740990 FlashMalfuncIndicatorLamp 3 "Unavailable / Do Not Flash" 2 "Class C DTC  " 1 "Fast Flash" 0 "Slow Flash" ;
VAL_ 2566740990 FlashAmberWarningLamp 3 "Unavailable / Do Not Flash" 2 "Reserved" 1 "Fast Flash" 0 "Slow Flash" ;
VAL_ 2566740990 MalfunctionIndLampStatus 3 "Not available" 2 "Short MIL for WWH OBD" 1 "Lamp On" 0 "Lamp Off" ;
VAL_ 2566740990 AmberWarningLampStatus 3 "Not available" 2 "Reserved" 1 "Lamp On" 0 "Lamp Off" ;
VAL_ 2566740990 RedStopLampState 3 "Not available" 2 "Reserved" 1 "Lamp On" 0 "Lamp Off" ;
VAL_ 2566740990 ProtectLampStatus 0 "Lamp Off" 3 "Not available" 2 "Reserved" 1 "Lamp On" ;
VAL_ 2566741246 FMI5 24 "Assurance Data Error" 23 "Request DM60 for more info" 22 "Special Instructions #2 " 21 "Data drifted low" 20 "Data drifted high" 31 "Condition exists" 19 "Received network data in error" 18 "Below normal (moderately severe)" 17 "Below normal (least severe)" 16 "Above normal (moderately severe)" 15 "Above normal (least severe)" 14 "Special intstructions" 13 "Out of calibration" 12 "Bad intelligent device" 11 "Root cause not known" 10 "Abnormal rate of change" 9 "Abnormal update rate" 8 "Abnormal frequency" 7 "Mechanical system not responding" 6 "Current above normal" 5 "Current below normal" 4 "Voltage below normal" 3 "Voltage above normal" 2 "Data erratic" 1 "Below normal (most severe)" 0 "Above normal (most severe)" ;
VAL_ 2566741246 FMI4 24 "Assurance Data Error" 23 "Request DM60 for more info" 22 "Special Instructions #2 " 21 "Data drifted low" 20 "Data drifted high" 31 "Condition exists" 19 "Received network data in error" 18 "Below normal (moderately severe)" 17 "Below normal (least severe)" 16 "Above normal (moderately severe)" 15 "Above normal (least severe)" 14 "Special intstructions" 13 "Out of calibration" 12 "Bad intelligent device" 11 "Root cause not known" 10 "Abnormal rate of change" 9 "Abnormal update rate" 8 "Abnormal frequency" 7 "Mechanical system not responding" 6 "Current above normal" 5 "Current below normal" 4 "Voltage below normal" 3 "Voltage above normal" 2 "Data erratic" 1 "Below normal (most severe)" 0 "Above normal (most severe)" ;
VAL_ 2566741246 FMI3 24 "Assurance Data Error" 23 "Request DM60 for more info" 22 "Special Instructions #2 " 21 "Data drifted low" 20 "Data drifted high" 31 "Condition exists" 19 "Received network data in error" 18 "Below normal (moderately severe)" 17 "Below normal (least severe)" 16 "Above normal (moderately severe)" 15 "Above normal (least severe)" 14 "Special intstructions" 13 "Out of calibration" 12 "Bad intelligent device" 11 "Root cause not known" 10 "Abnormal rate of change" 9 "Abnormal update rate" 8 "Abnormal frequency" 7 "Mechanical system not responding" 6 "Current above normal" 5 "Current below normal" 4 "Voltage below normal" 3 "Voltage above normal" 2 "Data erratic" 1 "Below normal (most severe)" 0 "Above normal (most severe)" ;
VAL_ 2566741246 FMI2 24 "Assurance Data Error" 23 "Request DM60 for more info" 22 "Special Instructions #2 " 21 "Data drifted low" 20 "Data drifted high" 31 "Condition exists" 19 "Received network data in error" 18 "Below normal (moderately severe)" 17 "Below normal (least severe)" 16 "Above normal (moderately severe)" 15 "Above normal (least severe)" 14 "Special intstructions" 13 "Out of calibration" 12 "Bad intelligent device" 11 "Root cause not known" 10 "Abnormal rate of change" 9 "Abnormal update rate" 8 "Abnormal frequency" 7 "Mechanical system not responding" 6 "Current above normal" 5 "Current below normal" 4 "Voltage below normal" 3 "Voltage above normal" 2 "Data erratic" 1 "Below normal (most severe)" 0 "Above normal (most severe)" ;
VAL_ 2566741246 FMI1 24 "Assurance Data Error" 23 "Request DM60 for more info" 22 "Special Instructions #2 " 21 "Data drifted low" 20 "Data drifted high" 31 "Condition exists" 19 "Received network data in error" 18 "Below normal (moderately severe)" 17 "Below normal (least severe)" 16 "Above normal (moderately severe)" 15 "Above normal (least severe)" 14 "Special intstructions" 13 "Out of calibration" 12 "Bad intelligent device" 11 "Root cause not known" 10 "Abnormal rate of change" 9 "Abnormal update rate" 8 "Abnormal frequency" 7 "Mechanical system not responding" 6 "Current above normal" 5 "Current below normal" 4 "Voltage below normal" 3 "Voltage above normal" 2 "Data erratic" 1 "Below normal (most severe)" 0 "Above normal (most severe)" ;
VAL_ 2566741246 FlashRedStopLamp 3 "Unavailable / Do Not Flash" 2 "Reserved" 1 "Fast Flash" 0 "Slow Flash" ;
VAL_ 2566741246 FlashProtectLamp 3 "Unavailable / Do Not Flash" 2 "Reserved" 1 "Fast Flash" 0 "Slow Flash" ;
VAL_ 2566741246 FlashMalfuncIndicatorLamp 3 "Unavailable / Do Not Flash" 2 "Class C DTC  " 1 "Fast Flash" 0 "Slow Flash" ;
VAL_ 2566741246 FlashAmberWarningLamp 3 "Unavailable / Do Not Flash" 2 "Reserved" 1 "Fast Flash" 0 "Slow Flash" ;
VAL_ 2566741246 MalfunctionIndLampStatus 3 "Not available" 2 "Short MIL for WWH OBD" 1 "Lamp On" 0 "Lamp Off" ;
VAL_ 2566741246 AmberWarningLampStatus 3 "Not available" 2 "Reserved" 1 "Lamp On" 0 "Lamp Off" ;
VAL_ 2566741246 RedStopLampState 3 "Not available" 2 "Reserved" 1 "Lamp On" 0 "Lamp Off" ;
VAL_ 2566741246 ProtectLampStatus 0 "Lamp Off" 3 "Not available" 2 "Reserved" 1 "Lamp On" ;
VAL_ 2566741502 FMI5 24 "Assurance Data Error" 23 "Request DM60 for more info" 22 "Special Instructions #2 " 21 "Data drifted low" 20 "Data drifted high" 31 "Condition exists" 19 "Received network data in error" 18 "Below normal (moderately severe)" 17 "Below normal (least severe)" 16 "Above normal (moderately severe)" 15 "Above normal (least severe)" 14 "Special intstructions" 13 "Out of calibration" 12 "Bad intelligent device" 11 "Root cause not known" 10 "Abnormal rate of change" 9 "Abnormal update rate" 8 "Abnormal frequency" 7 "Mechanical system not responding" 6 "Current above normal" 5 "Current below normal" 4 "Voltage below normal" 3 "Voltage above normal" 2 "Data erratic" 1 "Below normal (most severe)" 0 "Above normal (most severe)" ;
VAL_ 2566741502 FMI4 24 "Assurance Data Error" 23 "Request DM60 for more info" 22 "Special Instructions #2 " 21 "Data drifted low" 20 "Data drifted high" 31 "Condition exists" 19 "Received network data in error" 18 "Below normal (moderately severe)" 17 "Below normal (least severe)" 16 "Above normal (moderately severe)" 15 "Above normal (least severe)" 14 "Special intstructions" 13 "Out of calibration" 12 "Bad intelligent device" 11 "Root cause not known" 10 "Abnormal rate of change" 9 "Abnormal update rate" 8 "Abnormal frequency" 7 "Mechanical system not responding" 6 "Current above normal" 5 "Current below normal" 4 "Voltage below normal" 3 "Voltage above normal" 2 "Data erratic" 1 "Below normal (most severe)" 0 "Above normal (most severe)" ;
VAL_ 2566741502 FMI3 24 "Assurance Data Error" 23 "Request DM60 for more info" 22 "Special Instructions #2 " 21 "Data drifted low" 20 "Data drifted high" 31 "Condition exists" 19 "Received network data in error" 18 "Below normal (moderately severe)" 17 "Below normal (least severe)" 16 "Above normal (moderately severe)" 15 "Above normal (least severe)" 14 "Special intstructions" 13 "Out of calibration" 12 "Bad intelligent device" 11 "Root cause not known" 10 "Abnormal rate of change" 9 "Abnormal update rate" 8 "Abnormal frequency" 7 "Mechanical system not responding" 6 "Current above normal" 5 "Current below normal" 4 "Voltage below normal" 3 "Voltage above normal" 2 "Data erratic" 1 "Below normal (most severe)" 0 "Above normal (most severe)" ;
VAL_ 2566741502 FMI2 24 "Assurance Data Error" 23 "Request DM60 for more info" 22 "Special Instructions #2 " 21 "Data drifted low" 20 "Data drifted high" 31 "Condition exists" 19 "Received network data in error" 18 "Below normal (moderately severe)" 17 "Below normal (least severe)" 16 "Above normal (moderately severe)" 15 "Above normal (least severe)" 14 "Special intstructions" 13 "Out of calibration" 12 "Bad intelligent device" 11 "Root cause not known" 10 "Abnormal rate of change" 9 "Abnormal update rate" 8 "Abnormal frequency" 7 "Mechanical system not responding" 6 "Current above normal" 5 "Current below normal" 4 "Voltage below normal" 3 "Voltage above normal" 2 "Data erratic" 1 "Below normal (most severe)" 0 "Above normal (most severe)" ;
VAL_ 2566741502 FMI1 24 "Assurance Data Error" 23 "Request DM60 for more info" 22 "Special Instructions #2 " 21 "Data drifted low" 20 "Data drifted high" 31 "Condition exists" 19 "Received network data in error" 18 "Below normal (moderately severe)" 17 "Below normal (least severe)" 16 "Above normal (moderately severe)" 15 "Above normal (least severe)" 14 "Special intstructions" 13 "Out of calibration" 12 "Bad intelligent device" 11 "Root cause not known" 10 "Abnormal rate of change" 9 "Abnormal update rate" 8 "Abnormal frequency" 7 "Mechanical system not responding" 6 "Current above normal" 5 "Current below normal" 4 "Voltage below normal" 3 "Voltage above normal" 2 "Data erratic" 1 "Below normal (most severe)" 0 "Above normal (most severe)" ;
VAL_ 2566741502 FlashRedStopLamp 3 "Unavailable / Do Not Flash" 2 "Reserved" 1 "Fast Flash" 0 "Slow Flash" ;
VAL_ 2566741502 FlashProtectLamp 3 "Unavailable / Do Not Flash" 2 "Reserved" 1 "Fast Flash" 0 "Slow Flash" ;
VAL_ 2566741502 FlashMalfuncIndicatorLamp 3 "Unavailable / Do Not Flash" 2 "Class C DTC  " 1 "Fast Flash" 0 "Slow Flash" ;
VAL_ 2566741502 FlashAmberWarningLamp 3 "Unavailable / Do Not Flash" 2 "Reserved" 1 "Fast Flash" 0 "Slow Flash" ;
VAL_ 2566741502 MalfunctionIndLampStatus 3 "Not available" 2 "Short MIL for WWH OBD" 1 "Lamp On" 0 "Lamp Off" ;
VAL_ 2566741502 AmberWarningLampStatus 3 "Not available" 2 "Reserved" 1 "Lamp On" 0 "Lamp Off" ;
VAL_ 2566741502 RedStopLampState 3 "Not available" 2 "Reserved" 1 "Lamp On" 0 "Lamp Off" ;
VAL_ 2566741502 ProtectLampStatus 0 "Lamp Off" 3 "Not available" 2 "Reserved" 1 "Lamp On" ;
VAL_ 2566741758 FMI5 24 "Assurance Data Error" 23 "Request DM60 for more info" 22 "Special Instructions #2 " 21 "Data drifted low" 20 "Data drifted high" 31 "Condition exists" 19 "Received network data in error" 18 "Below normal (moderately severe)" 17 "Below normal (least severe)" 16 "Above normal (moderately severe)" 15 "Above normal (least severe)" 14 "Special intstructions" 13 "Out of calibration" 12 "Bad intelligent device" 11 "Root cause not known" 10 "Abnormal rate of change" 9 "Abnormal update rate" 8 "Abnormal frequency" 7 "Mechanical system not responding" 6 "Current above normal" 5 "Current below normal" 4 "Voltage below normal" 3 "Voltage above normal" 2 "Data erratic" 1 "Below normal (most severe)" 0 "Above normal (most severe)" ;
VAL_ 2566741758 FMI4 24 "Assurance Data Error" 23 "Request DM60 for more info" 22 "Special Instructions #2 " 21 "Data drifted low" 20 "Data drifted high" 31 "Condition exists" 19 "Received network data in error" 18 "Below normal (moderately severe)" 17 "Below normal (least severe)" 16 "Above normal (moderately severe)" 15 "Above normal (least severe)" 14 "Special intstructions" 13 "Out of calibration" 12 "Bad intelligent device" 11 "Root cause not known" 10 "Abnormal rate of change" 9 "Abnormal update rate" 8 "Abnormal frequency" 7 "Mechanical system not responding" 6 "Current above normal" 5 "Current below normal" 4 "Voltage below normal" 3 "Voltage above normal" 2 "Data erratic" 1 "Below normal (most severe)" 0 "Above normal (most severe)" ;
VAL_ 2566741758 FMI3 24 "Assurance Data Error" 23 "Request DM60 for more info" 22 "Special Instructions #2 " 21 "Data drifted low" 20 "Data drifted high" 31 "Condition exists" 19 "Received network data in error" 18 "Below normal (moderately severe)" 17 "Below normal (least severe)" 16 "Above normal (moderately severe)" 15 "Above normal (least severe)" 14 "Special intstructions" 13 "Out of calibration" 12 "Bad intelligent device" 11 "Root cause not known" 10 "Abnormal rate of change" 9 "Abnormal update rate" 8 "Abnormal frequency" 7 "Mechanical system not responding" 6 "Current above normal" 5 "Current below normal" 4 "Voltage below normal" 3 "Voltage above normal" 2 "Data erratic" 1 "Below normal (most severe)" 0 "Above normal (most severe)" ;
VAL_ 2566741758 FMI2 24 "Assurance Data Error" 23 "Request DM60 for more info" 22 "Special Instructions #2 " 21 "Data drifted low" 20 "Data drifted high" 31 "Condition exists" 19 "Received network data in error" 18 "Below normal (moderately severe)" 17 "Below normal (least severe)" 16 "Above normal (moderately severe)" 15 "Above normal (least severe)" 14 "Special intstructions" 13 "Out of calibration" 12 "Bad intelligent device" 11 "Root cause not known" 10 "Abnormal rate of change" 9 "Abnormal update rate" 8 "Abnormal frequency" 7 "Mechanical system not responding" 6 "Current above normal" 5 "Current below normal" 4 "Voltage below normal" 3 "Voltage above normal" 2 "Data erratic" 1 "Below normal (most severe)" 0 "Above normal (most severe)" ;
VAL_ 2566741758 FMI1 24 "Assurance Data Error" 23 "Request DM60 for more info" 22 "Special Instructions #2 " 21 "Data drifted low" 20 "Data drifted high" 31 "Condition exists" 19 "Received network data in error" 18 "Below normal (moderately severe)" 17 "Below normal (least severe)" 16 "Above normal (moderately severe)" 15 "Above normal (least severe)" 14 "Special intstructions" 13 "Out of calibration" 12 "Bad intelligent device" 11 "Root cause not known" 10 "Abnormal rate of change" 9 "Abnormal update rate" 8 "Abnormal frequency" 7 "Mechanical system not responding" 6 "Current above normal" 5 "Current below normal" 4 "Voltage below normal" 3 "Voltage above normal" 2 "Data erratic" 1 "Below normal (most severe)" 0 "Above normal (most severe)" ;
VAL_ 2566741758 FlashRedStopLamp 3 "Unavailable / Do Not Flash" 2 "Reserved" 1 "Fast Flash" 0 "Slow Flash" ;
VAL_ 2566741758 FlashProtectLamp 3 "Unavailable / Do Not Flash" 2 "Reserved" 1 "Fast Flash" 0 "Slow Flash" ;
VAL_ 2566741758 FlashMalfuncIndicatorLamp 3 "Unavailable / Do Not Flash" 2 "Class C DTC  " 1 "Fast Flash" 0 "Slow Flash" ;
VAL_ 2566741758 FlashAmberWarningLamp 3 "Unavailable / Do Not Flash" 2 "Reserved" 1 "Fast Flash" 0 "Slow Flash" ;
VAL_ 2566741758 MalfunctionIndLampStatus 3 "Not available" 2 "Short MIL for WWH OBD" 1 "Lamp On" 0 "Lamp Off" ;
VAL_ 2566741758 AmberWarningLampStatus 3 "Not available" 2 "Reserved" 1 "Lamp On" 0 "Lamp Off" ;
VAL_ 2566741758 RedStopLampState 3 "Not available" 2 "Reserved" 1 "Lamp On" 0 "Lamp Off" ;
VAL_ 2566741758 ProtectLampStatus 0 "Lamp Off" 3 "Not available" 2 "Reserved" 1 "Lamp On" ;
