/*@!Encoding:1252*/
/*
 * J1939DTC - Diagnostic Trouble Code CAPL Library Version 1.0
 *
 * Copyright 2021, Vector Informatik GmbH - All right reserved
 *
 * Previous versions have been replaced due to new functionality of the 
 * J1939 Interaction Layer. All manual implementations of DM messages
 * were replaced by similiar functions of the Interaction Layer.
 * 
 * History:
 * 1.0 (Rio)  Created 
 */
variables
{
  enum DM //PGNs of Diagnostic Messages by J1939-73 specification 
  {
    kDM1   = 0xFECA,
    kDM2   = 0xFECB,
    kDM3   = 0xFECC,
    kDM6   = 0xFECF,
    kDM12  = 0xFED4,
    kDM22  = 0xC300,
    kDM23  = 0xFDB5,
    kDM27  = 0xFD82,
    kDM28  = 0xFD80,
    kDM35  = 0x9F00
  };
  
  enum FMI //Failure Mode Identification by J1939-73 specification
  {
    kDataValidButAboveNormalMostSevere        = 0,
    kDataValidButBelowNormalMostSevere        = 1,
    kDataErratic                              = 2,
    kVoltageAboveNormal                       = 3,
    kVoltageBelowNormal                       = 4,
    kCurrentBelowNormal                       = 5,
    kCurrentAboveNormal                       = 6,
    kMechanicalSystemNotResponding            = 7,
    kAbnormalFrequencyPulseWidthPeriod        = 8,
    kAbnormalUpdateRate                       = 9,
    kAbnormalRateOfChange                     = 10,
    kRootCauseNotKnown                        = 11,
    kBadIntelligentDeviceOrComponent          = 12,
    kOutOfCalibration                         = 13,
    kSpecialInstuctions                       = 14,
    kDataValidButAboveNormalLeastSevere       = 15,
    kDataValidButAboveNormalModeratelySevere  = 16,
    kDataValidButBelowNormalLeastSevere       = 17,
    kDataValidButBelowNormalModeratelySevere  = 18,
    kReceivedNetowrkDataInError               = 19,
    kDataDriftedHigh                          = 20,
    kDataDriftedLow                           = 21
  }; 
  
  enum LampIndex //The index in the byte of lamp states in DM1 (and other) messages.
  {
    kProtectLamp      = 0x00,
    kAmberWarnLamp    = 0x01,
    kRedStopLamp      = 0x02,
    kMalfunctionLamp  = 0x03
  };
  
  enum LampState
  {
    kOff      = 0x00,
    kOn       = 0x01,
    kDontCare = 0x03
  };
  
  enum LampFlashState
  {
    kSlowFlash    = 0x00,
    kFastFlash    = 0x01,
    kReserved     = 0x02,
    kPermanentOn  = 0x03
  };
}

/*
* Creates the bitmask of 2 bytes length for the lamp states in DM1 (and other) messages.
* The first byte indicates the state of all lamps (ON/OFF) with 2 bits per lamp.
* The second byte indicates wether the lamps flash (slow/fast) or are permanent on.
* Again the byte is seperated in 2 bits per lamp.
* The index of the lamp in the 2 bytes range is defined in J1939-73
*/
word SetLampStatus(enum LampIndex lampIdx, enum LampState lampState, enum LampFlashState flashState)
{
  word lampStats;
  word deleteBits;
  deleteBits = 0x00;
  
  if(lampState)
  {
    lampStats |= (lampState << lampIdx * 2);
    lampStats |= (flashState << (lampIdx * 2 + 8));
  }
  else
  {
    deleteBits |= (0x03 << lampIdx * 2); //Set bits to be deleted
    deleteBits |= (0x03 << (lampIdx * 2 + 8));
    lampStats &= (~deleteBits); //Inverse the bit mask and delete exactly the selected bits.
  }
  return lampStats;
}

