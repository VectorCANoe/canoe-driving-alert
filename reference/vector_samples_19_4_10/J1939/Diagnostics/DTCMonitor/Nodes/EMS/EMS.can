/*@!Encoding:1252*/
includes
{
  #include "..\Include Files\J1939.cin"
  #include "..\Include Files\J1939DTC.cin"
}

/*
 * EMS - Engine Management System                  Version 1.0
 *
 * Copyright 2021, Vector Informatik GmbH - All right reserved
 *
 * Previous versions have been replaced due to new functionality of the 
 * J1939 Interaction Layer. All manual implementations of DM messages
 * were replaced by similiar functions of the Interaction Layer.
 * 
 * History:
 * 1.0 (Rio) Created
 */
variables
{
  //SPN of the two malfunctions
  const int gFaultTemperatureSPN = 110;
  const int gFaultOxygenSPN = 1119;
  
  //Helper flags
  int gParallelMILErrors = 0; //Indicates if the corresponding lamp can be turned off
  int gIsFaultOxygenRemoved = 0; //Indicates if the DTC is already removed from a DM
  int gIsFaultTemperatureRemoved = 0; //Indicates if the DTC is already removed from a DM
}


on start
{
    J1939ILActivateDiagnosticsSupport(1);   //Enable diagnostic functionality of Interaction Layer
}

long J1939ILOnRequest( long rqPGN, long sourceAddr )
{
  switch(rqPGN) 
  {
  case kDM3:
    if(gIsFaultTemperatureRemoved)
    {
      //Remove from DM23 since the DTC is active again
      J1939ILRemoveDTC(kDM23, gFaultTemperatureSPN);
      gIsFaultTemperatureRemoved = 0;
    }
    if(gIsFaultOxygenRemoved)
    {
      //Remove from DM23 since the DTC is active again
      J1939ILRemoveDTC(kDM23, gFaultOxygenSPN);
      gIsFaultOxygenRemoved = 0;
    }
    break;
  default:
  break;
  }
  return 1;
}

/*
 * Individual clear/reset of active or previsouly active DTC
 */
on pg DM22
{
  DWORD   spn;
  DWORD   fmi;
  pg DM22 dm22;

  if (!J1939ILAcceptRxPG( this )) return;

  spn = this.SPN;
  fmi = this.FMI;

  switch(this.ControlByte) {
    case 1:  // Request to clear previously active DTC
      J1939ILRemoveDTC(kDM23, spn, fmi);
      J1939ILRemoveDTC(kDM2, spn, fmi);
      break;
    case 17: // Request to clear active DTC
      J1939ILRemoveDTC(kDM12, spn, fmi);
      break;
  }
}

/*
 * Active DTC for FaultTemperature signal.
 */
on sysvar Powertrain::EMS::FaultTemperature
{
  byte oc;
  if (@this == 1) //Button pressed
  {
    J1939ILActivateDTC(gFaultTemperatureSPN, kDataValidButAboveNormalMostSevere, 1); //Add to DM1 message
    J1939ILSetLampStatus(kDM1, SetLampStatus(kMalfunctionLamp, kOn, kPermanentOn)); //Set lamp states of DM1
    J1939ILAddDTC(kDM12, gFaultTemperatureSPN, kDataValidButAboveNormalMostSevere, ++oc); //Add to additional DM12 message (emission related)
    if(gIsFaultTemperatureRemoved)
    {
      //Remove from DM23 since the DTC is active again
      J1939ILRemoveDTC(kDM23, gFaultTemperatureSPN, kDataValidButAboveNormalMostSevere);
      gIsFaultTemperatureRemoved = 0;
    }
    gParallelMILErrors++; //Helper to ensure we do not turn off the lamp if another error is active.
  }
  else //Button released
  {
    J1939ILRemoveDTC(kDM12, gFaultTemperatureSPN, kDataValidButAboveNormalMostSevere); //Remove from additional DM12 message (emission related)
    J1939ILAddDTC(kDM23, gFaultTemperatureSPN, kDataValidButAboveNormalMostSevere, oc); //Add to previous MIL ON emission related DM23
    gIsFaultTemperatureRemoved = 1;
    J1939ILDeactivateDTC(gFaultTemperatureSPN, kDataValidButAboveNormalMostSevere, 1); //Remove from DM1
    
    gParallelMILErrors--;
    if(gParallelMILErrors == 0)
    {
      //This is the last active error that turned on the lamp, so we can turn it off.
      J1939ILSetLampStatus(kDM1, SetLampStatus(kMalfunctionLamp, kOff, kPermanentOn));
    }
  }
}

/*
 * Active DTC for FaultOxygen signal.
 */
on sysvar Powertrain::EMS::FaultOxygen
{
  byte oc;
  
  if (@this == 1) //Button pressed
  {
    J1939ILActivateDTC(gFaultOxygenSPN, kRootCauseNotKnown, 1);
    J1939ILAddDTC(kDM12, gFaultOxygenSPN, kRootCauseNotKnown, ++oc);
    J1939ILSetLampStatus(kDM1, SetLampStatus(kMalfunctionLamp, kOn, kPermanentOn));
    if(gIsFaultOxygenRemoved)
    {
      //Remove from DM23 since the DTC is active again
      J1939ILRemoveDTC(kDM23, gFaultOxygenSPN, kRootCauseNotKnown);
      gIsFaultOxygenRemoved = 0;
    }
    gParallelMILErrors++;
  }
  else //Button released
  {
    J1939ILRemoveDTC(kDM12, gFaultOxygenSPN, kRootCauseNotKnown);
    gIsFaultOxygenRemoved = 1;
    J1939ILDeactivateDTC(gFaultOxygenSPN, kRootCauseNotKnown, 1);
    J1939ILAddDTC(kDM23, gFaultOxygenSPN, kRootCauseNotKnown, oc);

    gParallelMILErrors--;
    if(gParallelMILErrors == 0)
    {
      //This is the last active error that turned on the lamp, so we can turn it off.
      J1939ILSetLampStatus(kDM1, SetLampStatus(kMalfunctionLamp, kOff, kPermanentOn));
    }
  }
}

