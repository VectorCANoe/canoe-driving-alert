/*@!Encoding:1252*/
includes
{
  #include "..\Include Files\J1939.cin"
  #include "..\Include Files\J1939DTC.cin"
}

/*
 * EBS - Electronic Brake System                   Version 1.0
 *
 * Copyright 2021, Vector Informatik GmbH - All right reserved
 *
 * Previous versions have been replaced due to new functionality of the 
 * J1939 Interaction Layer. All manual implementations of DM messages
 * were replaced by similiar functions of the Interaction Layer.
 * 
 * History:
 * 1.0 (Rio) Created
 */
variables
{
  const int gFaultBrakePedalPosSPN = 521;
  const int gFaultAppPressureErrorSPN = 1091;
}

on start
{
    J1939ILActivateDiagnosticsSupport(1);   //Enable diagnostic functionality of Interaction Layer
}

/*
 * Active DTC for BrakePedalPos signal.
 */
on sysvar Powertrain::EBS::FaultBrakePedalPos
{
  if (@this == 1) 
  {
    J1939ILActivateDTC(gFaultBrakePedalPosSPN, kDataValidButBelowNormalLeastSevere, 1);  //Add to DM1 message
    J1939ILSetLampStatus(kDM1, SetLampStatus(kMalfunctionLamp, kOn, kPermanentOn)); //Set lamp states of DM1
  }
  else 
  {
    J1939ILDeactivateDTC(gFaultBrakePedalPosSPN, kDataValidButBelowNormalLeastSevere, 1); //Remove from DM1
    J1939ILSetLampStatus(kDM1, SetLampStatus(kMalfunctionLamp, kOff, kPermanentOn)); //Set lamp states of DM1
  }
}

/*
 * Active DTC for AppPressure signal.
 */
on sysvar Powertrain::EBS::FaultAppPressureError
{
  if (@this == 1) 
  {
    J1939ILActivateDTC(gFaultAppPressureErrorSPN, kDataValidButBelowNormalMostSevere, 1); //Add to DM1 message
    J1939ILSetLampStatus(kDM1, SetLampStatus(kRedStopLamp, kOn, kPermanentOn)); //Set lamp states of DM1
  }
  else 
  {
    J1939ILDeactivateDTC(gFaultAppPressureErrorSPN, kDataValidButBelowNormalMostSevere, 1); //Remove from DM1
    J1939ILSetLampStatus(kDM1, SetLampStatus(kRedStopLamp, kOff, kPermanentOn)); //Set lamp states of DM1
  }
}



