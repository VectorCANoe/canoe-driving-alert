/*@!Encoding:1252*/
includes
{
  #include "CANopenHelper.cin"
}

variables
{
  // ------------------------------------------------
  // File information
  // Copyright         : 2019, Vector Informatik GmbH
  // ------------------------------------------------

  // Globals for "Master" device
  BYTE gNodeId          = 1;
  char gNodeLabel[32]   = "Master";

  sysvarInt * gRunLEDVar;
  sysvarInt * gErrLEDVar;
}

on preStart
{
  gRunLEDVar = sysvar::GUIControls::Node1_State;
  gErrLEDVar = sysvar::GUIControls::Node1_ErrLed;
  @sysvar::GUIControls::Node1_ID = gNodeId;
}

on sysvar CANopen::CAN::Master::Control::CommunicationState
{
  CANopenUpdateState(@this);
}

/*
server implementation
*/
// Is called in the SDO server simulation if an SOO client writes an entry in the Object dictionary of data type DOMAIN
OnCANopenDomainServerUploadBegin(dword index, dword subIndex, dword& sz)
{
  if(index == 0x2001)
  {
    sz = 20;
  }
}

// Is called in the SDO server simulation for the next data transmission writing an entry of data type DOMAIN
OnCANopenDomainServerUploadNextData(dword index, dword subIndex, dword offset, dword payloadSize, byte payload[])
{
  if(index == 0x2001)
  {
    int i;
    int c = 0;
    for(i = 0; i < payloadSize; i++)
    {
      payload[i] = i + c*7; // uploaded message
    }
    c++;
  } 
}
