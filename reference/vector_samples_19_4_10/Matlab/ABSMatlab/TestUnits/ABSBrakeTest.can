variables
{
}

export testcase Brake_Time(int ABSon)
{
  
  int MaxAllowedBrakeTime;

  MaxAllowedBrakeTime=@sysvar::MatlabIO::SetPointBrakeTime;

  //preparation
  SetSignal(MotorState::CarSpeed,100);
  
  @sysvar::Control::activeABS=ABSon;
  testStep("","System variable 'Control::activeABS':  %d", ABSon);

  @sysvar::MatlabIO::BrakeDistVerdict=0;
  testStep("","System variable 'MatlabIO::BrakeTimeVerdict':  0");

  //main part
  testWaitForTimeout(2000);
  @sysvar::Control::brakeActive=1;
  testStep("","Successfully set system variable 'Control::brakeActive': 1");
  testStep("1","Stimulation of the input parameters");

  testWaitForTimeoutSilent(15000);
  testStep("2","Wait for 15000 ms.");

  if(@sysvar::MatlabIO::BrakeTime<=MaxAllowedBrakeTime)
  {
    testStepPass("","Check system variable 'MatlabIO::BrakeTime' value passed: = %d, condition: <= %d",@sysvar::MatlabIO::BrakeTime,MaxAllowedBrakeTime);
    testStepPass("3","Validation of the expected parameters");
  }
  else
  {
    testStepFail("","Check system variable 'MatlabIO::BrakeTime' value failed: = %d, condition: <= %d",@sysvar::MatlabIO::BrakeTime,MaxAllowedBrakeTime);
    testStepFail("3","Validation of the expected parameters");
  }

  //completion
  TestStep("","Releasing Pedal");
  @sysvar::Control::brakeActive=0;
  TestStep("","System variable 'Control::brakeActive'   0");
  TestStep("","Stimulation of the input parameters");


  TestStep("","Reset brake");
  setSignal(ModelInfo::xF,0);
  TestStep("","Stimulation of the input parameters");

  TestwaitforTimeout(500);
}

export testcase Brake_Distance(int ABSon)
{
  //preparation
  SetSignal(MotorState::CarSpeed,100);

  @sysvar::MatlabIO::BrakeDistVerdict=0;
  TestStep("","System variable 'MatlabIO::BrakeDistVerdict'   0");
  @sysvar::Control::activeABS=ABSon;
  TestStep("","System variable 'MatlabIO::activeABS'   0");

  //main part
  testWaitForTimeoutSilent(2000);
  TestStep("","Waited for 2000 ms");
  
  @sysvar::Control::brakeActive=1;
  TestStep("","Successfully set system variable 'Control::brakeActive':  1");

  TestStep("1","Stimulation of input parameters");
  testWaitForTimeoutSilent(15000);
  TestStep("2", "Wait for 15000 ms.");

  if(@sysvar::MatlabIO::BrakeDistVerdict==0)
  {
    testStepPass("","Check system variable 'MatlabIO::BrakeDistVerdict' value passed: = %d, condition: <= %d",@sysvar::MatlabIO::BrakeDistVerdict,0);
    testStepPass("3","Validation of the expected parameters");
  }
  else
  {
    testStepFail("","Check system variable 'MatlabIO::BrakeDistVerdict' value failed: = %d, condition: <= %d",@sysvar::MatlabIO::BrakeDistVerdict,0);
    testStepFail("3","Validation of the expected parameters");
  }

  
  //completion
  TestStep("","Release Pedal");
  @sysvar::Control::brakeActive=0;
  TestStep("","System variable 'Control::brakeActive':  0");
  testStep("","Stimulation of the input parameters");
  testWaitForTimeout(500); 
}

export testcase slipValue(int slipValue)
{
  //preparation
  SetSignal(MotorState::CarSpeed,100);
  @sysvar::Control::brakeActive=0;
  @sysvar::Control::activeABS=1;
  @sysvar::MatlabIO::BrakeDistVerdict=0;
  @sysvar::Brakes::Parameters::EnabledSubsystem::Slip_Reference::Value=slipValue;

  //main part
  testWaitForTimeoutSilent(2000);
  @sysvar::Control::brakeActive=1;
  testWaitForTimeoutSilent(10000);

  if(@sysvar::MatlabIO::BrakeDistVerdict==0)
  {
    testStepPass("","Check system variable 'MatlabIO::BrakeDistVerdict' value passed: = %d, condition: <= %d",@sysvar::MatlabIO::BrakeDistVerdict,0);
  }
  else
  {
    testStepFail("","Check system variable 'MatlabIO::BrakeDistVerdict' value failed: = %d, condition: <= %d",@sysvar::MatlabIO::BrakeDistVerdict,0);
  }

  //completion
  @sysvar::Control::brakeActive=0;
  TestwaitfortimeoutSilent(500);
  
}
