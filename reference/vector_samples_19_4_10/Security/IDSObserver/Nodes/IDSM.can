/*@!Encoding:65001*/
includes
{

}

variables
{
  // CAN
  dword IdsCanId = 9;
  byte IdsQSE_EventFrameOnly[8] = { 0x10,0x26,0x18,0xCA,0xFE,0x00,0x10,0x00};
  
  // CANFD
  dword IdsCanFDId = 10;
  byte IdsQSE_canfd[50] = {0x16,0xFF,0xFF,0x75,0x30,0x00,0x0A,0x00,0x02,0x00,0x00,0x00,0x00,0x00,0x00,0x03,0x00,0x20,0xFF,0xEE,0xDD,0xCC,0xBB,0xAA,0x99,0x88,0x77,0x66,0x55,0x44,0x33,0x22,0x11,0x00,0xFF,0xEE,0xDD,0xCC,0xBB,0xAA,0x99,0x88,0x77,0x66,0x55,0x44,0x33,0x22,0x11,0x00};
  
  // CAN-TP
  dword IdsCanTpIdTx = 0x12;
  dword IdsCanTpIdRx = 0x13;
  byte IdsQSE_128byteData[157] = {0x27,0xFF,0xFF,0x9C,0x40,0x00,0x0A,0x00,0xD3,0x2D,0x00,0x78,0x00,0xA9,0xF1,0x04,0x80,0x01,0x08,0x12,0xBD,0xC5,0x46,0x29,0x1F,0x4B,0x12,0x00,0x80,0xFF,0xEE,0xDD,0xCC,0xBB,0xAA,0x99,0x88,0x77,0x66,0x55,0x44,0x33,0x22,0x11,0x00,0xFF,0xEE,0xDD,0xCC,0xBB,0xAA,0x99,0x88,0x77,0x66,0x55,0x44,0x33,0x22,0x11,0x00,0xFF,0xEE,0xDD,0xCC,0xBB,0xAA,0x99,0x88,0x77,0x66,0x55,0x44,0x33,0x22,0x11,0x00,0xFF,0xEE,0xDD,0xCC,0xBB,0xAA,0x99,0x88,0x77,0x66,0x55,0x44,0x33,0x22,0x11,0x00,0xFF,0xEE,0xDD,0xCC,0xBB,0xAA,0x99,0x88,0x77,0x66,0x55,0x44,0x33,0x22,0x11,0x00,0xFF,0xEE,0xDD,0xCC,0xBB,0xAA,0x99,0x88,0x77,0x66,0x55,0x44,0x33,0x22,0x11,0x00,0xFF,0xEE,0xDD,0xCC,0xBB,0xAA,0x99,0x88,0x77,0x66,0x55,0x44,0x33,0x22,0x11,0x00,0xFF,0xEE,0xDD,0xCC,0xBB,0xAA,0x99,0x88,0x77,0x66,0x55,0x44,0x33,0x22,0x11,0x00};

  msTimer sendTimer;
  int sendTimerDuration = 10;
  int sendIndex = 0;
  int sendIndexCan = 0;
  int sendIndexCanFd = 0;
  int sendIndexCanTp = 0;
  int sendIndexCanTpError = 0;
  int sendIndexUdp = 0;
  int sendIndexTcp = 0;
}

on start
{
  if( @sysvar::IDSMPanel::CyclicTransmissionMode == 1)
  {
    setTimer(sendTimer, 50);
    ManageControls(0);
  }
}

/// <Panel>
on sysvar_update sysvar::IDSMPanel::CyclicTransmissionMode
{
  if(@this == 1)
  {
    setTimer(sendTimer, 50);
    ManageControls(0);
  }
  else
  {
    cancelTimer(sendTimer);
    ManageControls(1);
  }
}

on timer sendTimer 
{
  SendQSE();
  setTimer(sendTimer, sendTimerDuration);
}

/// <IDSMSendFunctions>
void SendQSE()
{
  int result;
  switch (sendIndex) {
    case(0) :
      IDSM_SendCan(IdsCanId, IdsQSE_EventFrameOnly, elcount(IdsQSE_EventFrameOnly),@sysvar::IDSMPanel::EventID,@sysvar::IDSMPanel::SensorInstanceID);
      break;
    case(1) :
      IDSM_SendCanFd(IdsCanFDId, IdsQSE_canfd, elcount(IdsQSE_canfd),@sysvar::IDSMPanel::EventID,@sysvar::IDSMPanel::SensorInstanceID);
      break;
    case(2) :
      IDSM_SendCanTp(IdsCanTpIdTx, IdsCanTpIdRx, IdsQSE_128byteData, elcount(IdsQSE_128byteData),@sysvar::IDSMPanel::EventID,@sysvar::IDSMPanel::SensorInstanceID);
      break;
  }
  ++sendIndex;
  if( sendIndex == 3)
    sendIndex = 0;
}

/// <Panel>
// panel logic
on sysvar sysvar::IDSMPanel::Button_Send
{
  if(@this)
  {
    switch(@IDSMPanel::Bus_Protocol)
    {
      case sysvar::IDSMPanel::Bus_Protocol::CAN:
        IDSM_SendCan(IdsCanId, IdsQSE_EventFrameOnly, elcount(IdsQSE_EventFrameOnly),@sysvar::IDSMPanel::EventID,@sysvar::IDSMPanel::SensorInstanceID);
        break;
      case sysvar::IDSMPanel::Bus_Protocol::CAN_FD:
        IDSM_SendCanFd(IdsCanFDId, IdsQSE_canfd, elcount(IdsQSE_canfd),@sysvar::IDSMPanel::EventID,@sysvar::IDSMPanel::SensorInstanceID);
        break;
      case sysvar::IDSMPanel::Bus_Protocol::CAN_TP:
        IDSM_SendCanTp(IdsCanTpIdTx, IdsCanTpIdRx, IdsQSE_128byteData, elcount(IdsQSE_128byteData),@sysvar::IDSMPanel::EventID,@sysvar::IDSMPanel::SensorInstanceID);
        break;
    }
  }
}

/// <Panel>
void ManageControls(int enable)
{
  enableControl("IDSM","ButtonSend",enable);
  enableControl("IDSM","GroupBoxProtocol",enable);
  enableControl("IDSM","GroupBoxEventFrame",enable);
}

/// <IDSMSendFunctions>
/**
 * @brief Send an IDS Message other CAN-TP.
 * @param txID CAN ID used for sending CAN-TP frames.
 * @param rxID CAN ID used for receiving CAN-TP frames.
 * @param data Raw data of the IDS Message.
 */
void IDSM_SendCanTp(dword txID, dword rxID, byte data[], dword size, int EventId,byte SensorId)
{
  long handle;
  byte buffer[4]; // event id
  
  if(size > elCount(data))
  {
    return;
  }
  
  handle = CanTpCreateConnection(0);
  if (handle <= 0)
  {
    writeLineEx(1, 3, "<%BASE_FILE_NAME%> Client_SendCanTp() - CanTpCreateConnection(...) failed");
  }
  CanTpSetTxIdentifier(handle, txID);
  CanTpSetRxIdentifier(handle, rxID);
  CanTpSetBlockSize(handle,4);
  
    // set event id
  buffer.dword(0) = EventId; 
  data.byte(3) = buffer[1];
  data.byte(4) = buffer[0];
  // set sensor Instance Id
  data.byte(2) &=  0xC0;
  data.byte(2) = SensorId | 0xC0;
  
  CanTpSendData(handle, data, size);
}

/// <IDSMSendFunctions>
/**
 * @brief Send an IDS Message other CAN.
 * @param id CAN ID used for sending.
 * @param data Raw data of the IDS Message.
 */
void IDSM_SendCan(dword id, byte data[], dword size,int EventId,byte SensorId)
{
  int i;
  message * msg;
  byte buffer[4]; // event id
  
  if (size > 8)
  {
    writeLineEx(1, 3, "<%BASE_FILE_NAME%> Client_SendCan() - Can only send max 8 Byte long CAN Frames.");
    return;
  }
  
  msg.id = id;
  msg.DLC = size;
  for (i = 0; i < size; i++)
  {
    msg.BYTE(i) = data[i];
  }
  // set event id
  buffer.dword(0) = EventId; 
  msg.byte(3) = buffer[1];
  msg.byte(4) = buffer[0];
  // set sensor Instance Id
  msg.byte(2) &=  0xC0;
  msg.byte(2) = SensorId | msg.byte(2);
  output(msg);
}

/// <IDSMSendFunctions>
/**
 * @brief Send an IDS Message other CAN FD.
 * @param id CAN ID used for sending.
 * @param data Raw data of the IDS Message.
 */
void IDSM_SendCanFd(dword id, byte data[], dword size, int EventId,byte SensorId)
{
  int i;
  message * msg;
  byte buffer[4]; // event id
  
  if(elCount(data) < size)
  {
    return;
  }

  if (size <= 8)
  {
    msg.DLC = size;
  }
  else if (size <= 12)
  {
    msg.DLC = 9;
  }
  else if (size <= 16)
  {
    msg.DLC = 10;
  }
  else if (size <= 20)
  {
    msg.DLC = 11;
  }
  else if (size <= 24)
  {
    msg.DLC = 12;
  }
  else if (size <= 32)
  {
    msg.DLC = 13;
  }
  else if (size <= 48)
  {
    msg.DLC = 14;
  }
  else if (size <= 64)
  {
    msg.DLC = 15;
  }
  else
  {
    writeLineEx(1, 3, "<%BASE_FILE_NAME%> Client_SendCanFd() - Can only send max 64 Byte long CAN FD Frames.");
    return;
  }

  msg.FDF = 1;  
  msg.id = id;
  for (i = 0; i < size; i++)
  {
    msg.BYTE(i) = data[i];
  }
  
  // set event id
  buffer.dword(0) = EventId; 
  msg.byte(3) = buffer[1];
  msg.byte(4) = buffer[0];
  // set sensor Instance Id
  msg.byte(2) &=  0xC0;
  msg.byte(2) = SensorId | msg.byte(2);
    
  output(msg);
}