/*@!Encoding:65001*/
includes
{

}

variables
{
  // CAN-TP
  dword IdsCanTpIdRx = 0x12;
  dword IdsCanTpIdTx = 0x13;
}

on start
{
  SetupTPConnection(IdsCanTpIdRx,IdsCanTpIdTx);
}

// setup basic tp connection 
void SetupTPConnection(dword CanTpIdRx,dword CanTpIdTx )
{
  long handle;
  
  handle = CanTpCreateConnection(0);
  if (handle <= 0)
  {
    writeLineEx(1, 3, "<%BASE_FILE_NAME%> Client_SendCanTp() - CanTpCreateConnection(...) failed");
  }
  CanTpSetTxIdentifier(handle, CanTpIdTx);
  CanTpSetRxIdentifier(handle, CanTpIdRx);
}