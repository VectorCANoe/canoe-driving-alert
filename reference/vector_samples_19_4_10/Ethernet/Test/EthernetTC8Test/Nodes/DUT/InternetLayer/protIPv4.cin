/*@!Encoding:1252*/
/***************************************************************************************
 * Demo- and Example-Programs
 *
 * Please note: The demo and example programs only show special aspects of the software.
 * With regard to the fact that these programs are meant for demonstration purposes only,
 * Vector Informatik's liability shall be expressly excluded in cases of ordinary
 * negligence, to the extent admissible by law or statute.
 *
 * Beta-Version
 *
 * These programs are fully operative programs. However, they are not thoroughly tested
 * yet (beta-version). With regard to the fact that the programs are a beta-version only,
 * Vector Informatik's liability shall be expressly excluded in cases of ordinary
 * negligence, to the extent admissible by law or statute.
 *
 * DESCRIPTION:
 *
 * Demo test implementation of the 'OPEN Alliance Automotive Ethernet ECU Test
 * Specification - TC8 ECU Test' (Document Version 2.0, August 23, 2017)
 *
 * Copyright (c) Vector Informatik GmbH. All rights reserved.
 ***************************************************************************************/

includes
{
  #include "protICMPv4.cin"
  #include "../TransportLayer/protUDP.cin"
  #include "../TransportLayer/protTCP.cin"
  #include "../TransportLayer/protTCPIPStackCallback.cin"
  #include "../ApplicationLayer/protSOMEIP.cin"
  
}

variables
{  
  enum IPv4_Protocol
  {
    IPv4_Prot_ICMPv4 = 1,
    IPv4_Prot_IGMP = 2,
    IPv4_Prot_TCP = 6,
    IPv4_Prot_UDP = 17,
    
    IPv4_Prot_Invalid = 0xFF
  };
  
  struct _Token_IPv4
  {
    dword dwSource;
    dword dwDestination;
    enum IPv4_Protocol protocol;
    byte bIhl;    // Internet Header length
    int offset; // bit offset for upper layer
    byte bflags_MF; // More Fragments of Control Flags

    struct _Token_UDP udp;
    struct _Token_TCP tcp;
    struct _Token_ICMPv4 icmpv4;
  };
  
}

/// <initialize>
// initialization IPv4 Token data from received ethernet packet
void initIpv4TokenData(struct _Token_IPv4 data)
{
  int i;
  data.dwSource = 0;  
  data.dwDestination = 0;  
  data.protocol = IPv4_Prot_Invalid;  
  data.bIhl = 0;  
  data.offset = 0;
  data.bflags_MF = 0;
  
  initIcmpv4TokenData(data.icmpv4);
  initUdpTokenData(data.udp);
  initTcpTokenData(data.tcp);
}

/// <getPacketData>
// get the IPv4 token data 
int getIpv4Packet(struct _Token_IPv4 data, long handle)
{
  int iRet;
  
  iRet = 0;
    
  getIpv4PacketHeaderData(data, handle);
  
  switch(data.protocol)
  {
    // ICMPv4
    case IPv4_Prot_ICMPv4:
      iRet = getIcmpv4Packet(data.icmpv4, handle);
      break;
    // TCP
    case IPv4_Prot_TCP:
      iRet = getTcpPacket(data.tcp, handle);
      break;
    // UDP
    case IPv4_Prot_UDP:
      iRet = getUdpPacket(data.udp, handle);
      break;
    // other
    default:
      // Send ICMP Destination Unreachable for unknown protocol(e.g.0x8F)
      // Continue the process if the received frame is not ICMPv4, TCP and UDP
      iRet = 1;
      break;
  }  
  
  return iRet;
}

/// <getPacketData>
// get IPv4 Packet Header Data
void getIpv4PacketHeaderData(struct _Token_IPv4 data, long handle)
{
  data.bIhl = EthGetTokenInt(handle, "ipv4", "ihl");
  data.protocol = (enum IPv4_Protocol)EthGetTokenInt(handle, "ipv4", "protocol");
  data.bflags_MF = EthGetTokenInt(handle, "ipv4", "flags") & 0x01;
  
  data.dwDestination = EthGetTokenInt(handle, "ipv4", "destination", kBYTE_OFFSET, kBYTE_LENGTH_IP, kBYTE_ORDER_INTEL);
  data.dwSource = EthGetTokenInt(handle, "ipv4", "source", kBYTE_OFFSET, kBYTE_LENGTH_IP, kBYTE_ORDER_INTEL);
}

/// <sendPacket/constructHeader>
// construct IPv4 header packet handle
void constructIpv4Header(dword srcIpAddr, dword dstIpAddr, long lPacketHandle)
{
  EthInitProtocol(lPacketHandle, "ipv4");
  EthSetTokenInt(lPacketHandle, "ipv4", "source", kBYTE_OFFSET, kBYTE_LENGTH_IP, kBYTE_ORDER_INTEL, srcIpAddr);
  EthSetTokenInt(lPacketHandle, "ipv4", "destination", kBYTE_OFFSET, kBYTE_LENGTH_IP, kBYTE_ORDER_INTEL, dstIpAddr);
}

/// <sendPacket>
// construct IPv4 packet handle
// ret 1:succeed 0:failed
int constructIpv4Packet(struct _Token_IPv4 data, long lPacketHandle)
{
  int iRet;
  
  iRet = 0;
  
  constructIpv4Header(data.dwSource, data.dwDestination, lPacketHandle);
 
  // make upper layer packet
  switch(data.protocol)
  {
    // ICMPv4
    case IPv4_Prot_ICMPv4:
      iRet = constructIcmpv4Packet(data, lPacketHandle);
      break;
    // TCP
    case IPv4_Prot_TCP:
      iRet = constructTcpPacket(data.tcp, lPacketHandle);
      break;
    // UDP
    case IPv4_Prot_UDP:
      iRet = constructUdpPacket(data.udp, lPacketHandle);
      break;
      
    default:
      break;
  }
  
  return iRet;
}

/// <makePacketData>
// make IPv4 packet
// return 1:receive is nessasary  0:receive is unnecessary
int makeIpv4Packet(struct _Token_Eth_Packet recvData, struct _Token_IPv4 sendData)
{
  int iRet;
  
  iRet = 0;
  
  sendData.dwSource = recvData.ipv4.dwDestination;
  sendData.dwDestination = recvData.ipv4.dwSource;
 
  // make upper layer packet
  switch(recvData.ipv4.protocol)
  {
    // ICMPv4
    case IPv4_Prot_ICMPv4:
      sendData.protocol = IPv4_Prot_ICMPv4;
      iRet = makeIcmpv4Packet(recvData, sendData);
      break;
    // TCP
    case IPv4_Prot_TCP:
      sendData.protocol = IPv4_Prot_TCP;
      break;
    // UDP
    case IPv4_Prot_UDP:
      sendData.protocol = IPv4_Prot_UDP;
        iRet = makeUdpPacket(recvData.ipv4.udp, sendData.udp);
      break;
      
    default:
      // Send ICMP Destination Unreachable for unknown protocol(e.g.0x8F)
      // Send if the received frame is not ICMPv4, TCP and UDP
      sendData.protocol = IPv4_Prot_ICMPv4;
      iRet = makeIcmpv4Packet(recvData, sendData);
      break;
  }
  return iRet;
}

/// <processPacketData>
// process when IPv4 protocol received
// ret 1:succeed 0:failued
// This function should be removed if TCP/IP stack is used.
int procIpv4(struct _Token_IPv4 recvData)
{
  int iRet;
  
  iRet = 0;
  
  switch(recvData.protocol)
  {
    // ICMPv4
    case IPv4_Prot_ICMPv4:
      // now handled in OnIpReceivePrepare callback
      break;
    // TCP
    case IPv4_Prot_TCP:
      //@@@ remove because TCP/IP stack is used.
//      iRet = procTcp(recvData.tcp);
      break;
    // UDP
    case IPv4_Prot_UDP:
      //@@@ remove because TCP/IP stack is used.
//      iRet = procUdp(recvData.udp);
      break;
      
    default:
      break;
  }  

  return iRet;
}

int ConvertSubnetMaskToCidr(char subnetMask[])
{
  long       res;
  ip_Address subnetIp;
  byte       subnetArray[16];
  byte       ipv4Buf[4];
  int        i;
  byte       b;
  
  if(subnetIp.ParseAddressFromString(subnetMask) != 0)
    return -1;
  
  if(subnetIp.GetAddressAsArray(subnetArray) !=0)
  {
    if(subnetIp.GetAddressAsArray(ipv4Buf) == 0)
      memcpy(subnetArray, ipv4Buf, elcount(ipv4Buf));
    else
      return -1;
  }
  
  for(i = 0; i < elcount(subnetArray); i++)
  {
    if(subnetArray[i] != 0xFF)
      break;
  }
  
  b = i < elcount(subnetArray) ? subnetArray[i] : 0;
  i = i * 8;
  while(b >> 7 != 0)
  {
    b = b << 1;
    i++;
  }
  
  return i;
}

// initialize IPv4/IPv6 address
int initIpAddress()
{
  int prefix;
  long res, countAdapters, adapterIdx;
  IP_Address addr;
  qword macAddress;
  char buffer[100];
  IP_Address addresses[10];
  dword addressesCount;
  
  if(IpGetAdapterMacId(1)!=0)
    writeLineEx(0, 2, "Ignoring MAC address of DUT configured via 'TCP/IP Stack', using parameter DIface0MacAddr defined in GeneralTestParameters.vparam");
    
  sysGetVariableString(sysvar::Internal::DIface0MacAddr, buffer, elcount(buffer));  
  macAddress = ethGetMacAddressAsNumber(buffer);
  res = ipSetAdapterMacId(1, macAddress);
  if(res!=0)
  {
    writeLineEx(0, 3,"Setting MAC address of DUT failed");
    stop();
    return res;
  }
 
  countAdapters = IpGetAdapterCount();
  for(adapterIdx=1; adapterIdx<=countAdapters; ++adapterIdx)
  {
    ipGetAdapterAddress(adapterIdx, addresses, addressesCount);   
    
    if(addressesCount>0)
    {
      dword addressIdx;
      byte  ipv6Addr[16];
      
      for(addressIdx = 0; addressIdx < addressesCount; ++addressIdx)
      {
        // skip IPv6 Link-Local address which is automatically configured
        if(addresses[addressIdx].IsIPv6Address() && addresses[addressIdx].GetAddressAsArray(ipv6Addr) == 0 && ipv6Addr[0] == 0xFE && ipv6Addr[1] == 0x80)
        {
          continue;
        }
        else
        {
          writeLineEx(0, 3, "Please remove all DUT ip addresses configured via 'TCP/IP Stack'. Address will be set using parameter DIface0Ip defined in GeneralTestParameters.vparam");
          stop();
          return 1;
        }
      }
    }
  }

  sysGetVariableString(sysvar::Internal::DIface0Ip, buffer, elcount(buffer));  
    
  res = addr.ParseAddressFromString(buffer);
  if (res == 0)
  {
    
    sysGetVariableString(sysvar::Internal::Host1SubnetMaskTester, buffer, elcount(buffer)); 
    prefix = ConvertSubnetMaskToCidr(buffer);
    res = ipAddAdapterAddress(kdwIPV4_INTERFACE_INDEX, addr, prefix);
    if(res != 0)
    {
      sysGetVariableString(sysvar::Internal::DIface0Ip, buffer, elcount(buffer));  
      writeLineEx(0, 3, "DUT setting adapter address failed, IpAddAdapterAddress returned error %d, address: %s, prefix: %d", res, buffer, prefix);
      if(addr.IsIPv4Address())
        writeLineEx(0, 3, "Please ensure that 'IPv4 Enabled' is selected for this network");
      else
        writeLineEx(0, 3, "Please ensure that 'IPv6 Enabled' is selected for this network");
      stop();
    }
    else
    {
      sysGetVariableString(sysvar::Internal::DIface0Ip, buffer, elcount(buffer));  
      write("DUT ipAddAdapterAddress returned %d, address: %s, prefix: %d", res, buffer, prefix);
    }
  }
  else
  {
   write("ERROR: DUT addr.ParseAddressFromString(%s) returned error %d", buffer, res);
  }
  
  // Open UDP port for Testability
  initTestabilityUDPSocket();
  
  //initialize UDP socket handle array
  initUDPSocketArray();

  //initialize TCP socket handle array
  initTCPSocketArray();
  
  return res;
}

int removeIpAddress()
{
  const dword AF_INET = 2;   // IPv4 adapter family
  const dword AF_INET6 = 28; // IPv6 adapter family
  
  long res;
  IP_Address addr;
  IP_Address addresses[10];
  char buffer[100];
  int prefix;
  dword count, i;

  sysGetVariableString(sysvar::Internal::Host1SubnetMaskTester, buffer, elcount(buffer)); 
  prefix = ConvertSubnetMaskToCidr(buffer);

  sysGetVariableString(sysvar::Internal::DIface0Ip, buffer, elcount(buffer)); 
  res = addr.ParseAddressFromString(buffer);
  if (res == 0)
  {
    res = IpGetAdapterAddress(kdwIPV4_INTERFACE_INDEX, addresses, count);
    if(res==0)
    {
      for(i=0; i<count; ++i)
      {
        if(addr.MatchesAddress(addresses[i]))
        {
          res = ipRemoveAdapterAddress(kdwIPV4_INTERFACE_INDEX, addr, prefix);
          if(res != 0)
          {
            write("ERROR: DUT ipRemoveAdapterAddress returned error %d, address %s", res, buffer);
          }
          else
          {
             write("INFO: DUT ipRemoveAdapterAddress returned %d, address %s", res, buffer);
          }
          return res;
        }
      }
    }
    else
    {
      write("ERROR: DUT IpGetAdapterAddress returned error %d", res);
    }
  }
  
  return res;  
}
