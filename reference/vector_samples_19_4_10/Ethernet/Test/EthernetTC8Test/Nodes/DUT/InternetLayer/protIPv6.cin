/*@!Encoding:1252*/
/***************************************************************************************
 * Demo- and Example-Programs
 *
 * Please note: The demo and example programs only show special aspects of the software.
 * With regard to the fact that these programs are meant for demonstration purposes only,
 * Vector Informatik's liability shall be expressly excluded in cases of ordinary
 * negligence, to the extent admissible by law or statute.
 *
 * Beta-Version
 *
 * These programs are fully operative programs. However, they are not thoroughly tested
 * yet (beta-version). With regard to the fact that the programs are a beta-version only,
 * Vector Informatik's liability shall be expressly excluded in cases of ordinary
 * negligence, to the extent admissible by law or statute.
 *
 * DESCRIPTION:
 *
 * Demo test implementation of the 'OPEN Alliance Automotive Ethernet ECU Test
 * Specification - TC8 ECU Test' (Document Version 2.0, August 23, 2017)
 *
 * Copyright (c) Vector Informatik GmbH. All rights reserved.
 ***************************************************************************************/

includes
{
}

variables
{  
  struct _Token_IPv6
  {
    byte dwSource[16];
    byte dwDestination[16];
    enum IPv4_Protocol next; // same values as IPv4.protocol;
    int offset; // bit offset for upper layer

    struct _Token_UDP udp;
    struct _Token_TCP tcp;
    //struct _Token_ICMPv6 icmpv6;
  };

}

/// <initialize>
// initialization IPv6 Token data from received ethernet packet
void initIpv6TokenData(struct _Token_IPv6 data)
{
  int i;
  for(i=0; i<elcount(data.dwSource); ++i)
  {
    data.dwSource[i] = 0;
    data.dwDestination[i] = 0;
  }
  data.next = IPv4_Prot_Invalid;  
  data.offset = 0;
  
  //initIcmpv4TokenData(data.icmpv4);
  initUdpTokenData(data.udp);
  initTcpTokenData(data.tcp);
}

/// <getPacketData>
// get the IPv6 token data 
int getIpv6Packet(struct _Token_IPv6 data, long handle)
{
  int iRet;
  
  iRet = 0;
    
  getIpv6PacketHeaderData(data, handle);
  
  switch(data.next)
  {
    // ICMPv6
    //case IPv4_Prot_ICMPv6:
    //  iRet = getIcmpv6Packet(data.icmpv6, handle);
    //  break;
    // TCP
    case IPv4_Prot_TCP:
      iRet = getTcpPacket(data.tcp, handle);
      break;
    // UDP
    case IPv4_Prot_UDP:
      iRet = getUdpPacket(data.udp, handle);
      break;
    // other
    default:
      // Send ICMP Destination Unreachable for unknown protocol(e.g.0x8F)
      // Continue the process if the received frame is not ICMPv6, TCP and UDP
      iRet = 1;
      break;
  }  
  
  return iRet;
}

/// <getPacketData>
// get IPv6 Packet Header Data
void getIpv6PacketHeaderData(struct _Token_IPv6 data, long handle)
{
  data.next = (enum IPv4_Protocol)EthGetTokenInt(handle, "ipv6", "next");
  
  EthGetTokenData(handle, "ipv6", "destination", elcount(data.dwDestination), data.dwDestination);
  EthGetTokenData(handle, "ipv6", "source", elcount(data.dwSource), data.dwSource);
}

/// <sendPacket/constructHeader>
// construct IPv6 header packet handle
void constructIpv6Header(byte srcIpAddr[], byte dstIpAddr[], long lPacketHandle)
{
  EthInitProtocol(lPacketHandle, "ipv6");
  EthSetTokenData(lPacketHandle, "ipv6", "destination", elcount(dstIpAddr), dstIpAddr);
  EthSetTokenData(lPacketHandle, "ipv6", "source", elcount(srcIpAddr), srcIpAddr);
}

/// <sendPacket>
// construct IPv6 packet handle
// ret 1:succeed 0:failed
int constructIpv6Packet(struct _Token_IPv6 data, long lPacketHandle)
{
  int iRet;
  iRet = 0;
  
  constructIpv6Header(data.dwSource, data.dwDestination, lPacketHandle);
 
  // make upper layer packet
  switch(data.next)
  {
    // ICMPv6
    //case IPv4_Prot_ICMPv6:
    //  iRet = constructIcmpv4Packet(data, lPacketHandle);
    //  break;
    // TCP
    case IPv4_Prot_TCP:
      iRet = constructTcpPacket(data.tcp, lPacketHandle);
      break;
    // UDP
    case IPv4_Prot_UDP:
      iRet = constructUdpPacket(data.udp, lPacketHandle);
      break;
      
    default:
      break;
  }
  
  return iRet;
}

/// <makePacketData>
// make IPv6 packet
// return 1:receive is nessasary  0:receive is unnecessary
int makeIpv6Packet(struct _Token_Eth_Packet recvData, struct _Token_IPv6 sendData)
{
  int iRet,i;
  iRet = 0;
  
  for(i=0; i<elcount(sendData.dwSource); ++i)
  {
    sendData.dwSource[i] = recvData.ipv6.dwDestination[i];
    sendData.dwDestination[i] = recvData.ipv6.dwSource[i];
  }
  
  // make upper layer packet
  switch(recvData.ipv6.next)
  {
    // ICMPv4
    //case IPv4_Prot_ICMPv6:
    //  sendData.protocol = IPv4_Prot_ICMPv6;
    //  iRet = makeIcmpv6Packet(recvData, sendData);
    //  break;
    // TCP
    case IPv4_Prot_TCP:
      sendData.next = IPv4_Prot_TCP;
      break;
    // UDP
    case IPv4_Prot_UDP:
      sendData.next = IPv4_Prot_UDP;
        iRet = makeUdpPacket(recvData.ipv6.udp, sendData.udp);
      break;
      
    default:
      // Send ICMP Destination Unreachable for unknown protocol(e.g.0x8F)
      // Send if the received frame is not ICMPv4, TCP and UDP
      //sendData.next = IPv4_Prot_ICMPv6;
      //iRet = makeIcmpv6Packet(recvData, sendData);
      break;
  }
  return iRet;
}
