/*@!Encoding:1252*/
/***************************************************************************************
 * Demo- and Example-Programs
 *
 * Please note: The demo and example programs only show special aspects of the software.
 * With regard to the fact that these programs are meant for demonstration purposes only,
 * Vector Informatik's liability shall be expressly excluded in cases of ordinary
 * negligence, to the extent admissible by law or statute.
 *
 * Beta-Version
 *
 * These programs are fully operative programs. However, they are not thoroughly tested
 * yet (beta-version). With regard to the fact that the programs are a beta-version only,
 * Vector Informatik's liability shall be expressly excluded in cases of ordinary
 * negligence, to the extent admissible by law or statute.
 *
 * DESCRIPTION:
 *
 * Demo test implementation of the 'OPEN Alliance Automotive Ethernet ECU Test
 * Specification - TC8 ECU Test' (Document Version 2.0, August 23, 2017)
 *
 * Copyright (c) Vector Informatik GmbH. All rights reserved.
 ***************************************************************************************/

includes
{
  #include "SOMEIP_ETS_HelperFunctions.cin"
}

variables
{
  char gETSProcessName[12] = "DUT";
}

void ReportSomeIpError(char msg[])
{
  char buffer[1024];
  if((SomeIpGetLastErrorText(elcount(buffer),buffer)) != 0)
  {
     write("%.5f %s: %s. SOME/IP IL error %d: %s", timeNowFloat()/100000.0, gETSProcessName , msg, SomeIpGetLastError(), buffer);
  }
  else
  {
    write(msg);
  }
  write(msg);
}

void SetTestMethodResult(dword result)
{
  // not used on DUT
}

// Returns the instance id of the Tester ETS server
dword GetInstanceIdOfConsumedETS()
{
  return @sysvar::TC8_ETS_Config::ETS_Tester_ServiceInstanceId;
}
