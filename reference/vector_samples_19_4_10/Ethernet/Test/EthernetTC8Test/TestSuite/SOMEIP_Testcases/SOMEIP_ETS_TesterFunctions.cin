/*@!Encoding:1252*/
/***************************************************************************************
 * Demo- and Example-Programs
 *
 * Please note: The demo and example programs only show special aspects of the software.
 * With regard to the fact that these programs are meant for demonstration purposes only,
 * Vector Informatik's liability shall be expressly excluded in cases of ordinary
 * negligence, to the extent admissible by law or statute.
 *
 * Beta-Version
 *
 * These programs are fully operative programs. However, they are not thoroughly tested
 * yet (beta-version). With regard to the fact that the programs are a beta-version only,
 * Vector Informatik's liability shall be expressly excluded in cases of ordinary
 * negligence, to the extent admissible by law or statute.
 *
 * DESCRIPTION:
 *
 * Demo test implementation of the 'OPEN Alliance Automotive Ethernet ECU Test
 * Specification - TC8 ECU Test' (Document Version 3.0, May 7, 2020)
 *
 * Copyright (c) Vector Informatik GmbH. All rights reserved.
 ***************************************************************************************/

includes
{
  #include "..\..\Nodes\DUT\ApplicationLayer\SOMEIP_ETS_HelperFunctions.cin"
}

variables
{
  msTimer gWaitConditionReachedTimer;
  
  byte gWaitingForEventNotificationsCount[long];
  enum Bool gWaitingForEventNotifications = kFalse,
    gEventNotificationReceived_TestEventUINT8 = kFalse,
    gEventNotificationReceived_TestEventUINT8Array = kFalse,
    gEventNotificationReceived_TestEventUINT8Reliable = kFalse;
    
  byte gWaitingForFieldNotificationsCount[long];
  enum Bool gWaitingForFieldNotifications = kFalse,
    gFieldNotificationReceived_InterfaceVersion = kFalse,
    gFieldNotificationReceived_TestFieldUINT8 = kFalse,
    gFieldNotificationReceived_TestFieldUINT8Array = kFalse,
    gFieldNotificationReceived_TestFieldUINT8Reliable = kFalse;
 
  enum Bool gWaitingForSubscribeAckEventgroups[long],
    gWaitingForSubscribeAcks=kFalse;
  
  int gSubscribedEventgroupId = -1;
  
  enum Bool gResponseOfFirstMethodReceived = kFalse,  gResponseOfSecondMethodReceived = kFalse;
  
  dword gMultiCallExpectedNumberOfResponses, gMultiCallReceivedNumberOfResponses;
  dword gMultiCallResults[long];
  dword gMultiCallResultTypes[long];
  enum Bool gMultiCallAllResponsesOk, gWaitForConnectionToDutEstablishedDone=kFalse;

  dword gExpectedResult_checkByteOrder;
  
  dword gExpectedResult_echoBitfields[3];

  struct _echoCommonDatatypesArgs gExpectedResult_echoCommonDatatypes;

  byte gExpectedResult_echoENUM;
  float gExpectedResult_echoFLOAT64;
  int gExpectedResult_echoINT8;
  
  const byte gEchoStaticUINT8Array_Length = 5;
  byte gExpectedResult_echoStaticUINT8Array[gEchoStaticUINT8Array_Length];

  byte gExpectedResult_echoUINT8;

  byte gExpectedResult_echoUINT8Reliable;
  
  const byte gEchoUINT8Array_Length = 5;
  byte gExpectedResult_echoUINT8Array[gEchoUINT8Array_Length];

  const byte gEchoUINT8Array16BitLength_Length = 5;
  byte gExpectedResult_echoUINT8Array16BitLength[gEchoUINT8Array16BitLength_Length];
  
  const byte gEchoUINT8Array8BitLength_Length = 5;
  byte gExpectedResult_echoUINT8Array8BitLength[gEchoUINT8Array8BitLength_Length];

  const byte gEchoUINT8ArrayMinSize_Length = 4;
  byte gExpectedResult_echoUINT8ArrayMinSize[gEchoUINT8ArrayMinSize_Length];
  
  const byte gEchoUINT8Array2Dim_Length1 = 5;
  const byte gEchoUINT8Array2Dim_Length2 = 3;
  byte gExpectedResult_echoUINT8Array2Dim[gEchoUINT8Array2Dim_Length1][gEchoUINT8Array2Dim_Length2];
  
  dword gExpectedResult_echoUNION;
  dword gExpectedResult_echoUNION_validIndex;
  
  const byte gUTFStringMaxLen = 64;
  char gExpectedResult_echoUTF16DYNAMIC[32] = "Some UTF16 text";

  char gExpectedResult_echoUTF8DYNAMIC[32] = "Some UTF8 text";

  const byte UTF16FIXED_ENCODED_SIZE = 64;
  const byte UTF16BOM_SIZE = 2;
  const byte UTF16TERMINATION_SIZE = 2;
  const byte UTF16FIXED_STRING_LEN = (UTF16FIXED_ENCODED_SIZE - UTF16BOM_SIZE)/2;
  char gExpectedResult_echoUTF16FIXED[UTF16FIXED_STRING_LEN];

  const byte UTF8FIXED_ENCODED_SIZE = 64;
  const byte UTF8BOM_SIZE = 3;
  const byte UTF8TERMINATION_SIZE = 1;
  const byte UTF8FIXED_STRING_LEN = (UTF8FIXED_ENCODED_SIZE - UTF8BOM_SIZE);
  char gExpectedResult_echoUTF8FIXED[UTF8FIXED_STRING_LEN];

  struct _InterfaceVersion gResponseValue_GetterInterfaceVersion;
  
  dword gStoredValueTestFieldUINT8, gResponseValue_GetterTestFieldUINT8=0xff,
    gRequestedValue_SetterTestFieldUINT8, gResponseValue_SetterTestFieldUINT8;

  dword gStoredValueTestFieldUINT8Reliable, gResponseValue_GetterTestFieldUINT8Reliable=0xff,
    gRequestedValue_SetterTestFieldUINT8Reliable, gResponseValue_SetterTestFieldUINT8Reliable;
  
  struct _TestFieldUINT8Array gStoredValuesTestFieldUINT8Array, gResponseValues_GetterTestFieldUINT8Array,
    gRequestedValues_SetterTestFieldUINT8Array, gResponseValues_SetterTestFieldUINT8Array;
  
  const byte UINT8ARRAY_LENGTH = 5;
}

/// <Helper functions>
void RestorePayloadStringTermination(dword payloadSize, byte payload[], byte terminationSize)
{
  int i;
  for(i=0; i<terminationSize; ++i)
    payload[payloadSize-i-1] = 0; // restore termination
}

enum Bool CheckMethodResponse_echoUTF16(dword messageResponseHandle, char argName[], char expectedResult[], dword & errorCode)
{
  char response[gUTFStringMaxLen];
  
  return (enum Bool)
    (CheckResponseReturnCode(messageResponseHandle, 0, errorCode) &&
     GetMethodArgumentStringUTF16(messageResponseHandle, argName, elcount(response), response, errorCode) &&
     CheckResponseDataComparision(strncmp(response, expectedResult, elcount(response))==0, errorCode));
}

/// <Helper functions>
enum Bool CheckMethodResponse_echoUTF8(dword messageResponseHandle, char argName[], char expectedResult[], dword & errorCode)
{
  char response[gUTFStringMaxLen];

  return (enum Bool)
    (CheckResponseReturnCode(messageResponseHandle, 0, errorCode) &&
     GetMethodArgumentStringUTF8(messageResponseHandle, argName, elcount(response), response, errorCode) &&
     CheckResponseDataComparision(strncmp(response, expectedResult, elcount(response))==0, errorCode));
}

/// <Helper functions>
enum Bool CheckResponseReturnCode(dword messageResponseHandle, dword expectedRC, dword & errorCode)
{
  dword returnCode;
  returnCode = SomeIpGetReturnCode(messageResponseHandle);
  if(returnCode!=expectedRC)
  {
    char expected[64], actualResult[64];
    sysGetVariableDescriptionForValue(sysvar::TC8_ETS::ETS_MethodResult, expectedRC, expected, elcount(expected));
    sysGetVariableDescriptionForValue(sysvar::TC8_ETS::ETS_MethodResult, returnCode, actualResult, elcount(actualResult));
    
    // Just set the result. No error message necessary. It will be handled by the function that triggered the call
    errorCode = returnCode;
    return kFalse;
  }
  return kTrue;
}

/// <Helper functions>
enum Bool CheckResponseDataComparision(dword dataIsEqual, dword & errorCode)
{
  if(dataIsEqual==0)
    errorCode = sysvar::TC8_ETS::ETS_MethodResult::InvalidMethodResponseData;

  return dataIsEqual==0 ? kFalse : kTrue;
}

/// <Helper functions>
enum Bool ProvideArgumentsForMethod_echoUINT8Array(dword methodCallHandle, byte arrayLength, byte result[], char argumentName[])
{
  dword count, errorCode;
  char reqBuffer[64];
  int i;
  
  for(i=0; i<arrayLength; ++i)
  {
    result[i] = i + 19;
    snprintf(reqBuffer, elCount(reqBuffer), "%s[%d]", argumentName, i);
    if(SetMethodArgumentDWord(methodCallHandle, reqBuffer, result[i], errorCode)==kFalse)
      return kFalse;
  }

  if(SetMethodArgumentDWord(methodCallHandle, argumentName, arrayLength, errorCode)==kFalse ||
     GetMethodArgumentDWord(methodCallHandle, argumentName, count, errorCode)==kFalse)
    return kFalse;

  if(count!=arrayLength)
  {
    //write("Error: Array size did not change");
    errorCode = sysvar::TC8_ETS::ETS_MethodResult::GeneralFailure;
    return kFalse;
  }

  return kTrue;
}

/// <Helper functions>
enum Bool CheckArraySize(dword messageResponseHandle, char arrayName[], dword expectedSize, dword & errorCode)
{
  dword arraySize;
  return (enum Bool)(
    GetMethodArgumentDWord(messageResponseHandle, arrayName, arraySize, errorCode) &&
    CheckResponseDataComparision(ReportUnequal(arraySize==expectedSize, "array size"), errorCode));
}

/// <Helper functions>
enum Bool CheckResponseOfMethod_echoUINT8Array(dword messageResponseHandle, byte arrayLength, byte expectedResult[],
  char resArgumentName[], dword expectedReturnCode, dword & errorCode)
{
  dword response;
  char resBuffer[64];
  int i;

  if(CheckResponseReturnCode(messageResponseHandle, expectedReturnCode, errorCode) &&
     CheckArraySize(messageResponseHandle, resArgumentName, arrayLength, errorCode))
  {
    for(i=0; i<arrayLength; ++i)
    {
      snprintf(resBuffer, elCount(resBuffer), "%s[%d]", resArgumentName, i);
      if(GetMethodArgumentDWord(messageResponseHandle, resBuffer, response, errorCode)==kFalse ||
         CheckResponseDataComparision(response==expectedResult[i], errorCode)==kFalse)
        return kFalse;
    }
    return kTrue;
  }
  return kFalse;
}

/// <checkByteOrder>
enum Bool ProvideArgumentsForMethod_checkByteOrder(dword methodCallHandle)
{
  dword errorCode;
  stack dword arg1 = 55;
  stack dword arg2 = 65500;
  gExpectedResult_checkByteOrder = arg1 + arg2;

  return (enum Bool)
    (SetMethodArgumentDWord(methodCallHandle, gMethodArgumentName_checkByteOrder_REQ_arg1, arg1, errorCode) &&
     SetMethodArgumentDWord(methodCallHandle, gMethodArgumentName_checkByteOrder_REQ_arg2, arg2, errorCode));
}

/// <checkByteOrder>
void OnMethodResponse_checkByteOrder(dword methodCallHandle, dword messageResponseHandle)
{
  dword value, errorCode;

  if(CheckResponseReturnCode(messageResponseHandle, 0, errorCode)==kFalse)
  {
    SetTestMethodResult(errorCode);
    return;
  }
  
  if(GetMethodArgumentDWord(messageResponseHandle, gMethodArgumentName_checkByteOrder_RES_arg1, value, errorCode) &&
     CheckResponseDataComparision(value==gExpectedResult_checkByteOrder, errorCode))
    SetTestMethodResult(sysvar::TC8_ETS::ETS_MethodResult::OK);
  else
    SetTestMethodResult(errorCode);
}

/// <echoBitfields>
enum Bool ProvideArgumentsForMethod_echoBitfields(dword methodCallHandle)
{
  dword args[3], errorCode;
  args[0] = 0x3F;
  args[1] = 0x7FE0;
  args[2] = 0x7F03E2E0;
  gExpectedResult_echoBitfields[0] = reverseBits(args[0], 8);
  gExpectedResult_echoBitfields[1] = reverseBits(args[1], 16);
  gExpectedResult_echoBitfields[2] = reverseBits(args[2], 32);
  
  return (enum Bool)
    (SetMethodArgumentDWord(methodCallHandle, gMethodArgumentName_echoBitfields_REQ_bitfield8,  args[0], errorCode) &&
     SetMethodArgumentDWord(methodCallHandle, gMethodArgumentName_echoBitfields_REQ_bitfield16, args[1], errorCode) &&
     SetMethodArgumentDWord(methodCallHandle, gMethodArgumentName_echoBitfields_REQ_bitfield32, args[2], errorCode));
}

/// <echoBitfields>
void OnMethodResponse_echoBitfields(dword methodCallHandle, dword messageResponseHandle)
{
  dword args[3], errorCode;
  
  if(CheckResponseReturnCode(messageResponseHandle, 0, errorCode) &&
     GetMethodArgumentDWord(messageResponseHandle, gMethodArgumentName_echoBitfields_RES_bitfield8, args[0], errorCode) &&
     GetMethodArgumentDWord(messageResponseHandle, gMethodArgumentName_echoBitfields_RES_bitfield16, args[1], errorCode) &&
     GetMethodArgumentDWord(messageResponseHandle, gMethodArgumentName_echoBitfields_RES_bitfield32, args[2], errorCode) &&
     CheckResponseDataComparision(args[0]==gExpectedResult_echoBitfields[0] &&
         args[1]==gExpectedResult_echoBitfields[1] && args[2]==gExpectedResult_echoBitfields[2], errorCode))
      SetTestMethodResult(sysvar::TC8_ETS::ETS_MethodResult::OK);
  else
    SetTestMethodResult(errorCode);
}


/// <echoCommonDatatypes>
enum Bool ProvideArgumentsForMethod_echoCommonDatatypes(dword methodCallHandle)
{
  dword errorCode;
  gExpectedResult_echoCommonDatatypes.booleanArg = 1;
  gExpectedResult_echoCommonDatatypes.unsignedArgs[0] = 18;
  gExpectedResult_echoCommonDatatypes.unsignedArgs[1] = 116;
  gExpectedResult_echoCommonDatatypes.unsignedArgs[2] = 132;
  gExpectedResult_echoCommonDatatypes.signedArgs[0] = -28;
  gExpectedResult_echoCommonDatatypes.signedArgs[1] = -23212;
  gExpectedResult_echoCommonDatatypes.signedArgs[2] = -134215;
  gExpectedResult_echoCommonDatatypes.float32Arg = interpretAsFloat(interpretAsDword(18.4)); // force float32 value
  gExpectedResult_echoCommonDatatypes.float64Arg = 29.4;

  return (enum Bool)
    (SetMethodArgumentDWord(methodCallHandle,
       gMethodArgumentName_echoCommonDatatypes_REQ_ARG1_BOOLEAN, gExpectedResult_echoCommonDatatypes.booleanArg, errorCode) &&
     SetMethodArgumentDWord(methodCallHandle,
       gMethodArgumentName_echoCommonDatatypes_REQ_ARG2_UINT8,  gExpectedResult_echoCommonDatatypes.unsignedArgs[0], errorCode) &&
     SetMethodArgumentDWord(methodCallHandle,
       gMethodArgumentName_echoCommonDatatypes_REQ_ARG3_UINT16, gExpectedResult_echoCommonDatatypes.unsignedArgs[1], errorCode) &&
     SetMethodArgumentDWord(methodCallHandle,
       gMethodArgumentName_echoCommonDatatypes_REQ_ARG4_UINT32, gExpectedResult_echoCommonDatatypes.unsignedArgs[2], errorCode) &&
     SetMethodArgumentLong(methodCallHandle,
       gMethodArgumentName_echoCommonDatatypes_REQ_ARG5_INT8,  gExpectedResult_echoCommonDatatypes.signedArgs[0], errorCode) &&
     SetMethodArgumentLong(methodCallHandle,
       gMethodArgumentName_echoCommonDatatypes_REQ_ARG6_INT16, gExpectedResult_echoCommonDatatypes.signedArgs[1], errorCode) &&
     SetMethodArgumentLong(methodCallHandle,
       gMethodArgumentName_echoCommonDatatypes_REQ_ARG7_INT32, gExpectedResult_echoCommonDatatypes.signedArgs[2], errorCode) &&
     SetMethodArgumentFloat(methodCallHandle,
       gMethodArgumentName_echoCommonDatatypes_REQ_ARG8_FLOAT32, gExpectedResult_echoCommonDatatypes.float32Arg, errorCode) &&
     SetMethodArgumentFloat(methodCallHandle,
       gMethodArgumentName_echoCommonDatatypes_REQ_ARG9_FLOAT64, gExpectedResult_echoCommonDatatypes.float64Arg, errorCode));  
}

/// <Helper functions>
dword ReportUnequal(dword isEqual, char descr[])
{
  if(isEqual==0)
    write("Method response contains wrong value: %s", descr);
  return isEqual;
}

/// <echoCommonDatatypes>
void OnMethodResponse_echoCommonDatatypes(dword methodCallHandle, dword messageResponseHandle)
{
  dword errorCode;
  struct _echoCommonDatatypesArgs response;
  if(CheckResponseReturnCode(messageResponseHandle, 0, errorCode) &&
     GetMethodArgumentFloat(messageResponseHandle, gMethodArgumentName_echoCommonDatatypes_RES_ARG1_FLOAT64, response.float64Arg, errorCode) &&
     GetMethodArgumentFloat(messageResponseHandle, gMethodArgumentName_echoCommonDatatypes_RES_ARG2_FLOAT32, response.float32Arg, errorCode) &&
     GetMethodArgumentLong(messageResponseHandle,  gMethodArgumentName_echoCommonDatatypes_RES_ARG3_INT32,   response.signedArgs[2], errorCode) &&
     GetMethodArgumentLong(messageResponseHandle,  gMethodArgumentName_echoCommonDatatypes_RES_ARG4_INT16,   response.signedArgs[1], errorCode) &&
     GetMethodArgumentLong(messageResponseHandle,  gMethodArgumentName_echoCommonDatatypes_RES_ARG5_INT8,    response.signedArgs[0], errorCode) &&
     GetMethodArgumentDWord(messageResponseHandle, gMethodArgumentName_echoCommonDatatypes_RES_ARG6_UINT32,  response.unsignedArgs[2], errorCode) &&
     GetMethodArgumentDWord(messageResponseHandle, gMethodArgumentName_echoCommonDatatypes_RES_ARG7_UINT16,  response.unsignedArgs[1], errorCode) &&
     GetMethodArgumentDWord(messageResponseHandle, gMethodArgumentName_echoCommonDatatypes_RES_ARG8_UINT8,   response.unsignedArgs[0], errorCode) &&
     GetMethodArgumentDWord(messageResponseHandle, gMethodArgumentName_echoCommonDatatypes_RES_ARG9_BOOLEAN, response.booleanArg, errorCode) &&
     CheckResponseDataComparision(
         response.booleanArg==gExpectedResult_echoCommonDatatypes.booleanArg &&
         response.unsignedArgs[0]==gExpectedResult_echoCommonDatatypes.unsignedArgs[0] &&
         response.unsignedArgs[1]==gExpectedResult_echoCommonDatatypes.unsignedArgs[1] &&
         response.unsignedArgs[2]==gExpectedResult_echoCommonDatatypes.unsignedArgs[2] &&
         response.signedArgs[0]==gExpectedResult_echoCommonDatatypes.signedArgs[0] &&
         response.signedArgs[1]==gExpectedResult_echoCommonDatatypes.signedArgs[1] &&
         response.signedArgs[2]==gExpectedResult_echoCommonDatatypes.signedArgs[2] &&
         ReportUnequal(response.float32Arg==gExpectedResult_echoCommonDatatypes.float32Arg, "float32 member") &&
         ReportUnequal(response.float64Arg==gExpectedResult_echoCommonDatatypes.float64Arg, "float64 member"), errorCode))
    SetTestMethodResult(sysvar::TC8_ETS::ETS_MethodResult::OK);
  else
    SetTestMethodResult(errorCode);
}

/// <echoENUM>
enum Bool ProvideArgumentsForMethod_echoENUM(dword methodCallHandle)
{
  dword errorCode;
  gExpectedResult_echoENUM = 1;

  return SetMethodArgumentDWord(methodCallHandle, gMethodArgumentName_echoENUM_REQ_enumValue, gExpectedResult_echoENUM, errorCode);
}

/// <echoENUM>
void OnMethodResponse_echoENUM(dword methodCallHandle, dword messageResponseHandle)
{
  dword response, errorCode;
  
  if(CheckResponseReturnCode(messageResponseHandle, 0, errorCode) &&
     GetMethodArgumentDWord(messageResponseHandle, gMethodArgumentName_echoENUM_RES_enumValue, response, errorCode) &&
     CheckResponseDataComparision(response==gExpectedResult_echoENUM, errorCode))
    SetTestMethodResult(sysvar::TC8_ETS::ETS_MethodResult::OK);
  else
    SetTestMethodResult(errorCode);
}

/// <echoFLOAT64>
enum Bool ProvideArgumentsForMethod_echoFLOAT64(dword methodCallHandle)
{
  dword errorCode;
  gExpectedResult_echoFLOAT64 = 120.4;

  return SetMethodArgumentFloat(methodCallHandle, gMethodArgumentName_echoFLOAT64_REQ_FLOAT64Value, gExpectedResult_echoFLOAT64, errorCode);
}

/// <echoFLOAT64>
void OnMethodResponse_echoFLOAT64(dword methodCallHandle, dword messageResponseHandle)
{
  dword errorCode;
  float response;
  
  if(CheckResponseReturnCode(messageResponseHandle, 0, errorCode) &&
     GetMethodArgumentFloat(messageResponseHandle, gMethodArgumentName_echoFLOAT64_RES_FLOAT64Value, response, errorCode) &&
     CheckResponseDataComparision(response==gExpectedResult_echoFLOAT64, errorCode))
    SetTestMethodResult(sysvar::TC8_ETS::ETS_MethodResult::OK);
  else
    SetTestMethodResult(errorCode);
}

/// <echoINT8>
enum Bool ProvideArgumentsForMethod_echoINT8(dword methodCallHandle)
{
  dword errorCode;
  gExpectedResult_echoINT8 = -14;

  return SetMethodArgumentLong(methodCallHandle, gMethodArgumentName_echoINT8_REQ_INT8Value, gExpectedResult_echoINT8, errorCode);
}

/// <echoINT8>
void OnMethodResponse_echoINT8(dword methodCallHandle, dword messageResponseHandle)
{
  dword errorCode;
  long response;
  
  if(CheckResponseReturnCode(messageResponseHandle, 0, errorCode) &&
     GetMethodArgumentLong(messageResponseHandle, gMethodArgumentName_echoINT8_RES_INT8Value, response, errorCode) &&
     CheckResponseDataComparision(response==gExpectedResult_echoINT8, errorCode))
    SetTestMethodResult(sysvar::TC8_ETS::ETS_MethodResult::OK);
  else
    SetTestMethodResult(errorCode);
}

/// <echoUINT8>
enum Bool ProvideArgumentsForMethod_echoUINT8(dword methodCallHandle)
{
  dword errorCode;
  gExpectedResult_echoUINT8 = 236;

  return SetMethodArgumentDWord(methodCallHandle, gMethodArgumentName_echoUINT8_REQ_UINT8Value, gExpectedResult_echoUINT8, errorCode);
}

/// <echoUINT8>
void OnMethodResponse_echoUINT8(dword methodCallHandle, dword messageResponseHandle)
{
  dword response, errorCode;
  if(CheckResponseReturnCode(messageResponseHandle, 0, errorCode) &&
     GetMethodArgumentDWord(messageResponseHandle, gMethodArgumentName_echoUINT8_RES_UINT8Value, response, errorCode) &&
     CheckResponseDataComparision(response==gExpectedResult_echoUINT8, errorCode))
    SetTestMethodResult(sysvar::TC8_ETS::ETS_MethodResult::OK);
  else
    SetTestMethodResult(errorCode);
}

/// <echoUINT8Reliable>
enum Bool ProvideArgumentsForMethod_echoUINT8Reliable(dword methodCallHandle)
{
  dword errorCode;
  //write("#### ProvideArgumentsForMethod_echoUINT8Reliable");
  gExpectedResult_echoUINT8Reliable = 216;

  return SetMethodArgumentDWord(methodCallHandle, gMethodArgumentName_echoUINT8Reliable_REQ_UINT8Value,
    gExpectedResult_echoUINT8Reliable, errorCode);
}

/// <echoUINT8Reliable>
void OnMethodResponse_echoUINT8Reliable(dword methodCallHandle, dword messageResponseHandle)
{
  dword response, errorCode;
  
  //write("### OnMethodResponse_echoUINT8Reliable");
  if(CheckResponseReturnCode(messageResponseHandle, 0, errorCode) &&
     GetMethodArgumentDWord(messageResponseHandle, gMethodArgumentName_echoUINT8Reliable_RES_UINT8Value, response, errorCode) &&
     CheckResponseDataComparision(response==gExpectedResult_echoUINT8Reliable, errorCode))
    SetTestMethodResult(sysvar::TC8_ETS::ETS_MethodResult::OK);
  else
    SetTestMethodResult(errorCode);
}

/// <echoUINT8Reliable>
enum Bool ProvideArgumentsForMethod_echoUINT8Reliable_ExtendedPayload(dword methodCallHandle)
{
  dword errorCode;
  enum Bool result;
  //write("#### ProvideArgumentsForMethod_echoUINT8Reliable_ExtendedPayload");
  gExpectedResult_echoUINT8Reliable = 216;

  result = SetMethodArgumentDWord(methodCallHandle, gMethodArgumentName_echoUINT8Reliable_REQ_UINT8Value,
    gExpectedResult_echoUINT8Reliable, errorCode);
  if(result==kTrue)
  {
    byte payload[1600];
    dword payloadLength;
    payloadLength = SomeIpGetData(methodCallHandle, elcount(payload), payload);
    SomeIpSetData(methodCallHandle, payloadLength+1, payload);
  }
  return result;
}

/// <echoUINT8Reliable>
void OnMethodResponse_echoUINT8Reliable_ExtendedPayload(dword methodCallHandle, dword messageResponseHandle)
{
  dword response, errorCode;
  
  //write("### OnMethodResponse_echoUINT8Reliable");
  if(CheckResponseReturnCode(messageResponseHandle, 0, errorCode) &&
     GetMethodArgumentDWord(messageResponseHandle, gMethodArgumentName_echoUINT8Reliable_RES_UINT8Value, response, errorCode) &&
     CheckResponseDataComparision(response==gExpectedResult_echoUINT8Reliable, errorCode))
    SetTestMethodResult(sysvar::TC8_ETS::ETS_MethodResult::OK);
  else
    SetTestMethodResult(errorCode);
}

/// <echoStaticUINT8Array>
enum Bool ProvideArgumentsForMethod_echoStaticUINT8Array(dword methodCallHandle)
{
  dword errorCode;
  char reqBuffer[64];
  int i;
  
  for(i=0; i<gEchoStaticUINT8Array_Length; ++i)
  {
    gExpectedResult_echoStaticUINT8Array[i] = i + 42;
    snprintf(reqBuffer, elCount(reqBuffer), "%s[%d]", gMethodArgumentName_echoStaticUINT8Array_REQ_UINT8Array, i);
    if(SetMethodArgumentDWord(methodCallHandle, reqBuffer, gExpectedResult_echoStaticUINT8Array[i], errorCode)==kFalse)
      return kFalse;
  }

  return kTrue;
}

/// <echoStaticUINT8Array>
void OnMethodResponse_echoStaticUINT8Array(dword methodCallHandle, dword messageResponseHandle)
{
  dword response, errorCode;
  char resBuffer[64];
  int i;

  if(CheckResponseReturnCode(messageResponseHandle, 0, errorCode) &&
     CheckArraySize(messageResponseHandle, gMethodArgumentName_echoStaticUINT8Array_RES_UINT8Array,
       gEchoStaticUINT8Array_Length, errorCode))
  {  
    for(i=0; i<gEchoStaticUINT8Array_Length; ++i)
    {
      snprintf(resBuffer, elCount(resBuffer), "%s[%d]", gMethodArgumentName_echoStaticUINT8Array_RES_UINT8Array, i);
      if(GetMethodArgumentDWord(messageResponseHandle, resBuffer, response, errorCode)==kFalse ||
         CheckResponseDataComparision(ReportUnequal(response==gExpectedResult_echoStaticUINT8Array[i], resBuffer), errorCode)==kFalse)
      {
        SetTestMethodResult(errorCode);
        return;
      }
    }
    SetTestMethodResult(sysvar::TC8_ETS::ETS_MethodResult::OK);
  }
  else
    SetTestMethodResult(errorCode);
}

/// <echoUINT8Array>
enum Bool ProvideArgumentsForMethod_echoUINT8Array(dword methodCallHandle)
{
  return ProvideArgumentsForMethod_echoUINT8Array(methodCallHandle, gEchoUINT8Array_Length,
    gExpectedResult_echoUINT8Array, gMethodArgumentName_echoUINT8Array_REQ_UINT8Array);
}

/// <echoUINT8Array>
void OnMethodResponse_echoUINT8Array(dword methodCallHandle, dword messageResponseHandle)
{
  dword errorCode;
  if(CheckResponseOfMethod_echoUINT8Array(messageResponseHandle, gEchoUINT8Array_Length,
       gExpectedResult_echoUINT8Array, gMethodArgumentName_echoUINT8Array_RES_UINT8Array, 0, errorCode))
    SetTestMethodResult(sysvar::TC8_ETS::ETS_MethodResult::OK);
  else
    SetTestMethodResult(errorCode);
}

/// <echoUINT8Array>
enum Bool ProvideArgumentsForMethod_echoUINT8Array_ExtendedPayload(dword methodCallHandle)
{
  enum Bool result;
  result = ProvideArgumentsForMethod_echoUINT8Array(methodCallHandle, gEchoUINT8Array_Length,
    gExpectedResult_echoUINT8Array, gMethodArgumentName_echoUINT8Array_REQ_UINT8Array);
  if(result==kTrue)
  {
    byte payload[1600];
    dword payloadLength;
    payloadLength = SomeIpGetData(methodCallHandle, elcount(payload), payload);
    SomeIpSetData(methodCallHandle, payloadLength+1, payload);
  }
  return result;
}

/// <echoUINT8Array>
void OnMethodResponse_echoUINT8Array_ExtendedPayload(dword methodCallHandle, dword messageResponseHandle)
{
  dword errorCode;
  if(CheckResponseOfMethod_echoUINT8Array(messageResponseHandle, gEchoUINT8Array_Length,
       gExpectedResult_echoUINT8Array, gMethodArgumentName_echoUINT8Array_RES_UINT8Array, 0, errorCode))
    SetTestMethodResult(sysvar::TC8_ETS::ETS_MethodResult::OK);
  else
    SetTestMethodResult(errorCode);
}

/// <echoUINT8Array>
enum Bool ProvideArgumentsForMethod_echoUINT8Array_EmptyArray(dword methodCallHandle)
{
  return ProvideArgumentsForMethod_echoUINT8Array(methodCallHandle, 0,
    gExpectedResult_echoUINT8Array, gMethodArgumentName_echoUINT8Array_REQ_UINT8Array);
}

/// <echoUINT8Array>
void OnMethodResponse_echoUINT8Array_EmptyArray(dword methodCallHandle, dword messageResponseHandle)
{
  dword errorCode;
  if(CheckResponseOfMethod_echoUINT8Array(messageResponseHandle, 0,
       gExpectedResult_echoUINT8Array, gMethodArgumentName_echoUINT8Array_RES_UINT8Array, 0, errorCode))
    SetTestMethodResult(sysvar::TC8_ETS::ETS_MethodResult::OK);
  else
    SetTestMethodResult(errorCode);  
}

/// <echoUINT8Array>
enum Bool ProvideArgumentsForMethod_echoUINT8Array_Array_Length_too_long(dword methodCallHandle)
{
  dword i;
  BYTE buffer[200];
  dword sizePayload;
  enum Bool result;

  result = ProvideArgumentsForMethod_echoUINT8Array(methodCallHandle, UINT8ARRAY_LENGTH,
    gExpectedResult_echoUINT8Array, gMethodArgumentName_echoUINT8Array_REQ_UINT8Array);
  if(result==kTrue)
  {
    sizePayload = SomeIpGetData(methodCallHandle,elcount(buffer),buffer);
    for(i=0; i<4; i++) // patch the correct byte of the array length
    {
      if(buffer[i]==UINT8ARRAY_LENGTH)
      {
        buffer[i] = UINT8ARRAY_LENGTH + 1; // patch array length
        if(SomeIpSetData(methodCallHandle, sizePayload, buffer)!=0)
        {
          ReportSomeIpError("Setting payload failed");
          return kFalse;
        }
        return kTrue;
      }
    }      
    ReportSomeIpError("Patching array length failed");
    return kFalse;
  }
  return result;
}

/// <echoUINT8Array>
void OnMethodResponse_echoUINT8Array_Array_Length_too_long(dword methodCallHandle, dword messageResponseHandle)
{
  dword errorCode;
  if(CheckResponseOfMethod_echoUINT8Array(messageResponseHandle, UINT8ARRAY_LENGTH+1,
       gExpectedResult_echoUINT8Array, gMethodArgumentName_echoUINT8Array_RES_UINT8Array, 0, errorCode))
    SetTestMethodResult(sysvar::TC8_ETS::ETS_MethodResult::OK);
  else
    SetTestMethodResult(errorCode);
}

/// <echoUINT8Array>
enum Bool ProvideArgumentsForMethod_echoUINT8Array_Array_Length_too_short(dword methodCallHandle)
{
  dword i;
  BYTE buffer[200];
  dword sizePayload;
  enum Bool result;

  result = ProvideArgumentsForMethod_echoUINT8Array(methodCallHandle, UINT8ARRAY_LENGTH,
    gExpectedResult_echoUINT8Array, gMethodArgumentName_echoUINT8Array_REQ_UINT8Array);
  if(result==kTrue)
  {
    sizePayload = SomeIpGetData(methodCallHandle,elcount(buffer),buffer);
    for(i=0; i<4; i++) // patch the correct byte of the array length
    {
      if(buffer[i]==UINT8ARRAY_LENGTH)
      {
        buffer[i] = UINT8ARRAY_LENGTH - 1; // patch array length
        if(SomeIpSetData(methodCallHandle, sizePayload, buffer)!=0)
        {
          ReportSomeIpError("Setting payload failed");
          return kFalse;
        }
        return kTrue;
      }
    }      
    ReportSomeIpError("Patching array length failed");
    return kFalse;
  }
  return result;
}

/// <echoUINT8Array>
void OnMethodResponse_echoUINT8Array_Array_Length_too_short(dword methodCallHandle, dword messageResponseHandle)
{
  dword errorCode;
  if(CheckResponseOfMethod_echoUINT8Array(messageResponseHandle, UINT8ARRAY_LENGTH-1,
       gExpectedResult_echoUINT8Array, gMethodArgumentName_echoUINT8Array_RES_UINT8Array, 0, errorCode))
    SetTestMethodResult(sysvar::TC8_ETS::ETS_MethodResult::OK);
  else
    SetTestMethodResult(errorCode);
}

/// <echoUINT8Array16BitLength>
enum Bool ProvideArgumentsForMethod_echoUINT8Array16BitLength(dword methodCallHandle)
{
  return ProvideArgumentsForMethod_echoUINT8Array(methodCallHandle, gEchoUINT8Array16BitLength_Length,
    gExpectedResult_echoUINT8Array16BitLength, gMethodArgumentName_echoUINT8Array16BitLength_REQ_UINT8Array);
}

/// <echoUINT8Array16BitLength>
void OnMethodResponse_echoUINT8Array16BitLength(dword methodCallHandle, dword messageResponseHandle)
{
  dword errorCode;
  if(CheckResponseOfMethod_echoUINT8Array(messageResponseHandle, gEchoUINT8Array16BitLength_Length,
       gExpectedResult_echoUINT8Array16BitLength, gMethodArgumentName_echoUINT8Array16BitLength_RES_UINT8Array, 0, errorCode))
    SetTestMethodResult(sysvar::TC8_ETS::ETS_MethodResult::OK);
  else
    SetTestMethodResult(errorCode);
}

/// <echoUINT8Array8BitLength>
enum Bool ProvideArgumentsForMethod_echoUINT8Array8BitLength(dword methodCallHandle)
{
  return ProvideArgumentsForMethod_echoUINT8Array(methodCallHandle, gEchoUINT8Array8BitLength_Length,
    gExpectedResult_echoUINT8Array8BitLength, gMethodArgumentName_echoUINT8Array8BitLength_REQ_UINT8Array);
}

/// <echoUINT8Array8BitLength>
void OnMethodResponse_echoUINT8Array8BitLength(dword methodCallHandle, dword messageResponseHandle)
{
  dword errorCode;
  if(CheckResponseOfMethod_echoUINT8Array(messageResponseHandle, gEchoUINT8Array8BitLength_Length,
       gExpectedResult_echoUINT8Array8BitLength, gMethodArgumentName_echoUINT8Array8BitLength_RES_UINT8Array, 0, errorCode))
    SetTestMethodResult(sysvar::TC8_ETS::ETS_MethodResult::OK);
  else
    SetTestMethodResult(errorCode);
}

/// <echoUINT8ArrayMinSize>
enum Bool ProvideArgumentsForMethod_echoUINT8ArrayMinSize(dword methodCallHandle)
{
  return ProvideArgumentsForMethod_echoUINT8Array(methodCallHandle, gEchoUINT8ArrayMinSize_Length,
     gExpectedResult_echoUINT8ArrayMinSize, gMethodArgumentName_echoUINT8ArrayMinSize_REQ_UINT8Array);
}

/// <echoUINT8ArrayMinSize>
void OnMethodResponse_echoUINT8ArrayMinSize(dword methodCallHandle, dword messageResponseHandle)
{
  dword errorCode;
  if(CheckResponseOfMethod_echoUINT8Array(messageResponseHandle, gEchoUINT8ArrayMinSize_Length,
      gExpectedResult_echoUINT8ArrayMinSize, gMethodArgumentName_echoUINT8ArrayMinSize_RES_UINT8Array, 0, errorCode))
    SetTestMethodResult(sysvar::TC8_ETS::ETS_MethodResult::OK);
  else
    SetTestMethodResult(errorCode);
}

/// <echoUINT8ArrayMinSize_ArrayMinSize_too_short>
enum Bool ProvideArgumentsForMethod_echoUINT8ArrayMinSize_ArrayMinSize_too_short(dword methodCallHandle)
{
  dword i;
  BYTE buffer[200];
  dword sizePayload;
  enum Bool success;

  success = ProvideArgumentsForMethod_echoUINT8Array(methodCallHandle, gEchoUINT8ArrayMinSize_MinLength-1,
    gExpectedResult_echoUINT8ArrayMinSize, gMethodArgumentName_echoUINT8ArrayMinSize_REQ_UINT8Array);

  if(success)
  {
    sizePayload = SomeIpGetData(methodCallHandle,elcount(buffer),buffer);
    for(i=0; i<4; i++) // array length in payload might not be what we need
    {
      if(buffer[i]==gEchoUINT8ArrayMinSize_MinLength-1) // array length is as required
        break;

      if(buffer[i]==gEchoUINT8ArrayMinSize_MinLength) // array length is still minLength and needs to be corrected
      {
        buffer[i] = gEchoUINT8ArrayMinSize_MinLength-1; // patch array length
        if(SomeIpSetData(methodCallHandle, sizePayload - 1, buffer)!=0)
        {
          ReportSomeIpError("Setting payload failed");
          return kFalse;
        }
        break;
      }
    }
  }
  return success;
}

/// <echoUINT8ArrayMinSize_ArrayMinSize_too_short>
void OnMethodResponse_echoUINT8ArrayMinSize_ArrayMinSize_too_short(dword methodCallHandle, dword messageResponseHandle)
{
  dword errorCode;
  if(CheckResponseOfMethod_echoUINT8Array(messageResponseHandle, gEchoUINT8ArrayMinSize_MinLength-1,
      gExpectedResult_echoUINT8ArrayMinSize, gMethodArgumentName_echoUINT8ArrayMinSize_RES_UINT8Array, 0, errorCode))
    SetTestMethodResult(sysvar::TC8_ETS::ETS_MethodResult::OK);  
  else
    SetTestMethodResult(errorCode);
}

/// <echoUINT8Array2Dim>
enum Bool ProvideArgumentsForMethod_echoUINT8Array2Dim(dword methodCallHandle)
{
  dword errorCode;
  char reqBuffer[64];
  int row, col;
  for(row=0; row<gEchoUINT8Array2Dim_Length1; ++row)
  {
    for(col=0; col<gEchoUINT8Array2Dim_Length2; ++col)
    {
      gExpectedResult_echoUINT8Array2Dim[row][col] = ((row*10 + col) % 0xFF);
      snprintf(reqBuffer, elCount(reqBuffer), "%s[%d][%d]", gMethodArgumentName_echoUINT8Array2Dim_REQ_UINT8Array, row, col);
      if(SetMethodArgumentDWord(methodCallHandle, reqBuffer, gExpectedResult_echoUINT8Array2Dim[row][col], errorCode)==kFalse)
        return kFalse;
    }
  }
  return kTrue;
}

/// <echoUINT8Array2Dim>
void OnMethodResponse_echoUINT8Array2Dim(dword methodCallHandle, dword messageResponseHandle)
{
  dword row, col, countRows, countCols, errorCode;
  char resBuffer[64];
  dword value;

  if(CheckResponseReturnCode(messageResponseHandle, 0, errorCode) &&
     GetMethodArgumentDWord(messageResponseHandle, gMethodArgumentName_echoUINT8Array2Dim_RES_UINT8Array, countRows, errorCode)&&
     CheckResponseDataComparision(countRows==gEchoUINT8Array2Dim_Length1, errorCode))
  {
    for(row=0; row<countRows; ++row)
    {
      snprintf(resBuffer, elCount(resBuffer), "%s[%d]", gMethodArgumentName_echoUINT8Array2Dim_RES_UINT8Array, row);
      if(GetMethodArgumentDWord(messageResponseHandle, resBuffer, countCols, errorCode)==kFalse ||
         CheckResponseDataComparision(countCols==gEchoUINT8Array2Dim_Length2, errorCode)==kFalse)
      {
        SetTestMethodResult(errorCode);
        return;
      }
      
      for(col=0; col<countCols; ++col)
      {
        snprintf(resBuffer, elCount(resBuffer), "%s[%d][%d]", gMethodArgumentName_echoUINT8Array2Dim_RES_UINT8Array, row, col);
        if(GetMethodArgumentDWord(messageResponseHandle, resBuffer, value, errorCode)==kFalse ||
           CheckResponseDataComparision(value==gExpectedResult_echoUINT8Array2Dim[row][col], errorCode)==kFalse)
        {
          SetTestMethodResult(errorCode);
          return;
        }
      }
    }
    SetTestMethodResult(sysvar::TC8_ETS::ETS_MethodResult::OK);
  }
  else
    SetTestMethodResult(errorCode);
}

/// <echoUNION>
enum Bool ProvideArgumentsForMethod_echoUNION(dword methodCallHandle)
{
  dword errorCode;
  gExpectedResult_echoUNION = 2048;
  return (enum Bool)
    (SetMethodArgumentDWord(methodCallHandle, gMethodArgumentName_echoUNION_REQ_unionMember3, gExpectedResult_echoUNION, errorCode) &&
     GetMethodArgumentDWord(methodCallHandle, gMethodArgumentName_echoUNION_REQ_unionElement, gExpectedResult_echoUNION_validIndex, errorCode));
}

/// <echoUNION>
void OnMethodResponse_echoUNION(dword methodCallHandle, dword messageResponseHandle)
{
  dword response, validIndex, errorCode;
  if(CheckResponseReturnCode(messageResponseHandle, 0, errorCode) &&
     GetMethodArgumentDWord(messageResponseHandle, gMethodArgumentName_echoUNION_RES_unionElement, validIndex, errorCode) &&
     CheckResponseDataComparision(validIndex==gExpectedResult_echoUNION_validIndex, errorCode) &&
     GetMethodArgumentDWord(messageResponseHandle, gMethodArgumentName_echoUNION_RES_unionMember3, response, errorCode) &&
     CheckResponseDataComparision(response==gExpectedResult_echoUNION, errorCode))
    SetTestMethodResult(sysvar::TC8_ETS::ETS_MethodResult::OK);
  else
    SetTestMethodResult(errorCode);
}

/// <echoUNION>
enum Bool ProvideArgumentsForMethod_echoUNION_UnionLength_too_long_for_message(dword methodCallHandle)
{
  byte payload[64];
  long payloadSize;
  byte LENGTH_INCREMENT = 10;

  if(ProvideArgumentsForMethod_echoUNION(methodCallHandle)==kFalse)
    return kFalse;

  payloadSize = SomeIpGetData(methodCallHandle, elcount(payload), payload);

  payload[3] += LENGTH_INCREMENT; // increment union length, but keep payload length
  
  if(SomeIpSetData(methodCallHandle, payloadSize, payload)!=0)
  {
    ReportSomeIpError("Setting payload failed");
    return kFalse;
  }
  return kTrue;
}

/// <echoUNION>
void OnMethodResponse_echoUNION_UnionLength_too_long_for_message(dword methodCallHandle, dword messageResponseHandle)
{
  OnMethodResponse_echoUNION(methodCallHandle, messageResponseHandle);
}

/// <echoUNION>
enum Bool ProvideArgumentsForMethod_echoUNION_UnionLength_too_long(dword methodCallHandle)
{
  byte payload[128];
  long payloadSize;
  byte LENGTH_INCREMENT = 10;
  
  if(ProvideArgumentsForMethod_echoUNION(methodCallHandle)==kFalse)
    return kFalse;

  payloadSize = SomeIpGetData(methodCallHandle, elcount(payload), payload);
  payload[3] += LENGTH_INCREMENT; // change the union length
  
  if(SomeIpSetData(methodCallHandle, payloadSize + LENGTH_INCREMENT, payload)!=0)
  {
    ReportSomeIpError("Setting payload failed");
    return kFalse;
  }
  return kTrue;
}

/// <echoUNION>
void OnMethodResponse_echoUNION_UnionLength_too_long(dword methodCallHandle, dword messageResponseHandle)
{
  OnMethodResponse_echoUNION(methodCallHandle, messageResponseHandle);
}

/// <echoUNION>
enum Bool ProvideArgumentsForMethod_echoUNION_UnionLength_too_short(dword methodCallHandle)
{
  byte payload[64];
  long payloadSize;
  
  if(ProvideArgumentsForMethod_echoUNION(methodCallHandle)==kFalse)
    return kFalse;

  payloadSize = SomeIpGetData(methodCallHandle, elcount(payload), payload);

  payload[3] -= 1; // change the union length
  
  if(SomeIpSetData(methodCallHandle, payloadSize, payload)!=0)
  {
    ReportSomeIpError("Setting payload failed");
    return kFalse;
  }
  return kTrue;
}

/// <echoUNION>
void OnMethodResponse_echoUNION_UnionLength_too_short(dword methodCallHandle, dword messageResponseHandle)
{
  OnMethodResponse_echoUNION(methodCallHandle, messageResponseHandle);
}

/// <echoUTF16DYNAMIC>
enum Bool ProvideArgumentsForMethod_echoUTF16DYNAMIC(dword methodCallHandle)
{
  dword errorCode;
  return SetMethodArgumentStringUTF16(methodCallHandle, gMethodArgumentName_echoUTF16DYNAMIC_REQ_UTF16String,
      gExpectedResult_echoUTF16DYNAMIC, errorCode);
}

/// <echoUTF16DYNAMIC>
void OnMethodResponse_echoUTF16DYNAMIC(dword methodCallHandle, dword messageResponseHandle)
{
  dword errorCode;
  if(CheckMethodResponse_echoUTF16(messageResponseHandle, gMethodArgumentName_echoUTF16DYNAMIC_RES_UTF16String,
       gExpectedResult_echoUTF16DYNAMIC, errorCode))
    SetTestMethodResult(sysvar::TC8_ETS::ETS_MethodResult::OK);
  else
    SetTestMethodResult(errorCode);
}

/// <echoUTF16DYNAMIC>
enum Bool ProvideArgumentsForMethod_echoUTF16DYNAMIC_Length_too_long_for_String(dword methodCallHandle)
{
  dword i, errorCode;
  BYTE buffer[200];
  dword sizePayload;
  enum Bool success;

  success = SetMethodArgumentStringUTF16(methodCallHandle, gMethodArgumentName_echoUTF16DYNAMIC_REQ_UTF16String,
    gExpectedResult_echoUTF16DYNAMIC, errorCode);

  if(success)
  {
    sizePayload = SomeIpGetData(methodCallHandle, elcount(buffer), buffer);
    for(i=0; i<4; i++) // length in payload has to be patched
    {
      if(buffer[i]==0)
        continue;

      buffer[i] += 5;
      if(SomeIpSetData(methodCallHandle, sizePayload - 1, buffer)!=0)
      {
        ReportSomeIpError("Setting payload failed");
        return kFalse;
      }
      break;
    }
  }
  return success;
}

/// <echoUTF16DYNAMIC>
void OnMethodResponse_echoUTF16DYNAMIC_Length_too_long_for_String(dword methodCallHandle, dword messageResponseHandle)
{
  dword errorCode;

  if(CheckMethodResponse_echoUTF16(messageResponseHandle, gMethodArgumentName_echoUTF16DYNAMIC_RES_UTF16String,
       gExpectedResult_echoUTF16DYNAMIC, errorCode))
    SetTestMethodResult(sysvar::TC8_ETS::ETS_MethodResult::OK);
  else
    SetTestMethodResult(errorCode);
}

/// <echoUTF16DYNAMIC>
enum Bool ProvideArgumentsForMethod_echoUTF16DYNAMIC_Odd_number_before_termination(dword methodCallHandle)
{
  dword i, errorCode;
  BYTE buffer[200];
  dword sizePayload;

  if(SetMethodArgumentStringUTF16(methodCallHandle, gMethodArgumentName_echoUTF16DYNAMIC_REQ_UTF16String,
       gExpectedResult_echoUTF16DYNAMIC, errorCode))
  {
    sizePayload = SomeIpGetData(methodCallHandle, elcount(buffer), buffer);
    for(i=0; i<4; i++) // length in payload has to be patched
    {
      if(buffer[i]==0)
        continue;

      buffer[i] += 1;
      sizePayload += 1;
      buffer[sizePayload-3] = 65;
      buffer[sizePayload-2] = 0;
      buffer[sizePayload-1] = 0;
      if(SomeIpSetData(methodCallHandle, sizePayload, buffer)!=0)
      {
        ReportSomeIpError("Setting payload failed");
        return kFalse;
      }
      return kTrue;
    }
  }
  return kFalse;
}

/// <echoUTF16DYNAMIC>
void OnMethodResponse_echoUTF16DYNAMIC_Odd_number_before_termination(dword methodCallHandle, dword messageResponseHandle)
{
  dword errorCode;

  if(CheckMethodResponse_echoUTF16(messageResponseHandle, gMethodArgumentName_echoUTF16DYNAMIC_RES_UTF16String,
       gExpectedResult_echoUTF16DYNAMIC, errorCode))
    SetTestMethodResult(sysvar::TC8_ETS::ETS_MethodResult::OK);
  else
    SetTestMethodResult(errorCode);
}

/// <echoUTF16DYNAMIC>
enum Bool ProvideArgumentsForMethod_echoUTF16DYNAMIC_Odd_number_after_termination(dword methodCallHandle)
{
  dword i, errorCode;
  BYTE buffer[200];
  dword sizePayload;
  enum Bool success;

  success = SetMethodArgumentStringUTF16(methodCallHandle, gMethodArgumentName_echoUTF16DYNAMIC_REQ_UTF16String,
    gExpectedResult_echoUTF16DYNAMIC, errorCode);

  if(success)
  {
    sizePayload = SomeIpGetData(methodCallHandle, elcount(buffer), buffer);
    for(i=0; i<4; i++) // length in payload has to be patched
    {
      if(buffer[i]==0)
        continue;

      buffer[i] += 1;
      sizePayload += 1;
      buffer[sizePayload-1] = 65;
      if(SomeIpSetData(methodCallHandle, sizePayload, buffer)!=0)
      {
        ReportSomeIpError("Setting payload failed");
        return kFalse;
      }
      break;
    }
  }
  return success;
}

/// <echoUTF16DYNAMIC>
void OnMethodResponse_echoUTF16DYNAMIC_Odd_number_after_termination(dword methodCallHandle, dword messageResponseHandle)
{
  dword errorCode;
  if(CheckMethodResponse_echoUTF16(messageResponseHandle, gMethodArgumentName_echoUTF16DYNAMIC_RES_UTF16String,
       gExpectedResult_echoUTF16DYNAMIC, errorCode))
    SetTestMethodResult(sysvar::TC8_ETS::ETS_MethodResult::OK);
  else
    SetTestMethodResult(errorCode);
}

/// <echoUTF16DYNAMIC>
enum Bool ProvideArgumentsForMethod_echoUTF16DYNAMIC_Wrong_BOM(dword methodCallHandle)
{
  dword i, errorCode;
  BYTE buffer[200];
  dword sizePayload;
  enum Bool success;

  success = SetMethodArgumentStringUTF16(methodCallHandle, gMethodArgumentName_echoUTF16DYNAMIC_REQ_UTF16String,
    gExpectedResult_echoUTF16DYNAMIC, errorCode);

  if(success)
  {
    sizePayload = SomeIpGetData(methodCallHandle, elcount(buffer), buffer);
    for(i=0; i<4; i++) // length in payload has to be patched
    {
      if(buffer[i]==0)
        continue;

      buffer[i] += 1;
      break;
    }

    for(i=sizePayload-1; i>5; --i) // make space for additional UTF8 BOM byte
    {
      buffer[i+1] = buffer[i];
    }
    buffer[4] = 0xEF; // write UTF8 BOM into payload
    buffer[5] = 0xBB;
    buffer[6] = 0xBF;
    sizePayload += 1;
    if(SomeIpSetData(methodCallHandle, sizePayload, buffer)!=0)
    {
      ReportSomeIpError("Setting payload failed");
      return kFalse;
    }
  
  }
  return success;
}

/// <echoUTF16DYNAMIC>
void OnMethodResponse_echoUTF16DYNAMIC_Wrong_BOM(dword methodCallHandle, dword messageResponseHandle)
{
  dword errorCode;
  if(CheckMethodResponse_echoUTF16(messageResponseHandle, gMethodArgumentName_echoUTF16DYNAMIC_RES_UTF16String,
       gExpectedResult_echoUTF16DYNAMIC, errorCode))
    SetTestMethodResult(sysvar::TC8_ETS::ETS_MethodResult::OK);
  else
    SetTestMethodResult(errorCode);
}

///////////////
/// <echoUTF16DYNAMIC>
enum Bool ProvideArgumentsForMethod_echoUTF16DYNAMIC_Length_too_short_for_malformed_String(dword methodCallHandle)
{
  dword i, errorCode;
  BYTE buffer[200];
  dword sizePayload;
  enum Bool success;

  success = SetMethodArgumentStringUTF16(methodCallHandle, gMethodArgumentName_echoUTF16DYNAMIC_REQ_UTF16String,
    gExpectedResult_echoUTF16DYNAMIC, errorCode);

  if(success)
  {
    sizePayload = SomeIpGetData(methodCallHandle, elcount(buffer), buffer);
    for(i=0; i<4; i++) // length in payload has to be patched
    {
      if(buffer[i]==0)
        continue;

      buffer[i] = 2;
      if(SomeIpSetData(methodCallHandle, sizePayload, buffer)!=0)
      {
        ReportSomeIpError("Setting payload failed");
        return kFalse;
      }
      break;
    }
  }
  return success;
}

/// <echoUTF16DYNAMIC>
void OnMethodResponse_echoUTF16DYNAMIC_Length_too_short_for_malformed_String(dword methodCallHandle, dword messageResponseHandle)
{
  dword errorCode;
  if(CheckMethodResponse_echoUTF16(messageResponseHandle, gMethodArgumentName_echoUTF16DYNAMIC_RES_UTF16String,
     gExpectedResult_echoUTF16DYNAMIC, errorCode))
    SetTestMethodResult(sysvar::TC8_ETS::ETS_MethodResult::OK);
  else
    SetTestMethodResult(errorCode);
}

/// <echoUTF16DYNAMIC>
enum Bool ProvideArgumentsForMethod_echoUTF16DYNAMIC_Length_too_short_for_String(dword methodCallHandle)
{
  dword i, errorCode;
  BYTE buffer[200];
  dword sizePayload;
  enum Bool success;

  success = SetMethodArgumentStringUTF16(methodCallHandle, gMethodArgumentName_echoUTF16DYNAMIC_REQ_UTF16String,
    gExpectedResult_echoUTF16DYNAMIC, errorCode);

  if(success)
  {
    sizePayload = SomeIpGetData(methodCallHandle, elcount(buffer), buffer);
    for(i=0; i<4; i++) // length in payload has to be patched
    {
      if(buffer[i]==0)
        continue;

      buffer[i] = buffer[i] - 2;
      if(SomeIpSetData(methodCallHandle, sizePayload, buffer)!=0)
      {
        ReportSomeIpError("Setting payload failed");
        return kFalse;
      }
      break;
    }
  }
  return success;
}

/// <echoUTF16DYNAMIC>
void OnMethodResponse_echoUTF16DYNAMIC_Length_too_short_for_String(dword methodCallHandle, dword messageResponseHandle)
{
  dword errorCode;
  if(CheckMethodResponse_echoUTF16(messageResponseHandle, gMethodArgumentName_echoUTF16DYNAMIC_RES_UTF16String,
     gExpectedResult_echoUTF16DYNAMIC, errorCode))
    SetTestMethodResult(sysvar::TC8_ETS::ETS_MethodResult::OK);
  else
    SetTestMethodResult(errorCode);
}

/// <echoUTF16FIXED>
enum Bool ProvideArgumentsForMethod_echoUTF16FIXED(dword methodCallHandle)
{
  dword errorCode;
  enum Bool result;
  int i;

  //write("#### ProvideArgumentsForMethod_echoUTF16FIXED");
  for(i=0; i<elcount(gExpectedResult_echoUTF16FIXED)-1; ++i)
  {
    gExpectedResult_echoUTF16FIXED[i] = 65 + (i%26);
  }
  gExpectedResult_echoUTF16FIXED[i] = 0;
  return SetMethodArgumentStringUTF16(methodCallHandle, gMethodArgumentName_echoUTF16FIXED_REQ_UTF16String,
      gExpectedResult_echoUTF16FIXED, errorCode);
}

/// <echoUTF16FIXED>
void OnMethodResponse_echoUTF16FIXED(dword methodCallHandle, dword messageResponseHandle)
{
  dword errorCode;
  if(CheckMethodResponse_echoUTF16(messageResponseHandle, gMethodArgumentName_echoUTF16FIXED_RES_UTF16String,
       gExpectedResult_echoUTF16FIXED, errorCode))
    SetTestMethodResult(sysvar::TC8_ETS::ETS_MethodResult::OK);
  else
    SetTestMethodResult(errorCode);
}

/// <echoUTF16FIXED>
enum Bool ProvideArgumentsForMethod_echoUTF16FIXED_Odd_number_after_termination(dword methodCallHandle)
{
  dword i, errorCode;
  BYTE buffer[200];
  dword sizePayload;
  enum Bool success;

  for(i=0; i<elcount(gExpectedResult_echoUTF16FIXED)-1; ++i)
  {
    gExpectedResult_echoUTF16FIXED[i] = 65 + (i%26);
  }
  gExpectedResult_echoUTF16FIXED[i] = 0;
  success = SetMethodArgumentStringUTF16(methodCallHandle, gMethodArgumentName_echoUTF16FIXED_REQ_UTF16String,
    gExpectedResult_echoUTF16FIXED, errorCode);

  if(success)
  {
    sizePayload = SomeIpGetData(methodCallHandle, elcount(buffer), buffer);
    // length of payload has to be patched
    sizePayload += 1;
    buffer[sizePayload-1] = 65;
    if(SomeIpSetData(methodCallHandle, sizePayload, buffer)!=0)
    {
      ReportSomeIpError("Setting payload failed");
      return kFalse;
    }
  }
  return success;
}

/// <echoUTF16FIXED>
void OnMethodResponse_echoUTF16FIXED_Odd_number_after_termination(dword methodCallHandle, dword messageResponseHandle)
{
  dword errorCode;
  if(CheckMethodResponse_echoUTF16(messageResponseHandle, gMethodArgumentName_echoUTF16FIXED_RES_UTF16String,
       gExpectedResult_echoUTF16FIXED, errorCode))
    SetTestMethodResult(sysvar::TC8_ETS::ETS_MethodResult::OK);
  else
    SetTestMethodResult(errorCode);
}

/// <echoUTF8DYNAMIC>
enum Bool ProvideArgumentsForMethod_echoUTF8DYNAMIC_Wrong_BOM(dword methodCallHandle)
{
  dword i, errorCode;
  BYTE buffer[200];
  dword sizePayload;
  enum Bool success;

  success = SetMethodArgumentStringUTF8(methodCallHandle, gMethodArgumentName_echoUTF8DYNAMIC_REQ_UTF8String,
    gExpectedResult_echoUTF8DYNAMIC, errorCode);

  if(success)
  {
    sizePayload = SomeIpGetData(methodCallHandle, elcount(buffer), buffer);
    for(i=0; i<4; i++) // length in payload has to be patched
    {
      if(buffer[i]==0)
        continue;

      buffer[i] -= 1;
      break;
    }

    for(i=6; i<sizePayload-1; ++i) // UTF16 BOM has just 2 bytes, remove one byte of the payload
    {
      buffer[i] = buffer[i+1];
    }
    buffer[4] = 0xFE; // write UTF16 BOM into payload
    buffer[5] = 0xFF;
    sizePayload -= 1;
    if(SomeIpSetData(methodCallHandle, sizePayload, buffer)!=0)
    {
      ReportSomeIpError("Setting payload failed");
      return kFalse;
    }
  
  }
  return success;
}

/// <echoUTF8DYNAMIC>
void OnMethodResponse_echoUTF8DYNAMIC_Wrong_BOM(dword methodCallHandle, dword messageResponseHandle)
{
  dword errorCode;
  if(CheckMethodResponse_echoUTF16(messageResponseHandle, gMethodArgumentName_echoUTF8DYNAMIC_RES_UTF8String,
       gExpectedResult_echoUTF8DYNAMIC, errorCode))
    SetTestMethodResult(sysvar::TC8_ETS::ETS_MethodResult::OK);
  else
    SetTestMethodResult(errorCode);
}

/// <echoUTF16FIXED>
enum Bool ProvideArgumentsForMethod_echoUTF16FIXED_String_too_long(dword methodCallHandle)
{
  dword errorCode;
  enum Bool result;
  byte payload[UTF16FIXED_ENCODED_SIZE + 20];
  long payloadSize;
  int i;

  for(i=0; i<elcount(gExpectedResult_echoUTF16FIXED)-1; ++i)
  {
    gExpectedResult_echoUTF16FIXED[i] = 65 + (i%26);
  }
  gExpectedResult_echoUTF16FIXED[i] = 0;
  
  result = SetMethodArgumentStringUTF16(methodCallHandle, gMethodArgumentName_echoUTF16FIXED_REQ_UTF16String,
      gExpectedResult_echoUTF16FIXED, errorCode);
  
  if(result)
  {
    payloadSize = SomeIpGetData(methodCallHandle, elcount(payload), payload);
    if(payloadSize!=UTF16FIXED_ENCODED_SIZE+UTF16BOM_SIZE || SomeIpGetLastError()!=0)
    {
      ReportSomeIpError("Payload problem");
      return kFalse;
    }
    
    for(i=payloadSize-UTF16TERMINATION_SIZE*2; i<elcount(payload)-UTF16TERMINATION_SIZE; i += 2)
    {
      payload[i] = payload[UTF8BOM_SIZE];     // fill the payload with the first encoded
      payload[i+1] = payload[UTF8BOM_SIZE+1]; // character
    }
    payloadSize = elcount(payload);
    
    RestorePayloadStringTermination(payloadSize, payload, UTF16TERMINATION_SIZE);    

    if(SomeIpSetData(methodCallHandle, elcount(payload), payload)!=0)
    {
      result = kFalse;
      ReportSomeIpError("Set data failed");
    }
  }
  return result;
}

/// <echoUTF16FIXED>
void OnMethodResponse_echoUTF16FIXED_String_too_long(dword methodCallHandle, dword messageResponseHandle)
{
  dword errorCode;
  if(CheckMethodResponse_echoUTF16(messageResponseHandle, gMethodArgumentName_echoUTF16FIXED_RES_UTF16String,
       gExpectedResult_echoUTF16FIXED, errorCode))
    SetTestMethodResult(sysvar::TC8_ETS::ETS_MethodResult::OK);
  else
    SetTestMethodResult(errorCode);
}

/// <echoUTF16FIXED>
enum Bool ProvideArgumentsForMethod_echoUTF16FIXED_String_too_short(dword methodCallHandle)
{
  dword errorCode;
  enum Bool result;
  byte payload[UTF16FIXED_ENCODED_SIZE + 20];
  long payloadSize;
  int i;
  byte SHORTEN_BY_SIZE = 10;

  for(i=0; i<(elcount(gExpectedResult_echoUTF16FIXED) - 1); ++i)
  {
    gExpectedResult_echoUTF16FIXED[i] = 65 + (i%26);
  }
  gExpectedResult_echoUTF16FIXED[i] = 0;
  
  result = SetMethodArgumentStringUTF16(methodCallHandle, gMethodArgumentName_echoUTF16FIXED_REQ_UTF16String,
      gExpectedResult_echoUTF16FIXED, errorCode);
  
  if(result)
  {
    payloadSize = SomeIpGetData(methodCallHandle, elcount(payload), payload);
    
    if(payloadSize!=UTF16FIXED_ENCODED_SIZE+UTF16BOM_SIZE || SomeIpGetLastError()!=0)
    {
      ReportSomeIpError("Payload problem");
      return kFalse;
    }
    payloadSize -= SHORTEN_BY_SIZE;

    RestorePayloadStringTermination(payloadSize, payload, UTF16TERMINATION_SIZE);
    
    if(SomeIpSetData(methodCallHandle, payloadSize, payload)!=0)
    {
      result = kFalse;
      ReportSomeIpError("Set data failed");
    }
  }
  return result;
}

/// <echoUTF16FIXED>
void OnMethodResponse_echoUTF16FIXED_String_too_short(dword methodCallHandle, dword messageResponseHandle)
{
  dword errorCode;
  if(CheckMethodResponse_echoUTF16(messageResponseHandle, gMethodArgumentName_echoUTF16FIXED_RES_UTF16String,
       gExpectedResult_echoUTF16FIXED, errorCode))
    SetTestMethodResult(sysvar::TC8_ETS::ETS_MethodResult::OK);
  else
    SetTestMethodResult(errorCode);
}

/// <echoUTF8DYNAMIC>
enum Bool ProvideArgumentsForMethod_echoUTF8DYNAMIC(dword methodCallHandle)
{
  dword errorCode;
  return SetMethodArgumentStringUTF8(methodCallHandle, gMethodArgumentName_echoUTF8DYNAMIC_REQ_UTF8String,
      gExpectedResult_echoUTF8DYNAMIC, errorCode);
}

/// <echoUTF8DYNAMIC>
void OnMethodResponse_echoUTF8DYNAMIC(dword methodCallHandle, dword messageResponseHandle)
{
  dword errorCode;
  if(CheckMethodResponse_echoUTF8(messageResponseHandle, gMethodArgumentName_echoUTF8DYNAMIC_RES_UTF8String,
       gExpectedResult_echoUTF8DYNAMIC, errorCode))
    SetTestMethodResult(sysvar::TC8_ETS::ETS_MethodResult::OK);
  else
    SetTestMethodResult(errorCode);
}

/// <echoUTF8DYNAMIC>
enum Bool ProvideArgumentsForMethod_echoUTF8DYNAMIC_Length_too_long_for_String(dword methodCallHandle)
{
  dword i, errorCode;
  BYTE buffer[200];
  dword sizePayload;
  enum Bool success;

  success = SetMethodArgumentStringUTF8(methodCallHandle, gMethodArgumentName_echoUTF8DYNAMIC_REQ_UTF8String,
    gExpectedResult_echoUTF8DYNAMIC, errorCode);

  if(success)
  {
    sizePayload = SomeIpGetData(methodCallHandle, elcount(buffer), buffer);
    for(i=0; i<4; i++) // length in payload has to be patched
    {
      if(buffer[i]==0)
        continue;

      buffer[i] += 5;
      if(SomeIpSetData(methodCallHandle, sizePayload - 1, buffer)!=0)
      {
        ReportSomeIpError("Setting payload failed");
        return kFalse;
      }
      break;
    }
  }
  return success;
}

/// <echoUTF8DYNAMIC>
void OnMethodResponse_echoUTF8DYNAMIC_Length_too_long_for_String(dword methodCallHandle, dword messageResponseHandle)
{
  dword errorCode;
  if(CheckMethodResponse_echoUTF8(messageResponseHandle, gMethodArgumentName_echoUTF8DYNAMIC_RES_UTF8String,
       gExpectedResult_echoUTF8DYNAMIC, errorCode))
    SetTestMethodResult(sysvar::TC8_ETS::ETS_MethodResult::OK);
  else
    SetTestMethodResult(errorCode);
}

/// <echoUTF8DYNAMIC>
enum Bool ProvideArgumentsForMethod_echoUTF8DYNAMIC_Length_too_short_for_String(dword methodCallHandle)
{
  dword i, errorCode;
  BYTE buffer[200];
  dword sizePayload;
  enum Bool success;

  success = SetMethodArgumentStringUTF8(methodCallHandle, gMethodArgumentName_echoUTF8DYNAMIC_REQ_UTF8String,
    gExpectedResult_echoUTF8DYNAMIC, errorCode);

  if(success)
  {
    sizePayload = SomeIpGetData(methodCallHandle, elcount(buffer), buffer);
    for(i=0; i<4; i++) // length in payload has to be patched
    {
      if(buffer[i]==0)
        continue;

      buffer[i] = buffer[i] - 4;
      if(SomeIpSetData(methodCallHandle, sizePayload, buffer)!=0)
      {
        ReportSomeIpError("Setting payload failed");
        return kFalse;
      }
      break;
    }
  }
  return success;
}

/// <echoUTF8DYNAMIC>
void OnMethodResponse_echoUTF8DYNAMIC_Length_too_short_for_String(dword methodCallHandle, dword messageResponseHandle)
{
  dword errorCode;
  if(CheckMethodResponse_echoUTF8(messageResponseHandle, gMethodArgumentName_echoUTF8DYNAMIC_RES_UTF8String,
     gExpectedResult_echoUTF8DYNAMIC, errorCode))
    SetTestMethodResult(sysvar::TC8_ETS::ETS_MethodResult::OK);
  else
    SetTestMethodResult(errorCode);
}

/// <echoUTF8DYNAMIC>
enum Bool ProvideArgumentsForMethod_echoUTF8DYNAMIC_Length_too_short_for_malformed_String(dword methodCallHandle)
{
  dword i, errorCode;
  BYTE buffer[200];
  dword sizePayload;
  enum Bool success;

  success = SetMethodArgumentStringUTF8(methodCallHandle, gMethodArgumentName_echoUTF8DYNAMIC_REQ_UTF8String,
    gExpectedResult_echoUTF8DYNAMIC, errorCode);

  if(success)
  {
    sizePayload = SomeIpGetData(methodCallHandle, elcount(buffer), buffer);
    for(i=0; i<4; i++) // length in payload has to be patched
    {
      if(buffer[i]==0)
        continue;

      buffer[i] = 2;
      if(SomeIpSetData(methodCallHandle, sizePayload, buffer)!=0)
      {
        ReportSomeIpError("Setting payload failed");
        return kFalse;
      }
      break;
    }
  }
  return success;
}

/// <echoUTF8DYNAMIC>
void OnMethodResponse_echoUTF8DYNAMIC_Length_too_short_for_malformed_String(dword methodCallHandle, dword messageResponseHandle)
{
  dword errorCode;
  if(CheckMethodResponse_echoUTF8(messageResponseHandle, gMethodArgumentName_echoUTF8DYNAMIC_RES_UTF8String,
       gExpectedResult_echoUTF8DYNAMIC, errorCode))
    SetTestMethodResult(sysvar::TC8_ETS::ETS_MethodResult::OK);
  else
    SetTestMethodResult(errorCode);  
}

/// <echoUTF8FIXED>
enum Bool ProvideArgumentsForMethod_echoUTF8FIXED(dword methodCallHandle)
{
  dword errorCode;
 int i;

  for(i=0; i<elcount(gExpectedResult_echoUTF8FIXED)-5; ++i)
  {
    gExpectedResult_echoUTF8FIXED[i] = 65 + (i%26);
  }
  gExpectedResult_echoUTF8FIXED[i] = 0;
  return SetMethodArgumentStringUTF8(methodCallHandle, gMethodArgumentName_echoUTF8FIXED_REQ_UTF8String,
      gExpectedResult_echoUTF8FIXED, errorCode);
}

/// <echoUTF8FIXED>
void OnMethodResponse_echoUTF8FIXED(dword methodCallHandle, dword messageResponseHandle)
{
  dword errorCode;
  if(CheckMethodResponse_echoUTF8(messageResponseHandle, gMethodArgumentName_echoUTF8FIXED_RES_UTF8String,
       gExpectedResult_echoUTF8FIXED, errorCode))
    SetTestMethodResult(sysvar::TC8_ETS::ETS_MethodResult::OK);
  else
    SetTestMethodResult(errorCode);
}

/// <echoUTF8FIXED>
enum Bool ProvideArgumentsForMethod_echoUTF8FIXED_String_too_long(dword methodCallHandle)
{
  dword errorCode;
  enum Bool result;
  byte payload[UTF8FIXED_ENCODED_SIZE + 20];
  long payloadSize;
  int i;

  for(i=0; i<elcount(gExpectedResult_echoUTF8FIXED)-1; ++i)
  {
    gExpectedResult_echoUTF8FIXED[i] = 65 + (i%26);
  }
  gExpectedResult_echoUTF8FIXED[i] = 0;
  
  result = SetMethodArgumentStringUTF8(methodCallHandle, gMethodArgumentName_echoUTF8FIXED_REQ_UTF8String,
      gExpectedResult_echoUTF8FIXED, errorCode);
  
  if(result)
  {
    payloadSize = SomeIpGetData(methodCallHandle, elcount(payload), payload);
    if(payloadSize!=UTF8FIXED_ENCODED_SIZE+UTF8BOM_SIZE || SomeIpGetLastError()!=0)
    {
      ReportSomeIpError("Payload problem");
      return kFalse;
    }

    for(i=payloadSize-UTF8BOM_SIZE-UTF8TERMINATION_SIZE; i<elcount(payload)-UTF8TERMINATION_SIZE; ++i)
    {
      payload[i] = payload[UTF8BOM_SIZE];   // fill the payload with the first encoded character
    }
    payloadSize = elcount(payload);
    
    RestorePayloadStringTermination(payloadSize, payload, UTF8TERMINATION_SIZE);

    if(SomeIpSetData(methodCallHandle, payloadSize, payload)!=0)
    {
      result = kFalse;
      ReportSomeIpError("Set data failed");
    }
  }
  return result;
}

/// <echoUTF8FIXED>
void OnMethodResponse_echoUTF8FIXED_String_too_long(dword methodCallHandle, dword messageResponseHandle)
{
  dword errorCode;
  if(CheckMethodResponse_echoUTF8(messageResponseHandle, gMethodArgumentName_echoUTF8FIXED_RES_UTF8String,
       gExpectedResult_echoUTF8FIXED, errorCode))
    SetTestMethodResult(sysvar::TC8_ETS::ETS_MethodResult::OK);
  else
    SetTestMethodResult(errorCode);
}

/// <echoUTF8FIXED>
enum Bool ProvideArgumentsForMethod_echoUTF8FIXED_String_too_short(dword methodCallHandle)
{
  dword errorCode;
  enum Bool result;
  byte payload[UTF8FIXED_ENCODED_SIZE+20];
  long payloadSize;
  int i;
  byte SHORTEN_BY_SIZE = 10;
  
  for(i=0; i<(elcount(gExpectedResult_echoUTF8FIXED) - 1); ++i)
  {
    gExpectedResult_echoUTF8FIXED[i] = 65 + (i%26);
  }
  gExpectedResult_echoUTF8FIXED[i] = 0;
  
  result = SetMethodArgumentStringUTF8(methodCallHandle, gMethodArgumentName_echoUTF8FIXED_REQ_UTF8String,
      gExpectedResult_echoUTF8FIXED, errorCode);
  
  
  if(result)
  {
    payloadSize = SomeIpGetData(methodCallHandle, elcount(payload), payload);
    if(payloadSize!=UTF8FIXED_ENCODED_SIZE+UTF8BOM_SIZE || SomeIpGetLastError()!=0)
    {
      ReportSomeIpError("Payload problem");
      return kFalse;
    }
    payloadSize -= SHORTEN_BY_SIZE;

    RestorePayloadStringTermination(payloadSize, payload, UTF8TERMINATION_SIZE);

    if(SomeIpSetData(methodCallHandle, payloadSize, payload)!=0)
    {
      result = kFalse;
      ReportSomeIpError("Set data failed");
    }
  }
  return result;
}

/// <echoUTF16FIXED>
void OnMethodResponse_echoUTF8FIXED_String_too_short(dword methodCallHandle, dword messageResponseHandle)
{
  dword errorCode;
  if(CheckMethodResponse_echoUTF8(messageResponseHandle, gMethodArgumentName_echoUTF8FIXED_RES_UTF8String,
       gExpectedResult_echoUTF8FIXED, errorCode))
    SetTestMethodResult(sysvar::TC8_ETS::ETS_MethodResult::OK);
  else
    SetTestMethodResult(errorCode);
}

/// <clientService>
enum Bool ProvideArgumentsForMethod_suspendInterface(dword methodCallHandle)
{
  dword errorCode;
  return (enum Bool)
    (SetMethodArgumentDWord(methodCallHandle, gMethodArgumentName_suspendInterface_REQ_delay, syspar::SomeIp_ETS_SuspendInterface_DelayMilliseconds/1000, errorCode) &&
     SetMethodArgumentDWord(methodCallHandle, gMethodArgumentName_suspendInterface_REQ_duration, syspar::SomeIp_ETS_SuspendInterface_DurationMilliseconds/1000, errorCode));
}

/// <clientService>
void OnMethodResponse_clientServiceGetLastValueOfEventTCP(dword methodCallHandle, dword messageResponseHandle)
{
  dword response, errorCode;
  
  if(CheckResponseReturnCode(messageResponseHandle, 0, errorCode) &&
     GetMethodArgumentDWord(messageResponseHandle, gMethodArgumentName_clientServiceGetLastValueOfEventTCP_RES_arg1, response, errorCode) &&
     CheckResponseDataComparision(response==gTestEventUINT8Reliable, errorCode))
    SetTestMethodResult(sysvar::TC8_ETS::ETS_MethodResult::OK);
  else
    SetTestMethodResult(errorCode);
}

/// <clientService>
void OnMethodResponse_clientServiceGetLastValueOfEventUDPMulticast(dword methodCallHandle, dword messageResponseHandle)
{
  dword response, errorCode;
  
  if(CheckResponseReturnCode(messageResponseHandle, 0, errorCode) &&
     GetMethodArgumentDWord(messageResponseHandle, gMethodArgumentName_clientServiceGetLastValueOfEventUDPMulticast_RES_arg1, response, errorCode) &&
     CheckResponseDataComparision(response==gTestEventUINT8Multicast, errorCode))
    SetTestMethodResult(sysvar::TC8_ETS::ETS_MethodResult::OK);
  else
    SetTestMethodResult(errorCode);
}

/// <clientService>
void OnMethodResponse_clientServiceGetLastValueOfEventUDPUnicast(dword methodCallHandle, dword messageResponseHandle)
{
  dword response, errorCode;
  
  if(CheckResponseReturnCode(messageResponseHandle, 0, errorCode) &&
     GetMethodArgumentDWord(messageResponseHandle, gMethodArgumentName_clientServiceGetLastValueOfEventUDPUnicast_RES_arg1, response, errorCode) &&
     CheckResponseDataComparision(response==gTestEventUINT8, errorCode))
    SetTestMethodResult(sysvar::TC8_ETS::ETS_MethodResult::OK);
  else
    SetTestMethodResult(errorCode);
}

/// <Helper functions>
enum Bool AllFieldNotificationsReceived()
{
  for(long fieldId: gWaitingForFieldNotificationsCount)
  {
    if(gWaitingForFieldNotificationsCount[fieldId]>0)
      return kFalse;
  }
  return kTrue;
}

/// <Helper functions>
enum Bool AllEventNotificationsReceived()
{
  for(long eventId: gWaitingForEventNotificationsCount)
  {
    if(gWaitingForEventNotificationsCount[eventId]>0)
      return kFalse;
  }
  return kTrue;
}

on timer gWaitConditionReachedTimer
{
  testSupplyTextEvent("ETSAllWaitNotificationsReached");
}

/// <Event Notifications>
void EventNotificationReceived(dword eventId)
{
  if(gWaitingForEventNotifications && gWaitingForEventNotificationsCount.containsKey(eventId) && gWaitingForEventNotificationsCount[eventId]>0)
  {
    --gWaitingForEventNotificationsCount[eventId];
    if(AllEventNotificationsReceived() && isTimerActive(gWaitConditionReachedTimer)==0)
      setTimer(gWaitConditionReachedTimer, 0);
  }
}

/// <Event Notifications>
void Tester_EventReceived_TestEventUINT8(dword eventHandle, dword messageHandle)
{
  EventNotificationReceived(EVENT_ID_TestEventUINT8);
}

/// <Event Notifications>
void Tester_EventReceived_TestEventUINT8Array(dword eventHandle, dword messageHandle)
{
  EventNotificationReceived(EVENT_ID_TestEventUINT8Array);
}

/// <Event Notifications>
void Tester_EventReceived_TestEventUINT8Reliable(dword eventHandle, dword messageHandle)
{
  EventNotificationReceived(EVENT_ID_TestEventUINT8Reliable);
}

/// <Event Notifications>
void Tester_EventReceived_TestEventUINT8Multicast(dword eventHandle, dword messageHandle)
{
  EventNotificationReceived(EVENT_ID_TestEventUINT8Multicast);  
}

/// <Field Notifications>
void FieldNotificationReceived(dword fieldId)
{
  if(gWaitingForFieldNotifications && gWaitingForFieldNotificationsCount.containsKey(fieldId) && gWaitingForFieldNotificationsCount[fieldId]>0)
  {
    --gWaitingForFieldNotificationsCount[fieldId];
    if(AllFieldNotificationsReceived() && isTimerActive(gWaitConditionReachedTimer)==0)
      setTimer(gWaitConditionReachedTimer, 0);
  }
}

/// <Field Notifications>
void Tester_OnFieldNotification_InterfaceVersion(DWORD pfHandle, DWORD messageHandle)
{
  gFieldNotificationReceived_InterfaceVersion = kTrue;
  FieldNotificationReceived(FIELD_ID_InterfaceVersion);
}

/// <Field Notifications>
void Tester_OnFieldNotification_TestFieldUINT8(DWORD pfHandle, DWORD messageHandle)
{
  gFieldNotificationReceived_TestFieldUINT8 = kTrue;
  FieldNotificationReceived(FIELD_ID_TestFieldUINT8);
}

/// <Field Notifications>
void Tester_OnFieldNotification_TestFieldUINT8Array(DWORD pfHandle, DWORD messageHandle)
{
  gFieldNotificationReceived_TestFieldUINT8Array = kTrue;
  FieldNotificationReceived(FIELD_ID_TestFieldUINT8Array);
}

/// <Field Notifications>
void Tester_OnFieldNotification_TestFieldUINT8Reliable(DWORD pfHandle, DWORD messageHandle)
{
  gFieldNotificationReceived_TestFieldUINT8Reliable = kTrue;
  FieldNotificationReceived(FIELD_ID_TestFieldUINT8Reliable);
}

void OnSomeIpSDClientEventGroupStatusChanged( dword serviceId, dword instanceId, dword eventGroupId, long status )
{
  if(gWaitingForSubscribeAcks)
  {
    if(serviceId==syspar::SomeIp_ETS_ServiceId && instanceId==syspar::SomeIp_ETS_DUT_InstanceId &&
       gWaitingForSubscribeAckEventgroups.containsKey(eventGroupId))
    {
      if(status==1)
      {
        int i;
        
        gWaitingForSubscribeAckEventgroups[eventGroupId] = kFalse;
        
        for(long aKey: gWaitingForSubscribeAckEventgroups)
        {
          if(gWaitingForSubscribeAckEventgroups[aKey]==kTrue)
            return;
        }
        
        if(isTimerActive(gWaitConditionReachedTimer)==0)
          setTimer(gWaitConditionReachedTimer, 0);
      }
    }
  }
}

/// <InterfaceVersion>
void OnMethodResponse_get_InterfaceVersion(dword methodCallHandle, dword messageHandle )
{
  dword majorVersion, minorVersion, errorCode;
  if(GetMethodArgumentDWord(messageHandle, gFieldname_InterfaceVersion_majorVersion, majorVersion, errorCode)!=kOk &&
     GetMethodArgumentDWord(messageHandle, gFieldname_InterfaceVersion_minorVersion, minorVersion, errorCode)!=kOk)
  {
    gResponseValue_GetterInterfaceVersion.majorVersion = majorVersion;
    gResponseValue_GetterInterfaceVersion.minorVersion = minorVersion;
    SetTestMethodResult(sysvar::TC8_ETS::ETS_MethodResult::OK);
  }
  else
    SetTestMethodResult(errorCode);
}

/// <TestFieldUINT8>
void OnMethodResponse_get_TestFieldUINT8(dword methodCallHandle, dword messageHandle )
{
  dword errorCode;
  if(GetMethodArgumentDWord(messageHandle, "", gResponseValue_GetterTestFieldUINT8, errorCode)!=kOk)
    SetTestMethodResult(sysvar::TC8_ETS::ETS_MethodResult::OK);
  else
    SetTestMethodResult(errorCode);
}

/// <TestFieldUINT8>
enum Bool ProvideArgumentsForMethod_set_TestFieldUINT8(dword methodCallHandle)
{
  dword errorCode;
  return SetMethodArgumentDWord(methodCallHandle, "", gRequestedValue_SetterTestFieldUINT8, errorCode);
}

/// <TestFieldUINT8>
void OnMethodResponse_set_TestFieldUINT8(dword methodCallHandle, dword messageResponseHandle)
{
  dword errorCode;
  if(CheckResponseReturnCode(messageResponseHandle, 0, errorCode) &&
     GetMethodArgumentDWord(messageResponseHandle, "", gResponseValue_SetterTestFieldUINT8, errorCode))
    SetTestMethodResult(sysvar::TC8_ETS::ETS_MethodResult::OK);
  else
    SetTestMethodResult(errorCode);
}

/// <TestFieldUINT8Reliable>
void OnMethodResponse_get_TestFieldUINT8Reliable(dword methodCallHandle, dword messageResponseHandle )
{
  dword errorCode;
  if(CheckResponseReturnCode(messageResponseHandle, 0, errorCode) &&
     GetMethodArgumentDWord(messageResponseHandle, "", gResponseValue_GetterTestFieldUINT8Reliable, errorCode))
    SetTestMethodResult(sysvar::TC8_ETS::ETS_MethodResult::OK);
  else
    SetTestMethodResult(errorCode);
}

/// <TestFieldUINT8Reliable>
enum Bool ProvideArgumentsForMethod_set_TestFieldUINT8Reliable(dword methodCallHandle)
{
  dword errorCode;
  return SetMethodArgumentDWord(methodCallHandle, "", gRequestedValue_SetterTestFieldUINT8Reliable, errorCode);
}

/// <TestFieldUINT8Reliable>
void OnMethodResponse_set_TestFieldUINT8Reliable(dword methodCallHandle, dword messageResponseHandle)
{
  dword errorCode;
  if(CheckResponseReturnCode(messageResponseHandle, 0, errorCode) &&
     GetMethodArgumentDWord(messageResponseHandle, "", gResponseValue_SetterTestFieldUINT8Reliable, errorCode)==kTrue)
    SetTestMethodResult(sysvar::TC8_ETS::ETS_MethodResult::OK);
  else
    SetTestMethodResult(errorCode);
}

/// <TestFieldUINT8Array>
void OnMethodResponse_get_TestFieldUINT8Array(dword methodCallHandle, dword messageHandle )
{
  dword length, i, value, errorCode;
  char buffer[32];
  gResponseValues_GetterTestFieldUINT8Array.length = 0;
  if(SetMethodArgumentDWord(messageHandle, "", length, errorCode)==kTrue)
  {
    gResponseValues_GetterTestFieldUINT8Array.length = length;
    for(i=0; i<length; ++i)
    {
      snprintf(buffer, elcount(buffer), "[%d]", i);
      if(GetMethodArgumentDWord(messageHandle, buffer, value, errorCode)!=kTrue)
      {
        SetTestMethodResult(errorCode);
        return;
      }
      gResponseValues_GetterTestFieldUINT8Array.values[i] = value;
    }
    SetTestMethodResult(sysvar::TC8_ETS::ETS_MethodResult::OK);
  }
  else
    SetTestMethodResult(errorCode);
}

/// <TestFieldUINT8Array>
enum Bool ProvideArgumentsForMethod_set_TestFieldUINT8Array(dword methodCallHandle)
{
  dword i, errorCode;
  char buffer[32];
  
  if(SetMethodArgumentDWord(methodCallHandle, "", gRequestedValues_SetterTestFieldUINT8Array.length, errorCode)!=kTrue)
    return kFalse;
  
  for(i=0; i<gRequestedValues_SetterTestFieldUINT8Array.length; i++)
  {
    snprintf(buffer, elcount(buffer), "[%d]", i);
    if(SetMethodArgumentDWord(methodCallHandle, buffer, gRequestedValues_SetterTestFieldUINT8Array.values[i], errorCode)!=kTrue)
      return kFalse;
  }
  return kTrue;
}

/// <TestFieldUINT8Array>
void OnMethodResponse_set_TestFieldUINT8Array(dword methodCallHandle, dword messageResponseHandle)
{
  dword i, length, value, errorCode;
  char buffer[32];
  gResponseValues_SetterTestFieldUINT8Array.length = 0;

  if(CheckResponseReturnCode(messageResponseHandle, 0, errorCode) &&
     GetMethodArgumentDWord(messageResponseHandle, "", length, errorCode))
  {  
    for(i=0; i<length; i++)
    {
      snprintf(buffer, elcount(buffer), "[%d]", i);
      if(GetMethodArgumentDWord(messageResponseHandle, buffer, value, errorCode)!=kTrue)
      {
        SetTestMethodResult(errorCode);
        return;
      }
      gResponseValues_SetterTestFieldUINT8Array.values[i] = value;
    }
    gResponseValues_SetterTestFieldUINT8Array.length = length;
    SetTestMethodResult(sysvar::TC8_ETS::ETS_MethodResult::OK);
  }
  else
    SetTestMethodResult(errorCode);
}

/// <Helper functions>
void CallTriggerEventMethod(char testFunctionName[], dword methodId, dword eventId,
  char triggerEventDelayArgName[], dword triggerEventDelay,
  char triggerEventDurationArgName[], dword triggerEventDuration,
  char triggerEventDebounceTimeArgName[], dword triggerEventDebounceTime)
{
  DWORD methodCallHandle, errorCode, udpHandle;
  
  udpHandle = (gClientServiceAepHandleUDP ? gClientServiceAepHandleUDP : gUdpAepForSubscribeWithoutCSI);
  
  if(CreateMethodHandleFireAndForget(udpHandle, methodId, methodCallHandle)==kFalse)
  {
      testStepFail(testFunctionName, "Creation of method call handle failed");
      return;
  }

  if(SetMethodArgumentDWord(methodCallHandle, triggerEventDelayArgName, triggerEventDelay, errorCode)!=kTrue ||
     SetMethodArgumentDWord(methodCallHandle, triggerEventDurationArgName, triggerEventDuration, errorCode)!=kTrue ||
     SetMethodArgumentDWord(methodCallHandle, triggerEventDebounceTimeArgName, triggerEventDebounceTime, errorCode)!=kTrue)
  {
    testStepFail(testFunctionName, "Setting arguments failed");
    return;
  }

  testWaitForTimeoutSilent(100);    

  if(SomeIpCallMethod(methodCallHandle)!=0)
  {
    ReportSomeIpError("Call of triggerEvent* failed");
    testStepFail(testFunctionName, "Method call failed");
    return;
  }
  
  gWaitingForEventNotificationsCount[eventId] = 1; 
}

void OnMethodResponseTypeError(dword methodCallHandle, dword messageResponseHandle)
{
  SetTestMethodResult(SomeIpGetReturnCode(messageResponseHandle), E_MRT_ERROR);
}
