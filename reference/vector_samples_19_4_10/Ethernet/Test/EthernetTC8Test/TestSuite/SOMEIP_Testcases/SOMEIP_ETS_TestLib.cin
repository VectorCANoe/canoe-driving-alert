/*@!Encoding:1252*/
/***************************************************************************************
 * Demo- and Example-Programs
 *
 * Please note: The demo and example programs only show special aspects of the software.
 * With regard to the fact that these programs are meant for demonstration purposes only,
 * Vector Informatik's liability shall be expressly excluded in cases of ordinary
 * negligence, to the extent admissible by law or statute.
 *
 * Beta-Version
 *
 * These programs are fully operative programs. However, they are not thoroughly tested
 * yet (beta-version). With regard to the fact that the programs are a beta-version only,
 * Vector Informatik's liability shall be expressly excluded in cases of ordinary
 * negligence, to the extent admissible by law or statute.
 *
 * DESCRIPTION:
 *
 * Demo test implementation of the 'OPEN Alliance Automotive Ethernet ECU Test
 * Specification - TC8 ECU Test' (Document Version 3.0, May 7, 2020)
 *
 * Copyright (c) Vector Informatik GmbH. All rights reserved.
 ***************************************************************************************/

includes
{
  #include "SOMEIP_ETS_TesterFunctions.cin"
}

variables
{
  enum SomeIpResponseMessageType
  {
    E_MRT_RESPONSE,
    E_MRT_ERROR
  };

  word gExtractedPort=0;
  
  msTimer gTestResultTimer, gTriggerFindServiceTimer;
  enum Bool gIsWaitingForETSCallResult = kFalse;
 
  enum Bool gObserveSomeIpMessageForOtherIp;
  IP_Address gObserveSomeIpMessageForOtherIp_Address;
  
  enum EndpointSelector
  {
    Without_Endpoints,
    UDP_Endpoint_Only,
    UDP_Endpoint_Twice,
    UDP_and_TCP_Endpoint
  };

  struct TriggerFindServiceTimerArgs
  {
    dword numberOfMessagesToSend;
    dword numberOfSendsDone;
    dword sessionId;
    dword instanceId;
    enum EndpointSelector endpointSelector;
    char majorVersion[16];
    char minorVersion[16];
    char destinationIP[64];
  };
  
  struct TriggerFindServiceTimerArgs gTriggerFindServiceTimerArgs;
  
  // used for method calls
  dword gResultOfMethodCall;
  enum SomeIpResponseMessageType gMessageTypeOfResultOfMethodCall;
  
  // used for 
  dword gUdpAepForSendEvent;
  dword gTcpAepForOfferEvent;
  
  // used for subscribe notificatins without a ConsumedServiceInstance
  dword gTcpAepForSubscribeWithoutCSI, gUdpAepForSubscribeWithoutCSI, gPortForSubscribeWithoutCSI;

  char gETSProcessName[12] = "Tester";

  byte gIsWaitingForETSService = 0;
  LONG gETSStatus = -1, gETSExpectedStatus;

  byte gServiceCreatedETS = 0;

  dword gFieldConsumerHandle_InterfaceVersion=0;
  dword gFieldConsumerHandle_TestFieldUINT8=0;
  dword gFieldConsumerHandle_TestFieldUINT8Array=0;
  dword gFieldConsumerHandle_TestFieldUINT8Reliable=0;
  
  enum TCPConnectionState {
    kTCPConnectionEstablished,
    kTCPConnectionClosed,
    kTCPConnectionReestablished
  };
  enum Bool gWaitingForNewTCPConnectionState = kFalse;
  enum TCPConnectionState gWaitingForTCPConnectionState;
  enum Bool gReestablishedEstablished = kFalse;
  enum Bool gReestablishedClosed = kFalse;
  
  IP_Endpoint gLocalEndpointOfEstablishedConnection;

}

enum EndpointSelector getEndpointSelectorForEVG(dword evgId)
{
  return evgId==2 ? UDP_and_TCP_Endpoint : UDP_Endpoint_Only;
}

export InitTestFixtureETS()
{
  SetBusContext(GetBusNameContext("Ethernet_1"));
  
  gSomeIpTestGroup = kSomeIpEts;
  strncpy(gSomeIpTestGroupName, "SOMEIP ETS", elcount(gSomeIpTestGroupName));
  Internal_InitTestFixture(gSomeIpTestGroup, "OnEthernetPacketSOMEIP_ETS");

  sysSetVariableInt(sysvar::TC8_ETS_Config::ETS_ServiceId, syspar::SomeIp_ETS_ServiceId);
  sysSetVariableInt(sysvar::TC8_ETS_Config::ETS_Port, syspar::SomeIp_ETS_Port);

  sysSetVariableInt(sysvar::TC8_ETS_Config::ETS_DUT_ServiceInstanceId, syspar::SomeIp_ETS_DUT_InstanceId);
  sysSetVariableInt(sysvar::TC8_ETS_Config::ETS_Tester_ServiceInstanceId, atol(syspar::SomeIp_ETS_Tester_InstanceId));
  sysSetVariableString(sysvar::TC8_ETS_Config::EventGroupId1Si1MulticastAddr, syspar::EventGroupId1Si1MulticastAddr);
  
  SomeIpSetVerbosity(3);
  SomeIpIlControlStart();

  SomeIpConsistencyCheck();
  
  testWaitForTimeout(5000); //Wait until IGMP messages have been sent
  OpenLocalApplicationEndPointsForETS();
}

void OpenLocalApplicationEndPointsForETS()
{
  IP_Endpoint endpoint;
  SetBusContext(GetBusNameContext("Ethernet_1"));
  
  if(InitEndpoint(endpoint, syspar::IpAddressTester, 0)!=kTrue)
  {
    testStepFail("UDP Server AEP init endpoint failed");
    return;
  }
  
  endpoint.SetToUdp();
  gClientServiceAepHandleUDP = ETSOpenLocalApplicationEndpoint(endpoint);
  if(gClientServiceAepHandleUDP==0)
  {
    ReportSomeIpError("Creation of UDP local application endpoint failed");
    return;
  }

  endpoint.SetToTcp();
  gClientServiceAepHandleTCP = ETSOpenLocalApplicationEndpoint(endpoint);
  if(gClientServiceAepHandleTCP==0)
  {
    ReportSomeIpError("Creation of TCP local application endpoint failed");
    return;
  }
}

void ReceivedEthPacketTcp(long channel, long dir, long packetHandle)
{
  if (gObservingEthPackets == kFalse)
  {
    //write("Ethernet packet received, but not observed at %.5f", timeNowFloat()/100000.0);
    return;
  } 

  if(CompareParameters(packetHandle, channel, gReportOnFailure))
    EthernetPacketReceived(channel);
}

enum Bool HasIpDestinationAddress(ethernetPacket * packet, IP_Address destination)
{
  IP_Address packetAddress;
  byte addressArray[16];
  if(packet.ipv4.IsAvailable())
  {
    return packet.ipv4.destination==destination.IPv4Address ? kTrue : kFalse;
  }
  else if(packet.ipv6.IsAvailable())
  {
    packet.ipv6.destination.GetData(0, addressArray, elcount(addressArray));
    packetAddress.SetAddressAsArray(addressArray);
    return packetAddress.MatchesAddress(destination) ? kTrue : kFalse;
  }
  return kFalse;
}

on ethernetPacket *
{
  byte NOTIFICATION_MESSAGE_SIZE = 16;
  byte buffer[1600], buffer2[1600];
  word bufferLength;
  dword destIp, messageHandle, msgLen, offset, msgType;
  
  // special handling necessary for SOME/IP messages which are addressed to another ip
  // because these packets are not processed by SOME/IP IL
  if(gObserveSomeIpMessageForOtherIp==kTrue && this.msgChannel==1 && this.dir==RX &&
     this.someip.isAvailable() && HasIpDestinationAddress(this, gObserveSomeIpMessageForOtherIp_Address)==kTrue)
  {
    bufferLength = this.someip.GetData(0, buffer, elcount(buffer));
    if(bufferLength)
    {
      offset=0;
      while(offset<bufferLength) // process all messages in that packet
      {
        messageHandle = SomeIpCreateMessage(bufferLength, buffer, offset); 
        if(messageHandle)
        {
          msgType = SomeIpGetMessageType(messageHandle);
          msgLen = SomeIpGetData(messageHandle, elcount(buffer2), buffer2);
          OnSomeIpProcessRxMessage(messageHandle, this.msgChannel);
          SomeIpReleaseMessage(messageHandle);
          if(msgType!=0x02) // Notification
          {
            write("############# unhandled SOME/IP message type %d ################", msgType);
            break;
          }
          offset += NOTIFICATION_MESSAGE_SIZE + msgLen;
        }
        else
          break;
      }
    }
  }
}

void OnEthernetPacketSOMEIP_ETS(long channel, long dir, long packetHandle)
{
  //
  char direction[2][16] = { "receiving", "sending" };
  long result;
  //write("> OnEthernetPacketSOMEIP_ETS at %.5f, dir: %s, channel %ld, isWaiting %d isObserving %d", timeNowFloat()/100000.0, direction[dir], channel, gIsWaitingForSOMEIPMessage, gObservingEthPackets);
  //
  AnswerArpRequestForHost1(packetHandle);
  AnswerNdpSolicitation(packetHandle);
  if(gIsWaitingForSOMEIPMessage==0) // SOME/IP packets must be handled by OnSomeIpProcessRxMessage
  {
    ReceivedEthPacketTcp(channel, dir, packetHandle);
  }
  //write("< OnEthernetPacketSOMEIP_ETS");
}

enum Bool ETS_PostSomeIpSDNotification2(dword & notificationHandle, IP_Endpoint sourceEndpoint, IP_Endpoint destinationEndpoint)
{
  dword aep;
  long result;
  enum Bool success;
  
  SetBusContext(GetBusNameContext("Ethernet_1"));
  
  success = kTrue;
  
  sourceEndpoint.SetToUdp();
  destinationEndpoint.SetToUdp();
  aep = ETSOpenLocalApplicationEndpoint(sourceEndpoint);
  if(aep==0)
  {
    ReportSomeIpError("SomeIpOpenLocalApplicationEndpoint failed");
    success = kFalse;
  }
  else
  {
    result = SomeIpPostMessage(aep, destinationEndpoint, notificationHandle);
    if(result!=0)
    {
      ReportSomeIpError("Post message failed");
      success = kFalse;
    }
  }
  
  if(SomeIpReleaseMessage(notificationHandle)!=0)
  {
    ReportSomeIpError("Release message failed");
    success = kFalse;
  }
  notificationHandle=0;
  
  if(aep && ETSCloseLocalApplicationEndpoint(aep))
  {
    ReportSomeIpError("SomeIpCloseLocalApplicationEndpoint failed");
    success = kFalse;
  }
  aep = 0;
  return success;
}

enum Bool ETS_OutputSomeIpSDNotification(dword & notificationHandle, IP_Endpoint sourceEndpoint, IP_Endpoint destinationEndpoint)
{
  dword aep;
  long result;
  enum Bool success;
  
  SetBusContext(GetBusNameContext("Ethernet_1"));
  
  success = kTrue;

  sourceEndpoint.SetToUdp();
  destinationEndpoint.SetToUdp();
  aep = ETSOpenLocalApplicationEndpoint(sourceEndpoint); //syspar::UdpProtocol, atol(syspar::SomeIpServiceDiscoveryPort));
  if(aep==0)
  {
    ReportSomeIpError("SomeIpOpenLocalApplicationEndpoint failed");
    success = kFalse;
  }
  else
  {
    result = SomeIpOutputMessage(aep, destinationEndpoint, notificationHandle);
    if(result!=0)
    {
      ReportSomeIpError("Output message failed");
      success = kFalse;
    }
  }
  
  if(SomeIpReleaseMessage(notificationHandle)!=0)
  {
    ReportSomeIpError("Release message failed");
    success = kFalse;
  }
  notificationHandle=0;
  
  if(aep && ETSCloseLocalApplicationEndpoint(aep))
  {
    ReportSomeIpError("SomeIpCloseLocalApplicationEndpoint failed");
    success = kFalse;
  }
  aep = 0;
  return success;
}

export testfunction ETS_StartServer2(enum Bool useMulticastEvents, enum Bool useExtendedSDBaseRepetitionDelay)
{
    if(gServiceCreatedETS==0)
    {
      char buf[100];
      int64 multicastThreshold;
      multicastThreshold = useMulticastEvents==kTrue ? 1 : 0;

      //writeEx(-3,1,"%s: ServiceID=%u", gProcessName, @sysvar::TC8_ETS_Config::ETS_ServiceId);
      gServiceCreatedETS = createETSService(atol(syspar::SomeIp_ETS_Tester_InstanceId), syspar::IpAddressTester, multicastThreshold);
      if(gServiceCreatedETS==kFalse)
      {
        testStepFail("ETS_StartServer2", "Instantiation of ETS server 2 failed");
        return;
      }
    }
    else
    {
      write("########### ETS Server still exists ################");
    }
    if(startETSService()==kFalse)
    {
      ReportSomeIpError("Start of ETS service failed");
      testStepFail("ETS_StartServer2", "Start of ETS service failed");
      return;
    }
    else
      testStepPass("ETS_StartServer2", "ETS service started");
    
    if(useExtendedSDBaseRepetitionDelay)
    {
      SomeIpSetProperty(gPsiUdp, "SDBaseRepetitionDelay", 5000);
      SomeIpSetProperty(gPsiTcp, "SDBaseRepetitionDelay", 5000);
    }
}

export testfunction ETS_StartServer2(enum Bool useMulticastEvents)
{
  ETS_StartServer2(useMulticastEvents, kFalse);
}

export testfunction ETS_StartServer2()
{
  ETS_StartServer2(kFalse, kFalse);
}

export testfunction ETS_StopServer2()
{
  if(gServiceCreatedETS==kTrue)
  {
    stopETSService();
    testWaitForTimeout(5);
    if(destroyETSService()==kFalse)
    {
      testStepFail("ETS_StopServer2", "ETS server not stopped");
    }
    gServiceCreatedETS=0;
  }
}

export testfunction ETS_TriggerMethodCall(dword methodId)
{
  if(TriggerETSMethodCall(methodId, sysvar::TC8_ETS::ETS_TestVariant::Standard, sysvar::TC8_ETS::ETS_HeaderPatchVariant::Not_patched)==kFalse)
  {
    testStepFail("ETS_TriggerMethodCall", "ETS call failed or not executed");
  }
}

export testfunction ETS_TriggerMethodCall(dword methodId, dword testVariant)
{
  if(TriggerETSMethodCall(methodId, testVariant, sysvar::TC8_ETS::ETS_HeaderPatchVariant::Not_patched)==kFalse)
  {
    testStepFail("ETS_TriggerMethodCall", "ETS call failed or not executed");
  }
}

export testfunction ETS_WaitFor_AllMethodResults()
{
  if(gMultiCallExpectedNumberOfResponses==0)
  {
    testStepFail("ETS_WaitFor_AllMethodResults", "No method call results expected");
  }
  
  if(WaitForTestMethodResult()!=1)
  {
    testStepFail("ETS_WaitFor_AllMethodResults", "Method result not received");
  }
  else
  {
    testStepPass("ETS_WaitFor_AllMethodResults", "All method results have been received");
  }
}

export testfunction ETS_CallMethod_TriggerEventUINT8(dword delaySeconds, dword durationSeconds, dword debounceTimeSeconds)
{
  CallTriggerEventMethod("ETS_CallMethod_TriggerEventUINT8", sysvar::TC8_ETS::ETS_Method::triggerEventUINT8, EVENT_ID_TestEventUINT8,
    gMethodArgumentName_triggerEventUINT8_REQ_delay, delaySeconds, 
    gMethodArgumentName_triggerEventUINT8_REQ_duration, durationSeconds, 
    gMethodArgumentName_triggerEventUINT8_REQ_debounceTime, debounceTimeSeconds);
}

export testfunction ETS_CallMethod_TriggerEventUINT8Array(dword delaySeconds, dword durationSeconds, dword debounceTimeSeconds)
{
    CallTriggerEventMethod("ETS_CallMethod_TriggerEventUINT8Array", sysvar::TC8_ETS::ETS_Method::triggerEventUINT8Array, EVENT_ID_TestEventUINT8Array,
    gMethodArgumentName_triggerEventUINT8Array_REQ_delay, delaySeconds, 
    gMethodArgumentName_triggerEventUINT8Array_REQ_duration, durationSeconds, 
    gMethodArgumentName_triggerEventUINT8Array_REQ_debounceTime, debounceTimeSeconds);
}

export testfunction ETS_CallMethod_TriggerEventUINT8Multicast(dword delaySeconds, dword durationSeconds, dword debounceTimeSeconds)
{
    CallTriggerEventMethod("ETS_CallMethod_TriggerEventUINT8Multicast", sysvar::TC8_ETS::ETS_Method::triggerEventUINT8Multicast, EVENT_ID_TestEventUINT8Multicast,
    gMethodArgumentName_triggerEventUINT8Multicast_REQ_delay, delaySeconds, 
    gMethodArgumentName_triggerEventUINT8Multicast_REQ_duration, durationSeconds, 
    gMethodArgumentName_triggerEventUINT8Multicast_REQ_debounceTime, debounceTimeSeconds);
}

export testfunction ETS_CallMethod_TriggerEventUINT8Reliable(dword delaySeconds, dword durationSeconds, dword debounceTimeSeconds)
{
    CallTriggerEventMethod("ETS_CallMethod_TriggerEventUINT8Reliable", sysvar::TC8_ETS::ETS_Method::triggerEventUINT8Reliable, EVENT_ID_TestEventUINT8Reliable,
    gMethodArgumentName_triggerEventUINT8Reliable_REQ_delay, delaySeconds, 
    gMethodArgumentName_triggerEventUINT8Reliable_REQ_duration, durationSeconds, 
    gMethodArgumentName_triggerEventUINT8Reliable_REQ_debounceTime, debounceTimeSeconds);
}

export testfunction ETS_CallMethod_ClientServiceSubscribeEventgroup(dword delaySeconds, dword durationSeconds)
{
  DWORD methodCallHandle, errorCode;
    
  if(CreateMethodHandleFireAndForget(gClientServiceAepHandleUDP, sysvar::TC8_ETS::ETS_Method::clientServiceSubscribeEventgroup, methodCallHandle)==kFalse)
  {
      testStepFail("ETS_CallMethod_ClientServiceSubscribeEventgroup", "Creation of method call handle failed");
      return;
  }
  
  if(SetMethodArgumentDWord(methodCallHandle, gMethodArgumentName_clientServiceSubscribeEventgroup_REQ_delay, delaySeconds, errorCode)==kFalse ||
     SetMethodArgumentDWord(methodCallHandle, gMethodArgumentName_clientServiceSubscribeEventgroup_REQ_duration, durationSeconds, errorCode)==kFalse )
  {
    testStepFail("ETS_CallMethod_ClientServiceSubscribeEventgroup", "Setting delay argument failed");
    return;
  }

  testWaitForTimeoutSilent(1);
      
  if(SomeIpCallMethod(methodCallHandle)!=0)
  {
    ReportSomeIpError("Call of ClientServiceSubscribeEventgroup failed");
    testStepFail("ETS_CallMethod_ClientServiceSubscribeEventgroup", "Method call ClientServiceSubscribeEventgroup failed");
  }
}
  
export testfunction ETS_CallMethod_ClientServiceActivate(dword delaySeconds)
{
  DWORD methodCallHandle, errorCode;

  if(CreateMethodHandleFireAndForget(gClientServiceAepHandleUDP, sysvar::TC8_ETS::ETS_Method::clientServiceActivate, methodCallHandle)==kFalse)
  {
      testStepFail("ETS_CallMethod_ClientServiceActivate", "Creation of method call handle failed");
      return;
  }
  
  if(SetMethodArgumentDWord(methodCallHandle, gMethodArgumentName_clientServiceActivate_REQ_arg1, delaySeconds, errorCode)==kFalse)
  {
    testStepFail("ETS_CallMethod_ClientServiceActivate", "Setting delay argument failed");
    return;
  }

  testWaitForTimeoutSilent(50);
      
  if(SomeIpCallMethod(methodCallHandle)!=0)
  {
    ReportSomeIpError("Call of ClientServiceActivate failed");
    testStepFail("ETS_CallMethod_ClientServiceActivate", "Method call ClientServiceActivate failed");
  }
}

export testfunction ETS_CallMethod_ClientServiceDeactivate(dword delaySeconds)
{
  dword methodCallHandle, errorCode;
  if(CreateMethodHandleFireAndForget(gClientServiceAepHandleUDP, sysvar::TC8_ETS::ETS_Method::clientServiceDeactivate, methodCallHandle)==kFalse)
  {
      testStepFail("ETS_CallMethod_ClientServiceDeactivate", "Creation of method call handle failed");
      return;
  }
  
  if(SetMethodArgumentDWord(methodCallHandle, gMethodArgumentName_clientServiceDeactivate_REQ_arg1, delaySeconds, errorCode)==kFalse)
  {
    testStepFail("ETS_CallMethod_ClientServiceDeactivate", "Setting delay argument failed");
    return;
  }
  
  testWaitForTimeoutSilent(50);
  
  if(SomeIpCallMethod(methodCallHandle)!=0)
  {
    ReportSomeIpError("Call of ClientServiceDeactivate failed");
    testStepFail("ETS_CallMethod_ClientServiceDeactivate", "Method call ClientServiceDeactivate failed");
  }
}

export testfunction ETS_CallMethodAndWaitForAllResults(dword methodId, dword numberOfCallRepetitions, dword repetitionDelayMs)
{
  dword methodCallHandle, callCounter;
  enum Bool expectResponse;
  
  gMultiCallExpectedNumberOfResponses = 1 + numberOfCallRepetitions;
  gMultiCallReceivedNumberOfResponses = 0;
  gMultiCallAllResponsesOk = kTrue;

  for(callCounter=0;callCounter<gMultiCallExpectedNumberOfResponses; ++callCounter)
  {
    if(CreateETSMethodCallAndProvideArguments(methodId, sysvar::TC8_ETS::ETS_TestVariant::Standard, methodCallHandle, expectResponse)==kFalse)
    {
      testStepFail("ETS_CallMethodAndWaitForAllResults", "CreateMethodHandle failed");
      return;
    }
    
    //SomeIpRegisterCallback(methodCallHandle, "OnResponse_MethodMultiCall");
    
    if(callCounter>0 && repetitionDelayMs>0)
      testWaitForTimeout(repetitionDelayMs);

//testWaitForTimeoutSilent(100);    
    if(SomeIpCallMethod(methodCallHandle)!=0)
    {
      ReportSomeIpError("Call failed");
      testStepFail("ETS_CallMethodAndWaitForAllResults", "Call failed");
      return;
    }
  }    

  if(WaitForTestMethodResult()!=1)
  {
    testStepFail("ETS_CallMethodAndWaitForAllResults", "Response not received");
  }
  else
  {
    if(gResultOfMethodCall!=sysvar::TC8_ETS::ETS_MethodResult::OK)
    {
      char expected[64], actualResult[64];
      sysGetVariableDescriptionForValue(sysvar::TC8_ETS::ETS_MethodResult,
        sysvar::TC8_ETS::ETS_MethodResult::OK, expected, elcount(expected));
      sysGetVariableDescriptionForValue(sysvar::TC8_ETS::ETS_MethodResult,
        gResultOfMethodCall, actualResult, elcount(actualResult));
      
      testStepFail("ETS_CallMethodAndWaitForAllResults", "Invalid result '%s', expected '%s'", actualResult, expected);
    }
    else
    {
      testStepPass("ETS_CallMethodAndWaitForAllResults", "Call results fit expectation");
    }
  }
}

export testfunction ETS_CallMethodWithPatchedHeaderAndCheckError(dword methodId, dword headerPatchVariant, dword expectedError, enum Bool errorIsOptional)
{
  dword oldExpectedNumberOfResponses;
  //write("### ETS_CallMethodWithPatchedHeaderAndCheckError calling %d", gMultiCallExpectedNumberOfResponses);

  oldExpectedNumberOfResponses = gMultiCallExpectedNumberOfResponses;
  if(TriggerETSMethodCall(methodId, sysvar::TC8_ETS::ETS_TestVariant::Standard, headerPatchVariant))
  {
    gMultiCallExpectedNumberOfResponses = oldExpectedNumberOfResponses; // message with patched header gets no SOME/IP-IL response callback
    ETS_InternalWaitForSOMEIPError("ETS_CallMethodWithPatchedHeaderAndCheckError", syspar::ParamListenTimeMs, methodId, expectedError, errorIsOptional);
  }
  else
  {
      testStepFail("ETS_CallMethodWithPatchedHeaderAndCheckError", "ETS call failed or not executed");
  }
}

export testfunction ETS_CallMethodWithPatchedHeaderAndCheckNoAnswere(dword methodId, dword headerPatchVariant)
{
  byte payload[1];
  char serviceIdStr[32], returnCodeStr[32], methodIdStr[32];
  
  if(TriggerETSMethodCall(methodId, sysvar::TC8_ETS::ETS_TestVariant::Standard, headerPatchVariant))
  {
    snprintf(serviceIdStr, elcount(serviceIdStr), "%d", syspar::SomeIp_ETS_ServiceId);
    snprintf(methodIdStr, elcount(methodIdStr), "%d", methodId);
  
    gMultiCallExpectedNumberOfResponses = gMultiCallReceivedNumberOfResponses = 0;  
    gMultiCallResults.clear();

    InternalWaitForSOMEIP(
      syspar::ParamListenTimeMs,
      syspar::Host1Mac,
      syspar::IpAddressTester,
      syspar::Wildcard,
      syspar::Wildcard,
      SomeIpMessageTypeError,
      SomeIpEntryNull,
      -1,
      syspar::Wildcard,
      serviceIdStr,
      syspar::Wildcard,
      methodIdStr,
      syspar::Wildcard, syspar::Wildcard, kEquals,
      syspar::Wildcard, syspar::Wildcard, kEquals,
      syspar::Wildcard, syspar::Wildcard, kEquals,
      syspar::Wildcard, syspar::Wildcard, kEquals,
      syspar::Wildcard, syspar::Wildcard, kEquals,
      syspar::Wildcard, syspar::Wildcard, kEquals,
      syspar::UdpProtocol,
      kNoAnswerExpected,
      payload,
      0,
      0
    );
  }
  else
  {
      testStepFail("ETS_CallMethodWithPatchedHeaderAndCheckNoAnswere", "ETS call failed or not executed");
  }
}

export testfunction ETS_CallMethodVariantAndCheckResult(dword methodId, dword testVariant, dword expectedResult)
{
  dword result;
  if(TriggerETSMethodCall(methodId, testVariant, sysvar::TC8_ETS::ETS_HeaderPatchVariant::Not_patched))
  {
    result = WaitForTestMethodResult();
    if(result!=1)
    {
      testStepFail("ETS_CallMethodVariantAndCheckResult", "Response not received");
    }
    else
    {
      if(gResultOfMethodCall!=expectedResult)
      {
        char expected[64], actualResult[64];
        sysGetVariableDescriptionForValue(sysvar::TC8_ETS::ETS_MethodResult, expectedResult, expected, elcount(expected));
        sysGetVariableDescriptionForValue(sysvar::TC8_ETS::ETS_MethodResult, gResultOfMethodCall, actualResult, elcount(actualResult));
        
        testStepFail("ETS_CallMethodVariantAndCheckResult", "Invalid result '%s', expected '%s'", actualResult, expected);
      }
      else
      {
        testStepPass("ETS_CallMethodVariantAndCheckResult", "Call result fits expectation");
      }
    }
  }
  else
  {
      testStepFail("ETS_CallMethodVariantAndCheckResult", "ETS call failed or not executed");
  }
}

export testfunction ETS_CallMethodVariantAndCheckError(dword methodId, dword testVariant, dword expectedError)
{
  dword result;
  
  #if (TOOL_MAJOR_VERSION < 14) 
    testStepInconclusive("Insufficent tool version. This test requires at least version 14");
    return;
  #endif
  
  if(TriggerETSMethodCall(methodId, testVariant, sysvar::TC8_ETS::ETS_HeaderPatchVariant::Not_patched))
  {
    result = WaitForTestMethodResult();
    if(result!=1)
    {
      testStepFail("ETS_CallMethodVariantAndCheckError", "Response not received");
    }
    else
    {
      if(gMessageTypeOfResultOfMethodCall!=E_MRT_ERROR)
      {
        testStepFail("ETS_CallMethodVariantAndCheckError", "Response has wrong Message Type, expected ERROR");
      }
      else if(gResultOfMethodCall!=expectedError)
      {
        char expected[64], actualResult[64];
        sysGetVariableDescriptionForValue(sysvar::TC8_ETS::ETS_MethodResult,
          expectedError, expected, elcount(expected));
        sysGetVariableDescriptionForValue(sysvar::TC8_ETS::ETS_MethodResult,
          gResultOfMethodCall, actualResult, elcount(actualResult));
        
        testStepFail("ETS_CallMethodVariantAndCheckError", "Invalid result '%s', expected '%s'", actualResult, expected);
      }
      else
      {
        testStepPass("ETS_CallMethodVariantAndCheckError", "Call result fits expectation");
      }
    }
  }
  else
  {
      testStepFail("ETS_CallMethodVariantAndCheckError", "ETS call failed or not executed");
  }
}

export testfunction ETS_CallMethodVariantAndCheckOptionalResult(dword methodId, dword testVariant, dword expectedResult)
{
  dword result;
  
  if(TriggerETSMethodCall(methodId, testVariant, sysvar::TC8_ETS::ETS_HeaderPatchVariant::Not_patched))
  {
    //++gMultiCallExpectedNumberOfResponses;
    result = WaitForTestMethodResult();
    if(result!=1)
    {
      write("Received no response, but response is optional");
      testStepPass("ETS_CallMethodVariantAndCheckOptionalResult", "Received no response, but response is optional");
    }
    else
    {
      if(gResultOfMethodCall!=expectedResult)
      {
        char expected[64], actualResult[64];
        sysGetVariableDescriptionForValue(sysvar::TC8_ETS::ETS_MethodResult,
          expectedResult, expected, elcount(expected));
        sysGetVariableDescriptionForValue(sysvar::TC8_ETS::ETS_MethodResult,
          gResultOfMethodCall, actualResult, elcount(actualResult));
        
        testStepFail("ETS_CallMethodVariantAndCheckOptionalResult", "Invalid result '%s', expected '%s'", actualResult, expected);
      }
      else
      {
        testStepPass("ETS_CallMethodVariantAndCheckOptionalResult", "Call result fits expectation");
      }
    }
  }
  else
  {
      testStepFail("ETS_CallMethodVariantAndCheckOptionalResult", "ETS call failed or not executed");
  }
}

export testfunction ETS_CallMethodAndCheckResult(dword methodId, dword expectedResult)
{
  ETS_CallMethodVariantAndCheckResult(methodId, sysvar::TC8_ETS::ETS_TestVariant::Standard, expectedResult);
}

dword WaitForTestMethodResult()
{
  dword result;
  if(gMultiCallExpectedNumberOfResponses>0 && gMultiCallExpectedNumberOfResponses>gMultiCallReceivedNumberOfResponses)
  {
    write("Start waiting for method call responses: %d", gMultiCallExpectedNumberOfResponses);
    gIsWaitingForETSCallResult = kTrue;
    result = testWaitForTextEvent("ETSCallResult", syspar::ParamListenTimeMs);
    gIsWaitingForETSCallResult = kFalse;
    if(result!=1)
      write("Received only %d of %d results", gMultiCallReceivedNumberOfResponses, gMultiCallExpectedNumberOfResponses);
    write("Finished waiting for method call responses");
  }
  else
    result = 1; // we already received all responses
  gMultiCallExpectedNumberOfResponses = gMultiCallReceivedNumberOfResponses = 0;  
  gMultiCallResults.clear();
  gMultiCallResultTypes.clear();
  gWaitForConnectionToDutEstablishedDone=kFalse;
  return result;
}

on timer gTestResultTimer
{
  testSupplyTextEvent("ETSCallResult");
}

enum Bool SetTestMethodError(dword result)
{
  SetTestMethodResult(result);
  return kFalse;
}

void SetTestMethodResult(dword result)
{
  SetTestMethodResult(result, E_MRT_RESPONSE);
}

void SetTestMethodResult(dword result, enum SomeIpResponseMessageType responseMessageType)
{
  //write("### >SetTestMethodResult, expected: %d, got: %d", gMultiCallExpectedNumberOfResponses, gMultiCallReceivedNumberOfResponses);
  if(gMultiCallExpectedNumberOfResponses>0 && gMultiCallExpectedNumberOfResponses>gMultiCallReceivedNumberOfResponses)
  {
    ++gMultiCallReceivedNumberOfResponses;
    if(gIsWaitingForETSCallResult==kFalse)
      write("Received response %d of %d at %.5f, but not yet waiting for it", gMultiCallReceivedNumberOfResponses, gMultiCallExpectedNumberOfResponses, timeNowFloat()/100000.0);
    else
      write("Received response %d of %d at %.5f", gMultiCallReceivedNumberOfResponses, gMultiCallExpectedNumberOfResponses, timeNowFloat()/100000.0);
    gMultiCallResults[result] = result;
    gMultiCallResultTypes[responseMessageType] = 1;
    if(gMultiCallResultTypes.size()>1)
      gResultOfMethodCall = sysvar::TC8_ETS::ETS_MethodResult::ResponsesWithDifferentRC;
    else if(gMultiCallResults.size()>1)
      gResultOfMethodCall = sysvar::TC8_ETS::ETS_MethodResult::ResponseHasWrongMessageType;
    else
      gResultOfMethodCall = result;
    gMessageTypeOfResultOfMethodCall = responseMessageType;
    if(gIsWaitingForETSCallResult && gMultiCallExpectedNumberOfResponses==gMultiCallReceivedNumberOfResponses)
    {
      setTimer(gTestResultTimer, 0);
    }
  }
  else
  {
    testStepFail("Received unexpected method response");
    write("Received unexpected method response at %.5f", timeNowFloat()/100000.0);
    gMultiCallExpectedNumberOfResponses = gMultiCallReceivedNumberOfResponses = 0;
  }
  //write("### <SetTestMethodResult, expected: %d, got: %d", gMultiCallExpectedNumberOfResponses, gMultiCallReceivedNumberOfResponses);
}

enum Bool ETS_waitForConnectionToDutEstablished()
{
  if(gWaitForConnectionToDutEstablishedDone==kFalse)
  {
    PrepareWaitForEthernet(syspar::DIface0MacAddr, syspar::MacAddressTester);
    PrepareWaitForIp(syspar::DIface0Ip, syspar::IpAddressTester, 0x06); /* TCP Protocol Type */
    
    InternalAddExpectedParameter("tcp", "destination", syspar::SomeIp_ETS_Port);
    InternalAddExpectedParameter("tcp", "flags", TcpFlagAck, kEquals);

    gObservingEthPackets = kTrue;
    StartObservationOfIncomingPackets(kAnswerExpected);
    
    if (WaitForIncomingPacket(kAnswerExpected, 150) != 0)
    {
      testStepFail("TCP connection for method call not established.");
      gObservingEthPackets = kFalse;
      return kFalse;
    }
    gObservingEthPackets = kFalse;
    
    InternalClearAllParameters();
    
    testWaitForTimeout(syspar::SomeIp_ETS_CSI_TCP_ReadyDelayMs); // Give SomeIp IL some time to process the packet
  }
  gWaitForConnectionToDutEstablishedDone=kTrue;
  return kTrue;
}

enum Bool CreateETSMethodCallAndProvideArguments(dword methodId, dword testVariant, dword & methodCallHandle, enum Bool & expectResponse)
{
  stack enum Bool result = kFalse;
  char errorCallbackName[32] = "OnMethodResponseTypeError";
  
  expectResponse = kTrue;
  
  switch(methodId)
  {
    case sysvar::TC8_ETS::ETS_Method::checkByteOrder:
      if(CreateMethodHandle(gClientServiceAepHandleUDP, methodId, testVariant, methodCallHandle, errorCallbackName))
        result = CheckResultOfProvideArgumentsCall("checkByteOrder", ProvideArgumentsForMethod_checkByteOrder(methodCallHandle));
      break;
    case sysvar::TC8_ETS::ETS_Method::echoBitfields:
      if(CreateMethodHandle(gClientServiceAepHandleUDP, methodId, testVariant, methodCallHandle, errorCallbackName))
        result = CheckResultOfProvideArgumentsCall("echoBitfields", ProvideArgumentsForMethod_echoBitfields(methodCallHandle));
      break;
    case sysvar::TC8_ETS::ETS_Method::echoCommonDatatypes:
      if(CreateMethodHandle(gClientServiceAepHandleUDP, methodId, testVariant, methodCallHandle, errorCallbackName))
        result = CheckResultOfProvideArgumentsCall("echoCommonDatatypes", ProvideArgumentsForMethod_echoCommonDatatypes(methodCallHandle));
      break;
    case sysvar::TC8_ETS::ETS_Method::echoENUM:
      if(CreateMethodHandle(gClientServiceAepHandleUDP, methodId, testVariant, methodCallHandle, errorCallbackName))
        result = CheckResultOfProvideArgumentsCall("echoENUM", ProvideArgumentsForMethod_echoENUM(methodCallHandle));
      break;
    case sysvar::TC8_ETS::ETS_Method::echoFLOAT64:
      if(CreateMethodHandle(gClientServiceAepHandleUDP, methodId, testVariant, methodCallHandle, errorCallbackName))
        result = CheckResultOfProvideArgumentsCall("echoFLOAT64", ProvideArgumentsForMethod_echoFLOAT64(methodCallHandle));
      break;
    case sysvar::TC8_ETS::ETS_Method::echoINT8:
      if(CreateMethodHandle(gClientServiceAepHandleUDP, methodId, testVariant, methodCallHandle, errorCallbackName))
        result = CheckResultOfProvideArgumentsCall("echoINT8", ProvideArgumentsForMethod_echoINT8(methodCallHandle));
      break;
    case sysvar::TC8_ETS::ETS_Method::echoStaticUINT8Array:
      if(CreateMethodHandle(gClientServiceAepHandleUDP, methodId, testVariant, methodCallHandle, errorCallbackName))
        result = CheckResultOfProvideArgumentsCall("echoStaticUINT8Array", ProvideArgumentsForMethod_echoStaticUINT8Array(methodCallHandle));
      break;
    case sysvar::TC8_ETS::ETS_Method::echoUINT8:
      if(CreateMethodHandle(gClientServiceAepHandleUDP, methodId, testVariant, methodCallHandle, errorCallbackName))
          result = CheckResultOfProvideArgumentsCall("echoUINT8", ProvideArgumentsForMethod_echoUINT8(methodCallHandle));
      break;
    case sysvar::TC8_ETS::ETS_Method::echoUINT8RELIABLE:
      if(CreateMethodHandle(gClientServiceAepHandleTCP, methodId, testVariant, methodCallHandle, errorCallbackName)==kTrue &&
         ETS_waitForConnectionToDutEstablished()==kTrue)
      {
        if(testVariant == sysvar::TC8_ETS::ETS_TestVariant::Standard)
          result = CheckResultOfProvideArgumentsCall("echoUINT8Reliable", ProvideArgumentsForMethod_echoUINT8Reliable(methodCallHandle));
        else if(testVariant == sysvar::TC8_ETS::ETS_TestVariant::ExtendedPayload)
          result = CheckResultOfProvideArgumentsCall("echoUINT8Reliable_ExtendedPayload", ProvideArgumentsForMethod_echoUINT8Reliable_ExtendedPayload(methodCallHandle));
      }
      break;
    case sysvar::TC8_ETS::ETS_Method::echoUINT8Array:
      if(CreateMethodHandle(gClientServiceAepHandleUDP, methodId, testVariant, methodCallHandle, errorCallbackName))
      {
        if(testVariant == sysvar::TC8_ETS::ETS_TestVariant::Standard)
          result = CheckResultOfProvideArgumentsCall("echoUINT8Array", ProvideArgumentsForMethod_echoUINT8Array(methodCallHandle));
        else if(testVariant == sysvar::TC8_ETS::ETS_TestVariant::EmptyArray)
          result = CheckResultOfProvideArgumentsCall("echoUINT8Array_EmptyArray", ProvideArgumentsForMethod_echoUINT8Array_EmptyArray(methodCallHandle));
        else if(testVariant == sysvar::TC8_ETS::ETS_TestVariant::Array_Length_too_long)
          result = CheckResultOfProvideArgumentsCall("echoUINT8Array_Array_Length_too_long", ProvideArgumentsForMethod_echoUINT8Array_Array_Length_too_long(methodCallHandle));
        else if(testVariant == sysvar::TC8_ETS::ETS_TestVariant::Array_Length_too_short)
          result = CheckResultOfProvideArgumentsCall("echoUINT8Array_Array_Length_too_short", ProvideArgumentsForMethod_echoUINT8Array_Array_Length_too_short(methodCallHandle));
        else if(testVariant == sysvar::TC8_ETS::ETS_TestVariant::ExtendedPayload)
          result = CheckResultOfProvideArgumentsCall("echoUINT8Array_ExtendedPayload", ProvideArgumentsForMethod_echoUINT8Array_ExtendedPayload(methodCallHandle));
      }
      break;
    case sysvar::TC8_ETS::ETS_Method::echoUINT8Array16BitLength:
      if(CreateMethodHandle(gClientServiceAepHandleUDP, methodId, testVariant, methodCallHandle, errorCallbackName))
        result = CheckResultOfProvideArgumentsCall("echoUINT8Array16BitLength", ProvideArgumentsForMethod_echoUINT8Array16BitLength(methodCallHandle));
      break;
    case sysvar::TC8_ETS::ETS_Method::echoUINT8Array8BitLength:
      if(CreateMethodHandle(gClientServiceAepHandleUDP, methodId, testVariant, methodCallHandle, errorCallbackName))
        result = CheckResultOfProvideArgumentsCall("echoUINT8Array8BitLength", ProvideArgumentsForMethod_echoUINT8Array8BitLength(methodCallHandle));
      break;
    case sysvar::TC8_ETS::ETS_Method::echoUINT8Array2Dim:
      if(CreateMethodHandle(gClientServiceAepHandleUDP, methodId, testVariant, methodCallHandle, errorCallbackName))
        result = CheckResultOfProvideArgumentsCall("echoUINT8Array2Dim", ProvideArgumentsForMethod_echoUINT8Array2Dim(methodCallHandle));
      break;
    case sysvar::TC8_ETS::ETS_Method::echoUINT8ArrayMinSize:
      if(CreateMethodHandle(gClientServiceAepHandleUDP, methodId, testVariant, methodCallHandle, errorCallbackName))
      {
        if(testVariant == sysvar::TC8_ETS::ETS_TestVariant::Standard)
          result = CheckResultOfProvideArgumentsCall("echoUINT8ArrayMinSize", ProvideArgumentsForMethod_echoUINT8ArrayMinSize(methodCallHandle));
        else if(testVariant == sysvar::TC8_ETS::ETS_TestVariant::ArrayMinSize_too_short)
          result = CheckResultOfProvideArgumentsCall("echoUINT8ArrayMinSize_ArrayMinSize_too_short", ProvideArgumentsForMethod_echoUINT8ArrayMinSize_ArrayMinSize_too_short(methodCallHandle));
      }
      break;
    case sysvar::TC8_ETS::ETS_Method::echoUNION:
      if(CreateMethodHandle(gClientServiceAepHandleUDP, methodId, testVariant, methodCallHandle, errorCallbackName))
      {
        if(testVariant == sysvar::TC8_ETS::ETS_TestVariant::Standard)
          result = CheckResultOfProvideArgumentsCall("echoUNION", ProvideArgumentsForMethod_echoUNION(methodCallHandle));
        else if(testVariant == sysvar::TC8_ETS::ETS_TestVariant::UnionLength_too_long_for_message)
          result = CheckResultOfProvideArgumentsCall("echoUNION_UnionLength_too_long_for_message", ProvideArgumentsForMethod_echoUNION_UnionLength_too_long_for_message(methodCallHandle));
        else if(testVariant == sysvar::TC8_ETS::ETS_TestVariant::UnionLength_too_long)
          result = CheckResultOfProvideArgumentsCall("echoUNION_UnionLength_too_long", ProvideArgumentsForMethod_echoUNION_UnionLength_too_long(methodCallHandle));
        else if(testVariant == sysvar::TC8_ETS::ETS_TestVariant::UnionLength_too_short)
          result = CheckResultOfProvideArgumentsCall("echoUNION_UnionLength_too_short", ProvideArgumentsForMethod_echoUNION_UnionLength_too_short(methodCallHandle));
      }
      break;
    case sysvar::TC8_ETS::ETS_Method::echoUTF16DYNAMIC:
      if(CreateMethodHandle(gClientServiceAepHandleUDP, methodId, testVariant, methodCallHandle, errorCallbackName))
      {
        if(testVariant == sysvar::TC8_ETS::ETS_TestVariant::Standard)
          result = CheckResultOfProvideArgumentsCall("echoUTF16DYNAMIC", ProvideArgumentsForMethod_echoUTF16DYNAMIC(methodCallHandle));
        else if(testVariant == sysvar::TC8_ETS::ETS_TestVariant::Length_too_long_for_String)
          result = CheckResultOfProvideArgumentsCall("echoUTF16DYNAMIC_Length_too_long_for_String", ProvideArgumentsForMethod_echoUTF16DYNAMIC_Length_too_long_for_String(methodCallHandle));
        else if(testVariant == sysvar::TC8_ETS::ETS_TestVariant::Length_too_short_for_malformed_String)
          result = CheckResultOfProvideArgumentsCall("echoUTF16DYNAMIC_Length_too_short_for_malformed_String", ProvideArgumentsForMethod_echoUTF16DYNAMIC_Length_too_short_for_malformed_String(methodCallHandle));
        else if(testVariant == sysvar::TC8_ETS::ETS_TestVariant::Length_too_short_for_String)
          result = CheckResultOfProvideArgumentsCall("echoUTF16DYNAMIC_Length_too_short_for_String", ProvideArgumentsForMethod_echoUTF16DYNAMIC_Length_too_short_for_String(methodCallHandle));
        else if(testVariant == sysvar::TC8_ETS::ETS_TestVariant::Odd_number_before_termination)
          result = CheckResultOfProvideArgumentsCall("echoUTF16DYNAMIC_Odd_number_before_termination", ProvideArgumentsForMethod_echoUTF16DYNAMIC_Odd_number_before_termination(methodCallHandle));
        else if(testVariant == sysvar::TC8_ETS::ETS_TestVariant::Odd_number_after_termination)
          result = CheckResultOfProvideArgumentsCall("echoUTF16DYNAMIC_Odd_number_after_termination", ProvideArgumentsForMethod_echoUTF16DYNAMIC_Odd_number_after_termination(methodCallHandle));
        else if(testVariant == sysvar::TC8_ETS::ETS_TestVariant::Wrong_BOM)
          result = CheckResultOfProvideArgumentsCall("echoUTF16DYNAMIC_Wrong_BOM", ProvideArgumentsForMethod_echoUTF16DYNAMIC_Wrong_BOM(methodCallHandle));
      }
      break;
    case sysvar::TC8_ETS::ETS_Method::echoUTF16FIXED:
      if(CreateMethodHandle(gClientServiceAepHandleUDP, methodId, testVariant, methodCallHandle, errorCallbackName))
      {
        if(testVariant == sysvar::TC8_ETS::ETS_TestVariant::Standard)
          result = CheckResultOfProvideArgumentsCall("echoUTF16FIXED", ProvideArgumentsForMethod_echoUTF16FIXED(methodCallHandle));
        else if(testVariant == sysvar::TC8_ETS::ETS_TestVariant::String_too_long)
          result = CheckResultOfProvideArgumentsCall("echoUTF16FIXED_String_too_long", ProvideArgumentsForMethod_echoUTF16FIXED_String_too_long(methodCallHandle));
        else if(testVariant == sysvar::TC8_ETS::ETS_TestVariant::String_too_short)
          result = CheckResultOfProvideArgumentsCall("echoUTF16FIXED_String_too_short", ProvideArgumentsForMethod_echoUTF16FIXED_String_too_short(methodCallHandle));
        else if(testVariant == sysvar::TC8_ETS::ETS_TestVariant::Odd_number_after_termination)
          result = CheckResultOfProvideArgumentsCall("echoUTF16FIXED_Odd_number_after_termination", ProvideArgumentsForMethod_echoUTF16FIXED_Odd_number_after_termination(methodCallHandle));

      }
      break;
    case sysvar::TC8_ETS::ETS_Method::echoUTF8DYNAMIC:
      if(CreateMethodHandle(gClientServiceAepHandleUDP, methodId, testVariant, methodCallHandle, errorCallbackName))
      {
        if(testVariant == sysvar::TC8_ETS::ETS_TestVariant::Standard)
          result = CheckResultOfProvideArgumentsCall("echoUTF8DYNAMIC", ProvideArgumentsForMethod_echoUTF8DYNAMIC(methodCallHandle));
        else if(testVariant == sysvar::TC8_ETS::ETS_TestVariant::Length_too_long_for_String)
          result = CheckResultOfProvideArgumentsCall("echoUTF8DYNAMIC_Length_too_long_for_String", ProvideArgumentsForMethod_echoUTF8DYNAMIC_Length_too_long_for_String(methodCallHandle));
        else if(testVariant == sysvar::TC8_ETS::ETS_TestVariant::Length_too_short_for_malformed_String)
          result = CheckResultOfProvideArgumentsCall("echoUTF8DYNAMIC_Length_too_short_for_malformed_String", ProvideArgumentsForMethod_echoUTF8DYNAMIC_Length_too_short_for_malformed_String(methodCallHandle));
        else if(testVariant == sysvar::TC8_ETS::ETS_TestVariant::Length_too_short_for_String)
          result = CheckResultOfProvideArgumentsCall("echoUTF8DYNAMIC_Length_too_short_for_String", ProvideArgumentsForMethod_echoUTF8DYNAMIC_Length_too_short_for_String(methodCallHandle));
        else if(testVariant == sysvar::TC8_ETS::ETS_TestVariant::Wrong_BOM)
          result = CheckResultOfProvideArgumentsCall("echoUTF8DYNAMIC_Wrong_BOM", ProvideArgumentsForMethod_echoUTF8DYNAMIC_Wrong_BOM(methodCallHandle));
      }
      break;
    case sysvar::TC8_ETS::ETS_Method::echoUTF8FIXED:
      if(CreateMethodHandle(gClientServiceAepHandleUDP, methodId, testVariant, methodCallHandle, errorCallbackName))
      {
        if(testVariant == sysvar::TC8_ETS::ETS_TestVariant::Standard)
          result = CheckResultOfProvideArgumentsCall("echoUTF8FIXED", ProvideArgumentsForMethod_echoUTF8FIXED(methodCallHandle));
        else if(testVariant == sysvar::TC8_ETS::ETS_TestVariant::String_too_long)
          result = CheckResultOfProvideArgumentsCall("echoUTF8FIXED_String_too_long", ProvideArgumentsForMethod_echoUTF8FIXED_String_too_long(methodCallHandle));
        else if(testVariant == sysvar::TC8_ETS::ETS_TestVariant::String_too_short)
          result = CheckResultOfProvideArgumentsCall("echoUTF8FIXED_String_too_short", ProvideArgumentsForMethod_echoUTF8FIXED_String_too_short(methodCallHandle));
      }
      break;        
    case sysvar::TC8_ETS::ETS_Method::clientServiceActivate:
      expectResponse = kFalse;
      result = CreateMethodHandleFireAndForget(gClientServiceAepHandleUDP, methodId, methodCallHandle);
      break;
    case sysvar::TC8_ETS::ETS_Method::resetInterface:
      expectResponse = kFalse;
      result = CreateMethodHandleFireAndForget(gClientServiceAepHandleUDP, methodId, methodCallHandle);
      break;
    case sysvar::TC8_ETS::ETS_Method::suspendInterface:
      expectResponse = kFalse;
      if(CreateMethodHandleFireAndForget(gClientServiceAepHandleUDP, methodId, methodCallHandle))
        result = CheckResultOfProvideArgumentsCall("suspendInterface", ProvideArgumentsForMethod_suspendInterface(methodCallHandle));
      break;
    case sysvar::TC8_ETS::ETS_Method::clientServiceGetLastValueOfEventTCP:
      result = CreateMethodHandle(gClientServiceAepHandleUDP, methodId, testVariant, methodCallHandle, errorCallbackName);
      break;
    case sysvar::TC8_ETS::ETS_Method::clientServiceGetLastValueOfEventUDPMulticast:
      result = CreateMethodHandle(gClientServiceAepHandleUDP, methodId, testVariant, methodCallHandle, errorCallbackName);
      break;
    case sysvar::TC8_ETS::ETS_Method::clientServiceGetLastValueOfEventUDPUnicast:
      result = CreateMethodHandle(gClientServiceAepHandleUDP, methodId, testVariant, methodCallHandle, errorCallbackName);
      break;
    case sysvar::TC8_ETS::ETS_Method::get_InterfaceVersion:
      result = CreateMethodHandle(gClientServiceAepHandleUDP, methodId, testVariant, methodCallHandle, errorCallbackName);
      break;
    case sysvar::TC8_ETS::ETS_Method::get_TestFieldUINT8:
      result = CreateMethodHandle(gClientServiceAepHandleUDP, methodId, testVariant, methodCallHandle, errorCallbackName);
      break;
    case sysvar::TC8_ETS::ETS_Method::set_TestFieldUINT8:
      if(CreateMethodHandle(gClientServiceAepHandleUDP, methodId, testVariant, methodCallHandle, errorCallbackName))
        result = CheckResultOfProvideArgumentsCall("set_TestFieldUINT8", ProvideArgumentsForMethod_set_TestFieldUINT8(methodCallHandle));
      break;
    case sysvar::TC8_ETS::ETS_Method::get_TestFieldUINT8Array:
      result = CreateMethodHandle(gClientServiceAepHandleUDP, methodId, testVariant, methodCallHandle, errorCallbackName);
      break;
    case sysvar::TC8_ETS::ETS_Method::set_TestFieldUINT8Array:
      if(CreateMethodHandle(gClientServiceAepHandleUDP, methodId, testVariant, methodCallHandle, errorCallbackName))
        result = CheckResultOfProvideArgumentsCall("set_TestFieldUINT8Array", ProvideArgumentsForMethod_set_TestFieldUINT8Array(methodCallHandle));
      break;
    case sysvar::TC8_ETS::ETS_Method::get_TestFieldUINT8Reliable:
      if(CreateMethodHandle(gClientServiceAepHandleTCP, methodId, testVariant, methodCallHandle, errorCallbackName)==kTrue &&
         ETS_waitForConnectionToDutEstablished()==kTrue)
        result = kTrue;
      break;
    case sysvar::TC8_ETS::ETS_Method::set_TestFieldUINT8Reliable:
      if(CreateMethodHandle(gClientServiceAepHandleTCP, methodId, testVariant, methodCallHandle, errorCallbackName)==kTrue &&
         ETS_waitForConnectionToDutEstablished()==kTrue)
        result = CheckResultOfProvideArgumentsCall("set_TestFieldUINT8Reliable", ProvideArgumentsForMethod_set_TestFieldUINT8Reliable(methodCallHandle));
      break;
    default:
      write("Error: Method is not supported");
      break;
  }
  
  return result;
}

enum Bool SendMessageWithPatchedHeader(DWORD methodCallHandle, dword headerPatchVariant)
{
  IP_Endpoint destAddr;
  byte messageBuffer[1600];
  dword messageLength;
  dword msgHandle;
  long res;
  //write("### SendMessageWithPatchedHeader");
  messageLength = SomeIpSerializeMessage(methodCallHandle, elCount(messageBuffer), messageBuffer);
  if(PatchSomeIpHeader(headerPatchVariant, elCount(messageBuffer), messageBuffer, messageLength)==kFalse)
  {
    write("#### Patching header failed ####");
    return kFalse;
  }
  InitEndpoint(destAddr, syspar::DIface0Ip, @sysvar::TC8_ETS_Config::ETS_Port);
  
  msgHandle = SomeIpCreateMessage(messageLength, messageBuffer);
  SomeIpOutputMessage(gClientServiceAepHandleUDP, destAddr, msgHandle);
  
  return kTrue;
}

enum Bool TriggerETSMethodCall(dword methodId, dword testVariant, dword headerPatchVariant)
{
  char methodName[64];
  DWORD methodCallHandle;
  enum Bool result, expectResponse;
  result = CreateETSMethodCallAndProvideArguments(methodId, testVariant, methodCallHandle, expectResponse);
  if(result==kTrue)
  {
    if(headerPatchVariant!=sysvar::TC8_ETS::ETS_HeaderPatchVariant::Not_patched)
    {
      result = SendMessageWithPatchedHeader(methodCallHandle, headerPatchVariant);
    }
    else
    {
//      testWaitForTimeoutSilent(100);    
      if(SomeIpCallMethod(methodCallHandle)!=0)
      {
        result = kFalse;
        ReportSomeIpError("Call failed");
      }
      else if(expectResponse)
      {
        ++gMultiCallExpectedNumberOfResponses;
      }
    }
  }
 
  sysGetVariableDescriptionForValue(sysvar::TC8_ETS::ETS_Method, methodId, methodName, elCount(methodName));
  if(result==kTrue)
    write("Triggered method call %s at %.5f", methodName, timeNowFloat()/100000.0);
  else
    write("Could not triggered method call %s at %.5f", methodName, timeNowFloat()/100000.0);
  return result;
}

enum Bool PatchSomeIpHeader(dword headerPatchVariant, dword messageBufferLength, byte messageBuffer[], dword & messageLength)
{
  dword headerLength;
  enum Bool result;
  result = kTrue;
  
  switch(headerPatchVariant)
  {
    case sysvar::TC8_ETS::ETS_HeaderPatchVariant::Length_equals_0:
      messageBuffer[4] = messageBuffer[5] = messageBuffer[6] = messageBuffer[7] = 0;
      break;
    case sysvar::TC8_ETS::ETS_HeaderPatchVariant::Length_smaller_than_8:
      messageBuffer[4] = messageBuffer[5] = messageBuffer[6] = 0;
      messageBuffer[7] = 7;
      break;
    case sysvar::TC8_ETS::ETS_HeaderPatchVariant::Length_way_too_long:
      messageBuffer[4] = messageBuffer[5] =  0;
      messageBuffer[6] = messageBuffer[7] = 0xff;
      break;
    case sysvar::TC8_ETS::ETS_HeaderPatchVariant::Invalid_interface_version:
      messageBuffer[13] = atol(syspar::UnknownIntfVerMajSi1);
      break;
    case sysvar::TC8_ETS::ETS_HeaderPatchVariant::Length_decremented:
      headerLength = (((messageBuffer[4] << 8) | messageBuffer[5]) << 8 | messageBuffer[6]) << 8 | messageBuffer[7] - 1;
      messageBuffer[7] = headerLength & 0xff;
      headerLength = headerLength >> 8;
      messageBuffer[6] = headerLength & 0xff;
      headerLength = headerLength >> 8;
      messageBuffer[5] = headerLength & 0xff;
      headerLength = headerLength >> 8;
      messageBuffer[4] = headerLength & 0xff;
      break;
    case sysvar::TC8_ETS::ETS_HeaderPatchVariant::Type_REQUEST_NO_RETURN:
      messageBuffer[14] = 0x01;
      break;
    case sysvar::TC8_ETS::ETS_HeaderPatchVariant::MethodId_Wrong:
      messageBuffer[2] = (atol(syspar::UnknownMethodId) >> 8) & 0xff;
      messageBuffer[3] = atol(syspar::UnknownMethodId) & 0xff;
      break;
    case sysvar::TC8_ETS::ETS_HeaderPatchVariant::ServiceID_Wrong:
      messageBuffer[0] = (atol(syspar::UnknownServiceId) >> 8) & 0xff;
      messageBuffer[1] = atol(syspar::UnknownServiceId) & 0xff;
      break;
    case sysvar::TC8_ETS::ETS_HeaderPatchVariant::ProtocolVersion_Wrong:
      messageBuffer[12] = 2;
      break;
    default:
      result = kFalse;
      write("HeaderPatchVariant not handled");
      break;
  }
  
  return result;
}

void ReportSomeIpError(char msg[])
{
  char buffer[1024];
  if((SomeIpGetLastErrorText(elcount(buffer),buffer)) != 0)
  {
     write("%.5f %s: %s. SOME/IP IL error: %s", timeNowFloat()/100000.0, gETSProcessName , msg, buffer);
  }
  else
  {
    write(msg);
  }
}

// Returns the instance id of the DUT ETS server
dword GetInstanceIdOfConsumedETS()
{
  return syspar::SomeIp_ETS_DUT_InstanceId;
}

enum Bool CreateMethodHandle(dword aepHandle, dword methodId, dword testVariant, dword & methodCallHandle, char onMethodResponseTypeErrorFunctionName[])
{
  dword csiHandle=0;
  char callbackName[128];
  char methodName[64];
  char variantName[64];
  long rc;
 
  csiHandle = ETS_SomeIpCreateConsumedServiceInstance(aepHandle, @sysvar::TC8_ETS_Config::ETS_ServiceId, @sysvar::TC8_ETS_Config::ETS_DUT_ServiceInstanceId); 
  if(csiHandle==0)
    return kFalse;

  sysGetVariableDescriptionForValue(sysvar::TC8_ETS::ETS_Method, methodId, methodName, elCount(methodName));
  if(testVariant==sysvar::TC8_ETS::ETS_TestVariant::Standard)
  {
    snprintf(callbackName, elCount(callbackName), "OnMethodResponse_%s", methodName);
  }
  else
  {
    rc = sysGetVariableDescriptionForValue(sysvar::TC8_ETS::ETS_TestVariant, testVariant, variantName, elCount(variantName));
    if(rc!=0)
    {
      write("Error: converting testVariant '%d' to string failed, rc: %ld", testVariant, rc);
      return kFalse;
    }
    snprintf(callbackName, elCount(callbackName), "OnMethodResponse_%s_%s", methodName, variantName);
  }
  //writeEx(-3,1, "### Callback name: %s , error callback name: %s", callbackName, onMethodResponseTypeErrorFunctionName);
  
  // CANoe 14 introduced a new variant of SomeIpCreateMethodCall
  // To prevent compile errors in earlier versions, we need to check for the version
  // The test might fail with earlier version (depending on the expectations of the testcase),
  // therefore the affected test needs this check too on a higher level to abort the test
  #if (TOOL_MAJOR_VERSION < 14) 
    methodCallHandle = SomeIpCreateMethodCall(csiHandle, methodId, callbackName);
  #else
    methodCallHandle = SomeIpCreateMethodCall(csiHandle, methodId, callbackName, onMethodResponseTypeErrorFunctionName);
  #endif
  
  if(SomeIpGetLastError()!=0)
  {
    ReportSomeIpError("Creation of method call handle failed");
    return kFalse;
  }

  return kTrue;
}

enum Bool CreateMethodHandleFireAndForget(dword aepHandle, dword methodId, dword & methodCallHandle)
{
  dword csiHandle;
  long rc;

  csiHandle = ETS_SomeIpCreateConsumedServiceInstance(aepHandle, @sysvar::TC8_ETS_Config::ETS_ServiceId, @sysvar::TC8_ETS_Config::ETS_DUT_ServiceInstanceId); 
  if(csiHandle==0)
    return kFalse;

  methodCallHandle = SomeIpCreateMethodCall(csiHandle, methodId); 
  if(SomeIpGetLastError()!=0)
  {
    ReportSomeIpError("Creation of method call handle failed");
    return kFalse;
  }

  return kTrue;
}

enum Bool CheckResultOfProvideArgumentsCall(char methodName[], enum Bool success)
{
  char buffer[128];
  if(success==kFalse)
  {
    snprintf(buffer, elcount(buffer), "Error: Provide arguments for method %s failed", methodName);
    ReportSomeIpError(buffer);
  }
  return success;
}

export testfunction ETS_WaitFor_ETSServiceStatusUp(dword timeoutMs)
{
  //writeEx(-3,1,"waiting for ETS service status up, timeout %d ms", timeoutMs);
  WaitForETSServiceStatus(1, timeoutMs);
  //writeEx(-3,1,"waiting for ETS service status up done");
}

export testfunction ETS_WaitFor_ETSServiceStatusDown(dword timeoutMs)
{
  WaitForETSServiceStatus(0, timeoutMs);
  testWaitForTimeout(50);  // give SOME/IP-IL some time before we continue to prevent race conditions
  releaseAllCreatedCSIs();
  testWaitForTimeout(syspar::SomeIp_ETS_WaitDurationForTcpConnectionClosed_ms);
}

void WaitForETSServiceStatus(LONG status, dword timeoutMs)
{
  char messagesOk[2][32]  = { "Service status down reached", "Service status up reached" };
  char messagesNOk[2][32] = { "Service status down not reached", "Service status up not reached" };
  long result;
  if(gETSStatus!=-1 && gETSStatus==status)
    return;  // status already reached
  
  gIsWaitingForETSService = 1;
  gETSExpectedStatus = status;
  result = testWaitForTextEvent("ETSAllWaitNotificationsReached", timeoutMs);
  gIsWaitingForETSService = 0;
 
  if(result!=1)
    testStepFail(messagesNOk[status]);
  else
    testStepPass(messagesOk[status]);
}

void OnSomeIpSDClientServiceStatusChanged(dword serviceId, dword instanceId, LONG status )
{
  if(serviceId==syspar::SomeIp_ETS_ServiceId)
    gETSStatus = status;
  if(gIsWaitingForETSService && serviceId==syspar::SomeIp_ETS_ServiceId && instanceId==@sysvar::TC8_ETS_Config::ETS_DUT_ServiceInstanceId &&
     status==gETSExpectedStatus && isTimerActive(gWaitConditionReachedTimer)==0)
  {
    setTimer(gWaitConditionReachedTimer, 0);
  }
}

export testfunction ETS_IncrementAndStoreValueFor_TestFieldUINT8()
{
  gStoredValueTestFieldUINT8 = gRequestedValue_SetterTestFieldUINT8 = (gResponseValue_GetterTestFieldUINT8 + 1) % 256;
  // gRequestedValue_SetterTestFieldUINT8 is used in ProvideArgumentsForMethod_SetterTestFieldUINT8 function
}

export testfunction ETS_IncrementAndStoreValueFor_TestFieldUINT8Reliable()
{
  gStoredValueTestFieldUINT8Reliable = gRequestedValue_SetterTestFieldUINT8Reliable = (gResponseValue_GetterTestFieldUINT8Reliable + 1) % 256;
  // gRequestedValue_SetterTestFieldUINT8Reliable is used in ProvideArgumentsForMethod_SetterTestFieldUINT8 function
}

export testfunction ETS_IncrementAndStoreValuesFor_TestFieldUINT8Array()
{
  int i;
  gStoredValuesTestFieldUINT8Array.length = gRequestedValues_SetterTestFieldUINT8Array.length = gResponseValues_GetterTestFieldUINT8Array.length;
  for(i=0; i<gResponseValues_GetterTestFieldUINT8Array.length; ++i)
  {
    gStoredValuesTestFieldUINT8Array.values[i] = gRequestedValues_SetterTestFieldUINT8Array.values[i] = (gResponseValues_GetterTestFieldUINT8Array.values[i] + 1) % 256;
    // gRequestedValues_SetterTestFieldUINT8Array is used in ProvideArgumentsForMethod_SetterTestFieldUINT8Array function
  }
}

export testfunction ETS_CheckValueChanged_TestFieldUINT8()
{
  if(gStoredValueTestFieldUINT8 == gResponseValue_GetterTestFieldUINT8)
    testStepFail("ETS_CheckValueChanged_TestFieldUINT8", "Field value did not change, stored value: %d , new value: %d", gStoredValueTestFieldUINT8, gResponseValue_GetterTestFieldUINT8);
  else
    testStepPass("ETS_CheckValueChanged_TestFieldUINT8", "Field value did change, stored value: %d , new value: %d", gStoredValueTestFieldUINT8, gResponseValue_GetterTestFieldUINT8);
}

export testfunction ETS_CheckValueChanged_TestFieldUINT8Reliable()
{
  if(gStoredValueTestFieldUINT8Reliable == gResponseValue_GetterTestFieldUINT8Reliable)
    testStepFail("ETS_CheckValueChanged_TestFieldUINT8Reliable", "Field value did not change, stored value: %d , new value: %d", gStoredValueTestFieldUINT8Reliable, gResponseValue_GetterTestFieldUINT8Reliable);
  else
    testStepPass("ETS_CheckValueChanged_TestFieldUINT8Reliable", "Field value did change, stored value: %d , new value: %d", gStoredValueTestFieldUINT8Reliable, gResponseValue_GetterTestFieldUINT8Reliable);
}

export testfunction ETS_CheckResponseValueOfSetter_TestFieldUINT8()
{
  if(gRequestedValue_SetterTestFieldUINT8 != gResponseValue_SetterTestFieldUINT8)
    testStepFail("ETS_CheckResponseValueOfSetter_TestFieldUINT8", "Setter returned unexpected value: %d, expected: %d", gResponseValue_SetterTestFieldUINT8, gRequestedValue_SetterTestFieldUINT8);
  else
    testStepPass("ETS_CheckResponseValueOfSetter_TestFieldUINT8", "Setter returned expected value: %d", gResponseValue_SetterTestFieldUINT8);
}

export testfunction ETS_CheckResponseValueOfSetter_TestFieldUINT8Reliable()
{
  if(gRequestedValue_SetterTestFieldUINT8Reliable != gResponseValue_SetterTestFieldUINT8Reliable)
    testStepFail("ETS_CheckResponseValueOfSetter_TestFieldUINT8Reliable", "Setter returned unexpected value: %d, expected: %d", gResponseValue_SetterTestFieldUINT8Reliable, gRequestedValue_SetterTestFieldUINT8Reliable);
  else
    testStepPass("ETS_CheckResponseValueOfSetter_TestFieldUINT8Reliable", "Setter returned expected value: %d", gResponseValue_SetterTestFieldUINT8Reliable);
}

export testfunction ETS_CheckResponseValueOfSetter_TestFieldUINT8Array()
{
  dword i;
  if(gRequestedValues_SetterTestFieldUINT8Array.length != gResponseValues_SetterTestFieldUINT8Array.length)
    testStepFail("ETS_CheckResponseValueOfSetter_TestFieldUINT8Array", "Setter returned unexpected array length: %d, expected: %d",
                 gResponseValues_SetterTestFieldUINT8Array.length, gRequestedValues_SetterTestFieldUINT8Array.length);
  else
  {
    for(i=0; i<gRequestedValues_SetterTestFieldUINT8Array.length; ++i)
    {
      if(gRequestedValues_SetterTestFieldUINT8Array.values[i]!=gResponseValues_SetterTestFieldUINT8Array.values[i])
      {
        testStepFail("ETS_CheckResponseValueOfSetter_TestFieldUINT8Array", "Setter returned unexpected value at index %d: %d, expected: %d", i,
                 gResponseValues_SetterTestFieldUINT8Array.values[i], gRequestedValues_SetterTestFieldUINT8Array.values[i]);
        return;
      }
    }
    testStepPass("ETS_CheckResponseValueOfSetter_TestFieldUINT8Array", "Setter returned expected values");
  }
}

export testfunction ETS_CheckValueDidNotChange_TestFieldUINT8()
{
  write(" storedValue %d lastValue %d", gStoredValueTestFieldUINT8, gResponseValue_GetterTestFieldUINT8);
  if(gStoredValueTestFieldUINT8 != gResponseValue_GetterTestFieldUINT8)
    testStepFail("ETS_CheckValueDidNotChange_TestFieldUINT8", "Field value did change, stored value: %d , new value: %d", gStoredValueTestFieldUINT8, gResponseValue_GetterTestFieldUINT8);
  else
    testStepPass("ETS_CheckValueDidNotChange_TestFieldUINT8", "Field value did not change, stored value: %d , new value: %d", gStoredValueTestFieldUINT8, gResponseValue_GetterTestFieldUINT8);
}

export testfunction ETS_SetEventUINT8Reliable(word value, dword preDelayMs, dword postDelayMs)
{
  if(preDelayMs>0)
    testWaitForTimeout(preDelayMs);
  gTestEventUINT8Reliable = value; // the function arguments gets set in the corresponding OnService_ETS_PrepareEvent_* function
  SomeIpTriggerEvent(gEventHandle_TestEventUINT8Reliable);
  if(SomeIpGetLastError()!=0)
  {
    ReportSomeIpError("Set event failed");
    testStepFail("ETS_SetEventUINT8Reliable", "Set event failed");
  }
  // Events are send asynchronously and delayed, to prevent race conditions with following calls
  // we try to ensure the send by waiting some time
  if(postDelayMs>0)
    testWaitForTimeout(postDelayMs);
}

export testfunction ETS_SetEventUINT8(word value, dword preDelayMs, dword postDelayMs)
{
  if(preDelayMs>0)
    testWaitForTimeout(preDelayMs);
  gTestEventUINT8 = value; // the function arguments gets set in the corresponding OnService_ETS_PrepareEvent_* function
  SomeIpTriggerEvent(gEventHandle_TestEventUINT8);
  if(SomeIpGetLastError()!=0)
  {
    ReportSomeIpError("Set event failed");
    testStepFail("ETS_SetEventUINT8", "Set event failed");
  }
  // Events are send asynchronously and delayed, to prevent race conditions with following calls
  // we try to ensure the send by waiting some time
  if(postDelayMs>0)
    testWaitForTimeout(postDelayMs);
}

export testfunction ETS_SetEventUINT8Multicast(word value, dword preDelayMs, dword postDelayMs)
{
  if(preDelayMs>0)
    testWaitForTimeout(preDelayMs);
  gTestEventUINT8Multicast = value; // the function arguments gets set in the corresponding OnService_ETS_PrepareEvent_* function
  SomeIpTriggerEvent(gEventHandle_TestEventUINT8Multicast);
  if(SomeIpGetLastError()!=0)
  {
    ReportSomeIpError("Set event failed");
    testStepFail("ETS_SetEventUINT8Multicast", "Set event failed");
  }
  // Events are send asynchronously and delayed, to prevent race conditions with following calls
  // we try to ensure the send by waiting some time
  if(postDelayMs>0)
    testWaitForTimeout(postDelayMs);
}

/// <Helper functions>
enum Bool HandleSomeIpCreateFieldConsumer(dword csiHandle, long notificationId, long getterId, long setterId, char onFieldNotificationCallback[], dword & handle)
{
  handle = SomeIpCreateFieldConsumer(csiHandle, notificationId, getterId, setterId, onFieldNotificationCallback);
  if(handle==0)
  {
    ReportSomeIpError("Creation of field consumer failed");
    write("Creation of field consumer failed. %s", onFieldNotificationCallback);
    return kFalse;
  }
  return kTrue;
}

enum Bool CreateAllFieldConsumer()
{
  if(HandleSomeIpCreateFieldConsumer(gCsiHandleUDP, FIELD_ID_InterfaceVersion, sysvar::TC8_ETS::ETS_Method::get_InterfaceVersion,
        -1, "Tester_OnFieldNotification_InterfaceVersion", gFieldConsumerHandle_InterfaceVersion)!=kTrue ||
     HandleSomeIpCreateFieldConsumer(gCsiHandleUDP, FIELD_ID_TestFieldUINT8, sysvar::TC8_ETS::ETS_Method::get_TestFieldUINT8,
        sysvar::TC8_ETS::ETS_Method::set_TestFieldUINT8, "Tester_OnFieldNotification_TestFieldUINT8",
        gFieldConsumerHandle_TestFieldUINT8)!=kTrue ||
     HandleSomeIpCreateFieldConsumer(gCsiHandleUDP, FIELD_ID_TestFieldUINT8Array, sysvar::TC8_ETS::ETS_Method::get_TestFieldUINT8Array,
        sysvar::TC8_ETS::ETS_Method::set_TestFieldUINT8Array, "Tester_OnFieldNotification_TestFieldUINT8Array",
        gFieldConsumerHandle_TestFieldUINT8Array)!=kTrue ||
     HandleSomeIpCreateFieldConsumer(gCsiHandleTCP, FIELD_ID_TestFieldUINT8Reliable, sysvar::TC8_ETS::ETS_Method::get_TestFieldUINT8Reliable,
        sysvar::TC8_ETS::ETS_Method::set_TestFieldUINT8Reliable, "Tester_OnFieldNotification_TestFieldUINT8Reliable",
        gFieldConsumerHandle_TestFieldUINT8Reliable)!=kTrue)
    return kFalse;
  return kTrue;
}

export testfunction ETS_SubscribeEventgroupOfDUT(int eventGroupId)
{
  IP_Endpoint endpoint;
  if(InitEndpoint(endpoint, syspar::IpAddressTester, 0)!=kTrue ||
     ActivateClientService("Tester_", endpoint)!=kTrue)
  {
    testStepFail("ETS_SubscribeEventgroupOfDUT", "ActivateClientService failed");
    return;
  }

  if(CreateAllFieldConsumer()!=kTrue)
  {
    ReportSomeIpError("ETS_SubscribeEventgroupOfDUT failed");
    ETS_UnsubscribeAllEventgroupsOfDUT();
    testStepFail("ETS_SubscribeEventgroupOfDUT", "SomeIpCreateFieldConsumer failed");
    return;
  }

  AddEventGroupConsumers(eventGroupId, gCegHandle1UDP, gCegHandle1TCP);
  
  if(SubscribeEventGroup(eventGroupId, gCegHandle1UDP, gCegHandle1TCP)!=kTrue)
  {
    testStepFail("ETS_SubscribeEventgroupOfDUT", "SubscribeEventGroup failed");
    return;
  }
 
  gWaitingForFieldNotificationsCount.clear();
  if(eventGroupId==EVENTGROUP_ID_EvgAll || eventGroupId==EVENTGROUP_ID_EvgUnreliableOnly)
  {
    gWaitingForFieldNotificationsCount[FIELD_ID_InterfaceVersion] = 1;
    gWaitingForFieldNotificationsCount[FIELD_ID_TestFieldUINT8] = 1;
    gWaitingForFieldNotificationsCount[FIELD_ID_TestFieldUINT8Array] = 1;
  }
  if(eventGroupId==EVENTGROUP_ID_EvgAll)
    gWaitingForFieldNotificationsCount[FIELD_ID_TestFieldUINT8Reliable] = 1;
}

export testfunction ETS_SubscribeAllEventgroupsOfDUT()
{
  IP_Endpoint endpoint;
  
  if(InitEndpoint(endpoint, syspar::IpAddressTester, 0)!=kTrue ||
     ActivateClientService("Tester_", endpoint)!=kTrue)
  {
    testStepFail("ETS_SubscribeAllEventgroupsOfDUT", "ActivateClientService failed");
    return;
  }

  AddEventGroupConsumers(EVENTGROUP_ID_EvgAll, gCegHandle1UDP, gCegHandle1TCP);
  AddEventGroupConsumers(EVENTGROUP_ID_EvgUnreliableOnly, gCegHandle2UDP, gCegHandle2TCP);
  AddEventGroupConsumers(EVENTGROUP_ID_EvgMulticast, gCegHandle3UDP, gCegHandle3TCP);
  if(CreateAllFieldConsumer()!=kTrue)
  {
    ReportSomeIpError("ETS_SubscribeAllEventgroupsOfDUT failed");
    ETS_UnsubscribeAllEventgroupsOfDUT();
    testStepFail("ETS_SubscribeAllEventgroupsOfDUT", "SomeIpCreateFieldConsumer failed");
    return;
  }
 
  if(SubscribeEventGroup(EVENTGROUP_ID_EvgAll, gCegHandle1UDP, gCegHandle1TCP)!=kTrue ||
     SubscribeEventGroup(EVENTGROUP_ID_EvgUnreliableOnly, gCegHandle2UDP, gCegHandle2TCP)!=kTrue ||
     SubscribeEventGroup(EVENTGROUP_ID_EvgMulticast, gCegHandle3UDP, gCegHandle3TCP)!=kTrue)
  {
    ReportSomeIpError("ETS_SubscribeAllEventgroupsOfDUT failed");
    ETS_UnsubscribeAllEventgroupsOfDUT();
    testStepFail("ETS_SubscribeAllEventgroupsOfDUT", "SubscribeEventGroup failed");
    return;
  }
  gWaitingForFieldNotificationsCount.clear();
  gWaitingForFieldNotificationsCount[FIELD_ID_InterfaceVersion] = 2;
  gWaitingForFieldNotificationsCount[FIELD_ID_TestFieldUINT8] = 2;
  gWaitingForFieldNotificationsCount[FIELD_ID_TestFieldUINT8Array] = 2;
  gWaitingForFieldNotificationsCount[FIELD_ID_TestFieldUINT8Reliable] = 1;
}

void UnsubscribeField(dword & fieldHandle, char name[])
{
  gSubscribedEventgroupId = -1;
  if(fieldHandle!=0)
  {
    if(SomeIpRemoveFieldConsumer(fieldHandle)>0)
    {
      write("UnsubscribeField failed for field: %s", name);
      ReportSomeIpError("UnsubscribeField failed");
    }
    fieldHandle = 0;
  }
}

void UnsubscribeEvent(dword & eventHandle, char name[])
{
  if(eventHandle!=0)
  {
    if(SomeIpRemoveEventConsumer(eventHandle)>0)
    {
      write("UnsubscribeEvent failed for event: %s", name);
      ReportSomeIpError("UnsubscribeEvent failed");
    }
    eventHandle = 0;
  }
}

export testfunction ETS_UnsubscribeAllEventgroupsOfDUT()
{
  UnsubscribeField(gFieldConsumerHandle_TestFieldUINT8Reliable, "TestFieldUINT8Reliable");
  UnsubscribeField(gFieldConsumerHandle_TestFieldUINT8Array, "TestFieldUINT8Array");
  UnsubscribeField(gFieldConsumerHandle_TestFieldUINT8, "TestFieldUINT8");
  UnsubscribeField(gFieldConsumerHandle_InterfaceVersion, "InterfaceVersion");
 
  RemoveEventGroupConsumers(gCegHandle1UDP, gCegHandle1TCP);
  RemoveEventGroupConsumers(gCegHandle2UDP, gCegHandle2TCP);
  RemoveEventGroupConsumers(gCegHandle3UDP, gCegHandle3TCP);

  testWaitForTimeout(1);
  DeactivateClientService();
}

export testfunction ETS_WaitFor_AllFieldNotificationCallbacks(dword timeout)
{
  dword result;

  gWaitingForFieldNotifications = kTrue;
  result = testWaitForTextEvent("ETSAllWaitNotificationsReached", timeout);
  gWaitingForFieldNotifications = kFalse;
  if(result!=1)
  {
    testStepFail("ETS_WaitFor_AllFieldNotificationCallbacks", "Not all field notifications have been received");
  }
  else
  {
    testStepPass("ETS_WaitFor_AllFieldNotificationCallbacks", "All field notifications have been received");
  }
}

export testfunction ETS_WaitFor_AllEventNotificationCallbacks(dword timeout)
{
  dword result;

  gWaitingForEventNotifications = kTrue;
  result = testWaitForTextEvent("ETSAllWaitNotificationsReached", timeout);
  gWaitingForEventNotifications = kFalse;
  if(result!=1)
  {
    testStepFail("ETS_WaitFor_AllEventNotificationCallbacks", "Not all event notifications have been received");
  }
  else
  {
    testStepPass("ETS_WaitFor_AllEventNotificationCallbacks", "All event notifications have been received");
  }
}

export testfunction ETS_WaitFor_AllSubscribeAckCallbacks(dword timeout)
{
  dword result;

  gWaitingForSubscribeAckEventgroups.clear();
  gWaitingForSubscribeAckEventgroups[2] = kTrue;
  gWaitingForSubscribeAckEventgroups[5] = kTrue;
  gWaitingForSubscribeAckEventgroups[6] = kTrue;
  
  gWaitingForSubscribeAcks = kTrue;
  result = testWaitForTextEvent("ETSAllWaitNotificationsReached", timeout);
  gWaitingForSubscribeAcks = kFalse;
  if(result!=1)
  {
    testStepFail("ETS_WaitFor_AllSubscribeAckCallbacks", "Not all field notifications have been received");
  }
  else
  {
    testStepPass("ETS_WaitFor_AllSubscribeAckCallbacks", "All field notifications have been received");
  }
}

enum Bool ETS_InternalWaitForSOMEIPNotification(char callerFunctionName[], 
  long timeout,
  enum SomeIpMessageType messageType,
  enum SomeIpEntryType entryType,
  int entryServiceId,
  char entryTTL[],
  char serviceId[],
  char returnCode[],
  char methodId[],
  char firstToken[],
  char firstTokenValue[],
  enum CheckType firstTokenCheckType,
  char secondToken[],
  char secondTokenValue[],
  enum CheckType secondTokenCheckType,
  int protocol,
  char extractSomeIpToken[],
  enum ExpectedResult expectedResult
  )
{
  return ETS_InternalWaitForSOMEIPNotification(callerFunctionName, timeout,
           messageType, entryType, entryServiceId, entryTTL,
           serviceId, returnCode, methodId,
           firstToken, firstTokenValue, firstTokenCheckType,
           secondToken, secondTokenValue, secondTokenCheckType,
           syspar::Wildcard, syspar::Wildcard, kEquals, // thirdToken
           protocol, extractSomeIpToken, expectedResult);
}

enum Bool ETS_InternalWaitForSOMEIPNotification(char callerFunctionName[], 
  long timeout,
  enum SomeIpMessageType messageType,
  enum SomeIpEntryType entryType,
  int entryServiceId,
  char entryTTL[],
  char serviceId[],
  char returnCode[],
  char methodId[],
  char firstToken[],
  char firstTokenValue[],
  enum CheckType firstTokenCheckType,
  char secondToken[],
  char secondTokenValue[],
  enum CheckType secondTokenCheckType,
  char thirdToken[],
  char thirdTokenValue[],
  enum CheckType thirdTokenCheckType,
  int protocol,
  char extractSomeIpToken[],
  enum ExpectedResult expectedResult
  )
{
  enum Bool result;
  char temp[100];

  gIsWaitingForSOMEIPMessage = 1;
  SetBusContext(GetBusNameContext("Ethernet_1"));
   
  InternalAddExpectedParameter("SOME/IP", "MessageType", messageType);
  
  if(!IsWildcard(extractSomeIpToken))
  {
    gExtractingParameters.clear();
    gExtractingParametersCount=0;
    InternalSetExtractedParameter("SOME/IP", extractSomeIpToken, kExtractInt64);
  }
  
  if(entryType != SomeIpEntryNull)
  {
    InternalAddExpectedParameter("SOME/IP", "ServiceId", 65535, kEquals);
    InternalAddExpectedParameter("SOME/IP", "Entry[0]", entryType);
    snprintf(temp, elcount(temp), "Entry[0].%s.TTL", entryType.name());
    if(IsWildcard(entryTTL))
    {
     InternalAddExpectedParameter("SOME/IP", temp, 0, kGreaterThan);
    }
    else
    {
      InternalAddExpectedParameter("SOME/IP", temp, ConvertStringValueToInt64(entryTTL));
    }
    if(entryServiceId != -1)
    {
      snprintf(temp, elcount(temp), "Entry[0].%s.ServiceID", entryType.name());
      InternalAddExpectedParameter("SOME/IP", temp, entryServiceId);
    }
  }

  if(!IsWildcard(serviceId))
  {
    InternalAddExpectedParameter("SOME/IP", "ServiceId", ConvertStringValueToInt64(serviceId));
  }
  if(!IsWildcard(methodId))
  {
    InternalAddExpectedParameter("SOME/IP", "MethodId", (0x7FFF & ConvertStringValueToInt64(methodId)));
  }
  if(!IsWildcard(returnCode))
  {
    InternalAddExpectedParameter("SOME/IP", "ReturnCode", ConvertStringValueToInt64(returnCode));
  }
  
  AddTokenAsExpectedParameter(firstToken, firstTokenValue, firstTokenCheckType);
  AddTokenAsExpectedParameter(secondToken, secondTokenValue, secondTokenCheckType);
  AddTokenAsExpectedParameter(thirdToken, thirdTokenValue, thirdTokenCheckType);
  
  StartObservationOfIncomingPackets(expectedResult);

  result = InternalWaitForIncomingPacket(callerFunctionName, timeout, expectedResult);

  InternalClearAllParameters();
  gIsWaitingForSOMEIPMessage = 0;  
  
  return result;
}

void ETS_InternalWaitForSOMEIPError(char callerFunctionName[], long timeout, dword methodId, dword expectedError, enum Bool errorIsOptional)
{
  dword aep;
  long result;
  char passVerb[32];
  char failVerb[32];
  dword port;
  char temp[100];
  enum ExpectedResult expectedResult;
  
  SetBusContext(GetBusNameContext("Ethernet_1"));

  //InternalAddExpectedParameter("SOME/IP", "ServiceId", syspar::SomeIp_ETS_ServiceId);
  //InternalAddExpectedParameter("SOME/IP", "MethodId", (0x7FFF & methodId));
  
  if(errorIsOptional)
  {
    // There are two types of unexpected messages
    // 1. wrong message type => group 0
    InternalAddExpectedParameter("SOME/IP", "ServiceId", syspar::SomeIp_ETS_ServiceId, kEquals, 0);
    InternalAddExpectedParameter("SOME/IP", "MethodId", (0x7FFF & methodId), kEquals, 0 );
    InternalAddExpectedParameter("SOME/IP", "MessageType", SomeIpMessageTypeError, kNotEquals, 0);
    
    // 2. correct message type, but wrong return code => group 1
    InternalAddExpectedParameter("SOME/IP", "ServiceId", syspar::SomeIp_ETS_ServiceId, kEquals, 1);
    InternalAddExpectedParameter("SOME/IP", "MethodId", (0x7FFF & methodId), kEquals, 1);
    InternalAddExpectedParameter("SOME/IP", "MessageType", SomeIpMessageTypeError, kEquals, 1);
    InternalAddExpectedParameter("SOME/IP", "ReturnCode", expectedError, kNotEquals, 1);
    expectedResult = kNoAnswerExpected;
  } 
  else // There is just one expected type of message
  {
    InternalAddExpectedParameter("SOME/IP", "MessageType", SomeIpMessageTypeError, kEquals);
    InternalAddExpectedParameter("SOME/IP", "ReturnCode", expectedError, kEquals);
    expectedResult = kAnswerExpected;
  }
  
  gIsWaitingForSOMEIPMessage = 1;
  StartObservationOfIncomingPackets(expectedResult);
  
  result = InternalWaitForIncomingPacket(callerFunctionName, timeout, expectedResult);

  InternalClearAllParameters();
  gIsWaitingForSOMEIPMessage = 0;  
}

void ETS_InternalWaitForNotificationWithMethodId(char callerFunctionName[], long timeout, dword instanceId, dword methodId, enum Bool answerExpected)
{
  enum SomeIpMessageType messageType = SomeIpMessageTypeNotification;
  enum ExpectedResult expectedResult;
  enum Bool result;
  char passVerb[32];
  char failVerb[32];
  char temp[100];
  
  expectedResult = (answerExpected==kFalse) ? kNoAnswerExpected : kAnswerExpected;
  
  gIsWaitingForSOMEIPMessage = 1;
  SetBusContext(GetBusNameContext("Ethernet_1"));

  InternalAddExpectedParameter("SOME/IP", "MessageType", messageType);
  InternalAddExpectedParameter("SOME/IP", "ServiceId", syspar::SomeIp_ETS_ServiceId);
  InternalAddExpectedParameter("SOME/IP", "MethodId", (0x7FFF & methodId));

  StartObservationOfIncomingPackets(expectedResult);
  
  result = InternalWaitForIncomingPacket(callerFunctionName, timeout, expectedResult);

  InternalClearAllParameters();
  gIsWaitingForSOMEIPMessage = 0;  
  return;
  
}

void ETS_InternalWaitForNotificationWithMethodIds(char callerFunctionName[], long timeout, dword instanceId, dword methodIds[], dword countMethodIds, enum Bool answerExpected)
{
  enum Bool success; 
  dword group;

  SetBusContext(GetBusNameContext("Ethernet_1"));

  for(group=0; group<countMethodIds; ++group)
  {
    InternalAddExpectedParameter("SOME/IP", "MessageType", SomeIpMessageTypeNotification, kEquals, group);
    InternalAddExpectedParameter("SOME/IP", "ServiceId", syspar::SomeIp_ETS_ServiceId, kEquals, group);
    InternalAddExpectedParameter("SOME/IP", "MethodId", (0x7FFF & methodIds[group]), kEquals, group);
  }
  
  gIsWaitingForSOMEIPMessage = 1;
  StartObservationOfIncomingPackets(kNoAnswerExpected);
  
  write("start waiting for SOME/IP message at %.5f", timeNowFloat()/100000.0);
  testWaitForTimeout(timeout);
  gObservingEthPackets = kFalse;
  gIsWaitingForSOMEIPMessage = 0; 

  if((answerExpected==kTrue && gReceivedMessagesPerChannel[1]!=countMethodIds) ||
     (answerExpected==kFalse && gReceivedMessagesPerChannel[1]!=0))
  {
    if(answerExpected)
      testStepFail(callerFunctionName, "Wrong number of field notifications recognized: %d, expected %d.", gReceivedMessagesPerChannel[1], countMethodIds);
    else
      testStepFail(callerFunctionName, "Unexpected field notification recognized.");
  }
  else
  {
    if(answerExpected)
    {
      success=kTrue;
      for(group=0; group<countMethodIds && success==kTrue; ++group)
      {
        if(gExpectedParametersMatches[group]!=1) // one match per group only
        {
          if(gExpectedParametersMatches[group]==0)
            testStepFail(callerFunctionName, "Expected field notifications have not been recognized.");
          else
            testStepFail(callerFunctionName, "Duplicated field notifications have not been recognized.");
          write("#### group: %d, expected: 1, matches: %d", group, gExpectedParametersMatches[group]);
          success=kFalse;
        }
      }
      
      if(success==kTrue)
        testStepPass(callerFunctionName, "Expected field notifications have been recognized.");
    }
    else
    {
      testStepPass(callerFunctionName, "No unexpected field notifications have been recognized.");
    }
  } 
  write("finished waiting for SOME/IP message at %.5f", timeNowFloat()/100000.0);

  InternalClearAllParameters();
}

/*
  When subscribing without a ConsumedServiceInstance, the specified port must be opened to receive the
  field notifications.
*/
export testfunction ETS_OpenLocalApplicationEndPointForSubscribeWithoutCSI()
{
  IP_Endpoint sourceEndpoint, destinationEndpoint;
  //write("#### >ETS_OpenLocalApplicationEndPointForSubscribeWithoutCSI at %.5f", timeNowFloat()/100000.0);

  if(InitEndpoint(sourceEndpoint, syspar::IpAddressTester, 0)!=kTrue)
  {
    testStepFail("ETS_OpenLocalApplicationEndPointForSubscribeWithoutCSI", "Invalid IP address: %s", syspar::IpAddressTester);
    return;
  }
    
  if(InitEndpoint(destinationEndpoint, syspar::DIface0Ip, syspar::SomeIp_ETS_Port)!=kTrue)
  {
    testStepFail("ETS_OpenLocalApplicationEndPointForSubscribeWithoutCSI", "Invalid IP address: %s", syspar::DIface0Ip);
    return;
  }

  sourceEndpoint.SetToTcp();
  destinationEndpoint.SetToTcp();
  gTcpAepForSubscribeWithoutCSI = ETSOpenLocalApplicationEndpoint(sourceEndpoint);
  
  if(gTcpAepForSubscribeWithoutCSI==0)
  {
    ReportSomeIpError("ETS_OpenLocalApplicationEndPointForSubscribeWithoutCSI open failed, tcp");
    testStepFail("ETS_OpenLocalApplicationEndPointForSubscribeWithoutCSI", "SomeIp error");
    return;
  }

  if(SomeIpEstablishTCPConnection (gTcpAepForSubscribeWithoutCSI, destinationEndpoint)>0 ||
     SomeIpGetLastError()>0 || WaitFor_NewTCPConnectionState(1000, kTCPConnectionEstablished)==kFalse)
  {
    ReportSomeIpError("ETS_OpenLocalApplicationEndPointForSubscribeWithoutCSI open failed, tcp");
    testStepFail("ETS_OpenLocalApplicationEndPointForSubscribeWithoutCSI", "Could not establish connection");
    //write("#### <ETS_OpenLocalApplicationEndPointForSubscribeWithoutCSI with error TCP");
    return;
  }
  gPortForSubscribeWithoutCSI = gLocalEndpointOfEstablishedConnection.PortNumber;
  sourceEndpoint.PortNumber = gPortForSubscribeWithoutCSI;
  sourceEndpoint.SetToUdp();
  gUdpAepForSubscribeWithoutCSI = ETSOpenLocalApplicationEndpoint(sourceEndpoint);
  if(gUdpAepForSubscribeWithoutCSI==0)
  {
    ReportSomeIpError("ETS_OpenLocalApplicationEndPointForSubscribeWithoutCSI open failed, udp");
    testStepFail("ETS_OpenLocalApplicationEndPointForSubscribeWithoutCSI", "SomeIp error");
    //write("#### <ETS_OpenLocalApplicationEndPointForSubscribeWithoutCSI with error UDP");
    return;
  }
  
  //write("#### <ETS_OpenLocalApplicationEndPointForSubscribeWithoutCSI at %.5f", timeNowFloat()/100000.0);
}

export testfunction ETS_CloseLocalApplicationEndPointForSubscribeWithoutCSI()
{
  testWaitForTimeout(50); // When the test has been aborted the AEP might be still in use
  if(gUdpAepForSubscribeWithoutCSI)
  {
    ETSCloseLocalApplicationEndpoint(gUdpAepForSubscribeWithoutCSI);
    gPortForSubscribeWithoutCSI = gUdpAepForSubscribeWithoutCSI = 0;
  }
  if(gTcpAepForSubscribeWithoutCSI)
  {
    SomeIpCloseEstablishedTCPConnection(gTcpAepForSubscribeWithoutCSI);
    WaitFor_NewTCPConnectionState(1000, kTCPConnectionClosed);
    ETSCloseLocalApplicationEndpoint(gTcpAepForSubscribeWithoutCSI);
    gTcpAepForSubscribeWithoutCSI = 0;
  }
}

export testfunction ETS_SendNotification_Subscribe_LengthPatchedVarA(dword sessionId, dword instanceId, char destinationIP[])
{
  dword HEADER_FIELD_LENGTH_OFFSET = 4, HEADER_FIELD_OPTION_ARRAY_LENGTH_OFFSET = 40, HEADER_FIELD_MESSAGE_ID_LENGTH = 4, HEADER_FIELD_LENGTH_LENGTH = 4;
  dword EXPECTED_VALUE_OF_HEADER_FIELD_LENGTH = 60; // message contains two IPv4 endpoint options
  dword EXPECTED_VALUE_OF_HEADER_FIELD_OPTION_ARRAY_LENGTH = 24; // The two IPv4 endpoint options
  dword EventGroupID = 2;
  byte messageBuffer[1600];
  dword messageLength, lengthValue;
  dword msgHandle;
  dword handle;
  
  IP_Endpoint sourceEndpoint, destinationEndpoint;
  if(InitEndpoint(sourceEndpoint, syspar::IpAddressTester, atol(syspar::SomeIpServiceDiscoveryPort))!=kTrue ||
     InitEndpoint(destinationEndpoint, destinationIP, atol(syspar::SomeIpServiceDiscoveryPort))!=kTrue)
  {
    testStepFail("ETS_SendNotification_Subscribe_LengthPatchedVarA", "Creation of endpoints failed");
    return;
  }
  
  if(ETS_CreateSomeIpSDNotification(handle, sourceEndpoint.Address, syspar::SomeIp_ETS_ServiceId,
    syspar::Wildcard, "Subscribe", instanceId, syspar::Wildcard, syspar::SomeIp_ETS_Subscribe_TTL, syspar::Wildcard, sessionId,
    gPortForSubscribeWithoutCSI, "EventgroupID", EventGroupID, getEndpointSelectorForEVG(EventGroupID), kTrue)==kFalse)
  {
    testStepFail("ETS_SendNotification_Subscribe_LengthPatchedVarA", "Creation of notification failed");
    if(handle)
      SomeIpReleaseMessage(handle);
    return;
  }

  messageLength = SomeIpSerializeMessage(handle, elCount(messageBuffer), messageBuffer);
  if(messageLength!=HEADER_FIELD_MESSAGE_ID_LENGTH+HEADER_FIELD_LENGTH_LENGTH+EXPECTED_VALUE_OF_HEADER_FIELD_LENGTH)
  {
    testStepFail("ETS_SendNotification_Subscribe_LengthPatchedVarA", "Patch not possible, wrong message size: %d", messageLength);
    return ;
  }
  
  lengthValue = getBigEndianDWORD(messageBuffer, HEADER_FIELD_LENGTH_OFFSET);
  if(lengthValue!=EXPECTED_VALUE_OF_HEADER_FIELD_LENGTH)
  {
    testStepFail("ETS_SendNotification_Subscribe_LengthPatchedVarA", "Patch not possible, wrong header length: %d, expected %d",
                 lengthValue, EXPECTED_VALUE_OF_HEADER_FIELD_LENGTH);
    return ;
  }
  setBigEndianDWORD(messageBuffer, HEADER_FIELD_LENGTH_OFFSET, 48);

  lengthValue = getBigEndianDWORD(messageBuffer, HEADER_FIELD_OPTION_ARRAY_LENGTH_OFFSET);
  if(lengthValue!=EXPECTED_VALUE_OF_HEADER_FIELD_OPTION_ARRAY_LENGTH)
  {
    testStepFail("ETS_SendNotification_Subscribe_LengthPatchedVarA", "Patch not possible, wrong option length: %d, expected %d",
                 lengthValue, EXPECTED_VALUE_OF_HEADER_FIELD_OPTION_ARRAY_LENGTH);
    return ;
  }
  setBigEndianDWORD(messageBuffer, HEADER_FIELD_OPTION_ARRAY_LENGTH_OFFSET, 12);

  msgHandle = SomeIpCreateMessage(messageLength, messageBuffer);
  InitEndpoint(destinationEndpoint, syspar::SomeIpServiceDiscoveryIpAddress, atol(syspar::SomeIpServiceDiscoveryPort));
  SomeIpOutputMessage(gClientServiceAepHandleUDP, destinationEndpoint, msgHandle);
  
  SomeIpReleaseMessage(handle);
}

export testfunction ETS_SendNotification_Subscribe_LengthShorted(dword sessionId, dword instanceId, char destinationIP[])
{
  dword HEADER_FIELD_MESSAGE_ID_SIZE = 4, HEADER_FIELD_LENGTH_OFFSET = 4,  HEADER_FIELD_LENGTH_SIZE = 4;
  dword HEADER_FIELD_LENGTH_DECREMENT_VALUE=10;
  dword EventGroupID = 2;
  byte messageBuffer[1600];
  dword messageLength, lengthValue;
  dword msgHandle;
  dword handle;
  
  IP_Endpoint sourceEndpoint, destinationEndpoint;
  if(InitEndpoint(sourceEndpoint, syspar::IpAddressTester, atol(syspar::SomeIpServiceDiscoveryPort))!=kTrue ||
     InitEndpoint(destinationEndpoint, destinationIP, atol(syspar::SomeIpServiceDiscoveryPort))!=kTrue)
  {
    testStepFail("ETS_SendNotification_Subscribe_LengthShorted", "Creation of endpoints failed");
    return;
  }
  
  if(ETS_CreateSomeIpSDNotification(handle, sourceEndpoint.Address, syspar::SomeIp_ETS_ServiceId,
    syspar::Wildcard, "Subscribe", instanceId, syspar::Wildcard, syspar::SomeIp_ETS_Subscribe_TTL, syspar::Wildcard, sessionId,
    gPortForSubscribeWithoutCSI, "EventgroupID", EventGroupID, getEndpointSelectorForEVG(EventGroupID), kTrue)==kFalse)
  {
    testStepFail("ETS_SendNotification_Subscribe_LengthPatchedVarA", "Creation of notification failed");
    if(handle)
      SomeIpReleaseMessage(handle);
    return;
  }

  messageLength = SomeIpSerializeMessage(handle, elCount(messageBuffer), messageBuffer);
  if(messageLength<HEADER_FIELD_MESSAGE_ID_SIZE+HEADER_FIELD_LENGTH_SIZE)
  {
    testStepFail("ETS_SendNotification_Subscribe_LengthPatchedVarA", "Patch not possible, wrong message size: %d", messageLength);
    return ;
  }
  
  lengthValue = getBigEndianDWORD(messageBuffer, HEADER_FIELD_LENGTH_OFFSET);
  if(lengthValue<HEADER_FIELD_LENGTH_DECREMENT_VALUE)
  {
    testStepFail("ETS_SendNotification_Subscribe_LengthPatchedVarA", "Patch not possible, wrong header length: %d, expected at least %d",
                 lengthValue, HEADER_FIELD_LENGTH_DECREMENT_VALUE);
    return ;
  }
  setBigEndianDWORD(messageBuffer, HEADER_FIELD_LENGTH_OFFSET, lengthValue-HEADER_FIELD_LENGTH_DECREMENT_VALUE);


  msgHandle = SomeIpCreateMessage(messageLength, messageBuffer);
  InitEndpoint(destinationEndpoint, syspar::SomeIpServiceDiscoveryIpAddress, atol(syspar::SomeIpServiceDiscoveryPort));
  SomeIpOutputMessage(gClientServiceAepHandleUDP, destinationEndpoint, msgHandle);
  //SomeIpOutputMessage(gClientServiceAepHandleUDP, ipGetAddressAsNumber(syspar::SomeIpServiceDiscoveryIpAddress), atol(syspar::SomeIpServiceDiscoveryPort), msgHandle);
  
  SomeIpReleaseMessage(handle);
}


enum Bool getIndexOfOptionsArrayLength(byte payload[], long payloadLen, dword & optionArrayLengthIndex, dword & optionsLen)
{
  byte HEADER_FIELD_ENTRY_LENGTH_OFFSET = 4, LENGTH_FIELD_SIZE = 4;
  dword lengthOfEntries;
  
  lengthOfEntries = getBigEndianDWORD(payload, HEADER_FIELD_ENTRY_LENGTH_OFFSET);
  optionArrayLengthIndex = HEADER_FIELD_ENTRY_LENGTH_OFFSET + lengthOfEntries + LENGTH_FIELD_SIZE;
  
  if(optionArrayLengthIndex+LENGTH_FIELD_SIZE<=payloadLen)
  {
    optionsLen = getBigEndianDWORD(payload, optionArrayLengthIndex);
    return kTrue;
  }
  return kFalse;
}

enum Bool getIndexOfFirstOption(byte payload[], long payloadLen, dword & optionIndex, dword & optionsLen)
{
  byte HEADER_FIELD_ENTRY_LENGTH_OFFSET = 4, LENGTH_FIELD_SIZE = 4;
  dword lengthOfEntries, optionLengthIndex;
  
  if(getIndexOfOptionsArrayLength(payload, payloadLen, optionLengthIndex, optionsLen)==kTrue)
  {
    optionIndex = optionLengthIndex + LENGTH_FIELD_SIZE;

    if(optionIndex+optionsLen<=payloadLen)
      return kTrue;
  }
  
  return kFalse;
}

export testfunction ETS_SendNotification_Subscribe_WithUdpOptionLength4(dword sessionId, dword instanceId, char destinationIP[])
{
  byte PROTOCOL_OFFSET_IPv4=9, PROTOCOL_OFFSET_IPv6=21, OPTION_SIZE_NOT_COVERED_BY_LENGTH=3;
  int i;
  long dataLen;
  byte buffer[1500];
  enum Bool patched;
  dword handle;
  dword EventGroupID = 2;
  dword indexOfFirstOption, optionsLen, optionOffset, optionIndex, optionLength;
  
  IP_Endpoint sourceEndpoint, destinationEndpoint;
  if(InitEndpoint(sourceEndpoint, syspar::IpAddressTester, atol(syspar::SomeIpServiceDiscoveryPort))!=kTrue ||
     InitEndpoint(destinationEndpoint, destinationIP, atol(syspar::SomeIpServiceDiscoveryPort))!=kTrue)
  {
    testStepFail("ETS_SendNotification_Subscribe_WithUdpOptionLength4", "Creation of endpoints failed");
    return;
  }
  
  if(ETS_CreateSomeIpSDNotification(handle, sourceEndpoint.Address, syspar::SomeIp_ETS_ServiceId,
    syspar::Wildcard, "Subscribe", instanceId, syspar::Wildcard, syspar::SomeIp_ETS_Subscribe_TTL, syspar::Wildcard, sessionId,
    gPortForSubscribeWithoutCSI, "EventgroupID", EventGroupID, getEndpointSelectorForEVG(EventGroupID), kTrue)==kFalse)
  {
    testStepFail("ETS_SendNotification_Subscribe_WithUdpOptionLength4", "Creation of notification failed");
    if(handle)
      SomeIpReleaseMessage(handle);
    return;
  }

  dataLen = SomeIpGetData(handle, elcount(buffer), buffer);
  patched=kFalse;
  
  if(getIndexOfFirstOption(buffer, dataLen, indexOfFirstOption, optionsLen)==kTrue)
  {
    optionOffset=0;
    do
    {
      optionIndex = indexOfFirstOption + optionOffset;
      // search for the IPv4 or IPv6 UDP option length data
      if((buffer[optionIndex]==0x00 && buffer[optionIndex+1]==0x09 && buffer[optionIndex+2]==0x04 && buffer[optionIndex+PROTOCOL_OFFSET_IPv4]==TP_UDP) ||
         (buffer[optionIndex]==0x00 && buffer[optionIndex+1]==0x15 && buffer[optionIndex+2]==0x06 && buffer[optionIndex+PROTOCOL_OFFSET_IPv6]==TP_UDP))
      {
        buffer[optionIndex+1] = 4;
        patched=kTrue;
      }
      else
      {
        optionLength = getBigEndianWORD(buffer, optionIndex);
        if(optionLength==0)
        {
          testStepFail("ETS_SendNotification_Subscribe_WithUdpOptionLength4", "Message contains option with length 0");
          return;
        }
        optionOffset += optionLength + OPTION_SIZE_NOT_COVERED_BY_LENGTH;
      }
    }
    while(patched==kFalse && optionOffset<optionsLen);
    
    if(patched==kFalse)
    {
      testStepFail("ETS_SendNotification_Subscribe_WithUdpOptionLength4", "UDP Endpoint Option not found in message");
      return;
    } 
   
    SomeIpSetData(handle, dataLen, buffer);

    if(ETS_OutputSomeIpSDNotification(handle, sourceEndpoint, destinationEndpoint)==kFalse)
    {
      testStepFail("ETS_SendNotification_Subscribe_WithUdpOptionLength4", "Sending of notification failed");
    }
  }
  else
  {
    testStepFail("ETS_SendNotification_Subscribe_WithUdpOptionLength4", "Message contains no options");
    return;
  }
}

enum Bool isOptionIpv4Endpoint(byte buffer[], dword optionIndex)
{
  byte PROTOCOL_OFFSET_IPv4=9, OPTION_TYPE_IPV4_ENDPOINT=0x04;

  if(buffer[optionIndex]==0x00 && buffer[optionIndex+1]==0x09 && buffer[optionIndex+2]==OPTION_TYPE_IPV4_ENDPOINT &&
      (buffer[optionIndex+PROTOCOL_OFFSET_IPv4]==TP_UDP || buffer[optionIndex+PROTOCOL_OFFSET_IPv4]==TP_TCP))
    return kTrue;
  return kFalse;
}

enum Bool isOptionIpv6Endpoint(byte buffer[], dword optionIndex)
{
  byte PROTOCOL_OFFSET_IPv6=21, OPTION_TYPE_IPv6_ENDPOINT=0x06;

  if(buffer[optionIndex]==0x00 && buffer[optionIndex+1]==0x15 && buffer[optionIndex+2]==OPTION_TYPE_IPv6_ENDPOINT &&
      (buffer[optionIndex+PROTOCOL_OFFSET_IPv6]==TP_UDP || buffer[optionIndex+PROTOCOL_OFFSET_IPv6]==TP_TCP))
    return kTrue;
  return kFalse;
}

export testfunction ETS_SendNotification_Subscribe_WithShortenedUnalignedOption(dword sessionId, dword instanceId, char destinationIP[])
{
  byte OPTION_SIZE_NOT_COVERED_BY_LENGTH=3, COUNT_BYTES_MOVED=5;
  int i;
  long dataLen;
  byte buffer[1500], patchBuffer;
  dword handle;
  dword EventGroupID = 2;
  dword indexOfFirstOption, optionsLen, optionOffset, optionIndex, optionLength;
  dword indexOfIPvXEndpointOptions[long], lengthOfIPvXEndpointOptions[long];
  
  IP_Endpoint sourceEndpoint, destinationEndpoint;
  if(InitEndpoint(sourceEndpoint, syspar::IpAddressTester, atol(syspar::SomeIpServiceDiscoveryPort))!=kTrue ||
     InitEndpoint(destinationEndpoint, destinationIP, atol(syspar::SomeIpServiceDiscoveryPort))!=kTrue)
  {
    testStepFail("ETS_SendNotification_Subscribe_WithShortenedUnalignedOption", "Creation of endpoints failed");
    return;
  }
  
  if(ETS_CreateSomeIpSDNotification(handle, sourceEndpoint.Address, syspar::SomeIp_ETS_ServiceId,
    syspar::Wildcard, "Subscribe", instanceId, syspar::Wildcard, syspar::SomeIp_ETS_Subscribe_TTL, syspar::Wildcard, sessionId,
    gPortForSubscribeWithoutCSI, "EventgroupID", EventGroupID, getEndpointSelectorForEVG(EventGroupID), kTrue)==kFalse)
  {
    testStepFail("ETS_SendNotification_Subscribe_WithShortenedUnalignedOption", "Creation of notification failed");
    if(handle)
      SomeIpReleaseMessage(handle);
    return;
  }

  dataLen = SomeIpGetData(handle, elcount(buffer), buffer);
  
  if(getIndexOfFirstOption(buffer, dataLen, indexOfFirstOption, optionsLen)==kTrue)
  {
    optionOffset=0;
    while(indexOfIPvXEndpointOptions.size()!=2 && optionOffset<optionsLen) // find the two IP Endpoints
    {
      optionIndex = indexOfFirstOption + optionOffset;
      optionLength = getBigEndianWORD(buffer, optionIndex);
      if(optionLength==0)
      {
        testStepFail("ETS_SendNotification_Subscribe_WithShortenedUnalignedOption", "Message contains option with length 0");
        return;
      }

      if(isOptionIpv4Endpoint(buffer, optionIndex)==kTrue || isOptionIpv6Endpoint(buffer, optionIndex))
      {
        indexOfIPvXEndpointOptions[indexOfIPvXEndpointOptions.size()] = optionIndex;
        lengthOfIPvXEndpointOptions[lengthOfIPvXEndpointOptions.size()] = optionLength;
      }
      
      optionOffset += optionLength + OPTION_SIZE_NOT_COVERED_BY_LENGTH;
    }
    
    if(indexOfIPvXEndpointOptions.size()!=2)
    {
      testStepFail("ETS_SendNotification_Subscribe_WithShortenedUnalignedOption", "Endpoint options not found in message");
      return;
    } 
   
    // move and cut data of second endpoint to the right
    for(i=indexOfIPvXEndpointOptions[1]+OPTION_SIZE_NOT_COVERED_BY_LENGTH+lengthOfIPvXEndpointOptions[1]-COUNT_BYTES_MOVED; i>=indexOfIPvXEndpointOptions[1]; --i)
      buffer[i+COUNT_BYTES_MOVED] = buffer[i];
    // change the length of both endpoints
    setBigEndianWORD(buffer, indexOfIPvXEndpointOptions[0], lengthOfIPvXEndpointOptions[0]+COUNT_BYTES_MOVED);
    setBigEndianWORD(buffer, indexOfIPvXEndpointOptions[1]+COUNT_BYTES_MOVED, lengthOfIPvXEndpointOptions[1]-COUNT_BYTES_MOVED);
      
    SomeIpSetData(handle, dataLen, buffer);

    if(ETS_OutputSomeIpSDNotification(handle, sourceEndpoint, destinationEndpoint)==kFalse)
    {
      testStepFail("ETS_SendNotification_Subscribe_WithShortenedUnalignedOption", "Sending of notification failed");
    }
  }
  else
  {
    testStepFail("ETS_SendNotification_Subscribe_WithShortenedUnalignedOption", "Message contains no options");
    return;
  }
  
}

export testfunction ETS_SendNotification_Subscribe_WithIncreasedOptionLength(dword sessionId, dword instanceId, char destinationIP[])
{
  byte  OPTION_SIZE_NOT_COVERED_BY_LENGTH=3;
  int i;
  long dataLen;
  byte buffer[1500];
  enum Bool patched;
  dword handle;
  dword evgId = 5;
  dword indexOfFirstOption, optionsLen, optionOffset, optionIndex, optionLength;

  IP_Endpoint sourceEndpoint, destinationEndpoint;
  if(InitEndpoint(sourceEndpoint, syspar::IpAddressTester, atol(syspar::SomeIpServiceDiscoveryPort))!=kTrue ||
     InitEndpoint(destinationEndpoint, destinationIP, atol(syspar::SomeIpServiceDiscoveryPort))!=kTrue)
  {
    testStepFail("ETS_SendNotification_Subscribe_WithIncreasedOptionLength", "Creation of endpoints failed");
    return;
  }
  
  if(ETS_CreateSomeIpSDNotification(handle, sourceEndpoint.Address, syspar::SomeIp_ETS_ServiceId, syspar::Wildcard, "Subscribe",
    instanceId, syspar::Wildcard, syspar::SomeIp_ETS_Subscribe_TTL, syspar::Wildcard, sessionId, gPortForSubscribeWithoutCSI, "EventgroupID", evgId, getEndpointSelectorForEVG(evgId), kTrue)==kFalse)
  {
    testStepFail("ETS_SendNotification_Subscribe_WithIncreasedOptionLength", "Creation of notification failed");
    return;
  }

  dataLen = SomeIpGetData(handle, elcount(buffer), buffer);
  patched=kFalse;
  
  if(getIndexOfFirstOption(buffer, dataLen, indexOfFirstOption, optionsLen)==kTrue)
  {
    setBigEndianWORD(buffer, indexOfFirstOption, 0xff00);
    SomeIpSetData(handle, dataLen, buffer);

    if(ETS_OutputSomeIpSDNotification(handle, sourceEndpoint, destinationEndpoint)==kFalse)
    {
      testStepFail("ETS_SendNotification_Subscribe_WithIncreasedOptionLength", "Sending of notification failed");
    }
  }
  else
  {
    testStepFail("ETS_SendNotification_Subscribe_WithIncreasedOptionLength", "Message contains no options");
    return;
  } 
}

export testfunction ETS_SendNotification_Subscribe_WithIncreasedOptionsArrayLength(dword sessionId, dword instanceId, char destinationIP[])
{
  long dataLen;
  byte buffer[1500];
  dword handle;
  dword EventGroupID = 2;
  dword arrayLengthIndex, optionsLen;
  
  IP_Endpoint sourceEndpoint, destinationEndpoint;
  if(InitEndpoint(sourceEndpoint, syspar::IpAddressTester, atol(syspar::SomeIpServiceDiscoveryPort))!=kTrue ||
     InitEndpoint(destinationEndpoint, destinationIP, atol(syspar::SomeIpServiceDiscoveryPort))!=kTrue)
  {
    testStepFail("ETS_SendNotification_Subscribe_WithIncreasedOptionsArrayLength", "Creation of endpoints failed");
    return;
  }
  
  if(ETS_CreateSomeIpSDNotification(handle, sourceEndpoint.Address, syspar::SomeIp_ETS_ServiceId,
    syspar::Wildcard, "Subscribe", instanceId, syspar::Wildcard, syspar::SomeIp_ETS_Subscribe_TTL, syspar::Wildcard, sessionId,
    gPortForSubscribeWithoutCSI, "EventgroupID", EventGroupID, getEndpointSelectorForEVG(EventGroupID), kTrue)==kFalse)
  {
    testStepFail("ETS_SendNotification_Subscribe_WithIncreasedOptionsArrayLength", "Creation of notification failed");
    if(handle)
      SomeIpReleaseMessage(handle);
    return;
  }

  dataLen = SomeIpGetData(handle, elcount(buffer), buffer);
  
  if(getIndexOfOptionsArrayLength(buffer, dataLen, arrayLengthIndex, optionsLen)==kTrue)
  {
    setBigEndianDWORD(buffer, arrayLengthIndex, optionsLen+0x10);
    SomeIpSetData(handle, dataLen, buffer);

    if(ETS_OutputSomeIpSDNotification(handle, sourceEndpoint, destinationEndpoint)==kFalse)
    {
      testStepFail("ETS_SendNotification_Subscribe_WithIncreasedOptionsArrayLength", "Sending of notification failed");
    }
  }
  else
  {
    testStepFail("ETS_SendNotification_Subscribe_WithIncreasedOptionsArrayLength", "Message contains no options");
    return;
  }
  
}

export testfunction ETS_SendNotification_Subscribe_WithOptionsArrayLengthTooShort(dword sessionId, dword instanceId, char destinationIP[])
{
  long dataLen;
  byte buffer[1500];
  dword handle;
  dword EventGroupID = 2;
  dword arrayLengthIndex, optionsLen;
   
  IP_Endpoint sourceEndpoint, destinationEndpoint;
  if(InitEndpoint(sourceEndpoint, syspar::IpAddressTester, atol(syspar::SomeIpServiceDiscoveryPort))!=kTrue ||
     InitEndpoint(destinationEndpoint, destinationIP, atol(syspar::SomeIpServiceDiscoveryPort))!=kTrue)
  {
    testStepFail("ETS_SendNotification_Subscribe_WithOptionsArrayLengthTooShort", "Creation of endpoints failed");
    return;
  }
  
  if(ETS_CreateSomeIpSDNotification(handle, sourceEndpoint.Address, syspar::SomeIp_ETS_ServiceId,
    syspar::Wildcard, "Subscribe", instanceId, syspar::Wildcard, syspar::SomeIp_ETS_Subscribe_TTL, syspar::Wildcard, sessionId,
    gPortForSubscribeWithoutCSI, "EventgroupID", EventGroupID, getEndpointSelectorForEVG(EventGroupID), kTrue)==kFalse)
  {
    testStepFail("ETS_SendNotification_Subscribe_WithOptionsArrayLengthTooShort", "Creation of notification failed");
    if(handle)
      SomeIpReleaseMessage(handle);
    return;
  }

  dataLen = SomeIpGetData(handle, elcount(buffer), buffer);
  
  if(getIndexOfOptionsArrayLength(buffer, dataLen, arrayLengthIndex, optionsLen)==kTrue)
  {
    setBigEndianDWORD(buffer, arrayLengthIndex, 2);
    SomeIpSetData(handle, dataLen, buffer);

    if(ETS_OutputSomeIpSDNotification(handle, sourceEndpoint, destinationEndpoint)==kFalse)
    {
      testStepFail("ETS_SendNotification_Subscribe_WithOptionsArrayLengthTooShort", "Sending of notification failed");
    }
  }
  else
  {
    testStepFail("ETS_SendNotification_Subscribe_WithOptionsArrayLengthTooShort", "Message contains no options");
    return;
  }
  
}

export testfunction ETS_SendNotification_Subscribe(dword sessionId, dword instanceId, dword evgId, char destinationIP[])
{
  ETS_SendSomeIpSDNotification("ETS_SendNotification_Subscribe", destinationIP, syspar::SomeIp_ETS_ServiceId, syspar::Wildcard, "Subscribe",
    instanceId, syspar::Wildcard, syspar::SomeIp_ETS_Subscribe_TTL, syspar::Wildcard, sessionId, gPortForSubscribeWithoutCSI,
    "EventgroupID", evgId, getEndpointSelectorForEVG(evgId));
}

export testfunction ETS_SendNotification_Subscribe_SetOptionReservedField(dword sessionId, dword instanceId, dword evgId, char destinationIP[])
{
  byte OPTION_SIZE_NOT_COVERED_BY_LENGTH=3, OPTION_RESERVED_FIELD_OFFSET=3;
  long dataLen;
  byte buffer[1500];
  enum Bool patched;
  dword handle;
  dword EventGroupID = 2;
  dword indexOfFirstOption, optionsLen, optionOffset, optionIndex, optionLength;
  
  IP_Endpoint sourceEndpoint, destinationEndpoint;
  if(InitEndpoint(sourceEndpoint, syspar::IpAddressTester, atol(syspar::SomeIpServiceDiscoveryPort))!=kTrue ||
     InitEndpoint(destinationEndpoint, destinationIP, atol(syspar::SomeIpServiceDiscoveryPort))!=kTrue)
  {
    testStepFail("ETS_SendNotification_Subscribe_SetOptionReservedField", "Creation of endpoints failed");
    return;
  }
  
  if(ETS_CreateSomeIpSDNotification(handle, sourceEndpoint.Address, syspar::SomeIp_ETS_ServiceId,
    syspar::Wildcard, "Subscribe", instanceId, syspar::Wildcard, syspar::SomeIp_ETS_Subscribe_TTL, syspar::Wildcard, sessionId,
    gPortForSubscribeWithoutCSI, "EventgroupID", EventGroupID, getEndpointSelectorForEVG(EventGroupID), kTrue)==kFalse)
  {
    testStepFail("ETS_SendNotification_Subscribe_SetOptionReservedField", "Creation of notification failed");
    if(handle)
      SomeIpReleaseMessage(handle);
    return;
  }

  dataLen = SomeIpGetData(handle, elcount(buffer), buffer);
  patched=kFalse;
  
  if(getIndexOfFirstOption(buffer, dataLen, indexOfFirstOption, optionsLen)==kTrue)
  {
    optionOffset=0;
    do
    {
      optionIndex = indexOfFirstOption + optionOffset;
      // search for the IPv4 or IPv6 option
      if(isOptionIPv4Endpoint(buffer, optionIndex)==kTrue || isOptionIPv6Endpoint(buffer, optionIndex)==kTrue)
      {
        buffer[optionIndex+OPTION_RESERVED_FIELD_OFFSET] = 0xFF;
        patched=kTrue;
      }
      else
      {
        optionLength = getBigEndianWORD(buffer, optionIndex);
        if(optionLength==0)
        {
          testStepFail("ETS_SendNotification_Subscribe_SetOptionReservedField", "Message contains option with length 0");
          return;
        }
        optionOffset += optionLength + OPTION_SIZE_NOT_COVERED_BY_LENGTH;
      }
    }
    while(patched==kFalse && optionOffset<optionsLen);
    
    if(patched==kFalse)
    {
      testStepFail("ETS_SendNotification_Subscribe_SetOptionReservedField", "IP Endpoint Option not found in message");
      return;
    } 
   
    SomeIpSetData(handle, dataLen, buffer);

    if(ETS_OutputSomeIpSDNotification(handle, sourceEndpoint, destinationEndpoint)==kFalse)
    {
      testStepFail("ETS_SendNotification_Subscribe_SetOptionReservedField", "Sending of notification failed");
    }
  }
  else
  {
    testStepFail("ETS_SendNotification_Subscribe_SetOptionReservedField", "Message contains no options");
    return;
  }

}

export testfunction ETS_SendNotification_Subscribe(dword sessionId, dword instanceId, dword evgId, char ttl[], char destinationIP[])
{
  ETS_SendSomeIpSDNotification("ETS_SendNotification_Subscribe", destinationIP, syspar::SomeIp_ETS_ServiceId, syspar::Wildcard, "Subscribe",
    instanceId, syspar::Wildcard, ttl, syspar::Wildcard, sessionId, gPortForSubscribeWithoutCSI, "EventgroupID", evgId, getEndpointSelectorForEVG(evgId));
}

export testfunction ETS_SendNotification_Subscribe(char sourceIP[], char destinationIP[])
{
  const dword evgId=2;
  ETS_SendSomeIpSDNotification("ETS_SendNotification_Subscribe", sourceIP, destinationIP, syspar::SomeIp_ETS_ServiceId, syspar::Wildcard, "Subscribe",
    syspar::SomeIp_ETS_DUT_InstanceId, syspar::Wildcard, syspar::SomeIp_ETS_Subscribe_TTL, syspar::Wildcard, 1, gPortForSubscribeWithoutCSI, "EventgroupID", evgId,
    getEndpointSelectorForEVG(evgId), kTrue);
}

export testfunction ETS_SendNotification_Subscribe(dword sessionId, dword serviceId, dword instanceId, dword evgId, char majorVersion[], char destinationIP[])
{
  ETS_SendSomeIpSDNotification("ETS_SendNotification_Subscribe", destinationIP, serviceId, syspar::Wildcard, "Subscribe",
    instanceId, majorVersion, syspar::SomeIp_ETS_Subscribe_TTL, syspar::Wildcard, sessionId, gPortForSubscribeWithoutCSI,
    "EventgroupID", evgId, getEndpointSelectorForEVG(evgId));
}

export testfunction ETS_SendNotification_Subscribe_WithPort0(dword sessionId, dword instanceId, dword evgId, char ttl[], char destinationIP[])
{
  dword port=0;
  ETS_SendSomeIpSDNotification("ETS_SendNotification_Subscribe_WithPort0", destinationIP, syspar::SomeIp_ETS_ServiceId, syspar::Wildcard, "Subscribe",
    instanceId, syspar::Wildcard, ttl, syspar::Wildcard, sessionId, port, "EventgroupID", evgId, getEndpointSelectorForEVG(evgId));
}

export testfunction ETS_SendNotification_Subscribe_WithoutIPv4Address(dword sessionId, dword instanceId, dword evgId, char ttl[], char destinationIP[])
{
  ETS_SendSomeIpSDNotification("ETS_SendNotification_Subscribe_WithoutIPv4Address", "32.0.0.0", destinationIP, syspar::SomeIp_ETS_ServiceId, syspar::Wildcard, "Subscribe",
    instanceId, syspar::Wildcard, ttl, syspar::Wildcard, sessionId, gPortForSubscribeWithoutCSI, "EventgroupID", evgId, getEndpointSelectorForEVG(evgId), kTrue);
}

export testfunction ETS_SendNotification_Subscribe_WithSrcAddress(dword sessionId, dword instanceId, dword evgId, char ttl[], char destinationIP[], char srcIP[], dword srcPort)
{
  ETS_SendSomeIpSDNotification("ETS_SendNotification_Subscribe_WithSrcAddress",srcIP, destinationIP, syspar::SomeIp_ETS_ServiceId, syspar::Wildcard, "Subscribe",
    instanceId, syspar::Wildcard, ttl, syspar::Wildcard, sessionId, srcPort, "EventgroupID", evgId, getEndpointSelectorForEVG(evgId), kTrue);
}

export testfunction ETS_SendNotification_Subscribe_WithEmptyEntriesArray(dword sessionId, dword instanceId, dword evgId, char ttl[], char destinationIP[])
{
  ETS_SendSomeIpSDNotification("ETS_SendNotification_Subscribe_WithEmptyEntriesArray",syspar::IpAddressTester, destinationIP, syspar::SomeIp_ETS_ServiceId, syspar::Wildcard, "Subscribe",
    instanceId, syspar::Wildcard, ttl, syspar::Wildcard, sessionId, gPortForSubscribeWithoutCSI, "EventgroupID", evgId, getEndpointSelectorForEVG(evgId), kFalse);
}

export testfunction ETS_SendNotification_Subscribe_WithEmptyOptionsArray(dword sessionId, dword instanceId, dword evgId, char ttl[], char destinationIP[])
{
  ETS_SendSomeIpSDNotification("ETS_SendNotification_Subscribe_WithEmptyOptionsArray", syspar::IpAddressTester, destinationIP, syspar::SomeIp_ETS_ServiceId, syspar::Wildcard, "Subscribe",
    instanceId, syspar::Wildcard, ttl, syspar::Wildcard, sessionId, gPortForSubscribeWithoutCSI, "EventgroupID", evgId, Without_Endpoints, kTrue);
}

export testfunction ETS_SendNotification_Subscribe_WithIPv4OptionLength0(dword sessionId, dword instanceId, dword evgId, char ttl[], char destinationIP[])
{
  byte  OPTION_SIZE_NOT_COVERED_BY_LENGTH=3;
  int i;
  long dataLen;
  byte buffer[1500];
  enum Bool patched;
  dword handle;
  dword EventGroupID = 2;
  dword indexOfFirstOption, optionsLen, optionOffset, optionIndex, optionLength;
  
  IP_Endpoint sourceEndpoint, destinationEndpoint;
  if(InitEndpoint(sourceEndpoint, syspar::IpAddressTester, atol(syspar::SomeIpServiceDiscoveryPort))!=kTrue ||
     InitEndpoint(destinationEndpoint, destinationIP, atol(syspar::SomeIpServiceDiscoveryPort))!=kTrue)
  {
    testStepFail("ETS_SendNotification_Subscribe_WithIPv4OptionLength0", "Creation of endpoints failed");
    return;
  }
  
  if(ETS_CreateSomeIpSDNotification(handle, sourceEndpoint.Address, syspar::SomeIp_ETS_ServiceId, syspar::Wildcard, "Subscribe",
    instanceId, syspar::Wildcard, ttl, syspar::Wildcard, sessionId, gPortForSubscribeWithoutCSI, "EventgroupID", evgId, getEndpointSelectorForEVG(evgId), kTrue)==kFalse)
  {
    testStepFail("ETS_SendNotification_Subscribe_WithIPv4OptionLength0", "Creation of notification failed");
    return;
  }

  dataLen = SomeIpGetData(handle, elcount(buffer), buffer);
  patched=kFalse;
  
  if(getIndexOfFirstOption(buffer, dataLen, indexOfFirstOption, optionsLen)==kTrue)
  {
    optionOffset=0;
    do
    {
      optionIndex = indexOfFirstOption + optionOffset;
      // search for the IPv4 or IPv6 option length data
      if(isOptionIPv4Endpoint(buffer, optionIndex)==kTrue || isOptionIPv6Endpoint(buffer, optionIndex)==kTrue)
      {
        buffer[optionIndex+1] = 0;
        patched=kTrue;
      }
      else
      {
        optionLength = getBigEndianWORD(buffer, optionIndex);
        if(optionLength==0)
        {
          testStepFail("ETS_SendNotification_Subscribe_WithIPv4OptionLength0", "Message contains option with length 0");
          return;
        }
        optionOffset += optionLength + OPTION_SIZE_NOT_COVERED_BY_LENGTH;
      }
    }
    while(patched==kFalse && optionOffset<optionsLen);
    
    if(patched==kFalse)
    {
      testStepFail("ETS_SendNotification_Subscribe_WithIPv4OptionLength0", "UDP Endpoint Option not found in message");
      return;
    } 
   
    SomeIpSetData(handle, dataLen, buffer);

    if(ETS_OutputSomeIpSDNotification(handle, sourceEndpoint, destinationEndpoint)==kFalse)
    {
      testStepFail("ETS_SendNotification_Subscribe_WithIPv4OptionLength0", "Sending of notification failed");
    }
  }
  else
  {
    testStepFail("ETS_SendNotification_Subscribe_WithIPv4OptionLength0", "Message contains no options");
    return;
  }
}

export testfunction ETS_SendNotification_Subscribe_WithEntryArrayLengthTooLong(dword sessionId, dword instanceId, dword evgId, char ttl[], char destinationIP[])
{
  const dword OFFSET_FIELD_EntryLength = 4; // payload starts with field 'flags'
  int i;
  long dataLen;
  byte buffer[1500];
  dword handle, entriesLength;
  
  IP_Endpoint sourceEndpoint, destinationEndpoint;
  if(InitEndpoint(sourceEndpoint, syspar::IpAddressTester, atol(syspar::SomeIpServiceDiscoveryPort))!=kTrue ||
     InitEndpoint(destinationEndpoint, destinationIP, atol(syspar::SomeIpServiceDiscoveryPort))!=kTrue)
  {
    testStepFail("ETS_SendNotification_Subscribe_WithEntryArrayLengthTooLong", "Creation of endpoints failed");
    return;
  }
  
  if(ETS_CreateSomeIpSDNotification(handle, sourceEndpoint.Address, syspar::SomeIp_ETS_ServiceId, syspar::Wildcard, "Subscribe",
    instanceId, syspar::Wildcard, ttl, syspar::Wildcard, sessionId, gPortForSubscribeWithoutCSI, "EventgroupID", evgId, getEndpointSelectorForEVG(evgId), kTrue)==kFalse)
  {
    testStepFail("ETS_SendNotification_Subscribe_WithEntryArrayLengthTooLong", "Creation of notification failed");
    return;
  }

  dataLen = SomeIpGetData(handle, elcount(buffer), buffer);

  entriesLength = getBigEndianDWORD(buffer, OFFSET_FIELD_EntryLength);
  setBigEndianDWORD(buffer, OFFSET_FIELD_EntryLength, entriesLength + 2000);
  
  SomeIpSetData(handle, dataLen, buffer);

  if(ETS_OutputSomeIpSDNotification(handle, sourceEndpoint, destinationEndpoint)==kFalse)
  {
    testStepFail("ETS_SendNotification_Subscribe_WithEntryArrayLengthTooLong", "Sending of notification failed");
  }
}

export testfunction ETS_SendNotification_Subscribe_WithShortenedEntriesArrayLength(dword sessionId, dword instanceId, dword evgId1, dword evgId2,char ttl[], char destinationIP[])
{
  const dword OFFSET_FIELD_EntryLength = 4; // payload starts with field 'flags'
  int i;
  long dataLen;
  byte buffer[1500];
  dword handle, entriesLength;
  
  IP_Endpoint sourceEndpoint, destinationEndpoint;
  if(InitEndpoint(sourceEndpoint, syspar::IpAddressTester, atol(syspar::SomeIpServiceDiscoveryPort))!=kTrue ||
     InitEndpoint(destinationEndpoint, destinationIP, atol(syspar::SomeIpServiceDiscoveryPort))!=kTrue)
  {
    testStepFail("ETS_SendNotification_Subscribe_WithShortenedEntriesArrayLength", "Creation of endpoints failed");
    return;
  }
  
  if(ETS_CreateSomeIpSDNotification2Entries(handle, sourceEndpoint.Address, syspar::UdpProtocol, syspar::SomeIp_ETS_ServiceId, syspar::Wildcard, "Subscribe",
    instanceId, syspar::Wildcard, ttl, syspar::Wildcard, sessionId, gPortForSubscribeWithoutCSI, "EventgroupID", evgId1, "EventgroupID", evgId2)==kFalse)
  {
    testStepFail("ETS_SendNotification_Subscribe_WithShortenedEntriesArrayLength", "Creation of notification failed");
    return;
  }

  dataLen = SomeIpGetData(handle, elcount(buffer), buffer);

  entriesLength = getBigEndianDWORD(buffer, OFFSET_FIELD_EntryLength);
  setBigEndianDWORD(buffer, OFFSET_FIELD_EntryLength, entriesLength - 5);
  
  SomeIpSetData(handle, dataLen, buffer);

  if(ETS_OutputSomeIpSDNotification(handle, sourceEndpoint, destinationEndpoint)==kFalse)
  {
    testStepFail("ETS_SendNotification_Subscribe_WithShortenedEntriesArrayLength", "Sending of notification failed");
  }
}

export testfunction ETS_SendNotification_Subscribe_WithIncrementedNbrOfOpt1(dword sessionId, dword instanceId, dword evgId, char ttl[], char destinationIP[])
{
  const dword IDX_NbrOfOpt1 = 11; // payload starts with field 'flags'
  int i;
  long dataLen;
  byte buffer[1500], nbrOfOpt1;
  dword handle;
  
  IP_Endpoint sourceEndpoint, destinationEndpoint;
  if(InitEndpoint(sourceEndpoint, syspar::IpAddressTester, atol(syspar::SomeIpServiceDiscoveryPort))!=kTrue ||
     InitEndpoint(destinationEndpoint, destinationIP, atol(syspar::SomeIpServiceDiscoveryPort))!=kTrue)
  {
    testStepFail("ETS_SendNotification_Subscribe_WithIncrementedNbrOfOpt1", "Creation of endpoints failed");
    return;
  }
  
  if(ETS_CreateSomeIpSDNotification(handle, sourceEndpoint.Address, syspar::SomeIp_ETS_ServiceId, syspar::Wildcard, "Subscribe",
    instanceId, syspar::Wildcard, ttl, syspar::Wildcard, sessionId, gPortForSubscribeWithoutCSI, "EventgroupID", evgId, getEndpointSelectorForEVG(evgId), kTrue)==kFalse)
  {
    testStepFail("ETS_SendNotification_Subscribe_WithIncrementedNbrOfOpt1", "Creation of notification failed");
    return;
  }

  dataLen = SomeIpGetData(handle, elcount(buffer), buffer);

  nbrOfOpt1 = (buffer[IDX_NbrOfOpt1] >> 4);
  nbrOfOpt1 += 1;
  buffer[IDX_NbrOfOpt1] = (nbrOfOpt1 << 4) | (buffer[IDX_NbrOfOpt1] & 0xF);
  
  SomeIpSetData(handle, dataLen, buffer);

  if(ETS_OutputSomeIpSDNotification(handle, sourceEndpoint, destinationEndpoint)==kFalse)
  {
    testStepFail("ETS_SendNotification_Subscribe_WithIncrementedNbrOfOpt1", "Sending of notification failed");
  }
}

export testfunction ETS_SendNotification_Subscribe(dword sessionId, dword instanceId, dword evgId, char destinationIP[],
  dword index1stOptions, dword index2ndOptions, dword numOfOptions1, dword numOfOptions2)
{
  dword IDX_Index1stOptions=9, IDX_Index2ndOptions=10, IDX_NbrOfOptions = 11; // payload starts with field 'flags'
  int i;
  long dataLen;
  byte buffer[1500], nbrOfOpt1;
  dword handle;
  
  IP_Endpoint sourceEndpoint, destinationEndpoint;
  if(InitEndpoint(sourceEndpoint, syspar::IpAddressTester, atol(syspar::SomeIpServiceDiscoveryPort))!=kTrue ||
     InitEndpoint(destinationEndpoint, destinationIP, atol(syspar::SomeIpServiceDiscoveryPort))!=kTrue)
  {
    testStepFail("ETS_SendNotification_Subscribe", "Creation of endpoints failed");
    return;
  }
  
  if(ETS_CreateSomeIpSDNotification(handle, sourceEndpoint.Address, syspar::SomeIp_ETS_ServiceId, syspar::Wildcard, "Subscribe",
    instanceId, syspar::Wildcard, syspar::SomeIp_ETS_Subscribe_TTL, syspar::Wildcard, sessionId, gPortForSubscribeWithoutCSI, "EventgroupID", evgId,
    getEndpointSelectorForEVG(evgId), kTrue)==kFalse)
  {
    testStepFail("ETS_SendNotification_Subscribe", "Creation of notification failed");
    return;
  }

  dataLen = SomeIpGetData(handle, elcount(buffer), buffer);

  buffer[IDX_Index1stOptions] = (index1stOptions & 0xFF);
  buffer[IDX_Index2ndOptions] = (index2ndOptions & 0xFF);
  buffer[IDX_NbrOfOptions] = ((numOfOptions1 & 0xF) << 4) | (numOfOptions2 & 0xF);
  
  SomeIpSetData(handle, dataLen, buffer);

  if(ETS_OutputSomeIpSDNotification(handle, sourceEndpoint, destinationEndpoint)==kFalse)
  {
    testStepFail("ETS_SendNotification_Subscribe", "Sending of notification failed");
  }
}

export testfunction ETS_SendNotification_Subscribe_WithInvalidOptionType(dword sessionId, dword instanceId, dword evgId, char destinationIP[])
{
  const dword OFFSET_FIELD_EntryLength = 4; // payload starts with field 'flags'
  const dword SIZE_FIELD_LengthOfEntriesArray = 4;
  const dword SIZE_FIELD_LengthOfOptionsArray = 4;
  const dword SIZE_FIELD_OptionLength = 2;
  int i;
  long dataLen;
  byte buffer[1500];
  dword handle, entriesLength, offsetOfFieldOptionType;
  
  IP_Endpoint sourceEndpoint, destinationEndpoint;
  if(InitEndpoint(sourceEndpoint, syspar::IpAddressTester, atol(syspar::SomeIpServiceDiscoveryPort))!=kTrue ||
     InitEndpoint(destinationEndpoint, destinationIP, atol(syspar::SomeIpServiceDiscoveryPort))!=kTrue)
  {
    testStepFail("Creation of endpoints failed");
    return;
  }
  
  if(ETS_CreateSomeIpSDNotification(handle, sourceEndpoint.Address, syspar::SomeIp_ETS_ServiceId, syspar::Wildcard, "Subscribe",
    instanceId, syspar::Wildcard, syspar::SomeIp_ETS_Subscribe_TTL, syspar::Wildcard, sessionId, gPortForSubscribeWithoutCSI, "EventgroupID", evgId,
    getEndpointSelectorForEVG(evgId), kTrue)==kFalse)
  {
    testStepFail("ETS_SendNotification_Subscribe_WithInvalidOptionType", "Creation of notification failed");
    return;
  }

  dataLen = SomeIpGetData(handle, elcount(buffer), buffer);

  entriesLength = getBigEndianDWORD(buffer, OFFSET_FIELD_EntryLength);

  offsetOfFieldOptionType = OFFSET_FIELD_EntryLength + SIZE_FIELD_LengthOfEntriesArray +
    entriesLength + SIZE_FIELD_LengthOfOptionsArray + SIZE_FIELD_OptionLength;
  buffer[offsetOfFieldOptionType] = 0x77;
  
  SomeIpSetData(handle, dataLen, buffer);

  if(ETS_OutputSomeIpSDNotification(handle, sourceEndpoint, destinationEndpoint)==kFalse)
  {
    testStepFail("ETS_SendNotification_Subscribe_WithInvalidOptionType", "Sending of notification failed");
  }
}

export testfunction ETS_SendNotification_Subscribe_WithUnreferencedOption(dword sessionId, dword instanceId, char destinationIP[])
{
  dword OPTION_FIELD_TYPE_OFFSET = 2, OPTION_FIELD_RESERVED_OFFSET=3, OPTION_FIELD_VALUE_OFFSET = 4, SIZE_FIELD_LengthOfOptionsArray = 4;
  byte OPTION_TYPE_CONFIGURATION = 0x01;
  dword evgId=2; 
  char cfgStr[6] = "abc=5";
  dword optionArrayLengthIndex, optionsLen, indexOfAppendedOption, addedSize;

  long payloadLen;
  byte payload[1500];
  dword handle;
  
  IP_Endpoint sourceEndpoint, destinationEndpoint;
  if(InitEndpoint(sourceEndpoint, syspar::IpAddressTester, atol(syspar::SomeIpServiceDiscoveryPort))!=kTrue ||
     InitEndpoint(destinationEndpoint, destinationIP, atol(syspar::SomeIpServiceDiscoveryPort))!=kTrue)
  {
    testStepFail("Creation of endpoints failed");
    return;
  }
  
  addedSize = OPTION_FIELD_VALUE_OFFSET + strlen(cfgStr) + 1;
  
  if(ETS_CreateSomeIpSDNotification(handle, sourceEndpoint.Address, syspar::SomeIp_ETS_ServiceId, syspar::Wildcard, "Subscribe",
    instanceId, syspar::Wildcard, syspar::SomeIp_ETS_Subscribe_TTL, syspar::Wildcard, sessionId, gPortForSubscribeWithoutCSI, "EventgroupID", evgId,
    getEndpointSelectorForEVG(evgId), kTrue)==kFalse)
  {
    testStepFail("ETS_SendNotification_Subscribe_WithUnreferencedOption", "Creation of notification failed");
    return;
  }  
  
  payloadLen = SomeIpGetData(handle, elcount(payload), payload);

  if(getIndexOfOptionsArrayLength(payload, payloadLen, optionArrayLengthIndex, optionsLen)==kFalse)
  {
    testStepFail("ETS_SendNotification_Subscribe_WithUnreferencedOption", "Failed to patch payload");
    return;
  }
  indexOfAppendedOption = optionArrayLengthIndex + optionsLen + SIZE_FIELD_LengthOfOptionsArray;
  // append a configuration option
  setBigEndianWORD(payload, indexOfAppendedOption, 1 + strlen(cfgStr) + 1);                              // length
  payload[indexOfAppendedOption + OPTION_FIELD_TYPE_OFFSET] = OPTION_TYPE_CONFIGURATION;                 // type
  payload[indexOfAppendedOption + OPTION_FIELD_RESERVED_OFFSET] = 0x00;                                  // reserved
  memcpy_off(payload, indexOfAppendedOption + OPTION_FIELD_VALUE_OFFSET, cfgStr, 0, strlen(cfgStr) + 1); // value
  // correct the length of the options array
  setBigEndianDWORD(payload, optionArrayLengthIndex, optionsLen + addedSize);
  
  SomeIpSetData(handle, payloadLen + addedSize, payload);

  if(ETS_OutputSomeIpSDNotification(handle, sourceEndpoint, destinationEndpoint)==kFalse)
  {
    testStepFail("ETS_SendNotification_Subscribe_WithUnreferencedOption", "Sending of notification failed");
  }
}

export testfunction ETS_SendNotification_Subscribe_WithUnusedOptionData(dword sessionId, dword instanceId, char destinationIP[], enum Bool correctLength)
{
  dword HEADER_FIELD_LENGTH_OFFSET = 4, HEADER_FIELD_OPTION_ARRAY_LENGTH_OFFSET = 40, HEADER_FIELD_MESSAGE_ID_LENGTH = 4, HEADER_FIELD_LENGTH_LENGTH = 4;
  byte extraPayload[5] = { 0x30, 0x30 , 0x3a, 0x30, 0x31 };
  dword addedPayloadSize = 5; // elcount(extraPayload);
  dword evgId = 2;
  byte messageBuffer[1600];
  dword messageLength, lengthValue;
  dword msgHandle;
  dword handle;
  
  IP_Endpoint sourceEndpoint, destinationEndpoint;
  if(InitEndpoint(sourceEndpoint, syspar::IpAddressTester, atol(syspar::SomeIpServiceDiscoveryPort))!=kTrue ||
     InitEndpoint(destinationEndpoint, destinationIP, atol(syspar::SomeIpServiceDiscoveryPort))!=kTrue)
  {
    testStepFail("Creation of endpoints failed");
    return;
  }
  
  if(ETS_CreateSomeIpSDNotification(handle, sourceEndpoint.Address, syspar::SomeIp_ETS_ServiceId, syspar::Wildcard, "Subscribe",
      instanceId, syspar::Wildcard, syspar::SomeIp_ETS_Subscribe_TTL, syspar::Wildcard, sessionId, gPortForSubscribeWithoutCSI, "EventgroupID", evgId,
      getEndpointSelectorForEVG(evgId), kTrue)==kFalse)
  {
    testStepFail("ETS_SendNotification_Subscribe_WithUnusedOptionData", "Creation of notification failed");
    if(handle)
      SomeIpReleaseMessage(handle);
    return;
  }

  messageLength = SomeIpSerializeMessage(handle, elCount(messageBuffer), messageBuffer);
  
  memcpy_off(messageBuffer, messageLength, extraPayload, 0, addedPayloadSize);
  messageLength += addedPayloadSize;
  
  if(correctLength)
  {
    lengthValue = getBigEndianDWORD(messageBuffer, HEADER_FIELD_LENGTH_OFFSET);
    setBigEndianDWORD(messageBuffer, HEADER_FIELD_LENGTH_OFFSET, lengthValue + addedPayloadSize);
  }
  
  msgHandle = SomeIpCreateMessage(messageLength, messageBuffer);
  //SomeIpOutputMessage(gClientServiceAepHandleUDP, ipGetAddressAsNumber(destinationIP), atol(syspar::SomeIpServiceDiscoveryPort), msgHandle);
  InitEndpoint(destinationEndpoint, destinationIP, atol(syspar::SomeIpServiceDiscoveryPort));
  SomeIpOutputMessage(gClientServiceAepHandleUDP, destinationEndpoint, msgHandle);

  SomeIpReleaseMessage(handle);

}

export testfunction ETS_SendNotification_Subscribe_WithWrongMessageID(dword sessionId, dword instanceId, char destinationIP[])
{
  dword evgId = 2;
  byte messageBuffer[1600];
  dword messageLength, lengthValue;
  dword msgHandle;
  dword handle;
  
  IP_Endpoint sourceEndpoint, destinationEndpoint;
  if(InitEndpoint(sourceEndpoint, syspar::IpAddressTester, atol(syspar::SomeIpServiceDiscoveryPort))!=kTrue ||
     InitEndpoint(destinationEndpoint, destinationIP, atol(syspar::SomeIpServiceDiscoveryPort))!=kTrue)
  {
    testStepFail("Creation of endpoints failed");
    return;
  }
  
  if(ETS_CreateSomeIpSDNotification(handle, sourceEndpoint.Address, syspar::SomeIp_ETS_ServiceId, syspar::Wildcard, "Subscribe",
      instanceId, syspar::Wildcard, syspar::SomeIp_ETS_Subscribe_TTL, syspar::Wildcard, sessionId, gPortForSubscribeWithoutCSI, "EventgroupID", evgId,
      getEndpointSelectorForEVG(evgId), kTrue)==kFalse)
  {
    testStepFail("ETS_SendNotification_Subscribe_WithUnusedOptionData", "Creation of notification failed");
    if(handle)
      SomeIpReleaseMessage(handle);
    return;
  }

  messageLength = SomeIpSerializeMessage(handle, elCount(messageBuffer), messageBuffer);
  setBigEndianDWORD(messageBuffer, 0 , 0xFFEE8100); 
  
  msgHandle = SomeIpCreateMessage(messageLength, messageBuffer);
  //SomeIpOutputMessage(gClientServiceAepHandleUDP, ipGetAddressAsNumber(destinationIP), atol(syspar::SomeIpServiceDiscoveryPort), msgHandle);
  InitEndpoint(destinationEndpoint, destinationIP, atol(syspar::SomeIpServiceDiscoveryPort));
  SomeIpOutputMessage(gClientServiceAepHandleUDP, destinationEndpoint, msgHandle);
  
  SomeIpReleaseMessage(handle);

}


export testfunction ETS_SendNotification_Subscribe_WithInvalidL4Proto(dword sessionId, dword instanceId, dword evgId, char ttl[], char destinationIP[])
{
  const dword OFFSET_FIELD_EntryLength = 4; // payload starts with field 'flags'
  const dword SIZE_FIELD_LengthOfEntriesArray = 4;
  const dword SIZE_FIELD_LengthOfOptionsArray = 4;
  const dword REL_OFFSET_FIELD_L4Proto = 9;
  int i;
  long dataLen;
  byte buffer[1500];
  dword handle, entriesLength, offsetOfFieldL4Proto;
  
  IP_Endpoint sourceEndpoint, destinationEndpoint;
  if(InitEndpoint(sourceEndpoint, syspar::IpAddressTester, atol(syspar::SomeIpServiceDiscoveryPort))!=kTrue ||
     InitEndpoint(destinationEndpoint, destinationIP, atol(syspar::SomeIpServiceDiscoveryPort))!=kTrue)
  {
    testStepFail("Creation of endpoints failed");
    return;
  }
  
  if(ETS_CreateSomeIpSDNotification(handle, sourceEndpoint.Address, syspar::SomeIp_ETS_ServiceId, syspar::Wildcard, "Subscribe",
    instanceId, syspar::Wildcard, ttl, syspar::Wildcard, sessionId, gPortForSubscribeWithoutCSI, "EventgroupID", evgId, getEndpointSelectorForEVG(evgId), kTrue)==kFalse)
  {
    testStepFail("ETS_SendNotification_Subscribe_WithInvalidL4Proto", "Creation of notification failed");
    return;
  }

  dataLen = SomeIpGetData(handle, elcount(buffer), buffer);

  entriesLength = getBigEndianDWORD(buffer, OFFSET_FIELD_EntryLength);

  offsetOfFieldL4Proto = OFFSET_FIELD_EntryLength + SIZE_FIELD_LengthOfEntriesArray +
    entriesLength + SIZE_FIELD_LengthOfOptionsArray + REL_OFFSET_FIELD_L4Proto;
  buffer[offsetOfFieldL4Proto] = 0x00;
  
  SomeIpSetData(handle, dataLen, buffer);

  if(ETS_OutputSomeIpSDNotification(handle, sourceEndpoint, destinationEndpoint)==kFalse)
  {
    testStepFail("ETS_SendNotification_Subscribe_WithInvalidL4Proto", "Sending of notification failed");
  }
}

export testfunction ETS_SendNotification_Subscribe_WithoutEndpoints(dword sessionId, dword instanceId, dword evgId, char ttl[], char destinationIP[])
{
  ETS_SendSomeIpSDNotification("ETS_SendNotification_Subscribe_WithoutEndpoints", destinationIP, syspar::SomeIp_ETS_ServiceId, syspar::Wildcard, "Subscribe",
    instanceId, syspar::Wildcard, ttl, syspar::Wildcard, sessionId, gPortForSubscribeWithoutCSI, "EventgroupID", evgId, Without_Endpoints);
}

export testfunction ETS_SendNotification_Subscribe_WithDuplicatedEndpoint(dword sessionId, dword instanceId, dword evgId, char ttl[], char destinationIP[])
{
  ETS_SendSomeIpSDNotification("ETS_SendNotification_Subscribe_WithDuplicatedEndpoint", destinationIP, syspar::SomeIp_ETS_ServiceId, syspar::Wildcard, "Subscribe",
    instanceId, syspar::Wildcard, ttl, syspar::Wildcard, sessionId, gPortForSubscribeWithoutCSI, "EventgroupID", evgId, UDP_Endpoint_Twice);
}

/*
  Sends two subscribe notifications (unsubscribe and subscribe) as one message
void ETS_PostSomeIpSDNotification(char callerFunctionName[],
  char srcIp[], char destIp[], int protocol, int serviceId,
  char flags[], char entryType[], word instanceId,
  char majorVersion[], char ttl[], char minorVersion[],
  word sessionId, dword udpPort,
  char additionalEntryFieldName[], dword additionalEntryFieldValue,
  enum EndpointSelector endpointSelector, enum Bool withEntry
  )
*/
export testfunction ETS_SendNotification_ResubscribeAsOneMessage(dword sessionId, dword instanceId, dword evgId, char ttl[], char destinationIP[])
{
  ETS_PostSomeIpSDNotification("ETS_SendNotification_Resubscribe", syspar::IpAddressTester, destinationIP, syspar::UdpProtocol, syspar::SomeIp_ETS_ServiceId, syspar::Wildcard, "Subscribe",
    instanceId, syspar::Wildcard, "0", syspar::Wildcard, sessionId, gPortForSubscribeWithoutCSI, "EventgroupID", evgId, getEndpointSelectorForEVG(evgId), kTrue);
  ETS_PostSomeIpSDNotification("ETS_SendNotification_Resubscribe", syspar::IpAddressTester, destinationIP, syspar::UdpProtocol, syspar::SomeIp_ETS_ServiceId, syspar::Wildcard, "Subscribe",
    instanceId, syspar::Wildcard, ttl, syspar::Wildcard, sessionId+1, gPortForSubscribeWithoutCSI, "EventgroupID", evgId, getEndpointSelectorForEVG(evgId), kTrue);
}

export testfunction ETS_SendNotification_StopSubscribe(dword sessionId, dword instanceId, dword evgId, char destinationIP[])
{
  ETS_SendSomeIpSDNotification("ETS_SendNotification_StopSubscribe", destinationIP, syspar::SomeIp_ETS_ServiceId, syspar::Wildcard, "Subscribe",
    instanceId, syspar::Wildcard, "0", syspar::Wildcard, sessionId, gPortForSubscribeWithoutCSI, "EventgroupID", evgId, getEndpointSelectorForEVG(evgId));
}


enum Bool WaitForOfferGetSessionId(long timeout, char instanceIdStr[], long & sessionId)
{
  if(ETS_InternalWaitForSOMEIPNotification("ETS_WaitForNotification_OfferService",
       timeout, SomeIpMessageTypeNotification, OfferService,
       syspar::SomeIp_ETS_ServiceId, // entryServiceId
       syspar::Wildcard, // entryTTL
       syspar::Wildcard, // serviceId
       syspar::Wildcard, // returnCode
       syspar::Wildcard, // methodId
       "Entry[0].OfferService.InstanceID", instanceIdStr, kEquals, // first token
       syspar::Wildcard, syspar::Wildcard, kEquals, // second token
       syspar::UdpProtocol,
       "SessionId", // extractSomeIpToken
       kAnswerExpected
      )==kFalse)
    return kFalse;
  
  sessionId = gExtractingParameters[0].Value;
  return kTrue;
}

export testfunction ETS_WaitForNotifications_OfferService_CheckIncreasingSessionId(long timeout, dword instanceId, dword countOffersToCheck)
{
  long lastSessionId, currentSessionId;
  dword i;
  char instanceIdStr[16];
  snprintf(instanceIdStr, elcount(instanceIdStr), "%d", instanceId);

  if(WaitForOfferGetSessionId(timeout, instanceIdStr, lastSessionId)==kFalse)
    return;

  i=1;
  while(i<countOffersToCheck)
  {
    if(WaitForOfferGetSessionId(timeout, instanceIdStr, currentSessionId)==kFalse)
      return;

    if(lastSessionId>=currentSessionId)
    {
      testStepFail("ETS_WaitForNotification_OfferService_CheckSessionId", "SessionId did not increase, OfferService[%d]: %d, OfferSercice[%d]: %d", i-1, lastSessionId, i, currentSessionId);
      return;
    }
    ++i;
  }
  
  testStepPass("ETS_WaitForNotification_OfferService_CheckSessionId", "SessionIds did increase");
}

export testfunction ETS_WaitForNotifications_ForAllFieldsOfEvg5(long timeout, dword instanceId, enum Bool answerExpected)
{
  dword allFieldIds[3] = {FIELD_ID_InterfaceVersion, FIELD_ID_TestFieldUINT8, FIELD_ID_TestFieldUINT8Array};
  ETS_InternalWaitForNotificationWithMethodIds("ETS_WaitForNotifications_ForAllFieldOfEvg5", timeout, instanceId, allFieldIds, elcount(allFieldIds), answerExpected);
}

export testfunction ETS_WaitForNotifications_ForAllFieldsOfEvg5_OtherDestIP(long timeout, dword instanceId, enum Bool answerExpected, char destIp[])
{
  dword allFieldIds[3] = {FIELD_ID_InterfaceVersion, FIELD_ID_TestFieldUINT8, FIELD_ID_TestFieldUINT8Array};
  gObserveSomeIpMessageForOtherIp = kTrue;
  gObserveSomeIpMessageForOtherIp_Address.ParseAddressFromString(destIp);
  ETS_InternalWaitForNotificationWithMethodIds("ETS_WaitForNotifications_ForAllFieldsOfEvg5_OtherDestIP", timeout, instanceId, allFieldIds, elcount(allFieldIds), answerExpected);
  gObserveSomeIpMessageForOtherIp=kFalse;
}

export testfunction ETS_WaitForNotification_Event_TestEventUINT8(long timeout, dword instanceId, enum Bool answerExpected)
{
  ETS_InternalWaitForNotificationWithMethodId("ETS_WaitForNotification_Event_TestEventUINT8", timeout, instanceId, EVENT_ID_TestEventUINT8, answerExpected);
}

export testfunction ETS_WaitForNotification_FieldInterfaceVersion(long timeout, dword instanceId, enum Bool answerExpected)
{
  ETS_InternalWaitForNotificationWithMethodId("ETS_WaitForNotification_FieldInterfaceVersion", timeout, instanceId, FIELD_ID_InterfaceVersion, answerExpected);
}

export testfunction ETS_WaitForNotification_OfferService(long timeout, dword instanceId)
{
  char instanceIdStr[16];
  snprintf(instanceIdStr, elcount(instanceIdStr), "%d", instanceId);
  ETS_InternalWaitForSOMEIPNotification("ETS_WaitForNotification_OfferService",
    timeout,
    SomeIpMessageTypeNotification,
    OfferService,
    syspar::SomeIp_ETS_ServiceId, // entryServiceId
    syspar::Wildcard, // entryTTL
    syspar::Wildcard, // serviceId
    syspar::Wildcard, // returnCode
    syspar::Wildcard, // methodId
    "Entry[0].OfferService.InstanceID", instanceIdStr, kEquals, // first token
    syspar::Wildcard, syspar::Wildcard, kEquals, // second token
    syspar::UdpProtocol, syspar::Wildcard,
    kAnswerExpected
  );
}

export testfunction ETS_WaitForNotification_OfferService(long timeout, dword instanceId, char destIp[])
{
  char instanceIdStr[16];
  snprintf(instanceIdStr, elcount(instanceIdStr), "%d", instanceId);
  ETS_InternalWaitForSOMEIPNotification("ETS_WaitForNotification_OfferService",
    timeout,
    SomeIpMessageTypeNotification,
    OfferService,
    syspar::SomeIp_ETS_ServiceId, // entryServiceId
    syspar::Wildcard, // entryTTL
    syspar::Wildcard, // serviceId
    syspar::Wildcard, // returnCode
    syspar::Wildcard, // methodId
    "Entry[0].OfferService.InstanceID", instanceIdStr, kEquals, // first token
    "DestinationAddress", destIp, kEquals, // second token
    syspar::UdpProtocol, syspar::Wildcard,
    kAnswerExpected
  );
}

export testfunction ETS_WaitForNotification_FindService(long timeout, dword instanceId, enum Bool answerExpected)
{
  char instanceIdStr[16];
  snprintf(instanceIdStr, elcount(instanceIdStr), "%d", instanceId);
  ETS_InternalWaitForSOMEIPNotification("ETS_WaitForNotification_OfferService",
    timeout,
    SomeIpMessageTypeNotification,
    FindService,
    syspar::SomeIp_ETS_ServiceId, // entryServiceId
    syspar::Wildcard, // entryTTL
    syspar::Wildcard, // serviceId
    syspar::Wildcard, // returnCode
    syspar::Wildcard, // methodId
    "Entry[0].FindService.InstanceID", instanceIdStr, kEquals, // first token
    syspar::Wildcard, syspar::Wildcard, kEquals, // second token
    syspar::UdpProtocol, syspar::Wildcard,
    (answerExpected==kFalse) ? kNoAnswerExpected : kAnswerExpected
  );
}

enum Bool ETS_waitForTCP(char sourceIP[], char destIP[], dword flags, enum CheckType check )
{
  long waitResult;
  
  SetBusContext(GetBusNameContext("Ethernet_1"));
  //PrepareWaitForIp(destIP, sourceIP, PROTOCOL_TCP);
  PrepareWaitForIp(destIP, sourceIP);
  InternalAddExpectedParameter("tcp", "flags", flags, check);

  gObservingEthPackets = kTrue;
  StartObservationOfIncomingPackets(kAnswerExpected);
  waitResult = WaitForIncomingPacket(kAnswerExpected, 150);
  gObservingEthPackets = kFalse;  
  InternalClearAllParameters();
  
  if(waitResult != 0)
    return kFalse;
   
  return kTrue;
}

export testfunction ETS_WaitFor_SYN(char sourceIP[], char destIP[])
{
  if(ETS_waitForTCP(sourceIP, destIP, TcpFlagSyn, kEquals)==kTrue)
    testStepPass("ETS_WaitFor_SYN", "SYN packet recognized");
  else
    testStepFail("ETS_WaitFor_SYN", "SYN packet not recognized");
}

export testfunction ETS_WaitFor_RSTACK(char sourceIP[], char destIP[])
{
  if(ETS_waitForTCP(sourceIP, destIP, TcpFlagRstAck, kEquals)==kTrue)
    testStepPass("ETS_WaitFor_SYN", "RSTACK packet recognized");
  else
    testStepFail("ETS_WaitFor_SYN", "RSTACK packet not recognized");
}

export testfunction ETS_WaitForUnexpectedNotification(long timeout, dword instanceId, char destinationIP[])
{
  char instanceIdStr[16];
  snprintf(instanceIdStr, elcount(instanceIdStr), "%d", instanceId);
  ETS_InternalWaitForSOMEIPNotification("ETS_WaitForUnexpectedNotification",
    timeout,
    SomeIpMessageTypeNotification,
    SomeIpEntryNull,
    syspar::SomeIp_ETS_ServiceId, // entryServiceId
    syspar::Wildcard, // entryTTL
    syspar::Wildcard, // serviceId
    syspar::Wildcard, // returnCode
    syspar::Wildcard, // methodId
    "DestinationAddress", destinationIP, kEquals, // first token
    syspar::Wildcard, syspar::Wildcard, kEquals, // second token
    syspar::UdpProtocol, syspar::Wildcard,
    kNoAnswerExpected
  );
}

export testfunction ETS_WaitForNotification_Subscribe(long timeout, char instanceIdStr[], char destinationIP[], enum Bool answerExpected)
{
  ETS_InternalWaitForSOMEIPNotification("ETS_WaitForNotification_Subscribe",
    timeout,
    SomeIpMessageTypeNotification,
    Subscribe,
    syspar::SomeIp_ETS_ServiceId, // entryServiceId
    syspar::Wildcard, // entryTTL
    syspar::Wildcard, // serviceId
    syspar::Wildcard, // returnCode
    syspar::Wildcard, // methodId
    "Entry[0].Subscribe.InstanceID", instanceIdStr, kEquals, // first token
    "DestinationAddress", destinationIP, kEquals, // second token
    syspar::UdpProtocol, syspar::Wildcard,
    (answerExpected==kFalse) ? kNoAnswerExpected : kAnswerExpected
  );
}

export testfunction ETS_WaitForNotification_Subscribe(long timeout, dword instanceId, char destinationIP[], enum Bool answerExpected)
{
  char instanceIdStr[16];
  snprintf(instanceIdStr, elcount(instanceIdStr), "%d", instanceId);
  ETS_WaitForNotification_Subscribe(timeout, instanceIdStr, destinationIP, answerExpected);
}

export testfunction ETS_WaitForNotification_Subscribe(long timeout, dword instanceId, char destinationIP[])
{
  char instanceIdStr[16];
  snprintf(instanceIdStr, elcount(instanceIdStr), "%d", instanceId);
  ETS_InternalWaitForSOMEIPNotification("ETS_WaitForNotification_Subscribe",
    timeout,
    SomeIpMessageTypeNotification,
    Subscribe,
    syspar::SomeIp_ETS_ServiceId, // entryServiceId
    syspar::Wildcard, // entryTTL
    syspar::Wildcard, // serviceId
    syspar::Wildcard, // returnCode
    syspar::Wildcard, // methodId
    "Entry[0].Subscribe.InstanceID", instanceIdStr, kEquals, // first token
    "DestinationAddress", destinationIP, kEquals, // second token
    syspar::UdpProtocol, syspar::Wildcard,
    kAnswerExpected
  );
}

export testfunction ETS_WaitForNotification_Subscribe_ExtractPort(long timeout, dword instanceId, char destinationIP[])
{
  char instanceIdStr[16];
  snprintf(instanceIdStr, elcount(instanceIdStr), "%d", instanceId);
  ETS_InternalWaitForSOMEIPNotification("ETS_WaitForNotification_Subscribe",
    timeout,
    SomeIpMessageTypeNotification,
    Subscribe,
    syspar::SomeIp_ETS_ServiceId, // entryServiceId
    syspar::Wildcard, // entryTTL
    syspar::Wildcard, // serviceId
    syspar::Wildcard, // returnCode
    syspar::Wildcard, // methodId
    "Entry[0].Subscribe.InstanceID", instanceIdStr, kEquals, // first token
    "DestinationAddress", destinationIP, kEquals, // second token
    syspar::UdpProtocol, "Option[0].IPv4Endpoint.PortNumber",
    kAnswerExpected
  );
  gExtractedPort = gExtractingParameters[0].Value;
}

export testfunction ETS_WaitForNotification_Unsubscribe(long timeout, dword instanceId, char destinationIP[])
{
  char instanceIdStr[16];
  snprintf(instanceIdStr, elcount(instanceIdStr), "%d", instanceId);
  ETS_InternalWaitForSOMEIPNotification("ETS_WaitForNotification_Unsubscribe",
    timeout,
    SomeIpMessageTypeNotification,
    Subscribe,
    syspar::SomeIp_ETS_ServiceId, // entryServiceId
    "0", // entryTTL
    syspar::Wildcard, // serviceId
    syspar::Wildcard, // returnCode
    syspar::Wildcard, // methodId
    "Entry[0].Subscribe.InstanceID", instanceIdStr, kEquals, // first token
    "DestinationAddress", destinationIP, kEquals, // second token
    syspar::UdpProtocol, syspar::Wildcard,
    kAnswerExpected
  );
}

export testfunction ETS_WaitForNotification_SubscribeAck(long timeout, dword instanceId, char destinationIP[], enum Bool answereExpected)
{
  char instanceIdStr[16];
  snprintf(instanceIdStr, elcount(instanceIdStr), "%d", instanceId);
  ETS_InternalWaitForSOMEIPNotification("ETS_WaitForNotification_SubscribeAck",
    timeout,
    SomeIpMessageTypeNotification,
    SubscribeAck,
    syspar::SomeIp_ETS_ServiceId, // entryServiceId
    syspar::Wildcard, // entryTTL
    syspar::Wildcard, // serviceId
    syspar::Wildcard, // returnCode
    syspar::Wildcard, // methodId
    "Entry[0].SubscribeAck.InstanceID", instanceIdStr, kEquals, // first token
    "DestinationAddress", destinationIP, kEquals, // second token
    syspar::UdpProtocol, syspar::Wildcard,
    answereExpected ? kAnswerExpected : kNoAnswerExpected
  );
}

export testfunction ETS_WaitForNotification_SubscribeAck(long timeout, dword instanceId, char destinationIP[])
{
  ETS_WaitForNotification_SubscribeAck(timeout, instanceId, destinationIP, kTrue);
}

export testfunction ETS_WaitForNotification_SubscribeNAck(long timeout, dword instanceId, char destinationIP[])
{
  char instanceIdStr[16];
  snprintf(instanceIdStr, elcount(instanceIdStr), "%d", instanceId);
  ETS_InternalWaitForSOMEIPNotification("ETS_WaitForNotification_SubscribeAck",
    timeout,
    SomeIpMessageTypeNotification,
    SubscribeAck,
    syspar::SomeIp_ETS_ServiceId, // entryServiceId
    "0", // entryTTL
    syspar::Wildcard, // serviceId
    syspar::Wildcard, // returnCode
    syspar::Wildcard, // methodId
    "Entry[0].SubscribeAck.InstanceID", instanceIdStr, kEquals, // first token
    "DestinationAddress", destinationIP, kEquals, // second token
    syspar::UdpProtocol, syspar::Wildcard,
    kAnswerExpected
  );
}

export testfunction ETS_WaitForNotification_SubscribeNAck(long timeout, dword serviceId, dword instanceId, char majorVersion[], char destinationIP[])
{
  char instanceIdStr[16];
  snprintf(instanceIdStr, elcount(instanceIdStr), "%d", instanceId);
  ETS_InternalWaitForSOMEIPNotification("ETS_WaitForNotification_SubscribeAck",
    timeout,
    SomeIpMessageTypeNotification,
    SubscribeAck,
    serviceId,
    "0", // entryTTL
    syspar::Wildcard, // serviceId
    syspar::Wildcard, // returnCode
    syspar::Wildcard, // methodId
    "Entry[0].SubscribeAck.InstanceID", instanceIdStr, kEquals, // first token
    "DestinationAddress", destinationIP, kEquals, // second token
    "Entry[0].SubscribeAck.MajorVersion", majorVersion, kEquals, // third token
    syspar::UdpProtocol, syspar::Wildcard,
    kAnswerExpected
  );
}

void OnSomeIpEstablishedTCPConnection(IP_Endpoint localIPEndpoint, IP_Endpoint remoteIPEndpoint)
{
  char localEndpointStr[128], remoteEndpointStr[128];
  localIPEndpoint.PrintEndpointToString(localEndpointStr);
  remoteIPEndpoint.PrintEndpointToString(remoteEndpointStr);
  //writeEx(-3,1,"### EstablishedTCPConnection lep: %s, rep: %s, at %.5f", localEndpointStr, remoteEndpointStr, timeNowFloat()/100000.0);
  
  if(gWaitingForNewTCPConnectionState==kTrue)
  {
    if(gWaitingForTCPConnectionState==kTCPConnectionReestablished)
    {
      gReestablishedEstablished=kTrue;
      testStepPass("ETS_WaitForNewTCPConnectionState", "TCP connection has been established.");
      if(gReestablishedClosed)
      {
        gLocalEndpointOfEstablishedConnection = localIPEndpoint;
        setTimer(gWaitConditionReachedTimer, 0);  // both wait conditions reached
      }
    }
    else if(gWaitingForTCPConnectionState==kTCPConnectionEstablished)
    {
      gLocalEndpointOfEstablishedConnection = localIPEndpoint;
      setTimer(gWaitConditionReachedTimer, 0);
    }
  }
}

void OnSomeIpClosedTCPConnection(IP_Endpoint localIPEndpoint, IP_Endpoint remoteIPEndpoint)
{
  //char localEndpointStr[128], remoteEndpointStr[128];
  //localIPEndpoint.PrintEndpointToString(localEndpointStr);
  //remoteIPEndpoint.PrintEndpointToString(remoteEndpointStr);
  //write("### ClosedTCPConnection lep: %s, rep: %s, at %.5f", localEndpointStr, remoteEndpointStr, timeNowFloat()/100000.0);

  if(gWaitingForNewTCPConnectionState==kTrue && gWaitingForTCPConnectionState==kTCPConnectionClosed)
    setTimer(gWaitConditionReachedTimer, 0);    
  if(gWaitingForNewTCPConnectionState==kTrue)
  {
    if(gWaitingForTCPConnectionState==kTCPConnectionReestablished)
    {
      gReestablishedClosed=kTrue;
      testStepPass("ETS_WaitForNewTCPConnectionState", "TCP connection has been closed.");
      if(gReestablishedEstablished)
        setTimer(gWaitConditionReachedTimer, 0);  // both wait conditions reached
    }
    else if(gWaitingForTCPConnectionState==kTCPConnectionClosed)
      setTimer(gWaitConditionReachedTimer, 0);
  }
}

enum Bool WaitFor_NewTCPConnectionState(dword timeoutMs, enum TCPConnectionState state)
{
  long result;
  gWaitingForTCPConnectionState=state;
  gReestablishedEstablished = gReestablishedClosed = kFalse;
  gWaitingForNewTCPConnectionState=kTrue; 
  result = testWaitForTextEvent("ETSAllWaitNotificationsReached", timeoutMs);
  gWaitingForNewTCPConnectionState=kFalse;
  if(result==1)
    return kTrue;
  else
    return kFalse;
}

export testfunction ETS_WaitFor_NewTCPConnectionState(dword timeoutMs, enum TCPConnectionState state)
{
  char messagesOk[3][64]  = { "TCP connection has been established.",     "TCP connection has been closed.", "TCP connection has been reestablished."};
  char messagesNOk[3][64] = { "TCP connection has not been established.", "TCP connection has not been closed", "TCP connection has not been reestablished." };

  if(WaitFor_NewTCPConnectionState(timeoutMs, state)==kTrue)
    testStepPass("ETS_WaitFor_NewTCPConnectionState", messagesOk[state]);
  else
    testStepFail("ETS_WaitFor_NewTCPConnectionState", messagesNOk[state]);
}

void ETS_SendSomeIpSDNotification(char callerFunctionName[],
  char destIp[], int serviceId, char flags[],
  char entryType[], word instanceId, char majorVersion[],
  char ttl[], char minorVersion[], word sessionId, dword portNumber,
  char additionalEntryFieldName[], dword additionalEntryFieldValue,
  enum EndpointSelector endpointSelector)
{
  ETS_SendSomeIpSDNotification(callerFunctionName, syspar::IpAddressTester, destIp, serviceId, flags, entryType,
    instanceId, majorVersion, ttl, minorVersion, sessionId, portNumber, additionalEntryFieldName, additionalEntryFieldValue,
    endpointSelector, kTrue);
}

enum Bool ETS_CreateSomeIpSDNotification(
  dword & handle,
  IP_Address sourceIpAddress,
  int serviceId,
  char flags[],
  char entryType[],
  word instanceId,
  char majorVersion[],
  char ttl[],
  char minorVersion[],
  word sessionId,
  dword portNumber,
  char additionalEntryFieldName[],
  dword additionalEntryFieldValue,
  enum EndpointSelector endpointSelector, enum Bool withEntry
  )
{
  dword messageId=0xFFFF8100, protocolVersion=0x01, interfaceVersion=0x01, messageType=SomeIpMessageTypeNotification, returnCode=0x00;
  dword numberOfOptions;
  long result;
  char tempstr[64];
  dword requestId,  errorCode;
  byte buffer[500];
  int i;
 
  tempstr[0] = '\0';    
  requestId = (0 << 16) + sessionId;
  
  handle = SomeIpCreateMessage(messageId, requestId, protocolVersion, interfaceVersion, messageType, returnCode);
  if(handle==0)
  {
    ReportSomeIpError("SomeIpCreateMessage failed");
    return kFalse;
  }
  
  if(SetMethodArgumentDWord(handle, "Flags", IsWildcard(flags) ? 0xC0 : atol(flags), errorCode)!=kTrue)
    return kFalse;
  
  if(withEntry==kTrue)
  {
    //Set Number of Entries
    if(SetMethodArgumentDWord(handle, "Entry", 1, errorCode) != kTrue)
      return kFalse;

    //Set ServiceId of Entry
    snprintf(tempstr, elCount(tempstr), "Entry[0].%s.ServiceID", entryType);
    if(SetMethodArgumentDWord(handle, tempstr, serviceId, errorCode) != kTrue)
      return kFalse;
  
    //Set InstanceId of Entry
    snprintf(tempstr, elCount(tempstr), "Entry[0].%s.InstanceID", entryType);
    if(SetMethodArgumentDWord(handle, tempstr, instanceId, errorCode) != kTrue)
      return kFalse;
  
    if(!IsWildcard(additionalEntryFieldName))
    {
      snprintf(tempstr, elCount(tempstr), "Entry[0].%s.%s", entryType, additionalEntryFieldName);
      if(SetMethodArgumentDWord(handle, tempstr, additionalEntryFieldValue, errorCode) != kTrue)
        return kFalse;
    }
  
    //Set Major Version of entry
    snprintf(tempstr, elCount(tempstr), "Entry[0].%s.MajorVersion", entryType);
    if(SetMethodArgumentDWord(handle, tempstr, IsWildcard(majorVersion) ? syspar::SdClientServiceMajorVersion : atol(majorVersion), errorCode) != kTrue)
      return kFalse;
  
    //Set TTL of entry
    snprintf(tempstr, elCount(tempstr), "Entry[0].%s.TTL", entryType);
    if(SetMethodArgumentDWord(handle, tempstr, IsWildcard(ttl) ? atol(syspar::ServiceId1TTL) : atol(ttl), errorCode) != kTrue)
      return kFalse;
  
    //Set Minor Version of entry
    if(!IsWildcard(minorVersion))
    {
     snprintf(tempstr, elCount(tempstr), "Entry[0].%s.MinorVersion", entryType);
     if(SetMethodArgumentDWord(handle, tempstr, ConvertStringValueToInt64(minorVersion), errorCode) != kTrue)
       return kFalse;
    }
  }
  
  if(endpointSelector!=Without_Endpoints)
  {
    numberOfOptions = (endpointSelector==UDP_and_TCP_Endpoint || endpointSelector==UDP_Endpoint_Twice) ? 2 : 1;
    if(withEntry)
    {
      //Set NumberOfOptions1 of Entry
      snprintf(tempstr, elCount(tempstr), "Entry[0].%s.NumberOfOptions1", entryType);
      if(SetMethodArgumentDWord(handle, tempstr, numberOfOptions, errorCode) != kTrue)
        return kFalse;
    }

    //Set Number of options
    if(SetMethodArgumentDWord(handle, "Option", numberOfOptions, errorCode) != kTrue)
      return kFalse;
    
    if(sourceIpAddress.IsIPv4Address())
    {
     
      if(endpointSelector==UDP_and_TCP_Endpoint)
      {
       if(SetOptionIPv4Address(handle, 0, entryType, sourceIpAddress.IPv4Address, portNumber, PROTOCOL_TCP) != kTrue)
          return kFalse;
      }
      else
      {
        if(SetOptionIPv4Address(handle, 0, entryType, sourceIpAddress.IPv4Address, portNumber, PROTOCOL_UDP) != kTrue)
          return kFalse;
      }            
    }
    else
    {
      byte addressArray[16];
      
      if(sourceIpAddress.GetAddressAsArray(addressArray)!=0)
        return kFalse;
      
      if(endpointSelector==UDP_and_TCP_Endpoint)
      {
        if(SetOptionIPv6Address(handle, 0, entryType, addressArray, portNumber, PROTOCOL_TCP) != kTrue)
          return kFalse;
      }
      else
      {
        if(SetOptionIPv6Address(handle, 0, entryType, addressArray, portNumber, PROTOCOL_UDP) != kTrue)
          return kFalse;
      }
    }
    
    if(numberOfOptions==2)
    {
      if(sourceIpAddress.IsIPv4Address())
      {
        if(SetOptionIPv4Address(handle, 1, entryType, sourceIpAddress.IPv4Address, portNumber, PROTOCOL_UDP) != kTrue)
          return kFalse;
      }
      else
      {
        byte addressArray[16];
      
        if(sourceIpAddress.GetAddressAsArray(addressArray)!=0 ||
          SetOptionIPv6Address(handle, 1, entryType, addressArray, portNumber, PROTOCOL_UDP) != kTrue)
          return kFalse;
      }
    }
  }

  return kTrue;
}

enum Bool SetOptionIPv4Address(dword handle, byte index, char entryType[], dword ipV4Address, dword port, dword protocol) 
{
  char optionIPv4Address[2][64] = {"Option[x].IPv4Endpoint.IPv4Address", "Option[x].IPv4Multicast.IPv4Address" };
  char optionPortNumber[2][64]  = {"Option[x].IPv4Endpoint.PortNumber",  "Option[x].IPv4Multicast.PortNumber"  };
  char optionL4Proto[2][64]     = {"Option[x].IPv4Endpoint.L4Proto",     "Option[x].IPv4Multicast.L4Proto"     };
  dword errorCode;
  byte isSubscribeAck;
  
  isSubscribeAck = strncmp(entryType, "SubscribeAck", 12)==0;
  optionIPv4Address[isSubscribeAck][7] = optionPortNumber[isSubscribeAck][7] = optionL4Proto[isSubscribeAck][7] = (48 + index);
  
  if(isSubscribeAck) // must use multicast address
  {
    IP_Endpoint optIpEndpoint;
    InitEndpoint(optIpEndpoint, syspar::SomeIpServiceDiscoveryIpAddress, atol(syspar::SomeIpServiceDiscoveryPort));
    ipV4Address = optIpEndpoint.Address.IPv4Address;
  }

  if(SetMethodArgumentDWord(handle, optionIPv4Address[isSubscribeAck], SwapDWord(ipV4Address), errorCode) != kTrue ||
     SetMethodArgumentDWord(handle, optionPortNumber[isSubscribeAck], port, errorCode) != kTrue ||
     SetMethodArgumentDWord(handle, optionL4Proto[isSubscribeAck], protocol, errorCode) != kTrue)
    return kFalse;
  return kTrue;
}

enum Bool SetOptionIPv6Address(dword handle, byte index, char entryType[], byte ipV6Address[], dword port, dword protocol) 
{
  char optionIPv6Address[2][64] = {"Option[x].IPv6Endpoint.IPv6Address", "Option[x].IPv6Multicast.IPv6Address" };
  char optionPortNumber[2][64]  = {"Option[x].IPv6Endpoint.PortNumber",  "Option[x].IPv6Multicast.PortNumber"  };
  char optionL4Proto[2][64]     = {"Option[x].IPv6Endpoint.L4Proto",     "Option[x].IPv6Multicast.L4Proto"     };
  dword errorCode;
  byte isSubscribeAck;
  
  isSubscribeAck = strncmp(entryType, "SubscribeAck", 12)==0;
  optionIPv6Address[isSubscribeAck][7] = optionPortNumber[isSubscribeAck][7] = optionL4Proto[isSubscribeAck][7] = (48 + index);
  
  if(isSubscribeAck) // must use multicast address
  {
    IP_Endpoint optIpEndpoint;
    InitEndpoint(optIpEndpoint, syspar::SomeIpServiceDiscoveryIpAddress, atol(syspar::SomeIpServiceDiscoveryPort));
    if(optIpEndpoint.Address.GetAddressAsArray(ipV6Address)!=0)
      return kFalse;
  }

  if(SetMethodArgumentArray(handle, optionIPv6Address[isSubscribeAck], ipV6Address, errorCode) != kTrue ||
     SetMethodArgumentDWord(handle, optionPortNumber[isSubscribeAck], port, errorCode) != kTrue ||
     SetMethodArgumentDWord(handle, optionL4Proto[isSubscribeAck], protocol, errorCode) != kTrue)
    return kFalse;
  return kTrue;
}

enum Bool ETS_CreateSomeIpSDNotification2Entries(
  dword & handle,
  IP_Address sourceIpAddress,//char srcIp[],
  int protocol,
  int serviceId,
  char flags[],
  char entryType[],
  word instanceId,
  char majorVersion[],
  char ttl[],
  char minorVersion[],
  word sessionId,
  dword udpPort,
  char additionalEntry0FieldName[],
  dword additionalEntry0FieldValue,
  char additionalEntry1FieldName[],
  dword additionalEntry1FieldValue
  )
{
  dword messageId=0xFFFF8100, protocolVersion=0x01, interfaceVersion=0x01, messageType=SomeIpMessageTypeNotification, returnCode=0x00;
  const NumberOfEntries=2;
  long result;
  char tempstr[64];
  dword requestId,  errorCode;
  byte buffer[500];
  int i;
 
  tempstr[0] = '\0';    
  requestId = (0 << 16) + sessionId;
  
  handle = SomeIpCreateMessage(messageId, requestId, protocolVersion, interfaceVersion, messageType, returnCode);
  if(handle==0)
  {
    ReportSomeIpError("SomeIpCreateMessage failed");
    return kFalse;
  }
  
  if(SetMethodArgumentDWord(handle, "Flags", IsWildcard(flags) ? 0xC0 : atol(flags), errorCode)!=kTrue)
    return kFalse;
  
    //Set Number of Entries
    if(SetMethodArgumentDWord(handle, "Entry", 2, errorCode) != kTrue)
      return kFalse;

  for(i=0;i<NumberOfEntries;++i)
  {
    //Set ServiceId of Entry
    snprintf(tempstr, elCount(tempstr), "Entry[%d].%s.ServiceID", i, entryType);
    if(SetMethodArgumentDWord(handle, tempstr, serviceId, errorCode) != kTrue)
      return kFalse;
  
    //Set InstanceId of Entry
    snprintf(tempstr, elCount(tempstr), "Entry[%d].%s.InstanceID", i, entryType);
    if(SetMethodArgumentDWord(handle, tempstr, instanceId, errorCode) != kTrue)
      return kFalse;
  
    if(!IsWildcard(additionalEntry0FieldName) && i==0)
    {
      snprintf(tempstr, elCount(tempstr), "Entry[0].%s.%s", entryType, additionalEntry0FieldName);
      if(SetMethodArgumentDWord(handle, tempstr, additionalEntry0FieldValue, errorCode) != kTrue)
        return kFalse;
    }
    if(!IsWildcard(additionalEntry1FieldName) && i==1)
    {
      snprintf(tempstr, elCount(tempstr), "Entry[1].%s.%s", entryType, additionalEntry1FieldName);
      if(SetMethodArgumentDWord(handle, tempstr, additionalEntry1FieldValue, errorCode) != kTrue)
        return kFalse;
    }
  
    //Set Major Version of entry
    snprintf(tempstr, elCount(tempstr), "Entry[%d].%s.MajorVersion", i, entryType);
    if(SetMethodArgumentDWord(handle, tempstr, IsWildcard(majorVersion) ? syspar::SdClientServiceMajorVersion : atol(majorVersion), errorCode) != kTrue)
      return kFalse;
  
    //Set TTL of entry
    snprintf(tempstr, elCount(tempstr), "Entry[%d].%s.TTL", i, entryType);
    if(SetMethodArgumentDWord(handle, tempstr, IsWildcard(ttl) ? atol(syspar::ServiceId1TTL) : atol(ttl), errorCode) != kTrue)
      return kFalse;
  
    //Set Minor Version of entry
    if(!IsWildcard(minorVersion))
    {
     snprintf(tempstr, elCount(tempstr), "Entry[%d].%s.MinorVersion", i, entryType);
     if(SetMethodArgumentDWord(handle, tempstr, ConvertStringValueToInt64(minorVersion), errorCode) != kTrue)
       return kFalse;
    }
  }
  
  for(i=0;i<NumberOfEntries;++i)
  {
    //Set NumberOfOptions1 of Entry
    snprintf(tempstr, elCount(tempstr), "Entry[%d].%s.NumberOfOptions1", i, entryType);
    if(SetMethodArgumentDWord(handle, tempstr, 2, errorCode) != kTrue)
      return kFalse;
  }

  if(SetMethodArgumentDWord(handle, "Option", 2, errorCode) != kTrue)
    return kFalse;
  
  if(sourceIpAddress.IsIPv4Address())
  {
    if(SetMethodArgumentDWord(handle, "Option[0].IPv4Endpoint.IPv4Address", SwapDWord(sourceIpAddress.IPv4Address), errorCode) != kTrue ||
       SetMethodArgumentDWord(handle, "Option[0].IPv4Endpoint.PortNumber", udpPort, errorCode) != kTrue ||
       SetMethodArgumentDWord(handle, "Option[0].IPv4Endpoint.L4Proto", PROTOCOL_UDP, errorCode) != kTrue ||
       SetMethodArgumentDWord(handle, "Option[1].IPv4Endpoint.IPv4Address", SwapDWord(sourceIpAddress.IPv4Address), errorCode) != kTrue ||
       SetMethodArgumentDWord(handle, "Option[1].IPv4Endpoint.PortNumber", udpPort, errorCode) != kTrue ||
       SetMethodArgumentDWord(handle, "Option[1].IPv4Endpoint.L4Proto", PROTOCOL_TCP, errorCode) != kTrue)
      return kFalse;
  }
  else
  {
    byte addressArray[16];
      
    if(sourceIpAddress.GetAddressAsArray(addressArray)!=0 ||
       SetMethodArgumentArray(handle, "Option[0].IPv6Endpoint.IPv6Address", addressArray, errorCode) != kTrue ||
       SetMethodArgumentDWord(handle, "Option[0].IPv6Endpoint.PortNumber", udpPort, errorCode) != kTrue ||
       SetMethodArgumentDWord(handle, "Option[0].IPv6Endpoint.L4Proto", PROTOCOL_UDP, errorCode) != kTrue ||
       SetMethodArgumentArray(handle, "Option[1].IPv6Endpoint.IPv6Address", addressArray, errorCode) != kTrue ||
       SetMethodArgumentDWord(handle, "Option[1].IPv6Endpoint.PortNumber", udpPort, errorCode) != kTrue ||
       SetMethodArgumentDWord(handle, "Option[1].IPv6Endpoint.L4Proto", PROTOCOL_TCP, errorCode) != kTrue)
      return kFalse;
  }
  
  return kTrue;
}

void ETS_SendSomeIpSDNotification(char callerFunctionName[],
  char srcIp[], char destIp[], int serviceId,
  char flags[], char entryType[], word instanceId,
  char majorVersion[], char ttl[], char minorVersion[],
  word sessionId, dword udpPort,
  char additionalEntryFieldName[], dword additionalEntryFieldValue,
  enum EndpointSelector endpointSelector, enum Bool withEntry
  )
{
  dword handle;
  
  IP_Endpoint sourceEndpoint, destinationEndpoint, sendEndpoint;
  if(InitEndpoint(sourceEndpoint, srcIp, atol(syspar::SomeIpServiceDiscoveryPort))!=kTrue ||
     InitEndpoint(destinationEndpoint, destIp, atol(syspar::SomeIpServiceDiscoveryPort))!=kTrue ||
     InitEndpoint(sendEndpoint, syspar::IpAddressTester, atol(syspar::SomeIpServiceDiscoveryPort))!=kTrue)
  {
    testStepFail("Creation of endpoints failed");
    return;
  }
  
  if(ETS_CreateSomeIpSDNotification(handle, sourceEndpoint.Address, serviceId, flags, entryType,
    instanceId, majorVersion, ttl, minorVersion, sessionId, udpPort, additionalEntryFieldName, additionalEntryFieldValue, endpointSelector, withEntry)==kFalse)
  {
    testStepFail(callerFunctionName, "Creation of notification failed");
    if(handle)
      SomeIpReleaseMessage(handle);
    return;
  }

  if(ETS_OutputSomeIpSDNotification(handle, sendEndpoint, destinationEndpoint)==kFalse)
  {
    testStepFail(callerFunctionName, "Sending of notification failed");
  }
}

void ETS_PostSomeIpSDNotification(char callerFunctionName[],
  char srcIp[], char destIp[], int protocol, int serviceId,
  char flags[], char entryType[], word instanceId,
  char majorVersion[], char ttl[], char minorVersion[],
  word sessionId, dword udpPort,
  char additionalEntryFieldName[], dword additionalEntryFieldValue,
  enum EndpointSelector endpointSelector, enum Bool withEntry
  )
{
  dword handle;
  
  IP_Endpoint sourceEndpoint, destinationEndpoint;
  if(InitEndpoint(sourceEndpoint, srcIp, atol(syspar::SomeIpServiceDiscoveryPort))!=kTrue ||
     InitEndpoint(destinationEndpoint, destIp, atol(syspar::SomeIpServiceDiscoveryPort))!=kTrue)
  {
    testStepFail("Creation of endpoints failed");
    return;
  }
  
  if(ETS_CreateSomeIpSDNotification(handle, sourceEndpoint.Address, serviceId, flags, entryType,
    instanceId, majorVersion, ttl, minorVersion, sessionId, udpPort, additionalEntryFieldName, additionalEntryFieldValue, endpointSelector, withEntry)==kFalse)
  {
    testStepFail(callerFunctionName, "Creation of notification failed");
    if(handle)
      SomeIpReleaseMessage(handle);
    return;
  }

  if(ETS_PostSomeIpSDNotification2(handle, sourceEndpoint, destinationEndpoint)==kFalse)
  {
    testStepFail(callerFunctionName, "Sending of notification failed");
  }
}

export testfunction ETS_SendNotification_FindService(dword sessionId, dword instanceId, char destinationIP[])
{
  ETS_SendSomeIpSDNotification("ETS_SendNotification_FindService", destinationIP, syspar::SomeIp_ETS_ServiceId, syspar::Wildcard, "FindService",
    instanceId, syspar::Wildcard, syspar::SomeIp_ETS_OfferService_TTL, syspar::Wildcard, sessionId, syspar::SomeIp_ETS_Port, syspar::Wildcard, 0, Without_Endpoints);
}

export testfunction ETS_SendNotification_FindService(dword sessionId, dword instanceId)
{
  ETS_SendSomeIpSDNotification("ETS_SendNotification_FindService", syspar::SomeIpServiceDiscoveryIpAddress, syspar::SomeIp_ETS_ServiceId, syspar::Wildcard, "FindService",
    instanceId, syspar::Wildcard, syspar::SomeIp_ETS_OfferService_TTL, syspar::Wildcard, sessionId, syspar::SomeIp_ETS_Port, syspar::Wildcard, 0, Without_Endpoints);
}

export testfunction ETS_SendNotification_FindService_UnicastFlag0(dword sessionId, dword instanceId)
{
  char FLAGS_REBOOT[8] = "0x80";
  ETS_SendSomeIpSDNotification("ETS_SendNotification_FindService_UnicastFlag0", syspar::SomeIpServiceDiscoveryIpAddress, syspar::SomeIp_ETS_ServiceId, FLAGS_REBOOT, "FindService",
    instanceId, syspar::Wildcard, syspar::SomeIp_ETS_OfferService_TTL, syspar::Wildcard, sessionId, syspar::SomeIp_ETS_Port, syspar::Wildcard, 0, Without_Endpoints);
}

export testfunction ETS_WaitForFinishedSendingNotifications_FindService()
{
  testWaitForTimeout((gTriggerFindServiceTimerArgs.numberOfMessagesToSend-gTriggerFindServiceTimerArgs.numberOfSendsDone + 2)*10);
}

export testfunction ETS_StopSendingNotifications_FindService()
{
  cancelTimer(gTriggerFindServiceTimer);
}

export testfunction ETS_StartSendingNotifications_FindServiceWithEndpoint(dword sessionId, dword instanceId)
{
  gTriggerFindServiceTimerArgs.numberOfMessagesToSend = 10;
  gTriggerFindServiceTimerArgs.numberOfSendsDone = 0;
  gTriggerFindServiceTimerArgs.sessionId = sessionId;
  gTriggerFindServiceTimerArgs.instanceId = instanceId;
  gTriggerFindServiceTimerArgs.endpointSelector = UDP_Endpoint_Only;
  strncpy(gTriggerFindServiceTimerArgs.destinationIP, syspar::SomeIpServiceDiscoveryIpAddress, elcount(gTriggerFindServiceTimerArgs.destinationIP));
  snprintf(gTriggerFindServiceTimerArgs.majorVersion, elCount(gTriggerFindServiceTimerArgs.majorVersion), "%s", syspar::Wildcard);
  snprintf(gTriggerFindServiceTimerArgs.minorVersion, elCount(gTriggerFindServiceTimerArgs.minorVersion), "%s", syspar::Wildcard);

  setTimer(gTriggerFindServiceTimer, 10);
}

export testfunction ETS_StartSendingNotifications_FindService(dword sessionId, dword instanceId, char destinationIP[])
{
  gTriggerFindServiceTimerArgs.numberOfMessagesToSend = 10;
  gTriggerFindServiceTimerArgs.numberOfSendsDone = 0;
  gTriggerFindServiceTimerArgs.sessionId = sessionId;
  gTriggerFindServiceTimerArgs.instanceId = instanceId;
  gTriggerFindServiceTimerArgs.endpointSelector = Without_Endpoints;
  strncpy(gTriggerFindServiceTimerArgs.destinationIP, destinationIP, elcount(gTriggerFindServiceTimerArgs.destinationIP));
  snprintf(gTriggerFindServiceTimerArgs.majorVersion, elCount(gTriggerFindServiceTimerArgs.majorVersion), "%s", syspar::Wildcard);
  snprintf(gTriggerFindServiceTimerArgs.minorVersion, elCount(gTriggerFindServiceTimerArgs.minorVersion), "%s", syspar::Wildcard);
  setTimer(gTriggerFindServiceTimer, 10);
}

export testfunction ETS_StartSendingNotifications_FindService(dword sessionId, dword instanceId)
{
  gTriggerFindServiceTimerArgs.numberOfMessagesToSend = 10;
  gTriggerFindServiceTimerArgs.numberOfSendsDone = 0;
  gTriggerFindServiceTimerArgs.sessionId = sessionId;
  gTriggerFindServiceTimerArgs.instanceId = instanceId;
  gTriggerFindServiceTimerArgs.endpointSelector = Without_Endpoints;
  strncpy(gTriggerFindServiceTimerArgs.destinationIP, syspar::SomeIpServiceDiscoveryIpAddress, elcount(gTriggerFindServiceTimerArgs.destinationIP));
  snprintf(gTriggerFindServiceTimerArgs.majorVersion, elCount(gTriggerFindServiceTimerArgs.majorVersion), "%s", syspar::Wildcard);
  snprintf(gTriggerFindServiceTimerArgs.minorVersion, elCount(gTriggerFindServiceTimerArgs.minorVersion), "%s", syspar::Wildcard);
  setTimer(gTriggerFindServiceTimer, 10);
}

export testfunction ETS_StartSendingNotifications_FindService_MajorVersion(dword sessionId, dword instanceId, char majorVersion[])
{
  gTriggerFindServiceTimerArgs.numberOfMessagesToSend = 10;
  gTriggerFindServiceTimerArgs.numberOfSendsDone = 0;
  gTriggerFindServiceTimerArgs.sessionId = sessionId;
  gTriggerFindServiceTimerArgs.instanceId = instanceId;
  gTriggerFindServiceTimerArgs.endpointSelector = Without_Endpoints;
  strncpy(gTriggerFindServiceTimerArgs.destinationIP, syspar::SomeIpServiceDiscoveryIpAddress, elcount(gTriggerFindServiceTimerArgs.destinationIP));
  snprintf(gTriggerFindServiceTimerArgs.majorVersion, elCount(gTriggerFindServiceTimerArgs.majorVersion), "%s", majorVersion);
  snprintf(gTriggerFindServiceTimerArgs.minorVersion, elCount(gTriggerFindServiceTimerArgs.minorVersion), "%s", syspar::Wildcard);
  setTimer(gTriggerFindServiceTimer, 10);
}

export testfunction ETS_StartSendingNotifications_FindService_MinorVersion(dword sessionId, dword instanceId, char minorVersion[])
{
  gTriggerFindServiceTimerArgs.numberOfMessagesToSend = 10;
  gTriggerFindServiceTimerArgs.numberOfSendsDone = 0;
  gTriggerFindServiceTimerArgs.sessionId = sessionId;
  gTriggerFindServiceTimerArgs.instanceId = instanceId;
  gTriggerFindServiceTimerArgs.endpointSelector = Without_Endpoints;
  strncpy(gTriggerFindServiceTimerArgs.destinationIP, syspar::SomeIpServiceDiscoveryIpAddress, elcount(gTriggerFindServiceTimerArgs.destinationIP));
  snprintf(gTriggerFindServiceTimerArgs.majorVersion, elCount(gTriggerFindServiceTimerArgs.majorVersion), "%s", syspar::Wildcard);
  snprintf(gTriggerFindServiceTimerArgs.minorVersion, elCount(gTriggerFindServiceTimerArgs.minorVersion), "%s", minorVersion);
  setTimer(gTriggerFindServiceTimer, 10);
}

on timer gTriggerFindServiceTimer
{
  ETS_SendSomeIpSDNotification("ETS_SendNotification_FindService", gTriggerFindServiceTimerArgs.destinationIP, syspar::SomeIp_ETS_ServiceId, syspar::Wildcard, "FindService",
    gTriggerFindServiceTimerArgs.instanceId, gTriggerFindServiceTimerArgs.majorVersion, syspar::SomeIp_ETS_OfferService_TTL, gTriggerFindServiceTimerArgs.minorVersion,
    gTriggerFindServiceTimerArgs.sessionId++, syspar::SomeIp_ETS_Port, syspar::Wildcard, 0, gTriggerFindServiceTimerArgs.endpointSelector);
  gTriggerFindServiceTimerArgs.numberOfSendsDone++;
  if(gTriggerFindServiceTimerArgs.sessionId == 0)
    gTriggerFindServiceTimerArgs.sessionId = 1;
  if(gTriggerFindServiceTimerArgs.numberOfMessagesToSend==0 || // unlimited number of messages to send
     gTriggerFindServiceTimerArgs.numberOfSendsDone<gTriggerFindServiceTimerArgs.numberOfMessagesToSend)
    setTimer(gTriggerFindServiceTimer, 10);
}

export testfunction ETS_SendNotification_StopOfferService(dword sessionId, dword instanceId, char destinationIP[])
{
  ETS_SendSomeIpSDNotification("ETS_SendNotification_StopOfferService", destinationIP, syspar::SomeIp_ETS_ServiceId, syspar::Wildcard, "OfferService",
    instanceId, syspar::Wildcard, "0", syspar::Wildcard, sessionId, syspar::SomeIp_ETS_Port, syspar::Wildcard, 0, UDP_and_TCP_Endpoint);
}

export testfunction ETS_SendNotification_StopOfferService(dword sessionId, dword instanceId, char destinationIP[], dword udpPort)
{
  ETS_SendSomeIpSDNotification("ETS_SendNotification_StopOfferService", destinationIP, syspar::SomeIp_ETS_ServiceId, syspar::Wildcard, "OfferService",
    instanceId, syspar::Wildcard, "0", syspar::Wildcard, sessionId, udpPort, syspar::Wildcard, 0, UDP_Endpoint_Only);
}

void ETS_SendNotification_OfferService(dword sessionId, dword instanceId, char destinationIP[], dword port, enum EndpointSelector endpointSelector)
{
  ETS_SendSomeIpSDNotification(
    "ETS_SendNotification_OfferService"
    , destinationIP
    , syspar::SomeIp_ETS_ServiceId
    , syspar::Wildcard
    , "OfferService"
    , instanceId
    , syspar::Wildcard
    , syspar::SomeIp_ETS_OfferService_TTL
    , syspar::Wildcard
    , sessionId
    , port
    , syspar::Wildcard
    , 0
    , endpointSelector
  );
}

export testfunction ETS_SendNotification_OfferService(dword sessionId, dword instanceId, char destinationIP[])
{
  ETS_SendNotification_OfferService(sessionId, instanceId, destinationIP, syspar::SomeIp_ETS_Port, UDP_and_TCP_Endpoint);
}

export testfunction ETS_SendNotification_OfferService(dword sessionId, dword instanceId, char destinationIP[], dword port)
{
  ETS_SendNotification_OfferService(sessionId, instanceId, destinationIP, port, UDP_Endpoint_Only);
}

export testfunction ETS_SendNotification_OfferService_TCP(dword sessionId, dword instanceId, char destinationIP[], dword port)
{
  ETS_SendNotification_OfferService(sessionId, instanceId, destinationIP, port, UDP_and_TCP_Endpoint);
}

enum Bool WaitFor_OfferService_ExtractSessionId(char callerFunctionName[], char instanceIdStr[])
{
  return ETS_InternalWaitForSOMEIPNotification(callerFunctionName, syspar::ParamListenTimeMs,
      SomeIpMessageTypeNotification, OfferService, syspar::SomeIp_ETS_ServiceId, // entryServiceId
      syspar::Wildcard, // entryTTL
      syspar::Wildcard, // serviceId
      syspar::Wildcard, // returnCode
      syspar::Wildcard, // methodId
     "Entry[0].OfferService.InstanceID", instanceIdStr, kEquals, // first token
     "DestinationAddress", syspar::IpAddressTester, kEquals, // second token
    syspar::UdpProtocol, "SessionId",
    kAnswerExpected
  );
}

void ETS_StartSendingNotifications_FindService_NoLimit(dword sessionId, dword instanceId)
{
  gTriggerFindServiceTimerArgs.numberOfMessagesToSend = 0; // unlimited
  gTriggerFindServiceTimerArgs.numberOfSendsDone = 0;
  gTriggerFindServiceTimerArgs.sessionId = sessionId;
  gTriggerFindServiceTimerArgs.instanceId = instanceId;
  gTriggerFindServiceTimerArgs.endpointSelector = Without_Endpoints;
  strncpy(gTriggerFindServiceTimerArgs.destinationIP, syspar::SomeIpServiceDiscoveryIpAddress, elcount(gTriggerFindServiceTimerArgs.destinationIP));
  snprintf(gTriggerFindServiceTimerArgs.majorVersion, elCount(gTriggerFindServiceTimerArgs.majorVersion), "%s", syspar::Wildcard);
  snprintf(gTriggerFindServiceTimerArgs.minorVersion, elCount(gTriggerFindServiceTimerArgs.minorVersion), "%s", syspar::Wildcard);
  setTimer(gTriggerFindServiceTimer, 10);
}

export testfunction ETS_SendNotification_SubscribeAck(dword sessionId, dword instanceId, char destinationIP[], dword port)
{
  ETS_SendSomeIpSDNotification("ETS_SendNotification_SubscribeAck", destinationIP, syspar::SomeIp_ETS_ServiceId, syspar::Wildcard, "SubscribeAck",
    instanceId, syspar::Wildcard, syspar::SomeIp_ETS_OfferService_TTL, syspar::Wildcard, sessionId, port, "EventgroupID", 2, UDP_Endpoint_Only);
}

export testfunction ETS_SendNotification_SubscribeNAck(dword sessionId, dword instanceId, char destinationIP[], dword port)
{
  ETS_SendSomeIpSDNotification("ETS_SendNotification_SubscribeAck", destinationIP, syspar::SomeIp_ETS_ServiceId, syspar::Wildcard, "SubscribeAck",
    instanceId, syspar::Wildcard, "0", syspar::Wildcard, sessionId, port, "EventgroupID", 2, UDP_Endpoint_Only);
}

export testfunction ETS_SendNotifications_FindService_WaitForOfferWithSessionIdWrapAround(dword instanceId)
{
  dword offerServiceSessionId;
  enum Bool success;
  char instanceIdStr[16];
  snprintf(instanceIdStr, elcount(instanceIdStr), "%d", instanceId);
  
  ETS_StartSendingNotifications_FindService_NoLimit(1, instanceId);
  
  do
  {
    success=WaitFor_OfferService_ExtractSessionId("ETS_SendNotifications_FindService_WaitForWrapAround", instanceIdStr);
    if(success)
      offerServiceSessionId=gExtractingParameters[0].Value;
  }
  while(success==kTrue && offerServiceSessionId<65535);
  
  if(success)
  {
    success=WaitFor_OfferService_ExtractSessionId("ETS_SendNotifications_FindService_WaitForWrapAround", instanceIdStr);
    offerServiceSessionId=gExtractingParameters[0].Value;
  }

  cancelTimer(gTriggerFindServiceTimer);

  if(success && offerServiceSessionId==1)
    testStepPass("ETS_SendNotifications_FindService_WaitForWrapAround", "SessionId wrap-around detected");
  else
    testStepFail("ETS_SendNotifications_FindService_WaitForWrapAround", "No sessionId wrap-around detected, expected sessionId: 1, instead of %d", offerServiceSessionId);
}

export testfunction ETS_WaitFor_AndDropSendingSubscribeNAck()
{
  gDropMatchingSomeIpMessage = 1;

  ETS_InternalWaitForSOMEIPNotification("ETS_WaitFor_AndDropSendingSubscribeNAck",
    syspar::ParamListenTimeMs,
    SomeIpMessageTypeNotification,
    SubscribeAck,
    syspar::SomeIp_ETS_ServiceId, // entryServiceId
    "0", // entryTTL
    syspar::Wildcard, // serviceId
    syspar::Wildcard, // returnCode
    syspar::Wildcard, // methodId
    "Entry[0].SubscribeAck.InstanceID", syspar::SomeIp_ETS_Tester_InstanceId, kEquals, // first token
    "DestinationAddress", syspar::DIface0Ip, kEquals, // second token
    syspar::UdpProtocol, syspar::Wildcard,
    kAnswerExpected
  );
  
  gDropMatchingSomeIpMessage = 0;
}

export testfunction ETS_OpenTcpEndpointFor_Offer(dword port)
{
  IP_Endpoint endpoint;
  
  InitEndpoint(endpoint, syspar::IpAddressTester, port);
  endpoint.SetToTcp();
  gTcpAepForOfferEvent = ETSOpenLocalApplicationEndpoint(endpoint);
  if(gTcpAepForOfferEvent==0)
  {
    ReportSomeIpError("ETS_OpenTcpEndpointFor_Offer open failed");
    testStepFail("ETS_OpenTcpEndpointFor_Offer", "SomeIp error");
    return;
  }
  else
  {
    SomeIpTCPListen(gTcpAepForOfferEvent);
  }
}

export testfunction ETS_CloseTcpEndpointFor_Offer()
{
  ETSCloseLocalApplicationEndpoint(gTcpAepForOfferEvent);
  gTcpAepForOfferEvent=0;
}

export testfunction ETS_OpenUdpEndpointFor_SendEvent(dword port)
{
  IP_Endpoint endpoint;
  if(gUdpAepForSendEvent)
    ETSCloseLocalApplicationEndpoint(gUdpAepForSendEvent);
  
  InitEndpoint(endpoint, syspar::IpAddressTester, port);
  endpoint.SetToUdp();
  gUdpAepForSendEvent =  ETSOpenLocalApplicationEndpoint(endpoint);
  if(gUdpAepForSendEvent==0)
  {
    ReportSomeIpError("ETS_OpenUdpEndpointFor_SendNotifications open failed");
    testStepFail("ETS_OpenUdpEndpointFor_SendNotifications", "SomeIp error");
    return;
  }
}

export testfunction ETS_CloseUdpEndpointFor_SendEvent()
{
  ETSCloseLocalApplicationEndpoint(gUdpAepForSendEvent);
  gUdpAepForSendEvent=0;
}

export testfunction ETS_SendEvent_TestEventUINT8_ToExtractedPort(dword sessionId, dword instanceId, char destinationIP[])
{
  IP_Endpoint destinationEndpoint;
  dword messageId, protocolVersion=0x01, interfaceVersion=0x01, messageType=SomeIpMessageTypeNotification, returnCode=0x00;
  dword requestId, notificationHandle;
  byte payload[1] = { 12 };
  long result;
  enum Bool isIpv6;
  byte ipv6Dest[16];

  requestId = (1 << 16) + sessionId;
  messageId = (syspar::SomeIp_ETS_ServiceId << 16) | (EVENT_ID_TestEventUINT8);
  
  notificationHandle = SomeIpCreateMessage(messageId, requestId, protocolVersion, interfaceVersion, messageType, returnCode);
  if(notificationHandle==0)
  {
    testStepFail("ETS_SendEvent_TestEventUINT8", "SomeIpCreateMessage failed");
    return;
  }

  SomeIpSetData(notificationHandle, elcount(payload), payload);
 
  SetBusContext(GetBusNameContext("Ethernet_1"));
  
  InitEndpoint(destinationEndpoint, destinationIP, gExtractedPort);
  result = SomeIpOutputMessage(gUdpAepForSendEvent, destinationEndpoint, notificationHandle);

  if(result!=0)
  {
    write("### Send TestEventUINT8 failed");
    testStepFail("ETS_SendEvent_TestEventUINT8", "Post message failed");
  }

  if(SomeIpReleaseMessage(notificationHandle)!=0)
  {
    testStepFail("ETS_SendEvent_TestEventUINT8", "Release message failed");
  }
  notificationHandle=0;
}
