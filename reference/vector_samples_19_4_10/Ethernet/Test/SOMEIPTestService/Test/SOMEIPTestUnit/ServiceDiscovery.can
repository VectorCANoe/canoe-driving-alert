/*@!Encoding:1252*/
includes
{
  
}

variables
{

}

// test disconnect and reconnect of provided service DrivingPSI1
export testcase EDRV_Service_DrivingPSI1_DisconnectAndConnect()
{
  char tc[57] = "EDRV_DrivingPSI1_DisconnectAndConnect";
  
  testCaseDescription("Enable DrivingPSI1 and wait for Offer-Service. Expect that subscribe is sent after an offer service");
  
  testStep(tc, "Stop provided service instance");
  EDRV::DrivingPSI1.Disconnect();
  
  if(testWaitForTextEvent("Driving::StopOfferService", 100) != 1)
  {
    testStepFail( tc, "Service EDRV::DrivingPSI1 no stop offer" );
    return;
  }
  
  testWaitForTimeout(100);
  
  testStep(tc, "Start provided service instance");
  EDRV::DrivingPSI1.Connect();
  
  if(testWaitForTextEvent("Driving::OfferService", 100) != 1)
  {
    testStepFail( tc, "Service EDRV::DrivingPSI1 no offer" );
    return;
  }

  if(testWaitForTextEvent("Driving::Subscribe", 100) != 1)
  {
    testStepFail( tc, "Service HPCM::DrivingPSI1 no subscribe" );
    return;
  }
  
  // wait for acknowledge
  testWaitForTimeout(1000);
  
  testStepPass( tc );
}

// test disconnect and reconnect of consumed service DrivingCSI1
export testcase HPCM_Service_DrivingCSI1_DisconnectAndConnect()
{
  char tc[57] = "HPCM_DrivingCSI1_DisconnectAndConnect";
  testCaseDescription("Enable DrivingCSI1 and wait for subscribe. Expect that SubscribeAcknowledge after a Subscribe Service is received");
  
  HPCM::DrivingCSI1.Disconnect();
  
  if(testWaitForTextEvent("Driving::StopSubscribe", 100) != 1)
  {
    testStepFail( tc, "Service HPCM::DrivingCSI1 not unsubscribed" );
    return;
  }
  
  testWaitForTimeout(100);
  
  HPCM::DrivingCSI1.Connect();
  
  if(testWaitForTextEvent("Driving::Subscribe", 100) != 1)
  {
    testStepFail( tc, "Service HPCM::DrivingCSI1 not subscribed" );
    return;
  }
  
    if(testWaitForTextEvent("Driving::SubscribeAcknowledge", 100) != 1)
  {
    testStepFail( tc, "Service HPCM::DrivingCSI1 no SubscribeAcknowledge" );
    return;
  }

  // wait for acknowledge
  testWaitForTimeout(1000);
  
  testStepPass( tc );
}

on someipSD Driving::Subscribe
{
  testSupplyTextEvent("Driving::Subscribe");
}

on someipSD Driving::SubscribeACK
{
  testSupplyTextEvent("Driving::SubscribeAcknowledge");
}

on someipSD Driving::StopSubscribe
{
  testSupplyTextEvent("Driving::StopSubscribe");
}

on someipSD Driving::StopOfferService
{
  testSupplyTextEvent("Driving::StopOfferService");
}

on someipSD Driving::OfferService
{
  testSupplyTextEvent("Driving::OfferService");
}