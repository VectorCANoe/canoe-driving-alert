/*@!Encoding:1252*/
variables
{
  const dword kSOMEIPDOMethod_RxTimeoutMs = 100;
}

// test method PowerBoost
export testcase HPCM_Method_DrivingCSI1_PowerBoost()
{
  char tc[48] = "Method_HPCM_DrivingCSI1_PowerBoost";
  long result = 0;
  callContext HPCM::DrivingCSI1.PowerBoost cco;
  word argPower;

  testStep( tc, "Call method HPCM::DrivingCSI1.PowerBoost from consumer-side and wait for response" );

  // set default response
  $VehicleNetwork::EDRV::DrivingPSI1.PowerBoost.ParamDefaults.ConfirmedPower.phys = 10;
  
  // call method
  argPower = 10;
  cco = HPCM::DrivingCSI1.PowerBoost.CallAsync( argPower );

  testStep( tc, "Wait for answer of HPCM::DrivingCSI1.PowerBoost" );

  result = testWaitForAnswer( cco, kSOMEIPDOMethod_RxTimeoutMs );

  if ( result != 1 )
  {
    testStepFail( tc, "Error, testWaitForAnswer for Method HPCM::DrivingCSI1.PowerBoost failed with result %d", result );
  }
  
  testStepPass( tc );
}
