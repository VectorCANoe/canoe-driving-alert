AUTOSAR XML (schema 4-3-0)
standard types defined: UInt8, UInt16, UInt32, UInt64, Float32, Float64
package /Cluster
  ethernet cluster VehicleNetwork: baudrate=100000000, protocol-name=ETHERNET
    ethernet physical channel VLAN_Drive: comm-connectors=[HPCM/VLAN_Drive, EDRV/VLAN_Drive]
      pdu triggering SD_Drive_MC_AEP_TRG: pdu=SD_PDU, from EDRV HPCM, to EDRV HPCM
      pdu triggering MotorState_Trg0: pdu=MotorState, from EDRV, to HPCM
      pdu triggering PowerBoostResponseTrg0: pdu=PowerBoostResponse, from EDRV, to HPCM
      pdu triggering Mode_NotifierTrg0: pdu=Mode_Notifier, from EDRV, to HPCM
      pdu triggering Mode_GetterRespTrg0: pdu=Mode_GetterResp, from EDRV, to HPCM
      pdu triggering Mode_SetterRespTrg0: pdu=Mode_SetterResp, from EDRV, to HPCM
      pdu triggering PowerBoostRequestTrg0: pdu=PowerBoostRequest, from HPCM, to EDRV
      pdu triggering Mode_GetterReqstTrg0: pdu=Mode_GetterRqst, from HPCM, to EDRV
      pdu triggering Mode_SetterRqstTrg0: pdu=Mode_SetterRqst, from HPCM, to EDRV
      network endpoint HPCM_Drive_NEP: network-endpoint-addresses=ipv-4-configuration={ipv-4-address=192.168.3.1, ipv-4-address-source=FIXED, network-mask=255.255.255.0}
      network endpoint EDRV_Drive_NEP: network-endpoint-addresses=ipv-4-configuration={ipv-4-address=192.168.3.10, ipv-4-address-source=FIXED, network-mask=255.255.255.0}
      network endpoint SD_Drive_MC_NEP: network-endpoint-addresses=ipv-4-configuration={ipv-4-address=239.0.3.1, ipv-4-address-source=FIXED, network-mask=255.255.255.0}
      so-ad-config:
        socket connection bundle SD_Drive_MC_AEP_BNDL: bundled-connections=[EDRV_Drive_SOMEIP_SD_AEP, HPCM_Drive_SOMEIP_SD_AEP], pdus=socket-connection-ipdu-identifier={header-id=4294934784, pdu-triggering=SD_Drive_MC_AEP_TRG}, server-port=SD_Drive_MC_AEP
        socket connection bundle DrivingPSI1: socket-connection=HPCM_Drive_SOMEIP_AEP, server-port=EDRV_Drive_SOMEIP_AEP
          pdus:
            header-id=65765377, pdu-triggering=MotorState_Trg0, routing-group=DrivingPSI1AllEvg
            header-id=65732609, pdu-triggering=PowerBoostResponseTrg0, routing-group=PowerBoostResponse0
            header-id=65765378, pdu-triggering=Mode_NotifierTrg0
            header-id=65732610, pdu-triggering=Mode_GetterRespTrg0, routing-group=Mode_Getter0
            header-id=65732611, pdu-triggering=Mode_SetterRespTrg0, routing-group=Mode_Setter0
        socket connection bundle DrivingCSI1: socket-connection=EDRV_Drive_SOMEIP_AEP, server-port=HPCM_Drive_SOMEIP_AEP
          pdus:
            header-id=65732609, pdu-triggering=PowerBoostRequestTrg0, routing-group=PowerBoostRequest0
            header-id=65732610, pdu-triggering=Mode_GetterReqstTrg0, routing-group=Mode_Getter0
            header-id=65732611, pdu-triggering=Mode_SetterRqstTrg0, routing-group=Mode_Setter0
        5 x socket address:
          HPCM_Drive_SOMEIP_SD_AEP: connector=HPCM/VLAN_Drive
            application endpoint HPCM_Drive_SOMEIP_SD_AEP: network-endpoint=HPCM_Drive_NEP, tp-configuration=udp-tp=udp-tp-port=port-number=30490
          HPCM_Drive_SOMEIP_AEP: connector=HPCM/VLAN_Drive
            application endpoint HPCM_Drive_SOMEIP_AEP: network-endpoint=HPCM_Drive_NEP, tp-configuration=udp-tp=udp-tp-port=port-number=30500
              consumed service instance DrivingCSI1: routing-group=[DrivingPSI1, PowerBoostResponse0], provided-service-instance=DrivingPSI1, sd-client-config={client-service-major-version=1, client-service-minor-version=0, initial-find-behavior={initial-delay-max-value=0.1, initial-delay-min-value=0.005, initial-repetitions-base-delay=0, initial-repetitions-max=0}, ttl=1000}
                consumed event group AllEvg: event-group-identifier=1, routing-group=DrivingPSI1AllEvg
          EDRV_Drive_SOMEIP_SD_AEP: connector=EDRV/VLAN_Drive
            application endpoint EDRV_Drive_SOMEIP_SD_AEP: network-endpoint=EDRV_Drive_NEP, tp-configuration=udp-tp=udp-tp-port=port-number=30490
          EDRV_Drive_SOMEIP_AEP: connector=EDRV/VLAN_Drive
            application endpoint EDRV_Drive_SOMEIP_AEP: network-endpoint=EDRV_Drive_NEP, tp-configuration=udp-tp=udp-tp-port=port-number=30500
              provided service instance DrivingPSI1:
                routing-group=[DrivingPSI1, PowerBoostRequest0]
                instance-identifier=1
                sd-server-config={initial-offer-behavior={initial-delay-max-value=0.1, initial-delay-min-value=0.01, initial-repetitions-base-delay=0, initial-repetitions-max=0}, offer-cyclic-delay=0, request-response-delay={max-value=0.2, min-value=0.01}, server-service-major-version=1, server-service-minor-version=0, ttl=1000}
                service-identifier=1003
                event handler AllEvg: application-endpoint=EDRV_Drive_SOMEIP_AEP, consumed-event-group=AllEvg, multicast-threshold=2
          SD_Drive_MC_AEP: multicast-connector=[HPCM/VLAN_Drive, EDRV/VLAN_Drive]
            application endpoint SD_Drive_MC_AEP: network-endpoint=SD_Drive_MC_NEP, tp-configuration=udp-tp=udp-tp-port=port-number=30490
      vlan VLAN_Drive: vlan-identifier=3
package /ECU
  ecu instance EDRV
    ethernet communication controller EDRV_VehicleNetwork: mac-unicast-address=02:00:00:00:00:0A
    ethernet communication connector VLAN_Drive: comm-controller=EDRV_VehicleNetwork, network-endpoint=[EDRV_Drive_NEP, SD_Drive_MC_NEP]
  ecu instance HPCM
    ethernet communication controller HPCM_VehicleNetwork: mac-unicast-address=02:00:00:00:00:01
    ethernet communication connector VLAN_Drive: comm-controller=HPCM_VehicleNetwork, network-endpoint=[HPCM_Drive_NEP, SD_Drive_MC_NEP]
package /PDU
  general purpose pdu SD_PDU: category=SD, length=1472
  pdu MotorState: length=16, unused-bit-pattern=0
    signal MotorState: start 0, 128 bit, little-endian, data-transformations=SOMEIPData, data-type-policy=TRANSFORMING-I-SIGNAL, someip-transformation-i-signal-props{transformer=SOMEIP, interface-version=1, size-of-array-length-fields=4, size-of-struct-length-fields=4, size-of-union-length-fields=4}, transfer-property=TRIGGERED, to HPCM
  pdu PowerBoostResponse: length=16, unused-bit-pattern=0
    signal PowerBoostResponse: start 0, 128 bit, little-endian, data-transformations=SOMEIPData, data-type-policy=TRANSFORMING-I-SIGNAL, someip-transformation-i-signal-props{transformer=SOMEIP, interface-version=1, size-of-array-length-fields=4, size-of-struct-length-fields=4, size-of-union-length-fields=4}, transfer-property=TRIGGERED, to HPCM
  pdu Mode_Notifier: length=16, unused-bit-pattern=0
    signal Mode_Notifier: start 0, 128 bit, little-endian, data-transformations=SOMEIPData, data-type-policy=TRANSFORMING-I-SIGNAL, someip-transformation-i-signal-props{transformer=SOMEIP, interface-version=1, size-of-array-length-fields=4, size-of-struct-length-fields=4, size-of-union-length-fields=4}, transfer-property=TRIGGERED, to HPCM
  pdu Mode_GetterResp: length=16, unused-bit-pattern=0
    signal Mode_GetterResp: start 0, 128 bit, little-endian, data-transformations=SOMEIPData, data-type-policy=TRANSFORMING-I-SIGNAL, someip-transformation-i-signal-props{transformer=SOMEIP, interface-version=1, size-of-array-length-fields=4, size-of-struct-length-fields=4, size-of-union-length-fields=4}, transfer-property=TRIGGERED, to HPCM
  pdu Mode_SetterResp: length=16, unused-bit-pattern=0
    signal Mode_SetterResp: start 0, 128 bit, little-endian, data-transformations=SOMEIPData, data-type-policy=TRANSFORMING-I-SIGNAL, someip-transformation-i-signal-props{transformer=SOMEIP, interface-version=1, size-of-array-length-fields=4, size-of-struct-length-fields=4, size-of-union-length-fields=4}, transfer-property=TRIGGERED, to HPCM
  pdu PowerBoostRequest: length=16, unused-bit-pattern=0
    signal PowerBoostRequest: start 0, 128 bit, little-endian, data-transformations=SOMEIPData, data-type-policy=TRANSFORMING-I-SIGNAL, someip-transformation-i-signal-props{transformer=SOMEIP, interface-version=1, size-of-array-length-fields=4, size-of-struct-length-fields=4, size-of-union-length-fields=4}, transfer-property=TRIGGERED, to EDRV
  pdu Mode_GetterRqst: length=16, unused-bit-pattern=0
    signal Mode_GetterRqst: start 0, 128 bit, little-endian, data-transformations=SOMEIPData, data-type-policy=TRANSFORMING-I-SIGNAL, someip-transformation-i-signal-props{transformer=SOMEIP, interface-version=1, size-of-array-length-fields=4, size-of-struct-length-fields=4, size-of-union-length-fields=4}, transfer-property=TRIGGERED, to EDRV
  pdu Mode_SetterRqst: length=16, unused-bit-pattern=0
    signal Mode_SetterRqst: start 0, 128 bit, little-endian, data-transformations=SOMEIPData, data-type-policy=TRANSFORMING-I-SIGNAL, someip-transformation-i-signal-props{transformer=SOMEIP, interface-version=1, size-of-array-length-fields=4, size-of-struct-length-fields=4, size-of-union-length-fields=4}, transfer-property=TRIGGERED, to EDRV
package /SystemMapping
  system System
    system mapping SystemMapping
      data-mappings:
        sender-receiver-to-signal-mapping={event-handler=AllEvg, service-instance=DrivingPSI1, data-element=MotorState, system-signal=MotorState}
        sender-receiver-to-signal-mapping={event-handler=AllEvg, service-instance=DrivingPSI1, data-element=Mode_Notifier, system-signal=Mode_Notifier}
        client-server-to-signal-mapping={service-instance=DrivingPSI1, call-signal=PowerBoostRequest, client-server-operation=PowerBoost, return-signal=PowerBoostResponse}
        client-server-to-signal-mapping={service-instance=DrivingPSI1, call-signal=Mode_GetterRqst, client-server-operation=Mode_Getter, return-signal=Mode_GetterResp}
        client-server-to-signal-mapping={service-instance=DrivingPSI1, call-signal=Mode_SetterRqst, client-server-operation=Mode_Setter, return-signal=Mode_SetterResp}
  sender receiver interface SenderReceiver
    data MotorState: type=MotorStateEvt
    data Mode_Notifier: type=DriveMode
package /ClientServerInterface
  client server interface Driving: category=CONTROL, is-service=true
    operation PowerBoost
      arg Power: type=Power, direction=IN
      arg ConfirmedPower: type=Power, direction=OUT
    operation Mode_Getter
      arg Mode: type=DriveMode, direction=OUT
    operation Mode_Setter
      arg Mode: type=DriveMode, direction=IN
package /ServiceInterface
  collection Driving: category=SET, element-role=SO_SERVICE_INTERFACE, element=[MotorState, PowerBoost, Mode]
  collection Mode: category=SET, element-role=SO_SERVICE_FIELD, element=[Mode_Notifier, Mode_Getter, Mode_Setter]
package /ADT
  application record data type MotorStateEvt: category=STRUCTURE
    4 x application record element, all with category=VALUE:
      Temperature: type=Temperature
      Speed: type=Speed
      Torque: type=Torque
      Current: type=Current
  6 x app type, all with category=VALUE:
    Temperature: base-type=UInt16
    Speed: base-type=UInt16
    Torque: base-type=UInt16
    Current: base-type=UInt16
    Power: base-type=UInt16
    DriveMode: base-type=UInt8
package /IDT
  7 x impl type:
    MotorStateEvt: category=STRUCTURE
      4 x element, all with category=TYPE_REFERENCE:
        Temperature: implementation-data-type=Temperature
        Speed: implementation-data-type=Speed
        Torque: implementation-data-type=Torque
        Current: implementation-data-type=Current
    Temperature: category=VALUE, base-type=UInt16, compu {phys=raw*0.1-272; unit °C}
    Speed: category=VALUE, base-type=UInt16, compu {phys=raw*0.1-100; unit km/h}
    Torque: category=VALUE, base-type=UInt16, compu {phys=raw*0.1; unit Nm}
    Current: category=VALUE, base-type=UInt16, compu {phys=raw*0.001; unit A}
    Power: category=VALUE, base-type=UInt16, compu {phys=raw*0.001; unit W}
    DriveMode: category=VALUE, base-type=UInt8, compu {1=Eco, 2=Comfort, 3=Race}
package /DataTypeMapping
  data type mapping set DatatypeMappingSet
    data-type-maps:
      application-data-type=MotorStateEvt, implementation-data-type=MotorStateEvt
      application-data-type=DriveMode, implementation-data-type=DriveMode
      application-data-type=Temperature, implementation-data-type=Temperature
      application-data-type=Speed, implementation-data-type=Speed
      application-data-type=Torque, implementation-data-type=Torque
      application-data-type=Current, implementation-data-type=Current
      application-data-type=Power, implementation-data-type=Power
      application-data-type=DriveMode, implementation-data-type=DriveMode
package /Unit
  5 x unit:
    DegUnit: display-name=°C
    SpeedUnit: display-name=km/h
    NmUnit: display-name=Nm
    AUnit: display-name=A
    WUnit: display-name=W
package /RoutingGroups
  6 x so ad routing group:
    PowerBoostRequest0
    PowerBoostResponse0
    Mode_Getter0
    Mode_Setter0
    DrivingPSI1
    DrivingPSI1AllEvg: event-group-control-type=ACTIVATION-UNICAST
package /BaseType
  8 x base type:
    Int8: category=FIXED_LENGTH, base-type-size=8, base-type-encoding=2C
    Int16: category=FIXED_LENGTH, base-type-size=16, base-type-encoding=2C
    Int32: category=FIXED_LENGTH, base-type-size=32, base-type-encoding=2C
    Int64: category=FIXED_LENGTH, base-type-size=64, base-type-encoding=2C
    Bool: category=FIXED_LENGTH, base-type-size=8, base-type-encoding=BOOLEAN
    ASCIIString: base-type-size=8, base-type-encoding=ISO-8859-1
    UTF8String: base-type-size=8, base-type-encoding=UTF-8
    UTF16String: base-type-size=16, base-type-encoding=UTF-16, byte-order=big-endian
package /Transformer
  data transformation set TransformationSet
    data transformation SOMEIPData: execute-despite-data-unavailability=false, transformer-chain=SOMEIP
    transformation technology SOMEIP: buffer-properties={header-length=64, in-place=false}, protocol=SOMEIP, someip-transformation-description{alignment=8, byte-order=little-endian, interface-version=1}, transformer-class=SERIALIZER, version=1
