/*@!Encoding:1252*/

/* 
   Consumer side CAPL application model for service 'Calculator'
   This model calls a method and prints the result
   Additionally, the value of the event 'State' is printed
*/

// Call method 'Add' of service 'Calculator' when key '+' is pressed 
on key '+'
{
  EthernetCluster::Calculator_Client::Calculator.Add.CallAsync(3,6);
}

// Call method 'Substract' of service 'Calculator' when key '-' is pressed
on key '-'
{
  EthernetCluster::Calculator_Client::Calculator.Subtract.CallAsync(8,6);
}

// Call method 'Divide' of service 'Calculator' when key '/' is pressed
on key '/'
{
  EthernetCluster::Calculator_Client::Calculator.Divide.CallAsync(8,4);
}

// Call method 'Multiply' of service 'Calculator' when key '*' is pressed
on key '*'
{
  EthernetCluster::Calculator_Client::Calculator.Multiply.CallAsync(3,9);
}

// This handler is called when the return value of method 'Add' of service 'Calculator' is received
on fct_returned EthernetCluster::Calculator_Client::Calculator.Add {
  write("Result of Add method: %f", this.res); // Print result in the Write Window of CANoe
}

on fct_returned EthernetCluster::Calculator_Client::Calculator.Subtract {
  write("Result of Substract method: %f", this.res); // Print result in the Write Window of CANoe
}

on fct_returned EthernetCluster::Calculator_Client::Calculator.Divide {
  write("Result of Divide method: %f", this.res); // Print result in the Write Window of CANoe
}

on fct_returned EthernetCluster::Calculator_Client::Calculator.Multiply {
  write("Result of Multiply method: %f", this.res); // Print result in the Write Window of CANoe
}

// This handler is called when the value of the event 'State' changed
on value_change EthernetCluster::Calculator_Client::Calculator.State
{
  write("State event received. AddCount: %d, SubtractCount: %d, MultiplyCount: %d, DivideCount: %d", 
    $EthernetCluster::Calculator_Client::Calculator.State.State.AddCount,
    $EthernetCluster::Calculator_Client::Calculator.State.State.SubtractCount,
    $EthernetCluster::Calculator_Client::Calculator.State.State.MultiplyCount,
    $EthernetCluster::Calculator_Client::Calculator.State.State.DivideCount);
}
