/*@!Encoding:1252*/

/* 
   Provider side CAPL application model for service 'Calculator'
   This model implements all methods and events of the service
*/

variables
{
  msTimer stateEventTimer; // Timer for event transmission
  int gAddCount;           // Number of add operations
  int gSubtractCount;      // Number of subtract operations
  int gMultiplyCount;      // Number of multiply operations
  int gDivideCount;        // Number of divide operations
}

on start
{
  // Set timer to cyclic interval of 1000 milliseconds
  setTimerCyclic(stateEventTimer, 1000);
}

on timer stateEventTimer
{
  // Update state event. This will also trigger the transmission of the event
  $EthernetCluster::Calculator_Server::Calculator.State.State.AddCount = gAddCount;
  $EthernetCluster::Calculator_Server::Calculator.State.State.SubtractCount = gSubtractCount;
  $EthernetCluster::Calculator_Server::Calculator.State.State.MultiplyCount = gMultiplyCount;
  $EthernetCluster::Calculator_Server::Calculator.State.State.DivideCount = gDivideCount;
}

// Implementation for method 'Add'
on fct_called EthernetCluster::Calculator_Server::Calculator.Add
{
  this.res = this.operand1 + this.operand2; // Calculate result
  gAddCount++;                                 // Update counter
  this.ReturnCall();                           // Return result
}

// Implementation for method 'Subtract'
on fct_called EthernetCluster::Calculator_Server::Calculator.Subtract
{
  this.res = this.operand1 - this.operand2;
  gSubtractCount++;
  this.ReturnCall();
}

// Implementation for method 'Multiply'
on fct_called EthernetCluster::Calculator_Server::Calculator.Multiply
{
  this.res = this.operand1 * this.operand2;
  gMultiplyCount++;
  this.ReturnCall();
}

// Implementation for method 'Divide'
on fct_called EthernetCluster::Calculator_Server::Calculator.Divide
{
  // Prevent division by zero
  if (this.operand2 != 0.0)
  {
    this.res = this.operand1 / this.operand2;
  }
  else
  {
	  if (this.operand1 > 0.0)
	  {
		  this.res = atodbl("INF");
	  } 
	  else if (this.operand1 < 0.0)
	  {
  		this.res = atodbl("-INF");
  	}
  	else
	  {
		  this.res = atodbl("NaN");
    }
  }
  
  gDivideCount++;
  this.ReturnCall();
}
