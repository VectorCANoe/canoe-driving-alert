AUTOSAR XML (schema 00049)
standard types defined: sint32, uint32, float32
package /Vector/ECU
  machine design Provider: service-discover-configs=someip-service-discovery={multicast-sd-ip-address=NEP_Multicast, someip-service-discovery-port=30490}
    ethernet communication connector Connector: unicast-network-endpoint=NEP_192_168_1_1
  machine design Consumer: service-discover-configs=someip-service-discovery={multicast-sd-ip-address=NEP_Multicast, someip-service-discovery-port=30490}
    ethernet communication connector Connector: unicast-network-endpoint=NEP_192_168_1_2
package /Vector/Cluster
  ethernet cluster EthernetCluster: baudrate=100000000, protocol-name=ETHERNET
    ethernet physical channel SomeIp: comm-connectors=[Provider/Connector, Consumer/Connector]
      network endpoint NEP_192_168_1_1: network-endpoint-addresses=ipv-4-configuration={ipv-4-address=192.168.1.1, ipv-4-address-source=FIXED, network-mask=255.255.255.0}
      network endpoint NEP_192_168_1_2: network-endpoint-addresses=ipv-4-configuration={ipv-4-address=192.168.1.2, ipv-4-address-source=FIXED, network-mask=255.255.255.0}
      network endpoint NEP_Multicast: network-endpoint-addresses=ipv-4-configuration=ipv-4-address=239.0.0.1
package /Vector/ServiceInterfaces
  service interface Calculator
    events:
      data State: type=StateType
    methods:
      4 x operation:
        Add
          arg operand1: type=Int32, direction=IN
          arg operand2: type=Int32, direction=IN
          arg result: type=Float32, direction=OUT
        Subtract
          arg operand1: type=Int32, direction=IN
          arg operand2: type=Int32, direction=IN
          arg result: type=Float32, direction=OUT
        Multiply
          arg operand1: type=Int32, direction=IN
          arg operand2: type=Int32, direction=IN
          arg result: type=Float32, direction=OUT
        Divide
          arg operand1: type=Int32, direction=IN
          arg operand2: type=Int32, direction=IN
          arg result: type=Float32, direction=OUT
package /Vector/ServiceInterfaces/deployment
  someip service interface deployment Calculator: service-interface=Calculator, service-interface-id=1666, service-interface-version={major-version=0, minor-version=1}
    someip event deployment State: event=State, event-id=8001, serializer=SOMEIP, transport-protocol=UDP
    4 x someip method deployment, all with transport-protocol=UDP:
      Add: method=Add, method-id=1
      Subtract: method=Subtract, method-id=2
      Multiply: method=Multiply, method-id=3
      Divide: method=Divide, method-id=4
    someip event group EventGroup: event-group-id=1, event=State
package /Vector/ServiceInterfaces/instance
  provided someip service instance Calculator: service-interface-deployment=Calculator, sd-server-config=ServerSd_Calculator_ProvidedSomeipServiceInstance, service-instance-id=1
    someip provided event group EventGroup: event-group=EventGroup, multicast-threshold=0
  required someip service instance CalculatorConsumer: service-interface-deployment=Calculator, required-service-instance-id=1, sd-client-config=No_Name
    someip required event group EventGroup: event-group=EventGroup
package /Vector/ServiceInterfaces/SomeipSdTimingConfigs
  someip sd server service instance config ServerSd_Calculator_ProvidedSomeipServiceInstance: initial-offer-behavior={initial-delay-max-value=0, initial-delay-min-value=0, initial-repetitions-base-delay=0.15, initial-repetitions-max=2}, offer-cyclic-delay=3, request-response-delay={max-value=0, min-value=0}, service-offer-time-to-live=10
  someip sd client service instance config No_Name: initial-find-behavior={initial-delay-max-value=0, initial-delay-min-value=0, initial-repetitions-base-delay=0.02, initial-repetitions-max=5}, service-find-time-to-live=10
package /Vector/ServiceInterfaces/ServiceMapping
  someip service instance to machine mapping CalculatorProviderMachineMapping: communication-connector=Provider/Connector, service-instance=Calculator, udp-port=40000
  someip service instance to machine mapping CalculatorConsumerMachineMapping: communication-connector=Consumer/Connector, service-instance=CalculatorConsumer, udp-port=40000
package /Vector/DataTypes/Implementation
  4 x std cpp implementation data type:
    StateType: category=STRUCTURE, sw-calibration-access=READ-ONLY, type-emitter=RTE
      4 x cpp implementation data type element, all with category=TYPE_REFERENCE, type-reference=Int32:
        AddCount
        SubtractCount
        MultiplyCount
        DivideCount
    Int32: category=VALUE, base-type=sint32
    UInt32: category=VALUE, base-type=uint32
    Float32: category=VALUE, base-type=float32
package /Vector/ServiceSerialization
  transformation props set SOME_IP_8Bit
    ap someip transformation props TransProps: alignment=8, byte-order=little-endian, size-of-array-length-field=0
