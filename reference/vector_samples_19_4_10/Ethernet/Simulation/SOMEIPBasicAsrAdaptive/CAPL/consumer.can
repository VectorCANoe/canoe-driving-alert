/*@!Encoding:1252*/

/* 
   Consumer side CAPL application model for service 'Calculator'
   This model calls a method and prints the result
   Additionally, the value of the event 'State' is printed
*/



// Call method 'Add' of service 'Calculator' when key 'c' is pressed 
on key '+'
{
  EthernetCluster::Consumer::CalculatorConsumer.Add.CallAsync(3,6);
//  CommunicationObjects::Calculator[Consumer,Provider].Add.CallAsync(3,6);
}

on key '-'
{
  EthernetCluster::Consumer::CalculatorConsumer.Subtract.CallAsync(8,6);
//  CommunicationObjects::Calculator[Consumer,Provider].Add.CallAsync(3,6);
}

on key '/'
{
  EthernetCluster::Consumer::CalculatorConsumer.Divide.CallAsync(8,4);
//  CommunicationObjects::Calculator[Consumer,Provider].Add.CallAsync(3,6);
}

on key '*'
{
  EthernetCluster::Consumer::CalculatorConsumer.Multiply.CallAsync(3,9);
//  CommunicationObjects::Calculator[Consumer,Provider].Add.CallAsync(3,6);
}

// This handler is called when the return value of method 'Add' of service 'Calculator' is received
on fct_returned EthernetCluster::Consumer::CalculatorConsumer.Add {
  write("Result of Add method: %f", this.result); // Print result in the Write Window of CANoe
}

on fct_returned EthernetCluster::Consumer::CalculatorConsumer.Subtract {
  write("Result of Substract method: %f", this.result); // Print result in the Write Window of CANoe
}

on fct_returned EthernetCluster::Consumer::CalculatorConsumer.Divide {
  write("Result of Divide method: %f", this.result); // Print result in the Write Window of CANoe
}

on fct_returned EthernetCluster::Consumer::CalculatorConsumer.Multiply {
  write("Result of Multiply method: %f", this.result); // Print result in the Write Window of CANoe
}

// This handler is called when the value of the event 'State' changed
on value_change EthernetCluster::Consumer::CalculatorConsumer.State
{
  write("State event received. AddCount: %d, SubtractCount: %d, MultiplyCount: %d, DivideCount: %d", 
    $EthernetCluster::Consumer::CalculatorConsumer.State.AddCount,
    $EthernetCluster::Consumer::CalculatorConsumer.State.SubtractCount,
    $EthernetCluster::Consumer::CalculatorConsumer.State.MultiplyCount,
    $EthernetCluster::Consumer::CalculatorConsumer.State.DivideCount);
}
