/*@!Encoding:1252*/

/* 
   Provider side CAPL application model for service 'Calculator'
   This model implements all methods and events of the service
*/

variables
{
  msTimer stateEventTimer; // Timer for event transmission
  int gAddCount;           // Number of add operations
  int gSubtractCount;      // Number of subtract operations
  int gMultiplyCount;      // Number of multiply operations
  int gDivideCount;        // Number of divide operations
}


on start
{
  // Set timer to cyclic interval of 1000 milliseconds
  setTimerCyclic(stateEventTimer, 1000);
}

on timer stateEventTimer
{
  // Update state event. This will also trigger the transmission of the event
  $EthernetCluster::Provider::Calculator.State.AddCount = gAddCount;
  $EthernetCluster::Provider::Calculator.State.SubtractCount = gSubtractCount;
  $EthernetCluster::Provider::Calculator.State.MultiplyCount = gMultiplyCount;
  $EthernetCluster::Provider::Calculator.State.DivideCount = gDivideCount;
}

// Implementation for method 'Add'
on fct_called EthernetCluster::Provider::Calculator.Add
{
  this.result = this.operand1 + this.operand2; // Calculate result
  gAddCount++;                                 // Update counter
  this.ReturnCall();                           // Return result
}

// Implementation for method 'Subtract'
on fct_called EthernetCluster::Provider::Calculator.Subtract
{
  this.result = this.operand1 - this.operand2;
  gSubtractCount++;
  this.ReturnCall();
}

// Implementation for method 'Multiply'
on fct_called EthernetCluster::Provider::Calculator.Multiply
{
  this.result = this.operand1 * this.operand2;
  gMultiplyCount++;
  this.ReturnCall();
}

// Implementation for method 'Divide'
on fct_called EthernetCluster::Provider::Calculator.Divide
{
  // Prevent division by zero
  if (this.operand2 != 0.0)
  {
    this.result = this.operand1 / this.operand2;
  }
  else
  {
	if (this.operand1 > 0.0)
	{
		this.result = atodbl("INF");
	}
	else if (this.operand1 < 0.0)
	{
		this.result = atodbl("-INF");
	}
	else
	{
		this.result = atodbl("NaN");
	}
  }
  gDivideCount++;
  this.ReturnCall();
}