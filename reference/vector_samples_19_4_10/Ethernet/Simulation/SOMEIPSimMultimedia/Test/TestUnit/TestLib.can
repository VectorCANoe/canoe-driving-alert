/*@!Encoding:1252*/
includes
{
}

variables
{
  dword gPeakLevelTime  = 0;
  byte  gFirstPeakLevel = 0;
}

export testcase TC_Observe()
{
  // wait until end of measurements
  // checks are done in 'on someipMessage' and 'on someipSD'
  testWaitForMeasurementEnd(0);
}

void CheckSOMEIPHeader( someipMessage * msg )
{
  if(msg.Length < 8)
  {
    testStepFail("CheckSOMEIPHeader", "SOME/IP message too short. Only %d bytes", msg.Length);
  }
  
  if (msg.ReturnCode != 0)
  {    
    testStepFail("CheckSOMEIPHeader", "SOME/IP return code is %d, but 0 expected", msg.ReturnCode );
    return;
  }
}

on someipMessage CDPlayer::ActiveDisk
{
  CheckSOMEIPHeader( this );
}

on someipMessage CDPlayer::DeckStatus
{
  CheckSOMEIPHeader( this );
}

on someipMessage CDPlayer::set_DeckStatus
{
  CheckSOMEIPHeader( this );

  if (this.Byte(3) >= 7)
  {
    testStepFail("on someipMessage CDPlayer::set_DeckStatus", "set_DeckStatus %d is auf of range 0..6", this.Byte(3) );
  }
}

on someipMessage CDPlayer::DecrementDisc
{
  CheckSOMEIPHeader( this );
}

on someipMessage CDPlayer::DecrementTrack
{
  CheckSOMEIPHeader( this );
}

on someipMessage CDPlayer::IncrementDisc
{
  CheckSOMEIPHeader( this );
}

on someipMessage CDPlayer::IncrementTrack
{
  CheckSOMEIPHeader( this );
}

on someipMessage CDPlayer::MagazineStatus
{
  CheckSOMEIPHeader( this );
}

on someipMessage CDPlayer::MediaInfo
{
  CheckSOMEIPHeader( this );
}

on someipMessage CDPlayer::get_MediaInfo
{
  CheckSOMEIPHeader( this );
}

on someipMessage CDPlayer::set_MediaInfo
{
  CheckSOMEIPHeader( this );
}

on someipMessage ethernetPort::MM::HeadUnit.CDPlayer::PeakLevel
{
  dword time;
  
  CheckSOMEIPHeader( this );
  
  time = timeNow();
  
  if (gFirstPeakLevel != 0 && time - gPeakLevelTime < 25000)
  {
    testStepFail("on someipMessage CDPlayer::PeakLevel", "Service CD_Player: Peak level cycle time too low: %d ms!", (time - gPeakLevelTime) / 100);
  }
  
  gPeakLevelTime  = time;
  gFirstPeakLevel = 1;
}
  
on someipMessage CDPlayer::TimePosition
{
  CheckSOMEIPHeader( this );
}

on someipMessage CDPlayer::TrackPosition
{
  CheckSOMEIPHeader( this );
  
  gPeakLevelTime = 0;
}

on someipMessage Navigation::Position
{
  CheckSOMEIPHeader( this );
}

on someipMessage TVReceiver::`Start
{
  CheckSOMEIPHeader( this );
}

on someipMessage TVReceiver::Stop
{
  CheckSOMEIPHeader( this );
}

on someipMessage ServiceDiscovery
{
}

on someipMessage *
{
  // if other, more specific 'on someipMessage' handlers are not called, this
  // handler is called.
  
  testStepFail("on someipMessage", "Unexpected SOME/IP message detected, Service ID %d, Method ID %d", this.ServiceID, this.MethodID );
}

on someipSD CDPlayer
{
  if ((this.Type == 1) && (this.MinorVersion > 0))
  {       
    testStepFail("on someipSD CDPlayer", "OfferService CDPlayer offers wrong minor version: %d", this.MinorVersion);
    return;
  }
}

on someipSD Navigation
{
  if ((this.Type == 1) && (this.MinorVersion > 0))
  {       
    testStepFail("on someipSD Navigation", "OfferService Navigation offers wrong minor version: %d", this.MinorVersion);
    return;
  }
}

on someipSD TVReceiver
{
  if ((this.Type == 1) && (this.MinorVersion > 0))
  {       
    testStepFail("on someipSD TVReceiver", "OfferService TVReceiver offers wrong minor version: %d", this.MinorVersion);
    return;
  }
}

on someipSD *
{
  // if other, more specific 'on someipSD' handlers are not called, this handler is called.

  switch(this.Type)
  {
    case 1: // OfferService
      testStepFail("on someipSD *", "Unknown service ID %d offered", this.ServiceID);
      break;
    case 0: // FindService
      testStepFail("on someipSD *", "Unknown service ID %d required", this.ServiceID);
      break;
  }
}
