/*@!Encoding:1252*/
includes
{
}

variables
{
  const long  kMedia_OK                      = kOK;
  const long  kMedia_InvalidHandle           = kInvalidHandle;
  const dword kMedia_NotAccepting            = 0xC00D36B5;
  const dword kMedia_TransformNeedsMoreInput = 0xC00D6D72;
  
  const dword kMedia_SourceReaderFlagError                    = 0x00000001;
  const dword kMedia_SourceReaderFlagEndOfStream              = 0x00000002;
  const dword kMedia_SourceReaderFlagNewStream                = 0x00000004;
  const dword kMedia_SourceReaderFlagNativeMediaTypeChanged   = 0x00000010;
  const dword kMedia_SourceReaderFlagCurrentMediaTypeChanged  = 0x00000020;
  const dword kMedia_SourceReaderFlagStreamTick               = 0x00000100;
  const dword kMedia_SourceReaderFlagAllEffectsRemoved        = 0x00000200;
  
  const dword kMedia_StreamIndexFirstVideoStream = 0xFFFFFFFC; /* The first video stream */
  const dword kMedia_StreamIndexFirstAudioStream = 0xFFFFFFFD; /* The first audio stream */
  const dword kMedia_StreamIndexAllStreams = 0xFFFFFFFE;       /* All streams */
  
  const long  kMedia_H264NALUTypeSPS = 7;
  
  enum Media_AudioChannelMaskFlags
  {
    SpeakerFrontLeft = 0x01,
    SpeakerFrontRight = 0x02,
    SpeakerFrontCenter = 0x04,
    SpeakerLowFrequency = 0x08,
    SpeakerBackLeft = 0x10,
    SpeakerBackRight = 0x20,
    SpeakerFrontLeftCenter = 0x40,
    SpeakerRightOfCenter = 0x80,
    SpeakerBackCenter = 0x100,
    SpeakerSideLeft = 0x200,
    SpeakerSideRight = 0x400,
    SpeakerTopCenter = 0x800,
    SpeakerTopFrontLeft = 0x1000,
    SpeakerTopFrontCenter = 0x2000,
    SpeakerTopFrontRight = 0x4000,
    SpeakerTopBackLeft = 0x8000,
    SpeakerTopBackCenter = 0x10000,
    SpeakerTopBackRight = 0x20000
  };
}

long Media_CheckHandleAndStopIfError(dword handle, char function[])
{
  char text[256];
  
  if (handle == kMedia_InvalidHandle)
  {
    strncpy(text, function, elCount(text));
    strncat(text, " returned 0, MediaGetLastError", elCount(text));
    
    return Avb_StopIfError(MediaGetLastError(), text);
  }
  
  return kMedia_OK;
}

long Media_StopIfError(long returnCode, char function[])
{
  if (returnCode != kMedia_OK)
  {
    Media_WriteErrorAndStop(returnCode, function);
    return returnCode;
  }
  
  return kMedia_OK;
}

void Media_WriteErrorAndStop(char text[], long errorCode)
{
  char textOut[256];
  long ret;
    
  PrependCaplFileName(text, textOut);
  
  snprintf(text, elCount(text), "%d", errorCode);
  strncat(textOut, text, elCount(textOut));
  
  write(textOut);
  Stop();
}

void Media_WriteErrorAndStop(long errorCode, char function[])
{
  char text[256];
  
  snprintf(text, elCount(text), "%s returned ", function);
 
  Media_WriteErrorAndStop(text, errorCode);
}