/*@!Encoding:1252*/
variables
{
  const dword kBufLength = 100000;
  
  byte gBuffer[kBufLength];
  
  dword gClientHandle[long],
        gFileHandle[long];
  
  msTimer gRestartTimer;
  dword   gRestartTalkerHandle;
  
  char gWavFileName[1024];
}

on timer gRestartTimer
{
  Talker_StopRead(gRestartTalkerHandle);
  Talker_StartRead(gRestartTalkerHandle);
  
  Talker_Read(gRestartTalkerHandle, gBuffer);
  
  gRestartTalkerHandle = kInvalidHandle;
}

void OnAvbSend(dword talkerHandle, dword result, byte buffer[], dword length)
{
  if (result != kOK)
  {
    Avb_WriteErrorAndStop(result, "OnAvbSend");
    return;
  }
    
  Talker_Read(talkerHandle, buffer);
}

void OnMediaRead(dword sourceReaderHandle, long result, dword streamIndex, dword streamFlags, int64 timestamp, byte buffer[], dword length)
{  
  if (result != 0)
  {
    Avb_WriteErrorAndStop(result, "OnMediaRead");
    return;
  }
  
  if (streamFlags == 2)
  {
    // End of file -> repeat
    
    gRestartTalkerHandle = gClientHandle[sourceReaderHandle];
    setTimer(gRestartTimer, 0);
    
    return;
  }
  
  Talker_Send(gClientHandle[sourceReaderHandle], buffer, length);
}

long Talker_StartRead(long talkerHandle)
{
  long ret;
  dword sourceReaderHandle;
  
  sourceReaderHandle = MediaCreateSourceReaderFromUrl(gWavFileName);

  gFileHandle[talkerHandle] = sourceReaderHandle;
  
  if (sourceReaderHandle != kAvb_InvalidHandle)
  {
    gClientHandle[sourceReaderHandle] = talkerHandle;
  }
  
  return kAvb_OK;
}

void Talker_StopRead(long talkerHandle)
{
  long ret;
  
  if (gFileHandle[talkerHandle] != 0)
  {
    ret = MediaReleaseSourceReader(gFileHandle[talkerHandle]);
    
    if (Avb_StopIfError(ret, "MediaReleaseSourceReader") != 0)
    {
      return;
    }
  }
}

void Talker_Read(dword talkerHandle, byte buffer[])
{
  dword ret, length;
    
  length = elCount(buffer);
  
  if (gFileHandle[talkerHandle] != kAvb_InvalidHandle)
  {
    ret = MediaRead(gFileHandle[talkerHandle], 0, buffer, length, "OnMediaRead");
     
    if (Avb_StopIfError(ret, "MediaRead") != 0)
    {
      return;
    }
  }
}

dword Talker_Start(byte destinationAddress[], char wavFileName[], dword& talkerHandle, char onConnectCallback[])
{
  long ret;
  
  talkerHandle = AvbOpenTalker();
    
  if (Avb_CheckHandleAndStopIfError(talkerHandle, "AvbOpenTalker") != 0)
  {
    return -1;
  }
  
  strncpy(gWavFileName, wavFileName, elCount(gWavFileName) - 1);
  
  ret = Talker_StartRead(talkerHandle);
  
  if (Avb_StopIfError(ret, "Talker_StartRead") != 0)
  {
    return ret;
  }
  
  ret = AvbConnect(talkerHandle, destinationAddress, onConnectCallback);
  
  if (Avb_StopIfError(ret, "AvbConnect") != 0)
  {
    return ret;
  }
  
  return ret;
}

void Talker_Stop(dword talkerHandle)
{
  long ret;
  
  Talker_StopRead(talkerHandle);
    
  if (talkerHandle != 0)
  {
    ret = AvbCloseTalker(talkerHandle);
    
    if (Avb_StopIfError(ret, "AvbCloseTalker") != 0)
    {
      return;
    }
  }
}

void Talker_Send(dword talkerHandle, byte buffer[], dword length)
{
  long ret;
  
  ret = AvbSend(talkerHandle, buffer, length, "OnAvbSend");
  
  switch (ret)
  {
    case kAvb_DataOmmitted:
      Write("Samples ommitted (delivered too late to AvbSend)");
    case kAvb_OK:
      Talker_Read(talkerHandle, buffer);
      break;
    case kAvb_IoPending:
      break;
    default:
      Avb_WriteErrorAndStop(ret, "AvbSend");
      break;
  }  
}