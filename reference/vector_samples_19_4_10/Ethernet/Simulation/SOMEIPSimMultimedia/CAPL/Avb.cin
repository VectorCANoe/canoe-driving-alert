/*@!Encoding:1252*/
includes
{
}

variables
{  
  enum Avb_Verbosity
  {
    kAvb_VerbositySilent = 0,
    kAvb_VerbosityError = 1,
    kAvb_VerbosityWarning = 2,
    kAvb_VerbosityInfo = 3
  };
  
  enum PtpPortRole
  {
    kPtp_PortRoleAuto = 0,
    kPtp_PortRoleMaster = 1,
    kPtp_PortRoleSlave = 2,
    kPtp_PortRolePassive = 3,
    kPtp_PortRoleDisabled = 4
  };
  
  const dword kAvb_OK = kOK;
  const dword kAvb_IoPending = 460609;
  const dword kAvb_InsufficientBuffer = 460607;
  const dword kAvb_DataOmmitted = 460611;
  const dword kAvb_PresentationTimeLessThanPacketTime = 460618;

  const dword kAvb_InvalidHandle = kInvalidHandle;
  
  const long kAvb_StreamSourceAddressSize = 6;
  const long kAvb_StreamUniqueIdSize = 2;
  const long kAvb_StreamIdSize = kAvb_StreamSourceAddressSize + kAvb_StreamUniqueIdSize;
}

long Avb_CheckHandleAndStopIfError(dword handle, char function[])
{
  char text[256];
  
  if (handle == kAvb_InvalidHandle)
  {
    strncpy(text, function, elCount(text));
    strncat(text, " returned 0, AvbGetLastError", elCount(text));
    
    return Avb_StopIfError(AvbGetLastError(), text);
  }
  
  return kAvb_OK;
}

long Avb_StopIfError(long returnCode, char function[])
{
  if (returnCode != kAvb_OK && returnCode != kAvb_IoPending)
  {
    Avb_WriteErrorAndStop(returnCode, function);
    return returnCode;
  }
  
  return kAvb_OK;
}

void Avb_WriteErrorAndStop(char text[], long errorCode)
{
  char textOut[256], lastErrorText[256];
  long ret;
    
  ret = AvbGetLastErrorText(elCount(lastErrorText), lastErrorText);
  
  if (ret == 0)
  {
    strncpy(lastErrorText, "AvbGetLastErrorText returned 0", elCount(lastErrorText));
  }
    
  PrependCaplFileName(text, textOut);
  
  snprintf(text, elCount(text), "%d (%s)", errorCode, lastErrorText);
  strncat(textOut, text, elCount(textOut));
  
  write(textOut);
  Stop();
}

void Avb_WriteErrorAndStop(long errorCode, char function[])
{
  char text[256];
  
  snprintf(text, elCount(text), "%s returned ", function);
 
  Avb_WriteErrorAndStop(text, errorCode);
}

long Avb_ParseStreamId(char streamId[], byte retStreamId[])
{
  long i, pos1, streamIdIndex, length;
  
  length = strlen(streamId);
    
  for (i = pos1 = streamIdIndex = 0; i < length; i++)
  {
    if (streamId[i] == ':' || streamId[i] == '.' || i == (length - 1))
    {
      char subStr[5] = "0x";
      long streamIdByte;
      int result;
      
      mbsubstr_cpy_off(subStr, 2, streamId, pos1, 2);
      
      result = strtol(subStr, streamIdByte);
      
      if (result < 0)
      {
        return -1;
      }
      
      retStreamId[streamIdIndex++] = streamIdByte;
      
      pos1 = i + 1;
    }
  }
  
  if (streamIdIndex != kAvb_StreamIdSize)
  {
    return -1;
  }
  
  return 0;
}