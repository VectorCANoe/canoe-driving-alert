/*@!Encoding:1252*/
includes
{
  #include "General.cin"
  #include "Media.cin"
  #include "Avb.cin"
  #include "FileTalker.cin"    
}

variables
{
  byte gTV_Rcv_StreamDestinationAddress[6] = { 0x91, 0xE0, 0xF0, 0x00, 0xFE, 0x01 };
  
  byte gTV_Rcv_StreamIdVideo[8] = { 0x91, 0xE0, 0xF0, 0x00, 0xFE, 0x01, 0x00, 0x01 };
  byte gTV_Rcv_StreamIdAudio[8] = { 0x91, 0xE0, 0xF0, 0x00, 0xFE, 0x01, 0x00, 0x02 };
  
  char gTV_Rcv_FilePath[44] = "Panels\\BMP\\Vector_Campus_Stuttgart-360p.mp4";
  
  dword gTV_Rcv_AudioTalkerHandle,
        gTV_Rcv_VideoTalkerHandle;
}

on start
{
  
}

on fct_called MM::TV_Receiver::TVReceiver_1_1.`Start
{
  long res;
  
  @sysvar::TV::PlayMode = 1;
  
  gTV_Rcv_VideoTalkerHandle = FileTalker_Open(2, gTV_Rcv_StreamIdVideo, gTV_Rcv_FilePath, kMedia_StreamIndexFirstVideoStream, 0, 1);
      
  if (Avb_CheckHandleAndStopIfError(gTV_Rcv_VideoTalkerHandle, "AvbSetProperty") != kAvb_OK)
  {
    return;
  }
  
  gTV_Rcv_AudioTalkerHandle = FileTalker_Open(2, gTV_Rcv_StreamIdAudio, gTV_Rcv_FilePath, kMedia_StreamIndexFirstAudioStream, 0, 1);
      
  if (Avb_CheckHandleAndStopIfError(gTV_Rcv_AudioTalkerHandle, "AvbSetProperty") != kAvb_OK)
  {
    return;
  }
  
  res = AvbSetProperty(gTV_Rcv_AudioTalkerHandle, "FramesPerPacket", 252);
  
  if (res != 0)
  {
    write("Error: Stop, AvbSetProperty fails with error code = %d", res);
    Stop();
    return;
  }
  
  FileTalker_Start(gTV_Rcv_VideoTalkerHandle, gTV_Rcv_StreamDestinationAddress);
  FileTalker_Start(gTV_Rcv_AudioTalkerHandle, gTV_Rcv_StreamDestinationAddress);
}

on fct_called MM::TV_Receiver::TVReceiver_1_1.`Stop
{  
  @sysvar::TV::PlayMode = 0;
    
  FileTalker_Stop(gTV_Rcv_AudioTalkerHandle);    
  FileTalker_Stop(gTV_Rcv_VideoTalkerHandle);
  
  FileTalker_Close(gTV_Rcv_AudioTalkerHandle);
  
  gTV_Rcv_AudioTalkerHandle = kAvb_InvalidHandle;
  
  if (gTV_Rcv_VideoTalkerHandle == kAvb_InvalidHandle)
  {
    return;
  }
  
  FileTalker_Close(gTV_Rcv_VideoTalkerHandle);
  
  gTV_Rcv_VideoTalkerHandle = kAvb_InvalidHandle;
}