/*@!Encoding:1252*/
/*
 * DHCP Client
 *
 * Copyright 2015, Vector Informatik GmbH - All right reserved
 *
 * The DHCP client checks cyclic its IP address and the gateway
 * address and writes the result to the panel.
 */
includes
{
  #include "Ethernet.cin"
  #include "Client.cin"
}

variables
{
  char clientNamespace[8] = "Client2";
}




