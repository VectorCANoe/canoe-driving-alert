/*@!Encoding:1252*/
/*
 * DHCP Server
 *
 * Copyright 2015, Vector Informatik GmbH - All right reserved
 *
 * The DHCP server offers ip addresses, masks and the default gateway
 * to the requesting clients.
 */

includes
{
  #include "Ethernet.cin"
  #include "dhcp.cin"
}

variables
{
  //
  // enums
  //
  enum VerbosityLevel
  {
    kVERBOSE_OFF = 0,
    kVERBOSE_ERROR,
    kVERBOSE_WARNING,
    kVERBOSE_INFO
  };
  
  enum dhcp_address_state
  {
    NOTAVAILABLE,
    NOTALLOCATED,
    TIMEDOUT,
    ALLOCATED
  };
  
  char gAddressStateNames[4][20] = 
  { 
    "NOTAVAILABLE",
    "NOTALLOCATED",
    "TIMEDOUT",
    "ALLOCATED"
  };
  
  //
  // structures
  //
  
  struct dhcp_lease{
    byte  clientMacId[6];                 // mac id of the dhcp client
    dword ipAddr;                         // ip address of the lease given by the dhcp server
    dword mask;                           // mask of the ip address
    dword time;                           // the lease time 
    dword router;                         // the router address
    enum dhcp_address_state addressState; // marking of the current address state
    dword expirationTime;                 // time when the lease expires
  };
  
  //
  // constants
  //
  const int   kLineLength        = 26;                                   // number of characters per line in the dhcp servers output console 
  const int   kMaxLines          = 20;                                   // maximum lines to display
  const int   gVerbosity         = kVERBOSE_ERROR;                       // the verbosity level
  const dword kBroadcastIpv4Addr = 0xFFFFFFFF;                           // broadcast IP address
  byte        kBroadcastMacId[6] = {0xFF, 0xFF, 0xFF, 0xFF, 0xFF, 0xFF}; // broadcast MAC id
  
  // 
  // global variables
  //  
  struct  dhcp_lease gLeases[char[]];     // list of all leases
  dword   gSocket;                        // udp socket opened on port 67 to avoid icmp error messages
  msTimer gUpdatePanelTimer;              // cyclic timer called every second to update the dhcp servers output console
}

/*
  The OnStart handler activates the dhcp server
*/
on Start
{
  const dword AF_INET = 2;   // IPv4 adapter family
  dword ifIdx;
  long result, ipv4AdrCount;
  Enable(@DHCPServer::Enable);
  
  @DHCPServer::VlanConfigured = 0;
  
  SetSysvarsForVlan(sysvar::DHCPServer::VlanConfigured, sysvar::DHCPServer::VlanTag);
  SetControlVisibility("DHCPServer", "VlanTag", @DHCPServer::VlanConfigured);
}

/*
  cyclic timer called every second to update the dhcp 
  servers output console
*/
on timer gUpdatePanelTimer
{
  UpdatePanel();
}

/*
  handler for the Enable/Disable button
*/
on sysvar DHCPServer::Enable
{
  Enable(@this);
}

/*
  Enable or disable the dhcp server

  enable - 1: Enable the dhcp server
           0: Disable the dhcp server
*/
void Enable(int enable)
{
   if(enable == @DHCPServer::Enable::On)
  {
    //BYTE emptyMacAddress[6] = { 0x00,0x00,0x00,0x00,0x00, 0x00};
    setBusContext(getBusNameContext("Ethernet"));
    //EthReceiveRawPacket( 0x7, emptyMacAddress, emptyMacAddress, 0x0000, "OnEthRawPacket" );
    gSocket = UdpOpen(0,67);
    setTimerCyclic(gUpdatePanelTimer, 0, 1000);
  }
  else
  {
    if(gSocket != 0)
    {
      UdpClose(gSocket);
    }
  }
}

on ethernetPacket ethernetPort::Ethernet::DhcpServer.*
{
  int error;
  
  if(this.dir == tx && // from the switch point of view it is a TX to our port
     @DHCPServer::Enable == @DHCPServer::Enable::On )
  {  
    if(this.dhcpv4.IsAvailable() && // check if it is a dhcp packet
       this.udp.IsAvailable() && this.udp.destination==67) // check port 67
    {     
      if(@DHCPServer::VlanConfigured && (this.HasVlan()==0 || this.GetVlanId()!=@DHCPServer::VlanTag))
      {
        if(gVerbosity >= kVERBOSE_INFO)
          writeLineEx(1, 1, "%BASE_FILE_NAME%: ignoring received DHCP packet with no or not matching vlan id.");
      }
      else if(@DHCPServer::VlanConfigured==0 && this.HasVlan())
      {
        if(gVerbosity >= kVERBOSE_INFO)
          writeLineEx(1, 1, "%BASE_FILE_NAME%: ignoring received DHCP packet with vlan id.");
      }
      else
      {
        if(gVerbosity >= kVERBOSE_INFO)
        {
          writeLineEx(1, 1, "%BASE_FILE_NAME%: received DHCP packet.");
        }

        if((error = ParseDhcp(this)) < 0 && gVerbosity >= kVERBOSE_ERROR)
        {
          writeLineEx(1, 3, "%BASE_FILE_NAME%: failed to parse DHCP packet. Error: %d", error);
        }
      }
    }
  }
}

/*
  Parse a dhcp packet and call the handler for the given message type

  dhcpMessage - the received dhcp messaqe
  dhcpSize    - size of the given dhcp message
*/
int ParseDhcp(ethernetPacket *packet)
{
  char udpData[258];
  byte optionCode, optionLength, optionValue;
  dword offset, i;
  byte optionData[258];
  char optionFieldName[10]; // optionXXX
  
  if(!packet.dhcpv4.magicCookie.IsAvailable())
  {
    if(gVerbosity >= kVERBOSE_ERROR)
    {
      writeLineEx(1,3,"%BASE_FILE_NAME%: invalid magic cookie");
    }
    return -1;
  }
  
  // print options in verbose info mode
  if(gVerbosity >= kVERBOSE_INFO)
  {
    writeLineEx(1,1,"%BASE_FILE_NAME%: options:");
    offset = packet.dhcpv4.magicCookie.byteOffset + packet.dhcpv4.magicCookie.byteLength - packet.dhcpv4.operation.byteOffset;
    while(offset < packet.udp.byteLength)
    {
      if(packet.udp.GetData(offset++, udpData, 1)!=1)
        break;
      optionCode = udpData[0];
      if(optionCode == kDHO_END)
      {
        writeLineEx (1,1,"    option code: %s:", DhcpOptionCodeNames[optionCode]);
        break;
      }
      else if(optionCode == kDHO_DHCP_MESSAGE_TYPE)
      {
        if(packet.udp.GetData(offset, udpData, 2)!=2)
          break;
        offset += 2;
        writeLineEx (1,1,"    option code: %s, value: %s", DhcpOptionCodeNames[optionCode], DhcpMessageTypeNames[udpData[1]]);
      }
      else
      {
        if(packet.udp.GetData(offset++, udpData, 1)!=1)
          break;
        optionLength = udpData[0];
        writeLineEx (1,1,"    option code: %s, option length: %d, value:", DhcpOptionCodeNames[optionCode], optionLength);
        if(packet.udp.GetData(offset, udpData, optionLength)!=optionLength)
          break;
        offset += optionLength;
        for(i=0; i<optionLength; i++)
        {
          optionValue = udpData[i];
          writeEx(1,1," %02X", optionValue);
        }
      }
    }
  }
    
  // handle message
  SetFieldNameForDhcpOption(optionFieldName, kDHO_DHCP_MESSAGE_TYPE);
  if(packet.getData("dhcpv4", optionFieldName, optionData)!=3)
  {
    if(gVerbosity >= kVERBOSE_ERROR)
    {
      writeLineEx(1,3,"%BASE_FILE_NAME%: Could not read message type option");
    }
    return -1;
  }
  
  switch(optionData[2])
  {
    case kDHCPDISCOVER:
      HandleDhcpDiscover(packet);
      break;
    case kDHCPREQUEST:
      HandleDhcpRequest(packet);
      break;
    case kDHCPDECLINE:
      // this simple demo DHCP client do not support the DHCPDECLINE message
      break;
    case kDHCPRELEASE:
      // this simple demo DHCP client do not support the DHCPRELEASE message
      break;
    case kDHCPINFORM:
      // this simple demo DHCP client do not support the DHCPINFORM message
      break;
    default:
      return -1;
  }
  
  return 0;
}

/*
  Handler for a received DHCPDISCOVER message

  dhcpMessage - the received DHCPDISCOVER message
*/
void HandleDhcpDiscover(ethernetPacket *dhcpPacket)
{
  ethernetPacket offer;
  struct dhcp_lease lease;
 
  // get a lease to offer to the client
  if(GetLeaseForClient(dhcpPacket, lease) < 0)
  {
    // if there is no lease available, create a new one
    if(CreateLease(dhcpPacket, lease) < 0)
    {
      if(gVerbosity >= kVERBOSE_ERROR)
      {
        writeLineEx(1,3,"%BASE_FILE_NAME%: pool of ip addresses empty 1");
      }
      return;
    }
  }
  
  if(IsIpAddressValid(lease.ipAddr) <= 0)
  {
    lease.ipAddr = GetFreeAddress();
    if(lease.ipAddr > 0)
    {
      UpdateLease(lease, NOTALLOCATED);
    }
    else
    {
      // no more addresses available
      UpdateLease(lease, NOTAVAILABLE);
      if(gVerbosity >= kVERBOSE_ERROR)
      {
        writeLineEx(1,3,"%BASE_FILE_NAME%: pool of ip addresses empty 2");
      }
      return;
    }
  }
  
  // create offer message
  CreateDhcpOffer(offer, lease, dhcpPacket);

  // we have to output a raw ethernet packet instead of using the tcp/ip stack
  // because the tcp/ip stack will try to detect the remote mac address by 
  // sending a arp request. This request will not be answered because the 
  // client do not have the address already.
  EthInjectPacket(offer, rx);
}

/*
  Handler for a received DHCPREQUEST message

  dhcpMessage - the received DHCPREQUEST message
*/
void HandleDhcpRequest(ethernetPacket *dhcpPacket)
{
  struct dhcp_lease lease;
  int    leaseAvailable;
  dword  adapterAddr[1];
  dword optionServerAddr;
  byte isAvailableOptionServerAddr;
  dword  optionRequestedAddress;
  byte isAvailableOptionRequestedAddress;
  byte optionData[32];
  long optionDataLength;
  char optionFieldName[10]; // optionXXX
  ethernetPacket answere;

  // get a lease for the client
  leaseAvailable = GetLeaseForClient(dhcpPacket, lease);

  // get local Ip address
  IpGetAdapterAddress(gIfIndex, adapterAddr, elcount(adapterAddr));
  
  SetFieldNameForDhcpOption(optionFieldName, kDHO_DHCP_SERVER_IDENTIFIER);
  isAvailableOptionServerAddr = dhcpPacket.IsAvailable("dhcpv4", optionFieldName);
  if(isAvailableOptionServerAddr)
  {
    optionDataLength = dhcpPacket.GetData("dhcpv4", optionFieldName, optionData);
    optionServerAddr = optionData.dword(2);
  }
  SetFieldNameForDhcpOption(optionFieldName, kDHO_DHCP_REQUESTED_ADDRESS);
  isAvailableOptionRequestedAddress = dhcpPacket.IsAvailable("dhcpv4", optionFieldName);
  if(isAvailableOptionRequestedAddress)
  {
    optionDataLength = dhcpPacket.GetData("dhcpv4", optionFieldName, optionData);
    optionRequestedAddress = optionData.dword(2);
  }
 
  // determine the state of the client
  if(isAvailableOptionServerAddr && (optionServerAddr == adapterAddr[0]) &&
    (dhcpPacket.dhcpv4.clientAddr == 0 ) &&
    isAvailableOptionRequestedAddress &&
    (optionRequestedAddress == lease.ipAddr) &&
    (IsIpAddressValid(optionRequestedAddress) > 0))
  {
    // valid request from client in selecting state
    if(gVerbosity >= kVERBOSE_INFO)
    {
      writeLineEx(1,1,"%BASE_FILE_NAME%: Received DHCPREQUEST from client in selecting state. Create DHCPACK");
    }
    UpdateLease(lease, ALLOCATED);
    CreateDhcpAck(answere, lease, dhcpPacket);
  }
  else if((isAvailableOptionServerAddr == 0) &&
    (dhcpPacket.dhcpv4.clientAddr == 0 ) &&
    isAvailableOptionRequestedAddress &&
    (IsIpAddressValid(optionRequestedAddress) > 0))
  {
    // request in init reboot state
    // check if address is available in address pool and decide to send ack or nak
    if((leaseAvailable < 0) || (lease.ipAddr != optionRequestedAddress))
    {
      if(leaseAvailable < 0)
      {
        CreateLease(dhcpPacket, lease);
      }
      if( IsAddressAvailable(optionRequestedAddress) > 0 )
      {
        if(gVerbosity >= kVERBOSE_INFO)
        {
          writeLineEx(1,1,"%BASE_FILE_NAME%: Received DHCPREQUEST from client in init-reboot state. Create DHCPACK1");
        }
        dhcpPacket.dhcpv4.clientHwAddr.GetData(0, lease.clientMacId, elcount(lease.clientMacId));
        lease.ipAddr = optionRequestedAddress;
        UpdateLease(lease, ALLOCATED);
        CreateDhcpAck(answere, lease, dhcpPacket);
      }
      else
      {
        if(gVerbosity >= kVERBOSE_ERROR)
        {
          writeLineEx(1,3,"%BASE_FILE_NAME%: Requested address not available");
        }
        UpdateLease(lease, NOTAVAILABLE);
        CreateDhcpNack(answere, lease, dhcpPacket);
      }
    }
    else
    {
      if(gVerbosity >= kVERBOSE_INFO)
      {
        writeLineEx(1,1,"%BASE_FILE_NAME%: Received DHCPREQUEST from client in init-reboot state. Create DHCPACK2");
      }
      lease.ipAddr = optionRequestedAddress;
      UpdateLease(lease, ALLOCATED);
      CreateDhcpAck(answere, lease, dhcpPacket);
    }
  }
  else if((isAvailableOptionServerAddr == 0) &&
    (isAvailableOptionRequestedAddress == 0) &&
    (dhcpPacket.dhcpv4.clientAddr == lease.ipAddr) &&
    (IsIpAddressValid(dhcpPacket.dhcpv4.clientAddr) > 0) &&
    (lease.addressState == ALLOCATED))
  {
    // valid request in renewing or rebinding state
    if(gVerbosity >= kVERBOSE_INFO)
    {
      writeLineEx(1,1,"%BASE_FILE_NAME%: Received DHCPREQUEST from client in renewing or rebinding state. Create DHCPACK");
    }
    UpdateLease(lease, ALLOCATED);
    CreateDhcpAck(answere, lease, dhcpPacket);
  }
  else
  {
    if(gVerbosity >= kVERBOSE_INFO)
    {
      writeLineEx(1,1,"%BASE_FILE_NAME%: Invalid DHCPREQUEST. Create DHCPNAK");
    }
    UpdateLease(lease, NOTALLOCATED);
    CreateDhcpNack(answere, lease, dhcpPacket);
  }
  // we have to output a raw ethernet packet instead of using the tcp/ip stack
  // because the tcp/ip stack will try to detect the remote mac address by 
  // sending a arp request. This request will not be answered because the 
  // client do not have the address already.
  EthInjectPacket(answere, rx);
}

/*
  Check if the given address is available

 return  - 0: address not valid 
           1: address valid
 address - the address to check
*/
int IsAddressAvailable(dword address)
{
  if(IsIpAddressValid(address) > 0)
  {
    for(char [] clientIdentifier : gLeases)
    {
      if(gLeases[clientIdentifier].ipAddr == address)
      {
        return 0;
      }
    }
    return 1;
  }
  return 0;
}

/*
  Check if the given address is in the range configured by the user

  return  - 0: address not valid 
            1: address valid
  address - the address to check
*/
int IsIpAddressValid(dword address)
{
  char buffer[18];
  dword rangeBegin;
  dword rangeEnd;
  
  // get system variables and calculate valid address range
  sysGetVariableString(sysvar::DHCPServer::AddressRangeStart, buffer, elcount(buffer));
  if((IpGetAddressAsNumber(buffer) == ~0) && (gVerbosity >= kVERBOSE_ERROR))
  {
    writeLineEx(1,3,"%BASE_FILE_NAME%: Invalid address given (%s)", buffer);
    return 0;
  }
  rangeBegin = htonl(IpGetAddressAsNumber(buffer));
  sysGetVariableString(sysvar::DHCPServer::AddressRangeEnd, buffer, elcount(buffer));
  if((IpGetAddressAsNumber(buffer) == ~0) && (gVerbosity >= kVERBOSE_ERROR))
  {
    writeLineEx(1,3,"%BASE_FILE_NAME%: Invalid address given (%s)", buffer);
    return 0;
  }
  rangeEnd = htonl(IpGetAddressAsNumber(buffer));

  if(rangeEnd >= htonl(address) && htonl(address) >= rangeBegin)
  {
    return 1;
  }
  return 0;
}

/*
  Update the lease for a client

  lease      - the lease to update
  leaseState - the new state of the lease
*/
void UpdateLease(struct dhcp_lease lease, enum dhcp_address_state leaseState)
{
  char buffer[18];

  if(IsIpAddressValid(lease.ipAddr) > 0)
  {
    lease.addressState = leaseState;
  }
  else
  {
    lease.addressState = NOTAVAILABLE;
  }
  
  if(leaseState == ALLOCATED)
  {
    lease.expirationTime = timeNow() / 100000 + @sysvar::DHCPServer::LeaseDuration;
    lease.time = @sysvar::DHCPServer::LeaseDuration;
  }
    
  sysGetVariableString(sysvar::DHCPServer::SubnetMask, buffer, elcount(buffer));
  if((IpGetAddressAsNumber(buffer) == ~0) && (gVerbosity >= kVERBOSE_ERROR))
  {
    writeLineEx(1,3,"%BASE_FILE_NAME%: Invalid mask given (%s)", buffer);
  }
  lease.mask = IpGetAddressAsNumber(buffer);
  sysGetVariableString(sysvar::DHCPServer::DefaultGateway, buffer, elcount(buffer));
  if((IpGetAddressAsNumber(buffer) == ~0) && (gVerbosity >= kVERBOSE_ERROR))
  {
    writeLineEx(1,3,"%BASE_FILE_NAME%: Invalid router given (%s)", buffer);
  }
  lease.router = IpGetAddressAsNumber(buffer);
  
  SetLeaseForClient(lease);
}

/*
  Get the lease for the client with the given MAC id. If there is no
  lease available the function returns -1

  return - 0: lease available
          -1: no lease available
  macId  - the mac id of the client
  lease  - the returned lease. Only valid if return value is 0
*/
int GetLeaseForClient(ethernetPacket *dhcpPacket, struct dhcp_lease lease)
{
  byte macId[16];
  char macIdStr[18];

  dhcpPacket.dhcpv4.clientHwAddr.GetData(0, macId, elcount(macId));
  EthMacId2Str(macId, 0, macIdStr);
  if(gLeases.containsKey(macIdStr)>0)
  {
    memcpy(lease, gLeases[macIdStr]);
    return 0;
  }
  return -1;
}

/*
  Set the values of the given lease to the lease for the client with 
  the leases macId. If there is no lease available the function 
  returns -1

  return - 0: lease available
          -1: no lease available
  lease  - the lease to set
*/
int SetLeaseForClient(struct dhcp_lease lease)
{
  char macIdStr[18];
  EthMacId2Str(lease.clientMacId, 0, macIdStr);
  if(gLeases.containsKey(macIdStr)>0)
  {
    memcpy(gLeases[macIdStr], lease);
    return 0;
  }
  return -1;
}

/*
  get a free address from the user defined address range

  return - 0: address not valid 
          >0: the valid address
*/
dword GetFreeAddress()
{
  char buffer[18];
  dword rangeBegin;
  dword rangeEnd;
  dword alreadyUsed;
  
  sysGetVariableString(sysvar::DHCPServer::AddressRangeStart, buffer, elcount(buffer));
  if((IpGetAddressAsNumber(buffer) == ~0) && (gVerbosity >= kVERBOSE_ERROR))
  {
    writeLineEx(1,3,"%BASE_FILE_NAME%: Invalid address range begin given (%s)", buffer);
    return 0;
  }
  rangeBegin = htonl(IpGetAddressAsNumber(buffer));
  sysGetVariableString(sysvar::DHCPServer::AddressRangeEnd, buffer, elcount(buffer));
  if((IpGetAddressAsNumber(buffer) == ~0) && (gVerbosity >= kVERBOSE_ERROR))
  {
    writeLineEx(1,3,"%BASE_FILE_NAME%: Invalid address range end given (%s)", buffer);
    return 0;
  }
  rangeEnd = htonl(IpGetAddressAsNumber(buffer));
  
  // find next free address
  while(rangeBegin <= rangeEnd)
  {
    if(IsAddressAvailable(ntohl(rangeBegin)) > 0)
    {
      return ntohl(rangeBegin);
    }
    rangeBegin++; 
  }
  
  return 0;
}

/*
  Init the given lease with the server rules. Then the lease will
  be added to the lease container
 
  return - 0: lease created
          -1: no lease available
  msg    - the dhcp message to get some parameters of the client
  lease  - the returned lease. Only valid if return value is 0
*/
int CreateLease(ethernetPacket *dhcpPacket, struct dhcp_lease lease)
{
  char buffer[18];
  
  lease.ipAddr = GetFreeAddress();
  if(lease.ipAddr != 0)
  {
    dhcpPacket.dhcpv4.clientHwAddr.GetData(0, lease.clientMacId, elcount(lease.clientMacId));
    lease.expirationTime = timeNow() / 100000 + @sysvar::DHCPServer::LeaseDuration;
    sysGetVariableString(sysvar::DHCPServer::SubnetMask, buffer, elcount(buffer));
    lease.mask = IpGetAddressAsNumber(buffer);
    lease.time = @sysvar::DHCPServer::LeaseDuration;
    sysGetVariableString(sysvar::DHCPServer::DefaultGateway, buffer, elcount(buffer));
    lease.router = IpGetAddressAsNumber(buffer);
    lease.addressState = NOTALLOCATED;
    
    // put lease to the list of leases
    EthMacId2Str(lease.clientMacId, 0, buffer);
    memcpy(gLeases[buffer], lease);
   
    return 0;
  }
  
  return -1;
}

/*
  Fill the eth header

  packet      - the dhcp packet where the ethernet header should be set
  srcMac      - the source MAC id of the packet
  dstMac      - the destination MAC id of the packet
*/
void FillEthHeader(ethernetPacket *packet, byte srcMac[], byte dstMac[])
{
  packet.source = macToQWord(srcMac);
  packet.destination = macToQWord(dstMac);
  if(@DHCPServer::VlanConfigured)
  {
    packet.SetVlanId(@DHCPServer::VlanTag);
  }
}

/*
  Fill the Ip header 

  packet      - the dhcp packet where the ip header should be set
  srcAddr     - the source IP address of the packet
  dstAddr     - the destination IP address of the packet
*/
void FillIpHeader(ethernetPacket *packet, dword srcAddr, dword dstAddr)
{
  packet.ipv4.source = srcAddr;
  packet.ipv4.destination = dstAddr;
  packet.ipv4.identification = random(0xFFFF);
  packet.ipv4.ttl = 0x20;
  packet.ipv4.flags=2;
}

/*
  Fill the UDP header 

  packet      - the dhcp packet where the udp header should be set
*/
void FillUdpHeader(ethernetPacket *packet)
{
  packet.udp.destination = (kDHCP_DEFAULT_CLIENT_PORT);
  packet.udp.source = (kDHCP_DEFAULT_SERVER_PORT);
}

/*
  Create a dhcp packet for a DHCPOFFER message

  offer          - the ethernet offer packet where the data should be set
  lease          - the dedicated lease entry from which this offer should be created
  discoverPacket - the dedicated discover message for which this offer should be created
*/
void CreateDhcpOffer(ethernetPacket *offer, struct dhcp_lease lease, ethernetPacket *discoverPacket)
{
  dword optionOffset;
  int i;
  DWORD adapterAddr[1];
  byte  adapterMac[6];
  byte data[512];
  long dataLength;
  byte optionData[32];
  long optionDataLength;
  char optionFieldName[10]; // optionXXX

  IpGetAdapterAddress(gIfIndex, adapterAddr, elcount(adapterAddr));
  IpGetAdapterMacId(discoverPacket.msgChannel, adapterMac);
  
  offer.ipv4.Init();
  offer.udp.Init();
  offer.dhcpv4.Init();

  // fill dhcp header
  offer.dhcpv4.operation = kBOOTRESPONSE;
  offer.dhcpv4.hwType = 1;
  offer.dhcpv4.hwSize = 6;
  offer.dhcpv4.hops = 0;
  offer.dhcpv4.xid = discoverPacket.dhcpv4.xid;
  offer.dhcpv4.time = 0;  
  offer.dhcpv4.clientAddr = 0;
  offer.dhcpv4.yourAddr = lease.ipAddr;
  offer.dhcpv4.serverAddr = 0;
  offer.dhcpv4.flags = discoverPacket.dhcpv4.flags;
  offer.dhcpv4.agentAddr = discoverPacket.dhcpv4.agentAddr;
  dataLength = discoverPacket.dhcpv4.clientHwAddr.GetData(0, data, elcount(data));
  offer.dhcpv4.clientHwAddr.SetData(0, data, dataLength);
  dataLength = discoverPacket.dhcpv4.serverName.GetData(0, data, elcount(data));
  offer.dhcpv4.serverName.SetData(0, data, dataLength);
  dataLength = discoverPacket.dhcpv4.file.GetData(0, data, elcount(data));
  offer.dhcpv4.file.SetData(0, data, dataLength);
  offer.dhcpv4.magicCookie.Init();  
 
  // add options
  optionOffset = offer.udp.GetData(0, data, elcount(data));
  optionOffset = AppendDhcpOption(data, optionOffset, kDHO_DHCP_MESSAGE_TYPE, 1, kDHCPOFFER);
  optionOffset = AppendDhcpOption(data, optionOffset, kDHO_DHCP_SERVER_IDENTIFIER, 4, adapterAddr[0]);
  optionOffset = AppendDhcpOption(data, optionOffset, kDHO_DHCP_LEASE_TIME, 4, htonl(lease.time));

  SetFieldNameForDhcpOption(optionFieldName, kDHO_DHCP_PARAMETER_REQUEST_LIST);
  optionDataLength = discoverPacket.GetData("dhcpv4", optionFieldName, optionData);
  if(optionDataLength>2)
  {
    for(i=0; i<optionData[1]; ++i)
    {
      switch(optionData[2+i])
      {
        case kDHO_SUBNET_MASK:
          optionOffset = AppendDhcpOption(data, optionOffset, kDHO_SUBNET_MASK, 4, lease.mask);
          break;
        case kDHO_ROUTERS:
          if(lease.router != 0)
          {
            optionOffset = AppendDhcpOption(data, optionOffset, kDHO_ROUTERS, 4, lease.router);
          }
          break;
      } 
    }
  }
  data[optionOffset++] = kDHO_END;

  offer.udp.SetData(0, data, optionOffset);

  // fill the lower level headers
  if(discoverPacket.dhcpv4.flags & (word)kDHCP_BROADCAST_FLAG)
  {
    // server shall respond via broadcast
    FillEthHeader(offer, adapterMac, kBroadcastMacId);
    FillIpHeader(offer, adapterAddr[0], kBroadcastIpv4Addr);
  }
  else
  {
    FillEthHeader(offer, adapterMac, lease.clientMacId);
    FillIpHeader(offer, adapterAddr[0], lease.ipAddr);
  }
  FillUdpHeader(offer);
  
  offer.CompletePacket();
}

/*
  Create a dhcp packet for a DHCPACK message

  answere     - the packet where the data should be set
  lease       - the dedicated lease entry from which this ack should be created
  requestMsg  - the dedicated request message for which this ack should be created
*/
void CreateDhcpAck(ethernetPacket *answere, struct dhcp_lease lease, ethernetPacket *requestMsg)
{
  int optionOffset;
  int i;
  DWORD adapterAddr[1];
  byte  adapterMac[6];
  byte data[512];
  long dataLength;
  byte optionData[32];
  long optionDataLength;
  char optionFieldName[10]; // optionXXX
  
  IpGetAdapterAddress(gIfIndex, adapterAddr, elcount(adapterAddr));
  IpGetAdapterMacId(requestMsg.msgChannel, adapterMac);
  
  answere.ipv4.Init();
  answere.udp.Init();
  answere.dhcpv4.Init();

  // fill dhcp header
  answere.dhcpv4.operation = kBOOTRESPONSE;
  answere.dhcpv4.hwType = 1;
  answere.dhcpv4.hwSize = 6;
  answere.dhcpv4.hops = 0;
  answere.dhcpv4.xid = requestMsg.dhcpv4.xid;
  answere.dhcpv4.time = 0;  
  answere.dhcpv4.clientAddr = requestMsg.dhcpv4.clientAddr;
  answere.dhcpv4.yourAddr = lease.ipAddr;
  answere.dhcpv4.serverAddr = 0;
  answere.dhcpv4.flags = requestMsg.dhcpv4.flags;
  answere.dhcpv4.agentAddr = requestMsg.dhcpv4.agentAddr;
  dataLength = requestMsg.dhcpv4.clientHwAddr.GetData(0, data, elcount(data));
  answere.dhcpv4.clientHwAddr.SetData(0, data, dataLength);
  dataLength = requestMsg.dhcpv4.serverName.GetData(0, data, elcount(data));
  answere.dhcpv4.serverName.SetData(0, data, dataLength);
  dataLength = requestMsg.dhcpv4.file.GetData(0, data, elcount(data));
  answere.dhcpv4.file.SetData(0, data, dataLength);
  answere.dhcpv4.magicCookie.Init();  

  // add options
  optionOffset = answere.udp.GetData(0, data, elcount(data));
  optionOffset = AppendDhcpOption(data, optionOffset, kDHO_DHCP_MESSAGE_TYPE, 1, kDHCPACK);
  optionOffset = AppendDhcpOption(data, optionOffset, kDHO_DHCP_SERVER_IDENTIFIER, 4, adapterAddr[0]);
  optionOffset = AppendDhcpOption(data, optionOffset, kDHO_DHCP_LEASE_TIME, 4, htonl(lease.time));
  
  SetFieldNameForDhcpOption(optionFieldName, kDHO_DHCP_PARAMETER_REQUEST_LIST);
  optionDataLength = requestMsg.GetData("dhcpv4", optionFieldName, optionData);
  if(optionDataLength>2)
  {
    for(i=0; i<optionData[1]; ++i)
    {
      switch(optionData[2+i])
      {
        case kDHO_SUBNET_MASK:
          optionOffset = AppendDhcpOption(data, optionOffset, kDHO_SUBNET_MASK, 4, lease.mask);
          break;
        case kDHO_ROUTERS:
          if(lease.router != 0)
          {
            optionOffset = AppendDhcpOption(data, optionOffset, kDHO_ROUTERS, 4, lease.router);
          }
          break;
      } 
    }
  }
  data[optionOffset++] = kDHO_END;
   
  answere.udp.SetData(0, data, optionOffset);
  
  // fill the lower level headers
  if(requestMsg.dhcpv4.flags & (word)kDHCP_BROADCAST_FLAG)
  {
    // server shall respond via broadcast
    FillEthHeader(answere, adapterMac, kBroadcastMacId);
    FillIpHeader(answere, adapterAddr[0], kBroadcastIpv4Addr);
  }
  else
  {
    FillEthHeader(answere, adapterMac, lease.clientMacId);
    FillIpHeader(answere, adapterAddr[0], lease.ipAddr);
  }
  FillUdpHeader(answere);
  
  answere.CompletePacket();
}

/*
  Create a dhcp packet for a DHCPNACK message

  answere     - the packet where the data should be set
  lease       - the dedicated lease entry from which this ack should be created
  requestMsg  - the dedicated request message for which this ack should be created
*/
void CreateDhcpNack(ethernetPacket *answere, struct dhcp_lease lease, ethernetPacket *requestMsg)
{
  int optionOffset;
  int i;
  DWORD adapterAddr[1];
  byte  adapterMac[6], clientMacId[6];
  byte data[512];
  long dataLength;
  byte optionData[32];
  long optionDataLength;
  char optionFieldName[10]; // optionXXX
  
  requestMsg.dhcpv4.clientHwAddr.GetData(0, clientMacId, elcount(clientMacId));
  
  IpGetAdapterAddress(gIfIndex, adapterAddr, elcount(adapterAddr));
  IpGetAdapterMacId(requestMsg.msgChannel, adapterMac);
  
  answere.ipv4.Init();
  answere.udp.Init();
  answere.dhcpv4.Init();
  
  // fill dhcp header 
  answere.dhcpv4.operation = kBOOTRESPONSE;
  answere.dhcpv4.hwType = 1;
  answere.dhcpv4.hwSize = 6;
  answere.dhcpv4.hops = 0;
  answere.dhcpv4.xid = requestMsg.dhcpv4.xid;
  answere.dhcpv4.time = 0;  
  answere.dhcpv4.clientAddr = 0;
  answere.dhcpv4.yourAddr = 0;
  answere.dhcpv4.serverAddr = 0;
  answere.dhcpv4.flags = requestMsg.dhcpv4.flags;
  answere.dhcpv4.agentAddr = requestMsg.dhcpv4.agentAddr;
  dataLength = requestMsg.dhcpv4.clientHwAddr.GetData(0, data, elcount(data));
  answere.dhcpv4.clientHwAddr.SetData(0, data, dataLength);
  answere.dhcpv4.magicCookie.Init();  

  // add options
  optionOffset = answere.udp.GetData(0, data, elcount(data));
  optionOffset = AppendDhcpOption(data, optionOffset, kDHO_DHCP_MESSAGE_TYPE, 1, kDHCPNAK);
  optionOffset = AppendDhcpOption(data, optionOffset, kDHO_DHCP_SERVER_IDENTIFIER, 4, adapterAddr[0]);
  data[optionOffset++] = kDHO_END;

  answere.udp.SetData(0, data, optionOffset);

  // fill the lower level headers
  if(lease.ipAddr == 0)
  {
    // if no address available answer to broadcast address
    FillEthHeader(answere, adapterMac, kBroadcastMacId);
    FillIpHeader(answere, adapterAddr[0], kBroadcastIpv4Addr);
  }
  else if(requestMsg.dhcpv4.flags & (word)kDHCP_BROADCAST_FLAG)
  {
    // if the DHCP broadcast flag is set, answer to broadcast address
    FillEthHeader(answere, adapterMac, kBroadcastMacId);
    FillIpHeader(answere, adapterAddr[0], kBroadcastIpv4Addr);
  }
  else
  {
    FillEthHeader(answere, adapterMac, clientMacId);
    FillIpHeader(answere, adapterAddr[0], lease.ipAddr);
  }
  FillUdpHeader(answere);
  
  answere.CompletePacket();
}

/*
  Update the client section in the panel
*/
void UpdatePanel()
{
  char buffer[kLineLength * kMaxLines];
  char line[kLineLength];
  char ipAddr[16];
  dword time;
  
  time = timeNow() / 100000;
  strncpy(buffer, "", elcount(buffer));
  for(char [] clientIdentifier : gLeases)
  {
    strncat(buffer, "-------------------------\n", elcount(buffer));
    snprintf(line, elcount(line), "Client: %s\n", clientIdentifier);
    strncat(buffer, line, elcount(buffer));
    IpGetAddressAsString(gLeases[clientIdentifier].ipAddr, ipAddr, elcount(ipAddr));
    snprintf(line, elcount(line), "Address: %16s", ipAddr);
    strncat(buffer, line, elcount(buffer));
    if(gLeases[clientIdentifier].expirationTime - time < 0)
    {
      snprintf(line, elcount(line), "Lease expired            ");
    }
    else
    {
      snprintf(line, elcount(line), "Lease time: %13d\n", gLeases[clientIdentifier].expirationTime - time);
    }
    strncat(buffer, line, elcount(buffer));
  }
  sysSetVariableString(sysvar::DHCPServer::Console, buffer);
}
