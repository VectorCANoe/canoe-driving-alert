/*@!Encoding:1252*/
/*
 * DHCP Client shared code
 *
 * Copyright 2015, Vector Informatik GmbH - All right reserved
 *
 * The DHCP client checks cyclic its IP address and the gateway
 * address and writes the result to the panel.
 */
 
 OnIpAddressAdded(dword ifIndex, ip_address address, dword prefix, dword origin)
{
  UpdateClientPanel(ifIndex);
}

OnIpAddressRemoved(dword ifIndex, ip_address address, dword prefix, dword origin)
{
  UpdateClientPanel(ifIndex);
}

/*
  Get the addresses, convert them to a string and update the panel
*/
void UpdateClientPanel(dword ifIndex)
{
  dword result;
  byte macId[6];
  char macIdStr[18];
  char ipAddr[16];
  char mask[16];
  char gateway[16];
  
  // get mac id and write it to the panel
  result = IpGetAdapterMacId(1, macId);
  if(result == 0)
  {
    EthMacId2Str(macId, 0, macIdStr);   
  }
  else
  {
    strncpy(macIdStr, "-", elcount(macId));
  }
  sysSetVariableString(clientNamespace, "MacId", macIdStr);
 
  // get ip address and write it to the panel
  result = IpGetAdapterAddressAsString(ifIndex, ipAddr, elcount(ipAddr));
  if(result != 0)
  {
    strncpy(ipAddr, "-", elcount(macId));
  }
  sysSetVariableString(clientNamespace, "IpAddress", ipAddr);
  
  // get netmask and write it to the panel
  result = IpGetAdapterMaskAsString(ifIndex, mask, elcount(mask));
  if(result != 0)
  {
    strncpy(mask, "-", elcount(macId));
  }
  sysSetVariableString(clientNamespace, "Mask", mask);
  
  // get default gateway and write it to the panel
  result = IpGetAdapterGatewayAsString(ifIndex, gateway, elcount(gateway));
  if(result != 0)
  {
    strncpy(gateway, "-", elcount(macId));
  }
  sysSetVariableString(clientNamespace, "DefaultGateway", gateway);
}
