AUTOSAR XML (schema 4-3-0)
standard types defined: UInt8, UInt16, UInt32, UInt64, Float32, Float64
package /Cluster
  ethernet cluster Vehicle_Ethernet: baudrate=100000000, protocol-name=ETHERNET
    ethernet physical channel VLAN_Drive: comm-connectors=[IC/VLAN_Drive, VGW/VLAN_Drive]
      pdu triggering SD_Drive_MC_AEP_TRG: pdu=SD_PDU, from VGW IC, to VGW IC
      pdu triggering EMotorStatus_Trg: pdu=EMotorStatus, from VGW, to IC
      network endpoint IC_Drive_NEP: network-endpoint-addresses=ipv-4-configuration={ipv-4-address=192.168.2.2, ipv-4-address-source=FIXED, network-mask=255.255.255.0}
      network endpoint VGW_Drive_NEP: network-endpoint-addresses=ipv-4-configuration={ipv-4-address=192.168.2.1, ipv-4-address-source=FIXED, network-mask=255.255.255.0}
      network endpoint SD_Drive_MC_NEP: network-endpoint-addresses=ipv-4-configuration={ipv-4-address=239.0.2.1, ipv-4-address-source=FIXED, network-mask=255.255.255.0}
      so-ad-config:
        socket connection bundle SD_Drive_MC_AEP_BNDL: bundled-connections=[VGW_Drive_SOMEIP_SD_AEP, IC_Drive_SOMEIP_SD_AEP], pdus=socket-connection-ipdu-identifier={header-id=4294934784, pdu-triggering=SD_Drive_MC_AEP_TRG}, server-port=SD_Drive_MC_AEP
        socket connection bundle EnginePSI1: socket-connection=IC_Drive_SOMEIP_AEP, pdus=socket-connection-ipdu-identifier={header-id=65601636, pdu-triggering=EMotorStatus_Trg, routing-group=VLAN_DriveEnginePSI1EngineEvg1}, server-port=VGW_Drive_SOMEIP_AEP
        socket connection bundle EngineCSI1: socket-connection=VGW_Drive_SOMEIP_AEP, server-port=IC_Drive_SOMEIP_AEP
        5 x socket address:
          IC_Drive_SOMEIP_SD_AEP: connector=IC/VLAN_Drive
            application endpoint IC_Drive_SOMEIP_SD_AEP: network-endpoint=IC_Drive_NEP, tp-configuration=udp-tp=udp-tp-port=port-number=30490
          IC_Drive_SOMEIP_AEP: connector=IC/VLAN_Drive
            application endpoint IC_Drive_SOMEIP_AEP: network-endpoint=IC_Drive_NEP, tp-configuration=udp-tp=udp-tp-port=port-number=30500
              consumed service instance EngineCSI1: routing-group=VLAN_Drive_EnginePSI1, provided-service-instance=EnginePSI1, sd-client-config={client-service-major-version=1, client-service-minor-version=0, initial-find-behavior={initial-delay-max-value=0.1, initial-delay-min-value=0.005, initial-repetitions-base-delay=0, initial-repetitions-max=0}, ttl=300}
                consumed event group EngineEvg1: event-group-identifier=1, routing-group=VLAN_DriveEnginePSI1EngineEvg1
          VGW_Drive_SOMEIP_SD_AEP: connector=VGW/VLAN_Drive
            application endpoint VGW_Drive_SOMEIP_SD_AEP: network-endpoint=VGW_Drive_NEP, tp-configuration=udp-tp=udp-tp-port=port-number=30490
          VGW_Drive_SOMEIP_AEP: connector=VGW/VLAN_Drive
            application endpoint VGW_Drive_SOMEIP_AEP: network-endpoint=VGW_Drive_NEP, tp-configuration=udp-tp=udp-tp-port=port-number=30500
              provided service instance EnginePSI1: routing-group=VLAN_Drive_EnginePSI1, instance-identifier=1, sd-server-config={initial-offer-behavior={initial-delay-max-value=0.1, initial-delay-min-value=0.01, initial-repetitions-base-delay=0, initial-repetitions-max=0}, offer-cyclic-delay=240, request-response-delay={max-value=0.2, min-value=0.01}, server-service-major-version=1, server-service-minor-version=0, ttl=300}, service-identifier=1001
                event handler EngineEvg1: application-endpoint=VGW_Drive_SOMEIP_AEP, consumed-event-group=EngineEvg1, multicast-threshold=2
          SD_Drive_MC_AEP: multicast-connector=[IC/VLAN_Drive, VGW/VLAN_Drive]
            application endpoint SD_Drive_MC_AEP: network-endpoint=SD_Drive_MC_NEP, tp-configuration=udp-tp=udp-tp-port=port-number=30490
      vlan VLAN_Drive: vlan-identifier=2
package /ECU
  ecu instance VGW
    ethernet communication controller VGW_Vehicle_Ethernet: mac-unicast-address=02:00:00:00:00:01
    ethernet communication connector VLAN_Drive: comm-controller=VGW_Vehicle_Ethernet, network-endpoint=[VGW_Drive_NEP, SD_Drive_MC_NEP]
  ecu instance IC
    ethernet communication controller IC_Vehicle_Ethernet: mac-unicast-address=02:00:00:00:00:02
    ethernet communication connector VLAN_Drive: comm-controller=IC_Vehicle_Ethernet, network-endpoint=[IC_Drive_NEP, SD_Drive_MC_NEP]
package /PDU
  general purpose pdu SD_PDU: category=SD, length=1472
  pdu EMotorStatus: length=12, transmission-mode-true-timing=cyclic-timing=time-period=0.1, unused-bit-pattern=0
    signal EMotorSpeed: start 0, 16 bit, little-endian, data-type-policy=OVERRIDE, base-type=UInt16, compu {phys=raw*0.1; unit rpm}, to IC
    signal EMotorTemperature: start 16, 16 bit, little-endian, data-type-policy=OVERRIDE, base-type=UInt16, compu {phys=raw*0.1-273; unit °C}, to IC
    signal EMotorCurrent: start 32, 32 bit, little-endian, data-type-policy=OVERRIDE, base-type=UInt32, compu {phys=raw*0.001-1000; unit A}, to IC
    signal EMotorPower: start 64, 32 bit, little-endian, data-type-policy=OVERRIDE, base-type=UInt32, compu {phys=raw*0.001-1000; unit kW}, to IC
package /SystemMapping
  system System
    system mapping SystemMapping
  sender receiver interface SenderReceiver
package /ServiceInterface
  collection Engine: category=SET, element-role=SO_SERVICE_INTERFACE
package /DataTypeMapping
  data type mapping set DatatypeMappingSet
package /Unit
  4 x unit:
    RpmUnit: display-name=rpm
    DegreeUnit: display-name=°C
    CurrentUnit: display-name=A
    PowerUnit: display-name=kW
package /RoutingGroups
  so ad routing group VLAN_Drive_EnginePSI1
  so ad routing group VLAN_DriveEnginePSI1EngineEvg1: event-group-control-type=ACTIVATION-UNICAST
package /BaseType
  8 x base type:
    Int8: category=FIXED_LENGTH, base-type-size=8, base-type-encoding=2C
    Int16: category=FIXED_LENGTH, base-type-size=16, base-type-encoding=2C
    Int32: category=FIXED_LENGTH, base-type-size=32, base-type-encoding=2C
    Int64: category=FIXED_LENGTH, base-type-size=64, base-type-encoding=2C
    Bool: category=FIXED_LENGTH, base-type-size=8, base-type-encoding=BOOLEAN
    ASCIIString: base-type-size=8, base-type-encoding=ISO-8859-1
    UTF8String: base-type-size=8, base-type-encoding=UTF-8
    UTF16String: base-type-size=16, base-type-encoding=UTF-16, byte-order=big-endian
package /Transformer
  data transformation set TransformationSet
    data transformation SOMEIPData: execute-despite-data-unavailability=false, transformer-chain=SOMEIP
    transformation technology SOMEIP: buffer-properties={header-length=64, in-place=false}, protocol=SOMEIP, someip-transformation-description{alignment=8, byte-order=little-endian, interface-version=1}, transformer-class=SERIALIZER, version=1
