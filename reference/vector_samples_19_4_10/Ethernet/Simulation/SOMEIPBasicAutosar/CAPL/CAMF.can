/*@!Encoding:1252*/
includes
{
  
}

variables
{
  
}

on sysvar sysvar::CAMF::EnableService
{ 
  if (@this == 1)
  {
    // ensure that the node offers service "CameraObjectDetectionPSI1"
    Vehicle_Ethernet::CAMF::CameraObjectDetectionPSI1.Connect();
  }
  else
  {
    // ensure that the node stops offering service "CameraObjectDetectionPSI1"
    Vehicle_Ethernet::CAMF::CameraObjectDetectionPSI1.Disconnect();
  }
}

on fct_called Vehicle_Ethernet::CAMF::CameraObjectDetectionPSI1.StartStop
{
  // on this callback you can implement your method algorithm. The key word 'this' gives you access
  // to the method arguments and return value.
  
  // set the method return value
  this.Result = 1;
  
  // let the user know that method 'StartStop' has been called
  write("CAMF: Method 'StartStop' called with parameter 'Activate' set to %d",this.Activate.phys);
}

on fct_called Vehicle_Ethernet::CAMF::CameraObjectDetectionPSI1.FrameRate.Get
{ 
  // let the user know that the field getter has been called
  write("CAMF: Getter of Field 'FrameRate' called");
}

on fct_called Vehicle_Ethernet::CAMF::CameraObjectDetectionPSI1.FrameRate.Set
{
  // let the user know that the field setter has been called
  write("CAMF: Setter of Field 'FrameRate' called with parameter set to %d",this.newValue.phys);
}