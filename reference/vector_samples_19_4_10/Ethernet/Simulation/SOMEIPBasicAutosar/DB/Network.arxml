AUTOSAR XML (schema 4-3-0)
standard types defined: UInt8, UInt16, UInt32, UInt64, Float32, Float64
package /Cluster
  ethernet cluster Vehicle_Ethernet: baudrate=100000000, protocol-name=ETHERNET
    ethernet physical channel VLAN_ADAS: comm-connectors=[ADAS/VLAN_ADAS, CAMF/VLAN_ADAS]
      pdu triggering SD_Body_MC_AEP_TRG: pdu=SD_PDU, from CAMF ADAS, to CAMF ADAS
      pdu triggering LaneDetection_Trg0: pdu=LaneDetection, from CAMF, to ADAS
      pdu triggering TrafficSignDetection_Trg0: pdu=TrafficSignDetection, from CAMF, to ADAS
      pdu triggering StartStopResponseTrg0: pdu=StartStopResponse, from CAMF, to ADAS
      pdu triggering FrameRate_NotifierTrg0: pdu=FrameRate_Notifier, from CAMF, to ADAS
      pdu triggering FrameRate_GetterRespTrg0: pdu=FrameRate_GetterResp, from CAMF, to ADAS
      pdu triggering FrameRate_SetterRespTrg0: pdu=FrameRate_SetterResp, from CAMF, to ADAS
      pdu triggering StartStopRequestTrg0: pdu=StartStopRequest, from ADAS, to CAMF
      pdu triggering FrameRate_GetterReqstTrg0: pdu=FrameRate_GetterRqst, from ADAS, to CAMF
      pdu triggering FrameRate_SetterRqstTrg0: pdu=FrameRate_SetterRqst, from ADAS, to CAMF
      network endpoint ADAS_ADAS_NEP: network-endpoint-addresses=ipv-4-configuration={ipv-4-address=192.168.3.4, ipv-4-address-source=FIXED, network-mask=255.255.255.0}
      network endpoint CAMF_ADAS_NEP: network-endpoint-addresses=ipv-4-configuration={ipv-4-address=192.168.3.7, ipv-4-address-source=FIXED, network-mask=255.255.255.0}
      network endpoint SD_Body_MC_NEP: network-endpoint-addresses=ipv-4-configuration={ipv-4-address=239.0.3.1, ipv-4-address-source=FIXED, network-mask=255.255.255.0}
      so-ad-config:
        socket connection bundle SD_Body_MC_AEP_BNDL: bundled-connections=[CAMF_ADAS_SOMEIP_SD_AEP, ADAS_ADAS_SOMEIP_SD_AEP], pdus=socket-connection-ipdu-identifier={header-id=4294934784, pdu-triggering=SD_Body_MC_AEP_TRG}, server-port=SD_Body_MC_AEP
        socket connection bundle CameraObjectDetectionPSI1: socket-connection=ADAS_ADAS_SOMEIP_AEP, server-port=CAMF_ADAS_SOMEIP_AEP
          pdus:
            header-id=131170404, pdu-triggering=TrafficSignDetection_Trg0, routing-group=VLAN_ADASCameraObjectDetectionPSI1CameraObjectDetectionEvg1
            header-id=131170405, pdu-triggering=LaneDetection_Trg0, routing-group=VLAN_ADASCameraObjectDetectionPSI1CameraObjectDetectionEvg1
            header-id=131137836, pdu-triggering=StartStopResponseTrg0, routing-group=StartStopResponse0
            header-id=131170504, pdu-triggering=FrameRate_NotifierTrg0
            header-id=131137737, pdu-triggering=FrameRate_GetterRespTrg0, routing-group=FrameRate_Getter0
            header-id=131137738, pdu-triggering=FrameRate_SetterRespTrg0, routing-group=FrameRate_Setter0
        socket connection bundle CameraObjectDetectionCSI1: socket-connection=CAMF_ADAS_SOMEIP_AEP, server-port=ADAS_ADAS_SOMEIP_AEP
          pdus:
            header-id=131137836, pdu-triggering=StartStopRequestTrg0, routing-group=StartStopRequest0
            header-id=131137737, pdu-triggering=FrameRate_GetterReqstTrg0, routing-group=FrameRate_Getter0
            header-id=131137738, pdu-triggering=FrameRate_SetterRqstTrg0, routing-group=FrameRate_Setter0
        5 x socket address:
          ADAS_ADAS_SOMEIP_SD_AEP: connector=ADAS/VLAN_ADAS
            application endpoint ADAS_ADAS_SOMEIP_SD_AEP: network-endpoint=ADAS_ADAS_NEP, tp-configuration=udp-tp=udp-tp-port=port-number=30490
          ADAS_ADAS_SOMEIP_AEP: connector=ADAS/VLAN_ADAS
            application endpoint ADAS_ADAS_SOMEIP_AEP: network-endpoint=ADAS_ADAS_NEP, tp-configuration=udp-tp=udp-tp-port=port-number=30500
              consumed service instance CameraObjectDetectionCSI1: routing-group=[VLAN_ADAS_CameraObjectDetectionPSI1, StartStopResponse0], provided-service-instance=CameraObjectDetectionPSI1, sd-client-config={client-service-major-version=1, client-service-minor-version=0, initial-find-behavior={initial-delay-max-value=0.1, initial-delay-min-value=0.005, initial-repetitions-base-delay=0, initial-repetitions-max=0}, ttl=300}
                consumed event group CameraObjectDetectionEvg1: event-group-identifier=1, routing-group=VLAN_ADASCameraObjectDetectionPSI1CameraObjectDetectionEvg1
          CAMF_ADAS_SOMEIP_SD_AEP: connector=CAMF/VLAN_ADAS
            application endpoint CAMF_ADAS_SOMEIP_SD_AEP: network-endpoint=CAMF_ADAS_NEP, tp-configuration=udp-tp=udp-tp-port=port-number=30490
          CAMF_ADAS_SOMEIP_AEP: connector=CAMF/VLAN_ADAS
            application endpoint CAMF_ADAS_SOMEIP_AEP: network-endpoint=CAMF_ADAS_NEP, tp-configuration=udp-tp=udp-tp-port=port-number=30500
              provided service instance CameraObjectDetectionPSI1:
                routing-group=[VLAN_ADAS_CameraObjectDetectionPSI1, StartStopRequest0]
                instance-identifier=1
                sd-server-config={initial-offer-behavior={initial-delay-max-value=0.1, initial-delay-min-value=0.01, initial-repetitions-base-delay=0, initial-repetitions-max=0}, offer-cyclic-delay=240, request-response-delay={max-value=0.2, min-value=0.01}, server-service-major-version=1, server-service-minor-version=0, ttl=300}
                service-identifier=2001
                event handler CameraObjectDetectionEvg1: application-endpoint=CAMF_ADAS_SOMEIP_AEP, consumed-event-group=CameraObjectDetectionEvg1, multicast-threshold=2
          SD_Body_MC_AEP: multicast-connector=[ADAS/VLAN_ADAS, CAMF/VLAN_ADAS]
            application endpoint SD_Body_MC_AEP: network-endpoint=SD_Body_MC_NEP, tp-configuration=udp-tp=udp-tp-port=port-number=30490
      vlan VLAN_ADAS: vlan-identifier=3
package /ECU
  ecu instance CAMF
    ethernet communication controller CAMF_Vehicle_Ethernet: mac-unicast-address=02:00:00:00:00:07
    ethernet communication connector VLAN_ADAS: comm-controller=CAMF_Vehicle_Ethernet, network-endpoint=[CAMF_ADAS_NEP, SD_Body_MC_NEP]
  ecu instance ADAS
    ethernet communication controller ADAS_Vehicle_Ethernet: mac-unicast-address=02:00:00:00:00:04
    ethernet communication connector VLAN_ADAS: comm-controller=ADAS_Vehicle_Ethernet, network-endpoint=[ADAS_ADAS_NEP, SD_Body_MC_NEP]
package /PDU
  general purpose pdu SD_PDU: category=SD, length=1472
  pdu LaneDetection: length=16, unused-bit-pattern=0
    signal LaneDetection: start 0, 128 bit, little-endian, data-transformations=SOMEIPData, data-type-policy=TRANSFORMING-I-SIGNAL, someip-transformation-i-signal-props{transformer=SOMEIP, interface-version=1, size-of-array-length-fields=4, size-of-struct-length-fields=4, size-of-union-length-fields=4}, transfer-property=TRIGGERED, to ADAS
  pdu TrafficSignDetection: length=16, unused-bit-pattern=0
    signal TrafficSignDetection: start 0, 128 bit, little-endian, data-transformations=SOMEIPData, data-type-policy=TRANSFORMING-I-SIGNAL, someip-transformation-i-signal-props{transformer=SOMEIP, interface-version=1, size-of-array-length-fields=4, size-of-struct-length-fields=4, size-of-union-length-fields=4}, transfer-property=TRIGGERED, to ADAS
  pdu StartStopResponse: length=16, unused-bit-pattern=0
    signal StartStopResponse: start 0, 128 bit, little-endian, data-transformations=SOMEIPData, data-type-policy=TRANSFORMING-I-SIGNAL, someip-transformation-i-signal-props{transformer=SOMEIP, interface-version=1, size-of-array-length-fields=4, size-of-struct-length-fields=4, size-of-union-length-fields=4}, transfer-property=TRIGGERED, to ADAS
  pdu FrameRate_Notifier: length=16, unused-bit-pattern=0
    signal FrameRate_Notifier: start 0, 128 bit, little-endian, data-transformations=SOMEIPData, data-type-policy=TRANSFORMING-I-SIGNAL, someip-transformation-i-signal-props{transformer=SOMEIP, interface-version=1, size-of-array-length-fields=4, size-of-struct-length-fields=4, size-of-union-length-fields=4}, transfer-property=TRIGGERED, to ADAS
  pdu FrameRate_GetterResp: length=16, unused-bit-pattern=0
    signal FrameRate_GetterResp: start 0, 128 bit, little-endian, data-transformations=SOMEIPData, data-type-policy=TRANSFORMING-I-SIGNAL, someip-transformation-i-signal-props{transformer=SOMEIP, interface-version=1, size-of-array-length-fields=4, size-of-struct-length-fields=4, size-of-union-length-fields=4}, transfer-property=TRIGGERED, to ADAS
  pdu FrameRate_SetterResp: length=16, unused-bit-pattern=0
    signal FrameRate_SetterResp: start 0, 128 bit, little-endian, data-transformations=SOMEIPData, data-type-policy=TRANSFORMING-I-SIGNAL, someip-transformation-i-signal-props{transformer=SOMEIP, interface-version=1, size-of-array-length-fields=4, size-of-struct-length-fields=4, size-of-union-length-fields=4}, transfer-property=TRIGGERED, to ADAS
  pdu StartStopRequest: length=16, unused-bit-pattern=0
    signal StartStopRequest: start 0, 128 bit, little-endian, data-transformations=SOMEIPData, data-type-policy=TRANSFORMING-I-SIGNAL, someip-transformation-i-signal-props{transformer=SOMEIP, interface-version=1, size-of-array-length-fields=4, size-of-struct-length-fields=4, size-of-union-length-fields=4}, transfer-property=TRIGGERED, to CAMF
  pdu FrameRate_GetterRqst: length=16, unused-bit-pattern=0
    signal FrameRate_GetterRqst: start 0, 128 bit, little-endian, data-transformations=SOMEIPData, data-type-policy=TRANSFORMING-I-SIGNAL, someip-transformation-i-signal-props{transformer=SOMEIP, interface-version=1, size-of-array-length-fields=4, size-of-struct-length-fields=4, size-of-union-length-fields=4}, transfer-property=TRIGGERED, to CAMF
  pdu FrameRate_SetterRqst: length=16, unused-bit-pattern=0
    signal FrameRate_SetterRqst: start 0, 128 bit, little-endian, data-transformations=SOMEIPData, data-type-policy=TRANSFORMING-I-SIGNAL, someip-transformation-i-signal-props{transformer=SOMEIP, interface-version=1, size-of-array-length-fields=4, size-of-struct-length-fields=4, size-of-union-length-fields=4}, transfer-property=TRIGGERED, to CAMF
package /SystemMapping
  system System
    system mapping SystemMapping
      data-mappings:
        sender-receiver-to-signal-mapping={event-handler=CameraObjectDetectionEvg1, service-instance=CameraObjectDetectionPSI1, data-element=TrafficSignDetection, system-signal=TrafficSignDetection}
        sender-receiver-to-signal-mapping={event-handler=CameraObjectDetectionEvg1, service-instance=CameraObjectDetectionPSI1, data-element=LaneDetection, system-signal=LaneDetection}
        sender-receiver-to-signal-mapping={event-handler=CameraObjectDetectionEvg1, service-instance=CameraObjectDetectionPSI1, data-element=FrameRate_Notifier, system-signal=FrameRate_Notifier}
        client-server-to-signal-mapping={service-instance=CameraObjectDetectionPSI1, call-signal=StartStopRequest, client-server-operation=StartStop, return-signal=StartStopResponse}
        client-server-to-signal-mapping={service-instance=CameraObjectDetectionPSI1, call-signal=FrameRate_GetterRqst, client-server-operation=FrameRate_Getter, return-signal=FrameRate_GetterResp}
        client-server-to-signal-mapping={service-instance=CameraObjectDetectionPSI1, call-signal=FrameRate_SetterRqst, client-server-operation=FrameRate_Setter, return-signal=FrameRate_SetterResp}
  sender receiver interface SenderReceiver
    data LaneDetection: type=LaneDetectionEvt
    data TrafficSignDetection: type=TrafficSignDetectionEvt
    data FrameRate_Notifier: type=FrameRateDT
package /ClientServerInterface
  client server interface CameraObjectDetection: category=CONTROL, is-service=true
    operation StartStop
      arg Activate: type=Activate, direction=IN
      arg Result: type=ActivateResult, direction=OUT
    operation FrameRate_Getter
      arg FrameRate: type=FrameRateDT, direction=OUT
    operation FrameRate_Setter
      arg FrameRate: type=FrameRateDT, direction=IN
package /ServiceInterface
  collection CameraObjectDetection: category=SET, element-role=SO_SERVICE_INTERFACE, element=[TrafficSignDetection, LaneDetection, StartStop, FrameRate]
  collection FrameRate: category=SET, element-role=SO_SERVICE_FIELD, element=[FrameRate_Notifier, FrameRate_Getter, FrameRate_Setter]
package /ADT
  application record data type LaneDetectionEvt: category=STRUCTURE
    application record element DetectedLaneBorder: category=ARRAY, type=LaneDetection_DetectedLaneBorder_ARRAYDT
  application record data type TrafficSignDetectionEvt: category=STRUCTURE
    application record element DetectedTrafficSigns: category=ARRAY, type=TrafficSignDetection_DetectedTrafficSigns_ARRAYDT
  application array data type LaneDetection_DetectedLaneBorder_ARRAYDT: category=ARRAY
    element DetectedLaneBorder: category=STRUCTURE, type=DetectedLaneBorder, array-size-handling=ALL-INDICES-SAME-ARRAY-SIZE, array-size-semantics=FIXED-SIZE, max-number-of-elements=3
  application array data type TrafficSignDetection_DetectedTrafficSigns_ARRAYDT: category=ARRAY
    element TrafficSignInfo: category=STRUCTURE, type=TrafficSignInfo, array-size-handling=ALL-INDICES-SAME-ARRAY-SIZE, array-size-semantics=FIXED-SIZE, max-number-of-elements=3
  application record data type DetectedLaneBorder: category=STRUCTURE
    5 x application record element, all with category=VALUE:
      LaneSegmentX: type=DistanceDT
      BorderLeft: type=DistanceDT
      BorderRight: type=DistanceDT
      ReliabilityLeft: type=ReliabilityDT
      ReliabilityRight: type=ReliabilityDT
  application record data type TrafficSignInfo: category=STRUCTURE
    application record element SignType: category=VALUE, type=SignKind
    application record element DistanceToSign: category=VALUE, type=DistanceDT
    application record element Reliability: category=VALUE, type=ReliabilityDT
  6 x app type, all with category=VALUE:
    DistanceDT: base-type=UInt32
    ReliabilityDT: base-type=UInt8
    SignKind: base-type=UInt8
    Activate: base-type=UInt8
    ActivateResult: base-type=UInt8
    FrameRateDT: base-type=UInt8
package /IDT
  12 x impl type:
    LaneDetectionEvt: category=STRUCTURE
      element DetectedLaneBorder: implementation-data-type=LaneDetection_DetectedLaneBorder_ARRAYDT
    TrafficSignDetectionEvt: category=STRUCTURE
      element DetectedTrafficSigns: implementation-data-type=TrafficSignDetection_DetectedTrafficSigns_ARRAYDT
    DistanceDT: category=VALUE, base-type=UInt32, compu {phys=raw*0.01-1000, 4294967295=NoDistance; unit m}
    ReliabilityDT: category=VALUE, base-type=UInt8, compu {phys=raw; unit %}
    SignKind: category=VALUE, base-type=UInt8, compu {0=NoObject, 1=NoLimit, 2=NoPassingZoneSign, 3=NoPassingZoneEndSign, 4=HazardSign, 5=HazardEndSign, 6=RoadworkSign, 7=RoadworkEndSign, 30=SpeedLimit30Sign, 40=SpeedLimit40Sign, 50=SpeedLimit50Sign, 60=SpeedLimit60Sign, 70=SpeedLimit70Sign, 80=SpeedLimit80Sign, 100=SpeedLimit100Sign}
    Activate: category=VALUE, base-type=UInt8, compu {0=Deactivate, 1=Activate}
    ActivateResult: category=VALUE, base-type=UInt8, compu {0=Failed, 1=Success}
    FrameRateDT: category=VALUE, base-type=UInt8
    DetectedLaneBorder: category=STRUCTURE
      5 x element, all with category=TYPE_REFERENCE:
        LaneSegmentX: implementation-data-type=DistanceDT
        BorderLeft: implementation-data-type=DistanceDT
        BorderRight: implementation-data-type=DistanceDT
        ReliabilityLeft: implementation-data-type=ReliabilityDT
        ReliabilityRight: implementation-data-type=ReliabilityDT
    TrafficSignInfo: category=STRUCTURE
      element SignType: implementation-data-type=SignKind
      element DistanceToSign: implementation-data-type=DistanceDT
      element Reliability: implementation-data-type=ReliabilityDT
    LaneDetection_DetectedLaneBorder_ARRAYDT: category=ARRAY
      element DetectedLaneBorder: array-size=3, array-size-semantics=FIXED-SIZE, implementation-data-type=DetectedLaneBorder
    TrafficSignDetection_DetectedTrafficSigns_ARRAYDT: category=ARRAY
      element TrafficSignInfo: array-size=3, array-size-semantics=FIXED-SIZE, implementation-data-type=TrafficSignInfo
package /DataTypeMapping
  data type mapping set DatatypeMappingSet
    data-type-maps:
      application-data-type=TrafficSignDetectionEvt, implementation-data-type=TrafficSignDetectionEvt
      application-data-type=LaneDetectionEvt, implementation-data-type=LaneDetectionEvt
      application-data-type=FrameRateDT, implementation-data-type=FrameRateDT
      application-data-type=LaneDetection_DetectedLaneBorder_ARRAYDT, implementation-data-type=LaneDetection_DetectedLaneBorder_ARRAYDT
      application-data-type=DetectedLaneBorder, implementation-data-type=DetectedLaneBorder
      application-data-type=DistanceDT, implementation-data-type=DistanceDT
      application-data-type=ReliabilityDT, implementation-data-type=ReliabilityDT
      application-data-type=TrafficSignDetection_DetectedTrafficSigns_ARRAYDT, implementation-data-type=TrafficSignDetection_DetectedTrafficSigns_ARRAYDT
      application-data-type=TrafficSignInfo, implementation-data-type=TrafficSignInfo
      application-data-type=SignKind, implementation-data-type=SignKind
      application-data-type=Activate, implementation-data-type=Activate
      application-data-type=ActivateResult, implementation-data-type=ActivateResult
      application-data-type=FrameRateDT, implementation-data-type=FrameRateDT
package /Unit
  unit DistanceUnit: display-name=m
  unit ReliabilityUnit: display-name=%
package /RoutingGroups
  6 x so ad routing group:
    StartStopRequest0
    StartStopResponse0
    FrameRate_Getter0
    FrameRate_Setter0
    VLAN_ADAS_CameraObjectDetectionPSI1
    VLAN_ADASCameraObjectDetectionPSI1CameraObjectDetectionEvg1: event-group-control-type=ACTIVATION-UNICAST
package /BaseType
  8 x base type:
    Int8: category=FIXED_LENGTH, base-type-size=8, base-type-encoding=2C
    Int16: category=FIXED_LENGTH, base-type-size=16, base-type-encoding=2C
    Int32: category=FIXED_LENGTH, base-type-size=32, base-type-encoding=2C
    Int64: category=FIXED_LENGTH, base-type-size=64, base-type-encoding=2C
    Bool: category=FIXED_LENGTH, base-type-size=8, base-type-encoding=BOOLEAN
    ASCIIString: base-type-size=8, base-type-encoding=ISO-8859-1
    UTF8String: base-type-size=8, base-type-encoding=UTF-8
    UTF16String: base-type-size=16, base-type-encoding=UTF-16, byte-order=big-endian
package /Transformer
  data transformation set TransformationSet
    data transformation SOMEIPData: execute-despite-data-unavailability=false, transformer-chain=SOMEIP
    transformation technology SOMEIP: buffer-properties={header-length=64, in-place=false}, protocol=SOMEIP, someip-transformation-description{alignment=8, byte-order=little-endian, interface-version=1}, transformer-class=SERIALIZER, version=1
