AUTOSAR XML (schema 4-3-0)
standard types defined: UInt8, UInt16, UInt32, UInt64, Float32, Float64
package /Cluster
  ethernet cluster Vehicle_Ethernet: baudrate=100000000, protocol-name=ETHERNET
    4 x ethernet physical channel:
      VLAN_NM: comm-connectors=[AMP/VLAN_NM, IC/VLAN_NM, HU/VLAN_NM, ADAS/VLAN_NM, LRR/VLAN_NM, CAMF/VLAN_NM, VGW/VLAN_NM]
        pdu triggering AMP_NM_AEPAMP_NM_UDP_Trg: pdu=AMP_NM_UDP, from AMP, to VGW
        pdu triggering IC_NM_AEPIC_NM_UDP_Trg: pdu=IC_NM_UDP, from IC, to VGW
        pdu triggering HU_NM_AEPHU_NM_UDP_Trg: pdu=HU_NM_UDP, from HU, to VGW
        pdu triggering ADAS_NM_AEPADAS_NM_UDP_Trg: pdu=ADAS_NM_UDP, from ADAS, to VGW
        pdu triggering LRR_NM_AEPLRR_NM_UDP_Trg: pdu=LRR_NM_UDP, from LRR, to VGW
        pdu triggering CAMF_NM_AEPCAMF_NM_UDP_Trg: pdu=CAMF_NM_UDP, from CAMF, to VGW
        pdu triggering VGW_NM_AEPVGW_NM_UDP_Trg: pdu=VGW_NM_UDP, from VGW, to VGW
        8 x network endpoint:
          AMP_NM_NEP: network-endpoint-addresses=ipv-4-configuration={ipv-4-address=192.168.1.8, ipv-4-address-source=FIXED, network-mask=255.255.255.0}
          IC_NM_NEP: network-endpoint-addresses=ipv-4-configuration={ipv-4-address=192.168.1.2, ipv-4-address-source=FIXED, network-mask=255.255.255.0}
          HU_NM_NEP: network-endpoint-addresses=ipv-4-configuration={ipv-4-address=192.168.1.3, ipv-4-address-source=FIXED, network-mask=255.255.255.0}
          ADAS_NM_NEP: network-endpoint-addresses=ipv-4-configuration={ipv-4-address=192.168.1.4, ipv-4-address-source=FIXED, network-mask=255.255.255.0}
          LRR_NM_NEP: network-endpoint-addresses=ipv-4-configuration={ipv-4-address=192.168.1.5, ipv-4-address-source=FIXED, network-mask=255.255.255.0}
          CAMF_NM_NEP: network-endpoint-addresses=ipv-4-configuration={ipv-4-address=192.168.1.7, ipv-4-address-source=FIXED, network-mask=255.255.255.0}
          VGW_NM_NEP: network-endpoint-addresses=ipv-4-configuration={ipv-4-address=192.168.1.1, ipv-4-address-source=FIXED, network-mask=255.255.255.0}
          NM_MC_NEP: network-endpoint-addresses=ipv-4-configuration={ipv-4-address=192.168.1.255, ipv-4-address-source=FIXED, network-mask=255.255.255.0}
        so-ad-config:
          7 x socket connection bundle, all with socket-connection=NM_MC_AEP:
            AMP_NM_AEP_NM_MC_AEP: pdus=socket-connection-ipdu-identifier=AMP_NM_AEPAMP_NM_UDP_Trg, server-port=AMP_NM_AEP
            IC_NM_AEP_NM_MC_AEP: pdus=socket-connection-ipdu-identifier=IC_NM_AEPIC_NM_UDP_Trg, server-port=IC_NM_AEP
            HU_NM_AEP_NM_MC_AEP: pdus=socket-connection-ipdu-identifier=HU_NM_AEPHU_NM_UDP_Trg, server-port=HU_NM_AEP
            ADAS_NM_AEP_NM_MC_AEP: pdus=socket-connection-ipdu-identifier=ADAS_NM_AEPADAS_NM_UDP_Trg, server-port=ADAS_NM_AEP
            LRR_NM_AEP_NM_MC_AEP: pdus=socket-connection-ipdu-identifier=LRR_NM_AEPLRR_NM_UDP_Trg, server-port=LRR_NM_AEP
            CAMF_NM_AEP_NM_MC_AEP: pdus=socket-connection-ipdu-identifier=CAMF_NM_AEPCAMF_NM_UDP_Trg, server-port=CAMF_NM_AEP
            VGW_NM_AEP_NM_MC_AEP: pdus=socket-connection-ipdu-identifier=VGW_NM_AEPVGW_NM_UDP_Trg, server-port=VGW_NM_AEP
          8 x socket address:
            AMP_NM_AEP: connector=AMP/VLAN_NM
              application endpoint AMP_NM_AEP: network-endpoint=AMP_NM_NEP, tp-configuration=udp-tp=udp-tp-port=port-number=50001
            IC_NM_AEP: connector=IC/VLAN_NM
              application endpoint IC_NM_AEP: network-endpoint=IC_NM_NEP, tp-configuration=udp-tp=udp-tp-port=port-number=50001
            HU_NM_AEP: connector=HU/VLAN_NM
              application endpoint HU_NM_AEP: network-endpoint=HU_NM_NEP, tp-configuration=udp-tp=udp-tp-port=port-number=50001
            ADAS_NM_AEP: connector=ADAS/VLAN_NM
              application endpoint ADAS_NM_AEP: network-endpoint=ADAS_NM_NEP, tp-configuration=udp-tp=udp-tp-port=port-number=50001
            LRR_NM_AEP: connector=LRR/VLAN_NM
              application endpoint LRR_NM_AEP: network-endpoint=LRR_NM_NEP, tp-configuration=udp-tp=udp-tp-port=port-number=50001
            CAMF_NM_AEP: connector=CAMF/VLAN_NM
              application endpoint CAMF_NM_AEP: network-endpoint=CAMF_NM_NEP, tp-configuration=udp-tp=udp-tp-port=port-number=50001
            VGW_NM_AEP: connector=VGW/VLAN_NM
              application endpoint VGW_NM_AEP: network-endpoint=VGW_NM_NEP, tp-configuration=udp-tp=udp-tp-port=port-number=50001
            NM_MC_AEP: multicast-connector=[AMP/VLAN_NM, IC/VLAN_NM, HU/VLAN_NM, ADAS/VLAN_NM, LRR/VLAN_NM, CAMF/VLAN_NM, VGW/VLAN_NM]
              application endpoint NM_MC_AEP: network-endpoint=NM_MC_NEP, tp-configuration=udp-tp=udp-tp-port=port-number=50001
        vlan VLAN_NM: vlan-identifier=1
      VLAN_Powertrain_Chassis: comm-connectors=[IC/VLAN_Powertrain_Chassis, HU/VLAN_Powertrain_Chassis, VGW/VLAN_Powertrain_Chassis]
        pdu triggering SD_Drive_MC_AEP_TRG: pdu=SD_PDU, from VGW HU IC, to VGW HU IC
        pdu triggering BatteryStatus_Trg: pdu=BatteryStatus, from VGW, to IC
        pdu triggering VehicleDistance_Trg: pdu=VehicleDistance, from VGW, to IC
        pdu triggering VehicleSpeed_Trg: pdu=VehicleSpeed, from VGW, to IC
        pdu triggering EMotorStatus_Trg: pdu=EMotorStatus, from VGW, to IC
        pdu triggering ExteriorTemperature_Trg: pdu=ExteriorTemperature, from VGW, to HU IC
        pdu triggering Time_Trg: pdu=Time, from VGW, to HU IC
        4 x network endpoint:
          IC_Drive_NEP: network-endpoint-addresses=ipv-4-configuration={ipv-4-address=192.168.2.2, ipv-4-address-source=FIXED, network-mask=255.255.255.0}
          HU_Drive_NEP: network-endpoint-addresses=ipv-4-configuration={ipv-4-address=192.168.2.3, ipv-4-address-source=FIXED, network-mask=255.255.255.0}
          VGW_Drive_NEP: network-endpoint-addresses=ipv-4-configuration={ipv-4-address=192.168.2.1, ipv-4-address-source=FIXED, network-mask=255.255.255.0}
          SD_Drive_MC_NEP: network-endpoint-addresses=ipv-4-configuration={ipv-4-address=239.0.2.1, ipv-4-address-source=FIXED, network-mask=255.255.255.0}
        so-ad-config:
          10 x socket connection bundle:
            SD_Drive_MC_AEP_BNDL: bundled-connections=[VGW_Drive_SOMEIP_SD_AEP, HU_Drive_SOMEIP_SD_AEP, IC_Drive_SOMEIP_SD_AEP], pdus=socket-connection-ipdu-identifier={header-id=4294934784, pdu-triggering=SD_Drive_MC_AEP_TRG}, server-port=SD_Drive_MC_AEP
            BatteryPSI1: socket-connection=IC_Drive_SOMEIP_AEP, pdus=socket-connection-ipdu-identifier={header-id=65667172, pdu-triggering=BatteryStatus_Trg, routing-group=VLAN_Powertrain_ChassisBatteryPSI1BatteryEvg1}, server-port=VGW_Drive_SOMEIP_AEP
            DriveStatusPSI1: socket-connection=IC_Drive_SOMEIP_AEP, server-port=VGW_Drive_SOMEIP_AEP
              pdus:
                header-id=65536101, pdu-triggering=VLAN_Powertrain_Chassis/VehicleDistance_Trg, routing-group=VLAN_Powertrain_ChassisDriveStatusPSI1DriveStatusEvg1
                header-id=65536100, pdu-triggering=VLAN_Powertrain_Chassis/VehicleSpeed_Trg, routing-group=VLAN_Powertrain_ChassisDriveStatusPSI1DriveStatusEvg1
            EnginePSI1: socket-connection=IC_Drive_SOMEIP_AEP, pdus=socket-connection-ipdu-identifier={header-id=65601636, pdu-triggering=EMotorStatus_Trg, routing-group=VLAN_Powertrain_ChassisEnginePSI1EngineEvg1}, server-port=VGW_Drive_SOMEIP_AEP
            InformationPSI1: bundled-connections=[HU_Drive_SOMEIP_AEP, IC_Drive_SOMEIP_AEP], server-port=VGW_Drive_SOMEIP_AEP
              pdus:
                header-id=65732709, pdu-triggering=ExteriorTemperature_Trg, routing-group=VLAN_Powertrain_ChassisInformationPSI1BatteryEvg1
                header-id=65732708, pdu-triggering=Time_Trg, routing-group=VLAN_Powertrain_ChassisInformationPSI1BatteryEvg1
            BatteryCSI1: socket-connection=VGW_Drive_SOMEIP_AEP, server-port=IC_Drive_SOMEIP_AEP
            DriveStatusCSI2: socket-connection=VGW_Drive_SOMEIP_AEP, server-port=IC_Drive_SOMEIP_AEP
            EngineCSI1: socket-connection=VGW_Drive_SOMEIP_AEP, server-port=IC_Drive_SOMEIP_AEP
            InformationCSI1: socket-connection=VGW_Drive_SOMEIP_AEP, server-port=HU_Drive_SOMEIP_AEP
            InformationCSI2: socket-connection=VGW_Drive_SOMEIP_AEP, server-port=IC_Drive_SOMEIP_AEP
          7 x socket address:
            IC_Drive_SOMEIP_SD_AEP: connector=IC/VLAN_Powertrain_Chassis
              application endpoint IC_Drive_SOMEIP_SD_AEP: network-endpoint=IC_Drive_NEP, tp-configuration=udp-tp=udp-tp-port=port-number=30490
            IC_Drive_SOMEIP_AEP: connector=IC/VLAN_Powertrain_Chassis
              application endpoint IC_Drive_SOMEIP_AEP: network-endpoint=IC_Drive_NEP, tp-configuration=udp-tp=udp-tp-port=port-number=30500
                4 x consumed service instance, all with sd-client-config={client-service-major-version=1, client-service-minor-version=0, initial-find-behavior={initial-delay-max-value=0.1, initial-delay-min-value=0.005, initial-repetitions-base-delay=0, initial-repetitions-max=0}, ttl=300}:
                  BatteryCSI1: routing-group=VLAN_Powertrain_Chassis_BatteryPSI1, provided-service-instance=BatteryPSI1
                    consumed event group BatteryEvg1: event-group-identifier=1, routing-group=VLAN_Powertrain_ChassisBatteryPSI1BatteryEvg1
                  DriveStatusCSI2: routing-group=VLAN_Powertrain_Chassis_DriveStatusPSI1, provided-service-instance=VGW_Drive_SOMEIP_AEP/DriveStatusPSI1
                    consumed event group DriveStatusEvg1: event-group-identifier=1, routing-group=VLAN_Powertrain_ChassisDriveStatusPSI1DriveStatusEvg1
                  EngineCSI1: routing-group=VLAN_Powertrain_Chassis_EnginePSI1, provided-service-instance=EnginePSI1
                    consumed event group EngineEvg1: event-group-identifier=1, routing-group=VLAN_Powertrain_ChassisEnginePSI1EngineEvg1
                  InformationCSI2: routing-group=VLAN_Powertrain_Chassis_InformationPSI1, provided-service-instance=InformationPSI1
                    consumed event group BatteryEvg1: event-group-identifier=1, routing-group=VLAN_Powertrain_ChassisInformationPSI1BatteryEvg1
            HU_Drive_SOMEIP_SD_AEP: connector=HU/VLAN_Powertrain_Chassis
              application endpoint HU_Drive_SOMEIP_SD_AEP: network-endpoint=HU_Drive_NEP, tp-configuration=udp-tp=udp-tp-port=port-number=30490
            HU_Drive_SOMEIP_AEP: connector=HU/VLAN_Powertrain_Chassis
              application endpoint HU_Drive_SOMEIP_AEP: network-endpoint=HU_Drive_NEP, tp-configuration=udp-tp=udp-tp-port=port-number=30500
                consumed service instance InformationCSI1: routing-group=VLAN_Powertrain_Chassis_InformationPSI1, provided-service-instance=InformationPSI1, sd-client-config={client-service-major-version=1, client-service-minor-version=0, initial-find-behavior={initial-delay-max-value=0.1, initial-delay-min-value=0.005, initial-repetitions-base-delay=0, initial-repetitions-max=0}, ttl=300}
                  consumed event group BatteryEvg1: event-group-identifier=1, routing-group=VLAN_Powertrain_ChassisInformationPSI1BatteryEvg1
            VGW_Drive_SOMEIP_SD_AEP: connector=VGW/VLAN_Powertrain_Chassis
              application endpoint VGW_Drive_SOMEIP_SD_AEP: network-endpoint=VGW_Drive_NEP, tp-configuration=udp-tp=udp-tp-port=port-number=30490
            VGW_Drive_SOMEIP_AEP: connector=VGW/VLAN_Powertrain_Chassis
              application endpoint VGW_Drive_SOMEIP_AEP: network-endpoint=VGW_Drive_NEP, tp-configuration=udp-tp=udp-tp-port=port-number=30500
                4 x provided service instance, all with instance-identifier=1, sd-server-config={initial-offer-behavior={initial-delay-max-value=0.1, initial-delay-min-value=0.01, initial-repetitions-base-delay=0, initial-repetitions-max=0}, offer-cyclic-delay=240, request-response-delay={max-value=0.2, min-value=0.01}, server-service-major-version=1, server-service-minor-version=0, ttl=300}:
                  BatteryPSI1: routing-group=VLAN_Powertrain_Chassis_BatteryPSI1, service-identifier=1002
                    event handler BatteryEvg1: application-endpoint=VGW_Drive_SOMEIP_AEP, consumed-event-group=BatteryCSI1/BatteryEvg1, multicast-threshold=2
                  DriveStatusPSI1: routing-group=VLAN_Powertrain_Chassis_DriveStatusPSI1, service-identifier=1000
                    event handler DriveStatusEvg1: application-endpoint=VGW_Drive_SOMEIP_AEP, consumed-event-group=DriveStatusCSI2/DriveStatusEvg1, multicast-threshold=2
                  EnginePSI1: routing-group=VLAN_Powertrain_Chassis_EnginePSI1, service-identifier=1001
                    event handler EngineEvg1: application-endpoint=VGW_Drive_SOMEIP_AEP, consumed-event-group=EngineEvg1, multicast-threshold=2
                  InformationPSI1: routing-group=VLAN_Powertrain_Chassis_InformationPSI1, service-identifier=1003
                    event handler BatteryEvg1: application-endpoint=VGW_Drive_SOMEIP_AEP, consumed-event-group=[InformationCSI1/BatteryEvg1, InformationCSI2/BatteryEvg1], multicast-threshold=2
            SD_Drive_MC_AEP: multicast-connector=[IC/VLAN_Powertrain_Chassis, HU/VLAN_Powertrain_Chassis, VGW/VLAN_Powertrain_Chassis]
              application endpoint SD_Drive_MC_AEP: network-endpoint=SD_Drive_MC_NEP, tp-configuration=udp-tp=udp-tp-port=port-number=30490
        vlan VLAN_Powertrain_Chassis: vlan-identifier=2
      VLAN_ADAS: comm-connectors=[IC/VLAN_ADAS, ADAS/VLAN_ADAS, LRR/VLAN_ADAS, CAMF/VLAN_ADAS, VGW/VLAN_ADAS]
        pdu triggering SD_ADAS_MC_AEP_TRG: pdu=SD_PDU, from VGW CAMF LRR ADAS IC, to VGW CAMF LRR ADAS IC
        pdu triggering LaneDetection_Trg0: pdu=LaneDetection, from CAMF, to ADAS
        pdu triggering TrafficSignDetection_Trg0: pdu=TrafficSignDetection, from CAMF, to ADAS
        pdu triggering StartStopResponseTrg0: pdu=StartStopResponse, from CAMF, to ADAS
        pdu triggering FrameRate_NotifierTrg0: pdu=FrameRate_Notifier, from CAMF, to ADAS
        pdu triggering FrameRate_GetterRespTrg0: pdu=FrameRate_GetterResp, from CAMF, to ADAS
        pdu triggering FrameRate_SetterRespTrg0: pdu=FrameRate_SetterResp, from CAMF, to ADAS
        pdu triggering LaneInfo_Trg0: pdu=LaneInfo, from ADAS, to IC
        pdu triggering TrafficSignInfo_Trg0: pdu=TrafficSignInfo, from ADAS, to IC
        pdu triggering VehicleDistance_Trg: pdu=VehicleDistance, from VGW, to ADAS
        pdu triggering VehicleSpeed_Trg: pdu=VehicleSpeed, from VGW, to ADAS
        pdu triggering ObstacleDetection_Trg0: pdu=ObstacleDetection, from LRR, to ADAS
        pdu triggering StartStopRequestTrg0: pdu=StartStopRequest, from ADAS, to CAMF
        pdu triggering FrameRate_GetterReqstTrg0: pdu=FrameRate_GetterRqst, from ADAS, to CAMF
        pdu triggering FrameRate_SetterRqstTrg0: pdu=FrameRate_SetterRqst, from ADAS, to CAMF
        6 x network endpoint:
          IC_ADAS_NEP: network-endpoint-addresses=ipv-4-configuration={ipv-4-address=192.168.4.2, ipv-4-address-source=FIXED, network-mask=255.255.255.0}
          ADAS_ADAS_NEP: network-endpoint-addresses=ipv-4-configuration={ipv-4-address=192.168.4.4, ipv-4-address-source=FIXED, network-mask=255.255.255.0}
          LRR_ADAS_NEP: network-endpoint-addresses=ipv-4-configuration={ipv-4-address=192.168.4.5, ipv-4-address-source=FIXED, network-mask=255.255.255.0}
          CAMF_ADAS_NEP: network-endpoint-addresses=ipv-4-configuration={ipv-4-address=192.168.4.7, ipv-4-address-source=FIXED, network-mask=255.255.255.0}
          VGW_ADAS_NEP: network-endpoint-addresses=ipv-4-configuration={ipv-4-address=192.168.4.1, ipv-4-address-source=FIXED, network-mask=255.255.255.0}
          SD_ADAS_MC_NEP: network-endpoint-addresses=ipv-4-configuration={ipv-4-address=239.0.4.1, ipv-4-address-source=FIXED, network-mask=255.255.255.0}
        so-ad-config:
          9 x socket connection bundle:
            SD_ADAS_MC_AEP_BNDL: pdus=socket-connection-ipdu-identifier={header-id=4294934784, pdu-triggering=SD_ADAS_MC_AEP_TRG}, server-port=SD_ADAS_MC_AEP
              bundled-connections:
                VGW_ADAS_SOMEIP_SD_AEP
                CAMF_ADAS_SOMEIP_SD_AEP
                LRR_ADAS_SOMEIP_SD_AEP
                ADAS_ADAS_SOMEIP_SD_AEP
                IC_ADAS_SOMEIP_SD_AEP
            CameraObjectDetectionPSI1: socket-connection=ADAS_ADAS_SOMEIP_AEP, server-port=CAMF_ADAS_SOMEIP_AEP
              pdus:
                header-id=131170404, pdu-triggering=TrafficSignDetection_Trg0, routing-group=VLAN_ADASCameraObjectDetectionPSI1CameraObjectDetectionEvg1
                header-id=131170405, pdu-triggering=LaneDetection_Trg0, routing-group=VLAN_ADASCameraObjectDetectionPSI1CameraObjectDetectionEvg1
                header-id=131137836, pdu-triggering=StartStopResponseTrg0, routing-group=StartStopResponse0
                header-id=131170504, pdu-triggering=FrameRate_NotifierTrg0
                header-id=131137737, pdu-triggering=FrameRate_GetterRespTrg0, routing-group=FrameRate_Getter0
                header-id=131137738, pdu-triggering=FrameRate_SetterRespTrg0, routing-group=FrameRate_Setter0
            DetectionStatusPSI1: socket-connection=IC_ADAS_SOMEIP_AEP, server-port=ADAS_ADAS_SOMEIP_AEP
              pdus:
                header-id=131104868, pdu-triggering=TrafficSignInfo_Trg0, routing-group=VLAN_ADASDetectionStatusPSI1DetectionStatusEvg1
                header-id=131104869, pdu-triggering=LaneInfo_Trg0, routing-group=VLAN_ADASDetectionStatusPSI1DetectionStatusEvg1
            DriveStatusPSI1: socket-connection=ADAS_ADAS_SOMEIP_AEP, server-port=VGW_ADAS_SOMEIP_AEP
              pdus:
                header-id=65536101, pdu-triggering=VLAN_ADAS/VehicleDistance_Trg, routing-group=VLAN_ADASDriveStatusPSI1DriveStatusEvg1
                header-id=65536100, pdu-triggering=VLAN_ADAS/VehicleSpeed_Trg, routing-group=VLAN_ADASDriveStatusPSI1DriveStatusEvg1
            ObstacleDetectionPSI1: socket-connection=ADAS_ADAS_SOMEIP_AEP, pdus=socket-connection-ipdu-identifier={header-id=131235940, pdu-triggering=ObstacleDetection_Trg0, routing-group=VLAN_ADASObstacleDetectionPSI1ObstacleDetectionEvg1}, server-port=LRR_ADAS_SOMEIP_AEP
            CameraObjectDetectionCSI1: socket-connection=CAMF_ADAS_SOMEIP_AEP, server-port=ADAS_ADAS_SOMEIP_AEP
              pdus:
                header-id=131137836, pdu-triggering=StartStopRequestTrg0, routing-group=StartStopRequest0
                header-id=131137737, pdu-triggering=FrameRate_GetterReqstTrg0, routing-group=FrameRate_Getter0
                header-id=131137738, pdu-triggering=FrameRate_SetterRqstTrg0, routing-group=FrameRate_Setter0
            DetectionStatusCSI1: socket-connection=ADAS_ADAS_SOMEIP_AEP, server-port=IC_ADAS_SOMEIP_AEP
            DriveStatusCSI1: socket-connection=VGW_ADAS_SOMEIP_AEP, server-port=ADAS_ADAS_SOMEIP_AEP
            ObstacleDetectionCSI1: socket-connection=LRR_ADAS_SOMEIP_AEP, server-port=ADAS_ADAS_SOMEIP_AEP
          11 x socket address:
            IC_ADAS_SOMEIP_SD_AEP: connector=IC/VLAN_ADAS
              application endpoint IC_ADAS_SOMEIP_SD_AEP: network-endpoint=IC_ADAS_NEP, tp-configuration=udp-tp=udp-tp-port=port-number=30490
            IC_ADAS_SOMEIP_AEP: connector=IC/VLAN_ADAS
              application endpoint IC_ADAS_SOMEIP_AEP: network-endpoint=IC_ADAS_NEP, tp-configuration=udp-tp=udp-tp-port=port-number=30500
                consumed service instance DetectionStatusCSI1: routing-group=VLAN_ADAS_DetectionStatusPSI1, provided-service-instance=DetectionStatusPSI1, sd-client-config={client-service-major-version=1, client-service-minor-version=0, initial-find-behavior={initial-delay-max-value=0.1, initial-delay-min-value=0.005, initial-repetitions-base-delay=0, initial-repetitions-max=0}, ttl=300}
                  consumed event group DetectionStatusEvg1: event-group-identifier=1, routing-group=VLAN_ADASDetectionStatusPSI1DetectionStatusEvg1
            ADAS_ADAS_SOMEIP_SD_AEP: connector=ADAS/VLAN_ADAS
              application endpoint ADAS_ADAS_SOMEIP_SD_AEP: network-endpoint=ADAS_ADAS_NEP, tp-configuration=udp-tp=udp-tp-port=port-number=30490
            ADAS_ADAS_SOMEIP_AEP: connector=ADAS/VLAN_ADAS
              application endpoint ADAS_ADAS_SOMEIP_AEP: network-endpoint=ADAS_ADAS_NEP, tp-configuration=udp-tp=udp-tp-port=port-number=30500
                consumed service instance CameraObjectDetectionCSI1: routing-group=[VLAN_ADAS_CameraObjectDetectionPSI1, StartStopResponse0], provided-service-instance=CameraObjectDetectionPSI1, sd-client-config={client-service-major-version=1, client-service-minor-version=0, initial-find-behavior={initial-delay-max-value=0.1, initial-delay-min-value=0.005, initial-repetitions-base-delay=0, initial-repetitions-max=0}, ttl=300}
                  consumed event group CameraObjectDetectionEvg1: event-group-identifier=1, routing-group=VLAN_ADASCameraObjectDetectionPSI1CameraObjectDetectionEvg1
                consumed service instance DriveStatusCSI1: routing-group=VLAN_ADAS_DriveStatusPSI1, provided-service-instance=VGW_Drive_SOMEIP_AEP/DriveStatusPSI1, sd-client-config={client-service-major-version=1, client-service-minor-version=0, initial-find-behavior={initial-delay-max-value=0.1, initial-delay-min-value=0.005, initial-repetitions-base-delay=0, initial-repetitions-max=0}, ttl=300}
                  consumed event group DriveStatusEvg1: event-group-identifier=1, routing-group=VLAN_ADASDriveStatusPSI1DriveStatusEvg1
                consumed service instance ObstacleDetectionCSI1: routing-group=VLAN_ADAS_ObstacleDetectionPSI1, provided-service-instance=ObstacleDetectionPSI1, sd-client-config={client-service-major-version=1, client-service-minor-version=0, initial-find-behavior={initial-delay-max-value=0.1, initial-delay-min-value=0.005, initial-repetitions-base-delay=0, initial-repetitions-max=0}, ttl=300}
                  consumed event group ObstacleDetectionEvg1: event-group-identifier=1, routing-group=VLAN_ADASObstacleDetectionPSI1ObstacleDetectionEvg1
                provided service instance DetectionStatusPSI1:
                  routing-group=VLAN_ADAS_DetectionStatusPSI1
                  instance-identifier=1
                  sd-server-config={initial-offer-behavior={initial-delay-max-value=0.1, initial-delay-min-value=0.01, initial-repetitions-base-delay=0, initial-repetitions-max=0}, offer-cyclic-delay=240, request-response-delay={max-value=0.2, min-value=0.01}, server-service-major-version=1, server-service-minor-version=0, ttl=300}
                  service-identifier=2000
                  event handler DetectionStatusEvg1: application-endpoint=ADAS_ADAS_SOMEIP_AEP, consumed-event-group=DetectionStatusEvg1, multicast-threshold=2
            LRR_ADAS_SOMEIP_SD_AEP: connector=LRR/VLAN_ADAS
              application endpoint LRR_ADAS_SOMEIP_SD_AEP: network-endpoint=LRR_ADAS_NEP, tp-configuration=udp-tp=udp-tp-port=port-number=30490
            LRR_ADAS_SOMEIP_AEP: connector=LRR/VLAN_ADAS
              application endpoint LRR_ADAS_SOMEIP_AEP: network-endpoint=LRR_ADAS_NEP, tp-configuration=udp-tp=udp-tp-port=port-number=30500
                provided service instance ObstacleDetectionPSI1:
                  routing-group=VLAN_ADAS_ObstacleDetectionPSI1
                  instance-identifier=1
                  sd-server-config={initial-offer-behavior={initial-delay-max-value=0.1, initial-delay-min-value=0.01, initial-repetitions-base-delay=0, initial-repetitions-max=0}, offer-cyclic-delay=240, request-response-delay={max-value=0.2, min-value=0.01}, server-service-major-version=1, server-service-minor-version=0, ttl=300}
                  service-identifier=2002
                  event handler ObstacleDetectionEvg1: application-endpoint=LRR_ADAS_SOMEIP_AEP, consumed-event-group=ObstacleDetectionEvg1, multicast-threshold=2
            CAMF_ADAS_SOMEIP_SD_AEP: connector=CAMF/VLAN_ADAS
              application endpoint CAMF_ADAS_SOMEIP_SD_AEP: network-endpoint=CAMF_ADAS_NEP, tp-configuration=udp-tp=udp-tp-port=port-number=30490
            CAMF_ADAS_SOMEIP_AEP: connector=CAMF/VLAN_ADAS
              application endpoint CAMF_ADAS_SOMEIP_AEP: network-endpoint=CAMF_ADAS_NEP, tp-configuration=udp-tp=udp-tp-port=port-number=30500
                provided service instance CameraObjectDetectionPSI1:
                  routing-group=[VLAN_ADAS_CameraObjectDetectionPSI1, StartStopRequest0]
                  instance-identifier=1
                  sd-server-config={initial-offer-behavior={initial-delay-max-value=0.1, initial-delay-min-value=0.01, initial-repetitions-base-delay=0, initial-repetitions-max=0}, offer-cyclic-delay=240, request-response-delay={max-value=0.2, min-value=0.01}, server-service-major-version=1, server-service-minor-version=0, ttl=300}
                  service-identifier=2001
                  event handler CameraObjectDetectionEvg1: application-endpoint=CAMF_ADAS_SOMEIP_AEP, consumed-event-group=CameraObjectDetectionEvg1, multicast-threshold=2
            VGW_ADAS_SOMEIP_SD_AEP: connector=VGW/VLAN_ADAS
              application endpoint VGW_ADAS_SOMEIP_SD_AEP: network-endpoint=VGW_ADAS_NEP, tp-configuration=udp-tp=udp-tp-port=port-number=30490
            VGW_ADAS_SOMEIP_AEP: connector=VGW/VLAN_ADAS
              application endpoint VGW_ADAS_SOMEIP_AEP: network-endpoint=VGW_ADAS_NEP, tp-configuration=udp-tp=udp-tp-port=port-number=30500
                provided service instance DriveStatusPSI1: routing-group=VLAN_ADAS_DriveStatusPSI1, instance-identifier=1, sd-server-config={initial-offer-behavior={initial-delay-max-value=0.1, initial-delay-min-value=0.01, initial-repetitions-base-delay=0, initial-repetitions-max=0}, offer-cyclic-delay=240, request-response-delay={max-value=0.2, min-value=0.01}, server-service-major-version=1, server-service-minor-version=0, ttl=300}, service-identifier=1000
                  event handler DriveStatusEvg1: application-endpoint=VGW_ADAS_SOMEIP_AEP, consumed-event-group=DriveStatusCSI1/DriveStatusEvg1, multicast-threshold=2
            SD_ADAS_MC_AEP: multicast-connector=[IC/VLAN_ADAS, ADAS/VLAN_ADAS, LRR/VLAN_ADAS, CAMF/VLAN_ADAS, VGW/VLAN_ADAS]
              application endpoint SD_ADAS_MC_AEP: network-endpoint=SD_ADAS_MC_NEP, tp-configuration=udp-tp=udp-tp-port=port-number=30490
        vlan VLAN_ADAS: vlan-identifier=4
      VLAN_Infotainment: comm-connectors=[AMP/VLAN_Infotainment, HU/VLAN_Infotainment]
        pdu triggering HU_ADAS_AUTOSAR_AEPVolumeRequest_Trg: pdu=VolumeRequest, from HU, to AMP
        network endpoint AMP_ADAS_NEP: network-endpoint-addresses=ipv-4-configuration={ipv-4-address=192.168.3.8, ipv-4-address-source=FIXED, network-mask=255.255.255.0}
        network endpoint HU_ADAS_NEP: network-endpoint-addresses=ipv-4-configuration={ipv-4-address=192.168.3.3, ipv-4-address-source=FIXED, network-mask=255.255.255.0}
        so-ad-config:
          socket connection bundle HU_ADAS_AUTOSAR_AEP_AMP_ADAS_AUTOSAR_AEP: socket-connection=AMP_ADAS_AUTOSAR_AEP, pdus=socket-connection-ipdu-identifier={header-id=103, pdu-triggering=HU_ADAS_AUTOSAR_AEPVolumeRequest_Trg}, server-port=HU_ADAS_AUTOSAR_AEP
          socket address AMP_ADAS_AUTOSAR_AEP: connector=AMP/VLAN_Infotainment
            application endpoint AMP_ADAS_AUTOSAR_AEP: network-endpoint=AMP_ADAS_NEP, tp-configuration=udp-tp=udp-tp-port=port-number=40001
          socket address HU_ADAS_AUTOSAR_AEP: connector=HU/VLAN_Infotainment
            application endpoint HU_ADAS_AUTOSAR_AEP: network-endpoint=HU_ADAS_NEP, tp-configuration=udp-tp=udp-tp-port=port-number=40001
        vlan VLAN_Infotainment: vlan-identifier=3
package /ECU
  7 x ecu instance:
    VGW
      ethernet communication controller VGW_Vehicle_Ethernet: mac-unicast-address=02:00:00:00:00:01
      ethernet communication connector VLAN_NM: comm-controller=VGW_Vehicle_Ethernet, network-endpoint=[VGW_NM_NEP, NM_MC_NEP]
      ethernet communication connector VLAN_Powertrain_Chassis: comm-controller=VGW_Vehicle_Ethernet, network-endpoint=[VGW_Drive_NEP, SD_Drive_MC_NEP]
      ethernet communication connector VLAN_ADAS: comm-controller=VGW_Vehicle_Ethernet, network-endpoint=[VGW_ADAS_NEP, SD_ADAS_MC_NEP]
    CAMF
      ethernet communication controller CAMF_Vehicle_Ethernet: mac-unicast-address=02:00:00:00:00:07
      ethernet communication connector VLAN_NM: comm-controller=CAMF_Vehicle_Ethernet, network-endpoint=[CAMF_NM_NEP, NM_MC_NEP]
      ethernet communication connector VLAN_ADAS: comm-controller=CAMF_Vehicle_Ethernet, network-endpoint=[CAMF_ADAS_NEP, SD_ADAS_MC_NEP]
    LRR
      ethernet communication controller LRR_Vehicle_Ethernet: mac-unicast-address=02:00:00:00:00:05
      ethernet communication connector VLAN_NM: comm-controller=LRR_Vehicle_Ethernet, network-endpoint=[LRR_NM_NEP, NM_MC_NEP]
      ethernet communication connector VLAN_ADAS: comm-controller=LRR_Vehicle_Ethernet, network-endpoint=[LRR_ADAS_NEP, SD_ADAS_MC_NEP]
    ADAS
      ethernet communication controller ADAS_Vehicle_Ethernet: mac-unicast-address=02:00:00:00:00:04
      ethernet communication connector VLAN_NM: comm-controller=ADAS_Vehicle_Ethernet, network-endpoint=[ADAS_NM_NEP, NM_MC_NEP]
      ethernet communication connector VLAN_ADAS: comm-controller=ADAS_Vehicle_Ethernet, network-endpoint=[ADAS_ADAS_NEP, SD_ADAS_MC_NEP]
    HU
      ethernet communication controller HU_Vehicle_Ethernet: mac-unicast-address=02:00:00:00:00:03
      ethernet communication connector VLAN_NM: comm-controller=HU_Vehicle_Ethernet, network-endpoint=HU_NM_NEP
      ethernet communication connector VLAN_Powertrain_Chassis: comm-controller=HU_Vehicle_Ethernet, network-endpoint=[HU_Drive_NEP, SD_Drive_MC_NEP]
      ethernet communication connector VLAN_Infotainment: comm-controller=HU_Vehicle_Ethernet, network-endpoint=[HU_ADAS_NEP, NM_MC_NEP]
    IC
      ethernet communication controller IC_Vehicle_Ethernet: mac-unicast-address=02:00:00:00:00:02
      ethernet communication connector VLAN_NM: comm-controller=IC_Vehicle_Ethernet, network-endpoint=[IC_NM_NEP, NM_MC_NEP]
      ethernet communication connector VLAN_Powertrain_Chassis: comm-controller=IC_Vehicle_Ethernet, network-endpoint=[IC_Drive_NEP, SD_Drive_MC_NEP]
      ethernet communication connector VLAN_ADAS: comm-controller=IC_Vehicle_Ethernet, network-endpoint=[IC_ADAS_NEP, SD_ADAS_MC_NEP]
    AMP
      ethernet communication controller AMP_Vehicle_Ethernet: mac-unicast-address=02:00:00:00:00:08
      ethernet communication connector VLAN_NM: comm-controller=AMP_Vehicle_Ethernet, network-endpoint=AMP_NM_NEP
      ethernet communication connector VLAN_Infotainment: comm-controller=AMP_Vehicle_Ethernet, network-endpoint=[AMP_ADAS_NEP, NM_MC_NEP]
package /PDU
  general purpose pdu SD_PDU: category=SD, length=1472
  pdu VehicleDistance: length=8, transmission-mode-true-timing=cyclic-timing=time-period=0.25, unused-bit-pattern=0
    signal VehicleTripDistance: start 0, 32 bit, little-endian, data-type-policy=OVERRIDE, base-type=UInt32, compu {phys=raw*0.01-1000, 0=NoDistance; unit m}, to IC ADAS
    signal VehicleTotalDistance: start 32, 32 bit, little-endian, data-type-policy=OVERRIDE, base-type=UInt32, compu {phys=raw*0.01-1000, 0=NoDistance; unit m}, to IC ADAS
  pdu VehicleSpeed: length=3, transmission-mode-true-timing=cyclic-timing=time-period=0.1, unused-bit-pattern=0
    signal VehicleSpeed: start 0, 16 bit, little-endian, data-type-policy=OVERRIDE, base-type=UInt16, compu {phys=raw*0.1-100; unit km/h}, to IC ADAS
    signal VehicleDirection: start 16, 8 bit, little-endian, data-type-policy=OVERRIDE, base-type=UInt8, compu {1=Forward, 2=Backward}, to IC ADAS
  pdu EMotorStatus: length=12, transmission-mode-true-timing=cyclic-timing=time-period=0.1, unused-bit-pattern=0
    signal EMotorSpeed: start 0, 16 bit, little-endian, data-type-policy=OVERRIDE, base-type=UInt16, compu {phys=raw*0.1-100; unit km/h}, to IC
    signal EMotorTemperature: start 16, 16 bit, little-endian, data-type-policy=OVERRIDE, base-type=UInt16, compu {phys=raw*0.1-273; unit °C}, to IC
    signal EMotorCurrent: start 32, 32 bit, little-endian, data-type-policy=OVERRIDE, base-type=UInt32, compu {phys=raw*0.001-1000; unit A}, to IC
    signal EMotorPower: start 64, 32 bit, little-endian, data-type-policy=OVERRIDE, base-type=UInt32, compu {phys=raw*0.001-1000; unit kW}, to IC
  pdu BatteryStatus: length=10, transmission-mode-true-timing=cyclic-timing=time-period=0.5, unused-bit-pattern=0
    signal BatteryTemperature: start 0, 16 bit, little-endian, data-type-policy=OVERRIDE, base-type=UInt16, compu {phys=raw*0.1-273; unit °C}, to IC
    signal RemainingCapacity: start 16, 32 bit, little-endian, data-type-policy=OVERRIDE, base-type=UInt32, compu {phys=raw*0.001; unit kWh}, to IC
    signal Capacity: start 48, 32 bit, little-endian, data-type-policy=OVERRIDE, base-type=UInt32, compu {phys=raw*0.001; unit kWh}, to IC
  pdu ExteriorTemperature: length=2, transmission-mode-true-timing=cyclic-timing=time-period=2, unused-bit-pattern=0
    signal ExteriorTemperature: start 0, 16 bit, little-endian, data-type-policy=OVERRIDE, base-type=UInt16, compu {phys=raw*0.1-273; unit °C}, to HU IC
  pdu Time: length=16, transmission-mode-true-timing=cyclic-timing=time-period=1, unused-bit-pattern=0
    signal Minute: start 0, 8 bit, little-endian, data-type-policy=OVERRIDE, base-type=UInt8, compu {linear; unit m}, to HU IC
    signal Second: start 8, 8 bit, little-endian, data-type-policy=OVERRIDE, base-type=UInt8, compu {linear; unit sec}, to HU IC
    signal Hour: start 16, 8 bit, little-endian, data-type-policy=OVERRIDE, base-type=UInt8, compu {linear; unit h}, to HU IC
  nm pdu AMP_NM_UDP: length=4, unused-bit-pattern=0
    signal AMP_NM_UDPRepeatMessageRequest: start 0, 1 bit, little-endian, data-type-policy=OVERRIDE, base-type=UInt32, to VGW
    signal AMP_NM_UDPNMCoordinatorSleeptReadyBit: start 3, 1 bit, little-endian, data-type-policy=OVERRIDE, base-type=UInt32, to VGW
    signal AMP_NM_UDPActiveWakeupBit: start 4, 1 bit, little-endian, data-type-policy=OVERRIDE, base-type=UInt32, to VGW
    signal AMP_NM_UDPPartialNetworkInformationBit: start 6, 1 bit, little-endian, data-type-policy=OVERRIDE, base-type=UInt32, to VGW
    signal AMP_NM_UDPNodeId: start 8, 8 bit, little-endian, data-type-policy=OVERRIDE, base-type=UInt8, to VGW
    signal AMP_NM_UDPPNCVector: start 16, 16 bit, little-endian, data-type-policy=OVERRIDE, base-type=UInt16, to VGW
  nm pdu IC_NM_UDP: length=4, unused-bit-pattern=0
    signal IC_NM_UDPRepeatMessageRequest: start 0, 1 bit, little-endian, data-type-policy=OVERRIDE, base-type=UInt32, to VGW
    signal IC_NM_UDPNMCoordinatorSleeptReadyBit: start 3, 1 bit, little-endian, data-type-policy=OVERRIDE, base-type=UInt32, to VGW
    signal IC_NM_UDPActiveWakeupBit: start 4, 1 bit, little-endian, data-type-policy=OVERRIDE, base-type=UInt32, to VGW
    signal IC_NM_UDPPartialNetworkInformationBit: start 6, 1 bit, little-endian, data-type-policy=OVERRIDE, base-type=UInt32, to VGW
    signal IC_NM_UDPNodeId: start 8, 8 bit, little-endian, data-type-policy=OVERRIDE, base-type=UInt8, to VGW
    signal IC_NM_UDPPNCVector: start 16, 16 bit, little-endian, data-type-policy=OVERRIDE, base-type=UInt16, to VGW
  nm pdu HU_NM_UDP: length=4, unused-bit-pattern=0
    signal HU_NM_UDPRepeatMessageRequest: start 0, 1 bit, little-endian, data-type-policy=OVERRIDE, base-type=UInt32, to VGW
    signal HU_NM_UDPNMCoordinatorSleeptReadyBit: start 3, 1 bit, little-endian, data-type-policy=OVERRIDE, base-type=UInt32, to VGW
    signal HU_NM_UDPActiveWakeupBit: start 4, 1 bit, little-endian, data-type-policy=OVERRIDE, base-type=UInt32, to VGW
    signal HU_NM_UDPPartialNetworkInformationBit: start 6, 1 bit, little-endian, data-type-policy=OVERRIDE, base-type=UInt32, to VGW
    signal HU_NM_UDPNodeId: start 8, 8 bit, little-endian, data-type-policy=OVERRIDE, base-type=UInt8, to VGW
    signal HU_NM_UDPPNCVector: start 16, 16 bit, little-endian, data-type-policy=OVERRIDE, base-type=UInt16, to VGW
  nm pdu ADAS_NM_UDP: length=4, unused-bit-pattern=0
    signal ADAS_NM_UDPRepeatMessageRequest: start 0, 1 bit, little-endian, data-type-policy=OVERRIDE, base-type=UInt32, to VGW
    signal ADAS_NM_UDPNMCoordinatorSleeptReadyBit: start 3, 1 bit, little-endian, data-type-policy=OVERRIDE, base-type=UInt32, to VGW
    signal ADAS_NM_UDPActiveWakeupBit: start 4, 1 bit, little-endian, data-type-policy=OVERRIDE, base-type=UInt32, to VGW
    signal ADAS_NM_UDPPartialNetworkInformationBit: start 6, 1 bit, little-endian, data-type-policy=OVERRIDE, base-type=UInt32, to VGW
    signal ADAS_NM_UDPNodeId: start 8, 8 bit, little-endian, data-type-policy=OVERRIDE, base-type=UInt8, to VGW
    signal ADAS_NM_UDPPNCVector: start 16, 16 bit, little-endian, data-type-policy=OVERRIDE, base-type=UInt16, to VGW
  nm pdu LRR_NM_UDP: length=4, unused-bit-pattern=0
    signal LRR_NM_UDPRepeatMessageRequest: start 0, 1 bit, little-endian, data-type-policy=OVERRIDE, base-type=UInt32, to VGW
    signal LRR_NM_UDPNMCoordinatorSleeptReadyBit: start 3, 1 bit, little-endian, data-type-policy=OVERRIDE, base-type=UInt32, to VGW
    signal LRR_NM_UDPActiveWakeupBit: start 4, 1 bit, little-endian, data-type-policy=OVERRIDE, base-type=UInt32, to VGW
    signal LRR_NM_UDPPartialNetworkInformationBit: start 6, 1 bit, little-endian, data-type-policy=OVERRIDE, base-type=UInt32, to VGW
    signal LRR_NM_UDPNodeId: start 8, 8 bit, little-endian, data-type-policy=OVERRIDE, base-type=UInt8, to VGW
    signal LRR_NM_UDPPNCVector: start 16, 16 bit, little-endian, data-type-policy=OVERRIDE, base-type=UInt16, to VGW
  nm pdu CAMF_NM_UDP: length=4, unused-bit-pattern=0
    signal CAMF_NM_UDPRepeatMessageRequest: start 0, 1 bit, little-endian, data-type-policy=OVERRIDE, base-type=UInt32, to VGW
    signal CAMF_NM_UDPNMCoordinatorSleeptReadyBit: start 3, 1 bit, little-endian, data-type-policy=OVERRIDE, base-type=UInt32, to VGW
    signal CAMF_NM_UDPActiveWakeupBit: start 4, 1 bit, little-endian, data-type-policy=OVERRIDE, base-type=UInt32, to VGW
    signal CAMF_NM_UDPPartialNetworkInformationBit: start 6, 1 bit, little-endian, data-type-policy=OVERRIDE, base-type=UInt32, to VGW
    signal CAMF_NM_UDPNodeId: start 8, 8 bit, little-endian, data-type-policy=OVERRIDE, base-type=UInt8, to VGW
    signal CAMF_NM_UDPPNCVector: start 16, 16 bit, little-endian, data-type-policy=OVERRIDE, base-type=UInt16, to VGW
  nm pdu VGW_NM_UDP: length=4, unused-bit-pattern=0
    signal VGW_NM_UDPRepeatMessageRequest: start 0, 1 bit, little-endian, data-type-policy=OVERRIDE, base-type=UInt32, to VGW
    signal VGW_NM_UDPNMCoordinatorSleeptReadyBit: start 3, 1 bit, little-endian, data-type-policy=OVERRIDE, base-type=UInt32, to VGW
    signal VGW_NM_UDPActiveWakeupBit: start 4, 1 bit, little-endian, data-type-policy=OVERRIDE, base-type=UInt32, to VGW
    signal VGW_NM_UDPPartialNetworkInformationBit: start 6, 1 bit, little-endian, data-type-policy=OVERRIDE, base-type=UInt32, to VGW
    signal VGW_NM_UDPNodeId: start 8, 8 bit, little-endian, data-type-policy=OVERRIDE, base-type=UInt8, to VGW
    signal VGW_NM_UDPPNCVector: start 16, 16 bit, little-endian, data-type-policy=OVERRIDE, base-type=UInt16, to VGW
  pdu LaneDetection: length=16, unused-bit-pattern=0
    signal LaneDetection: start 0, 128 bit, little-endian, data-transformations=SOMEIPData, data-type-policy=TRANSFORMING-I-SIGNAL, someip-transformation-i-signal-props{transformer=SOMEIP, interface-version=1, size-of-array-length-fields=4, size-of-struct-length-fields=4, size-of-union-length-fields=4}, transfer-property=TRIGGERED, to ADAS
  pdu TrafficSignDetection: length=16, unused-bit-pattern=0
    signal TrafficSignDetection: start 0, 128 bit, little-endian, data-transformations=SOMEIPData, data-type-policy=TRANSFORMING-I-SIGNAL, someip-transformation-i-signal-props{transformer=SOMEIP, interface-version=1, size-of-array-length-fields=4, size-of-struct-length-fields=4, size-of-union-length-fields=4}, transfer-property=TRIGGERED, to ADAS
  pdu StartStopResponse: length=16, unused-bit-pattern=0
    signal StartStopResponse: start 0, 128 bit, little-endian, data-transformations=SOMEIPData, data-type-policy=TRANSFORMING-I-SIGNAL, someip-transformation-i-signal-props{transformer=SOMEIP, interface-version=1, size-of-array-length-fields=4, size-of-struct-length-fields=4, size-of-union-length-fields=4}, transfer-property=TRIGGERED, to ADAS
  pdu FrameRate_Notifier: length=16, unused-bit-pattern=0
    signal FrameRate_Notifier: start 0, 128 bit, little-endian, data-transformations=SOMEIPData, data-type-policy=TRANSFORMING-I-SIGNAL, someip-transformation-i-signal-props{transformer=SOMEIP, interface-version=1, size-of-array-length-fields=4, size-of-struct-length-fields=4, size-of-union-length-fields=4}, transfer-property=TRIGGERED, to ADAS
  pdu FrameRate_GetterResp: length=16, unused-bit-pattern=0
    signal FrameRate_GetterResp: start 0, 128 bit, little-endian, data-transformations=SOMEIPData, data-type-policy=TRANSFORMING-I-SIGNAL, someip-transformation-i-signal-props{transformer=SOMEIP, interface-version=1, size-of-array-length-fields=4, size-of-struct-length-fields=4, size-of-union-length-fields=4}, transfer-property=TRIGGERED, to ADAS
  pdu FrameRate_SetterResp: length=16, unused-bit-pattern=0
    signal FrameRate_SetterResp: start 0, 128 bit, little-endian, data-transformations=SOMEIPData, data-type-policy=TRANSFORMING-I-SIGNAL, someip-transformation-i-signal-props{transformer=SOMEIP, interface-version=1, size-of-array-length-fields=4, size-of-struct-length-fields=4, size-of-union-length-fields=4}, transfer-property=TRIGGERED, to ADAS
  pdu LaneInfo: length=16, unused-bit-pattern=0
    signal LaneInfo: start 0, 128 bit, little-endian, data-transformations=SOMEIPData, data-type-policy=TRANSFORMING-I-SIGNAL, someip-transformation-i-signal-props{transformer=SOMEIP, interface-version=1, size-of-array-length-fields=4, size-of-struct-length-fields=4, size-of-union-length-fields=4}, transfer-property=TRIGGERED, to IC
  pdu TrafficSignInfo: length=16, unused-bit-pattern=0
    signal TrafficSignInfo: start 0, 128 bit, little-endian, data-transformations=SOMEIPData, data-type-policy=TRANSFORMING-I-SIGNAL, someip-transformation-i-signal-props{transformer=SOMEIP, interface-version=1, size-of-array-length-fields=4, size-of-struct-length-fields=4, size-of-union-length-fields=4}, transfer-property=TRIGGERED, to IC
  pdu ObstacleDetection: length=16, unused-bit-pattern=0
    signal ObstacleDetection: start 0, 128 bit, little-endian, data-transformations=SOMEIPData, data-type-policy=TRANSFORMING-I-SIGNAL, someip-transformation-i-signal-props{transformer=SOMEIP, interface-version=1, size-of-array-length-fields=4, size-of-struct-length-fields=4, size-of-union-length-fields=4}, transfer-property=TRIGGERED, to ADAS
  pdu StartStopRequest: length=16, unused-bit-pattern=0
    signal StartStopRequest: start 0, 128 bit, little-endian, data-transformations=SOMEIPData, data-type-policy=TRANSFORMING-I-SIGNAL, someip-transformation-i-signal-props{transformer=SOMEIP, interface-version=1, size-of-array-length-fields=4, size-of-struct-length-fields=4, size-of-union-length-fields=4}, transfer-property=TRIGGERED, to CAMF
  pdu FrameRate_GetterRqst: length=16, unused-bit-pattern=0
    signal FrameRate_GetterRqst: start 0, 128 bit, little-endian, data-transformations=SOMEIPData, data-type-policy=TRANSFORMING-I-SIGNAL, someip-transformation-i-signal-props{transformer=SOMEIP, interface-version=1, size-of-array-length-fields=4, size-of-struct-length-fields=4, size-of-union-length-fields=4}, transfer-property=TRIGGERED, to CAMF
  pdu FrameRate_SetterRqst: length=16, unused-bit-pattern=0
    signal FrameRate_SetterRqst: start 0, 128 bit, little-endian, data-transformations=SOMEIPData, data-type-policy=TRANSFORMING-I-SIGNAL, someip-transformation-i-signal-props{transformer=SOMEIP, interface-version=1, size-of-array-length-fields=4, size-of-struct-length-fields=4, size-of-union-length-fields=4}, transfer-property=TRIGGERED, to CAMF
  pdu VolumeRequest: length=16, transmission-mode-true-timing=event-controlled-timing=number-of-repetitions=0, unused-bit-pattern=0
    signal VolumeRequestVolumeRequest: start 0, 8 bit, little-endian, data-type-policy=OVERRIDE, base-type=UInt8, to AMP
package /SystemMapping
  system System
    system mapping SystemMapping
      data-mappings:
        sender-receiver-to-signal-mapping={event-handler=CameraObjectDetectionEvg1, service-instance=CameraObjectDetectionPSI1, data-element=TrafficSignDetection, system-signal=TrafficSignDetection}
        sender-receiver-to-signal-mapping={event-handler=CameraObjectDetectionEvg1, service-instance=CameraObjectDetectionPSI1, data-element=LaneDetection, system-signal=LaneDetection}
        sender-receiver-to-signal-mapping={event-handler=CameraObjectDetectionEvg1, service-instance=CameraObjectDetectionPSI1, data-element=FrameRate_Notifier, system-signal=FrameRate_Notifier}
        client-server-to-signal-mapping={service-instance=CameraObjectDetectionPSI1, call-signal=StartStopRequest, client-server-operation=StartStop, return-signal=StartStopResponse}
        client-server-to-signal-mapping={service-instance=CameraObjectDetectionPSI1, call-signal=FrameRate_GetterRqst, client-server-operation=FrameRate_Getter, return-signal=FrameRate_GetterResp}
        client-server-to-signal-mapping={service-instance=CameraObjectDetectionPSI1, call-signal=FrameRate_SetterRqst, client-server-operation=FrameRate_Setter, return-signal=FrameRate_SetterResp}
        sender-receiver-to-signal-mapping={event-handler=DetectionStatusEvg1, service-instance=DetectionStatusPSI1, data-element=TrafficSignInfo, system-signal=TrafficSignInfo}
        sender-receiver-to-signal-mapping={event-handler=DetectionStatusEvg1, service-instance=DetectionStatusPSI1, data-element=LaneInfo, system-signal=LaneInfo}
        sender-receiver-to-signal-mapping={event-handler=ObstacleDetectionEvg1, service-instance=ObstacleDetectionPSI1, data-element=ObstacleDetection, system-signal=ObstacleDetection}
  sender receiver interface SenderReceiver
    6 x data:
      LaneDetection: type=LaneDetectionEvt
      TrafficSignDetection: type=TrafficSignDetectionEvt
      FrameRate_Notifier: type=FrameRateDT
      ObstacleDetection: type=ObstacleDetectionEvt
      LaneInfo: type=LaneInfoEvt
      TrafficSignInfo: type=TrafficSignInfoEvt
package /ClientServerInterface
  client server interface CameraObjectDetection: category=CONTROL, is-service=true
    operation StartStop
      arg Activate: type=Activate, direction=IN
      arg Result: type=ActivateResult, direction=OUT
    operation FrameRate_Getter
      arg FrameRate: type=FrameRateDT, direction=OUT
    operation FrameRate_Setter
      arg FrameRate: type=FrameRateDT, direction=IN
package /ServiceInterface
  8 x collection, all with category=SET:
    CameraObjectDetection: element-role=SO_SERVICE_INTERFACE, element=[TrafficSignDetection, LaneDetection, StartStop, FrameRate]
    FrameRate: element-role=SO_SERVICE_FIELD, element=[FrameRate_Notifier, FrameRate_Getter, FrameRate_Setter]
    ObstacleDetection: element-role=SO_SERVICE_INTERFACE, element=ObstacleDetection
    DetectionStatus: element-role=SO_SERVICE_INTERFACE, element=[TrafficSignInfo, LaneInfo]
    DriveStatus: element-role=SO_SERVICE_INTERFACE
    Engine: element-role=SO_SERVICE_INTERFACE
    Battery: element-role=SO_SERVICE_INTERFACE
    Information: element-role=SO_SERVICE_INTERFACE
package /ADT
  5 x application record data type, all with category=STRUCTURE:
    LaneDetectionEvt
      application record element DetectedLaneBorder: category=ARRAY, type=LaneDetection_DetectedLaneBorder_ARRAYDT
    TrafficSignDetectionEvt
      application record element DetectedTrafficSigns: category=ARRAY, type=TrafficSignDetection_DetectedTrafficSigns_ARRAYDT
    ObstacleDetectionEvt
      application record element Segment: category=ARRAY, type=ObstacleDetection_Segment_ARRAYDT
    LaneInfoEvt
      4 x application record element, all with category=VALUE:
        LaneReliabilityLeft: type=ReliabilityDT
        LaneReliabilityRight: type=ReliabilityDT
        LaneDeparture: type=LaneDeparture
        CollisionWarning: type=LaneDeparture
    TrafficSignInfoEvt
      4 x application record element, all with category=VALUE, type=LaneDeparture:
        SpeedLimit
        NoPassingZone
        RoadWork
        Hazard
  application array data type LaneDetection_DetectedLaneBorder_ARRAYDT: category=ARRAY
    element DetectedLaneBorder: category=STRUCTURE, type=DetectedLaneBorder, array-size-handling=ALL-INDICES-SAME-ARRAY-SIZE, array-size-semantics=FIXED-SIZE, max-number-of-elements=3
  application array data type TrafficSignDetection_DetectedTrafficSigns_ARRAYDT: category=ARRAY
    element TrafficSignInfo: category=STRUCTURE, type=TrafficSignInfo, array-size-handling=ALL-INDICES-SAME-ARRAY-SIZE, array-size-semantics=FIXED-SIZE, max-number-of-elements=3
  application array data type ObstacleDetection_Segment_ARRAYDT: category=ARRAY
    element SegmentDT: category=STRUCTURE, type=SegmentDT, array-size-handling=ALL-INDICES-SAME-ARRAY-SIZE, array-size-semantics=FIXED-SIZE, max-number-of-elements=5
  application record data type DetectedLaneBorder: category=STRUCTURE
    5 x application record element, all with category=VALUE:
      LaneSegmentX: type=DistanceDT
      BorderLeft: type=DistanceDT
      BorderRight: type=DistanceDT
      ReliabilityLeft: type=ReliabilityDT
      ReliabilityRight: type=ReliabilityDT
  application record data type TrafficSignInfo: category=STRUCTURE
    application record element SignType: category=VALUE, type=SignKind
    application record element DistanceToSign: category=VALUE, type=DistanceDT
    application record element Reliability: category=VALUE, type=ReliabilityDT
  application record data type SegmentDT: category=STRUCTURE
    application record element Distance: category=VALUE, type=DistanceDT
    application record element Reliability: category=VALUE, type=ReliabilityDT
  7 x app type, all with category=VALUE:
    DistanceDT: base-type=UInt32
    ReliabilityDT: base-type=UInt8
    SignKind: base-type=UInt8
    Activate: base-type=UInt8
    ActivateResult: base-type=UInt8
    FrameRateDT: base-type=UInt8
    LaneDeparture: base-type=UInt8
package /IDT
  18 x impl type:
    LaneDetectionEvt: category=STRUCTURE
      element DetectedLaneBorder: implementation-data-type=LaneDetection_DetectedLaneBorder_ARRAYDT
    TrafficSignDetectionEvt: category=STRUCTURE
      element DetectedTrafficSigns: implementation-data-type=TrafficSignDetection_DetectedTrafficSigns_ARRAYDT
    ObstacleDetectionEvt: category=STRUCTURE
      element Segment: implementation-data-type=ObstacleDetection_Segment_ARRAYDT
    LaneInfoEvt: category=STRUCTURE
      4 x element, all with category=TYPE_REFERENCE:
        LaneReliabilityLeft: implementation-data-type=ReliabilityDT
        LaneReliabilityRight: implementation-data-type=ReliabilityDT
        LaneDeparture: implementation-data-type=LaneDeparture
        CollisionWarning: implementation-data-type=LaneDeparture
    TrafficSignInfoEvt: category=STRUCTURE
      4 x element, all with category=TYPE_REFERENCE, implementation-data-type=LaneDeparture:
        SpeedLimit
        NoPassingZone
        RoadWork
        Hazard
    DistanceDT: category=VALUE, base-type=UInt32, compu {phys=raw*0.01-1000, 0=NoDistance; unit m}
    ReliabilityDT: category=VALUE, base-type=UInt8, compu {phys=raw; unit %}
    SignKind: category=VALUE, base-type=UInt8, compu {0=NoObject, 1=NoLimit, 2=NoPassingZoneSign, 3=NoPassingZoneEndSign, 4=HazardSign, 5=HazardEndSign, 6=RoadworkSign, 7=RoadworkEndSign, 30=SpeedLimit30Sign, 40=SpeedLimit40Sign, 50=SpeedLimit50Sign, 60=SpeedLimit60Sign, 70=SpeedLimit70Sign, 80=SpeedLimit80Sign, 100=SpeedLimit100Sign}
    Activate: category=VALUE, base-type=UInt8, compu {0=Deactivate, 1=Activate}
    ActivateResult: category=VALUE, base-type=UInt8, compu {0=Failed, 1=Success}
    FrameRateDT: category=VALUE, base-type=UInt8
    LaneDeparture: category=VALUE, base-type=UInt8
    DetectedLaneBorder: category=STRUCTURE
      5 x element, all with category=TYPE_REFERENCE:
        LaneSegmentX: implementation-data-type=DistanceDT
        BorderLeft: implementation-data-type=DistanceDT
        BorderRight: implementation-data-type=DistanceDT
        ReliabilityLeft: implementation-data-type=ReliabilityDT
        ReliabilityRight: implementation-data-type=ReliabilityDT
    TrafficSignInfo: category=STRUCTURE
      element SignType: implementation-data-type=SignKind
      element DistanceToSign: implementation-data-type=DistanceDT
      element Reliability: implementation-data-type=ReliabilityDT
    SegmentDT: category=STRUCTURE
      element Distance: implementation-data-type=DistanceDT
      element Reliability: implementation-data-type=ReliabilityDT
    LaneDetection_DetectedLaneBorder_ARRAYDT: category=ARRAY
      element DetectedLaneBorder: array-size=3, array-size-semantics=FIXED-SIZE, implementation-data-type=DetectedLaneBorder
    TrafficSignDetection_DetectedTrafficSigns_ARRAYDT: category=ARRAY
      element TrafficSignInfo: array-size=3, array-size-semantics=FIXED-SIZE, implementation-data-type=TrafficSignInfo
    ObstacleDetection_Segment_ARRAYDT: category=ARRAY
      element SegmentDT: array-size=5, array-size-semantics=FIXED-SIZE, implementation-data-type=SegmentDT
package /DataTypeMapping
  data type mapping set DatatypeMappingSet
    data-type-maps:
      application-data-type=TrafficSignDetectionEvt, implementation-data-type=TrafficSignDetectionEvt
      application-data-type=LaneDetectionEvt, implementation-data-type=LaneDetectionEvt
      application-data-type=FrameRateDT, implementation-data-type=FrameRateDT
      application-data-type=TrafficSignInfoEvt, implementation-data-type=TrafficSignInfoEvt
      application-data-type=LaneInfoEvt, implementation-data-type=LaneInfoEvt
      application-data-type=ObstacleDetectionEvt, implementation-data-type=ObstacleDetectionEvt
      application-data-type=LaneDetection_DetectedLaneBorder_ARRAYDT, implementation-data-type=LaneDetection_DetectedLaneBorder_ARRAYDT
      application-data-type=DetectedLaneBorder, implementation-data-type=DetectedLaneBorder
      application-data-type=DistanceDT, implementation-data-type=DistanceDT
      application-data-type=ReliabilityDT, implementation-data-type=ReliabilityDT
      application-data-type=TrafficSignDetection_DetectedTrafficSigns_ARRAYDT, implementation-data-type=TrafficSignDetection_DetectedTrafficSigns_ARRAYDT
      application-data-type=TrafficSignInfo, implementation-data-type=TrafficSignInfo
      application-data-type=SignKind, implementation-data-type=SignKind
      application-data-type=Activate, implementation-data-type=Activate
      application-data-type=ActivateResult, implementation-data-type=ActivateResult
      application-data-type=FrameRateDT, implementation-data-type=FrameRateDT
      application-data-type=ObstacleDetection_Segment_ARRAYDT, implementation-data-type=ObstacleDetection_Segment_ARRAYDT
      application-data-type=SegmentDT, implementation-data-type=SegmentDT
      application-data-type=LaneDeparture, implementation-data-type=LaneDeparture
      application-data-type=LaneDeparture, implementation-data-type=LaneDeparture
      application-data-type=LaneDeparture, implementation-data-type=LaneDeparture
      application-data-type=LaneDeparture, implementation-data-type=LaneDeparture
      application-data-type=LaneDeparture, implementation-data-type=LaneDeparture
      application-data-type=LaneDeparture, implementation-data-type=LaneDeparture
package /Unit
  10 x unit:
    DistanceUnit: display-name=m
    ReliabilityUnit: display-name=%
    SpeedUnit: display-name=km/h
    DegreeUnit: display-name=°C
    CurrentUnit: display-name=A
    PowerUnit: display-name=kW
    CapacityUnit: display-name=kWh
    MinuteUnit: display-name=m
    SecondUnit: display-name=sec
    HourUnit: display-name=h
package /RoutingGroups
  20 x so ad routing group:
    StartStopRequest0
    StartStopResponse0
    FrameRate_Getter0
    FrameRate_Setter0
    VLAN_Powertrain_Chassis_BatteryPSI1
    VLAN_Powertrain_ChassisBatteryPSI1BatteryEvg1: event-group-control-type=ACTIVATION-UNICAST
    VLAN_Powertrain_Chassis_DriveStatusPSI1
    VLAN_Powertrain_ChassisDriveStatusPSI1DriveStatusEvg1: event-group-control-type=ACTIVATION-UNICAST
    VLAN_Powertrain_Chassis_EnginePSI1
    VLAN_Powertrain_ChassisEnginePSI1EngineEvg1: event-group-control-type=ACTIVATION-UNICAST
    VLAN_Powertrain_Chassis_InformationPSI1
    VLAN_Powertrain_ChassisInformationPSI1BatteryEvg1: event-group-control-type=ACTIVATION-UNICAST
    VLAN_ADAS_CameraObjectDetectionPSI1
    VLAN_ADASCameraObjectDetectionPSI1CameraObjectDetectionEvg1: event-group-control-type=ACTIVATION-UNICAST
    VLAN_ADAS_DetectionStatusPSI1
    VLAN_ADASDetectionStatusPSI1DetectionStatusEvg1: event-group-control-type=ACTIVATION-UNICAST
    VLAN_ADAS_DriveStatusPSI1
    VLAN_ADASDriveStatusPSI1DriveStatusEvg1: event-group-control-type=ACTIVATION-UNICAST
    VLAN_ADAS_ObstacleDetectionPSI1
    VLAN_ADASObstacleDetectionPSI1ObstacleDetectionEvg1: event-group-control-type=ACTIVATION-UNICAST
package /BaseType
  8 x base type:
    Int8: category=FIXED_LENGTH, base-type-size=8, base-type-encoding=2C
    Int16: category=FIXED_LENGTH, base-type-size=16, base-type-encoding=2C
    Int32: category=FIXED_LENGTH, base-type-size=32, base-type-encoding=2C
    Int64: category=FIXED_LENGTH, base-type-size=64, base-type-encoding=2C
    Bool: category=FIXED_LENGTH, base-type-size=8, base-type-encoding=BOOLEAN
    ASCIIString: base-type-size=8, base-type-encoding=ISO-8859-1
    UTF8String: base-type-size=8, base-type-encoding=UTF-8
    UTF16String: base-type-size=16, base-type-encoding=UTF-16, byte-order=big-endian
package /Transformer
  data transformation set TransformationSet
    data transformation SOMEIPData: execute-despite-data-unavailability=false, transformer-chain=SOMEIP
    transformation technology SOMEIP: buffer-properties={header-length=64, in-place=false}, protocol=SOMEIP, someip-transformation-description{alignment=8, byte-order=little-endian, interface-version=1}, transformer-class=SERIALIZER, version=1
