/*@!Encoding:1252*/
includes
{
}

variables
{
}

on value_change DriveStatusCSI2.VehicleDistance.VehicleTripDistance
{
  @sysvar::InstrumentCluster::Distance = $this.phys / 1000.0;
}

on value_change DetectionStatusCSI1.TrafficSignInfo.SpeedLimit
{
  @sysvar::InstrumentCluster::SpeedLimitSignImage = GetSpeedLimitSignImage($this.phys);
}

on value_change DetectionStatusCSI1.TrafficSignInfo.RoadWork
{
  @sysvar::InstrumentCluster::WarnSignImage = $this.phys > 0 ? 12 : 0;
}

on value_change DetectionStatusCSI1.TrafficSignInfo.Hazard
{
  @sysvar::InstrumentCluster::WarnSignImage = $this.phys > 0 ? 10 : 0;
}

on value_change DetectionStatusCSI1.TrafficSignInfo.NoPassingZone
{
  @sysvar::InstrumentCluster::NoPassingZoneSignImage = $this.phys > 0 ? 8 : 0;
}

on value_change DetectionStatusCSI1.LaneInfo.LaneDeparture
{
  @sysvar::InstrumentCluster::SteeringWheelVibration = $this.phys > 0 ? 1 : 0;
}

on value_update DetectionStatusCSI1.LaneInfo.LaneReliabilityLeft
{
  UpdateAssistentWarning();
}

on value_update DetectionStatusCSI1.LaneInfo.LaneReliabilityRight
{
  UpdateAssistentWarning();
}

on value_update DetectionStatusCSI1.LaneInfo.CollisionWarning
{
  UpdateAssistentWarning();
}

void UpdateAssistentWarning()
{
  byte assistantWarningImage;
  
  if ($DetectionStatusCSI1.LaneInfo.CollisionWarning.phys == 1)
  {
    assistantWarningImage = 1;
  }
  else if (($DetectionStatusCSI1.LaneInfo.LaneReliabilityLeft.phys > 80) && ($DetectionStatusCSI1.LaneInfo.LaneReliabilityRight.phys > 80))
  {
    assistantWarningImage = 4;
  }
  else if ($DetectionStatusCSI1.LaneInfo.LaneReliabilityLeft.phys > 80)
  {
    assistantWarningImage = 2;
  }
  else if ($DetectionStatusCSI1.LaneInfo.LaneReliabilityRight.phys > 80)
  {
    assistantWarningImage = 3;
  }
  else {
    assistantWarningImage = 0;
  }
  @sysvar::InstrumentCluster::AssistantWarningImage = assistantWarningImage; 
}


void UdpNm_NetworkModeInd()
{
  IC_SetControlVisible( 1 );
}

void UdpNm_BusSleepModeInd()
{
  IC_SetControlVisible( 0 );
}

void IC_SetControlVisible( long visible )
{
  setControlVisibility( "Instrument Cluster", "TotalDistanceControl"    , visible );
  setControlVisibility( "Instrument Cluster", "MeterControl"            , visible );
  setControlVisibility( "Instrument Cluster", "RemainingCapacityControl", visible );
  setControlVisibility( "Instrument Cluster", "NoPassingSignControl"    , visible );
  setControlVisibility( "Instrument Cluster", "SpeedLimitSignControl"   , visible );
  setControlVisibility( "Instrument Cluster", "WarnSignControl"         , visible );
  setControlVisibility( "Instrument Cluster", "LaneAssistControl"       , visible );
}

byte GetSpeedLimitSignImage(byte speedLimit)
{
  switch(speedLimit)
  {
    case 30: return SpeedLimit30Sign;
    case 50: return SpeedLimit50Sign;
    case 60: return SpeedLimit60Sign;
    case 70: return SpeedLimit70Sign;
    case 80: return SpeedLimit80Sign;
    case 100: return SpeedLimit100Sign;
    default: return 0;
  }
}