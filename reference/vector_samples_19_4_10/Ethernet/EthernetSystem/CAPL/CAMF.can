/*@!Encoding:1252*/
includes
{
  #include "include\VectorConceptCar_Grid.cin"
}

variables
{
  const double kLaneWidth = 4.0;
  const int kMaxDetectedTrafficSignsElems = 3;
}

void SetDetectedTrafficSign(byte n, byte signType, dword distance, byte reliability)
{
  $CameraObjectDetectionPSI1.TrafficSignDetection.DetectedTrafficSigns[n].SignType.phys       = signType;
  $CameraObjectDetectionPSI1.TrafficSignDetection.DetectedTrafficSigns[n].DistanceToSign.phys = distance;
  $CameraObjectDetectionPSI1.TrafficSignDetection.DetectedTrafficSigns[n].Reliability.phys    = reliability;
}

void SetDetectedLaneBorder(byte n, double laneOffset, byte reliabilityLeft, byte reliabilityRight) 
{
  $CameraObjectDetectionPSI1.LaneDetection.DetectedLaneBorder[n].LaneSegmentX.phys = 5.0*(n+1);
  $CameraObjectDetectionPSI1.LaneDetection.DetectedLaneBorder[n].BorderLeft.phys   = laneOffset - kLaneWidth / 2;
  $CameraObjectDetectionPSI1.LaneDetection.DetectedLaneBorder[n].BorderRight.phys  = laneOffset + kLaneWidth / 2;
  $CameraObjectDetectionPSI1.LaneDetection.DetectedLaneBorder[n].ReliabilityLeft.phys  = reliabilityLeft;
  $CameraObjectDetectionPSI1.LaneDetection.DetectedLaneBorder[n].ReliabilityRight.phys = reliabilityRight;
}

int GetDetectedTrafficSignsLength()
{
  return elCount($CameraObjectDetectionPSI1.TrafficSignDetection.DetectedTrafficSigns);
}

void UpdateOrResetDetectedTrafficSigns(long udpNmState)
{
  struct VCC_Object foundObjects[kMaxDetectedTrafficSignsElems];
  int foundObjectsCount;
  int i;
  
  foundObjectsCount = 0;
  if(udpNmState > 1) // Find nearest traffic signs
  {
    foundObjectsCount = VCC_FindNearestObjects( @sysvarMember::ConceptCar::Vehicle::Position.RelativeX, 
                                                @sysvarMember::ConceptCar::Vehicle::Position.RelativeY,
                                                @sysvarMember::ConceptCar::Vehicle::Position.Heading,
                                                -70, 70, 150, foundObjects, elcount(foundObjects) );
  }

  for(i=0; i < GetDetectedTrafficSignsLength(); ++i) 
  {
    byte signType, reliability;
    dword distance;
    
    signType = i < foundObjectsCount ? foundObjects[i].symbol : 0;
    distance = i < foundObjectsCount ? foundObjects[i].distance : 0;
    reliability = i < foundObjectsCount ? 100 : 0;

    SetDetectedTrafficSign(i, signType, distance, reliability);
  }
}

void UpdateDetectedLaneBorders() // maximum number of elements: 3 (cf. db)
{
  dword  reliabilityLeft, reliabilityRight;
  double laneOffset, d1, d2;
      
  laneOffset       = @sysvar::CAMF::FaultInjection::LaneOffsetY;
  d1               = _min( 1, _max( -1, @sysvarMember::ConceptCar::Vehicle::WaypointState.HeadingDelta/4.0 ));
  d2               = _min( 2, _max( -2, @sysvarMember::ConceptCar::Vehicle::WaypointState.HeadingDelta/3.0 ));
  reliabilityLeft  = @sysvar::CAMF::FaultInjection::ReliablityLeft;
  reliabilityRight = @sysvar::CAMF::FaultInjection::ReliablityRight;
  
  SetDetectedLaneBorder(0, laneOffset, reliabilityLeft, reliabilityRight);
  SetDetectedLaneBorder(1, laneOffset+d1, reliabilityLeft, reliabilityRight);
  SetDetectedLaneBorder(2, laneOffset+d2, reliabilityLeft, reliabilityRight);
}

on sysvar sysvar::ConceptCar::Vehicle::Position
{
  long udpNmState;
  
  udpNmState = UdpNm_GetState();
  
  UpdateOrResetDetectedTrafficSigns(udpNmState);
  
  if (udpNmState > 1)
  {
   UpdateDetectedLaneBorders();
  }
}
