/*@!Encoding:1252*/
includes
{
  #include "include\VectorConceptCar_Grid.cin"
  #include "include\VectorConceptCar_Track.cin"
  #include "include\VectorConceptCar.cin"
}

/*
 * Vehicle Gateway - VGW                                     Version 1.0
 *
 * Copyright Vector Informatik GmbH - All right reserved
 *
 * This node simulates a central vehicle gateway ECU between the powertrain of a car
 * and the Ethernet backbone network. It is only a stub which calculates
 * the engine and vehicle speed and transmits these signals on the
 * Backbone network bus. In a more realistic simulation it could be a gateway
 * between a CAN powertrain bus and the Vehicle backbone network.
 *
 */
 variables
{
  const double kMaxVehicleSpeed   = 120.0; // km/h
  const double kMotorPowerKw      =  80.0; // kW
  const double kBatterCapacityKwh =  40.0; // kW/h
  const double kVoltage           = 400.0; // V
  const double kWheelToMotorRatio =  60.0;
  const double kVehicleMassKg     =   900; // Vehicle mass [kg]
  const double kAirFriction       =   0.4; // F = kFriction*v*v
  const double kRollingFrictionN  = 100.0; // Newton
  const double kMaxPowerN         =  36.0; // Newton
        char   kIniFile[32]       = "EthernetSystemDemo.ini";
}

on start
{
  // initialize system variables
  char displayText[20];
  long tm[9];
  getLocalTime( tm );
  snprintf( displayText, elcount(displayText), "%d:%.2d", tm[2], tm[1]);
  sysSetVariableString( sysvar::HeadUnit::Fields::Time, displayText );
  snprintf( displayText, elcount(displayText), "%d °C", (int) @sysvar::ConceptCar::Environment::ExteriorTemperature);
  sysSetVariableString( sysvar::HeadUnit::Fields::ExteriorTemperature, displayText );
  @sysvar::ConceptCar::Battery::RemainingCapacity   = kBatterCapacityKwh;
  @sysvar::ConceptCar::Battery::Temperature         = @sysvar::ConceptCar::Environment::ExteriorTemperature;
  @sysvar::ConceptCar::EMotor::Temperature          = @sysvar::ConceptCar::Environment::ExteriorTemperature; 

  sysBeginVariableStructUpdate(sysvar::ConceptCar::Vehicle::Position);
  @sysvarMember::ConceptCar::Vehicle::Position.Altitude  = 320;
  @sysvarMember::ConceptCar::Vehicle::Position.Longitude = kVCC_LongitudeWest;
  @sysvarMember::ConceptCar::Vehicle::Position.Latitude  = kVCC_LatitudeNorth;
  @sysvarMember::ConceptCar::Vehicle::Position.RelativeX = 2026.0; // start at Vector Informatik building
  @sysvarMember::ConceptCar::Vehicle::Position.RelativeY = 2702.0;
  sysEndVariableStructUpdate(sysvar::ConceptCar::Vehicle::Position);

  // setup track from map  
  SelectMap( @sysvar::ConceptCar::Environment::SelectMap );
}

on stopMeasurement
{
  // write total distance to ini file
  writeProFileFloat( "%NODE_NAME%", "TotalDistance", @sysvar::ConceptCar::Vehicle::TotalDistance, kIniFile );
}

void updateBattery()
{
  $BatteryPSI1.BatteryStatus.BatteryTemperature.phys = @sysvar::ConceptCar::Battery::Temperature;
  $BatteryPSI1.BatteryStatus.Capacity.phys           = kBatterCapacityKwh;
  $BatteryPSI1.BatteryStatus.RemainingCapacity.phys  = @sysvar::ConceptCar::Battery::RemainingCapacity;
}

void updateDriveStatus()
{
  $DriveStatusPSI1.VehicleSpeed.VehicleSpeed.phys            = @sysvar::ConceptCar::Vehicle::Speed;
  $DriveStatusPSI1.VehicleSpeed.VehicleDirection             = 1;
  $DriveStatusPSI1.VehicleDistance.VehicleTripDistance.phys  = @sysvar::ConceptCar::Vehicle::TripDistance;
  $DriveStatusPSI1.VehicleDistance.VehicleTotalDistance.phys = @sysvar::ConceptCar::Vehicle::TotalDistance;
}

void updateEnginge()
{
  $EnginePSI1.EMotorStatus.EMotorSpeed.phys       = @sysvar::ConceptCar::EMotor::Speed;
  $EnginePSI1.EMotorStatus.EMotorCurrent.phys     = @sysvar::ConceptCar::EMotor::Current;
  $EnginePSI1.EMotorStatus.EMotorTemperature.phys = @sysvar::ConceptCar::EMotor::Temperature;
  $EnginePSI1.EMotorStatus.EMotorPower.phys       = @sysvar::ConceptCar::EMotor::Power;
}

void updateInformation()
{
  long tm[9];
  getLocalTime( tm );
  $InformationPSI1.Time.Hour.phys   = tm[2];
  $InformationPSI1.Time.Minute.phys = tm[1];
  $InformationPSI1.Time.Second.phys = tm[0];
  
  $InformationPSI1.ExteriorTemperature.ExteriorTemperature.phys = @sysvar::ConceptCar::Environment::ExteriorTemperature;
}

on sysvar sysvar::ConceptCar::Control::StartStop
{
  if (@this == 1)
  {
    if (@sysvar::_ILControl::Ignition) 
    {
      if (@sysvar::ConceptCar::Vehicle::Speed < 1)
      {
        @sysvar::_ILControl::Ignition = 0;
        VCC_Ignition( 0 );
      }
    }
    else
    {
      @sysvar::_ILControl::Ignition = 1;
      VCC_Ignition( 1 );
    }
  }
  
  @this = 0;
}

on sysvar sysvar::ConceptCar::Environment::SelectMap
{
  SelectMap( @this );
}

void SelectMap( long mapIndex )
{
  char             symbols[16]       = "~3567810PpHhRr";
  char             waypointSymbol[3] = "Xx";
  struct VCC_Point waypoints[kVCC_MaxPointCount];
  dword            waypointsCount;
  struct VCC_Point objects[kVCC_MaxPointCount];
  dword            objectsCount;
  
  switch(mapIndex)
  {
    default:
    case 1:
      waypointsCount = VCC_ScanGridAndSortByDistance( VCC_TrackGrid1, waypointSymbol, waypoints );
      objectsCount   = VCC_ScanGrid( VCC_TrackGrid1, symbols, objects );
      break;
    case 2:
      waypointsCount = VCC_ScanGridAndSortByDistance( VCC_TrackGrid2, waypointSymbol, waypoints );
      objectsCount   = VCC_ScanGrid( VCC_TrackGrid2, symbols, objects );
      break;
  }

  VCC_Points2Waypoints( waypoints, waypointsCount );
  VCC_Points2Environment( objects, objectsCount );
}

void updateGPS() {
  double x;
  double y;
  
  x = @sysvarMember::ConceptCar::Vehicle::Position.Longitude + (@sysvarMember::ConceptCar::Vehicle::Position.RelativeX * kVCC_ScaleLongitude);
  y = @sysvarMember::ConceptCar::Vehicle::Position.Latitude  - (@sysvarMember::ConceptCar::Vehicle::Position.RelativeY * kVCC_ScaleLatitude);
  
  sysBeginVariableStructUpdate( sysvar::GPS::GPS1 );
  @sysvarMember::GPS::GPS1.Direction = @sysvarMember::ConceptCar::Vehicle::Position.Heading;
  @sysvarMember::GPS::GPS1.Longitude = x;
  @sysvarMember::GPS::GPS1.Latitude  = y;
  @sysvarMember::GPS::GPS1.Speed     = @sysvar::ConceptCar::Vehicle::Speed / 3.6;
  sysEndVariableStructUpdate( sysvar::GPS::GPS1 );
}

void OnVCC_UpdateSignals( dword ignition )
{
  if (ignition) // update signals
  {
    updateBattery();
    updateDriveStatus();
    updateEnginge();
    updateInformation();
  }
  
  updateGPS();
}