VERSION ""

NS_ :

BS_:

BU_: GW Tester

BO_ 257 SendStoreData: 8 Tester
 SG_ SawTooth : 32|32@1- (1,0) [0|0] "" Vector__XXX
 SG_ Sinus : 0|32@1- (1,0) [0|0] "" Vector__XXX

BA_DEF_ BU_  "Diagnose-Stationsadresse" INT -1 255;
BA_DEF_ BU_  "TpAddressingMode" INT 0 3;
BA_DEF_ BU_  "NodeLayerModules" STRING ;
BA_DEF_  "BusType" STRING ;
BA_DEF_DEF_  "Diagnose-Stationsadresse" -1;
BA_DEF_DEF_  "TpAddressingMode" 1;
BA_DEF_DEF_  "NodeLayerModules" "osek_tp.vmodule";
BA_DEF_DEF_  "BusType" "CAN";
BA_ "BusType" "Ethernet";
BA_ "NodeLayerModules" BU_ GW "DoIP.vmodule";
BA_ "TpAddressingMode" BU_ GW 0;
BA_ "Diagnose-Stationsadresse" BU_ GW 2;
BA_ "TpAddressingMode" BU_ Tester 0;
BA_ "Diagnose-Stationsadresse" BU_ Tester 0;
BA_ "NodeLayerModules" BU_ Tester "";
SIG_VALTYPE_ 257 SawTooth : 1;
SIG_VALTYPE_ 257 Sinus : 1;
