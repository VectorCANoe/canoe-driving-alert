VERSION ""

NS_ :

BS_:

BU_: ECUVariantIdent GW ECU

BO_ 257 SendStoreData: 8 Vector__XXX
 SG_ SawTooth : 32|32@1- (1,0) [0|0] "" Vector__XXX
 SG_ Sinus : 0|32@1- (1,0) [0|0] "" Vector__XXX

BA_DEF_ BU_  "TpTxIdentifier" HEX 0 2047;
BA_DEF_ BU_  "TpRxIdentifier" HEX 0 2047;
BA_DEF_ BU_  "Diagnose-Stationsadresse" INT -1 255;
BA_DEF_ BU_  "TpAddressingMode" INT 0 3;
BA_DEF_ BU_  "NodeLayerModules" STRING ;
BA_DEF_  "BusType" STRING ;
BA_DEF_DEF_  "TpTxIdentifier" 0;
BA_DEF_DEF_  "TpRxIdentifier" 0;
BA_DEF_DEF_  "Diagnose-Stationsadresse" -1;
BA_DEF_DEF_  "TpAddressingMode" 1;
BA_DEF_DEF_  "NodeLayerModules" "osek_tp.vmodule";
BA_DEF_DEF_  "BusType" "CAN";
BA_ "TpAddressingMode" BU_ ECUVariantIdent 0;
BA_ "Diagnose-Stationsadresse" BU_ ECUVariantIdent 3;
BA_ "TpRxIdentifier" BU_ ECUVariantIdent 1794;
BA_ "TpTxIdentifier" BU_ ECUVariantIdent 1538;
BA_ "TpAddressingMode" BU_ GW 0;
BA_ "Diagnose-Stationsadresse" BU_ GW 2;
BA_ "TpRxIdentifier" BU_ GW 1793;
BA_ "TpTxIdentifier" BU_ GW 1537;
BA_ "TpAddressingMode" BU_ ECU 0;
BA_ "TpRxIdentifier" BU_ ECU 1792;
BA_ "Diagnose-Stationsadresse" BU_ ECU 1;
BA_ "TpTxIdentifier" BU_ ECU 1536;
SIG_VALTYPE_ 257 SawTooth : 1;
SIG_VALTYPE_ 257 Sinus : 1;
