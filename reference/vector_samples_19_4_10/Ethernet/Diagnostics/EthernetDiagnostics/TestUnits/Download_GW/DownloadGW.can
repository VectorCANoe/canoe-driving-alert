includes
{
  #include "../../Tester/Download.cin"
}

variables
{
}

export testcase DownloadGW(){
  strncpy( target, "GW", elcount( target));
  strncpy( tester, "Flash GW", elcount( tester));
  downloadSize = 0x00100000;
  TCDownload();
}


