/*@!Encoding:1252*/
includes
{
  #include "..\CAPL_Includes\DiagDefinitions.cin"
  #include "..\CAPL_Includes\LibFunctions_Write.cin"
  #include "..\CAPL_Includes\LibFunctions_Node.cin"
  #include "..\CAPL_Includes\Ethernet.cin"
  #include "..\CAPL_Includes\LibFunctions_DHCP.cin"
}

variables
{
  char gECU[20]="DoIP_ECU";
  mstimer tVoltageRead;
  msTimer tWindowPosRead;
  msTimer tOdometerValueRead;
  msTimer tAuthenticationTimeout;
  msTimer tVariantCodingTimeout;
  
  enum eVarCodeResult {vcrUndefined, vcrNOK, vcrOK, vcrAUTH};
  enum eLastVarcodeOperation {lvoUndefined, lvoRead, lvoWrite};
  enum eLastVarcodeOperation gLastVarcodeOperation=lvoUndefined;
  
  const cAUTHENTICATION_TIMEOUT_MS=3000;
  const cVARCODE_TIMEOUT_MS=1000;

  ip_Address DoIP_Tester_IpAddress;
  ip_Address DoIP_ECU_IpAddress;
  ip_Address DoIP_TLS_ECU_IpAddress;

  msTimer tObserveActivationLine;
  const cObserveActivationLineCycletime=1000;       // 1sec cycle time for polling
  char gActivationLineSysvarNamespace[100];
  char gActivationLineSysvar[50];
}

on start
{
  setWriteDbgLevel(1);
  writeDbgLvlPrefix(2, "DoIP Tester: gP2Timeout=%dms, gP2extended=%dms", diagGetP2Timeout(gECU, 1, 2), diagGetP2Extended(gECU, 1, 2));

  VariantCodingShowResult(vcrUndefined);

  diagGetCommParameter("DoIP.ActivationLineSysvarNamespace", 0, gActivationLineSysvarNamespace, elcount(gActivationLineSysvarNamespace));
  sysSetVariableString(sysvar::DiagAccessEth::ActivationLineSysvarNamespace, gActivationLineSysvarNamespace);
  diagGetCommParameter("DoIP.ActivationLineSysvar", 0, gActivationLineSysvar, elcount(gActivationLineSysvar));
  sysSetVariableString(sysvar::DiagAccessEth::ActivationLineSysvar, gActivationLineSysvar);
  
  //Cyclically check the activation line status has changed and update the panel, if necessary
  setTimerCyclic(tObserveActivationLine, 0, cObserveActivationLineCycletime);

  //Cyclically check IP address of DoIP_Tester, if IP address has been assigned update panel
  InitIpAddressObservation();  
}

// Observe the TCP connection status
on ethernetPacket *
{
  IP_Address sourceIpAddr, destIpAddr;
  
  if (this.msgChannel==1) {
    this.GetSourceIPAddress(sourceIpAddr);
    this.GetDestinationIPAddress(destIpAddr);
    
    if (this.tcp.IsAvailable()) {
      if (sourceIpAddr == DoIP_Tester_IpAddress) {
        if (destIpAddr == DoIP_ECU_IpAddress && this.tcp.destination == 13400) { // Sent by GW ECU to Tester, DoIP port
          if (this.tcp.flags & 0x02) { // SYN bit is set
            writeDbgLvlPrefix(2, "Probably TCP connection setup (SYN) on ETH1");
            @sysvar::DiagAccessEth::TcpConnectionEstablished=1;
          }
          else if (this.tcp.flags & 0x1 || this.tcp.flags & 0x4) { // FIN or RST bit set
            writeDbgLvlPrefix(2, "Probably TCP connection teardown (FIN) or reset (RST)) on ETH1");
            @sysvar::DiagAccessEth::TcpConnectionEstablished=0;          
          }
        } else if (destIpAddr == DoIP_TLS_ECU_IpAddress && this.tcp.destination == 3496) { // Sent by GW ECU to Tester, TLS port
          if (this.tls.IsAvailable()) {
            if (this.tls.byte(0) == 23) { // Content Type: Application Data
              @sysvar::DiagAccessEth::TlsConnectionEstablished=1;
            }
          }
        }
      }
    }
  }
}

//==========================
// Activation line handling
//==========================

// Poll HW activation line status because it could also be configured as an input
On timer tObserveActivationLine
{
  if (@sysvar::DiagAccessEth::ActivationLineStatus!=sysGetVariableLong(gActivationLineSysvarNamespace, gActivationLineSysvar))
  {
    // Only update internal activation line System Variable if HW activation line status was changed 
    @sysvar::DiagAccessEth::ActivationLineStatus=sysGetVariableLong(gActivationLineSysvarNamespace, gActivationLineSysvar);
  }
}

// Toggle the system variables (HW and internal) for activation line
on sysvar sysvar::Tester::BtnToggleActivationLine
{
  dword ActivationLineStatus;
  
  if (@this==1) {
    // Get current value from (HW) activation line System Variable configured in the Diagonstics/ISO TP configuration and toggle this value
    sysGetVariableDWord(gActivationLineSysvarNamespace, gActivationLineSysvar, ActivationLineStatus); 
    ActivationLineStatus = ((~ActivationLineStatus) & 0x01);
    sysSetVariableDWord(gActivationLineSysvarNamespace, gActivationLineSysvar, ActivationLineStatus); 

    // Set toggled value to internal activation line System Variable used in this configuration as well (e.g. for display in the panel)
    @sysvar::DiagAccessEth::ActivationLineStatus=ActivationLineStatus; 
  }
}

// Try to connect as soon as activation line is active and IP adresses are assigned (if activation line becomes active first)
on sysvar sysvar::DiagAccessEth::ActivationLineStatus
{
  if (@DoIP_ECU::IpAddressDiagAccessEthAssigned && @sysvar::Tester::IpAddressDiagAccessEthAssigned) {
    if (@this) {
      diagConnectChannel(gECU);
      diagStartTesterPresent(gECU);
    }
    else {
      // Close all potentially open diagnostics channels to assure that the TCP connection to the ECU is closed
      diagCloseChannel(gECU);
      diagCloseChannel("FunctionalGroup");
    }  
  }
}

getIpAddrFromSv(sysvarstring * IpAddrStrSv, ip_Address ipAddr)
{
  char ipAddress[15];

  sysGetVariableString(IpAddrStrSv, ipAddress, elcount(ipAddress));
  ipAddr.ParseAddressFromString(ipAddress);
}

on sysvar DoIP_ECU::IpAddressDiagAccessEth
{
  getIpAddrFromSv(this, DoIP_ECU_IpAddress);
}

on sysvar DoIP_TLS_ECU::IpAddressDiagAccessEth
{
  getIpAddrFromSv(this, DoIP_TLS_ECU_IpAddress);
}

on sysvar Tester::IpAddressDiagAccessEth
{
  getIpAddrFromSv(this, DoIP_Tester_IpAddress);
}

//=============================================
// Interactive diagnostics test implementation
//=============================================

// Cyclic requests for non-unsolicited responses
on timer tVoltageRead
{
  diagRequest DoIP_ECU.DID_Voltage_Read req;

  req.SendRequest();
}

on timer tWindowPosRead
{
  diagRequest DoIP_ECU.Additional.WindowLiftFinePositionRead req;

  req.SendRequest();
}

on timer tOdometerValueRead
{
  diagRequest DoIP_ECU.DID_OdometerValue_Read req;

  req.SendRequest();
}

// Timeout in case there is no response to the Variant Coding request
on timer tVariantCodingTimeout
{
  VariantCodingShowResult(vcrNOK);
}

on timer tAuthenticationTimeout
{
  writeDbgLvlPrefix(0, "DoIP Tester: ERROR: Authentication timeout!");
  VariantCodingShowResult(vcrNOK);
  gLastVarcodeOperation=lvoUndefined;
}

on key 'f'
{
  diagRequest DoIP_ECU.EcuIdentification_Read req;
  
  writeDbgLvlPrefix(0, "DoIP Tester: Trying to send a functional group request...");
  req.SendFunctional();
}

on sysvar sysvar::Tester::BtnReadSerialAndDoorStatus
{
  diagRequest DoIP_ECU.SerialNumber_Read reqSerialNoRead;
  diagRequest DoIP_ECU.Door_Status_Read reqDoorStatusRead;

  if (@this==1) {
    reqSerialNoRead.SendRequest();
    reqDoorStatusRead.SendRequest();
  }
}

on diagResponse DoIP_ECU.SerialNumber_Read
{
  long serialNumber;

  if (this.IsPositiveResponse()) {
    serialNumber=this.GetParameter("SerialNumber");
  
    if (serialNumber>=0) @sysvar::Tester::DeterminedSerialNumber=serialNumber;
  }
}

on diagResponse DoIP_ECU.Door_Status_Read
{
  long ret;
  double DoorContacts[1];
  
  if (this.IsPositiveResponse()) {
    ret=this.GetParameter("Door_Contact", DoorContacts);
  
    if (ret>=0) {
      @sysvarMember::Tester::OpenDoorContacts.FrontLeft=this.GetParameter("Door_Contact.Door_contact_front_left");
      @sysvarMember::Tester::OpenDoorContacts.FrontRight=this.GetParameter("Door_Contact.Door_contact_front_right");
      @sysvarMember::Tester::OpenDoorContacts.RearLeft=this.GetParameter("Door_Contact.Door_contact_rear_left");
      @sysvarMember::Tester::OpenDoorContacts.RearRight=this.GetParameter("Door_Contact.Door_contact_rear_right");
    }
    else {
      writeDbgLvlPrefix(0, "DoIP_Tester: Error when reading door contact status (ret=%d)", ret);
    }
  }  
}

on sysvar sysvar::Tester::BtnWindowPosition0
{
  diagRequest DoIP_ECU.DID_WindowLiftRoughPosition_Write req;
  if (@this==1) {
    req.SetParameter("WindowLiftRoughPosition", "0,00%");
    req.SendRequest();
  }
}

on sysvar sysvar::Tester::BtnWindowPosition50
{
  diagRequest DoIP_ECU.DID_WindowLiftRoughPosition_Write req;
  if (@this==1) {
    req.SetParameter("WindowLiftRoughPosition", "50,00%");
    req.SendRequest();
  }  
}

on sysvar sysvar::Tester::BtnWindowPosition100
{
  diagRequest DoIP_ECU.DID_WindowLiftRoughPosition_Write req;
  if (@this==1) {
    req.SetParameter("WindowLiftRoughPosition", "100,00%");
    req.SendRequest();
  }    
}

on sysvar sysvar::Tester::BtnInternalsCyclicRead
{
  diagRequest DoIP_ECU.Sawtooth_Send_fast reqSawtoothSend;
  diagRequest DoIP_ECU.Sawtooth_Stop reqSawtoothStop;
  diagRequest DoIP_ECU.SineWave_Send_fast reqSinewaveSend;
  diagRequest DoIP_ECU.SineWave_Stop reqSineWaveStop;

  if (@this==1) {
    reqSawtoothSend.SendRequest();
    reqSinewaveSend.SendRequest();
    setTimerCyclic(tOdometerValueRead, 500);
  }
  else {
    reqSawtoothStop.SendRequest();
    reqSineWaveStop.SendRequest();
    cancelTimer(tOdometerValueRead);
  }
}

on sysvar sysvar::Tester::BtnWindowPosCyclicRead
{
  if (@this==1) {
    setTimerCyclic(tWindowPosRead, 500);
  }
  else {
    cancelTimer(tWindowPosRead);
  }  
}

on sysvar sysvar::Tester::BtnVoltageCyclicRead
{
  if (@this==1) {
    setTimerCyclic(tVoltageRead, 500);
  }
  else {
    cancelTimer(tVoltageRead);
  }
}

//==========================
// Variant coding sequences
//==========================

// Switch to Extended Session and read variant coding
on sysvar sysvar::Tester::BtnReadVariantCoding
{
  diagRequest DoIP_ECU.DefaultSession_Start reqDefSession;
  
  if (@this==1 && gLastVarcodeOperation==lvoUndefined) {
    reqDefSession.SendRequest(); // Switch to default first to avoid unallowed transition from programming to extended session

    setTimer(tAuthenticationTimeout, cAUTHENTICATION_TIMEOUT_MS);
    VariantCodingShowResult(vcrAUTH);

    diagStartSecurityTask(gECU, "AUTH_UNIDIRECTIONAL","", "Cert=UDS 0x29 Supplier;AutoSessionChange=1;");
    gLastVarcodeOperation=lvoRead;
  }
}

// Switch via Extended Session to Programming Session and then request seed
on sysvar sysvar::Tester::BtnWriteVariantCoding
{
  diagRequest DoIP_ECU.DefaultSession_Start reqDefSession;
  
  if (@this==1 && gLastVarcodeOperation==lvoUndefined) {
    reqDefSession.SendRequest(); // Switch to default first to avoid unallowed transition from programming to extended session

    setTimer(tAuthenticationTimeout, cAUTHENTICATION_TIMEOUT_MS);
    VariantCodingShowResult(vcrAUTH);
    
    diagStartSecurityTask(gECU, "AUTH_UNIDIRECTIONAL","", "Cert=UDS 0x29 Supplier;AutoSessionChange=1;");
    gLastVarcodeOperation=lvoWrite;
  }
}


// Callback for authentication result in case of variant coding read or write
void _diag_SecurityTaskFinished(char ecuQualifier[], char taskId[], long result)
{
  cancelTimer(tAuthenticationTimeout);
  if (0==result) // success
  {
    writeDbgLvlPrefix(2, "TesterPanel: Tester authentication for '%s' successful.", ecuQualifier);
    finishLastVarcodeOperation();
  }
  else
  {
    writeDbgLvlPrefix(0, "TesterPanel: ERROR: Tester authentication for '%s' failed with result = %d!", ecuQualifier, result);
    VariantCodingShowResult(vcrNOK);
    gLastVarcodeOperation=lvoUndefined;
  }
}

void finishLastVarcodeOperation()
{
  diagRequest DoIP_ECU.ExtendedDiagnosticSession_Start reqExtSession;
  diagRequest DoIP_ECU.Variant_Coding_Read reqVarCoding;
  diagRequest DoIP_ECU.ProgrammingSession_Start reqProgSession;
  diagRequest DoIP_ECU.SeedLevel_0x01_Request reqSeed;
  
  setTimer(tVariantCodingTimeout, cVARCODE_TIMEOUT_MS);
  switch (gLastVarcodeOperation)
  {
    case lvoRead:
      // Checking on return values indicating an error when sending the requests or when receiving the responses was omitted here to simplify the example
      reqExtSession.SendRequest();
      reqVarCoding.SendRequest();
      break;
    case lvoWrite:
      // Checking on return values indicating an error when sending the requests or when receiving the responses was omitted here to simplify the example
      reqExtSession.SendRequest();
      reqProgSession.SendRequest();
      reqSeed.SendRequest();
      break;
    Default:
      break;
  }
  gLastVarcodeOperation=lvoUndefined;
}

// Compute Key from Seed using the Seed&Key DLL, then write Variant Coding
on diagResponse DoIP_ECU.SeedLevel_0x01_Request
{
  diagRequest DoIP_ECU.KeyLevel_0x01_Send reqKeySend;
  diagRequest DoIP_ECU.Variant_Coding_Write reqCodingWrite;
  word seed;
  word securityKey;
  byte seedArray[2];
  byte keyArray[2];
  dword keyActualSizeOut;
  
  seed=this.GetParameter("SecuritySeed");
  seedArray[1]=(seed>>8)&0xFF;
  seedArray[0]=seed&0xFF;
  diagGenerateKeyFromSeed(gECU, seedArray , 2, 1, "", "" , keyArray, elcount(keyArray), keyActualSizeOut); 
  
  securityKey=(((word)keyArray[1])<<8) | keyArray[0];

  reqKeySend.SetParameter("SecurityKey", securityKey);
  // Checking on return values indicating an error when sending the requests or when receiving the responses was omitted here to simplify the example
  reqKeySend.SendRequest();

  reqCodingWrite.SetParameter("Codingstring.CountryType", @sysvar::Tester::VariantCodingCountyCode);
  reqCodingWrite.SetParameter("Codingstring.VehicleType", @sysvar::Tester::VariantCodingVehicleType);
  reqCodingWrite.SetParameter("Codingstring.WindowLift_Support", @sysvar::Tester::VariantCodingWindowLiftSupport);
  reqCodingWrite.SetParameter("Codingstring.VehicleSpeedToLockDoor", @sysvar::Tester::VariantCodingSpeedToLockDoor);

  reqCodingWrite.SendRequest();
}

// Check result of Variant Coding Write response
on diagResponse DoIP_ECU.Variant_Coding_Write
{
  diagRequest DoIP_ECU.DefaultSession_Start reqDefaultSession;
  
  cancelTimer(tVariantCodingTimeout);
  if (this.IsPositiveResponse()) {
    VariantCodingShowResult(vcrOK);
    reqDefaultSession.SendRequest();  // avoid problems with subsequent TestUnit runs due to transiton from programming to extended session
  }
  else {
    VariantCodingShowResult(vcrNOK);
  }
}

on diagResponse DoIP_ECU.Variant_Coding_Read
{
  cancelTimer(tVariantCodingTimeout);
  if (this.IsPositiveResponse()) {
    // Checking on return values indicating an error when getting the parameters was omitted here to simplify the example
    @sysvar::Tester::VariantCodingCountyCode=this.GetParameter("Codingstring.CountryType");
    @sysvar::Tester::VariantCodingVehicleType=this.GetParameter("Codingstring.VehicleType");
    @sysvar::Tester::VariantCodingWindowLiftSupport=this.GetParameter("Codingstring.WindowLift_Support");
    @sysvar::Tester::VariantCodingSpeedToLockDoor=this.GetParameter("Codingstring.VehicleSpeedToLockDoor");
    VariantCodingShowResult(vcrOK);
  }
  else {
    VariantCodingShowResult(vcrNOK);
  }
}

void VariantCodingShowResult(enum eVarCodeResult result)
{
  switch (result) {
    case vcrOK:
      sysSetVariableString(sysvar::Tester::VariantCodingResult, "OK");
      setControlColors("VariantCoding", "VariantCodingResultText", MakeRGB(16,160,16), MakeRGB(0,0,0));
      break;
    case vcrNOK:
      sysSetVariableString(sysvar::Tester::VariantCodingResult, "NOK");
      setControlColors("VariantCoding", "VariantCodingResultText", MakeRGB(255,0,0), MakeRGB(0,0,0));
      break;
    case vcrAUTH:
      sysSetVariableString(sysvar::Tester::VariantCodingResult, "AUTH");
      setControlColors("VariantCoding", "VariantCodingResultText", MakeRGB(255,255,0), MakeRGB(0,0,0));
      break;
    default:
      sysSetVariableString(sysvar::Tester::VariantCodingResult, "");
      setControlColors("VariantCoding", "VariantCodingResultText", MakeRGB(255,255,255), MakeRGB(255,255,255));
      break;
  }
}