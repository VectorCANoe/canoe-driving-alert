/*@!Encoding:1252*/
includes
{
  #include "..\..\CAPL_Includes\DiagDefinitions.cin"
  #include "..\..\CAPL_Includes\LibFunctions_Write.cin"
  #include "..\..\CAPL_Includes\LibFunctions_Tester.cin"
  #include "..\..\CAPL_Includes\Download_Tester.cin"
}

variables
{
  char gECU[20]="DoIP_ECU"; // Diagnostic target for TCDownload()
  char gResultString[200];
}


export testcase TCReadSerialNumber()
{
  diagRequest DoIP_ECU.SerialNumber_Read req;

  setTestId(1,1);  
  SendRequestAndWaitForFirstResponse( req, TRUE, FALSE);
}

export testcase TC_TLS_ReadSerialNumber()
{
  diagRequest DoIP_TLS_ECU.SerialNumber_Read req;
  
  setTestId(3,1);
  SendRequestAndWaitForFirstResponse( req, TRUE, FALSE);
}

export testcase TC_TLS_ReadEcuIdentification()
{
  diagRequest DoIP_TLS_ECU.EcuIdentification_Read req;
  
  setTestId(4,1);
  SendRequestAndWaitForFirstResponse( req, TRUE, FALSE);
}
