/*@!Encoding:1252*/

variables
{
  const cObserveIpAddressAssignmentCycletime=1000;  // 1sec cycle time for polling
  msTimer tObserveIpAddressAssignment;
}

on timer tObserveIpAddressAssignment
{
  UpdateDhcpClientSysVars("%NODE_NAME%");
}

void InitIpAddressObservation(void)
{
  setTimerCyclic(tObserveIpAddressAssignment, cObserveIpAddressAssignmentCycletime);
  SetSysvarsForVlan(sysvar::%NODE_NAME%::VlanConfigured, sysvar::%NODE_NAME%::VlanTag);
}

void UpdateDhcpClientSysVars(char dhcpClientNamespace[])
{
  dword result;
  char ipAddr[16];

  // get ip address and write it to the panel
  result = IpGetAdapterAddressAsString(gIfIndex, ipAddr, elcount(ipAddr));
  if(result != 0)
  {
    strncpy(ipAddr, "-", elcount(ipAddr));
    sysSetVariableInt(dhcpClientNamespace, "IpAddressDiagAccessEthAssigned", 0);
  }
  else {
    sysSetVariableInt(dhcpClientNamespace, "IpAddressDiagAccessEthAssigned", 1);
	cancelTimer(tObserveIpAddressAssignment);
  }
  sysSetVariableString(dhcpClientNamespace, "IpAddressDiagAccessEth", ipAddr);
}
