/*@!Encoding:1252*/
//=========================================================
// Software Download Simulation for Example CDD ECUs
// Expects following callback functions in simulation node:
// long sendNegativeResponse(diagRequest * req, dword nrc)
// long sendNegativeResponse(diagResponse * resp, dword nrc)
//=========================================================

variables
{
  dword gDownloadSize = 0;
  dword gDownloadReceived = 0;
  byte  gDownloadCounter = 1;
  dword gDownloadMaxBlockSize = 0x00000400; // only 1024 Bytes to reduce application timeout
}

on diagRequest %BASE_FILE_NAME_NO_EXT%.Upload_Download_Stop
{
  diagResponse this resp;

  @sysvarMember::%BASE_FILE_NAME_NO_EXT%::Download.InProgress = 0;

  refreshS3Timer();
  DiagSendPositiveResponse( resp);
}

on diagRequest %BASE_FILE_NAME_NO_EXT%.Upload_Download_Transmit
{
  diagResponse this resp;

  refreshS3Timer();
  refreshSessionTimer();

  if ( !@sysvarMember::%BASE_FILE_NAME_NO_EXT%::Download.InProgress)
  {
    writeDbgLvlPrefix( 0, "%BASE_FILE_NAME_NO_EXT%: Download service is not active!");
    sendNegativeResponse( this, cNRC_RequestSequenceError);
    return;
  }
  @sysvarMember::%BASE_FILE_NAME_NO_EXT%::Download.BlockSequenceCounter=DiagGetParameter( this, "Block_Sequence_Counter");

  // Set the parameters in the response.
  DiagSetParameter( resp, "Block_Sequence_Counter", @sysvarMember::%BASE_FILE_NAME_NO_EXT%::Download.BlockSequenceCounter);
  DiagSendResponse( resp);
}

on diagRequest %BASE_FILE_NAME_NO_EXT%.Upload_Download_RequestDownload
{
  byte  addressAndLengthFormatIdentifier;
  dword addressFormatSize;
  dword memoryFormatSize;
  dword memorySpecSize;
  byte  memorySpec[8];
  long  i;
  dword address = 0;
  byte  blockSpec[4];
  diagResponse this resp;
  char tempstr[100];

  refreshS3Timer();
  if (Unlocked!=@sysvarMember::%BASE_FILE_NAME_NO_EXT%::Session.SecurityStatus || ProgrammingSession!=@sysvarMember::%BASE_FILE_NAME_NO_EXT%::Session.CurrentSession)
  {
    sendNegativeResponse( this, cNRC_SecurityAccessDenied);
    return;
  }

  addressAndLengthFormatIdentifier = DiagGetParameter( this, "ALFID");
  addressFormatSize = ( addressAndLengthFormatIdentifier & 0xF0) >> 4;
  memoryFormatSize = addressAndLengthFormatIdentifier & 0x0F;
  memorySpecSize = addressFormatSize + memoryFormatSize;
  if ( addressFormatSize > 4 || memoryFormatSize > 4)
  {
    sendNegativeResponse( this, cNRC_RequestOutOfRange);
    return;
  }

  if ( DiagGetParameterRaw( this, "MA_MS_", memorySpec, memorySpecSize) != 0)
  {
    sendNegativeResponse( this, cNRC_IncorrectMessageLengthOrInvalidFormat);
    return;
  }

  for ( i = 0; i < addressFormatSize; ++i)
  {
    address <<= 8;
    address += memorySpec[i];
  }

  gDownloadSize = 0;
  for ( ; i < memorySpecSize; ++i)
  {
    gDownloadSize <<= 8;
    gDownloadSize += memorySpec[i];
  }

  writeDbgLvlPrefix(2, "Received download request at address 0x%08X with size 0x%08X bytes", address, gDownloadSize);
  
  @sysvarMember::%BASE_FILE_NAME_NO_EXT%::Download.InProgress = 1;
  
  gDownloadReceived = 0;
  gDownloadCounter = 1;
  refreshSessionTimer();
  
  // Set the parameters in the response.
  DiagSetParameter( resp, "LFID", 0x40); // LengthFormatIdentifier
  blockSpec[0] = ( byte)( ( gDownloadMaxBlockSize >> 24) & 0xFF);
  blockSpec[1] = ( byte)( ( gDownloadMaxBlockSize >> 16) & 0xFF);
  blockSpec[2] = ( byte)( ( gDownloadMaxBlockSize >>  8) & 0xFF);
  blockSpec[3] = ( byte)( ( gDownloadMaxBlockSize >>  0) & 0xFF);

  diagResize(resp,2+elcount(blockSpec));
  for (i=0;i<elcount(blockSpec);i++) {
    DiagSetPrimitiveByte( resp, i+2, blockSpec[i]); // MaxNumberOfBlockLength
  }
  DiagSendPositiveResponse( resp);
}

// Simplified Routine Control handler to satisfy some tests
on diagRequest %BASE_FILE_NAME_NO_EXT%.Routine_Control::*
{
  diagResponse this resp;
  byte routineControlType;
  byte identifier[2];
  byte responseBuffer[5] = { 0x71, 0x00, 0x00, 0x00, 0x00 };

  refreshS3Timer();
  routineControlType=(byte)DiagGetPrimitiveByte(this,1);
  identifier[0]=(byte)DiagGetPrimitiveByte(this,2);
  identifier[1]=(byte)DiagGetPrimitiveByte(this,3);

  responseBuffer[1]=routineControlType;
  responseBuffer[2]=identifier[0];
  responseBuffer[3]=identifier[1];
  
  diagResize(resp, elcount(responseBuffer));
  diagSetPrimitiveData(resp, responseBuffer, elcount(responseBuffer));

  diagSendPositiveResponse(resp);
}