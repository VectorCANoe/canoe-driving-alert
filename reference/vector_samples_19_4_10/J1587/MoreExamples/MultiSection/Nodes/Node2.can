/*@!Encoding:1252*/
/*
 * Node2 - MultiSection example node               Version 1.1
 *
 * Copyright 2020, Vector Informatik GmbH - All right reserved
 *
 * History:
 * 1.0 Created 
 * 1.1 Use system variables instead of environment variables
 */
variables
{
  // Global variables
  int  gMID          = 0;
  char gNodeName[32] = "NodeA";

  // TX parameters
  J1587Param * TX_Param1 = { DLC = 255 };
}

on J1587Param CMP, CDP
{
  J1587Param CMP rxCmp;
  J1587Param CMP txCmp;
  J1587Param CDP rxCdp;
  INT            i;
  BYTE           nextSegment;
  BYTE           numberOfSegments;
  WORD           numberOfDataBytes;

  if (this.J1587_PID == rxCmp.J1587_PID) {
    rxCmp.DWORD(0) = this.DWORD(0);
    rxCmp.DWORD(4) = this.DWORD(4);

    if (this.J1587_ReceiverMID != gMID) return;

    switch(rxCmp.CMCommand) {
      case 1: // RTS
        nextSegment       = 1;
        numberOfSegments  = rxCmp.RTSNumberOfSegments;
        numberOfDataBytes = rxCmp.RTSNumberOfDataBytes;

        txCmp.J1587_MID           = gMID;
        txCmp.ReceiverMID         = this.J1587_MID;
        txCmp.CMCommand           = txCmp.CMCommand::CTS;
        txCmp.CTSNextSegment      = nextSegment;
        txCmp.CTSNumberOfSegments = 1;
        txCmp.DLC                 = 4;
        output( txCmp );
        break;
    }
  }
  else {
    for( i = 0; i < this.dlc; i++ ) {
      rxCdp.byte(i) = this.byte(i);
    }

    if (this.J1587_ReceiverMID != gMID) return;

    if (rxCdp.SegmentID == nextSegment) {
      nextSegment++;
      if (nextSegment > numberOfSegments) {
        txCmp.J1587_MID           = gMID;
        txCmp.ReceiverMID         = this.J1587_MID;
        txCmp.CMCommand           = txCmp.CMCommand::EOM;
        txCmp.DLC                 = 2;
        output( txCmp );
      }
      else {
        txCmp.J1587_MID           = gMID;
        txCmp.ReceiverMID         = this.J1587_MID;
        txCmp.CMCommand           = txCmp.CMCommand::CTS;
        txCmp.CTSNextSegment      = nextSegment;
        txCmp.CTSNumberOfSegments = 1;
        txCmp.DLC                 = 4;
        output( txCmp );
      }
    }
    else {
      txCmp.J1587_MID           = gMID;
      txCmp.ReceiverMID         = this.J1587_MID;
      txCmp.CMCommand           = txCmp.CMCommand::Abort;
      txCmp.DLC                 = 2;
      output( txCmp );
    }
  }
}

void Node2Init()
{
  gMID = Node2.NmStationAddress;

  @Node2::MID = gMID;
}

void Node2StartUp()
{
}

on start
{
  Node2Init();
  Node2StartUp();
}

on J1587Param *
{
  if (this.DIR == RX) 
  {
    @Node2::RxSize = this.DLC;
    @Node2::RxMID = this.J1587_MID;
  }
}

on sysvar Node2::Send
{
  int i;

  if (@this == 1) 
  {
    TX_Param1.J1587_MID         = gMID;
    TX_Param1.J1587_ReceiverMID = @Node2::ReceiverMID;
    TX_Param1.DLC               = @Node2::Size;
    TX_Param1.J1587_PID         = @Node2::PID;

    // use setJ1587TP to disable transport protocol
    // 0 = default, select TP by receiver
    // 1 = do not use TP
    // 2 = use multisection protocol
    // 3 = use RTS/CTS protocol
    // setJ1587TP( TX_Param1, 0 );

    for( i = 0; i < TX_Param1.DLC; i++ ) {
      TX_Param1.BYTE(i) = i;
    }

    output( TX_Param1 );
  }
}

