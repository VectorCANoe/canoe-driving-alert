/*@!Encoding:1252*/
/*
 * CAPLNodeC - Parameter Monitor example           Version 1.1
 *
 * Copyright 2020, Vector Informatik GmbH - All right reserved
 *
 * History:
 * 1.0 Created 
 * 1.1 Use of system variables instead of environment variables 
 */
variables
{
  BYTE gMID          = 0;
  char gNodeName[32] = "NodeC";
}

on preStart
{
  gMID = CAPLNodeC.NmStationAddress;
}

on start
{
  byte init[4];
  init[0] = 1; init[1] = 2; init[2] = 3; init[3] = 4;
  sysSetVariableData(sysvar::NodeC::`TxData, init, elcount(init));
  @NodeC::MID = gMID;
}

on sysvar NodeC::TxSend
{
  J1587Param 0 txParam;
  byte         data[21];
  int          i;
  long         copiedBytes;

  if (@this == 1) 
  {
    sysGetVariableData( sysvar::NodeC::`TxData, data, copiedBytes );
    
    txParam.J1587_PID         = @NodeC::TxPID;
    txParam.J1587_MID         = gMID;
    txParam.J1587_ReceiverMID = @NodeC::TxReceiverMID;
    txParam.DLC               = @NodeC::TxDataSize;
    for( i = 0; i < txParam.DLC; i++ ) 
    {
      txParam.BYTE(i) = data[i];
    }

    output( txParam );

    write( "<%s> Send PID %d, DLC %d", gNodeName, txParam.J1587_PID, txParam.DLC );
  }

}

on J1587Param CMP, CDP
{
  J1587Param CMP rxCmp;
  J1587Param CMP txCmp;
  J1587Param CDP rxCdp;
  INT            i;
  BYTE           nextSegment;
  BYTE           numberOfSegments;
  WORD           numberOfDataBytes;

  if (this.J1587_ReceiverMID != gMID || this.msgChannel > 1) return;

  if (this.J1587_PID == rxCmp.J1587_PID) 
  {
    rxCmp.DWORD(0) = this.DWORD(0);
    rxCmp.DWORD(4) = this.DWORD(4);

    switch(rxCmp.CMCommand) 
    {
      case 1: // RTS
        nextSegment       = 1;
        numberOfSegments  = rxCmp.RTSNumberOfSegments;
        numberOfDataBytes = rxCmp.RTSNumberOfDataBytes;

        txCmp.J1587_MID           = gMID;
        txCmp.ReceiverMID         = this.J1587_MID;
        txCmp.CMCommand           = txCmp.CMCommand::CTS;
        txCmp.CTSNextSegment      = nextSegment;
        txCmp.CTSNumberOfSegments = 1;
        txCmp.DLC                 = 4;
        output( txCmp );
        break;
    }
  }
  else 
  {
    for( i = 0; i < this.dlc; i++ ) 
    {
      rxCdp.byte(i) = this.byte(i);
    }

    if (this.J1587_ReceiverMID != gMID) return;

    if (rxCdp.SegmentID == nextSegment) {
      nextSegment++;
      if (nextSegment > numberOfSegments) {
        txCmp.J1587_MID           = gMID;
        txCmp.ReceiverMID         = this.J1587_MID;
        txCmp.CMCommand           = txCmp.CMCommand::EOM;
        txCmp.DLC                 = 2;
        output( txCmp );
      }
      else {
        txCmp.J1587_MID           = gMID;
        txCmp.ReceiverMID         = this.J1587_MID;
        txCmp.CMCommand           = txCmp.CMCommand::CTS;
        txCmp.CTSNextSegment      = nextSegment;
        txCmp.CTSNumberOfSegments = 1;
        txCmp.DLC                 = 4;
        output( txCmp );
      }
    }
    else 
    {
      txCmp.J1587_MID           = gMID;
      txCmp.ReceiverMID         = this.J1587_MID;
      txCmp.CMCommand           = txCmp.CMCommand::Abort;
      txCmp.DLC                 = 2;
      output( txCmp );
    }
  }
}

