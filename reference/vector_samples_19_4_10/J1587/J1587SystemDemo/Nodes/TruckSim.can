/*@!Encoding:1252*/
variables
{
  // Constants
  const float kPI              = 3.1415;
  const float kVehicleWeight   = 20000;  // Vehicle weight in [kg]
  const float kWheelRadius     = 0.4;    // Wheel radius in [m]
  const float kMaxEngineSpeed  = 2400.0; // Max. engine speed [rpm]
  const float kIdleEngineSpeed =  600.0; // Idle engine speed [rpm]

  // 
  const int   kSystemTime    = 100;                  // System time in [ms]
  const float kSystemTimeSec = kSystemTime / 1000.0; // System time in [sec]
  msTimer     SystemTimer;                           // System timer
}

/*
 * System timer
 *
 * Simulation values are calculated in this timer.
 */
on timer SystemTimer
{
  float vehicleSpeed;
  float axleSpeed;
  float transmissionRatio;
  float engineSpeed;
  float driveForce;
  float engineTorque;
  float brakePedal;
  int   recalc;

  // get values
  transmissionRatio = @TECU::GearRatio;            // [%]
  vehicleSpeed      = @VECU::VehicleSpeed / 3.6;   // [m/s]
  engineTorque      = @EMS::Torque;                // [Nm]
  brakePedal        = 0.0; //@EBS_BrakePedalPos ) / 100.0; // [%]
  engineSpeed       = @EMS::EngineSpeed;           // [rpm]

  // calculate forward force
  driveForce    = 0;
  if (   (transmissionRatio > 0) 
      && (engineSpeed < kMaxEngineSpeed) )
  {
    driveForce += engineTorque / transmissionRatio * kWheelRadius * 0.2;
  }
  driveForce   -= brakePedal * 60000; // brake force
  driveForce   -= (vehicleSpeed * vehicleSpeed) * 8; // Air resistance

  // caluclate simulated values
  vehicleSpeed += (driveForce / kVehicleWeight) * kSystemTimeSec;
  if (vehicleSpeed < 0) {
    vehicleSpeed  = 0;
  }
  axleSpeed = vehicleSpeed / 2 * kWheelRadius * kPI;

  // calculate engine speed
  if (transmissionRatio > 0) {
    engineSpeed = utilRange( axleSpeed / transmissionRatio, kIdleEngineSpeed, kMaxEngineSpeed);
  }

  // update envVars
  @VECU::VehicleSpeed = vehicleSpeed * 3.6;
  @TECU::OutputShaftSpeed = axleSpeed;
  @TECU::InputShaftSpeed = engineSpeed;
  if (transmissionRatio > 0) {
    @EMS::SimulationMode = 1;
    @EMS::EngineSpeed  = engineSpeed;
  }
  else {
    @EMS::SimulationMode = 0;
  }

  setTimer( SystemTimer, kSystemTime );
}

on start
{
  setTimer( SystemTimer, kSystemTime );
}

/*
 * Clip the value to the range of min and max
 */
float utilRange( float value, float min, float max )
{
  if (value < min) return min;
  if (value > max) return max;

  return value;
}

