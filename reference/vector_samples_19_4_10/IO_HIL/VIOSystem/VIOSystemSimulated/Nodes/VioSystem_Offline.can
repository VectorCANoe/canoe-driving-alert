/*@!Encoding:65001*/
includes
{
}

variables
{
}

on start
{
  // apply intial system state
  @sysvar::CANoe_GUI::CANoeStartButton = 0;
  // apply some card settings
  @sysvar::VIO_simulated::VIO1008Out::Ch01::VoltageRange = @sysvar::VIO_simulated::VIO1008Out::Ch01::VoltageRange::ePlusMinus5V;
  @sysvar::VIO_simulated::VIO2004Out::Ch01::OutputActive = 1.0;
  @sysvar::VIO_simulated::VIO2004Out::Ch02::OutputActive = 1.0;
  @sysvar::VIO_simulated::VIO4028Out::Ch01::OutputMode = @sysvar::VIO_simulated::VIO4028Out::Ch01::OutputMode::eIO;
  @sysvar::VIO_simulated::VIO4028Out::Ch02::OutputMode = @sysvar::VIO_simulated::VIO4028Out::Ch02::OutputMode::eIO;
  @sysvar::VIO_simulated::VIO4028Out::Ch08::OutputMode = @sysvar::VIO_simulated::VIO4028Out::Ch08::OutputMode::ePWM; 
  // apply some inititialisations
  @sysvar::VIO_simulated::VIO4028Out::Ch01::CANoeRunning = 0;
  @sysvar::VIO_simulated::VIO4028Out::Ch02::DutRunning = 0;
  @sysvar::VIO_simulated::VIO2004Out::Ch01::LedAnalogDimmVoltage = 0;
}

on sysvar CANoe_GUI::CANoeStartButton // pushbutton signal to simulate start / stop of CANoe
{
  // Detect pushbutton signal to 'start' CANoe, react on pos. edge only
  if((@sysvar::CANoe_GUI::CANoeStartButton == 1) && (@sysvar::VIO_simulated::VIO4028Out::Ch01::CANoeRunning == 0))
  {
    @sysvar::VIO_simulated::VIO4028Out::Ch01::CANoeRunning = 1;
  }
  // Detect pushbutton signal to 'stop' CANoe, react on pos. edge only
  else if((@sysvar::CANoe_GUI::CANoeStartButton == 1) && (@sysvar::VIO_simulated::VIO4028Out::Ch01::CANoeRunning == 1))
  {
    // Stop CANoe
    @sysvar::VIO_simulated::VIO4028Out::Ch01::CANoeRunning = 0;
    // If CANoe is stopped, the DUT is always stopped, too!
    @sysvar::VIO_simulated::VIO4028Out::Ch02::DutRunning = 0;
  }
}

on sysvar DUT_simulated::DutStartButton // pushbutton signal to start / stop DUT
{
  // update VIO signal
  @sysvar::VIO_simulated::VIO4028In::Ch07::DutStartButton = @sysvar::DUT_simulated::DutStartButton; 
  
  // If CANoe runs, detect pushbutton signal to start VIO, react on pos. edge only
  if((@sysvar::VIO_simulated::VIO4028Out::Ch01::CANoeRunning == 1) && (@sysvar::DUT_simulated::DutStartButton == 1) && (@sysvar::VIO_simulated::VIO4028Out::Ch02::DutRunning == 0))
  {
    @sysvar::VIO_simulated::VIO4028Out::Ch02::DutRunning = 1;
  }
  // If CANoe runs, detect pushbutton signal to stop VIO, react on pos. edge only
  else if((@sysvar::DUT_simulated::DutStartButton == 1) && (@sysvar::VIO_simulated::VIO4028Out::Ch02::DutRunning == 1))
  {
    @sysvar::VIO_simulated::VIO4028Out::Ch02::DutRunning = 0;
  }
}

on sysvar VIO_simulated::VIO4028In::Ch03::CounterBit0
{
  // calculate counter value from counter bits
  @sysvar::CANoe_GUI::CounterVal =  @sysvar::VIO_simulated::VIO4028In::Ch03::CounterBit0 
                                + 2*@sysvar::VIO_simulated::VIO4028In::Ch04::CounterBit1
                                + 4*@sysvar::VIO_simulated::VIO4028In::Ch05::CounterBit2 
                                + 8*@sysvar::VIO_simulated::VIO4028In::Ch06::CounterBit3;
  // sync DUT and CANoe signals
  @sysvar::CANoe_GUI::CounterFreq = @sysvar::DUT_simulated::CounterFreq;
}

on sysvar VIO_simulated::VIO2004Out::Ch01::LedAnalogDimmVoltage
{
  // set LED current depending on LED voltage
  if (@sysvar::VIO_simulated::VIO2004Out::Ch01::LedAnalogDimmVoltage == 0)
  { @sysvar::VIO_simulated::VIO1804In::Ch01::LedAnalogCurrent = 0; }
  
  if (@sysvar::VIO_simulated::VIO2004Out::Ch01::LedAnalogDimmVoltage == 1)
  { @sysvar::VIO_simulated::VIO1804In::Ch01::LedAnalogCurrent = 0; }
  
  if (@sysvar::VIO_simulated::VIO2004Out::Ch01::LedAnalogDimmVoltage == 2)
  { @sysvar::VIO_simulated::VIO1804In::Ch01::LedAnalogCurrent = 1; }
  
  if (@sysvar::VIO_simulated::VIO2004Out::Ch01::LedAnalogDimmVoltage == 3)
  { @sysvar::VIO_simulated::VIO1804In::Ch01::LedAnalogCurrent = 5; }
  
  if (@sysvar::VIO_simulated::VIO2004Out::Ch01::LedAnalogDimmVoltage == 4)
  { @sysvar::VIO_simulated::VIO1804In::Ch01::LedAnalogCurrent = 10; }
  
  if (@sysvar::VIO_simulated::VIO2004Out::Ch01::LedAnalogDimmVoltage == 5)
  { @sysvar::VIO_simulated::VIO1804In::Ch01::LedAnalogCurrent = 15; }
}
