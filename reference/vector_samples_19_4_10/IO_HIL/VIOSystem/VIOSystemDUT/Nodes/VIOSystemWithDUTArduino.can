/*@!Encoding:65001*/
includes
{
}

variables
{
  // Constants
  
  // Variables
  mstimer timerOut1;
  msTimer timerOut3;
}

/* Adapt input voltage range of VIO1008 such that it fits the internal supply voltage range of VIO2004 */
SetVoltageRangesAndOutputs()
{
  @sysvarMember::VIO::VIO1008Out.VoltageRange_Ch01 = @sysvarMember::VIO::VIO1008Out.VoltageRange_Ch01::ePlusMinus5V;
  @sysvarMember::VIO::VIO2004Out.OutputActive_Ch01 = 1.0;
  @sysvarMember::VIO::VIO1008Out.VoltageRange_Ch02 = @sysvarMember::VIO::VIO1008Out.VoltageRange_Ch02::ePlusMinus5V;
  @sysvarMember::VIO::VIO2004Out.OutputActive_Ch02 = 1.0;
}

on start
{
  // Apply intial system state
  SetVoltageRangesAndOutputs();
  // Start timers for output modification
  setTimerCyclic(timerOut1, 20);
  setTimerCyclic(timerOut3, 2000);
    
  // VIO4028 Output Ch01: 'CANoeRunning' signal for Arduino
  @sysvarMember::VIO::VIO4028Out.CanoeRunning_Ch01 = 1;
    
  // VIO4028 Output Ch02: 'VioRunning_Ch02' signal for Arduino
  @sysvarMember::VIO::VIO4028Out.VioRunning_Ch02 = 0;
  
  // VIO4028 Output Ch06:Timeout for input ch. 06 (Counter Bit 0)
  @sysvarMember::VIO::VIO4028Out.CounterBit0PwmTimeout_Ch06 = 0.5;
  
  //VIO4028 Output Ch.16: PWM output to control fan
  @sysvarMember::VIO::VIO4028Out.FanPwmOutputMode_Ch16 = @sysvarMember::VIO::VIO4028Out.FanPwmOutputMode_Ch16::ePWM;
  @sysvarMember::VIO::VIO4028Out.FanPwmFrequencyOut_Ch16 = 2000;
  // Start value of fan speed
  @sysvarMember::VIO::VIO4028Out.FanPwmDutyCycleOut_Ch16 = 0;
}  

on sysvar VIO::VIO4028In.StartButtonIn_Ch03 // startButton input to start / stop VIO
{
  // Detect startButton signal to start VIO, react on pos. edge only
  if((@sysvarMember::VIO::VIO4028In.StartButtonIn_Ch03 == 1) && (@sysvarMember::VIO::VIO4028Out.VioRunning_Ch02 == 0))
  {
    @sysvarMember::VIO::VIO4028Out.VioRunning_Ch02 = 1;
  }
  // Detect startButton signal to stop VIO, react on pos. edge only
  else if((@sysvarMember::VIO::VIO4028In.StartButtonIn_Ch03 == 1) && (@sysvarMember::VIO::VIO4028Out.VioRunning_Ch02 == 1))
  {
    @sysvarMember::VIO::VIO4028Out.VioRunning_Ch02 = 0;
  }
}

// Counter calc
on timer timerOut1
{
  // calc decimal value from counter bits
  @sysvar::Internal::CounterValue = @sysvarMember::VIO::VIO4028In.CounterBit0_Ch12
                              + 2 * @sysvarMember::VIO::VIO4028In.CounterBit1_Ch11 
                              + 4 * @sysvarMember::VIO::VIO4028In.CounterBit2_Ch10
                              + 8 * @sysvarMember::VIO::VIO4028In.CounterBit3_Ch09;
  // counter freq. is 2 times the freq. of the LS bit
  @sysvar::Internal::CounterFreq = 2 * @sysvarMember::VIO::VIO4028In.CounterBit0PwmFreqIn_Ch06;
}

// Temp measurement
on timer timerOut3 
{
  // NTC 36GZ: Offset = 0.5V, Gradient = 10mV/°C
  @sysvar::Internal::AmbientTempCelsius = (@sysvarMember::VIO::VIO1008In.AmbientTempVolt_Ch02 - 0.5) / 0.01;
}

// LED current to milliamps for display
on sysvar VIO::VIO1804In.DimmLedCurrentIn_Ch01 
{
  @sysvar::Internal::DimmLedCurrMillis = 1000 * @sysvarMember::VIO::VIO1804In.DimmLedCurrentIn_Ch01;
}

// Fan slider (0..10) to PWM duty cycle (0..100%)
on sysvar Internal::FanSpeedControl 
{
  if (@sysvarMember::VIO::VIO4028Out.VioRunning_Ch02 == 1)
  {
    @sysvarMember::VIO::VIO4028Out.FanPwmDutyCycleOut_Ch16 = 10 * @sysvar::Internal::FanSpeedControl;
  }
  else 
  {
    @sysvarMember::VIO::VIO4028Out.FanPwmDutyCycleOut_Ch16 = 0;
  }
}

// Fan stop if VioRunning = 0
on sysvar VIO::VIO4028Out.VioRunning_Ch02
{
  if (@sysvarMember::VIO::VIO4028Out.VioRunning_Ch02 == 1)
  {
    @sysvarMember::VIO::VIO4028Out.FanPwmDutyCycleOut_Ch16 = 10 * @sysvar::Internal::FanSpeedControl;
	@sysvar::Internal::FanRPMs = 0.03 * @sysvar::VIO::VIO4028In.FanRpmIn_Ch15;																		  
  }
  else 
  {
    @sysvarMember::VIO::VIO4028Out.FanPwmDutyCycleOut_Ch16 = 0;
	@sysvar::Internal::FanRPMs = 0;							   
  }
}

// Fan RPMs (Frequency 0..250 Hz equals 0..7500 rpm, 2 cycles = 1 rev)
// 7500 rpm equals 250Hz -> rpm (1/min) = freq.*30 -> rpm (1000/min) = freq.*0.03
on sysvar VIO::VIO4028In.FanRpmIn_Ch15
{
  @sysvar::Internal::FanRPMs = 0.03 * @sysvar::VIO::VIO4028In.FanRpmIn_Ch15;
}

// Fan current (0..0.1A) to mA
on sysvar VIO::VIO1804In.FanCurrentIn_Ch02
{
  @sysvar::Internal::FanCurrMillis = 1000 * @sysvar::VIO::VIO1804In.FanCurrentIn_Ch02;
}

on stopMeasurement
{
  @sysvarMember::VIO::VIO4028Out.FanPwmDutyCycleOut_Ch16 = 0;
}
