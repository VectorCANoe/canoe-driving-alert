/*@!Encoding:1252*/
includes
{
  
}

variables
{
  
}



on preStart
{
  sysSetVariableFloat(sysvar::FMI::BouncingBall3::Parameter::e, @sysvar::BouncingBall::BounceCof);
  sysSetVariableFloat(sysvar::FMI::BouncingBall3::Parameter::g, -@sysvar::BouncingBall::Gravity);
  sysSetVariableFloat(sysvar::FMI::BouncingBall3::Output::h, 1.0);
  sysSetVariableLong(sysvar::FMI::BouncingBall3::Input::n, 1);
}



on start
{
  enableControl("BouncingBall", "coeff_rest_up_down", 0);
  enableControl("BouncingBall", "gravity_up_down", 0);
}

on stopMeasurement
{
  enableControl("BouncingBall", "coeff_rest_up_down", 1);
  enableControl("BouncingBall", "gravity_up_down", 1);
}

on sysvar sysvar::BouncingBall::Bounce
{
  if (@this == 0)
  {
    sysSetVariableLong(sysvar::FMI::BouncingBall3::Input::n, @sysvar::FMI::BouncingBall3::Input::n + 1);
  }
}

