/*@!Encoding:1252*/
includes
{
  
}

variables
{
  const dword cSlave1Cs = 1;
  
  dword gMasterHandle = 0; 
  
  dword gSlave1FastFrame1Handle = 0;
  dword gSlave1FastFrame2Handle = 0;
  dword gSlave1SlowFrameHandle = 0;
}

on sysvar_update SafeSPIMaster::Slave1::RawResponse
{
  switch (@SafeSPIMaster::Slave1::RawResponse.ResponseFrameNumber)
  {
    case 1:
      @SafeSPIMaster::Slave1::FastFrame1CrcError = 0;
      break;
    
    case 2:
      @SafeSPIMaster::Slave1::FastFrame2CrcError = 0;
      break;   
     
    case 3:
      @SafeSPIMaster::Slave1::SlowFrameCrcError = 0;
      break;
  }
}

on sysvar_update SafeSPIMaster::Slave1::ResponseCrcError
{
  switch (@SafeSPIMaster::Slave1::ResponseCrcError.ResponseFrameNumber)
  {
    case 1:
      @SafeSPIMaster::Slave1::FastFrame1CrcError = 1;
      break;
    
    case 2:
      @SafeSPIMaster::Slave1::FastFrame2CrcError = 1;
      break;   
     
    case 3:
      @SafeSPIMaster::Slave1::SlowFrameCrcError = 1;
      break;
  }
}

on preStart
{
  if (!CreateSafeSPIFpgaNodes())
  {
    return;
  }
  
  if (!InitSafeSPISlaveNode1())
  {
    writeEx(0, 3, "Initialization of SafeSPI slave node 1 failed.");
    return;
  }  
 
  if (!InitSlaveNode1Frames())
  {
    writeEx(0, 3, "Initialization of SafeSPI slave node 1 frames failed.");
    return;
  }
}

dword CreateSafeSPIFpgaNodes()
{
  dword result;
  
  gMasterHandle = SafeSPICreateMasterNode(sysvar::VTS::SafeSPIMaster_Ch::i_Reset);
  if (gMasterHandle == 0)
  {
    writeEx(0, 3, "Failed to create SafeSPI master node.");
    return 0;
  }
  
  result = SafeSPICreateSlaveNode(gMasterHandle, cSlave1Cs);
  if (result != eSensorNoError)
  {
    writeEx(0, 3, "Creation of SafeSPI slave node 1 failed with code %d.", result);
    return 0;
  } 
  
  return 1;
}

dword InitSafeSPISlaveNode1()
{
  dword result;
  
  // SCLK = 4 MHz
  result = SafeSPISetSlaveClockFrequency(gMasterHandle, cSlave1Cs, 4000000);
  if (result != eSensorNoError)
  {
    writeEx(0, 3, "SafeSPI slave node 1: SafeSPISetSlaveClockFrequency failed with code %d.", result);
    return 0;
  }
  
  // Frame Format = In Frame
  result = SafeSPISetSlaveFrameFormat(gMasterHandle, cSlave1Cs, 0);
  if (result != eSensorNoError)
  {
    writeEx(0, 3, "SafeSPI slave node 1: SafeSPISetSlaveFrameFormat failed with code %d.", result);
    return 0;
  }
  
  // Mode = 1 (CPOL = 0, CPHA = 1)
  result = SafeSPISetSlaveMode(gMasterHandle, cSlave1Cs, 1);
  if (result != eSensorNoError)
  {
    writeEx(0, 3, "SafeSPI slave node 1: SafeSPISetSlaveMode failed with code %d.", result);
    return 0;
  }
  
  // MISO Sample Delay = 100 ns
  result = SafeSPISetSlaveMisoSampleDelay(gMasterHandle, cSlave1Cs, 100);
  if (result != eSensorNoError)
  {
    writeEx(0, 3, "SafeSPI slave node 1: SafeSPISetSlaveMisoSampleDelay failed with code %d.", result);
    return 0;
  }
  
  // Fast Transmit Frequency = 100 Hz
  result = SafeSPISetFastTransmitFrequency(gMasterHandle, cSlave1Cs, 100);
  if (result != eSensorNoError)
  {
    writeEx(0, 3, "SafeSPI slave node 1: SafeSPISetFastTransmitFrequency failed with code %d.", result);
    return 0;
  }
  
  // Slow Transmit Frequency = 1 Hz
  result = SafeSPISetSlowTransmitFrequency(gMasterHandle, cSlave1Cs, 1);
  if (result != eSensorNoError)
  {
    writeEx(0, 3, "SafeSPI slave node 1: SafeSPISetSlowTransmitFrequency failed with code %d.", result);
    return 0;
  }
  
  result = SafeSPISetSlaveRawCommandVariable(gMasterHandle, cSlave1Cs, sysvar::SafeSPIMaster::Slave1::RawCommand);
  if (result != eSensorNoError)
  {
    writeEx(0, 3, "SafeSPI slave node 1: SafeSPISetSlaveRawCommandVariable failed with code %d.", result);
    return 0;
  }
  
  result = SafeSPISetSlaveRawResponseVariable(gMasterHandle, cSlave1Cs, sysvar::SafeSPIMaster::Slave1::RawResponse);
  if (result != eSensorNoError)
  {
    writeEx(0, 3, "SafeSPI slave node 1: SafeSPISetSlaveRawResponseVariable failed with code %d.", result);
    return 0;
  }
  
  result = SafeSPISetSlaveCommandCrcErrorVariable(gMasterHandle, cSlave1Cs, sysvar::SafeSPIMaster::Slave1::CommandCrcError);
  if (result != eSensorNoError)
  {
    writeEx(0, 3, "SafeSPI slave node 1: SafeSPISetSlaveCommandCrcErrorVariable failed with code %d.", result);
    return 0;
  }
  
  result = SafeSPISetSlaveResponseCrcErrorVariable(gMasterHandle, cSlave1Cs, sysvar::SafeSPIMaster::Slave1::ResponseCrcError);
  if (result != eSensorNoError)
  {
    writeEx(0, 3, "SafeSPI slave node 1: SafeSPISetSlaveResponseCrcErrorVariable failed with code %d.", result);
    return 0;
  } 
  
  return 1;
}

dword InitSlaveNode1Frames()
{
  dword result;
  
  // Fast frame 1, Address 0b00000
  gSlave1FastFrame1Handle = SafeSPICreateFrame(gMasterHandle, cSlave1Cs, 32, 32);
  if (gSlave1FastFrame1Handle == 0)
  {
    writeEx(0, 3, "SafeSPI slave node 1: SafeSPICreateFrame failed.");
    return 0;
  }
  
  result = SafeSPISetFrameCommandData(gMasterHandle, cSlave1Cs, gSlave1FastFrame1Handle, 0x00000000);
  if (result != eSensorNoError)
  {
    writeEx(0, 3, "SafeSPI slave node 1: Setting of fast frame 1 data failed with code %d.", result);
    return 0;
  }
  
  result = SafeSPIAddFastSlot(gMasterHandle, cSlave1Cs, gSlave1FastFrame1Handle);
  if (result != eSensorNoError)
  {
    writeEx(0, 3, "SafeSPI slave node 1: Adding of fast frame 1 slot failed with code %d.", result);
    return 0;
  }
  
  result = SafeSPIAddFrameResponseBinding(gMasterHandle, cSlave1Cs, gSlave1FastFrame1Handle, sysvar::SafeSPIMaster::Slave1::FastFrame1);
  if (result != eSensorNoError)
  {
    writeEx(0, 3, "SafeSPI slave node 1: Adding of fast frame 1 variable binding failed with code %d.", result);
    return 0;
  }
  
  // Fast frame 2, Address 0b00001
  gSlave1FastFrame2Handle = SafeSPICreateFrame(gMasterHandle, cSlave1Cs, 32, 32);
  if (gSlave1FastFrame1Handle == 0)
  {
    writeEx(0, 3, "SafeSPI slave node 1: SafeSPICreateFrame failed.");
    return 0;
  }
  
  result = SafeSPISetFrameCommandData(gMasterHandle, cSlave1Cs, gSlave1FastFrame2Handle, 0x08000000);
  if (result != eSensorNoError)
  {
    writeEx(0, 3, "SafeSPI slave node 1: Setting of fast frame 2 data failed with code %d.", result);
    return 0;
  }
  
  result = SafeSPIAddFastSlot(gMasterHandle, cSlave1Cs, gSlave1FastFrame2Handle);
  if (result != eSensorNoError)
  {
    writeEx(0, 3, "SafeSPI slave node 1: Adding of fast frame 2 slot failed with code %d.", result);
    return 0;
  }
  
  result = SafeSPIAddFrameResponseBinding(gMasterHandle, cSlave1Cs, gSlave1FastFrame2Handle, sysvar::SafeSPIMaster::Slave1::FastFrame2);
  if (result != eSensorNoError)
  {
    writeEx(0, 3, "SafeSPI slave node 1: Adding of fast frame 2 variable binding failed with code %d.", result);
    return 0;
  }
  
  // Slow frame, Address 0b00010
  gSlave1SlowFrameHandle = SafeSPICreateFrame(gMasterHandle, cSlave1Cs, 32, 32);
  if (gSlave1FastFrame1Handle == 0)
  {
    writeEx(0, 3, "SafeSPI slave node 1: SafeSPICreateFrame failed.");
    return 0;
  }
  
  result = SafeSPISetFrameCommandData(gMasterHandle, cSlave1Cs, gSlave1SlowFrameHandle, 0x10000000);
  if (result != eSensorNoError)
  {
    writeEx(0, 3, "SafeSPI slave node 1: Setting of slow frame data failed with code %d.", result);
    return 0;
  }
  
  result = SafeSPIAddSlowSlot(gMasterHandle, cSlave1Cs, gSlave1SlowFrameHandle);
  if (result != eSensorNoError)
  {
    writeEx(0, 3, "SafeSPI slave node 1: Adding of slow frame slot failed with code %d.", result);
    return 0;
  }
  
  result = SafeSPIAddFrameResponseBinding(gMasterHandle, cSlave1Cs, gSlave1SlowFrameHandle, sysvar::SafeSPIMaster::Slave1::SlowFrame);
  if (result != eSensorNoError)
  {
    writeEx(0, 3, "SafeSPI slave node 1: Adding of slow frame variable binding failed with code %d.", result);
    return 0;
  }
  
  SafeSPIStartScheduler(gMasterHandle, cSlave1Cs);
  
  return 1;
}
