/*@!Encoding:1252*/

dword CalculateCrc(qword data, qword dataMask, dword polynom, dword seed)
{
  dword polyMsb;
  dword numCrcBits;
  dword crc;
  qword mask;
  dword i;
  
  polyMsb = 0x80000000;
  numCrcBits = 31;
  while ((polyMsb != 0) && ((polyMsb & polynom) == 0))
  {
    polyMsb >>= 1;
    numCrcBits--;
  }

  crc = seed & (polyMsb - 1);

  for (mask = 0x8000000000000000ll; mask != 0; mask >>= 1)
  {
    if (dataMask & mask)
    {
      crc = (crc << 1) | ((data & mask) != 0);
      if (crc & polyMsb)
      {
        crc ^= polynom;
      }
    }
  }

  for (i = 0; i < numCrcBits; i++)
  {
    crc <<= 1;
    if (crc & polyMsb)
    {
      crc ^= polynom;
    }
  }

  return crc;
}