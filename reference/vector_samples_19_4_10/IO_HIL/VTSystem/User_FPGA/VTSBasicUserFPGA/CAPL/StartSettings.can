/*@!Encoding:1252*/
includes
{
}

variables
{  
}



on start
{
  // VT2004
  sysvar::VTS::VT2004_Ch1.SetStimulationMode(eVTSStimulationModeVoltage);
  sysvar::VTS::VT2004_Ch1.SetCurveType(eVTSCurveTypeUserFPGA);
  
  // VT2516
  sysvar::VTS::VT2516_Ch2.SetStimulationMode(eVTSStimulationModeVoltage);
  sysvar::VTS::VT2516_Ch2.SetCurveType(eVTSCurveTypeUserFPGA);
  
  // VT2816
  sysvar::VTS::VT2816_Ch16.SetStimulationMode(eVTSStimulationModeVoltage);
  sysvar::VTS::VT2816_Ch16.SetCurveType(eVTSCurveTypeUserFPGA);
}