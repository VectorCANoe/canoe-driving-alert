/*@!Encoding:1252*/
includes
{
}

variables
{
}


// used to send a message only if the the trigger is used
// otherwise a message would already be send if either RegisterAddress ir Data changed
on sysvar sysvarMember::DemoSPI::WriteMessage.Trigger
{
  if(@this)
  {
    @sysvarMember::SENSOR::SPI::Channel1::Slave1::WriteFrame_Stim.TxTrigger = @this;
    @sysvarMember::SENSOR::SPI::Channel1::Slave1::WriteFrame_Stim.RegisterAddress = @sysvarMember::DemoSPI::WriteMessage.Address;
    @sysvarMember::SENSOR::SPI::Channel1::Slave1::WriteFrame_Stim.Data = @sysvarMember::DemoSPI::WriteMessage.Data;
  }
}


on sysvar sysvarMember::DemoSPI::ReadMessage.Trigger
{
  if(@this)
  {
    @sysvarMember::SENSOR::SPI::Channel1::Slave1::ReadFrame_Stim.TxTrigger = @this;
    // + 128 is needed because the MSB of the address is the write/read command bit
    @sysvarMember::SENSOR::SPI::Channel1::Slave1::ReadFrame_Stim.RegisterAddress = @sysvarMember::DemoSPI::ReadMessage.Address + 128;
  }
}