variables
{
}

export testcase VoltageTest(int DigitalOut,int Expected){
  
  
  // Set simulation mode to voltage generation
  sysvar::VTS::Digital_Ch1.SetStimulationMode(1);
  TestStepPass("","Stimulation Mode (VTS::Digital_Ch1) = voltage");
  

  //set curve type to static
  sysvar::VTS::Digital_Ch1.SetCurveType(0);
  TestStep("","Curve type (VTS::Digital_ch1) = static");

  // Set PMW voltage low  to 0V
  sysvar::VTS::Digital_Ch1.SetPWMVoltageLOW(0);
  TestStep("","PWM stimulation low voltage (VTS:Digital_Ch1) = 0V");

  // Set PMW voltage low  to 5V
  sysvar::VTS::Digital_Ch1.SetPWMVoltageHigh(5);
  TestStep("","PWM stimulation high voltage (VTS:Digital_Ch1) = 5V");

  //Setting DigitalOutput to value given to testcase by vtesttree.yaml file
  @sysvar::VTS::Digital_Ch1::DigitalOutput=DigitalOut;
  TestStep("","System variable 'VTS::Digital_Ch1::DigitalOutput' =  %d", DigitalOut);

  // Start generating the signal
  sysvar::VTS::Digital_Ch1.StartStimulation();
  TestStep("1","Stimulation of the input parameters");
 
  testWaitForTimeout(2000);
  TestStep("2","Waited for 2000ms");

  if (abs(@sysvar::VTS::Load_Ch1::Cur)<Expected+1 && abs(@sysvar::VTS::Load_Ch1::Cur)>Expected-1 ){
    testStepPass("","System Variable 'VTS::Load_Ch1::Cur':=%d, condition: %d <= value <= %d",abs(@sysvar::VTS::Load_Ch1::Cur),Expected-1,Expected+1);
  }
  else
  {
    testStepFail("","System Variable 'VTS::Load_Ch1::Cur':=%d, condition: %d <= value <= %d",abs(@sysvar::VTS::Load_Ch1::Cur),Expected-1,Expected+1);
  }
}

export testcase PWMTest(int Frequency,int DoubleFrequency){
  int durat;

  //Set measurement mode to direct
  sysvar::VTS::Load_Ch1.SetMeasurementMode(0);
  TestStep("","Measurement Mode(VTS::Load_Ch1) = direct");
  
  //Set pwm measurement duration to 0.5
  sysvar::VTS::Load_Ch1.SetPWMMeasurementDuration(0.5);
  TestStep("","PWM Measurement Duration (VTS::Load_Ch1) = 0.5s");
 
  //Set pwm threshold to 3.0
  sysvar::VTS::Load_Ch1.setPWMThreshold(3);
  TestStep("","PWM threshold (VTS::Load_Ch1) = 3V");

  //stop stimulation
  sysvar::VTS::Digital_Ch1.StopStimulation();
  TestStep("","Stimulation stopped on channel VTS::Digital_Ch1");
 
  // Set stimulation mode to voltage
  sysvar::VTS::Digital_Ch1.SetStimulationMode(1);
  TestStep("","Stimulation Mode (VTS::Digital_Ch1) = voltage");
  
  // Set curve type to PWM
  sysvar::VTS::Digital_Ch1.SetCurveType(1);
  TestStep("","Curve type (VTS::Digital_ch1) = PWM");

  // Set pwm voltage to 0V
  sysvar::VTS::Digital_Ch1.SetPWMVoltageLOW(0);
  TestStep("","PWM stimulation low voltage (VTS::Digital_Ch1 = 0V)");

  // Set pwm voltage to 5V
  sysvar::VTS::Digital_Ch1.SetPWMVoltageHigh(5);
  TestStep("","PWM stimulation low voltage (VTS::Digital_Ch1 = 5V)");
 
  // Start stimulation
  sysvar::VTS::Digital_Ch1.StartStimulation();
  TestStep("","Simulation started on channel VTS::Digital_Ch1");
  
  //Fraglich: Stimulation starten vor oder nach frequency und dc Festlegung

  // Set PWM output frequency
  @sysvar::VTS::Digital_Ch1::PWMOutputFreq=Frequency;
  TestStep("","System variable 'VTS::Digital_Ch1::PWMOutputFreq'  %d", Frequency);

  //Set PWM output DC to 40
  @sysvar::VTS::Digital_Ch1::PWMOutputDC=40;
  TestStep("","System variable 'VTS::Digital_Ch1::PWMOutputDC'  %d", 40);
   
  TestStep("1","Stimulation of the input parameters");

  testWaitForTimeout(2000);
  TestStep("2","Waited for 2000ms");

  if (abs(@sysvar::VTS::Load_Ch1::PWMFreq)<Frequency+200 && abs(@sysvar::VTS::Load_Ch1::PWMFreq)>Frequency-200 ){
    testStepPass("","System Variable 'VTS::Load_Ch1::Freq':=%f, condition: %d <= value <= %d",abs(@sysvar::VTS::Load_Ch1::PWMFreq),Frequency-200,Frequency+200);
  }
  else
  {
    testStepFail("","System Variable 'VTS::Load_Ch1::Freq':=%f, condition: %d <= value <= %d",abs(@sysvar::VTS::Load_Ch1::PWMFreq),Frequency-200,Frequency+200);
  }
 
}