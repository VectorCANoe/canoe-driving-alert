/*@!Encoding:1252*/
variables
{
  diagResponse FaultMemory_ReadAllIdentified response;
  int gotResponse = 0;
}


export testcase PowerSupplyTest1 ()
{
  // Prepare system by bringing it to the default state
  @sysvar::VTS_simulated::M1_Ch1::RelayShortCircuit = 0;
  @sysvar::VTS_simulated::M1_Ch1::Resistor = 2300;
  @sysvar::VTS_simulated::M2_Ch2::RelayShortCircuit = 0;
  @sysvar::VTS_simulated::M2_Ch1::IntLoadResistor = 500;
  @sysvar::VTS_simulated::M3_SupInt::RefVoltage = 12;
  testWaitForTimeoutSilent(100);

  // Set test case title
  TestCaseTitle ("PowerSupplyTest1", "Simulating an overvoltage at the ECU.");
  TestCaseDescription("Simulating an overvoltage at the ECU.");

  // Step 1: Set the decade resistor of the simulated VT2004 module to a very high resistance value
  @sysvar::VTS_simulated::M1_Ch1::Resistor = 4000;

  // Step 2: Wait 100ms to make sure the settings take effect
  TestWaitForTimeout(100);

  // Step 3: Check if cooling is at full power and heating is turned off
  if( @sysvar::VTS_simulated::M2_Ch1::Cur != 5.0 || @sysvar::VTS_simulated::M2_Ch2::Cur != 0.0 ) {
    write("%d  %d", @sysvar::VTS_simulated::M2_Ch1::Cur, @sysvar::VTS_simulated::M2_Ch2::Cur );
    TestStepFail("Cooling not at full power or heating turned off");
    return;
  }//end if

  // Step 4: Now set voltage state to overpower
  @sysvar::VTS_simulated::M3_SupInt::RefVoltage = 15.0;

  // Step 5: Wait 100ms to make sure the settings take effect
  TestWaitForTimeout(100);

  // Step 6: Check if cooling and heating is turned off
  if( @sysvar::VTS_simulated::M2_Ch1::Cur != 0.0 || @sysvar::VTS_simulated::M2_Ch2::Cur != 0.0 ) {
    TestStepFail("Cooling or heating not turned off");
    return;
  }//end if

  TestStepPass("PowerSupplyTest1 completed successfully");
}

export testcase PowerSupplyTest2 ()
{
  // Prepare system by bringing it to the default state
  @sysvar::VTS_simulated::M1_Ch1::RelayShortCircuit = 0;
  @sysvar::VTS_simulated::M1_Ch1::Resistor = 2300;
  @sysvar::VTS_simulated::M2_Ch2::RelayShortCircuit = 0;
  @sysvar::VTS_simulated::M2_Ch1::IntLoadResistor = 500;
  @sysvar::VTS_simulated::M3_SupInt::RefVoltage = 12;
  testWaitForTimeoutSilent(100);

  // Set test case title
  TestCaseTitle ("PowerSupplyTest2", "Simulating an undervoltage at the ECU.");
  TestCaseDescription("Simulating an undervoltage at the ECU.");

  // Step 0: Reset voltage
  @sysvar::VTS_simulated::M3_SupInt::RefVoltage = 12.0;

  // Step 1: Set the decade resistor of the simulated VT2004 module to a very high resistance value
  @sysvar::VTS_simulated::M1_Ch1::Resistor = 4000;

  // Step 2: Wait 100ms to make sure the settings take effect
  TestWaitForTimeout(100);

  // Step 3: Check if cooling is at full power and heating is turned off
  if( @sysvar::VTS_simulated::M2_Ch1::Cur != 5.0 || @sysvar::VTS_simulated::M2_Ch2::Cur != 0.0 ) {
    TestStepFail("Cooling not at full power or heating turned off");
    return;
  }//end if

  // Step 4: Now set voltage state to underpower
  @sysvar::VTS_simulated::M3_SupInt::RefVoltage = 10.0;

  // Step 5: Wait 100ms to make sure the settings take effect
  TestWaitForTimeout(100);

  // Step 6: Check if cooling and heating is turned off
  if( @sysvar::VTS_simulated::M2_Ch1::Cur != 0.0 || @sysvar::VTS_simulated::M2_Ch2::Cur != 0.0 ) {
    TestStepFail("Cooling or heating not turned off");
    return;
  }//end if

  TestStepPass("PowerSupplyTest2 completed successfully");
}

export testcase DiagnosticsTest ( int voltage, int expectedErrorCode )
{
  diagRequest ECU.FaultMemory_Clear re1;
  diagRequest ECU.FaultMemory_ReadAllIdentified re2;

  // Prepare system by bringing it to the default state
  @sysvar::VTS_simulated::M1_Ch1::RelayShortCircuit = 0;
  @sysvar::VTS_simulated::M1_Ch1::Resistor = 2300;
  @sysvar::VTS_simulated::M2_Ch2::RelayShortCircuit = 0;
  @sysvar::VTS_simulated::M2_Ch1::IntLoadResistor = 500;
  @sysvar::VTS_simulated::M3_SupInt::RefVoltage = 12;
  testWaitForTimeoutSilent(100);

  // Set test case title
  TestCaseTitle ("DiagnosticsTest", "Diagnostic test on the ECU.");
  TestCaseDescription("This Testcase creates two errors and then checks the fault meory for entries.");

  // Step 1: Clear the fault memory
  diagSendRequest(re1);
  TestWaitForTimeout(100);

  // Step 2: Create an errors
  @sysvar::VTS_simulated::M3_SupInt::RefVoltage = voltage;
  TestWaitForTimeout(100);

  // Step 3: Read the fault memory
  gotResponse = 0;
  diagSendRequest(re2);
  TestWaitForTimeout(100);

  if( gotResponse == 0 )
  {
    TestStepFail("Got no response from ECU");
    return;
  }//end if

  if( (int)(diagGetParameter (response, 0, "DTC")) != expectedErrorCode )
  {
      TestStepFail("Wrong DTC");

  }//end if

  TestStepPass("DiagnosticsTest completed successfully");
}

on diagResponse FaultMemory_ReadAllIdentified
{
  gotResponse = 1;
  diagGetLastResponse(response);
}

