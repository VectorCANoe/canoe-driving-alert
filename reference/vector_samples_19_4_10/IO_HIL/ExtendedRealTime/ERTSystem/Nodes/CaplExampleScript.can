/*@!Encoding:65001*/
includes
{
  
}

variables
{
  message SignalAnalysisMsg msg;
}

on start
{
  write("Hello from CAPL in ERT!");
}

on signal SignalSine
{
  // output message if signal ErtSineSig crosses zero 
  if(checkSignalInRange(SignalSine, -0.005, 0.005) == 1)
  {
    msg.SignalZero = 1;
    output(msg);
  }
}

