/*@!Encoding:65001*/
includes
{
  
}

variables
{
}

on sysvar ErtSine::Performance::StepTime
{
  double diffStepTime = 0;
  int64 cycleTimeUS = 500;
    
  diffStepTime = abs(@this - cycleTimeUS);
  if(diffStepTime > @sysvar::Demo::sysMaxDeviationUSERT)
  {
    @sysvar::Demo::sysMaxDeviationUSERT = diffStepTime;
  }
}

on message *
{
  output(this);
}
