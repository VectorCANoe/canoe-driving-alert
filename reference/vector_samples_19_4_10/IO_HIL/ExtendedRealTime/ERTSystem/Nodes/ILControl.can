/*@!Encoding:65001*/
includes
{
  
}

variables
{
  message SignalAnalysisMsg msg;
}

on preStart
{
  ILControlInit();
}

on sysvar ctrl::ToggleInteractionLayer
{
  if(@this)
  {
    ILControlStart();    
  }
  else
  {
   ILControlStop(); 
  }
}

// this function is called by the interaction layer every time a message is sent
dword applILTxPending (long aId, dword aDlc, byte data[])
{
  @ctrl::MsgCounter = @ctrl::MsgCounter + 1; 
  return 1;
}

// --------------------------------------------------------------------------------
// simple CAPL examples
on start
{
  // output messages from ERT to CANoe Write window
  write("Hello from CAPL in ERT!");
}

on signal SignalSine
{
  //Output message if signal ErtSineSig crosses zero 
  //if(checkSignalInRange(SignalSine, -0.005, 0.005) == 1) // 
  if ($SignalSine > -0.005 && $SignalSine < 0.005)
  {
    msg.SignalZero = 1;
    output(msg);
  }
}