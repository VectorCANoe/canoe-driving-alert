VERSION ""

NS_ :

BS_:

BU_: ErtNode

BO_ 1 SignalAnalysisMsg: 8 ErtNode
 SG_ SignalZero : 0|64@1- (1,0) [0|0] "" Vector__XXX

BO_ 0 ErtSineMsg: 8 ErtNode
 SG_ SignalSine : 0|64@1- (1,0) [0|0] "" Vector__XXX

BA_DEF_ SG_  "GenSigSendType" ENUM  "Cyclic","OnWrite","OnWriteWithRepetition","OnChange","OnChangeWithRepetition","IfActive","IfActiveWithRepetition","NoSigSendType","NotUsed","NotUsed","NotUsed","NotUsed","NotUsed";
BA_DEF_ SG_  "GenSigInactiveValue" INT 0 100000;
BA_DEF_ BO_  "GenMsgSendType" ENUM  "Cyclic","NotUsed","NotUsed","NotUsed","NotUsed","NotUsed","NotUsed","IfActive","NoMsgSendType","NotUsed","vector_leerstring";
BA_DEF_ BO_  "GenMsgCycleTime" INT 0 50000;
BA_DEF_ BO_  "GenMsgILSupport" ENUM  "No","Yes";
BA_DEF_ BU_  "NodeLayerModules" STRING ;
BA_DEF_  "NmBaseAddress" HEX 1024 1087;
BA_DEF_  "BusType" STRING ;
BA_DEF_DEF_  "GenSigSendType" "Cyclic";
BA_DEF_DEF_  "GenSigInactiveValue" 0;
BA_DEF_DEF_  "GenMsgSendType" "NoMsgSendType";
BA_DEF_DEF_  "GenMsgCycleTime" 0;
BA_DEF_DEF_  "GenMsgILSupport" "Yes";
BA_DEF_DEF_  "NodeLayerModules" "CANoeILNLVector.dll";
BA_DEF_DEF_  "NmBaseAddress" 1024;
BA_DEF_DEF_  "BusType" "CAN";
BA_ "NodeLayerModules" BU_ ErtNode "CANoeILNLVector.vmodule";
BA_ "GenMsgSendType" BO_ 0 0;
BA_ "GenMsgCycleTime" BO_ 0 10;
BA_ "GenSigSendType" SG_ 1 SignalZero 7;
BA_ "GenSigSendType" SG_ 0 SignalSine 7;
BA_ "GenSigInactiveValue" SG_ 0 SignalSine 10;
SIG_VALTYPE_ 1 SignalZero : 2;
SIG_VALTYPE_ 0 SignalSine : 2;
