/*@!Encoding:1252*/
includes
{
  
}

variables
{
  
}

export testcase tcsEngineTest2()
{
  testStep ("Engine", "This is the second EngineTest");
  testWaitForTimeout (500);
  testStepPass();
}

