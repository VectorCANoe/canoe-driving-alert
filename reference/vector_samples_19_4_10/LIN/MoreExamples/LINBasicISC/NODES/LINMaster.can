/*@@var:*/
variables
{ 
  dword mNewPage;  //sink identifier
}
/*@@end*/

/*@@startStart:Start:*/
on start
{
  //Create a new page at the write window
  mNewPage = writeCreate("Instructions");

  //get information about the scheduler mode in the write window
  writeLineEx(mNewPage,1,"The LIN Interactive Scheduler can be used to:");
  writeLineEx(mNewPage,1,"- change the response data (LinMsg1,LinMsg2)");
  writeLineEx(mNewPage,1,"- send a messag header (LinExtra)");
  writeLineEx(mNewPage,1,"For detailed information see \nthe configuration comment or online help.");
  writeLineEx(mNewPage,1,"\nPush the \"Send\" button to send an additional header!");
}
/*@@end*/

