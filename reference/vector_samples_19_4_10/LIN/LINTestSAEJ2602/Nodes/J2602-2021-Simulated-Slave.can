/*@!Encoding:1252*/
/*@!Encoding:1252*/
includes
{
  
}

variables
{
  msTimer gTimerWakeupBulk;          // timer to initiate next bulk of wake-up retries
  byte    gIsDuringWakeupProcedure;  // flag indicating if currently transiting to wakeup state  
  int     gWakeupRetriesCount;       // counter of wake-up retries
  int     gWakeupBulkCount;          // counter of wake-up bulks
}

on linWakeupFrame
{
  if (this.msgChannel != %CHANNEL%)
  {
    return;  
  }
  if (1 == gIsDuringWakeupProcedure)
  {
    ++gWakeupRetriesCount;
    if (gWakeupRetriesCount % @sysvar::LINConformanceTestDemoVariables_Channel2::WakeupRequestsInSequence == 0)
    {
      ++gWakeupBulkCount;
      if (gWakeupBulkCount < @sysvar::LINConformanceTestDemoVariables_Channel2::WakeupSequences)
      {
        setTimer(gTimerWakeupBulk, @sysvar::LINConformanceTestDemoVariables_Channel2::WakeupSequencesDelay);
      }
      else
      {
        OnStopWakeupProcedure();
      }
    }
  }
}

void OnStopWakeupProcedure ()
{
  gIsDuringWakeupProcedure = 0;
  gWakeupRetriesCount = 0;
  gWakeupBulkCount = 0;
}

void OnStartWakeupProcedure()
{
  gIsDuringWakeupProcedure = 1;
  gWakeupRetriesCount = 0;
  gWakeupBulkCount = 0;
  linWakeup(@sysvar::LINConformanceTestDemoVariables_Channel2::WakeupRetrDelay
          , @sysvar::LINConformanceTestDemoVariables_Channel2::WakeupRequestsInSequence
          , @sysvar::LINConformanceTestDemoVariables_Channel2::WakeupLength);
}


on linTransmError
{
  if (this.msgChannel != %CHANNEL%)
  {
    return;  
  }
  if (1 == gIsDuringWakeupProcedure)
  { 
    OnStopWakeupProcedure();
  }
}

on linCsError
{
  if (this.msgChannel != %CHANNEL%)
  {
    return;  
  }
  if (1 == gIsDuringWakeupProcedure)
  { 
    OnStopWakeupProcedure();
  }
}

on timer gTimerWakeupBulk
{
  if (1 == gIsDuringWakeupProcedure)
  {
    // initiate next bulk of wake-up retries
    linWakeup(@sysvar::LINConformanceTestDemoVariables_Channel2::WakeupRetrDelay
            , @sysvar::LINConformanceTestDemoVariables_Channel2::WakeupRequestsInSequence
            , @sysvar::LINConformanceTestDemoVariables_Channel2::WakeupLength);
  }
}

on sysvar sysvar::LINConformanceTestDemoVariables_Channel2::SlaveDNN
{
  int nad;
  nad = (@this | 0x60);
  linSetNAD(nad);
}

on sysvar sysvar::LINConformanceTestDemoVariables_Channel2::SendWakeupSequencies
{
  if (@this == 1)
  {
    OnStartWakeupProcedure();
  }
}


on preStart
{
  int i, j;
  
  gIsDuringWakeupProcedure = 0;
  gWakeupRetriesCount = 0;
  gWakeupBulkCount = 0;  
}

on linReceiveError
{
  int state, reason, frameID;
  
  if (this.msgChannel != %CHANNEL%)
  {
    return;  
  }
  
  if (1 == gIsDuringWakeupProcedure)
  { 
    OnStopWakeupProcedure();
  }
}

on linFrame *
{
  if (this.msgChannel != %CHANNEL%)
  {
    return;  
  }
  
  if (1 == gIsDuringWakeupProcedure)
  { 
    OnStopWakeupProcedure();
  }
}



