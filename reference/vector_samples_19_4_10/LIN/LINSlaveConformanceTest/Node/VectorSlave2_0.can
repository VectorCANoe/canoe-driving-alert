/*@!Encoding:1252*/
variables
{
  const byte gkSinkSystem           = 0;  // System tab is the target of a notification to Write window
  const byte gkSinkCAPL             = 1;  // CAPL tab is the target of a notification to Write window
  const byte gkSinkTest             = 4;  // Test tab is the target of a notification to Write window
  const byte gkSevError             = 3;  // Error severity of a notification to Write window
  const byte gkSevWarn              = 2;  // Warning severity of a notification to Write window
}

on start
{
  dword arrayOfSixteenthBits[9];
  int i;

  if (IsSimulated()) // don't activate tests when running in simulated mode
  {
    WriteLineEx(gkSinkCAPL, gkSevError
      , "VectorSlave2_0: Conformance tests cannot run in simulated mode!");     
    stop();
    return;
  }

  // set 2 bits interbyte between all databytes and cs-byte
  for (i = 1; i < 9; ++i)
  {
    arrayOfSixteenthBits[i] = 32;
  }
  linSetInterByteSpaces(arrayOfSixteenthBits);
  linSetInterByteSpaces(0x3D, arrayOfSixteenthBits);
}

on sysvar sysvar::LINConformanceTestDemoVariables_Channel2::SendWakeupSequencies
{
  if (@this == 1)
  {
    linWakeup();
  }
}

on sysvar sysvar::LINConformanceTestDemoVariables_Channel2::TriggerETF
{
  if (@this == 1)
  {
    if ($sigMotorState1_2.raw >= 0 || $sigMotorState1_2.raw < 255)
    {
      $sigMotorState1_2.raw = $sigMotorState1_2.raw + 1;
    }
    else
    {
      $sigMotorState1_2.raw = $sigMotorState1_2.raw - 1;
    }	
  }
}

