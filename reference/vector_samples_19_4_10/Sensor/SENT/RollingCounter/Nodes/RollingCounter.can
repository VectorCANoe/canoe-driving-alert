/*@!Encoding:1252*/
includes
{  
  #include "Utils_SENT.cin"
}

variables
{
  // Holds the current sensor signal value
  word gSensorSignalValue = 0;  
 
  // Holds the current serial message data
  dword gSendSerialMessage = 0;
  byte gSerialMessageBuffer[cEnhancedSerialMessageLength];
}

on preStart
{ 
  // Initialize serial message
  UpdateSerialMessageSettings();
  
  // Fill up sensor queue on start-up
  FillSensorQueue();
}

void FillSensorQueue()
{
  // Queue in frames until an error is returned (Queue overflow)
  while(QueueNextSensorFrame() == eSensorNoError);
}

dword QueueNextSensorFrame()
{
  byte rollingCounter = 0;
  dword errorCode = eSensorNoError;
  SentSensorFrameStruct sensorFrame;
  
  dword serMsgFramesLeft = 0;
  byte serMsgBuffer[cEnhancedSerialMessageLength];  
  
  if (gSendSerialMessage && serMsgFramesLeft == 0)
  {
    // Copy serial messsage data to local buffer to ensure data consistency during transmission
    memcpy(serMsgBuffer, gSerialMessageBuffer, cEnhancedSerialMessageLength);
    serMsgFramesLeft = cEnhancedSerialMessageLength;
  }
  
  if (serMsgFramesLeft != 0)
  {
    // Set serial message bits
    sensorFrame.StatusBits = serMsgBuffer[cEnhancedSerialMessageLength - serMsgFramesLeft];
  }
  
  // Set frame data
  sensorFrame.DataBits = gSensorSignalValue;
  sensorFrame.DataBits <<= 8;
  sensorFrame.DataBits |= rollingCounter;
  
  // Insert SENT frame into the channel send queue
  errorCode = sysvar::SENSOR::SENT::SENSORSIM.QueueSentFrame(sensorFrame);
  if (errorCode == eSensorNoError) 
  {
    // If queuing succeeded increment rolling counter and decrement serial message frame counter
    rollingCounter++;
    if (serMsgFramesLeft > 0)
    {
      serMsgFramesLeft--;
    }
  } 
  return errorCode;
}

void UpdateSerialMessageSettings()
{ 
  gSendSerialMessage = @SENTSignals::EnableSerialMsg;  
  if (gSendSerialMessage)
  {
    // Calculate serial message data according to set values if transmission is enabled
    Utils_SENT_GetEnhancedSerialMessageStatusBitValues(@SENTSignals::SerMsgId, 
                                                       @SENTSignals::SerMsgValue,
                                                       @SENTSignals::EnableLongSerMsgId,
                                                       0,
                                                       gSerialMessageBuffer,
                                                       cEnhancedSerialMessageLength);
  }
}

on sysvar SENSOR::SENT::SENSORSIM::Sensor::SensorFrame
{
  // Queue next frame on successful transmission of a sensor frame
  QueueNextSensorFrame();
}

on sysvar SENTSignals::SignalValue
{
  // Update current sensor signal value
  gSensorSignalValue = @this;
}

on sysvar (SENTSignals::EnableSerialMsg | SENTSignals::EnableLongSerMsgId | SENTSignals::SerMsgId | SENTSignals::SerMsgValue)
{
  // Update the serial message data if one of the panel variables has changed
  UpdateSerialMessageSettings();
}