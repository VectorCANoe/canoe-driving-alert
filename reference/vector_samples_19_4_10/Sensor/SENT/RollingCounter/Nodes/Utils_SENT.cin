/*@!Encoding:1252*/
includes
{  
}

variables
{   
  byte CRC4_TABLE[16] = { 
                           0, 13, 7, 10, 14, 3, 9, 4,
                           1, 12, 6, 11, 15, 2, 8, 5 
                        };
  
  byte CRC6_TABLE[64] = { 
                           0, 25, 50, 43, 61, 36, 15, 22,
                          35, 58, 17,  8, 30,  7, 44, 53,
                          31,  6, 45, 52, 34, 59, 16,  9,
                          60, 37, 14, 23,  1, 24, 51, 42,
                          62, 39, 12, 21,  3, 26, 49, 40,
                          29,  4, 47, 54, 32, 57, 18, 11,
                          33, 56, 19, 10, 28,  5, 46, 55,
                           2, 27, 48, 41, 63, 38, 13, 20
                        };
  
  const dword cShortSerialMessageLength = 16;
  const dword cEnhancedSerialMessageLength = 18;
}

byte Utils_SENT_CalculateCRC6(byte data6bit[], dword dataLen)
{
  long i;
  byte checksum;
  
  checksum = 21;
  for (i = 0; i < dataLen; i++)
  {
    checksum = (data6bit[i] & 0x3F) ^ CRC6_TABLE[checksum];
  }
  
  return CRC6_TABLE[checksum];
}

byte Utils_SENT_CalculateCRC4(byte data4bit[], dword dataLen, dword useRecommendedMode)
{
  long i;
  byte checksum;
  
  checksum = 5;
  for (i = 0; i < dataLen; i++)
  {
    checksum = (data4bit[i] & 0xF) ^ CRC4_TABLE[checksum];
  }
  
  return useRecommendedMode ? CRC4_TABLE[checksum] : checksum;
}

byte Utils_SENT_CalculateEnhancedSerialMessageCRC(byte id, word data, dword useLongMessageId)
{
  byte data6bit[4];
  byte idByte;
  
  idByte = useLongMessageId ? id : ((data & 0xF000) >> 12) | ((id & 0xF) << 4);
  
  data6bit[0] = ((data & (1 << 11)) > 0)    << 5; // m0
                                                  // m1 = always 0
  data6bit[0] |= ((data & (1 << 10)) > 0)   << 3; // m2
  data6bit[0] |= (useLongMessageId ? 0 : 1) << 2; // m3
  data6bit[0] |= ((data & (1 << 9)) > 0)    << 1; // m4
  data6bit[0] |= ((idByte & (1 << 7)) > 0)  << 0; // m5
  
  data6bit[1] = ((data & (1 << 8)) > 0)     << 5; // m6
  data6bit[1] |= ((idByte & (1 << 6)) > 0)  << 4; // m7
  data6bit[1] |= ((data & (1 << 7)) > 0)    << 3; // m8
  data6bit[1] |= ((idByte & (1 << 5)) > 0)  << 2; // m9
  data6bit[1] |= ((data & (1 << 6)) > 0)    << 1; // m10
  data6bit[1] |= ((idByte & (1 << 4)) > 0)  << 0; // m11
                                                  
  data6bit[2] = ((data & (1 << 5)) > 0)     << 5; // m12
                                                  // m13 = always 0
  data6bit[2] |= ((data & (1 << 4)) > 0)    << 3; // m14
  data6bit[2] |= ((idByte & (1 << 3)) > 0)  << 2; // m15
  data6bit[2] |= ((data & (1 << 3)) > 0)    << 1; // m16
  data6bit[2] |= ((idByte & (1 << 2)) > 0)  << 0; // m17
                                                  
  data6bit[3] = ((data & (1 << 2)) > 0)     << 5; // m18
  data6bit[3] |= ((idByte & (1 << 1)) > 0)  << 4; // m19
  data6bit[3] |= ((data & (1 << 1)) > 0)    << 3; // m20
  data6bit[3] |= ((idByte & (1 << 0)) > 0)  << 2; // m21
  data6bit[3] |= ((data & (1 << 0)) > 0)    << 1; // m22
                                                  // m23 = always 0
  
  return Utils_SENT_CalculateCRC6(data6bit, elCount(data6bit));
}

dword Utils_SENT_GetShortSerialMessageStatusBitValues(byte id, word data, dword useRecommendedCrcMode, dword sendInvalidCrc, byte buffer[], dword bufferSize)
{
  long i, crc;
  byte nibbles[3];  
  
  if (bufferSize < cShortSerialMessageLength)
  {
    return eSensorOperationFailed;
  } 

  nibbles[0] = (id & 0xF);
  nibbles[1] = (data & 0xF0) >> 4;
  nibbles[2] = (data & 0xF);
  
  crc = Utils_SENT_CalculateCRC4(nibbles, elCount(nibbles), useRecommendedCrcMode); 
  if (sendInvalidCrc) crc = ~crc;
  
  for (i = 0; i < cShortSerialMessageLength; i++)
  {
    if (i == 0)
    {
      buffer[i] = ((id & (0x8 >> i)) > 0) + 2;
    }
    else if (i < 4)
    {
      buffer[i] = (id & (0x8 >> i)) > 0;
    }
    else if (i < 12)
    {
      buffer[i] = (data & (0x80 >> (i - 4))) > 0;
    }
    else
    {
      buffer[i] = (crc & (0x8 >> (i - 12))) > 0;
    }
    
    buffer[i] <<= 2;
  }
  
  return eSensorNoError;
}

dword Utils_SENT_GetEnhancedSerialMessageStatusBitValues(byte id, word data, dword useLongMessageId, dword sendInvalidCrc, byte buffer[], dword bufferSize)
{
  byte idByte;
  long i, idBitIndex, crc;

  if (cEnhancedSerialMessageLength < cEnhancedSerialMessageLength)
  {
    return eSensorOperationFailed;
  }
  
  crc = Utils_SENT_CalculateEnhancedSerialMessageCRC(id, data, useLongMessageId);  
  if (sendInvalidCrc) crc = ~crc;

  idByte = useLongMessageId ? id : ((data & 0xF000) >> 12) | ((id & 0xF) << 4);
  idBitIndex = 0;
  
  for (i = 0; i < cEnhancedSerialMessageLength; i++)
  {
    if (i < 6)
    {
      buffer[i] = ((crc & (0x20 >> i)) > 0) + 2;
    }
    else
    {
      buffer[i] = ((data & (0x800 >> (i - 6))) > 0);
      
      if (i == 7)
      {
        buffer[i] += useLongMessageId ? 0 : 2;
      }
      else if (i != 6 && i != 12 && i != 17)
      {      
        // i == 8, 9, 10, 11, 13, 14, 15, 16
        buffer[i] += (idByte & (0x80 >> idBitIndex++)) ? 2 : 0;
      }
    }
    
    buffer[i] <<= 2;
  } 
  
  return eSensorNoError;
}

