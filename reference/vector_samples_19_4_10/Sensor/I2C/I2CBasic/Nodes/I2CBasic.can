/*@!Encoding:1252*/
includes
{
  
}

variables
{
  // Timing constants
  const dword cI2C_FRAME_CYCLE_TIME_MS = 10;
  const dword cI2C_ANIMATION_CYCLE_TIME_MS = 100;
  
  // Byte arrays, filled by I2C byte signals, transferred to Master and Slave port
  byte gMasterToSlave1TxBuffer[5] = {0x00, 0x00, 0x00, 0x00, 0x00};
  byte gMasterToSlave2TxBuffer[5] = {0x00, 0x00, 0x00, 0x00, 0x00};  

  msTimer I2CSlave1CommTimer;
  msTimer I2CSlave2CommTimer;
  msTimer dataAnimationTimer;
}

on start
{
  write("\n");
  writeDbgLevel(15,"I2CBasic Demo has to use VTSystem with VT2710 module and real wired I2C ports.");
  write("\n");
  
  // To run that configuration, a real VTSystem with additional VT2710 module is necessary at least.
  if (isSimulated())
  {
    writeDbgLevel(15,"!!! Demo can't run in simulated mode!, Simulation stopped !!!");
    stop();
    return;
  }
  
  // Queue initial slave read values
  QueueSlave1ReadSignalValues();
  QueueSlave2ReadSignalValues();
  
  // Start data request timers
  setTimer(I2CSlave1CommTimer, cI2C_FRAME_CYCLE_TIME_MS);  
  setTimerCyclic(dataAnimationTimer, cI2C_ANIMATION_CYCLE_TIME_MS);
}

on timer I2CSlave1CommTimer
{
  dword errorCode = eSensorNoError;
  
  errorCode = sysvar::SENSOR::I2C::Master_Port::Slave1.QueueCombinedFrame(gMasterToSlave1TxBuffer, 5, 5);
  if (errorCode != eSensorNoError)
  {
    write("Slave 1: 'QueueCombinedFrame' call failed with code: %d. Data could be lost.", errorCode); 
  }
  setTimer(I2CSlave2CommTimer, cI2C_FRAME_CYCLE_TIME_MS);
}

on timer I2CSlave2CommTimer
{
  dword errorCode = eSensorNoError;
  
  errorCode = sysvar::SENSOR::I2C::Master_Port::Slave2.QueueCombinedFrame(gMasterToSlave2TxBuffer, 5, 5);
  if (errorCode != eSensorNoError)
  {
    write("Slave 2: 'QueueCombinedFrame' call failed with code: %d. Data could be lost.", errorCode); 
  }
  setTimer(I2CSlave1CommTimer, cI2C_FRAME_CYCLE_TIME_MS);
}

on timer dataAnimationTimer
{
  // To see minimum communication on the I2C bus, 'Signal1' of both slaves is changed every 100ms
  if (@I2CCommunication::MasterToSlave1::W_Signal1 == 255)
  {
    @I2CCommunication::MasterToSlave1::W_Signal1 = 0;
  }
  else
  {
    @I2CCommunication::MasterToSlave1::W_Signal1++;
  }
  
  if (@I2CCommunication::MasterToSlave2::W_Signal1 == 0)
  {
    @I2CCommunication::MasterToSlave2::W_Signal1 = 255;
  }
  else
  {
    @I2CCommunication::MasterToSlave2::W_Signal1--;
  }
}

//
// Signals Master --> Slave 1
//
on sysvar (I2CCommunication::MasterToSlave1::W_Signal1 | I2CCommunication::MasterToSlave1::W_Signal2)
{
  // Insert signal1 (Byte) from master to slave 1 into the send buffer
  gMasterToSlave1TxBuffer[0] = @I2CCommunication::MasterToSlave1::W_Signal1;
  
  // Insert signal2 (UInt32) from master to slave 1 into the send buffer
  sensorInsertInteger(gMasterToSlave1TxBuffer, 5, @I2CCommunication::MasterToSlave1::W_Signal2, 8, 32, 1);
}

on sysvar SENSOR::I2C::Slave_Port::Slave1::Slave1_Frame.WriteSequence.Signals.MTS1_Byte
{
  @I2CCommunication::Slave1ToMaster::W_Signal1 = (byte)@this;
}

on sysvar SENSOR::I2C::Slave_Port::Slave1::Slave1_Frame.WriteSequence.Signals.MTS1_UInt32
{
  @I2CCommunication::Slave1ToMaster::W_Signal2 = (dword)@this;
}

//
// Signals Master --> Slave 2
//
on sysvar (I2CCommunication::MasterToSlave2::W_Signal1 | I2CCommunication::MasterToSlave2::W_Signal2)
{
  // Insert signal1 (Byte) from master to slave 2 into the send buffer
  gMasterToSlave2TxBuffer[0] = @I2CCommunication::MasterToSlave2::W_Signal1;
  
  // Insert signal2 (UInt32) from master to slave 2 into the send buffer
  sensorInsertInteger(gMasterToSlave2TxBuffer, 5, @I2CCommunication::MasterToSlave2::W_Signal2, 8, 32, 1);
}

on sysvar SENSOR::I2C::Slave_Port::Slave2::Slave2_Frame.WriteSequence.Signals.MTS2_Byte
{
  @I2CCommunication::Slave2ToMaster::W_Signal1 = (byte)@this;
}

on sysvar SENSOR::I2C::Slave_Port::Slave2::Slave2_Frame.WriteSequence.Signals.MTS2_UInt32
{
  @I2CCommunication::Slave2ToMaster::W_Signal2 = (dword)@this;
}

//
// Signals Slave 1 --> Master
//
on sysvar (I2CCommunication::Slave1ToMaster::R_Signal1 | I2CCommunication::Slave1ToMaster::R_Signal2)
{
  QueueSlave1ReadSignalValues();
}

void QueueSlave1ReadSignalValues()
{
  dword errorCode = eSensorNoError;
  byte slaveToMasterTxBuffer[5] = {0x00, 0x00, 0x00, 0x00, 0x00};
      
  // Insert signal1 (Byte) from slave1 to master into the send buffer
  slaveToMasterTxBuffer[0] = @I2CCommunication::Slave1ToMaster::R_Signal1;
  
  // Insert signal2 (UInt32) from slave1 to master into the send buffer
  sensorInsertInteger(slaveToMasterTxBuffer, 5, @I2CCommunication::Slave1ToMaster::R_Signal2, 8, 32, 1);
  
  errorCode = sysvar::SENSOR::I2C::Slave_Port::Slave1.QueueFrame(slaveToMasterTxBuffer, 5);
  if (errorCode != eSensorNoError)
  {
    write("Slave 1: 'QueueFrame' call failed with code: %d. Data could be lost.", errorCode); 
  }
}

on sysvar SENSOR::I2C::Master_Port::Slave1::Master_Frame_Slave1.ReadSequence.Signals.S1TM_Byte
{
  @I2CCommunication::MasterToSlave1::R_Signal1 = (byte)@this;
}

on sysvar SENSOR::I2C::Master_Port::Slave1::Master_Frame_Slave1.ReadSequence.Signals.S1TM_UInt32
{
  @I2CCommunication::MasterToSlave1::R_Signal2 = (dword)@this;
}

//
// Signals Slave 2 --> Master
//
on sysvar (I2CCommunication::Slave2ToMaster::R_Signal1 | I2CCommunication::Slave2ToMaster::R_Signal2)
{
  QueueSlave2ReadSignalValues();
}

void QueueSlave2ReadSignalValues()
{
  dword errorCode = eSensorNoError;;
  byte slaveToMasterTxBuffer[5] = {0x00, 0x00, 0x00, 0x00, 0x00};
      
  // Insert signal1 (Byte) from slave1 to master into the send buffer
  slaveToMasterTxBuffer[0] = @I2CCommunication::Slave2ToMaster::R_Signal1;
  
  // Insert signal2 (UInt32) from slave1 to master into the send buffer
  sensorInsertInteger(slaveToMasterTxBuffer, 5, @I2CCommunication::Slave2ToMaster::R_Signal2, 8, 32, 1);
  
  errorCode = sysvar::SENSOR::I2C::Slave_Port::Slave2.QueueFrame(slaveToMasterTxBuffer, 5);
  if (errorCode != eSensorNoError)
  {
    write("Slave 2: 'QueueFrame' call failed with code: %d. Data could be lost.", errorCode); 
  }
}

on sysvar SENSOR::I2C::Master_Port::Slave2::Master_Frame_Slave2.ReadSequence.Signals.S2TM_Byte
{
  @I2CCommunication::MasterToSlave2::R_Signal1 = (byte)@this;
}

on sysvar SENSOR::I2C::Master_Port::Slave2::Master_Frame_Slave2.ReadSequence.Signals.S2TM_UInt32
{
  @I2CCommunication::MasterToSlave2::R_Signal2 = (dword)@this;
}

on sysvar SENSOR::I2C::Master_Port::Slave1::Master_Frame_Slave1
{
  @I2CCommunication::MasterFrame::Timestamp = @SENSOR::I2C::Master_Port::Slave1::Master_Frame_Slave1.StartOfFrameTime;
}

on sysvar SENSOR::I2C::Master_Port::Slave2::Master_Frame_Slave2
{
  @I2CCommunication::MasterFrame::Timestamp = @SENSOR::I2C::Master_Port::Slave2::Master_Frame_Slave2.StartOfFrameTime;
}

on sysvar SENSOR::I2C::Slave_Port::Slave1::Slave1_Frame
{
  @I2CCommunication::SlaveFrame::Timestamp = @SENSOR::I2C::Slave_Port::Slave1::Slave1_Frame.StartOfFrameTime;
}

on sysvar SENSOR::I2C::Slave_Port::Slave2::Slave2_Frame
{
  @I2CCommunication::SlaveFrame::Timestamp = @SENSOR::I2C::Slave_Port::Slave2::Slave2_Frame.StartOfFrameTime;
}

