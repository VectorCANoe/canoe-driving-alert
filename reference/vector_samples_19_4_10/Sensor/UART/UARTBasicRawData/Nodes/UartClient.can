/*@!Encoding:1252*/
includes
{
  
}

variables
{
  /* Timer for cyclic transfer of data to queue */
  msTimer ClientTxUpdateTimer;
  long gDurationClientTxUpdateTimer = 50;
  
  /* limitation of value transmitted by UART */
  const long cMaxNbrUartValues = 255;
  
  /* array used to prepare the UART data */
  dword gUartTxData[cMaxNbrUartValues];
  
  /* index to read out current value from array to be transferred to UART queue */
  long gBufferIndex = 0; 
  
  /* variable to check return value from CAPL function */
  long gRetval1 = 0;
}

on start
{  
  /* call function to fill array with static values */
  PrepareUartTxBuffer();  
  
  /* start cyclic timer */
  setTimerCyclic(ClientTxUpdateTimer, gDurationClientTxUpdateTimer);  
}

void PrepareUartTxBuffer()
{
  long lBufferIndex = 0;
  
  /* fill array with static values */
  for (lBufferIndex = 0; lBufferIndex < cMaxNbrUartValues-1; lBufferIndex++)
  {
    gUartTxData[lBufferIndex] = lBufferIndex;
  } 
} 

on timer ClientTxUpdateTimer
{  
  if (gBufferIndex < cMaxNbrUartValues)
  {
    /* transfer array value to UART queue */
    gRetval1 = sensorQueueSerialFrame("SENSOR::UART::UartClient",gUartTxData[gBufferIndex]);
    
    /* update user panel */
    @sysvar::UartCommunication::ClientSignal = gUartTxData[gBufferIndex];
        
    /* check return value from CAPL function */
    if ( 0 != gRetval1)
    {
      write("sensorQueueSerialFrame --> ErrorCode = %d", gRetval1);      
    }
    gBufferIndex++;
  }
  /* no UART transmit action, just reset gBufferIndex */
  else
  {
    gBufferIndex = 0;   
  }  
}

on sysvar sysvar::UartCommunication::ClientSignalResetFlag
{
  /* check for active state of reset signal */
  if (1 == @sysvar::UartCommunication::ClientSignalResetFlag)
  {
    gBufferIndex = 0;
  }
}

