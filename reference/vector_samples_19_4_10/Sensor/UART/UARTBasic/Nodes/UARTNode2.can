/*@!Encoding:1252*/
includes
{
  
}

variables
{
  /* variables to handle the data to be sent using VT2710 UART interface 2 */
  long gNumberTxElements = 0;
  const long cTxBufferSize = 255;
  char gTxBuffer[cTxBufferSize];

  /* variables to hande the data received by VT2710 UART interface 2 */
  const long cRxBufferSize = 255;
  char gRxBuffer[cRxBufferSize]; 
  dword gRxValue;
  char gRxCharacter[4];
}

on sysvar sysvar::UserControl::TriggerCommunicationUARTNode2
{
  /* check for active transmit button from panel */
  if ( 1 == sysGetVariableInt(sysvar::UserControl::TriggerCommunicationUARTNode2) )
  {
    /* transfer string information into buffer variable */
    if ( 0 == sysGetVariableString(sysvar::UserControl::UARTNode2TxStringData, gTxBuffer,cTxBufferSize))
    {      
      /* check for minimum length of string */
      gNumberTxElements = strlen(gTxBuffer);
     
      if (1 <= gNumberTxElements)
      {
        SensorQueueSerialFrames("SENSOR::UART::Channel2_UARTNode2", gTxBuffer, gNumberTxElements);
        /* add a limiter at the end of communication */
        SensorQueueSerialFrame("SENSOR::UART::Channel2_UARTNode2", 0x0);
      }
      else
      {
        // send Null in case of empty string
        sensorQueueSerialFrame("SENSOR::UART::Channel2_UARTNode2", 0x0);      
      }
    }
    else
    {
      /* Error message in case of failure */
      write("Error --> UARTNode2 --> TriggerCommunicationUARTNode2 --> sysGetVariableString() --> no string");
    }
  }    
}

on sysvar_update sysvarMember::SENSOR::UART::Channel2_UARTNode2::Frame_Rx.Data
{ 
  sysGetVariableDWord(sysvarMember::SENSOR::UART::Channel2_UARTNode2::Frame_Rx.Data, gRxValue);
  snprintf(gRxCharacter, 4, "%c", gRxValue);

  /* check for Null limitation */
  if ( 0 != gRxValue)
  {
    strncat(gRxBuffer, gRxCharacter, 30);
  }
  else
  {
    sysSetVariableString(sysvar::UserControl::UARTNode2RxStringData, gRxBuffer);
    strncat(gRxBuffer, "", 1);    
  }
}

