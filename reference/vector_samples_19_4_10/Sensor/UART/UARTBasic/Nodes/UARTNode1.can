/*@!Encoding:1252*/
includes
{
  
}

variables
{
  /* variables to handle the data to be sent using VT2710 UART interface 1 */
  long gNumberTxElements = 0;
  const long cTxBufferSize = 255;
  char gTxBuffer[cTxBufferSize];

  /* variables to hande the data received by VT2710 UART interface 1 */
  const long cRxBufferSize = 255;
  char gRxBuffer[cRxBufferSize]; 
  dword gRxValue;
  char gRxCharacter[4];
}

on sysvar sysvar::UserControl::TriggerCommunicationUARTNode1
{
  /* check for active transmit button from panel */
  if ( 1 == sysGetVariableInt(sysvar::UserControl::TriggerCommunicationUARTNode1) )
  {
    /* transfer string information into buffer variable */
    if ( 0 == sysGetVariableString(sysvar::UserControl::UARTNode1TxStringData, gTxBuffer,cTxBufferSize))
    {      
      /* check for minimum length of string */
      gNumberTxElements = strlen(gTxBuffer);
     
      if (1 <= gNumberTxElements)
      {
        SensorQueueSerialFrames("SENSOR::UART::Channel1_UARTNode1", gTxBuffer, gNumberTxElements);
        /* add a limiter at the end of communication */
        SensorQueueSerialFrame("SENSOR::UART::Channel1_UARTNode1", 0x0);        
      }
      else
      {
        // send Null in case of empty string
        sensorQueueSerialFrame("SENSOR::UART::Channel1_UARTNode1", 0x0);      
      }
    }
    else
    {
      /* Error message in case of failure */
      write("Error --> UARTNode1 --> TriggerCommunicationUARTNode1 --> sysGetVariableString() --> no string");
    }
  }    
}

on sysvar_update sysvarMember::SENSOR::UART::Channel1_UARTNode1::Frame_Rx.Data
{
  sysGetVariableDWord(sysvarMember::SENSOR::UART::Channel1_UARTNode1::Frame_Rx.Data, gRxValue);
  snprintf(gRxCharacter, 4, "%c", gRxValue);
  
  /* check for Null limitation */
  if ( 0 != gRxValue)
  {
    strncat(gRxBuffer, gRxCharacter, 30);
  }
  else
  {
    sysSetVariableString(sysvar::UserControl::UARTNode1RxStringData, gRxBuffer);
    strncat(gRxBuffer, "", 1);    
  }
}

