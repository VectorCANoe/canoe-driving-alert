/*@!Encoding:1252*/
includes
{
  
}



variables
{
      byte transmit_buffer[255];
      byte length = 0;
      char options[10] = "0, 0";
}

on start
{
}

// encoding helper functions

long encode_header(struct DK::MessageHeaderType header)
{
  transmit_buffer[length++] = header.message_type;
  transmit_buffer[length++] = header.message_id;
  encode_uint16(header.length);
  return 1;
}

long encode_uint8(char value){
  transmit_buffer[length++] = value;
  return 1;
}

long encode_uint16(int value)
{
  transmit_buffer[length++] = value >> 8;
  transmit_buffer[length++] = value & 0x00FF;
  return 1;
}

long encode_uint32(int value){
  transmit_buffer[length++] = (value >> 24) & 0xFF;
  transmit_buffer[length++] = (value >> 16) & 0xFF;
  transmit_buffer[length++] = (value >> 8) & 0xFF;
  transmit_buffer[length++] = value & 0xFF;
  return 1; 
}

long encode_uint64(qword value){
  transmit_buffer[length++] = (value >> 56) & 0xFF;
  transmit_buffer[length++] = (value >> 48) & 0xFF;
  transmit_buffer[length++] = (value >> 40) & 0xFF;
  transmit_buffer[length++] = (value >> 32) & 0xFF;
  transmit_buffer[length++] = (value >> 24) & 0xFF;
  transmit_buffer[length++] = (value >> 16) & 0xFF;
  transmit_buffer[length++] = (value >> 8) & 0xFF;
  transmit_buffer[length++] = value & 0xFF;
  return 1; 
}

// event listeners

on value_update DK::Smartphone_Request.Capability
{
 // Datatypes wíth no fixed layout need to be serialized "manually" 
 int i;

 //length = 0;
  
 encode_header($this.message_header);
 encode_uint8(elCount($this.protocol_version));

 for(i = 0; i < elCount($this.protocol_version); i++)
 {
   encode_uint8($this.protocol_version[i].major);
   encode_uint8($this.protocol_version[i].minor);
 }

 encode_uint8(elCount($this.config_id));

  for(i = 0; i < elCount($this.config_id); i++)
 {
   encode_uint16($this.config_id[i]);
 }
 
  encode_uint8(elCount($this.pulseshape_combo));

  for(i = 0; i < elCount($this.pulseshape_combo); i++)
 {
   encode_uint8($this.pulseshape_combo[i]);
 }
 
 transmit_buffer[3] = length - 4;
 memcpy($PanelUtil::smartphonePanel.l2cap_write_data, transmit_buffer, length);
 IoTEnabler::Smartphone_L2CAP.write.CallAsync($PanelUtil::smartphonePanel.l2cap_socket, $PanelUtil::smartphonePanel.l2cap_write_data);
}



on value_update DK::Smartphone_Request.Session
{
  // Datatypes with fixed layout can be directly copyied / serialized using memcpy
   memcpy(transmit_buffer, $this);
 IoTEnabler::Smartphone_L2CAP.write.CallAsync($PanelUtil::smartphonePanel.l2cap_socket, transmit_buffer);
}

on value_update DK::Smartphone_Request.SessionSS
{
    memcpy(transmit_buffer, $this);
    IoTEnabler::Smartphone_L2CAP.write.CallAsync($PanelUtil::smartphonePanel.l2cap_socket, transmit_buffer);
}

on value_update DK::Smartphone_Request.Suspend
{
    memcpy(transmit_buffer, $this);
    IoTEnabler::Smartphone_L2CAP.write.CallAsync($PanelUtil::smartphonePanel.l2cap_socket, transmit_buffer);
}
    
on value_update DK::Smartphone_Request.Recovery
{
    memcpy(transmit_buffer, $this);
    IoTEnabler::Smartphone_L2CAP.write.CallAsync($PanelUtil::smartphonePanel.l2cap_socket, transmit_buffer);
}

on value_update DK::Smartphone_Request.CRRecovery
{
    memcpy(transmit_buffer, $this);
    IoTEnabler::Smartphone_L2CAP.write.CallAsync($PanelUtil::smartphonePanel.l2cap_socket, transmit_buffer);  
}

on value_update DK::Smartphone_Request.DKApdu
{
    memcpy(transmit_buffer, $this);
    IoTEnabler::Smartphone_L2CAP.write.CallAsync($PanelUtil::smartphonePanel.l2cap_socket, transmit_buffer);
}

on value_update DK::Smartphone_Notification.TimeSync
{
    encode_header($this.message_header);
  
    encode_uint64($this.device_event_count);
  
    encode_uint64($this.uwb_device_time);
  
    encode_uint8($this.uwb_dev_time_uncertainty);
  
    encode_uint8($this.uwb_clk_skew_meas_available);
  
    encode_uint16($this.device_max_ppm);
  
    encode_uint8($this.success);
  
    encode_uint16($this.retry_delay);
    transmit_buffer[3] = length - 4;
    IoTEnabler::Smartphone_L2CAP.write.CallAsync($PanelUtil::smartphonePanel.l2cap_socket, transmit_buffer);
}

on value_update DK::Smartphone_Request.FirstApproach
{ // sus behavior when called first at meas. start -> false values, eventually 0
    int i;   
    encode_header($this.message_header);

    encode_uint64($this.e1_payload);
  
    encode_uint64($this.iv1);
  
    encode_uint32($this.tag1);
  
    for(i = 0; i < elCount($this.e2_payload); ++i){
      encode_uint8($this.e2_payload[i]); 
    }
    
    encode_uint64($this.iv2);
    
    encode_uint32($this.tag2);
    transmit_buffer[3] = length - 4;
    IoTEnabler::Smartphone_L2CAP.write.CallAsync($PanelUtil::smartphonePanel.l2cap_socket, transmit_buffer);
}

on value_update DK::Smartphone_Request.RKEAuth
{
    int i;
    encode_header($this.message_header);
    for(i = 0; i < elCount($this.rke_challenge); ++i){
       encode_uint8($this.rke_challenge[i]);
    }
    transmit_buffer[3] = length - 4;
    IoTEnabler::Smartphone_L2CAP.write.CallAsync($PanelUtil::smartphonePanel.l2cap_socket, transmit_buffer);
}

on value_update DK::Smartphone_Request.HUP
{
    int i;  
    encode_header($this.message_header);
  
    encode_uint16($this.intent);
  
    for(i = 0; i < elCount($this.address); ++i){
      encode_uint8($this.address[i]); 
    }
    
    encode_uint16($this.capabilities);
    
    for(i = 0; i < elCount($this.PairingDataR192); ++i){
      encode_uint8($this.PairingDataR192[i]);
    }
    
    for(i = 0; i < elCount($this.PairingDataR256); ++i){
      encode_uint8($this.PairingDataR256[i]);
    }
    
    for(i = 0; i < elCount($this.PairingDataR192); ++i){
      encode_uint8($this.PairingDataC192[i]);
    }
    
    for(i = 0; i < elCount($this.PairingDataR192); ++i){
      encode_uint8($this.PairingDataC256[i]);
    }
    transmit_buffer[3] = length - 4;
    IoTEnabler::Smartphone_L2CAP.write.CallAsync($PanelUtil::smartphonePanel.l2cap_socket, transmit_buffer);
}


// ****************************
// ***** Response Section *****
// ****************************


on value_update DK::Vehicle_Response.Capability
{
  encode_header($this.message_header);
  encode_uint8($this.protocol_version.major);
  encode_uint8($this.protocol_version.minor);
  encode_uint16($this.config_id);
  encode_uint8($this.pulseshape_combo);
  transmit_buffer[3] = length - 4;
  IoTEnabler::Smartphone_L2CAP.write.CallAsync($PanelUtil::smartphonePanel.l2cap_socket, transmit_buffer);
}

on value_update DK::Vehicle_Response.Session{
  encode_header($this.message_header);
  encode_uint8($this.ran_multiplier);
  encode_uint8($this.slot_bitmask);
  encode_uint32($this.sync_ci_bitmask);
  encode_uint8($this.uwb_channel);
  encode_uint8($this.hop_conf_bitmask);
  transmit_buffer[3] = length - 4;
  IoTEnabler::Smartphone_L2CAP.write.CallAsync($PanelUtil::smartphonePanel.l2cap_socket, transmit_buffer);
}

on value_update DK::Vehicle_Response.SessionSS{
  encode_header($this.message_header);
  encode_uint32($this.sts_index0);
  encode_uint64($this.uwb_time0);
  encode_uint32($this.hop_mode_key);
  encode_uint8($this.sync_code_index);
  
  transmit_buffer[3] = length - 4;
  IoTEnabler::Smartphone_L2CAP.write.CallAsync($PanelUtil::smartphonePanel.l2cap_socket, transmit_buffer);
}

on value_update DK::Vehicle_Response.Suspend{
  encode_header($this.message_header);
  encode_uint8($this.suspend_response);
  transmit_buffer[3] = length - 4;
  IoTEnabler::Smartphone_L2CAP.write.CallAsync($PanelUtil::smartphonePanel.l2cap_socket, transmit_buffer);
}

on value_update DK::Vehicle_Response.Recovery{
  encode_header($this.message_header);
  encode_uint32($this.sts_index0);
  encode_uint64($this.uwb_time0);
  transmit_buffer[3] = length - 4;
  IoTEnabler::Smartphone_L2CAP.write.CallAsync($PanelUtil::smartphonePanel.l2cap_socket, transmit_buffer);
}

on value_update DK::Vehicle_Response.CRRecovery{
  encode_header($this.message_header);
  encode_uint8($this.ran_multiplier);
  encode_uint32($this.sts_index0);
  encode_uint64($this.uwb_time0);
  transmit_buffer[3] = length - 4;
  IoTEnabler::Smartphone_L2CAP.write.CallAsync($PanelUtil::smartphonePanel.l2cap_socket, transmit_buffer);
}

on value_update DK::Vehicle_Response.DKApdu{
  encode_header($this.message_header);
  // incomplete, variable size of ADPU response
  transmit_buffer[3] = length - 4;
  IoTEnabler::Smartphone_L2CAP.write.CallAsync($PanelUtil::smartphonePanel.l2cap_socket, transmit_buffer);
}

on value_update DK::Vehicle_Response.FirstApproach{
  int i;
  encode_header($this.message_header);
  //for(i = 0; i < 152; ++i){a
  //  encode_uint8($this.E_Payload[i]); 
  //}
  encode_uint64($this.iv);
  encode_uint32($this.tag);
  transmit_buffer[3] = length - 4;
  IoTEnabler::Smartphone_L2CAP.write.CallAsync($PanelUtil::smartphonePanel.l2cap_socket, transmit_buffer);
}

on value_update DK::Vehicle_Response.RKEAuth{
  encode_header($this.message_header);
  // very weird definition of parameters (HEX-Tag,...)
  transmit_buffer[3] = length - 4;
  IoTEnabler::Smartphone_L2CAP.write.CallAsync($PanelUtil::smartphonePanel.l2cap_socket, transmit_buffer);
}

on value_update DK::Vehicle_Notification.HUPP{
  int i;
  encode_header($this.message_header);
  /* SUSSY
  for(i = 0; i < 48; ++i){
    encode_uint8($this.BD_ADDR_headUnit[i]);
  }
  
  for(i = 0; i < 128; ++i){
    encode_uint8($this.PairingDataR192[i]); 
  }
  for(i = 0; i < 128; ++i){
    encode_uint8($this.PairingDataR256[i]); 
  }
  for(i = 0; i < 128; ++i){
    encode_uint8($this.PairingDataC192[i]); 
  }
  for(i = 0; i < 128; ++i){
    encode_uint8($this.PairingDataC256[i]); 
  }
  */
  transmit_buffer[3] = length - 4;
  IoTEnabler::Smartphone_L2CAP.write.CallAsync($PanelUtil::smartphonePanel.l2cap_socket, transmit_buffer);
}


void determineCoding(byte b[]){ 
  
  byte output[10];
  //write("input before determination: %X %X", b[0], b[1]);
  write("Response:");
  if(b[0] == 0x0){
    output[0] = 0x0;
    write("Message Type: Framework Message");
  }else if(b[0] == 0x1){
    output[0] = 0x1;
    write("Message Type: SE Message");
  }else if(b[0] == 0x2){
    output[0] = 0x2;
    write("Message Type: UWB Ranging Service Message");
  }else if(b[0] == 0x3){
    output[0] = 0x3;
    write("Message Type: DK Event Notification");
  }else if(b[0] == 0x4){
    output[0] = 0x4;
    write("Message Type: Vehicle OEM App Message");
  }else if(b[0] == 0x5){
    output[0] = 0x5;
    write("Message Type: Supplementary Service Message");
  }else if(b[0] == 0x6){
    output[0] = 0x6;
    write("Message Type: Head Unit Pairing Message");
  }else{
    output[0] = 0;
    write("Unknown Message Type");
  }
}


