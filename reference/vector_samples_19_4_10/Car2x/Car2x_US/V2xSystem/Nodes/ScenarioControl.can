/*@!Encoding:1252*/
includes
{
  #include "DrawRouteUtils.cin"
  #include "Car2xAPI.cin"
  #include "Usecases.cin"
    
  #include "..\DataSources_Templates\ASNV_Template_BaseDatatypes.cin"
  #include "..\DataSources_Templates\ASNV_Template_BasicSafetyMessage.cin"
}

variables
{
  /*
    Default names of objects in scenario files (should be the same in all files).
  */
  char egoVehicle[50] = "DuT";
  char scenarioRoute[50] = "DuT_Route";
  
  /*
    Default name of the route file and name. Values are given in the system variables.
  */
  char routeFile[255] = "";
  char loadedRoute[50] = "";
  
  char useCase[10];
}

on start
{
  // if route path is given relative, get it as absolute for Panel
  char absPath[256], relPath[256];
  sysGetVariableString(sysvar::RouteCtrl::FileName, relPath, elCount(relPath));
  getAbsFilePath(relPath, absPath, 256);
  sysSetVariableString(sysvar::RouteCtrl::FileName, absPath);
  
  loadScenario();
  C2xRegisterCallback(kRxIndication, "OnRx");
}

/********************************************************************************************************************************
****************************************************Starting Scenario************************************************************
*********************************************************************************************************************************/
void startScenarioOnRoute()
{
  int status;
  long refPointLat, refPointLng;
  // If the Scenario is running, it's stopped.
  if (C2xIsScenarioStarted())
  {
    C2xStopScenario();
    write("Scenario stopped.");
  }
  // Try to start the scenario.
  else
  {    
    // Check if scenario should be started relative
    if (@sysvar::ScenarioCtrl::StartScenarioRelative == 1)
    {
      write("Trying to start scenario relative using GNSS position.");  
      C2xResetScenario();
      status = C2xStartScenario(egoVehicle, @GNSS::Ath1.Latitude, @GNSS::Ath1.Longitude, @GNSS::Ath1.Direction);
      if (status == 1)
      {
        write("Scenario started.");
      }
      if (status == -1)
      {
        write("Error, scenario start was not successful.");
        return;
      }
      if (status == -2)
      {
        write("Error, invalid or out of range parameter specified.");
      }
      return;
    }

    write("Starting scenario on given route using GNSS position.");  
    // get the given file and route name
    sysGetVariableString(sysvar::RouteCtrl::FileName, routeFile, elCount(routeFile));
    sysGetVariableString(sysvar::RouteCtrl::RouteName, loadedRoute, elCount(loadedRoute));
    
    // try to load route from file
    if (strlen(routeFile) == 0 || strlen(loadedRoute) == 0)
    {
      write("No route given, cannot start scenario on loaded route.");
      return;
    }
    
    /****************************************************************
     *********************Step 1: Load Route*************************
     ****************************************************************/
    status = C2xLoadRoute(routeFile, loadedRoute, @sysvar::RouteCtrl::LoopFlag);
    if (status == -1)
    {
      write("Route File Path '%s' doesn't exist or file doesn't contain route by name '%s'", routeFile, loadedRoute);
      return;
    }
    if (status == -2)
    {
      write("Route with name '%s' was already loaded, using existing route.", loadedRoute);
    }
    else
    {    
      write("Route '%s' loaded from file '%s'.", loadedRoute, routeFile);
    }
  
    /****************************************************************
     ************Step 2: Set Stations on new route*******************
     ****************************************************************/
    status = C2xSetStationsOnRoute(scenarioRoute, loadedRoute);
    if (status == -1)
    {
      write("Stations couldn't be set from route '%s' to '%s', Route(s) and/or station do not exist in the loaded scenario.", scenarioRoute, loadedRoute);
	    return;
    }
  	else if (status == -2)
    {
      write("Stations couldn't be set from route '%s' to '%s', scenario is still running.", scenarioRoute, loadedRoute);
  	  return;
    }
  	else if (status == -3)
  	{
  		write("Stations couldn't be set from route '%s' to '%s', offset of the stations is larger than route length.", scenarioRoute, loadedRoute);
  		return;
  	}
    
    /****************************************************************
     ******************Step 3: Shift Stations************************
     ****************************************************************/
    status = C2xSetRouteStartPoint(loadedRoute, egoVehicle, @GNSS::Ath1.Latitude, @GNSS::Ath1.Longitude, @GNSS::Ath1.Direction);
    if (status == -1)
    {
      write("Start point of route '%s' couldn't be set, Route(s) and/or station do not exist in the loaded scenario.", loadedRoute);
	    return;
    }
	  else if (status == -2)
    {
      write("Start point of route '%s' couldn't be set, scenario is still running.", loadedRoute);
  	  return;
      }
  	else if (status == -3)
  	{
  		write("Start point of route '%s' couldn't be set. The configured position might be too far away, the heading differs too much or stations don't fit on the road.", loadedRoute);
  		return;
	  }
    
    /****************************************************************
     ******************Step 4: Start Scenario************************
     ****************************************************************/
    write("Starting scenario on route '%s' from current GNSS position.", loadedRoute);
  	C2xStartScenario();
  }
} 
/********************************************************************************************************************************
****************************************************Control Buttons and Sysvar***************************************************
*********************************************************************************************************************************/
// Called when pressing/releasing the "Start Scenario" button
// in the "Scenario Control" panel
on sysvar ScenarioCtrl::StartBtnState
{
  if (@this == 1 /*button pressed*/)
  {
    startScenarioOnRoute();
  }
}
// Called when pressing/releasing the "Stop Scenario" button
// in the "Scenario Control" panel
on sysvar ScenarioCtrl::StopBtnState
{
  if (@this == 1 /*button pressed*/)
  {
    C2xStopScenario();
  }
}

on key 's'
{
  startScenarioOnRoute();
}

// Called when pressing/releasing the "Draw Route" button
// in the "Scenario Control" panel
on sysvar RouteCtrl::DrawRouteBtnState
{
  if (@this==1)
  {
    // get the given file and route name
    sysGetVariableString(sysvar::RouteCtrl::FileName, routeFile, elCount(routeFile));
    sysGetVariableString(sysvar::RouteCtrl::RouteName, loadedRoute, elCount(loadedRoute));
    if (C2xLoadRoute(routeFile, loadedRoute, @RouteCtrl::LoopFlag) == -1)
    {
      write("Route File Path '%s' doesn't exist or file doesn't contain route by name '%s'", routeFile, loadedRoute);
      return;
    }
    DrawRouteInMapWindow(loadedRoute);
  }
}
/****************************************************************
 ********************Load Scenarios******************************
 ****************************************************************/
on sysvar ScenarioCtrl::ScenarioNumber
{
  loadScenario();
}

//Load Scenario file
void loadScenario()
{
  char folderName[500];
  char fileName[500];
  char scenarioFile[500];
  char scenarioName[1000];
  char slash = '/';
  
  // stop scenario if running
  if (C2xIsScenarioStarted() == 1)
  {
    C2xStopScenario();
  }
  
  // empty scenarioFile string
  snprintf(scenarioFile, elcount(scenarioFile), "");
    
  // get general foldername
  sysGetVariableString(sysvar::ScenarioCtrl::ScenarioFolderName, folderName, elcount(folderName));
  // get scenario file for current scenario number
  sysGetVariableDescriptionForValue(sysvar::ScenarioCtrl::ScenarioFileName, @ScenarioCtrl::ScenarioNumber, fileName, elcount(fileName));
  sysGetVariableDescriptionForValue(sysvar::ScenarioCtrl::ScenarioNumber, @ScenarioCtrl::ScenarioNumber, scenarioName, elcount(scenarioName));

  // concatenate string: <folderName>/<fileName>
  strncat(folderName, "/", elcount(folderName));
  strncat(scenarioFile, folderName, elcount(scenarioFile));
  strncat(scenarioFile, fileName, elcount(scenarioFile));
  // add .scn if not given
  if (mbstrstr(scenarioFile, ".scn") == -1)
  {
    strncat(scenarioFile, ".scn", elcount(scenarioFile)); 
  }
  
  // try to load scenario file for chosen scenario
  if(C2xLoadScenario(scenarioFile) == 1)
  {
    Write("Scenario %s loaded from file '%s'", scenarioName, scenarioFile);
  }
  else
  {
    Write("Loading scenario %s from file '%s' failed", scenarioName, scenarioFile);
  }
}


void OnRx(LONG channel, LONG dir, LONG radioChannel, LONG signalStrength, LONG sigQuality, LONG packet)
{
  struct BasicSafetyMessage bsmData;
  char   event[13];
  char   stationId[4];

  // Get the data of the BSM
  API_GetBasicSafetyMessageParams(packet, bsmData);
  memcpy(stationId, bsmData.value.basicSafetyMessage.coreData.id.string, bsmData.value.basicSafetyMessage.coreData.id.stringLength);
  // DuT_Simulator
  if (stationId[3] == 5)
  {
    return;
  }
  
  memcpy(event, bsmData.value.basicSafetyMessage.partII.arrayValue[0].partII_Value.vehicleSafetyExt.events.string, bsmData.value.basicSafetyMessage.partII.arrayValue[0].partII_Value.vehicleSafetyExt.events.stringLength);
  if (bsmData.value.basicSafetyMessage.partII.arrayValue[0].partII_Value.vehicleSafetyExt.events.isValidFlag == 1)
  {
    if (event[7] || event[11])
    {
      visualizeUsecase();
    }
  }
  else
  {
    ResetPanel();
  }
}

void OnScenarioStateChanged(long newState)
{
  if (newState == 1)
  {
    gEventReached = 0;
  }
  if (newState == 2)
  {
    ResetPanel();
  }
}