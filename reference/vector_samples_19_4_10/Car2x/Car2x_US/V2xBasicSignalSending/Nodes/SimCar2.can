/*@!Encoding:1252*/
includes
{
  #include "..\DataSources_Templates\ASNV_Template_BaseDatatypes.cin"
  #include "..\DataSources_Templates\ASNV_Template_BasicSafetyMessage.cin"
}

variables
{
  long gHeading;  // 175°, divide through 0.0125 to get the heading val
  long gLatitude;
  long gLongitude;

  // modify gSpeed to change position update time, this does not affect message send time.
  long gSpeed = 50; // milli seconds
  
  msTimer setLatTimer; // set latitude
  msTimer setLonTimer; // set longitude
  msTimer resetTimer;  // reset position
  
  struct BasicSafetyMessage gBSM;
}

/****************************************************************/
// Called on simulation start
/****************************************************************/
on start
{
  // register the pre transmit callback
  C2xRegisterCallback(1, "OnTxBSM", "BasicSafetyMessage") ;
  
  resetPosition();
  setLatTimer.setCyclic(gSpeed * 1);
  setLonTimer.setCyclic(gSpeed * 10);
  resetTimer.setCyclic(gSpeed * 338);
}

/****************************************************************/
// reset BSM position
/****************************************************************/
void resetPosition()
{
  gHeading   = 14000;
  gLatitude  = 424442610;
  gLongitude = -834387100;
  
  gBSM.value.basicSafetyMessage.coreData.heading = gHeading;
  gBSM.value.basicSafetyMessage.coreData.lat = gLatitude;
  gBSM.value.basicSafetyMessage.coreData.lon = gLongitude;
}

/****************************************************************/
// Timer to set BSM position
/****************************************************************/
on timer setLatTimer
{
  gLatitude -= 100 ;

  gBSM.value.basicSafetyMessage.coreData.lat = gLatitude;
}

on timer setLonTimer
{
  gHeading   -= 30;
  gLongitude += 80;
  
  gBSM.value.basicSafetyMessage.coreData.heading = gHeading;
  gBSM.value.basicSafetyMessage.coreData.lon = gLongitude;
}

on timer resetTimer
{
  resetPosition() ;  // Set values back, so that vehicles drive in a loop
}

void OnTxBSM(LONG packet)
{
  API_SetBasicSafetyMessageParams(packet, gBSM);
}

