/*@!Encoding:1252*/
/*
//  (c) Vector Informatik GmbH. All rights reserved.
//
//  This file contains definitions of structs and methods that may be used
//  to set and get the values of an ASN.1 defined packet's payload.
//
//  //This example demonstrates how to set a packet's payload:
//  LONG packetHandle;
//  struct TollAdvertisementMessage payload;
//  //you need to set the values of the variable "payload" yourself
//  packetHandle = API_InitTollAdvertisementMessagePacket();
//  if (packetHandle!=0) {
//    if (API_SetTollAdvertisementMessageParams(packetHandle, payload)==0) {
//      if (C2xCompletePacket(packetHandle)==0) {
//        C2xOutputPacket(packetHandle);
//      }
//    }
//  }
//                                                                             */
includes
{
  #include "ASNV_Template_BaseDatatypes.cin"  // If warning "Duplicate #include, ignoring this include" appears, please remove the ASNV_Template_BaseDatatypes.cin include from your other *.cin files in the project.
}
variables
{
    struct TollAdvertisementMessageEfcDataDictionary_PayUnit {
        INT isValidFlag;   // necessary if this struct is used as an optional field of a SEQUENCE
        CHAR string[3];
        INT  stringLength;
    };
    
    struct TollAdvertisementMessageEfcDataDictionary_PaymentFee {
        INT isValidFlag;   // necessary if this struct is used as an optional field of a SEQUENCE
        WORD paymentFeeAmount;  // INTEGER, 0..65535;
        struct TollAdvertisementMessageEfcDataDictionary_PayUnit paymentFeeUnit;  // OCTETSTRING;
    };
    
    struct TollAdvertisementMessageOperatorDefined {
        INT isValidFlag;   // necessary if this struct is used as an optional field of a SEQUENCE
        struct TollAdvertisementMessageEfcDataDictionary_PaymentFee opDefCharge1;  // SEQUENCE, OPTIONAL;
        struct TollAdvertisementMessageEfcDataDictionary_PaymentFee opDefCharge2;  // SEQUENCE, OPTIONAL;
        struct TollAdvertisementMessageEfcDataDictionary_PaymentFee opDefCharge3;  // SEQUENCE, OPTIONAL;
        struct TollAdvertisementMessageEfcDataDictionary_PaymentFee opDefCharge4;  // SEQUENCE, OPTIONAL;
        struct TollAdvertisementMessageEfcDataDictionary_PaymentFee opDefCharge5;  // SEQUENCE, OPTIONAL;
        struct TollAdvertisementMessageEfcDataDictionary_PaymentFee opDefCharge6;  // SEQUENCE, OPTIONAL;
        struct TollAdvertisementMessageEfcDataDictionary_PaymentFee opDefCharge7;  // SEQUENCE, OPTIONAL;
        struct TollAdvertisementMessageEfcDataDictionary_PaymentFee opDefCharge8;  // SEQUENCE, OPTIONAL;
        struct TollAdvertisementMessageEfcDataDictionary_PaymentFee opDefCharge9;  // SEQUENCE, OPTIONAL;
        struct TollAdvertisementMessageEfcDataDictionary_PaymentFee opDefCharge10;  // SEQUENCE, OPTIONAL;
        struct TollAdvertisementMessageEfcDataDictionary_PaymentFee opDefCharge11;  // SEQUENCE, OPTIONAL;
        struct TollAdvertisementMessageEfcDataDictionary_PaymentFee opDefCharge12;  // SEQUENCE, OPTIONAL;
        struct TollAdvertisementMessageEfcDataDictionary_PaymentFee opDefCharge13;  // SEQUENCE, OPTIONAL;
        struct TollAdvertisementMessageEfcDataDictionary_PaymentFee opDefCharge14;  // SEQUENCE, OPTIONAL;
        struct TollAdvertisementMessageEfcDataDictionary_PaymentFee opDefCharge15;  // SEQUENCE, OPTIONAL;
        struct TollAdvertisementMessageEfcDataDictionary_PaymentFee opDefCharge16;  // SEQUENCE, OPTIONAL;
    };
    
    struct TollAdvertisementMessageSpecialCharges {
        INT isValidFlag;   // necessary if this struct is used as an optional field of a SEQUENCE
        struct TollAdvertisementMessageEfcDataDictionary_PaymentFee hov2Charge;  // SEQUENCE, OPTIONAL;
        struct TollAdvertisementMessageEfcDataDictionary_PaymentFee hov3Charge;  // SEQUENCE, OPTIONAL;
        struct TollAdvertisementMessageEfcDataDictionary_PaymentFee hov4Charge;  // SEQUENCE, OPTIONAL;
        struct TollAdvertisementMessageEfcDataDictionary_PaymentFee hov5PlusCharge;  // SEQUENCE, OPTIONAL;
        struct TollAdvertisementMessageEfcDataDictionary_PaymentFee cleanAirCharge;  // SEQUENCE, OPTIONAL;
        struct TollAdvertisementMessageOperatorDefined operatorDefined;  // SEQUENCE, OPTIONAL;
        struct OPT_BYTE_ASN engineCharacteristics;  // INTEGER, OPTIONAL, 0..255, noEntry(0), noEngine(1), petrolUnleaded(2), petrolLeaded(3), diesel(4), lpg(5), battery(6), solar(7), hybrid(8), hydrogen(9), multiFuel(10), bivalentPetrolLpg(11), bivalentPetrolCng(12), combinedPetrolElectric(13), cng(14), lng(15), combinedDieselElectric(16), combinedHydrogenElectric(17), bivalentHydrogenPetrol(18), bivalentHydrogenPetrolElectricEngine(19), fuelCellHydrogen(20), fuelCellPetrol(21), fuelCellMethanol(22), fuelCellEthanol(23), fuelCellDiesel(24), combinedMultiFuelElectricEngine(25), combinedCngElectricEngine(26), combinedLngElectricEngine(27), petrolEthanol(28), combinedLpgElectricEngine(29), hybridPetrolExternalBattery(30), hybridDieselExternalBattery(31), hybridLpgExternalBattery(32), hybridHydrogenExternalBattery(33), hybridMultiFuelExternalBattery(34), hybridCngExternalBattery(35), hybridLngExternalBattery(36), hybridBivalentHydrogenPetrolExternalBattery(37), hydrogenCng(38), hydrogenLng(39), hybridHydrogenCngExternalBattery(40), hybridHydrogenLngExternalBattery(41), ethanol(42), hybridFuelCellHydrogen(43), hybridFuelCellHydrogenExternalBattery(44), dualFuelLngDiesel(45), electricExternal(46), biogas(47), bioDiesel(48), bioPetrol(49), bivalentPetrolBiogas(50), combinedBiogasElectricEngine(51), dualFuelCngDiesel(52), other(255);
    };
    
    struct TollAdvertisementMessageVehTypeCharges {
        INT isValidFlag;   // necessary if this struct is used as an optional field of a SEQUENCE
        INT vehType;  // ENUMERATED, motorcycles(1), passengerCars(2), fourTireSingleUnit(3), buses(4), twoAxleSixTireSingleUnit(5), threeAxleSingleUnit(6), fourOrMoreAxleSingleUnit(7), fourOrLessAxleSingleTrailer(8), fiveAxleTractorSemitrailer(9), sixOrMoreAxleSingleTrailer(10), fiveOrLessAxleMultiTrailer(11), sixAxleMultiTrailer(12), sevenOrMoreAxleMultiTrailer(13);
        struct TollAdvertisementMessageEfcDataDictionary_PaymentFee charges;  // SEQUENCE;
        struct TollAdvertisementMessageSpecialCharges specialCharges;  // SEQUENCE, OPTIONAL;
    };
    
    struct TollAdvertisementMessageVehTypeChargesTable {
        INT isValidFlag;   // necessary if this struct is used as an optional field of a SEQUENCE
        INT length;
        struct TollAdvertisementMessageVehTypeCharges arrayValue[13];  // SEQUENCE;
    };
    
    struct TollAdvertisementMessageAxlesCharges {
        INT isValidFlag;   // necessary if this struct is used as an optional field of a SEQUENCE
        BYTE axlesLimit;  // INTEGER, 2..10;
        struct TollAdvertisementMessageEfcDataDictionary_PaymentFee axlesCharge;  // SEQUENCE;
    };
    
    struct TollAdvertisementMessageAxlesChargesTable {
        INT isValidFlag;   // necessary if this struct is used as an optional field of a SEQUENCE
        INT length;
        struct TollAdvertisementMessageAxlesCharges arrayValue[10];  // SEQUENCE;
    };
    
    struct TollAdvertisementMessageTotalWeightCharges {
        INT isValidFlag;   // necessary if this struct is used as an optional field of a SEQUENCE
        DWORD weightLimit;  // INTEGER, 0..16777215;
        INT weightLimitUnits;  // ENUMERATED, pounds(-0), kilograms(1);
        struct TollAdvertisementMessageEfcDataDictionary_PaymentFee weightCharge;  // SEQUENCE;
    };
    
    struct TollAdvertisementMessagePerAxleWeightCharges {
        INT isValidFlag;   // necessary if this struct is used as an optional field of a SEQUENCE
        DWORD totalWeightLimit;  // INTEGER, 0..16777215;
        WORD maxLadenWeightOnAxle;  // INTEGER, 0..65535;
        INT weightLimitUnits;  // ENUMERATED, pounds(-0), kilograms(1);
        struct TollAdvertisementMessageEfcDataDictionary_PaymentFee axleWeightCharge;  // SEQUENCE;
    };
    
    struct TollAdvertisementMessageWeightCharges {
        INT isValidFlag;   // necessary if this struct is used as an optional field of a SEQUENCE
        INT choice;
        struct TollAdvertisementMessageTotalWeightCharges totalWeightCharges;  // SEQUENCE;
        struct TollAdvertisementMessagePerAxleWeightCharges perAxleWeightCharges;  // SEQUENCE;
    };
    
    struct TollAdvertisementMessageWeightChargesTable {
        INT isValidFlag;   // necessary if this struct is used as an optional field of a SEQUENCE
        INT length;
        struct TollAdvertisementMessageWeightCharges arrayValue[10];  // CHOICE;
    };
    
    struct TollAdvertisementMessageChargesTable {
        INT isValidFlag;   // necessary if this struct is used as an optional field of a SEQUENCE
        INT choice;
        struct TollAdvertisementMessageVehTypeChargesTable vehTypeBased;  // SEQUENCEOF;
        struct TollAdvertisementMessageAxlesChargesTable numAxlesBased;  // SEQUENCEOF;
        struct TollAdvertisementMessageWeightChargesTable weightBased;  // SEQUENCEOF;
    };
    
    struct TollAdvertisementMessageLaneChargesTable {
        INT isValidFlag;   // necessary if this struct is used as an optional field of a SEQUENCE
        BYTE laneId;  // INTEGER, 0..255;
        struct TollAdvertisementMessageChargesTable chargesTable;  // CHOICE;
    };
    
    struct TollAdvertisementMessageTollChargesTable_tollTypeCharge_perLaneCharges {
        INT isValidFlag;   // necessary if this struct is used as an optional field of a SEQUENCE
        INT length;
        struct TollAdvertisementMessageLaneChargesTable arrayValue[64];  // SEQUENCE;
    };
    
    struct TollAdvertisementMessageExitInfo {
        INT isValidFlag;   // necessary if this struct is used as an optional field of a SEQUENCE
        WORD exitNumber;  // INTEGER, 1..999;
        struct OPT_BYTE_ASN exitLetter;  // INTEGER, OPTIONAL, 65..90;
        struct OPT_WORD_ASN tollPointID;  // INTEGER, OPTIONAL, 1..2048;
    };
    
    struct TollAdvertisementMessageEntryChargesTable {
        INT isValidFlag;   // necessary if this struct is used as an optional field of a SEQUENCE
        struct TollAdvertisementMessageExitInfo exitInfo;  // SEQUENCE;
        struct TollAdvertisementMessageChargesTable chargesTable;  // CHOICE;
    };
    
    struct TollAdvertisementMessageExitChargesTable {
        INT isValidFlag;   // necessary if this struct is used as an optional field of a SEQUENCE
        struct OPT_WORD_ASN entryInfo;  // INTEGER, OPTIONAL, 1..2048;
        struct TollAdvertisementMessageChargesTable chargesTable;  // CHOICE;
    };
    
    struct TollAdvertisementMessageClosedNetworkChargesTable {
        INT isValidFlag;   // necessary if this struct is used as an optional field of a SEQUENCE
        INT choice;
        struct TollAdvertisementMessageEntryChargesTable entryChargesTable;  // SEQUENCE;
        struct TollAdvertisementMessageExitChargesTable exitChargesTable;  // SEQUENCE;
    };
    
    struct TollAdvertisementMessageTollChargesTable_tollTypeCharge_closedNetworkCharges {
        INT isValidFlag;   // necessary if this struct is used as an optional field of a SEQUENCE
        INT length;
        struct TollAdvertisementMessageClosedNetworkChargesTable arrayValue[64];  // CHOICE;
    };
    
    struct TollAdvertisementMessageTimeChargesTable {
        INT isValidFlag;   // necessary if this struct is used as an optional field of a SEQUENCE
        WORD maxTime;  // INTEGER, 1..1440;
        struct TollAdvertisementMessageChargesTable chargesTable;  // CHOICE;
    };
    
    struct TollAdvertisementMessageTollChargesTable_tollTypeCharge {
        INT isValidFlag;   // necessary if this struct is used as an optional field of a SEQUENCE
        INT choice;
        struct TollAdvertisementMessageChargesTable pointCharges;  // CHOICE;
        struct TollAdvertisementMessageTollChargesTable_tollTypeCharge_perLaneCharges perLaneCharges;  // SEQUENCEOF;
        struct TollAdvertisementMessageTollChargesTable_tollTypeCharge_closedNetworkCharges closedNetworkCharges;  // SEQUENCEOF;
        struct TollAdvertisementMessageTimeChargesTable timeBasedCharges;  // SEQUENCE;
    };
    
    struct TollAdvertisementMessageTollChargesTable {
        INT isValidFlag;   // necessary if this struct is used as an optional field of a SEQUENCE
        struct TollAdvertisementMessageTollChargesTable_tollTypeCharge tollTypeCharge;  // CHOICE;
    };
    
    struct TollAdvertisementMessageTollChargerInfo_tollChargerId_id {
        INT isValidFlag;   // necessary if this struct is used as an optional field of a SEQUENCE
        INT length;
        INT id;
    };
    
    struct TollAdvertisementMessageTollChargerInfo_tollChargerId {
        INT isValidFlag;   // necessary if this struct is used as an optional field of a SEQUENCE
        INT length;
        struct TollAdvertisementMessageTollChargerInfo_tollChargerId_id arrayValue[16];
    };
    
    struct TollAdvertisementMessageCommon_DescriptiveName {
        INT isValidFlag;   // necessary if this struct is used as an optional field of a SEQUENCE
        CHAR string[64];
        INT  stringLength;
    };
    
    struct TollAdvertisementMessageTollChargerInfo {
        INT isValidFlag;   // necessary if this struct is used as an optional field of a SEQUENCE
        struct TollAdvertisementMessageTollChargerInfo_tollChargerId tollChargerId;  // OBJECTIDENTIFIER;
        WORD tollPointId;  // INTEGER, 1..2048;
        struct TollAdvertisementMessageCommon_DescriptiveName descriptiveName;  // IA5STRING, OPTIONAL;
    };
    
    struct TollAdvertisementMessageCommon_DDateTime {
        INT isValidFlag;   // necessary if this struct is used as an optional field of a SEQUENCE
        struct OPT_WORD_ASN year;  // INTEGER, OPTIONAL, 0..4095;
        struct OPT_BYTE_ASN month;  // INTEGER, OPTIONAL, 0..12;
        struct OPT_BYTE_ASN day;  // INTEGER, OPTIONAL, 0..31;
        struct OPT_BYTE_ASN hour;  // INTEGER, OPTIONAL, 0..31;
        struct OPT_BYTE_ASN minute;  // INTEGER, OPTIONAL, 0..60;
        struct OPT_WORD_ASN second;  // INTEGER, OPTIONAL, 0..65535;
        struct OPT_INT_ASN offset;  // INTEGER, OPTIONAL, -840..840;
    };
    
    struct TollAdvertisementMessageTumInstructions {
        INT isValidFlag;   // necessary if this struct is used as an optional field of a SEQUENCE
        BYTE maxNumOfLocTimeStamps;  // INTEGER, 1..5;
        BYTE locTimeStampRate;  // INTEGER, 1..10;
    };
    
    struct TollAdvertisementMessageAddGrpB_LatitudeDMS2 {
        INT isValidFlag;   // necessary if this struct is used as an optional field of a SEQUENCE
        INT d;  // INTEGER, -90..90;
        BYTE m;  // INTEGER, 0..59;
        WORD s;  // INTEGER, 0..5999;
    };
    
    struct TollAdvertisementMessageAddGrpB_LongitudeDMS2 {
        INT isValidFlag;   // necessary if this struct is used as an optional field of a SEQUENCE
        INT d;  // INTEGER, -180..180;
        BYTE m;  // INTEGER, 0..59;
        WORD s;  // INTEGER, 0..5999;
    };
    
    struct TollAdvertisementMessageAddGrpB_Position3D_addGrpB {
        INT isValidFlag;   // necessary if this struct is used as an optional field of a SEQUENCE
        struct TollAdvertisementMessageAddGrpB_LatitudeDMS2 latitude;  // SEQUENCE;
        struct TollAdvertisementMessageAddGrpB_LongitudeDMS2 longitude;  // SEQUENCE;
        INT elevation;  // INTEGER, -32768..32767;
    };
    
    struct TollAdvertisementMessageAddGrpC_Altitude {
        INT isValidFlag;   // necessary if this struct is used as an optional field of a SEQUENCE
        LONG value;  // INTEGER, -100000..800001;
        INT confidence;  // ENUMERATED, alt_000_01(-0), alt_000_02(1), alt_000_05(2), alt_000_10(3), alt_000_20(4), alt_000_50(5), alt_001_00(6), alt_002_00(7), alt_005_00(8), alt_010_00(9), alt_020_00(10), alt_050_00(11), alt_100_00(12), alt_200_00(13), outOfRange(14), unavailable(15);
    };
    
    struct TollAdvertisementMessageAddGrpC_Position3D_addGrpC {
        INT isValidFlag;   // necessary if this struct is used as an optional field of a SEQUENCE
        struct TollAdvertisementMessageAddGrpC_Altitude altitude;  // SEQUENCE;
    };
    
    struct TollAdvertisementMessageCommon_RegionalExtension_Reg_Position3D_table {
        struct TollAdvertisementMessageAddGrpB_Position3D_addGrpB addGrpB;  // SEQUENCE;
        struct TollAdvertisementMessageAddGrpC_Position3D_addGrpC addGrpC;  // SEQUENCE;
    };
    
    struct TollAdvertisementMessageCommon_RegionalExtension_Reg_Position3D {
        INT isValidFlag;   // necessary if this struct is used as an optional field of a SEQUENCE
        BYTE regionId;  // INTEGER, 0..255, noRegion(0), addGrpA(1), addGrpB(2), addGrpC(3), addGrpD(4);
        struct TollAdvertisementMessageCommon_RegionalExtension_Reg_Position3D_table regExtvalue;  // TABLE;
    };
    
    struct TollAdvertisementMessageCommon_Position3D_regional {
        INT isValidFlag;   // necessary if this struct is used as an optional field of a SEQUENCE
        INT length;
        struct TollAdvertisementMessageCommon_RegionalExtension_Reg_Position3D arrayValue[4];  // SEQUENCE;
    };
    
    struct TollAdvertisementMessageCommon_Position3D {
        INT isValidFlag;   // necessary if this struct is used as an optional field of a SEQUENCE
        LONG lat;  // INTEGER, -900000000..900000001;
        LONG lon;  // INTEGER, -1799999999..1800000001;
        struct OPT_LONG_ASN elevation;  // INTEGER, OPTIONAL, -4096..61439;
        struct TollAdvertisementMessageCommon_Position3D_regional regional;  // SEQUENCEOF, OPTIONAL;
    };
    
    struct TollAdvertisementMessageCommon_RegulatorySpeedLimit {
        INT isValidFlag;   // necessary if this struct is used as an optional field of a SEQUENCE
        INT type;  // ENUMERATED, unknown(-0), maxSpeedInSchoolZone(1), maxSpeedInSchoolZoneWhenChildrenArePresent(2), maxSpeedInConstructionZone(3), vehicleMinSpeed(4), vehicleMaxSpeed(5), vehicleNightMaxSpeed(6), truckMinSpeed(7), truckMaxSpeed(8), truckNightMaxSpeed(9), vehiclesWithTrailersMinSpeed(10), vehiclesWithTrailersMaxSpeed(11), vehiclesWithTrailersNightMaxSpeed(12);
        WORD speed;  // INTEGER, 0..8191;
    };
    
    struct TollAdvertisementMessageMapData_LaneDirection {
        INT isValidFlag;   // necessary if this struct is used as an optional field of a SEQUENCE
        CHAR string[3];
        INT  stringLength;
    };
    
    struct TollAdvertisementMessageMapData_LaneSharing {
        INT isValidFlag;   // necessary if this struct is used as an optional field of a SEQUENCE
        CHAR string[11];
        INT  stringLength;
    };
    
    struct TollAdvertisementMessageMapData_LaneAttributes_Vehicle {
        INT isValidFlag;   // necessary if this struct is used as an optional field of a SEQUENCE
        CHAR string[9];
        INT  stringLength;
    };
    
    struct TollAdvertisementMessageMapData_LaneAttributes_Crosswalk {
        INT isValidFlag;   // necessary if this struct is used as an optional field of a SEQUENCE
        CHAR string[17];
        INT  stringLength;
    };
    
    struct TollAdvertisementMessageMapData_LaneAttributes_Bike {
        INT isValidFlag;   // necessary if this struct is used as an optional field of a SEQUENCE
        CHAR string[17];
        INT  stringLength;
    };
    
    struct TollAdvertisementMessageMapData_LaneAttributes_Sidewalk {
        INT isValidFlag;   // necessary if this struct is used as an optional field of a SEQUENCE
        CHAR string[17];
        INT  stringLength;
    };
    
    struct TollAdvertisementMessageMapData_LaneAttributes_Barrier {
        INT isValidFlag;   // necessary if this struct is used as an optional field of a SEQUENCE
        CHAR string[17];
        INT  stringLength;
    };
    
    struct TollAdvertisementMessageMapData_LaneAttributes_Striping {
        INT isValidFlag;   // necessary if this struct is used as an optional field of a SEQUENCE
        CHAR string[17];
        INT  stringLength;
    };
    
    struct TollAdvertisementMessageMapData_LaneAttributes_TrackedVehicle {
        INT isValidFlag;   // necessary if this struct is used as an optional field of a SEQUENCE
        CHAR string[17];
        INT  stringLength;
    };
    
    struct TollAdvertisementMessageMapData_LaneAttributes_Parking {
        INT isValidFlag;   // necessary if this struct is used as an optional field of a SEQUENCE
        CHAR string[17];
        INT  stringLength;
    };
    
    struct TollAdvertisementMessageMapData_LaneTypeAttributes {
        INT isValidFlag;   // necessary if this struct is used as an optional field of a SEQUENCE
        INT choice;
        struct TollAdvertisementMessageMapData_LaneAttributes_Vehicle vehicle;  // BITSTRING;
        struct TollAdvertisementMessageMapData_LaneAttributes_Crosswalk crosswalk;  // BITSTRING;
        struct TollAdvertisementMessageMapData_LaneAttributes_Bike bikeLane;  // BITSTRING;
        struct TollAdvertisementMessageMapData_LaneAttributes_Sidewalk sidewalk;  // BITSTRING;
        struct TollAdvertisementMessageMapData_LaneAttributes_Barrier median;  // BITSTRING;
        struct TollAdvertisementMessageMapData_LaneAttributes_Striping striping;  // BITSTRING;
        struct TollAdvertisementMessageMapData_LaneAttributes_TrackedVehicle trackedVehicle;  // BITSTRING;
        struct TollAdvertisementMessageMapData_LaneAttributes_Parking parking;  // BITSTRING;
    };
    
    struct TollAdvertisementMessageCommon_RegionalExtension_Reg_LaneAttributes_table {
    };
    
    struct TollAdvertisementMessageCommon_RegionalExtension_Reg_LaneAttributes {
        INT isValidFlag;   // necessary if this struct is used as an optional field of a SEQUENCE
        BYTE regionId;  // INTEGER, 0..255, noRegion(0), addGrpA(1), addGrpB(2), addGrpC(3), addGrpD(4);
        struct TollAdvertisementMessageCommon_RegionalExtension_Reg_LaneAttributes_table regExtvalue;  // TABLE;
    };
    
    struct TollAdvertisementMessageMapData_LaneAttributes {
        INT isValidFlag;   // necessary if this struct is used as an optional field of a SEQUENCE
        struct TollAdvertisementMessageMapData_LaneDirection directionalUse;  // BITSTRING;
        struct TollAdvertisementMessageMapData_LaneSharing sharedWith;  // BITSTRING;
        struct TollAdvertisementMessageMapData_LaneTypeAttributes laneType;  // CHOICE;
        struct TollAdvertisementMessageCommon_RegionalExtension_Reg_LaneAttributes regional;  // SEQUENCE, OPTIONAL;
    };
    
    struct TollAdvertisementMessageMapData_AllowedManeuvers {
        INT isValidFlag;   // necessary if this struct is used as an optional field of a SEQUENCE
        CHAR string[13];
        INT  stringLength;
    };
    
    struct TollAdvertisementMessageCommon_Node_XY_20b {
        INT isValidFlag;   // necessary if this struct is used as an optional field of a SEQUENCE
        INT x;  // INTEGER, -512..511;
        INT y;  // INTEGER, -512..511;
    };
    
    struct TollAdvertisementMessageCommon_Node_XY_22b {
        INT isValidFlag;   // necessary if this struct is used as an optional field of a SEQUENCE
        INT x;  // INTEGER, -1024..1023;
        INT y;  // INTEGER, -1024..1023;
    };
    
    struct TollAdvertisementMessageCommon_Node_XY_24b {
        INT isValidFlag;   // necessary if this struct is used as an optional field of a SEQUENCE
        INT x;  // INTEGER, -2048..2047;
        INT y;  // INTEGER, -2048..2047;
    };
    
    struct TollAdvertisementMessageCommon_Node_XY_26b {
        INT isValidFlag;   // necessary if this struct is used as an optional field of a SEQUENCE
        INT x;  // INTEGER, -4096..4095;
        INT y;  // INTEGER, -4096..4095;
    };
    
    struct TollAdvertisementMessageCommon_Node_XY_28b {
        INT isValidFlag;   // necessary if this struct is used as an optional field of a SEQUENCE
        INT x;  // INTEGER, -8192..8191;
        INT y;  // INTEGER, -8192..8191;
    };
    
    struct TollAdvertisementMessageCommon_Node_XY_32b {
        INT isValidFlag;   // necessary if this struct is used as an optional field of a SEQUENCE
        INT x;  // INTEGER, -32768..32767;
        INT y;  // INTEGER, -32768..32767;
    };
    
    struct TollAdvertisementMessageCommon_Node_LLmD_64b {
        INT isValidFlag;   // necessary if this struct is used as an optional field of a SEQUENCE
        LONG lon;  // INTEGER, -1799999999..1800000001;
        LONG lat;  // INTEGER, -900000000..900000001;
    };
    
    struct TollAdvertisementMessageAddGrpB_Node_LLdms_48b {
        INT isValidFlag;   // necessary if this struct is used as an optional field of a SEQUENCE
        LONG lon;  // INTEGER, -64800000..64800000;
        LONG lat;  // INTEGER, -32400000..32400000;
    };
    
    struct TollAdvertisementMessageAddGrpB_Node_LLdms_80b {
        INT isValidFlag;   // necessary if this struct is used as an optional field of a SEQUENCE
        struct TollAdvertisementMessageAddGrpB_LongitudeDMS2 lon;  // SEQUENCE;
        struct TollAdvertisementMessageAddGrpB_LatitudeDMS2 lat;  // SEQUENCE;
    };
    
    struct TollAdvertisementMessageAddGrpB_NodeOffsetPointXY_addGrpB {
        INT isValidFlag;   // necessary if this struct is used as an optional field of a SEQUENCE
        INT choice;
        struct TollAdvertisementMessageAddGrpB_Node_LLdms_48b posA;  // SEQUENCE;
        struct TollAdvertisementMessageAddGrpB_Node_LLdms_80b posB;  // SEQUENCE;
    };
    
    struct TollAdvertisementMessageCommon_RegionalExtension_Reg_NodeOffsetPointXY_table {
        struct TollAdvertisementMessageAddGrpB_NodeOffsetPointXY_addGrpB addGrpB;  // CHOICE;
    };
    
    struct TollAdvertisementMessageCommon_RegionalExtension_Reg_NodeOffsetPointXY {
        INT isValidFlag;   // necessary if this struct is used as an optional field of a SEQUENCE
        BYTE regionId;  // INTEGER, 0..255, noRegion(0), addGrpA(1), addGrpB(2), addGrpC(3), addGrpD(4);
        struct TollAdvertisementMessageCommon_RegionalExtension_Reg_NodeOffsetPointXY_table regExtvalue;  // TABLE;
    };
    
    struct TollAdvertisementMessageCommon_NodeOffsetPointXY {
        INT isValidFlag;   // necessary if this struct is used as an optional field of a SEQUENCE
        INT choice;
        struct TollAdvertisementMessageCommon_Node_XY_20b node_XY1;  // SEQUENCE;
        struct TollAdvertisementMessageCommon_Node_XY_22b node_XY2;  // SEQUENCE;
        struct TollAdvertisementMessageCommon_Node_XY_24b node_XY3;  // SEQUENCE;
        struct TollAdvertisementMessageCommon_Node_XY_26b node_XY4;  // SEQUENCE;
        struct TollAdvertisementMessageCommon_Node_XY_28b node_XY5;  // SEQUENCE;
        struct TollAdvertisementMessageCommon_Node_XY_32b node_XY6;  // SEQUENCE;
        struct TollAdvertisementMessageCommon_Node_LLmD_64b node_LatLon;  // SEQUENCE;
        struct TollAdvertisementMessageCommon_RegionalExtension_Reg_NodeOffsetPointXY regional;  // SEQUENCE;
    };
    
    struct TollAdvertisementMessageCommon_NodeAttributeXYList {
        INT isValidFlag;   // necessary if this struct is used as an optional field of a SEQUENCE
        INT length;
        INT arrayValue[8];  // ENUMERATED, reserved(-0), stopLine(1), roundedCapStyleA(2), roundedCapStyleB(3), mergePoint(4), divergePoint(5), downstreamStopLine(6), downstreamStartNode(7), closedToTraffic(8), safeIsland(9), curbPresentAtStepOff(10), hydrantPresent(11);
    };
    
    struct TollAdvertisementMessageCommon_SegmentAttributeXYList {
        INT isValidFlag;   // necessary if this struct is used as an optional field of a SEQUENCE
        INT length;
        INT arrayValue[8];  // ENUMERATED, reserved(-0), doNotBlock(1), whiteLine(2), mergingLaneLeft(3), mergingLaneRight(4), curbOnLeft(5), curbOnRight(6), loadingzoneOnLeft(7), loadingzoneOnRight(8), turnOutPointOnLeft(9), turnOutPointOnRight(10), adjacentParkingOnLeft(11), adjacentParkingOnRight(12), adjacentBikeLaneOnLeft(13), adjacentBikeLaneOnRight(14), sharedBikeLane(15), bikeBoxInFront(16), transitStopOnLeft(17), transitStopOnRight(18), transitStopInLane(19), sharedWithTrackedVehicle(20), safeIsland(21), lowCurbsPresent(22), rumbleStripPresent(23), audibleSignalingPresent(24), adaptiveTimingPresent(25), rfSignalRequestPresent(26), partialCurbIntrusion(27), taperToLeft(28), taperToRight(29), taperToCenterLine(30), parallelParking(31), headInParking(32), freeParking(33), timeRestrictionsOnParking(34), costToPark(35), midBlockCurbPresent(36), unEvenPavementPresent(37);
    };
    
    struct TollAdvertisementMessageCommon_SpeedLimitList {
        INT isValidFlag;   // necessary if this struct is used as an optional field of a SEQUENCE
        INT length;
        struct TollAdvertisementMessageCommon_RegulatorySpeedLimit arrayValue[9];  // SEQUENCE;
    };
    
    struct TollAdvertisementMessageAddGrpB_LaneDataAttribute_addGrpB {
        INT isValidFlag;   // necessary if this struct is used as an optional field of a SEQUENCE
    };
    
    struct TollAdvertisementMessageCommon_RegionalExtension_Reg_LaneDataAttribute_table {
        struct TollAdvertisementMessageAddGrpB_LaneDataAttribute_addGrpB addGrpB;  // SEQUENCE;
    };
    
    struct TollAdvertisementMessageCommon_RegionalExtension_Reg_LaneDataAttribute {
        INT isValidFlag;   // necessary if this struct is used as an optional field of a SEQUENCE
        BYTE regionId;  // INTEGER, 0..255, noRegion(0), addGrpA(1), addGrpB(2), addGrpC(3), addGrpD(4);
        struct TollAdvertisementMessageCommon_RegionalExtension_Reg_LaneDataAttribute_table regExtvalue;  // TABLE;
    };
    
    struct TollAdvertisementMessageCommon_LaneDataAttribute_regional {
        INT isValidFlag;   // necessary if this struct is used as an optional field of a SEQUENCE
        INT length;
        struct TollAdvertisementMessageCommon_RegionalExtension_Reg_LaneDataAttribute arrayValue[4];  // SEQUENCE;
    };
    
    struct TollAdvertisementMessageCommon_LaneDataAttribute {
        INT isValidFlag;   // necessary if this struct is used as an optional field of a SEQUENCE
        INT choice;
        INT pathEndPointAngle;  // INTEGER, -150..150;
        INT laneCrownPointCenter;  // INTEGER, -128..127;
        INT laneCrownPointLeft;  // INTEGER, -128..127;
        INT laneCrownPointRight;  // INTEGER, -128..127;
        INT laneAngle;  // INTEGER, -180..180;
        struct TollAdvertisementMessageCommon_SpeedLimitList speedLimits;  // SEQUENCEOF;
        struct TollAdvertisementMessageCommon_LaneDataAttribute_regional regional;  // SEQUENCEOF;
    };
    
    struct TollAdvertisementMessageCommon_LaneDataAttributeList {
        INT isValidFlag;   // necessary if this struct is used as an optional field of a SEQUENCE
        INT length;
        struct TollAdvertisementMessageCommon_LaneDataAttribute arrayValue[8];  // CHOICE;
    };
    
    struct TollAdvertisementMessageCommon_RegionalExtension_Reg_NodeAttributeSetXY_table {
    };
    
    struct TollAdvertisementMessageCommon_RegionalExtension_Reg_NodeAttributeSetXY {
        INT isValidFlag;   // necessary if this struct is used as an optional field of a SEQUENCE
        BYTE regionId;  // INTEGER, 0..255, noRegion(0), addGrpA(1), addGrpB(2), addGrpC(3), addGrpD(4);
        struct TollAdvertisementMessageCommon_RegionalExtension_Reg_NodeAttributeSetXY_table regExtvalue;  // TABLE;
    };
    
    struct TollAdvertisementMessageCommon_NodeAttributeSetXY_regional {
        INT isValidFlag;   // necessary if this struct is used as an optional field of a SEQUENCE
        INT length;
        struct TollAdvertisementMessageCommon_RegionalExtension_Reg_NodeAttributeSetXY arrayValue[4];  // SEQUENCE;
    };
    
    struct TollAdvertisementMessageCommon_NodeAttributeSetXY {
        INT isValidFlag;   // necessary if this struct is used as an optional field of a SEQUENCE
        struct TollAdvertisementMessageCommon_NodeAttributeXYList localNode;  // SEQUENCEOF, OPTIONAL;
        struct TollAdvertisementMessageCommon_SegmentAttributeXYList disabled;  // SEQUENCEOF, OPTIONAL;
        struct TollAdvertisementMessageCommon_SegmentAttributeXYList enabled;  // SEQUENCEOF, OPTIONAL;
        struct TollAdvertisementMessageCommon_LaneDataAttributeList data;  // SEQUENCEOF, OPTIONAL;
        struct OPT_INT_ASN dWidth;  // INTEGER, OPTIONAL, -512..511;
        struct OPT_INT_ASN dElevation;  // INTEGER, OPTIONAL, -512..511;
        struct TollAdvertisementMessageCommon_NodeAttributeSetXY_regional regional;  // SEQUENCEOF, OPTIONAL;
    };
    
    struct TollAdvertisementMessageCommon_NodeXY {
        INT isValidFlag;   // necessary if this struct is used as an optional field of a SEQUENCE
        struct TollAdvertisementMessageCommon_NodeOffsetPointXY delta;  // CHOICE;
        struct TollAdvertisementMessageCommon_NodeAttributeSetXY attributes;  // SEQUENCE, OPTIONAL;
    };
    
    struct TollAdvertisementMessageCommon_NodeSetXY {
        INT isValidFlag;   // necessary if this struct is used as an optional field of a SEQUENCE
        INT length;
        struct TollAdvertisementMessageCommon_NodeXY arrayValue[63];  // SEQUENCE;
    };
    
    struct TollAdvertisementMessageCommon_ComputedLane_offsetXaxis {
        INT isValidFlag;   // necessary if this struct is used as an optional field of a SEQUENCE
        INT choice;
        INT small;  // INTEGER, -2047..2047;
        INT large;  // INTEGER, -32767..32767;
    };
    
    struct TollAdvertisementMessageCommon_ComputedLane_offsetYaxis {
        INT isValidFlag;   // necessary if this struct is used as an optional field of a SEQUENCE
        INT choice;
        INT small;  // INTEGER, -2047..2047;
        INT large;  // INTEGER, -32767..32767;
    };
    
    struct TollAdvertisementMessageCommon_RegionalExtension_Reg_ComputedLane_table {
    };
    
    struct TollAdvertisementMessageCommon_RegionalExtension_Reg_ComputedLane {
        INT isValidFlag;   // necessary if this struct is used as an optional field of a SEQUENCE
        BYTE regionId;  // INTEGER, 0..255, noRegion(0), addGrpA(1), addGrpB(2), addGrpC(3), addGrpD(4);
        struct TollAdvertisementMessageCommon_RegionalExtension_Reg_ComputedLane_table regExtvalue;  // TABLE;
    };
    
    struct TollAdvertisementMessageCommon_ComputedLane_regional {
        INT isValidFlag;   // necessary if this struct is used as an optional field of a SEQUENCE
        INT length;
        struct TollAdvertisementMessageCommon_RegionalExtension_Reg_ComputedLane arrayValue[4];  // SEQUENCE;
    };
    
    struct TollAdvertisementMessageCommon_ComputedLane {
        INT isValidFlag;   // necessary if this struct is used as an optional field of a SEQUENCE
        BYTE referenceLaneId;  // INTEGER, 0..255;
        struct TollAdvertisementMessageCommon_ComputedLane_offsetXaxis offsetXaxis;  // CHOICE;
        struct TollAdvertisementMessageCommon_ComputedLane_offsetYaxis offsetYaxis;  // CHOICE;
        struct OPT_WORD_ASN rotateXY;  // INTEGER, OPTIONAL, 0..28800;
        struct OPT_INT_ASN scaleXaxis;  // INTEGER, OPTIONAL, -2048..2047;
        struct OPT_INT_ASN scaleYaxis;  // INTEGER, OPTIONAL, -2048..2047;
        struct TollAdvertisementMessageCommon_ComputedLane_regional regional;  // SEQUENCEOF, OPTIONAL;
    };
    
    struct TollAdvertisementMessageCommon_NodeListXY {
        INT isValidFlag;   // necessary if this struct is used as an optional field of a SEQUENCE
        INT choice;
        struct TollAdvertisementMessageCommon_NodeSetXY nodes;  // SEQUENCEOF;
        struct TollAdvertisementMessageCommon_ComputedLane computed;  // SEQUENCE;
    };
    
    struct TollAdvertisementMessageMapData_ConnectingLane {
        INT isValidFlag;   // necessary if this struct is used as an optional field of a SEQUENCE
        BYTE lane;  // INTEGER, 0..255;
        struct TollAdvertisementMessageMapData_AllowedManeuvers maneuver;  // BITSTRING, OPTIONAL;
    };
    
    struct TollAdvertisementMessageCommon_IntersectionReferenceID {
        INT isValidFlag;   // necessary if this struct is used as an optional field of a SEQUENCE
        struct OPT_WORD_ASN region;  // INTEGER, OPTIONAL, 0..65535;
        WORD id;  // INTEGER, 0..65535;
    };
    
    struct TollAdvertisementMessageMapData_Connection {
        INT isValidFlag;   // necessary if this struct is used as an optional field of a SEQUENCE
        struct TollAdvertisementMessageMapData_ConnectingLane connectingLane;  // SEQUENCE;
        struct TollAdvertisementMessageCommon_IntersectionReferenceID remoteIntersection;  // SEQUENCE, OPTIONAL;
        struct OPT_BYTE_ASN signalGroup;  // INTEGER, OPTIONAL, 0..255;
        struct OPT_BYTE_ASN userClass;  // INTEGER, OPTIONAL, 0..255;
        struct OPT_BYTE_ASN connectionID;  // INTEGER, OPTIONAL, 0..255;
    };
    
    struct TollAdvertisementMessageMapData_ConnectsToList {
        INT isValidFlag;   // necessary if this struct is used as an optional field of a SEQUENCE
        INT length;
        struct TollAdvertisementMessageMapData_Connection arrayValue[16];  // SEQUENCE;
    };
    
    struct TollAdvertisementMessageMapData_OverlayLaneList {
        INT isValidFlag;   // necessary if this struct is used as an optional field of a SEQUENCE
        INT length;
        BYTE arrayValue[5];  // INTEGER, 0..255;
    };
    
    struct TollAdvertisementMessageCommon_RegionalExtension_Reg_GenericLane_table {
    };
    
    struct TollAdvertisementMessageCommon_RegionalExtension_Reg_GenericLane {
        INT isValidFlag;   // necessary if this struct is used as an optional field of a SEQUENCE
        BYTE regionId;  // INTEGER, 0..255, noRegion(0), addGrpA(1), addGrpB(2), addGrpC(3), addGrpD(4);
        struct TollAdvertisementMessageCommon_RegionalExtension_Reg_GenericLane_table regExtvalue;  // TABLE;
    };
    
    struct TollAdvertisementMessageMapData_GenericLane_regional {
        INT isValidFlag;   // necessary if this struct is used as an optional field of a SEQUENCE
        INT length;
        struct TollAdvertisementMessageCommon_RegionalExtension_Reg_GenericLane arrayValue[4];  // SEQUENCE;
    };
    
    struct TollAdvertisementMessageMapData_GenericLane {
        INT isValidFlag;   // necessary if this struct is used as an optional field of a SEQUENCE
        BYTE laneID;  // INTEGER, 0..255;
        struct TollAdvertisementMessageCommon_DescriptiveName name;  // IA5STRING, OPTIONAL;
        struct OPT_BYTE_ASN ingressApproach;  // INTEGER, OPTIONAL, 0..15;
        struct OPT_BYTE_ASN egressApproach;  // INTEGER, OPTIONAL, 0..15;
        struct TollAdvertisementMessageMapData_LaneAttributes laneAttributes;  // SEQUENCE;
        struct TollAdvertisementMessageMapData_AllowedManeuvers maneuvers;  // BITSTRING, OPTIONAL;
        struct TollAdvertisementMessageCommon_NodeListXY nodeList;  // CHOICE;
        struct TollAdvertisementMessageMapData_ConnectsToList connectsTo;  // SEQUENCEOF, OPTIONAL;
        struct TollAdvertisementMessageMapData_OverlayLaneList overlays;  // SEQUENCEOF, OPTIONAL;
        struct TollAdvertisementMessageMapData_GenericLane_regional regional;  // SEQUENCEOF, OPTIONAL;
    };
    
    struct TollAdvertisementMessageTollPointMap_approachLanesMap {
        INT isValidFlag;   // necessary if this struct is used as an optional field of a SEQUENCE
        INT length;
        struct TollAdvertisementMessageMapData_GenericLane arrayValue[64];  // SEQUENCE;
    };
    
    struct TollAdvertisementMessageTollPointMap_tollZoneLanesMap {
        INT isValidFlag;   // necessary if this struct is used as an optional field of a SEQUENCE
        INT length;
        struct TollAdvertisementMessageMapData_GenericLane arrayValue[64];  // SEQUENCE;
    };
    
    struct TollAdvertisementMessageTollPointMap {
        INT isValidFlag;   // necessary if this struct is used as an optional field of a SEQUENCE
        BYTE revisionNum;  // INTEGER, 1..10;
        struct TollAdvertisementMessageCommon_Position3D referencePoint;  // SEQUENCE;
        struct TollAdvertisementMessageCommon_RegulatorySpeedLimit speedLimit;  // SEQUENCE;
        WORD laneWidth;  // INTEGER, 0..32767;
        struct TollAdvertisementMessageTollPointMap_approachLanesMap approachLanesMap;  // SEQUENCEOF;
        struct TollAdvertisementMessageTollPointMap_tollZoneLanesMap tollZoneLanesMap;  // SEQUENCEOF;
    };
    
    struct TollAdvertisementMessageTollAdvertisementInfo_tumPublicKey {
        INT isValidFlag;   // necessary if this struct is used as an optional field of a SEQUENCE
        CHAR string[33];
        INT  stringLength;
    };
    
    struct TollAdvertisementMessageAckPolicy {
        INT isValidFlag;   // necessary if this struct is used as an optional field of a SEQUENCE
        WORD timeout;  // INTEGER, 100..10000;
        BYTE numOfRetries;  // INTEGER, 1..5;
    };
    
    struct TollAdvertisementMessageTollAdvertisementInfo {
        INT isValidFlag;   // necessary if this struct is used as an optional field of a SEQUENCE
        BYTE tamSequenceNum;  // INTEGER, 0..127;
        BYTE totalTams;  // INTEGER, 1..10;
        BYTE tamNum;  // INTEGER, 1..10;
        struct TollAdvertisementMessageTollChargerInfo tollChargerInfo;  // SEQUENCE;
        struct TollAdvertisementMessageCommon_DDateTime timestamp;  // SEQUENCE;
        struct TollAdvertisementMessageTumInstructions tumInstructions;  // SEQUENCE, OPTIONAL;
        struct TollAdvertisementMessageTollPointMap tollPointMap;  // SEQUENCE;
        struct TollAdvertisementMessageTollAdvertisementInfo_tumPublicKey tumPublicKey;  // OCTETSTRING;
        struct TollAdvertisementMessageAckPolicy ackPolicy;  // SEQUENCE;
        struct OPT_BOOL_ASN lastTollPtDataReq;  // BOOLEAN, OPTIONAL;
    };
    
    struct TollAdvertisementMessage_TollAdvertisementMessage {
        INT isValidFlag;   // necessary if this struct is used as an optional field of a SEQUENCE
        struct TollAdvertisementMessageTollChargesTable tollChargesTable;  // SEQUENCE;
        struct TollAdvertisementMessageTollAdvertisementInfo tollAdvInfo;  // SEQUENCE, OPTIONAL;
    };
    
    struct TollAdvertisementMessageMESSAGE_ID_AND_TYPE {
        struct TollAdvertisementMessage_TollAdvertisementMessage tollAdvertisementMessage;  // SEQUENCE;
    };
    
    struct TollAdvertisementMessage {
        INT isValidFlag;   // necessary if this struct is used as an optional field of a SEQUENCE
        WORD messageId;  // INTEGER, 0..32767, mapData(18), signalPhaseAndTimingMessage(19), basicSafetyMessage(20), commonSafetyRequest(21), emergencyVehicleAlert(22), intersectionCollision(23), nmeaCorrections(24), probeDataManagement(25), probeVehicleData(26), roadSideAlert(27), rtcmCorrections(28), signalRequestMessage(29), signalStatusMessage(30), travelerInformation(31), personalSafetyMessage(32), roadSafetyMessage(33), roadWeatherMessage(34), probeDataConfigMessage(35), probeDataReportMessage(36), tollAdvertisementMessage(37), tollUsageMessage(38), tollUsageAckMessage(39), cooperativeControlMessage(40), sensorDataSharingMessage(41), maneuverSharingAndCoordinatingMessage(42), roadGeometryAndAttributes(43), personalSafetyMessage2(44), trafficSignalPhaseAndTiming(45), signalControlAndPrioritizationRequest(46), signalControlAndPrioritizationStatus(47), roadUserChargingConfigMessage(48), roadUserChargingReportMessage(49), trafficLightStatusMessage(50);
        struct TollAdvertisementMessageMESSAGE_ID_AND_TYPE value;  // TABLE;
    };
    
}

/*
// init function to create a simple packet handle
*/ 
LONG API_InitTollAdvertisementMessagePacket()
{
  return C2xInitPacket("TollAdvertisementMessage"); 
}

/*
// init function to create a simple packet handle and
// initialize the struct with valid data
*/ 
LONG API_InitTollAdvertisementMessagePacket(struct TollAdvertisementMessage msgStruct)
{
  long pktHandle;

  pktHandle = API_InitTollAdvertisementMessagePacket();

  if (pktHandle != 0)
  {
    // create valid message and application data
    if (C2xCompletePacket(pktHandle) == 0) 
    {
      API_GetTollAdvertisementMessageParams(pktHandle, msgStruct);
    }
  }
  return pktHandle;
}

/*
// init function to create a packet with security layer and
// initialize the struct with valid data
*/ 
LONG API_InitTollAdvertisementMessagePacket(struct TollAdvertisementMessage msgStruct, char packetTypeDesignator[], char certificateName[])
{
  long pktHandle, certHdl;

  // initialize the packet
  pktHandle = C2xInitPacket("TollAdvertisementMessage", packetTypeDesignator);

  if (pktHandle != 0)
  {
    certHdl = C2xSecCertificateGetHandle(certificateName);  // get the certificate handle for the cert with name "certificateName"
    if (certHdl != 0) 
    {
      C2xSecPacketSetSignerHandle(pktHandle, certHdl); // set the certHdl to the packet
    }

    // create valid message and application data
    if (C2xCompletePacket(pktHandle) == 0) 
    {
      // copy application data to the application structure
      API_GetTollAdvertisementMessageParams(pktHandle, msgStruct);
    }
  }
  return pktHandle;
}
    

int GetTollAdvertisementMessageEfcDataDictionary_PaymentFeeParams(LONG packetHandle, struct TollAdvertisementMessageEfcDataDictionary_PaymentFee value, char oldPath[])
{
  char newPath[300];
  int result;

  result = 0;

  snprintf(newPath, elcount(newPath), "%s.%s", oldPath, "paymentFeeAmount");
  value.paymentFeeAmount = C2xGetTokenInt(packetHandle, "TollAdvertisementMessage", newPath);
  result = CheckLastError("TollAdvertisementMessage", gkFuncRefGet, result);

  snprintf(newPath, elcount(newPath), "%s.%s", oldPath, "paymentFeeUnit");
  value.paymentFeeUnit.stringLength = C2xGetTokenData(packetHandle, "TollAdvertisementMessage", newPath, elcount(value.paymentFeeUnit.string), value.paymentFeeUnit.string);
  return result;
}

int SetTollAdvertisementMessageEfcDataDictionary_PaymentFeeParams(LONG packetHandle, struct TollAdvertisementMessageEfcDataDictionary_PaymentFee value, char oldPath[])
{
  char newPath[300];
  int result;

  result = 0;

  snprintf(newPath, elcount(newPath), "%s.%s", oldPath, "paymentFeeAmount");
  C2xSetTokenInt(packetHandle, "TollAdvertisementMessage", newPath, value.paymentFeeAmount);
  result = CheckLastError("TollAdvertisementMessage", gkFuncRefGet, result);

  snprintf(newPath, elcount(newPath), "%s.%s", oldPath, "paymentFeeUnit");
  C2xSetTokenData(packetHandle, "TollAdvertisementMessage", newPath, value.paymentFeeUnit.stringLength, value.paymentFeeUnit.string);

  return result;
}

int GetTollAdvertisementMessageOperatorDefinedParams(LONG packetHandle, struct TollAdvertisementMessageOperatorDefined value, char oldPath[])
{
  char newPath[300];
  int result;

  result = 0;

  snprintf(newPath, elcount(newPath), "%s.%s", oldPath, "opDefCharge1");
  value.opDefCharge1.isValidFlag = C2xIsTokenAvailable(packetHandle, "TollAdvertisementMessage", newPath);
  if(value.opDefCharge1.isValidFlag==1)
  {
    GetTollAdvertisementMessageEfcDataDictionary_PaymentFeeParams(packetHandle, value.opDefCharge1, newPath);
    result = CheckLastError("TollAdvertisementMessage", gkFuncRefGet, result);
  }
  snprintf(newPath, elcount(newPath), "%s.%s", oldPath, "opDefCharge2");
  value.opDefCharge2.isValidFlag = C2xIsTokenAvailable(packetHandle, "TollAdvertisementMessage", newPath);
  if(value.opDefCharge2.isValidFlag==1)
  {
    GetTollAdvertisementMessageEfcDataDictionary_PaymentFeeParams(packetHandle, value.opDefCharge2, newPath);
    result = CheckLastError("TollAdvertisementMessage", gkFuncRefGet, result);
  }
  snprintf(newPath, elcount(newPath), "%s.%s", oldPath, "opDefCharge3");
  value.opDefCharge3.isValidFlag = C2xIsTokenAvailable(packetHandle, "TollAdvertisementMessage", newPath);
  if(value.opDefCharge3.isValidFlag==1)
  {
    GetTollAdvertisementMessageEfcDataDictionary_PaymentFeeParams(packetHandle, value.opDefCharge3, newPath);
    result = CheckLastError("TollAdvertisementMessage", gkFuncRefGet, result);
  }
  snprintf(newPath, elcount(newPath), "%s.%s", oldPath, "opDefCharge4");
  value.opDefCharge4.isValidFlag = C2xIsTokenAvailable(packetHandle, "TollAdvertisementMessage", newPath);
  if(value.opDefCharge4.isValidFlag==1)
  {
    GetTollAdvertisementMessageEfcDataDictionary_PaymentFeeParams(packetHandle, value.opDefCharge4, newPath);
    result = CheckLastError("TollAdvertisementMessage", gkFuncRefGet, result);
  }
  snprintf(newPath, elcount(newPath), "%s.%s", oldPath, "opDefCharge5");
  value.opDefCharge5.isValidFlag = C2xIsTokenAvailable(packetHandle, "TollAdvertisementMessage", newPath);
  if(value.opDefCharge5.isValidFlag==1)
  {
    GetTollAdvertisementMessageEfcDataDictionary_PaymentFeeParams(packetHandle, value.opDefCharge5, newPath);
    result = CheckLastError("TollAdvertisementMessage", gkFuncRefGet, result);
  }
  snprintf(newPath, elcount(newPath), "%s.%s", oldPath, "opDefCharge6");
  value.opDefCharge6.isValidFlag = C2xIsTokenAvailable(packetHandle, "TollAdvertisementMessage", newPath);
  if(value.opDefCharge6.isValidFlag==1)
  {
    GetTollAdvertisementMessageEfcDataDictionary_PaymentFeeParams(packetHandle, value.opDefCharge6, newPath);
    result = CheckLastError("TollAdvertisementMessage", gkFuncRefGet, result);
  }
  snprintf(newPath, elcount(newPath), "%s.%s", oldPath, "opDefCharge7");
  value.opDefCharge7.isValidFlag = C2xIsTokenAvailable(packetHandle, "TollAdvertisementMessage", newPath);
  if(value.opDefCharge7.isValidFlag==1)
  {
    GetTollAdvertisementMessageEfcDataDictionary_PaymentFeeParams(packetHandle, value.opDefCharge7, newPath);
    result = CheckLastError("TollAdvertisementMessage", gkFuncRefGet, result);
  }
  snprintf(newPath, elcount(newPath), "%s.%s", oldPath, "opDefCharge8");
  value.opDefCharge8.isValidFlag = C2xIsTokenAvailable(packetHandle, "TollAdvertisementMessage", newPath);
  if(value.opDefCharge8.isValidFlag==1)
  {
    GetTollAdvertisementMessageEfcDataDictionary_PaymentFeeParams(packetHandle, value.opDefCharge8, newPath);
    result = CheckLastError("TollAdvertisementMessage", gkFuncRefGet, result);
  }
  snprintf(newPath, elcount(newPath), "%s.%s", oldPath, "opDefCharge9");
  value.opDefCharge9.isValidFlag = C2xIsTokenAvailable(packetHandle, "TollAdvertisementMessage", newPath);
  if(value.opDefCharge9.isValidFlag==1)
  {
    GetTollAdvertisementMessageEfcDataDictionary_PaymentFeeParams(packetHandle, value.opDefCharge9, newPath);
    result = CheckLastError("TollAdvertisementMessage", gkFuncRefGet, result);
  }
  snprintf(newPath, elcount(newPath), "%s.%s", oldPath, "opDefCharge10");
  value.opDefCharge10.isValidFlag = C2xIsTokenAvailable(packetHandle, "TollAdvertisementMessage", newPath);
  if(value.opDefCharge10.isValidFlag==1)
  {
    GetTollAdvertisementMessageEfcDataDictionary_PaymentFeeParams(packetHandle, value.opDefCharge10, newPath);
    result = CheckLastError("TollAdvertisementMessage", gkFuncRefGet, result);
  }
  snprintf(newPath, elcount(newPath), "%s.%s", oldPath, "opDefCharge11");
  value.opDefCharge11.isValidFlag = C2xIsTokenAvailable(packetHandle, "TollAdvertisementMessage", newPath);
  if(value.opDefCharge11.isValidFlag==1)
  {
    GetTollAdvertisementMessageEfcDataDictionary_PaymentFeeParams(packetHandle, value.opDefCharge11, newPath);
    result = CheckLastError("TollAdvertisementMessage", gkFuncRefGet, result);
  }
  snprintf(newPath, elcount(newPath), "%s.%s", oldPath, "opDefCharge12");
  value.opDefCharge12.isValidFlag = C2xIsTokenAvailable(packetHandle, "TollAdvertisementMessage", newPath);
  if(value.opDefCharge12.isValidFlag==1)
  {
    GetTollAdvertisementMessageEfcDataDictionary_PaymentFeeParams(packetHandle, value.opDefCharge12, newPath);
    result = CheckLastError("TollAdvertisementMessage", gkFuncRefGet, result);
  }
  snprintf(newPath, elcount(newPath), "%s.%s", oldPath, "opDefCharge13");
  value.opDefCharge13.isValidFlag = C2xIsTokenAvailable(packetHandle, "TollAdvertisementMessage", newPath);
  if(value.opDefCharge13.isValidFlag==1)
  {
    GetTollAdvertisementMessageEfcDataDictionary_PaymentFeeParams(packetHandle, value.opDefCharge13, newPath);
    result = CheckLastError("TollAdvertisementMessage", gkFuncRefGet, result);
  }
  snprintf(newPath, elcount(newPath), "%s.%s", oldPath, "opDefCharge14");
  value.opDefCharge14.isValidFlag = C2xIsTokenAvailable(packetHandle, "TollAdvertisementMessage", newPath);
  if(value.opDefCharge14.isValidFlag==1)
  {
    GetTollAdvertisementMessageEfcDataDictionary_PaymentFeeParams(packetHandle, value.opDefCharge14, newPath);
    result = CheckLastError("TollAdvertisementMessage", gkFuncRefGet, result);
  }
  snprintf(newPath, elcount(newPath), "%s.%s", oldPath, "opDefCharge15");
  value.opDefCharge15.isValidFlag = C2xIsTokenAvailable(packetHandle, "TollAdvertisementMessage", newPath);
  if(value.opDefCharge15.isValidFlag==1)
  {
    GetTollAdvertisementMessageEfcDataDictionary_PaymentFeeParams(packetHandle, value.opDefCharge15, newPath);
    result = CheckLastError("TollAdvertisementMessage", gkFuncRefGet, result);
  }
  snprintf(newPath, elcount(newPath), "%s.%s", oldPath, "opDefCharge16");
  value.opDefCharge16.isValidFlag = C2xIsTokenAvailable(packetHandle, "TollAdvertisementMessage", newPath);
  if(value.opDefCharge16.isValidFlag==1)
  {
    GetTollAdvertisementMessageEfcDataDictionary_PaymentFeeParams(packetHandle, value.opDefCharge16, newPath);
    result = CheckLastError("TollAdvertisementMessage", gkFuncRefGet, result);
  }
  return result;
}

int SetTollAdvertisementMessageOperatorDefinedParams(LONG packetHandle, struct TollAdvertisementMessageOperatorDefined value, char oldPath[])
{
  char newPath[300];
  int result;

  result = 0;

  snprintf(newPath, elcount(newPath), "%s.%s", oldPath, "opDefCharge1");
  if(value.opDefCharge1.isValidFlag==1)
  {
    SetTollAdvertisementMessageEfcDataDictionary_PaymentFeeParams(packetHandle, value.opDefCharge1, newPath);
    result = CheckLastError("TollAdvertisementMessage", gkFuncRefGet, result);
  }
  else
  {
    if( C2xIsTokenAvailable(packetHandle, "TollAdvertisementMessage", newPath) )
    {
      C2xRemoveToken(packetHandle, "TollAdvertisementMessage", newPath);
    }
  }

  snprintf(newPath, elcount(newPath), "%s.%s", oldPath, "opDefCharge2");
  if(value.opDefCharge2.isValidFlag==1)
  {
    SetTollAdvertisementMessageEfcDataDictionary_PaymentFeeParams(packetHandle, value.opDefCharge2, newPath);
    result = CheckLastError("TollAdvertisementMessage", gkFuncRefGet, result);
  }
  else
  {
    if( C2xIsTokenAvailable(packetHandle, "TollAdvertisementMessage", newPath) )
    {
      C2xRemoveToken(packetHandle, "TollAdvertisementMessage", newPath);
    }
  }

  snprintf(newPath, elcount(newPath), "%s.%s", oldPath, "opDefCharge3");
  if(value.opDefCharge3.isValidFlag==1)
  {
    SetTollAdvertisementMessageEfcDataDictionary_PaymentFeeParams(packetHandle, value.opDefCharge3, newPath);
    result = CheckLastError("TollAdvertisementMessage", gkFuncRefGet, result);
  }
  else
  {
    if( C2xIsTokenAvailable(packetHandle, "TollAdvertisementMessage", newPath) )
    {
      C2xRemoveToken(packetHandle, "TollAdvertisementMessage", newPath);
    }
  }

  snprintf(newPath, elcount(newPath), "%s.%s", oldPath, "opDefCharge4");
  if(value.opDefCharge4.isValidFlag==1)
  {
    SetTollAdvertisementMessageEfcDataDictionary_PaymentFeeParams(packetHandle, value.opDefCharge4, newPath);
    result = CheckLastError("TollAdvertisementMessage", gkFuncRefGet, result);
  }
  else
  {
    if( C2xIsTokenAvailable(packetHandle, "TollAdvertisementMessage", newPath) )
    {
      C2xRemoveToken(packetHandle, "TollAdvertisementMessage", newPath);
    }
  }

  snprintf(newPath, elcount(newPath), "%s.%s", oldPath, "opDefCharge5");
  if(value.opDefCharge5.isValidFlag==1)
  {
    SetTollAdvertisementMessageEfcDataDictionary_PaymentFeeParams(packetHandle, value.opDefCharge5, newPath);
    result = CheckLastError("TollAdvertisementMessage", gkFuncRefGet, result);
  }
  else
  {
    if( C2xIsTokenAvailable(packetHandle, "TollAdvertisementMessage", newPath) )
    {
      C2xRemoveToken(packetHandle, "TollAdvertisementMessage", newPath);
    }
  }

  snprintf(newPath, elcount(newPath), "%s.%s", oldPath, "opDefCharge6");
  if(value.opDefCharge6.isValidFlag==1)
  {
    SetTollAdvertisementMessageEfcDataDictionary_PaymentFeeParams(packetHandle, value.opDefCharge6, newPath);
    result = CheckLastError("TollAdvertisementMessage", gkFuncRefGet, result);
  }
  else
  {
    if( C2xIsTokenAvailable(packetHandle, "TollAdvertisementMessage", newPath) )
    {
      C2xRemoveToken(packetHandle, "TollAdvertisementMessage", newPath);
    }
  }

  snprintf(newPath, elcount(newPath), "%s.%s", oldPath, "opDefCharge7");
  if(value.opDefCharge7.isValidFlag==1)
  {
    SetTollAdvertisementMessageEfcDataDictionary_PaymentFeeParams(packetHandle, value.opDefCharge7, newPath);
    result = CheckLastError("TollAdvertisementMessage", gkFuncRefGet, result);
  }
  else
  {
    if( C2xIsTokenAvailable(packetHandle, "TollAdvertisementMessage", newPath) )
    {
      C2xRemoveToken(packetHandle, "TollAdvertisementMessage", newPath);
    }
  }

  snprintf(newPath, elcount(newPath), "%s.%s", oldPath, "opDefCharge8");
  if(value.opDefCharge8.isValidFlag==1)
  {
    SetTollAdvertisementMessageEfcDataDictionary_PaymentFeeParams(packetHandle, value.opDefCharge8, newPath);
    result = CheckLastError("TollAdvertisementMessage", gkFuncRefGet, result);
  }
  else
  {
    if( C2xIsTokenAvailable(packetHandle, "TollAdvertisementMessage", newPath) )
    {
      C2xRemoveToken(packetHandle, "TollAdvertisementMessage", newPath);
    }
  }

  snprintf(newPath, elcount(newPath), "%s.%s", oldPath, "opDefCharge9");
  if(value.opDefCharge9.isValidFlag==1)
  {
    SetTollAdvertisementMessageEfcDataDictionary_PaymentFeeParams(packetHandle, value.opDefCharge9, newPath);
    result = CheckLastError("TollAdvertisementMessage", gkFuncRefGet, result);
  }
  else
  {
    if( C2xIsTokenAvailable(packetHandle, "TollAdvertisementMessage", newPath) )
    {
      C2xRemoveToken(packetHandle, "TollAdvertisementMessage", newPath);
    }
  }

  snprintf(newPath, elcount(newPath), "%s.%s", oldPath, "opDefCharge10");
  if(value.opDefCharge10.isValidFlag==1)
  {
    SetTollAdvertisementMessageEfcDataDictionary_PaymentFeeParams(packetHandle, value.opDefCharge10, newPath);
    result = CheckLastError("TollAdvertisementMessage", gkFuncRefGet, result);
  }
  else
  {
    if( C2xIsTokenAvailable(packetHandle, "TollAdvertisementMessage", newPath) )
    {
      C2xRemoveToken(packetHandle, "TollAdvertisementMessage", newPath);
    }
  }

  snprintf(newPath, elcount(newPath), "%s.%s", oldPath, "opDefCharge11");
  if(value.opDefCharge11.isValidFlag==1)
  {
    SetTollAdvertisementMessageEfcDataDictionary_PaymentFeeParams(packetHandle, value.opDefCharge11, newPath);
    result = CheckLastError("TollAdvertisementMessage", gkFuncRefGet, result);
  }
  else
  {
    if( C2xIsTokenAvailable(packetHandle, "TollAdvertisementMessage", newPath) )
    {
      C2xRemoveToken(packetHandle, "TollAdvertisementMessage", newPath);
    }
  }

  snprintf(newPath, elcount(newPath), "%s.%s", oldPath, "opDefCharge12");
  if(value.opDefCharge12.isValidFlag==1)
  {
    SetTollAdvertisementMessageEfcDataDictionary_PaymentFeeParams(packetHandle, value.opDefCharge12, newPath);
    result = CheckLastError("TollAdvertisementMessage", gkFuncRefGet, result);
  }
  else
  {
    if( C2xIsTokenAvailable(packetHandle, "TollAdvertisementMessage", newPath) )
    {
      C2xRemoveToken(packetHandle, "TollAdvertisementMessage", newPath);
    }
  }

  snprintf(newPath, elcount(newPath), "%s.%s", oldPath, "opDefCharge13");
  if(value.opDefCharge13.isValidFlag==1)
  {
    SetTollAdvertisementMessageEfcDataDictionary_PaymentFeeParams(packetHandle, value.opDefCharge13, newPath);
    result = CheckLastError("TollAdvertisementMessage", gkFuncRefGet, result);
  }
  else
  {
    if( C2xIsTokenAvailable(packetHandle, "TollAdvertisementMessage", newPath) )
    {
      C2xRemoveToken(packetHandle, "TollAdvertisementMessage", newPath);
    }
  }

  snprintf(newPath, elcount(newPath), "%s.%s", oldPath, "opDefCharge14");
  if(value.opDefCharge14.isValidFlag==1)
  {
    SetTollAdvertisementMessageEfcDataDictionary_PaymentFeeParams(packetHandle, value.opDefCharge14, newPath);
    result = CheckLastError("TollAdvertisementMessage", gkFuncRefGet, result);
  }
  else
  {
    if( C2xIsTokenAvailable(packetHandle, "TollAdvertisementMessage", newPath) )
    {
      C2xRemoveToken(packetHandle, "TollAdvertisementMessage", newPath);
    }
  }

  snprintf(newPath, elcount(newPath), "%s.%s", oldPath, "opDefCharge15");
  if(value.opDefCharge15.isValidFlag==1)
  {
    SetTollAdvertisementMessageEfcDataDictionary_PaymentFeeParams(packetHandle, value.opDefCharge15, newPath);
    result = CheckLastError("TollAdvertisementMessage", gkFuncRefGet, result);
  }
  else
  {
    if( C2xIsTokenAvailable(packetHandle, "TollAdvertisementMessage", newPath) )
    {
      C2xRemoveToken(packetHandle, "TollAdvertisementMessage", newPath);
    }
  }

  snprintf(newPath, elcount(newPath), "%s.%s", oldPath, "opDefCharge16");
  if(value.opDefCharge16.isValidFlag==1)
  {
    SetTollAdvertisementMessageEfcDataDictionary_PaymentFeeParams(packetHandle, value.opDefCharge16, newPath);
    result = CheckLastError("TollAdvertisementMessage", gkFuncRefGet, result);
  }
  else
  {
    if( C2xIsTokenAvailable(packetHandle, "TollAdvertisementMessage", newPath) )
    {
      C2xRemoveToken(packetHandle, "TollAdvertisementMessage", newPath);
    }
  }

  return result;
}

int GetTollAdvertisementMessageSpecialChargesParams(LONG packetHandle, struct TollAdvertisementMessageSpecialCharges value, char oldPath[])
{
  char newPath[300];
  int result;

  result = 0;

  snprintf(newPath, elcount(newPath), "%s.%s", oldPath, "hov2Charge");
  value.hov2Charge.isValidFlag = C2xIsTokenAvailable(packetHandle, "TollAdvertisementMessage", newPath);
  if(value.hov2Charge.isValidFlag==1)
  {
    GetTollAdvertisementMessageEfcDataDictionary_PaymentFeeParams(packetHandle, value.hov2Charge, newPath);
    result = CheckLastError("TollAdvertisementMessage", gkFuncRefGet, result);
  }
  snprintf(newPath, elcount(newPath), "%s.%s", oldPath, "hov3Charge");
  value.hov3Charge.isValidFlag = C2xIsTokenAvailable(packetHandle, "TollAdvertisementMessage", newPath);
  if(value.hov3Charge.isValidFlag==1)
  {
    GetTollAdvertisementMessageEfcDataDictionary_PaymentFeeParams(packetHandle, value.hov3Charge, newPath);
    result = CheckLastError("TollAdvertisementMessage", gkFuncRefGet, result);
  }
  snprintf(newPath, elcount(newPath), "%s.%s", oldPath, "hov4Charge");
  value.hov4Charge.isValidFlag = C2xIsTokenAvailable(packetHandle, "TollAdvertisementMessage", newPath);
  if(value.hov4Charge.isValidFlag==1)
  {
    GetTollAdvertisementMessageEfcDataDictionary_PaymentFeeParams(packetHandle, value.hov4Charge, newPath);
    result = CheckLastError("TollAdvertisementMessage", gkFuncRefGet, result);
  }
  snprintf(newPath, elcount(newPath), "%s.%s", oldPath, "hov5PlusCharge");
  value.hov5PlusCharge.isValidFlag = C2xIsTokenAvailable(packetHandle, "TollAdvertisementMessage", newPath);
  if(value.hov5PlusCharge.isValidFlag==1)
  {
    GetTollAdvertisementMessageEfcDataDictionary_PaymentFeeParams(packetHandle, value.hov5PlusCharge, newPath);
    result = CheckLastError("TollAdvertisementMessage", gkFuncRefGet, result);
  }
  snprintf(newPath, elcount(newPath), "%s.%s", oldPath, "cleanAirCharge");
  value.cleanAirCharge.isValidFlag = C2xIsTokenAvailable(packetHandle, "TollAdvertisementMessage", newPath);
  if(value.cleanAirCharge.isValidFlag==1)
  {
    GetTollAdvertisementMessageEfcDataDictionary_PaymentFeeParams(packetHandle, value.cleanAirCharge, newPath);
    result = CheckLastError("TollAdvertisementMessage", gkFuncRefGet, result);
  }
  snprintf(newPath, elcount(newPath), "%s.%s", oldPath, "operatorDefined");
  value.operatorDefined.isValidFlag = C2xIsTokenAvailable(packetHandle, "TollAdvertisementMessage", newPath);
  if(value.operatorDefined.isValidFlag==1)
  {
    GetTollAdvertisementMessageOperatorDefinedParams(packetHandle, value.operatorDefined, newPath);
    result = CheckLastError("TollAdvertisementMessage", gkFuncRefGet, result);
  }
  snprintf(newPath, elcount(newPath), "%s.%s", oldPath, "engineCharacteristics");
  value.engineCharacteristics.isValidFlag = C2xIsTokenAvailable(packetHandle, "TollAdvertisementMessage", newPath);
  if(value.engineCharacteristics.isValidFlag==1)
  {
    value.engineCharacteristics.value = C2xGetTokenInt(packetHandle, "TollAdvertisementMessage", newPath);
    result = CheckLastError("TollAdvertisementMessage", gkFuncRefGet, result);
  }
  return result;
}

int SetTollAdvertisementMessageSpecialChargesParams(LONG packetHandle, struct TollAdvertisementMessageSpecialCharges value, char oldPath[])
{
  char newPath[300];
  int result;

  result = 0;

  snprintf(newPath, elcount(newPath), "%s.%s", oldPath, "hov2Charge");
  if(value.hov2Charge.isValidFlag==1)
  {
    SetTollAdvertisementMessageEfcDataDictionary_PaymentFeeParams(packetHandle, value.hov2Charge, newPath);
    result = CheckLastError("TollAdvertisementMessage", gkFuncRefGet, result);
  }
  else
  {
    if( C2xIsTokenAvailable(packetHandle, "TollAdvertisementMessage", newPath) )
    {
      C2xRemoveToken(packetHandle, "TollAdvertisementMessage", newPath);
    }
  }

  snprintf(newPath, elcount(newPath), "%s.%s", oldPath, "hov3Charge");
  if(value.hov3Charge.isValidFlag==1)
  {
    SetTollAdvertisementMessageEfcDataDictionary_PaymentFeeParams(packetHandle, value.hov3Charge, newPath);
    result = CheckLastError("TollAdvertisementMessage", gkFuncRefGet, result);
  }
  else
  {
    if( C2xIsTokenAvailable(packetHandle, "TollAdvertisementMessage", newPath) )
    {
      C2xRemoveToken(packetHandle, "TollAdvertisementMessage", newPath);
    }
  }

  snprintf(newPath, elcount(newPath), "%s.%s", oldPath, "hov4Charge");
  if(value.hov4Charge.isValidFlag==1)
  {
    SetTollAdvertisementMessageEfcDataDictionary_PaymentFeeParams(packetHandle, value.hov4Charge, newPath);
    result = CheckLastError("TollAdvertisementMessage", gkFuncRefGet, result);
  }
  else
  {
    if( C2xIsTokenAvailable(packetHandle, "TollAdvertisementMessage", newPath) )
    {
      C2xRemoveToken(packetHandle, "TollAdvertisementMessage", newPath);
    }
  }

  snprintf(newPath, elcount(newPath), "%s.%s", oldPath, "hov5PlusCharge");
  if(value.hov5PlusCharge.isValidFlag==1)
  {
    SetTollAdvertisementMessageEfcDataDictionary_PaymentFeeParams(packetHandle, value.hov5PlusCharge, newPath);
    result = CheckLastError("TollAdvertisementMessage", gkFuncRefGet, result);
  }
  else
  {
    if( C2xIsTokenAvailable(packetHandle, "TollAdvertisementMessage", newPath) )
    {
      C2xRemoveToken(packetHandle, "TollAdvertisementMessage", newPath);
    }
  }

  snprintf(newPath, elcount(newPath), "%s.%s", oldPath, "cleanAirCharge");
  if(value.cleanAirCharge.isValidFlag==1)
  {
    SetTollAdvertisementMessageEfcDataDictionary_PaymentFeeParams(packetHandle, value.cleanAirCharge, newPath);
    result = CheckLastError("TollAdvertisementMessage", gkFuncRefGet, result);
  }
  else
  {
    if( C2xIsTokenAvailable(packetHandle, "TollAdvertisementMessage", newPath) )
    {
      C2xRemoveToken(packetHandle, "TollAdvertisementMessage", newPath);
    }
  }

  snprintf(newPath, elcount(newPath), "%s.%s", oldPath, "operatorDefined");
  if(value.operatorDefined.isValidFlag==1)
  {
    SetTollAdvertisementMessageOperatorDefinedParams(packetHandle, value.operatorDefined, newPath);
    result = CheckLastError("TollAdvertisementMessage", gkFuncRefGet, result);
  }
  else
  {
    if( C2xIsTokenAvailable(packetHandle, "TollAdvertisementMessage", newPath) )
    {
      C2xRemoveToken(packetHandle, "TollAdvertisementMessage", newPath);
    }
  }

  snprintf(newPath, elcount(newPath), "%s.%s", oldPath, "engineCharacteristics");
  if(value.engineCharacteristics.isValidFlag==1)
  {
    C2xSetTokenInt(packetHandle, "TollAdvertisementMessage", newPath, value.engineCharacteristics.value);
    result = CheckLastError("TollAdvertisementMessage", gkFuncRefGet, result);
  }
  else
  {
    if( C2xIsTokenAvailable(packetHandle, "TollAdvertisementMessage", newPath) )
    {
      C2xRemoveToken(packetHandle, "TollAdvertisementMessage", newPath);
    }
  }

  return result;
}

int GetTollAdvertisementMessageVehTypeChargesParams(LONG packetHandle, struct TollAdvertisementMessageVehTypeCharges value, char oldPath[])
{
  char newPath[300];
  int result;

  result = 0;

  snprintf(newPath, elcount(newPath), "%s.%s", oldPath, "vehType");
  value.vehType = C2xGetTokenInt(packetHandle, "TollAdvertisementMessage", newPath);
  result = CheckLastError("TollAdvertisementMessage", gkFuncRefGet, result);

  snprintf(newPath, elcount(newPath), "%s.%s", oldPath, "charges");
  GetTollAdvertisementMessageEfcDataDictionary_PaymentFeeParams(packetHandle, value.charges, newPath);
  result = CheckLastError("TollAdvertisementMessage", gkFuncRefGet, result);

  snprintf(newPath, elcount(newPath), "%s.%s", oldPath, "specialCharges");
  value.specialCharges.isValidFlag = C2xIsTokenAvailable(packetHandle, "TollAdvertisementMessage", newPath);
  if(value.specialCharges.isValidFlag==1)
  {
    GetTollAdvertisementMessageSpecialChargesParams(packetHandle, value.specialCharges, newPath);
    result = CheckLastError("TollAdvertisementMessage", gkFuncRefGet, result);
  }
  return result;
}

int SetTollAdvertisementMessageVehTypeChargesParams(LONG packetHandle, struct TollAdvertisementMessageVehTypeCharges value, char oldPath[])
{
  char newPath[300];
  int result;

  result = 0;

  snprintf(newPath, elcount(newPath), "%s.%s", oldPath, "vehType");
  if (value.vehType < 1)
  {
    C2xSetTokenInt(packetHandle, "TollAdvertisementMessage", newPath, 1);
  }
  else if (value.vehType > 13)
  {
    C2xSetTokenInt(packetHandle, "TollAdvertisementMessage", newPath, 13);
  }
  else
  {
    C2xSetTokenInt(packetHandle, "TollAdvertisementMessage", newPath, value.vehType);
  }
  result = CheckLastError("TollAdvertisementMessage", gkFuncRefGet, result);

  snprintf(newPath, elcount(newPath), "%s.%s", oldPath, "charges");
  SetTollAdvertisementMessageEfcDataDictionary_PaymentFeeParams(packetHandle, value.charges, newPath);
  result = CheckLastError("TollAdvertisementMessage", gkFuncRefGet, result);

  snprintf(newPath, elcount(newPath), "%s.%s", oldPath, "specialCharges");
  if(value.specialCharges.isValidFlag==1)
  {
    SetTollAdvertisementMessageSpecialChargesParams(packetHandle, value.specialCharges, newPath);
    result = CheckLastError("TollAdvertisementMessage", gkFuncRefGet, result);
  }
  else
  {
    if( C2xIsTokenAvailable(packetHandle, "TollAdvertisementMessage", newPath) )
    {
      C2xRemoveToken(packetHandle, "TollAdvertisementMessage", newPath);
    }
  }

  return result;
}

int GetTollAdvertisementMessageVehTypeChargesTableParams(LONG packetHandle, struct TollAdvertisementMessageVehTypeChargesTable value, char oldPath[])
{
  char newPath[300]; 
  int i;
  int result;

  result = 0;

  value.length = C2xGetTokenInt(packetHandle, "TollAdvertisementMessage", oldPath);
  if((result = CheckLastError("TollAdvertisementMessage", gkFuncRefGet, result))==0)
  {
    for(i=0; i<value.length; i++)
    {
      snprintf(newPath, elcount(newPath), "%s[%d]", oldPath, i);
      GetTollAdvertisementMessageVehTypeChargesParams(packetHandle, value.arrayValue[i], newPath);
      result = CheckLastError("TollAdvertisementMessage", gkFuncRefGet, result);
    }
  }
  return result;
}

int SetTollAdvertisementMessageVehTypeChargesTableParams(LONG packetHandle, struct TollAdvertisementMessageVehTypeChargesTable value, char oldPath[])
{
  char newPath[300]; 
  int i;
  int result;

  result = 0;

  C2xRemoveToken(packetHandle, "TollAdvertisementMessage", oldPath);
  for(i=0; i<value.length; i++)
  {
    snprintf(newPath, elcount(newPath), "%s[%d]", oldPath, i);
    SetTollAdvertisementMessageVehTypeChargesParams(packetHandle, value.arrayValue[i], newPath);
    result = CheckLastError("TollAdvertisementMessage", gkFuncRefGet, result);
  }
  return result;
}

int GetTollAdvertisementMessageAxlesChargesParams(LONG packetHandle, struct TollAdvertisementMessageAxlesCharges value, char oldPath[])
{
  char newPath[300];
  int result;

  result = 0;

  snprintf(newPath, elcount(newPath), "%s.%s", oldPath, "axlesLimit");
  value.axlesLimit = C2xGetTokenInt(packetHandle, "TollAdvertisementMessage", newPath);
  result = CheckLastError("TollAdvertisementMessage", gkFuncRefGet, result);

  snprintf(newPath, elcount(newPath), "%s.%s", oldPath, "axlesCharge");
  GetTollAdvertisementMessageEfcDataDictionary_PaymentFeeParams(packetHandle, value.axlesCharge, newPath);
  result = CheckLastError("TollAdvertisementMessage", gkFuncRefGet, result);

  return result;
}

int SetTollAdvertisementMessageAxlesChargesParams(LONG packetHandle, struct TollAdvertisementMessageAxlesCharges value, char oldPath[])
{
  char newPath[300];
  int result;

  result = 0;

  snprintf(newPath, elcount(newPath), "%s.%s", oldPath, "axlesLimit");
  if (value.axlesLimit < 2)
  {
    C2xSetTokenInt(packetHandle, "TollAdvertisementMessage", newPath, 2);
  }
  else if (value.axlesLimit > 10)
  {
    C2xSetTokenInt(packetHandle, "TollAdvertisementMessage", newPath, 10);
  }
  else
  {
    C2xSetTokenInt(packetHandle, "TollAdvertisementMessage", newPath, value.axlesLimit);
  }
  result = CheckLastError("TollAdvertisementMessage", gkFuncRefGet, result);

  snprintf(newPath, elcount(newPath), "%s.%s", oldPath, "axlesCharge");
  SetTollAdvertisementMessageEfcDataDictionary_PaymentFeeParams(packetHandle, value.axlesCharge, newPath);
  result = CheckLastError("TollAdvertisementMessage", gkFuncRefGet, result);

  return result;
}

int GetTollAdvertisementMessageAxlesChargesTableParams(LONG packetHandle, struct TollAdvertisementMessageAxlesChargesTable value, char oldPath[])
{
  char newPath[300]; 
  int i;
  int result;

  result = 0;

  value.length = C2xGetTokenInt(packetHandle, "TollAdvertisementMessage", oldPath);
  if((result = CheckLastError("TollAdvertisementMessage", gkFuncRefGet, result))==0)
  {
    for(i=0; i<value.length; i++)
    {
      snprintf(newPath, elcount(newPath), "%s[%d]", oldPath, i);
      GetTollAdvertisementMessageAxlesChargesParams(packetHandle, value.arrayValue[i], newPath);
      result = CheckLastError("TollAdvertisementMessage", gkFuncRefGet, result);
    }
  }
  return result;
}

int SetTollAdvertisementMessageAxlesChargesTableParams(LONG packetHandle, struct TollAdvertisementMessageAxlesChargesTable value, char oldPath[])
{
  char newPath[300]; 
  int i;
  int result;

  result = 0;

  C2xRemoveToken(packetHandle, "TollAdvertisementMessage", oldPath);
  for(i=0; i<value.length; i++)
  {
    snprintf(newPath, elcount(newPath), "%s[%d]", oldPath, i);
    SetTollAdvertisementMessageAxlesChargesParams(packetHandle, value.arrayValue[i], newPath);
    result = CheckLastError("TollAdvertisementMessage", gkFuncRefGet, result);
  }
  return result;
}

int GetTollAdvertisementMessageTotalWeightChargesParams(LONG packetHandle, struct TollAdvertisementMessageTotalWeightCharges value, char oldPath[])
{
  char newPath[300];
  int result;

  result = 0;

  snprintf(newPath, elcount(newPath), "%s.%s", oldPath, "weightLimit");
  value.weightLimit = C2xGetTokenInt(packetHandle, "TollAdvertisementMessage", newPath);
  result = CheckLastError("TollAdvertisementMessage", gkFuncRefGet, result);

  snprintf(newPath, elcount(newPath), "%s.%s", oldPath, "weightLimitUnits");
  value.weightLimitUnits = C2xGetTokenInt(packetHandle, "TollAdvertisementMessage", newPath);
  result = CheckLastError("TollAdvertisementMessage", gkFuncRefGet, result);

  snprintf(newPath, elcount(newPath), "%s.%s", oldPath, "weightCharge");
  GetTollAdvertisementMessageEfcDataDictionary_PaymentFeeParams(packetHandle, value.weightCharge, newPath);
  result = CheckLastError("TollAdvertisementMessage", gkFuncRefGet, result);

  return result;
}

int SetTollAdvertisementMessageTotalWeightChargesParams(LONG packetHandle, struct TollAdvertisementMessageTotalWeightCharges value, char oldPath[])
{
  char newPath[300];
  int result;

  result = 0;

  snprintf(newPath, elcount(newPath), "%s.%s", oldPath, "weightLimit");
  C2xSetTokenInt(packetHandle, "TollAdvertisementMessage", newPath, value.weightLimit);
  result = CheckLastError("TollAdvertisementMessage", gkFuncRefGet, result);

  snprintf(newPath, elcount(newPath), "%s.%s", oldPath, "weightLimitUnits");
  C2xSetTokenInt(packetHandle, "TollAdvertisementMessage", newPath, value.weightLimitUnits);
  result = CheckLastError("TollAdvertisementMessage", gkFuncRefGet, result);

  snprintf(newPath, elcount(newPath), "%s.%s", oldPath, "weightCharge");
  SetTollAdvertisementMessageEfcDataDictionary_PaymentFeeParams(packetHandle, value.weightCharge, newPath);
  result = CheckLastError("TollAdvertisementMessage", gkFuncRefGet, result);

  return result;
}

int GetTollAdvertisementMessagePerAxleWeightChargesParams(LONG packetHandle, struct TollAdvertisementMessagePerAxleWeightCharges value, char oldPath[])
{
  char newPath[300];
  int result;

  result = 0;

  snprintf(newPath, elcount(newPath), "%s.%s", oldPath, "totalWeightLimit");
  value.totalWeightLimit = C2xGetTokenInt(packetHandle, "TollAdvertisementMessage", newPath);
  result = CheckLastError("TollAdvertisementMessage", gkFuncRefGet, result);

  snprintf(newPath, elcount(newPath), "%s.%s", oldPath, "maxLadenWeightOnAxle");
  value.maxLadenWeightOnAxle = C2xGetTokenInt(packetHandle, "TollAdvertisementMessage", newPath);
  result = CheckLastError("TollAdvertisementMessage", gkFuncRefGet, result);

  snprintf(newPath, elcount(newPath), "%s.%s", oldPath, "weightLimitUnits");
  value.weightLimitUnits = C2xGetTokenInt(packetHandle, "TollAdvertisementMessage", newPath);
  result = CheckLastError("TollAdvertisementMessage", gkFuncRefGet, result);

  snprintf(newPath, elcount(newPath), "%s.%s", oldPath, "axleWeightCharge");
  GetTollAdvertisementMessageEfcDataDictionary_PaymentFeeParams(packetHandle, value.axleWeightCharge, newPath);
  result = CheckLastError("TollAdvertisementMessage", gkFuncRefGet, result);

  return result;
}

int SetTollAdvertisementMessagePerAxleWeightChargesParams(LONG packetHandle, struct TollAdvertisementMessagePerAxleWeightCharges value, char oldPath[])
{
  char newPath[300];
  int result;

  result = 0;

  snprintf(newPath, elcount(newPath), "%s.%s", oldPath, "totalWeightLimit");
  C2xSetTokenInt(packetHandle, "TollAdvertisementMessage", newPath, value.totalWeightLimit);
  result = CheckLastError("TollAdvertisementMessage", gkFuncRefGet, result);

  snprintf(newPath, elcount(newPath), "%s.%s", oldPath, "maxLadenWeightOnAxle");
  C2xSetTokenInt(packetHandle, "TollAdvertisementMessage", newPath, value.maxLadenWeightOnAxle);
  result = CheckLastError("TollAdvertisementMessage", gkFuncRefGet, result);

  snprintf(newPath, elcount(newPath), "%s.%s", oldPath, "weightLimitUnits");
  C2xSetTokenInt(packetHandle, "TollAdvertisementMessage", newPath, value.weightLimitUnits);
  result = CheckLastError("TollAdvertisementMessage", gkFuncRefGet, result);

  snprintf(newPath, elcount(newPath), "%s.%s", oldPath, "axleWeightCharge");
  SetTollAdvertisementMessageEfcDataDictionary_PaymentFeeParams(packetHandle, value.axleWeightCharge, newPath);
  result = CheckLastError("TollAdvertisementMessage", gkFuncRefGet, result);

  return result;
}

int GetTollAdvertisementMessageWeightChargesParams(LONG packetHandle, struct TollAdvertisementMessageWeightCharges value, char oldPath[])
{
  char newPath[300];
  int result;

  result = 0;

  value.choice = C2xGetTokenInt(packetHandle, "TollAdvertisementMessage", oldPath);

  switch(value.choice)
  {
    case 0:
    {
      snprintf(newPath, elcount(newPath), "%s.%s", oldPath, "totalWeightCharges");
      GetTollAdvertisementMessageTotalWeightChargesParams(packetHandle, value.totalWeightCharges, newPath);
      result = CheckLastError("TollAdvertisementMessage", gkFuncRefGet, result);
    }
    break;
    case 1:
    {
      snprintf(newPath, elcount(newPath), "%s.%s", oldPath, "perAxleWeightCharges");
      GetTollAdvertisementMessagePerAxleWeightChargesParams(packetHandle, value.perAxleWeightCharges, newPath);
      result = CheckLastError("TollAdvertisementMessage", gkFuncRefGet, result);
    }
    break;
  }
  return result;
}

int SetTollAdvertisementMessageWeightChargesParams(LONG packetHandle, struct TollAdvertisementMessageWeightCharges value, char oldPath[])
{
  char newPath[300];
  int result;

  result = 0;

  switch(value.choice)
  {
    case 0:
    {
      snprintf(newPath, elcount(newPath), "%s.%s", oldPath, "totalWeightCharges");
      SetTollAdvertisementMessageTotalWeightChargesParams(packetHandle, value.totalWeightCharges, newPath);
      result = CheckLastError("TollAdvertisementMessage", gkFuncRefGet, result);
    }
    break;
    case 1:
    {
      snprintf(newPath, elcount(newPath), "%s.%s", oldPath, "perAxleWeightCharges");
      SetTollAdvertisementMessagePerAxleWeightChargesParams(packetHandle, value.perAxleWeightCharges, newPath);
      result = CheckLastError("TollAdvertisementMessage", gkFuncRefGet, result);
    }
    break;
  }
  return result;
}

int GetTollAdvertisementMessageWeightChargesTableParams(LONG packetHandle, struct TollAdvertisementMessageWeightChargesTable value, char oldPath[])
{
  char newPath[300]; 
  int i;
  int result;

  result = 0;

  value.length = C2xGetTokenInt(packetHandle, "TollAdvertisementMessage", oldPath);
  if((result = CheckLastError("TollAdvertisementMessage", gkFuncRefGet, result))==0)
  {
    for(i=0; i<value.length; i++)
    {
      snprintf(newPath, elcount(newPath), "%s[%d]", oldPath, i);
      GetTollAdvertisementMessageWeightChargesParams(packetHandle, value.arrayValue[i], newPath);
      result = CheckLastError("TollAdvertisementMessage", gkFuncRefGet, result);
    }
  }
  return result;
}

int SetTollAdvertisementMessageWeightChargesTableParams(LONG packetHandle, struct TollAdvertisementMessageWeightChargesTable value, char oldPath[])
{
  char newPath[300]; 
  int i;
  int result;

  result = 0;

  C2xRemoveToken(packetHandle, "TollAdvertisementMessage", oldPath);
  for(i=0; i<value.length; i++)
  {
    snprintf(newPath, elcount(newPath), "%s[%d]", oldPath, i);
    SetTollAdvertisementMessageWeightChargesParams(packetHandle, value.arrayValue[i], newPath);
    result = CheckLastError("TollAdvertisementMessage", gkFuncRefGet, result);
  }
  return result;
}

int GetTollAdvertisementMessageChargesTableParams(LONG packetHandle, struct TollAdvertisementMessageChargesTable value, char oldPath[])
{
  char newPath[300];
  int result;

  result = 0;

  value.choice = C2xGetTokenInt(packetHandle, "TollAdvertisementMessage", oldPath);

  switch(value.choice)
  {
    case 0:
    {
      snprintf(newPath, elcount(newPath), "%s.%s", oldPath, "vehTypeBased");
      GetTollAdvertisementMessageVehTypeChargesTableParams(packetHandle, value.vehTypeBased, newPath);
      result = CheckLastError("TollAdvertisementMessage", gkFuncRefGet, result);
    }
    break;
    case 1:
    {
      snprintf(newPath, elcount(newPath), "%s.%s", oldPath, "numAxlesBased");
      GetTollAdvertisementMessageAxlesChargesTableParams(packetHandle, value.numAxlesBased, newPath);
      result = CheckLastError("TollAdvertisementMessage", gkFuncRefGet, result);
    }
    break;
    case 2:
    {
      snprintf(newPath, elcount(newPath), "%s.%s", oldPath, "weightBased");
      GetTollAdvertisementMessageWeightChargesTableParams(packetHandle, value.weightBased, newPath);
      result = CheckLastError("TollAdvertisementMessage", gkFuncRefGet, result);
    }
    break;
  }
  return result;
}

int SetTollAdvertisementMessageChargesTableParams(LONG packetHandle, struct TollAdvertisementMessageChargesTable value, char oldPath[])
{
  char newPath[300];
  int result;

  result = 0;

  switch(value.choice)
  {
    case 0:
    {
      snprintf(newPath, elcount(newPath), "%s.%s", oldPath, "vehTypeBased");
      SetTollAdvertisementMessageVehTypeChargesTableParams(packetHandle, value.vehTypeBased, newPath);
      result = CheckLastError("TollAdvertisementMessage", gkFuncRefGet, result);
    }
    break;
    case 1:
    {
      snprintf(newPath, elcount(newPath), "%s.%s", oldPath, "numAxlesBased");
      SetTollAdvertisementMessageAxlesChargesTableParams(packetHandle, value.numAxlesBased, newPath);
      result = CheckLastError("TollAdvertisementMessage", gkFuncRefGet, result);
    }
    break;
    case 2:
    {
      snprintf(newPath, elcount(newPath), "%s.%s", oldPath, "weightBased");
      SetTollAdvertisementMessageWeightChargesTableParams(packetHandle, value.weightBased, newPath);
      result = CheckLastError("TollAdvertisementMessage", gkFuncRefGet, result);
    }
    break;
  }
  return result;
}

int GetTollAdvertisementMessageLaneChargesTableParams(LONG packetHandle, struct TollAdvertisementMessageLaneChargesTable value, char oldPath[])
{
  char newPath[300];
  int result;

  result = 0;

  snprintf(newPath, elcount(newPath), "%s.%s", oldPath, "laneId");
  value.laneId = C2xGetTokenInt(packetHandle, "TollAdvertisementMessage", newPath);
  result = CheckLastError("TollAdvertisementMessage", gkFuncRefGet, result);

  snprintf(newPath, elcount(newPath), "%s.%s", oldPath, "chargesTable");
  GetTollAdvertisementMessageChargesTableParams(packetHandle, value.chargesTable, newPath);
  result = CheckLastError("TollAdvertisementMessage", gkFuncRefGet, result);

  return result;
}

int SetTollAdvertisementMessageLaneChargesTableParams(LONG packetHandle, struct TollAdvertisementMessageLaneChargesTable value, char oldPath[])
{
  char newPath[300];
  int result;

  result = 0;

  snprintf(newPath, elcount(newPath), "%s.%s", oldPath, "laneId");
  C2xSetTokenInt(packetHandle, "TollAdvertisementMessage", newPath, value.laneId);
  result = CheckLastError("TollAdvertisementMessage", gkFuncRefGet, result);

  snprintf(newPath, elcount(newPath), "%s.%s", oldPath, "chargesTable");
  SetTollAdvertisementMessageChargesTableParams(packetHandle, value.chargesTable, newPath);
  result = CheckLastError("TollAdvertisementMessage", gkFuncRefGet, result);

  return result;
}

int GetTollAdvertisementMessageTollChargesTable_tollTypeCharge_perLaneChargesParams(LONG packetHandle, struct TollAdvertisementMessageTollChargesTable_tollTypeCharge_perLaneCharges value, char oldPath[])
{
  char newPath[300]; 
  int i;
  int result;

  result = 0;

  value.length = C2xGetTokenInt(packetHandle, "TollAdvertisementMessage", oldPath);
  if((result = CheckLastError("TollAdvertisementMessage", gkFuncRefGet, result))==0)
  {
    for(i=0; i<value.length; i++)
    {
      snprintf(newPath, elcount(newPath), "%s[%d]", oldPath, i);
      GetTollAdvertisementMessageLaneChargesTableParams(packetHandle, value.arrayValue[i], newPath);
      result = CheckLastError("TollAdvertisementMessage", gkFuncRefGet, result);
    }
  }
  return result;
}

int SetTollAdvertisementMessageTollChargesTable_tollTypeCharge_perLaneChargesParams(LONG packetHandle, struct TollAdvertisementMessageTollChargesTable_tollTypeCharge_perLaneCharges value, char oldPath[])
{
  char newPath[300]; 
  int i;
  int result;

  result = 0;

  C2xRemoveToken(packetHandle, "TollAdvertisementMessage", oldPath);
  for(i=0; i<value.length; i++)
  {
    snprintf(newPath, elcount(newPath), "%s[%d]", oldPath, i);
    SetTollAdvertisementMessageLaneChargesTableParams(packetHandle, value.arrayValue[i], newPath);
    result = CheckLastError("TollAdvertisementMessage", gkFuncRefGet, result);
  }
  return result;
}

int GetTollAdvertisementMessageExitInfoParams(LONG packetHandle, struct TollAdvertisementMessageExitInfo value, char oldPath[])
{
  char newPath[300];
  int result;

  result = 0;

  snprintf(newPath, elcount(newPath), "%s.%s", oldPath, "exitNumber");
  value.exitNumber = C2xGetTokenInt(packetHandle, "TollAdvertisementMessage", newPath);
  result = CheckLastError("TollAdvertisementMessage", gkFuncRefGet, result);

  snprintf(newPath, elcount(newPath), "%s.%s", oldPath, "exitLetter");
  value.exitLetter.isValidFlag = C2xIsTokenAvailable(packetHandle, "TollAdvertisementMessage", newPath);
  if(value.exitLetter.isValidFlag==1)
  {
    value.exitLetter.value = C2xGetTokenInt(packetHandle, "TollAdvertisementMessage", newPath);
    result = CheckLastError("TollAdvertisementMessage", gkFuncRefGet, result);
  }
  snprintf(newPath, elcount(newPath), "%s.%s", oldPath, "tollPointID");
  value.tollPointID.isValidFlag = C2xIsTokenAvailable(packetHandle, "TollAdvertisementMessage", newPath);
  if(value.tollPointID.isValidFlag==1)
  {
    value.tollPointID.value = C2xGetTokenInt(packetHandle, "TollAdvertisementMessage", newPath);
    result = CheckLastError("TollAdvertisementMessage", gkFuncRefGet, result);
  }
  return result;
}

int SetTollAdvertisementMessageExitInfoParams(LONG packetHandle, struct TollAdvertisementMessageExitInfo value, char oldPath[])
{
  char newPath[300];
  int result;

  result = 0;

  snprintf(newPath, elcount(newPath), "%s.%s", oldPath, "exitNumber");
  if (value.exitNumber < 1)
  {
    C2xSetTokenInt(packetHandle, "TollAdvertisementMessage", newPath, 1);
  }
  else if (value.exitNumber > 999)
  {
    C2xSetTokenInt(packetHandle, "TollAdvertisementMessage", newPath, 999);
  }
  else
  {
    C2xSetTokenInt(packetHandle, "TollAdvertisementMessage", newPath, value.exitNumber);
  }
  result = CheckLastError("TollAdvertisementMessage", gkFuncRefGet, result);

  snprintf(newPath, elcount(newPath), "%s.%s", oldPath, "exitLetter");
  if(value.exitLetter.isValidFlag==1)
  {
    if (value.exitLetter.value < 65)
    {
        C2xSetTokenInt(packetHandle, "TollAdvertisementMessage", newPath, 65);
    }
    else if (value.exitLetter.value > 90)
    {
        C2xSetTokenInt(packetHandle, "TollAdvertisementMessage", newPath, 90);
    }
    else
    {
        C2xSetTokenInt(packetHandle, "TollAdvertisementMessage", newPath, value.exitLetter.value);
    }
    result = CheckLastError("TollAdvertisementMessage", gkFuncRefGet, result);
  }
  else
  {
    if( C2xIsTokenAvailable(packetHandle, "TollAdvertisementMessage", newPath) )
    {
      C2xRemoveToken(packetHandle, "TollAdvertisementMessage", newPath);
    }
  }

  snprintf(newPath, elcount(newPath), "%s.%s", oldPath, "tollPointID");
  if(value.tollPointID.isValidFlag==1)
  {
    if (value.tollPointID.value < 1)
    {
        C2xSetTokenInt(packetHandle, "TollAdvertisementMessage", newPath, 1);
    }
    else if (value.tollPointID.value > 2048)
    {
        C2xSetTokenInt(packetHandle, "TollAdvertisementMessage", newPath, 2048);
    }
    else
    {
        C2xSetTokenInt(packetHandle, "TollAdvertisementMessage", newPath, value.tollPointID.value);
    }
    result = CheckLastError("TollAdvertisementMessage", gkFuncRefGet, result);
  }
  else
  {
    if( C2xIsTokenAvailable(packetHandle, "TollAdvertisementMessage", newPath) )
    {
      C2xRemoveToken(packetHandle, "TollAdvertisementMessage", newPath);
    }
  }

  return result;
}

int GetTollAdvertisementMessageEntryChargesTableParams(LONG packetHandle, struct TollAdvertisementMessageEntryChargesTable value, char oldPath[])
{
  char newPath[300];
  int result;

  result = 0;

  snprintf(newPath, elcount(newPath), "%s.%s", oldPath, "exitInfo");
  GetTollAdvertisementMessageExitInfoParams(packetHandle, value.exitInfo, newPath);
  result = CheckLastError("TollAdvertisementMessage", gkFuncRefGet, result);

  snprintf(newPath, elcount(newPath), "%s.%s", oldPath, "chargesTable");
  GetTollAdvertisementMessageChargesTableParams(packetHandle, value.chargesTable, newPath);
  result = CheckLastError("TollAdvertisementMessage", gkFuncRefGet, result);

  return result;
}

int SetTollAdvertisementMessageEntryChargesTableParams(LONG packetHandle, struct TollAdvertisementMessageEntryChargesTable value, char oldPath[])
{
  char newPath[300];
  int result;

  result = 0;

  snprintf(newPath, elcount(newPath), "%s.%s", oldPath, "exitInfo");
  SetTollAdvertisementMessageExitInfoParams(packetHandle, value.exitInfo, newPath);
  result = CheckLastError("TollAdvertisementMessage", gkFuncRefGet, result);

  snprintf(newPath, elcount(newPath), "%s.%s", oldPath, "chargesTable");
  SetTollAdvertisementMessageChargesTableParams(packetHandle, value.chargesTable, newPath);
  result = CheckLastError("TollAdvertisementMessage", gkFuncRefGet, result);

  return result;
}

int GetTollAdvertisementMessageExitChargesTableParams(LONG packetHandle, struct TollAdvertisementMessageExitChargesTable value, char oldPath[])
{
  char newPath[300];
  int result;

  result = 0;

  snprintf(newPath, elcount(newPath), "%s.%s", oldPath, "entryInfo");
  value.entryInfo.isValidFlag = C2xIsTokenAvailable(packetHandle, "TollAdvertisementMessage", newPath);
  if(value.entryInfo.isValidFlag==1)
  {
    value.entryInfo.value = C2xGetTokenInt(packetHandle, "TollAdvertisementMessage", newPath);
    result = CheckLastError("TollAdvertisementMessage", gkFuncRefGet, result);
  }
  snprintf(newPath, elcount(newPath), "%s.%s", oldPath, "chargesTable");
  GetTollAdvertisementMessageChargesTableParams(packetHandle, value.chargesTable, newPath);
  result = CheckLastError("TollAdvertisementMessage", gkFuncRefGet, result);

  return result;
}

int SetTollAdvertisementMessageExitChargesTableParams(LONG packetHandle, struct TollAdvertisementMessageExitChargesTable value, char oldPath[])
{
  char newPath[300];
  int result;

  result = 0;

  snprintf(newPath, elcount(newPath), "%s.%s", oldPath, "entryInfo");
  if(value.entryInfo.isValidFlag==1)
  {
    if (value.entryInfo.value < 1)
    {
        C2xSetTokenInt(packetHandle, "TollAdvertisementMessage", newPath, 1);
    }
    else if (value.entryInfo.value > 2048)
    {
        C2xSetTokenInt(packetHandle, "TollAdvertisementMessage", newPath, 2048);
    }
    else
    {
        C2xSetTokenInt(packetHandle, "TollAdvertisementMessage", newPath, value.entryInfo.value);
    }
    result = CheckLastError("TollAdvertisementMessage", gkFuncRefGet, result);
  }
  else
  {
    if( C2xIsTokenAvailable(packetHandle, "TollAdvertisementMessage", newPath) )
    {
      C2xRemoveToken(packetHandle, "TollAdvertisementMessage", newPath);
    }
  }

  snprintf(newPath, elcount(newPath), "%s.%s", oldPath, "chargesTable");
  SetTollAdvertisementMessageChargesTableParams(packetHandle, value.chargesTable, newPath);
  result = CheckLastError("TollAdvertisementMessage", gkFuncRefGet, result);

  return result;
}

int GetTollAdvertisementMessageClosedNetworkChargesTableParams(LONG packetHandle, struct TollAdvertisementMessageClosedNetworkChargesTable value, char oldPath[])
{
  char newPath[300];
  int result;

  result = 0;

  value.choice = C2xGetTokenInt(packetHandle, "TollAdvertisementMessage", oldPath);

  switch(value.choice)
  {
    case 0:
    {
      snprintf(newPath, elcount(newPath), "%s.%s", oldPath, "entryChargesTable");
      GetTollAdvertisementMessageEntryChargesTableParams(packetHandle, value.entryChargesTable, newPath);
      result = CheckLastError("TollAdvertisementMessage", gkFuncRefGet, result);
    }
    break;
    case 1:
    {
      snprintf(newPath, elcount(newPath), "%s.%s", oldPath, "exitChargesTable");
      GetTollAdvertisementMessageExitChargesTableParams(packetHandle, value.exitChargesTable, newPath);
      result = CheckLastError("TollAdvertisementMessage", gkFuncRefGet, result);
    }
    break;
  }
  return result;
}

int SetTollAdvertisementMessageClosedNetworkChargesTableParams(LONG packetHandle, struct TollAdvertisementMessageClosedNetworkChargesTable value, char oldPath[])
{
  char newPath[300];
  int result;

  result = 0;

  switch(value.choice)
  {
    case 0:
    {
      snprintf(newPath, elcount(newPath), "%s.%s", oldPath, "entryChargesTable");
      SetTollAdvertisementMessageEntryChargesTableParams(packetHandle, value.entryChargesTable, newPath);
      result = CheckLastError("TollAdvertisementMessage", gkFuncRefGet, result);
    }
    break;
    case 1:
    {
      snprintf(newPath, elcount(newPath), "%s.%s", oldPath, "exitChargesTable");
      SetTollAdvertisementMessageExitChargesTableParams(packetHandle, value.exitChargesTable, newPath);
      result = CheckLastError("TollAdvertisementMessage", gkFuncRefGet, result);
    }
    break;
  }
  return result;
}

int GetTollAdvertisementMessageTollChargesTable_tollTypeCharge_closedNetworkChargesParams(LONG packetHandle, struct TollAdvertisementMessageTollChargesTable_tollTypeCharge_closedNetworkCharges value, char oldPath[])
{
  char newPath[300]; 
  int i;
  int result;

  result = 0;

  value.length = C2xGetTokenInt(packetHandle, "TollAdvertisementMessage", oldPath);
  if((result = CheckLastError("TollAdvertisementMessage", gkFuncRefGet, result))==0)
  {
    for(i=0; i<value.length; i++)
    {
      snprintf(newPath, elcount(newPath), "%s[%d]", oldPath, i);
      GetTollAdvertisementMessageClosedNetworkChargesTableParams(packetHandle, value.arrayValue[i], newPath);
      result = CheckLastError("TollAdvertisementMessage", gkFuncRefGet, result);
    }
  }
  return result;
}

int SetTollAdvertisementMessageTollChargesTable_tollTypeCharge_closedNetworkChargesParams(LONG packetHandle, struct TollAdvertisementMessageTollChargesTable_tollTypeCharge_closedNetworkCharges value, char oldPath[])
{
  char newPath[300]; 
  int i;
  int result;

  result = 0;

  C2xRemoveToken(packetHandle, "TollAdvertisementMessage", oldPath);
  for(i=0; i<value.length; i++)
  {
    snprintf(newPath, elcount(newPath), "%s[%d]", oldPath, i);
    SetTollAdvertisementMessageClosedNetworkChargesTableParams(packetHandle, value.arrayValue[i], newPath);
    result = CheckLastError("TollAdvertisementMessage", gkFuncRefGet, result);
  }
  return result;
}

int GetTollAdvertisementMessageTimeChargesTableParams(LONG packetHandle, struct TollAdvertisementMessageTimeChargesTable value, char oldPath[])
{
  char newPath[300];
  int result;

  result = 0;

  snprintf(newPath, elcount(newPath), "%s.%s", oldPath, "maxTime");
  value.maxTime = C2xGetTokenInt(packetHandle, "TollAdvertisementMessage", newPath);
  result = CheckLastError("TollAdvertisementMessage", gkFuncRefGet, result);

  snprintf(newPath, elcount(newPath), "%s.%s", oldPath, "chargesTable");
  GetTollAdvertisementMessageChargesTableParams(packetHandle, value.chargesTable, newPath);
  result = CheckLastError("TollAdvertisementMessage", gkFuncRefGet, result);

  return result;
}

int SetTollAdvertisementMessageTimeChargesTableParams(LONG packetHandle, struct TollAdvertisementMessageTimeChargesTable value, char oldPath[])
{
  char newPath[300];
  int result;

  result = 0;

  snprintf(newPath, elcount(newPath), "%s.%s", oldPath, "maxTime");
  if (value.maxTime < 1)
  {
    C2xSetTokenInt(packetHandle, "TollAdvertisementMessage", newPath, 1);
  }
  else if (value.maxTime > 1440)
  {
    C2xSetTokenInt(packetHandle, "TollAdvertisementMessage", newPath, 1440);
  }
  else
  {
    C2xSetTokenInt(packetHandle, "TollAdvertisementMessage", newPath, value.maxTime);
  }
  result = CheckLastError("TollAdvertisementMessage", gkFuncRefGet, result);

  snprintf(newPath, elcount(newPath), "%s.%s", oldPath, "chargesTable");
  SetTollAdvertisementMessageChargesTableParams(packetHandle, value.chargesTable, newPath);
  result = CheckLastError("TollAdvertisementMessage", gkFuncRefGet, result);

  return result;
}

int GetTollAdvertisementMessageTollChargesTable_tollTypeChargeParams(LONG packetHandle, struct TollAdvertisementMessageTollChargesTable_tollTypeCharge value, char oldPath[])
{
  char newPath[300];
  int result;

  result = 0;

  value.choice = C2xGetTokenInt(packetHandle, "TollAdvertisementMessage", oldPath);

  switch(value.choice)
  {
    case 0:
    {
      snprintf(newPath, elcount(newPath), "%s.%s", oldPath, "pointCharges");
      GetTollAdvertisementMessageChargesTableParams(packetHandle, value.pointCharges, newPath);
      result = CheckLastError("TollAdvertisementMessage", gkFuncRefGet, result);
    }
    break;
    case 1:
    {
      snprintf(newPath, elcount(newPath), "%s.%s", oldPath, "perLaneCharges");
      GetTollAdvertisementMessageTollChargesTable_tollTypeCharge_perLaneChargesParams(packetHandle, value.perLaneCharges, newPath);
      result = CheckLastError("TollAdvertisementMessage", gkFuncRefGet, result);
    }
    break;
    case 2:
    {
      snprintf(newPath, elcount(newPath), "%s.%s", oldPath, "closedNetworkCharges");
      GetTollAdvertisementMessageTollChargesTable_tollTypeCharge_closedNetworkChargesParams(packetHandle, value.closedNetworkCharges, newPath);
      result = CheckLastError("TollAdvertisementMessage", gkFuncRefGet, result);
    }
    break;
    case 3:
    {
      snprintf(newPath, elcount(newPath), "%s.%s", oldPath, "timeBasedCharges");
      GetTollAdvertisementMessageTimeChargesTableParams(packetHandle, value.timeBasedCharges, newPath);
      result = CheckLastError("TollAdvertisementMessage", gkFuncRefGet, result);
    }
    break;
  }
  return result;
}

int SetTollAdvertisementMessageTollChargesTable_tollTypeChargeParams(LONG packetHandle, struct TollAdvertisementMessageTollChargesTable_tollTypeCharge value, char oldPath[])
{
  char newPath[300];
  int result;

  result = 0;

  switch(value.choice)
  {
    case 0:
    {
      snprintf(newPath, elcount(newPath), "%s.%s", oldPath, "pointCharges");
      SetTollAdvertisementMessageChargesTableParams(packetHandle, value.pointCharges, newPath);
      result = CheckLastError("TollAdvertisementMessage", gkFuncRefGet, result);
    }
    break;
    case 1:
    {
      snprintf(newPath, elcount(newPath), "%s.%s", oldPath, "perLaneCharges");
      SetTollAdvertisementMessageTollChargesTable_tollTypeCharge_perLaneChargesParams(packetHandle, value.perLaneCharges, newPath);
      result = CheckLastError("TollAdvertisementMessage", gkFuncRefGet, result);
    }
    break;
    case 2:
    {
      snprintf(newPath, elcount(newPath), "%s.%s", oldPath, "closedNetworkCharges");
      SetTollAdvertisementMessageTollChargesTable_tollTypeCharge_closedNetworkChargesParams(packetHandle, value.closedNetworkCharges, newPath);
      result = CheckLastError("TollAdvertisementMessage", gkFuncRefGet, result);
    }
    break;
    case 3:
    {
      snprintf(newPath, elcount(newPath), "%s.%s", oldPath, "timeBasedCharges");
      SetTollAdvertisementMessageTimeChargesTableParams(packetHandle, value.timeBasedCharges, newPath);
      result = CheckLastError("TollAdvertisementMessage", gkFuncRefGet, result);
    }
    break;
  }
  return result;
}

int GetTollAdvertisementMessageTollChargesTableParams(LONG packetHandle, struct TollAdvertisementMessageTollChargesTable value, char oldPath[])
{
  char newPath[300];
  int result;

  result = 0;

  snprintf(newPath, elcount(newPath), "%s.%s", oldPath, "tollTypeCharge");
  GetTollAdvertisementMessageTollChargesTable_tollTypeChargeParams(packetHandle, value.tollTypeCharge, newPath);
  result = CheckLastError("TollAdvertisementMessage", gkFuncRefGet, result);

  return result;
}

int SetTollAdvertisementMessageTollChargesTableParams(LONG packetHandle, struct TollAdvertisementMessageTollChargesTable value, char oldPath[])
{
  char newPath[300];
  int result;

  result = 0;

  snprintf(newPath, elcount(newPath), "%s.%s", oldPath, "tollTypeCharge");
  SetTollAdvertisementMessageTollChargesTable_tollTypeChargeParams(packetHandle, value.tollTypeCharge, newPath);
  result = CheckLastError("TollAdvertisementMessage", gkFuncRefGet, result);

  return result;
}

int GetTollAdvertisementMessageTollChargerInfoParams(LONG packetHandle, struct TollAdvertisementMessageTollChargerInfo value, char oldPath[])
{
  char newPath[300];
  int i;
  int result;

  result = 0;

  snprintf(newPath, elcount(newPath), "%s.%s", oldPath, "tollChargerId");
  value.tollChargerId.length = C2xGetTokenInt(packetHandle, "TollAdvertisementMessage", newPath);
  if((result = CheckLastError("TollAdvertisementMessage", gkFuncRefGet, result))==0)
  {
    if(value.tollChargerId.length > 0)
    {
      for(i=0; i<value.tollChargerId.length; i++)
      {
        value.tollChargerId.arrayValue[i].id = C2xGetTokenOidElement(packetHandle, "TollAdvertisementMessage", newPath, i);
      }
    }
  }
  snprintf(newPath, elcount(newPath), "%s.%s", oldPath, "tollPointId");
  value.tollPointId = C2xGetTokenInt(packetHandle, "TollAdvertisementMessage", newPath);
  result = CheckLastError("TollAdvertisementMessage", gkFuncRefGet, result);

  snprintf(newPath, elcount(newPath), "%s.%s", oldPath, "descriptiveName");
  value.descriptiveName.isValidFlag = C2xIsTokenAvailable(packetHandle, "TollAdvertisementMessage", newPath);
  if(value.descriptiveName.isValidFlag==1)
  {
    value.descriptiveName.stringLength = C2xGetTokenData(packetHandle, "TollAdvertisementMessage", newPath, elcount(value.descriptiveName.string), value.descriptiveName.string);
    result = CheckLastError("TollAdvertisementMessage", gkFuncRefGet, result);
  }
  return result;
}

int SetTollAdvertisementMessageTollChargerInfoParams(LONG packetHandle, struct TollAdvertisementMessageTollChargerInfo value, char oldPath[])
{
  char newPath[300];
  int i;
  int result;

  result = 0;

  snprintf(newPath, elcount(newPath), "%s.%s", oldPath, "tollChargerId");
  C2xRemoveToken(packetHandle, "TollAdvertisementMessage", newPath);
  if(value.tollChargerId.length > 0)
  {
    for(i=0; i<value.tollChargerId.length; i++)
    {
      C2xSetTokenOidElement(packetHandle, "TollAdvertisementMessage", newPath, i, value.tollChargerId.arrayValue[i].id);
    }
  }
  result = CheckLastError("TollAdvertisementMessage", gkFuncRefGet, result);

  snprintf(newPath, elcount(newPath), "%s.%s", oldPath, "tollPointId");
  if (value.tollPointId < 1)
  {
    C2xSetTokenInt(packetHandle, "TollAdvertisementMessage", newPath, 1);
  }
  else if (value.tollPointId > 2048)
  {
    C2xSetTokenInt(packetHandle, "TollAdvertisementMessage", newPath, 2048);
  }
  else
  {
    C2xSetTokenInt(packetHandle, "TollAdvertisementMessage", newPath, value.tollPointId);
  }
  result = CheckLastError("TollAdvertisementMessage", gkFuncRefGet, result);

  snprintf(newPath, elcount(newPath), "%s.%s", oldPath, "descriptiveName");
  if(value.descriptiveName.isValidFlag==1)
  {
    C2xSetTokenData(packetHandle, "TollAdvertisementMessage", newPath, value.descriptiveName.stringLength, value.descriptiveName.string);
    result = CheckLastError("TollAdvertisementMessage", gkFuncRefGet, result);
  }
  else
  {
    if( C2xIsTokenAvailable(packetHandle, "TollAdvertisementMessage", newPath) )
    {
      C2xRemoveToken(packetHandle, "TollAdvertisementMessage", newPath);
    }
  }

  return result;
}

int GetTollAdvertisementMessageCommon_DDateTimeParams(LONG packetHandle, struct TollAdvertisementMessageCommon_DDateTime value, char oldPath[])
{
  char newPath[300];
  int result;

  result = 0;

  snprintf(newPath, elcount(newPath), "%s.%s", oldPath, "year");
  value.year.isValidFlag = C2xIsTokenAvailable(packetHandle, "TollAdvertisementMessage", newPath);
  if(value.year.isValidFlag==1)
  {
    value.year.value = C2xGetTokenInt(packetHandle, "TollAdvertisementMessage", newPath);
    result = CheckLastError("TollAdvertisementMessage", gkFuncRefGet, result);
  }
  snprintf(newPath, elcount(newPath), "%s.%s", oldPath, "month");
  value.month.isValidFlag = C2xIsTokenAvailable(packetHandle, "TollAdvertisementMessage", newPath);
  if(value.month.isValidFlag==1)
  {
    value.month.value = C2xGetTokenInt(packetHandle, "TollAdvertisementMessage", newPath);
    result = CheckLastError("TollAdvertisementMessage", gkFuncRefGet, result);
  }
  snprintf(newPath, elcount(newPath), "%s.%s", oldPath, "day");
  value.day.isValidFlag = C2xIsTokenAvailable(packetHandle, "TollAdvertisementMessage", newPath);
  if(value.day.isValidFlag==1)
  {
    value.day.value = C2xGetTokenInt(packetHandle, "TollAdvertisementMessage", newPath);
    result = CheckLastError("TollAdvertisementMessage", gkFuncRefGet, result);
  }
  snprintf(newPath, elcount(newPath), "%s.%s", oldPath, "hour");
  value.hour.isValidFlag = C2xIsTokenAvailable(packetHandle, "TollAdvertisementMessage", newPath);
  if(value.hour.isValidFlag==1)
  {
    value.hour.value = C2xGetTokenInt(packetHandle, "TollAdvertisementMessage", newPath);
    result = CheckLastError("TollAdvertisementMessage", gkFuncRefGet, result);
  }
  snprintf(newPath, elcount(newPath), "%s.%s", oldPath, "minute");
  value.minute.isValidFlag = C2xIsTokenAvailable(packetHandle, "TollAdvertisementMessage", newPath);
  if(value.minute.isValidFlag==1)
  {
    value.minute.value = C2xGetTokenInt(packetHandle, "TollAdvertisementMessage", newPath);
    result = CheckLastError("TollAdvertisementMessage", gkFuncRefGet, result);
  }
  snprintf(newPath, elcount(newPath), "%s.%s", oldPath, "second");
  value.second.isValidFlag = C2xIsTokenAvailable(packetHandle, "TollAdvertisementMessage", newPath);
  if(value.second.isValidFlag==1)
  {
    value.second.value = C2xGetTokenInt(packetHandle, "TollAdvertisementMessage", newPath);
    result = CheckLastError("TollAdvertisementMessage", gkFuncRefGet, result);
  }
  snprintf(newPath, elcount(newPath), "%s.%s", oldPath, "offset");
  value.offset.isValidFlag = C2xIsTokenAvailable(packetHandle, "TollAdvertisementMessage", newPath);
  if(value.offset.isValidFlag==1)
  {
    value.offset.value = C2xGetTokenInt(packetHandle, "TollAdvertisementMessage", newPath);
    result = CheckLastError("TollAdvertisementMessage", gkFuncRefGet, result);
  }
  return result;
}

int SetTollAdvertisementMessageCommon_DDateTimeParams(LONG packetHandle, struct TollAdvertisementMessageCommon_DDateTime value, char oldPath[])
{
  char newPath[300];
  int result;

  result = 0;

  snprintf(newPath, elcount(newPath), "%s.%s", oldPath, "year");
  if(value.year.isValidFlag==1)
  {
    C2xSetTokenInt(packetHandle, "TollAdvertisementMessage", newPath, value.year.value);
    result = CheckLastError("TollAdvertisementMessage", gkFuncRefGet, result);
  }
  else
  {
    if( C2xIsTokenAvailable(packetHandle, "TollAdvertisementMessage", newPath) )
    {
      C2xRemoveToken(packetHandle, "TollAdvertisementMessage", newPath);
    }
  }

  snprintf(newPath, elcount(newPath), "%s.%s", oldPath, "month");
  if(value.month.isValidFlag==1)
  {
    C2xSetTokenInt(packetHandle, "TollAdvertisementMessage", newPath, value.month.value);
    result = CheckLastError("TollAdvertisementMessage", gkFuncRefGet, result);
  }
  else
  {
    if( C2xIsTokenAvailable(packetHandle, "TollAdvertisementMessage", newPath) )
    {
      C2xRemoveToken(packetHandle, "TollAdvertisementMessage", newPath);
    }
  }

  snprintf(newPath, elcount(newPath), "%s.%s", oldPath, "day");
  if(value.day.isValidFlag==1)
  {
    C2xSetTokenInt(packetHandle, "TollAdvertisementMessage", newPath, value.day.value);
    result = CheckLastError("TollAdvertisementMessage", gkFuncRefGet, result);
  }
  else
  {
    if( C2xIsTokenAvailable(packetHandle, "TollAdvertisementMessage", newPath) )
    {
      C2xRemoveToken(packetHandle, "TollAdvertisementMessage", newPath);
    }
  }

  snprintf(newPath, elcount(newPath), "%s.%s", oldPath, "hour");
  if(value.hour.isValidFlag==1)
  {
    C2xSetTokenInt(packetHandle, "TollAdvertisementMessage", newPath, value.hour.value);
    result = CheckLastError("TollAdvertisementMessage", gkFuncRefGet, result);
  }
  else
  {
    if( C2xIsTokenAvailable(packetHandle, "TollAdvertisementMessage", newPath) )
    {
      C2xRemoveToken(packetHandle, "TollAdvertisementMessage", newPath);
    }
  }

  snprintf(newPath, elcount(newPath), "%s.%s", oldPath, "minute");
  if(value.minute.isValidFlag==1)
  {
    C2xSetTokenInt(packetHandle, "TollAdvertisementMessage", newPath, value.minute.value);
    result = CheckLastError("TollAdvertisementMessage", gkFuncRefGet, result);
  }
  else
  {
    if( C2xIsTokenAvailable(packetHandle, "TollAdvertisementMessage", newPath) )
    {
      C2xRemoveToken(packetHandle, "TollAdvertisementMessage", newPath);
    }
  }

  snprintf(newPath, elcount(newPath), "%s.%s", oldPath, "second");
  if(value.second.isValidFlag==1)
  {
    C2xSetTokenInt(packetHandle, "TollAdvertisementMessage", newPath, value.second.value);
    result = CheckLastError("TollAdvertisementMessage", gkFuncRefGet, result);
  }
  else
  {
    if( C2xIsTokenAvailable(packetHandle, "TollAdvertisementMessage", newPath) )
    {
      C2xRemoveToken(packetHandle, "TollAdvertisementMessage", newPath);
    }
  }

  snprintf(newPath, elcount(newPath), "%s.%s", oldPath, "offset");
  if(value.offset.isValidFlag==1)
  {
    C2xSetTokenInt(packetHandle, "TollAdvertisementMessage", newPath, value.offset.value);
    result = CheckLastError("TollAdvertisementMessage", gkFuncRefGet, result);
  }
  else
  {
    if( C2xIsTokenAvailable(packetHandle, "TollAdvertisementMessage", newPath) )
    {
      C2xRemoveToken(packetHandle, "TollAdvertisementMessage", newPath);
    }
  }

  return result;
}

int GetTollAdvertisementMessageTumInstructionsParams(LONG packetHandle, struct TollAdvertisementMessageTumInstructions value, char oldPath[])
{
  char newPath[300];
  int result;

  result = 0;

  snprintf(newPath, elcount(newPath), "%s.%s", oldPath, "maxNumOfLocTimeStamps");
  value.maxNumOfLocTimeStamps = C2xGetTokenInt(packetHandle, "TollAdvertisementMessage", newPath);
  result = CheckLastError("TollAdvertisementMessage", gkFuncRefGet, result);

  snprintf(newPath, elcount(newPath), "%s.%s", oldPath, "locTimeStampRate");
  value.locTimeStampRate = C2xGetTokenInt(packetHandle, "TollAdvertisementMessage", newPath);
  result = CheckLastError("TollAdvertisementMessage", gkFuncRefGet, result);

  return result;
}

int SetTollAdvertisementMessageTumInstructionsParams(LONG packetHandle, struct TollAdvertisementMessageTumInstructions value, char oldPath[])
{
  char newPath[300];
  int result;

  result = 0;

  snprintf(newPath, elcount(newPath), "%s.%s", oldPath, "maxNumOfLocTimeStamps");
  if (value.maxNumOfLocTimeStamps < 1)
  {
    C2xSetTokenInt(packetHandle, "TollAdvertisementMessage", newPath, 1);
  }
  else if (value.maxNumOfLocTimeStamps > 5)
  {
    C2xSetTokenInt(packetHandle, "TollAdvertisementMessage", newPath, 5);
  }
  else
  {
    C2xSetTokenInt(packetHandle, "TollAdvertisementMessage", newPath, value.maxNumOfLocTimeStamps);
  }
  result = CheckLastError("TollAdvertisementMessage", gkFuncRefGet, result);

  snprintf(newPath, elcount(newPath), "%s.%s", oldPath, "locTimeStampRate");
  if (value.locTimeStampRate < 1)
  {
    C2xSetTokenInt(packetHandle, "TollAdvertisementMessage", newPath, 1);
  }
  else if (value.locTimeStampRate > 10)
  {
    C2xSetTokenInt(packetHandle, "TollAdvertisementMessage", newPath, 10);
  }
  else
  {
    C2xSetTokenInt(packetHandle, "TollAdvertisementMessage", newPath, value.locTimeStampRate);
  }
  result = CheckLastError("TollAdvertisementMessage", gkFuncRefGet, result);

  return result;
}

int GetTollAdvertisementMessageAddGrpB_LatitudeDMS2Params(LONG packetHandle, struct TollAdvertisementMessageAddGrpB_LatitudeDMS2 value, char oldPath[])
{
  char newPath[300];
  int result;

  result = 0;

  snprintf(newPath, elcount(newPath), "%s.%s", oldPath, "d");
  value.d = C2xGetTokenInt(packetHandle, "TollAdvertisementMessage", newPath);
  result = CheckLastError("TollAdvertisementMessage", gkFuncRefGet, result);

  snprintf(newPath, elcount(newPath), "%s.%s", oldPath, "m");
  value.m = C2xGetTokenInt(packetHandle, "TollAdvertisementMessage", newPath);
  result = CheckLastError("TollAdvertisementMessage", gkFuncRefGet, result);

  snprintf(newPath, elcount(newPath), "%s.%s", oldPath, "s");
  value.s = C2xGetTokenInt(packetHandle, "TollAdvertisementMessage", newPath);
  result = CheckLastError("TollAdvertisementMessage", gkFuncRefGet, result);

  return result;
}

int SetTollAdvertisementMessageAddGrpB_LatitudeDMS2Params(LONG packetHandle, struct TollAdvertisementMessageAddGrpB_LatitudeDMS2 value, char oldPath[])
{
  char newPath[300];
  int result;

  result = 0;

  snprintf(newPath, elcount(newPath), "%s.%s", oldPath, "d");
  C2xSetTokenInt(packetHandle, "TollAdvertisementMessage", newPath, value.d);
  result = CheckLastError("TollAdvertisementMessage", gkFuncRefGet, result);

  snprintf(newPath, elcount(newPath), "%s.%s", oldPath, "m");
  C2xSetTokenInt(packetHandle, "TollAdvertisementMessage", newPath, value.m);
  result = CheckLastError("TollAdvertisementMessage", gkFuncRefGet, result);

  snprintf(newPath, elcount(newPath), "%s.%s", oldPath, "s");
  C2xSetTokenInt(packetHandle, "TollAdvertisementMessage", newPath, value.s);
  result = CheckLastError("TollAdvertisementMessage", gkFuncRefGet, result);

  return result;
}

int GetTollAdvertisementMessageAddGrpB_LongitudeDMS2Params(LONG packetHandle, struct TollAdvertisementMessageAddGrpB_LongitudeDMS2 value, char oldPath[])
{
  char newPath[300];
  int result;

  result = 0;

  snprintf(newPath, elcount(newPath), "%s.%s", oldPath, "d");
  value.d = C2xGetTokenInt(packetHandle, "TollAdvertisementMessage", newPath);
  result = CheckLastError("TollAdvertisementMessage", gkFuncRefGet, result);

  snprintf(newPath, elcount(newPath), "%s.%s", oldPath, "m");
  value.m = C2xGetTokenInt(packetHandle, "TollAdvertisementMessage", newPath);
  result = CheckLastError("TollAdvertisementMessage", gkFuncRefGet, result);

  snprintf(newPath, elcount(newPath), "%s.%s", oldPath, "s");
  value.s = C2xGetTokenInt(packetHandle, "TollAdvertisementMessage", newPath);
  result = CheckLastError("TollAdvertisementMessage", gkFuncRefGet, result);

  return result;
}

int SetTollAdvertisementMessageAddGrpB_LongitudeDMS2Params(LONG packetHandle, struct TollAdvertisementMessageAddGrpB_LongitudeDMS2 value, char oldPath[])
{
  char newPath[300];
  int result;

  result = 0;

  snprintf(newPath, elcount(newPath), "%s.%s", oldPath, "d");
  C2xSetTokenInt(packetHandle, "TollAdvertisementMessage", newPath, value.d);
  result = CheckLastError("TollAdvertisementMessage", gkFuncRefGet, result);

  snprintf(newPath, elcount(newPath), "%s.%s", oldPath, "m");
  C2xSetTokenInt(packetHandle, "TollAdvertisementMessage", newPath, value.m);
  result = CheckLastError("TollAdvertisementMessage", gkFuncRefGet, result);

  snprintf(newPath, elcount(newPath), "%s.%s", oldPath, "s");
  C2xSetTokenInt(packetHandle, "TollAdvertisementMessage", newPath, value.s);
  result = CheckLastError("TollAdvertisementMessage", gkFuncRefGet, result);

  return result;
}

int GetTollAdvertisementMessageAddGrpB_Position3D_addGrpBParams(LONG packetHandle, struct TollAdvertisementMessageAddGrpB_Position3D_addGrpB value, char oldPath[])
{
  char newPath[300];
  int result;

  result = 0;

  snprintf(newPath, elcount(newPath), "%s.%s", oldPath, "latitude");
  GetTollAdvertisementMessageAddGrpB_LatitudeDMS2Params(packetHandle, value.latitude, newPath);
  result = CheckLastError("TollAdvertisementMessage", gkFuncRefGet, result);

  snprintf(newPath, elcount(newPath), "%s.%s", oldPath, "longitude");
  GetTollAdvertisementMessageAddGrpB_LongitudeDMS2Params(packetHandle, value.longitude, newPath);
  result = CheckLastError("TollAdvertisementMessage", gkFuncRefGet, result);

  snprintf(newPath, elcount(newPath), "%s.%s", oldPath, "elevation");
  value.elevation = C2xGetTokenInt(packetHandle, "TollAdvertisementMessage", newPath);
  result = CheckLastError("TollAdvertisementMessage", gkFuncRefGet, result);

  return result;
}

int SetTollAdvertisementMessageAddGrpB_Position3D_addGrpBParams(LONG packetHandle, struct TollAdvertisementMessageAddGrpB_Position3D_addGrpB value, char oldPath[])
{
  char newPath[300];
  int result;

  result = 0;

  snprintf(newPath, elcount(newPath), "%s.%s", oldPath, "latitude");
  SetTollAdvertisementMessageAddGrpB_LatitudeDMS2Params(packetHandle, value.latitude, newPath);
  result = CheckLastError("TollAdvertisementMessage", gkFuncRefGet, result);

  snprintf(newPath, elcount(newPath), "%s.%s", oldPath, "longitude");
  SetTollAdvertisementMessageAddGrpB_LongitudeDMS2Params(packetHandle, value.longitude, newPath);
  result = CheckLastError("TollAdvertisementMessage", gkFuncRefGet, result);

  snprintf(newPath, elcount(newPath), "%s.%s", oldPath, "elevation");
  C2xSetTokenInt(packetHandle, "TollAdvertisementMessage", newPath, value.elevation);
  result = CheckLastError("TollAdvertisementMessage", gkFuncRefGet, result);

  return result;
}

int GetTollAdvertisementMessageAddGrpC_AltitudeParams(LONG packetHandle, struct TollAdvertisementMessageAddGrpC_Altitude value, char oldPath[])
{
  char newPath[300];
  int result;

  result = 0;

  snprintf(newPath, elcount(newPath), "%s.%s", oldPath, "value");
  value.value = C2xGetTokenInt(packetHandle, "TollAdvertisementMessage", newPath);
  result = CheckLastError("TollAdvertisementMessage", gkFuncRefGet, result);

  snprintf(newPath, elcount(newPath), "%s.%s", oldPath, "confidence");
  value.confidence = C2xGetTokenInt(packetHandle, "TollAdvertisementMessage", newPath);
  result = CheckLastError("TollAdvertisementMessage", gkFuncRefGet, result);

  return result;
}

int SetTollAdvertisementMessageAddGrpC_AltitudeParams(LONG packetHandle, struct TollAdvertisementMessageAddGrpC_Altitude value, char oldPath[])
{
  char newPath[300];
  int result;

  result = 0;

  snprintf(newPath, elcount(newPath), "%s.%s", oldPath, "value");
  C2xSetTokenInt(packetHandle, "TollAdvertisementMessage", newPath, value.value);
  result = CheckLastError("TollAdvertisementMessage", gkFuncRefGet, result);

  snprintf(newPath, elcount(newPath), "%s.%s", oldPath, "confidence");
  C2xSetTokenInt(packetHandle, "TollAdvertisementMessage", newPath, value.confidence);
  result = CheckLastError("TollAdvertisementMessage", gkFuncRefGet, result);

  return result;
}

int GetTollAdvertisementMessageAddGrpC_Position3D_addGrpCParams(LONG packetHandle, struct TollAdvertisementMessageAddGrpC_Position3D_addGrpC value, char oldPath[])
{
  char newPath[300];
  int result;

  result = 0;

  snprintf(newPath, elcount(newPath), "%s.%s", oldPath, "altitude");
  GetTollAdvertisementMessageAddGrpC_AltitudeParams(packetHandle, value.altitude, newPath);
  result = CheckLastError("TollAdvertisementMessage", gkFuncRefGet, result);

  return result;
}

int SetTollAdvertisementMessageAddGrpC_Position3D_addGrpCParams(LONG packetHandle, struct TollAdvertisementMessageAddGrpC_Position3D_addGrpC value, char oldPath[])
{
  char newPath[300];
  int result;

  result = 0;

  snprintf(newPath, elcount(newPath), "%s.%s", oldPath, "altitude");
  SetTollAdvertisementMessageAddGrpC_AltitudeParams(packetHandle, value.altitude, newPath);
  result = CheckLastError("TollAdvertisementMessage", gkFuncRefGet, result);

  return result;
}

int GetTollAdvertisementMessageCommon_RegionalExtension_Reg_Position3D_tableParams(LONG packetHandle, WORD tableKey, struct TollAdvertisementMessageCommon_RegionalExtension_Reg_Position3D_table value, char oldPath[])
{
  char newPath[300];
  int result;

  result = 0;

  switch(tableKey)
  {
    case 2:
    {
      snprintf(newPath, elcount(newPath), "%s.%s", oldPath, "addGrpB");
      GetTollAdvertisementMessageAddGrpB_Position3D_addGrpBParams(packetHandle, value.addGrpB, newPath);
      result = CheckLastError("TollAdvertisementMessage", gkFuncRefGet, result);
    }
    break;
    case 3:
    {
      snprintf(newPath, elcount(newPath), "%s.%s", oldPath, "addGrpC");
      GetTollAdvertisementMessageAddGrpC_Position3D_addGrpCParams(packetHandle, value.addGrpC, newPath);
      result = CheckLastError("TollAdvertisementMessage", gkFuncRefGet, result);
    }
    break;
  }
  return result;
}

int SetTollAdvertisementMessageCommon_RegionalExtension_Reg_Position3D_tableParams(LONG packetHandle, WORD tableKey, struct TollAdvertisementMessageCommon_RegionalExtension_Reg_Position3D_table value, char oldPath[])
{
  char newPath[300];
  int result;

  result = 0;

  switch(tableKey)
  {
    case 2:
    {
      snprintf(newPath, elcount(newPath), "%s.%s", oldPath, "addGrpB");
      SetTollAdvertisementMessageAddGrpB_Position3D_addGrpBParams(packetHandle, value.addGrpB, newPath);
      result = CheckLastError("TollAdvertisementMessage", gkFuncRefGet, result);
    }
    break;
    case 3:
    {
      snprintf(newPath, elcount(newPath), "%s.%s", oldPath, "addGrpC");
      SetTollAdvertisementMessageAddGrpC_Position3D_addGrpCParams(packetHandle, value.addGrpC, newPath);
      result = CheckLastError("TollAdvertisementMessage", gkFuncRefGet, result);
    }
    break;
  }
  return result;
}

int GetTollAdvertisementMessageCommon_RegionalExtension_Reg_Position3DParams(LONG packetHandle, struct TollAdvertisementMessageCommon_RegionalExtension_Reg_Position3D value, char oldPath[])
{
  char newPath[300];
  int result;

  result = 0;

  snprintf(newPath, elcount(newPath), "%s.%s", oldPath, "regionId");
  value.regionId = C2xGetTokenInt(packetHandle, "TollAdvertisementMessage", newPath);
  result = CheckLastError("TollAdvertisementMessage", gkFuncRefGet, result);

  snprintf(newPath, elcount(newPath), "%s.%s", oldPath, "regExtvalue");
  GetTollAdvertisementMessageCommon_RegionalExtension_Reg_Position3D_tableParams(packetHandle, value.regionId, value.regExtvalue, newPath);
  result = CheckLastError("TollAdvertisementMessage", gkFuncRefGet, result);

  return result;
}

int SetTollAdvertisementMessageCommon_RegionalExtension_Reg_Position3DParams(LONG packetHandle, struct TollAdvertisementMessageCommon_RegionalExtension_Reg_Position3D value, char oldPath[])
{
  char newPath[300];
  int result;

  result = 0;


  snprintf(newPath, elcount(newPath), "%s.%s", oldPath, "regExtvalue");
  SetTollAdvertisementMessageCommon_RegionalExtension_Reg_Position3D_tableParams(packetHandle, value.regionId, value.regExtvalue, newPath);
  result = CheckLastError("TollAdvertisementMessage", gkFuncRefGet, result);

  return result;
}

int GetTollAdvertisementMessageCommon_Position3D_regionalParams(LONG packetHandle, struct TollAdvertisementMessageCommon_Position3D_regional value, char oldPath[])
{
  char newPath[300]; 
  int i;
  int result;

  result = 0;

  value.length = C2xGetTokenInt(packetHandle, "TollAdvertisementMessage", oldPath);
  if((result = CheckLastError("TollAdvertisementMessage", gkFuncRefGet, result))==0)
  {
    for(i=0; i<value.length; i++)
    {
      snprintf(newPath, elcount(newPath), "%s[%d]", oldPath, i);
      GetTollAdvertisementMessageCommon_RegionalExtension_Reg_Position3DParams(packetHandle, value.arrayValue[i], newPath);
      result = CheckLastError("TollAdvertisementMessage", gkFuncRefGet, result);
    }
  }
  return result;
}

int SetTollAdvertisementMessageCommon_Position3D_regionalParams(LONG packetHandle, struct TollAdvertisementMessageCommon_Position3D_regional value, char oldPath[])
{
  char newPath[300]; 
  int i;
  int result;

  result = 0;

  C2xRemoveToken(packetHandle, "TollAdvertisementMessage", oldPath);
  for(i=0; i<value.length; i++)
  {
    snprintf(newPath, elcount(newPath), "%s[%d]", oldPath, i);
    SetTollAdvertisementMessageCommon_RegionalExtension_Reg_Position3DParams(packetHandle, value.arrayValue[i], newPath);
    result = CheckLastError("TollAdvertisementMessage", gkFuncRefGet, result);
  }
  return result;
}

int GetTollAdvertisementMessageCommon_Position3DParams(LONG packetHandle, struct TollAdvertisementMessageCommon_Position3D value, char oldPath[])
{
  char newPath[300];
  int result;

  result = 0;

  snprintf(newPath, elcount(newPath), "%s.%s", oldPath, "lat");
  value.lat = C2xGetTokenInt(packetHandle, "TollAdvertisementMessage", newPath);
  result = CheckLastError("TollAdvertisementMessage", gkFuncRefGet, result);

  snprintf(newPath, elcount(newPath), "%s.%s", oldPath, "lon");
  value.lon = C2xGetTokenInt(packetHandle, "TollAdvertisementMessage", newPath);
  result = CheckLastError("TollAdvertisementMessage", gkFuncRefGet, result);

  snprintf(newPath, elcount(newPath), "%s.%s", oldPath, "elevation");
  value.elevation.isValidFlag = C2xIsTokenAvailable(packetHandle, "TollAdvertisementMessage", newPath);
  if(value.elevation.isValidFlag==1)
  {
    value.elevation.value = C2xGetTokenInt(packetHandle, "TollAdvertisementMessage", newPath);
    result = CheckLastError("TollAdvertisementMessage", gkFuncRefGet, result);
  }
  snprintf(newPath, elcount(newPath), "%s.%s", oldPath, "regional");
  value.regional.isValidFlag = C2xIsTokenAvailable(packetHandle, "TollAdvertisementMessage", newPath);
  if(value.regional.isValidFlag==1)
  {
    GetTollAdvertisementMessageCommon_Position3D_regionalParams(packetHandle, value.regional, newPath);
    result = CheckLastError("TollAdvertisementMessage", gkFuncRefGet, result);
  }
  return result;
}

int SetTollAdvertisementMessageCommon_Position3DParams(LONG packetHandle, struct TollAdvertisementMessageCommon_Position3D value, char oldPath[])
{
  char newPath[300];
  int result;

  result = 0;

  snprintf(newPath, elcount(newPath), "%s.%s", oldPath, "lat");
  C2xSetTokenInt(packetHandle, "TollAdvertisementMessage", newPath, value.lat);
  result = CheckLastError("TollAdvertisementMessage", gkFuncRefGet, result);

  snprintf(newPath, elcount(newPath), "%s.%s", oldPath, "lon");
  C2xSetTokenInt(packetHandle, "TollAdvertisementMessage", newPath, value.lon);
  result = CheckLastError("TollAdvertisementMessage", gkFuncRefGet, result);

  snprintf(newPath, elcount(newPath), "%s.%s", oldPath, "elevation");
  if(value.elevation.isValidFlag==1)
  {
    C2xSetTokenInt(packetHandle, "TollAdvertisementMessage", newPath, value.elevation.value);
    result = CheckLastError("TollAdvertisementMessage", gkFuncRefGet, result);
  }
  else
  {
    if( C2xIsTokenAvailable(packetHandle, "TollAdvertisementMessage", newPath) )
    {
      C2xRemoveToken(packetHandle, "TollAdvertisementMessage", newPath);
    }
  }

  snprintf(newPath, elcount(newPath), "%s.%s", oldPath, "regional");
  if(value.regional.isValidFlag==1)
  {
    SetTollAdvertisementMessageCommon_Position3D_regionalParams(packetHandle, value.regional, newPath);
    result = CheckLastError("TollAdvertisementMessage", gkFuncRefGet, result);
  }
  else
  {
    if( C2xIsTokenAvailable(packetHandle, "TollAdvertisementMessage", newPath) )
    {
      C2xRemoveToken(packetHandle, "TollAdvertisementMessage", newPath);
    }
  }

  return result;
}

int GetTollAdvertisementMessageCommon_RegulatorySpeedLimitParams(LONG packetHandle, struct TollAdvertisementMessageCommon_RegulatorySpeedLimit value, char oldPath[])
{
  char newPath[300];
  int result;

  result = 0;

  snprintf(newPath, elcount(newPath), "%s.%s", oldPath, "type");
  value.type = C2xGetTokenInt(packetHandle, "TollAdvertisementMessage", newPath);
  result = CheckLastError("TollAdvertisementMessage", gkFuncRefGet, result);

  snprintf(newPath, elcount(newPath), "%s.%s", oldPath, "speed");
  value.speed = C2xGetTokenInt(packetHandle, "TollAdvertisementMessage", newPath);
  result = CheckLastError("TollAdvertisementMessage", gkFuncRefGet, result);

  return result;
}

int SetTollAdvertisementMessageCommon_RegulatorySpeedLimitParams(LONG packetHandle, struct TollAdvertisementMessageCommon_RegulatorySpeedLimit value, char oldPath[])
{
  char newPath[300];
  int result;

  result = 0;

  snprintf(newPath, elcount(newPath), "%s.%s", oldPath, "type");
  C2xSetTokenInt(packetHandle, "TollAdvertisementMessage", newPath, value.type);
  result = CheckLastError("TollAdvertisementMessage", gkFuncRefGet, result);

  snprintf(newPath, elcount(newPath), "%s.%s", oldPath, "speed");
  C2xSetTokenInt(packetHandle, "TollAdvertisementMessage", newPath, value.speed);
  result = CheckLastError("TollAdvertisementMessage", gkFuncRefGet, result);

  return result;
}

int GetTollAdvertisementMessageMapData_LaneTypeAttributesParams(LONG packetHandle, struct TollAdvertisementMessageMapData_LaneTypeAttributes value, char oldPath[])
{
  char newPath[300]; 
  int j;
  int result;

  result = 0;

  value.choice = C2xGetTokenInt(packetHandle, "TollAdvertisementMessage", oldPath);

  switch(value.choice)
  {
    case 0:
    {
      snprintf(newPath, elcount(newPath), "%s.%s", oldPath, "vehicle");
      value.vehicle.isValidFlag = 1;
      value.vehicle.stringLength = C2xGetTokenLengthBit(packetHandle, "TollAdvertisementMessage", newPath);
      if ((result = CheckLastError("TollAdvertisementMessage", gkFuncRefGet, result))==0)
      {
        for(j=0; j<value.vehicle.stringLength; j++)
        {
          if(C2xGetTokenBitOfBitString(packetHandle, "TollAdvertisementMessage", newPath, j) == 0)
          {
            value.vehicle.string[j] = '0';
          }
          else
          {
            value.vehicle.string[j] = '1';
          }
          result = CheckLastError("TollAdvertisementMessage", gkFuncRefGet, result);
        }
      }

      result = CheckLastError("TollAdvertisementMessage", gkFuncRefGet, result);
    }
    break;
    case 1:
    {
      snprintf(newPath, elcount(newPath), "%s.%s", oldPath, "crosswalk");
      value.crosswalk.isValidFlag = 1;
      value.crosswalk.stringLength = C2xGetTokenLengthBit(packetHandle, "TollAdvertisementMessage", newPath);
      if ((result = CheckLastError("TollAdvertisementMessage", gkFuncRefGet, result))==0)
      {
        for(j=0; j<value.crosswalk.stringLength; j++)
        {
          if(C2xGetTokenBitOfBitString(packetHandle, "TollAdvertisementMessage", newPath, j) == 0)
          {
            value.crosswalk.string[j] = '0';
          }
          else
          {
            value.crosswalk.string[j] = '1';
          }
          result = CheckLastError("TollAdvertisementMessage", gkFuncRefGet, result);
        }
      }

      result = CheckLastError("TollAdvertisementMessage", gkFuncRefGet, result);
    }
    break;
    case 2:
    {
      snprintf(newPath, elcount(newPath), "%s.%s", oldPath, "bikeLane");
      value.bikeLane.isValidFlag = 1;
      value.bikeLane.stringLength = C2xGetTokenLengthBit(packetHandle, "TollAdvertisementMessage", newPath);
      if ((result = CheckLastError("TollAdvertisementMessage", gkFuncRefGet, result))==0)
      {
        for(j=0; j<value.bikeLane.stringLength; j++)
        {
          if(C2xGetTokenBitOfBitString(packetHandle, "TollAdvertisementMessage", newPath, j) == 0)
          {
            value.bikeLane.string[j] = '0';
          }
          else
          {
            value.bikeLane.string[j] = '1';
          }
          result = CheckLastError("TollAdvertisementMessage", gkFuncRefGet, result);
        }
      }

      result = CheckLastError("TollAdvertisementMessage", gkFuncRefGet, result);
    }
    break;
    case 3:
    {
      snprintf(newPath, elcount(newPath), "%s.%s", oldPath, "sidewalk");
      value.sidewalk.isValidFlag = 1;
      value.sidewalk.stringLength = C2xGetTokenLengthBit(packetHandle, "TollAdvertisementMessage", newPath);
      if ((result = CheckLastError("TollAdvertisementMessage", gkFuncRefGet, result))==0)
      {
        for(j=0; j<value.sidewalk.stringLength; j++)
        {
          if(C2xGetTokenBitOfBitString(packetHandle, "TollAdvertisementMessage", newPath, j) == 0)
          {
            value.sidewalk.string[j] = '0';
          }
          else
          {
            value.sidewalk.string[j] = '1';
          }
          result = CheckLastError("TollAdvertisementMessage", gkFuncRefGet, result);
        }
      }

      result = CheckLastError("TollAdvertisementMessage", gkFuncRefGet, result);
    }
    break;
    case 4:
    {
      snprintf(newPath, elcount(newPath), "%s.%s", oldPath, "median");
      value.median.isValidFlag = 1;
      value.median.stringLength = C2xGetTokenLengthBit(packetHandle, "TollAdvertisementMessage", newPath);
      if ((result = CheckLastError("TollAdvertisementMessage", gkFuncRefGet, result))==0)
      {
        for(j=0; j<value.median.stringLength; j++)
        {
          if(C2xGetTokenBitOfBitString(packetHandle, "TollAdvertisementMessage", newPath, j) == 0)
          {
            value.median.string[j] = '0';
          }
          else
          {
            value.median.string[j] = '1';
          }
          result = CheckLastError("TollAdvertisementMessage", gkFuncRefGet, result);
        }
      }

      result = CheckLastError("TollAdvertisementMessage", gkFuncRefGet, result);
    }
    break;
    case 5:
    {
      snprintf(newPath, elcount(newPath), "%s.%s", oldPath, "striping");
      value.striping.isValidFlag = 1;
      value.striping.stringLength = C2xGetTokenLengthBit(packetHandle, "TollAdvertisementMessage", newPath);
      if ((result = CheckLastError("TollAdvertisementMessage", gkFuncRefGet, result))==0)
      {
        for(j=0; j<value.striping.stringLength; j++)
        {
          if(C2xGetTokenBitOfBitString(packetHandle, "TollAdvertisementMessage", newPath, j) == 0)
          {
            value.striping.string[j] = '0';
          }
          else
          {
            value.striping.string[j] = '1';
          }
          result = CheckLastError("TollAdvertisementMessage", gkFuncRefGet, result);
        }
      }

      result = CheckLastError("TollAdvertisementMessage", gkFuncRefGet, result);
    }
    break;
    case 6:
    {
      snprintf(newPath, elcount(newPath), "%s.%s", oldPath, "trackedVehicle");
      value.trackedVehicle.isValidFlag = 1;
      value.trackedVehicle.stringLength = C2xGetTokenLengthBit(packetHandle, "TollAdvertisementMessage", newPath);
      if ((result = CheckLastError("TollAdvertisementMessage", gkFuncRefGet, result))==0)
      {
        for(j=0; j<value.trackedVehicle.stringLength; j++)
        {
          if(C2xGetTokenBitOfBitString(packetHandle, "TollAdvertisementMessage", newPath, j) == 0)
          {
            value.trackedVehicle.string[j] = '0';
          }
          else
          {
            value.trackedVehicle.string[j] = '1';
          }
          result = CheckLastError("TollAdvertisementMessage", gkFuncRefGet, result);
        }
      }

      result = CheckLastError("TollAdvertisementMessage", gkFuncRefGet, result);
    }
    break;
    case 7:
    {
      snprintf(newPath, elcount(newPath), "%s.%s", oldPath, "parking");
      value.parking.isValidFlag = 1;
      value.parking.stringLength = C2xGetTokenLengthBit(packetHandle, "TollAdvertisementMessage", newPath);
      if ((result = CheckLastError("TollAdvertisementMessage", gkFuncRefGet, result))==0)
      {
        for(j=0; j<value.parking.stringLength; j++)
        {
          if(C2xGetTokenBitOfBitString(packetHandle, "TollAdvertisementMessage", newPath, j) == 0)
          {
            value.parking.string[j] = '0';
          }
          else
          {
            value.parking.string[j] = '1';
          }
          result = CheckLastError("TollAdvertisementMessage", gkFuncRefGet, result);
        }
      }

      result = CheckLastError("TollAdvertisementMessage", gkFuncRefGet, result);
    }
    break;
  }
  return result;
}

int SetTollAdvertisementMessageMapData_LaneTypeAttributesParams(LONG packetHandle, struct TollAdvertisementMessageMapData_LaneTypeAttributes value, char oldPath[])
{
  char newPath[300]; 
  int j;
  int result;

  result = 0;

  switch(value.choice)
  {
    case 0:
    {
      snprintf(newPath, elcount(newPath), "%s.%s", oldPath, "vehicle");
      for(j=0; j<value.vehicle.stringLength; j++)
      {
        if(value.vehicle.string[j] == '0')
        {
          C2xSetTokenBitOfBitString(packetHandle, "TollAdvertisementMessage", newPath, j, 0);
        }
        else
        {
          C2xSetTokenBitOfBitString(packetHandle, "TollAdvertisementMessage", newPath, j, 1);
        }
        result = CheckLastError("TollAdvertisementMessage", gkFuncRefGet, result);
      }
      result = CheckLastError("TollAdvertisementMessage", gkFuncRefGet, result);
    }
    break;
    case 1:
    {
      snprintf(newPath, elcount(newPath), "%s.%s", oldPath, "crosswalk");
      for(j=0; j<value.crosswalk.stringLength; j++)
      {
        if(value.crosswalk.string[j] == '0')
        {
          C2xSetTokenBitOfBitString(packetHandle, "TollAdvertisementMessage", newPath, j, 0);
        }
        else
        {
          C2xSetTokenBitOfBitString(packetHandle, "TollAdvertisementMessage", newPath, j, 1);
        }
        result = CheckLastError("TollAdvertisementMessage", gkFuncRefGet, result);
      }
      result = CheckLastError("TollAdvertisementMessage", gkFuncRefGet, result);
    }
    break;
    case 2:
    {
      snprintf(newPath, elcount(newPath), "%s.%s", oldPath, "bikeLane");
      for(j=0; j<value.bikeLane.stringLength; j++)
      {
        if(value.bikeLane.string[j] == '0')
        {
          C2xSetTokenBitOfBitString(packetHandle, "TollAdvertisementMessage", newPath, j, 0);
        }
        else
        {
          C2xSetTokenBitOfBitString(packetHandle, "TollAdvertisementMessage", newPath, j, 1);
        }
        result = CheckLastError("TollAdvertisementMessage", gkFuncRefGet, result);
      }
      result = CheckLastError("TollAdvertisementMessage", gkFuncRefGet, result);
    }
    break;
    case 3:
    {
      snprintf(newPath, elcount(newPath), "%s.%s", oldPath, "sidewalk");
      for(j=0; j<value.sidewalk.stringLength; j++)
      {
        if(value.sidewalk.string[j] == '0')
        {
          C2xSetTokenBitOfBitString(packetHandle, "TollAdvertisementMessage", newPath, j, 0);
        }
        else
        {
          C2xSetTokenBitOfBitString(packetHandle, "TollAdvertisementMessage", newPath, j, 1);
        }
        result = CheckLastError("TollAdvertisementMessage", gkFuncRefGet, result);
      }
      result = CheckLastError("TollAdvertisementMessage", gkFuncRefGet, result);
    }
    break;
    case 4:
    {
      snprintf(newPath, elcount(newPath), "%s.%s", oldPath, "median");
      for(j=0; j<value.median.stringLength; j++)
      {
        if(value.median.string[j] == '0')
        {
          C2xSetTokenBitOfBitString(packetHandle, "TollAdvertisementMessage", newPath, j, 0);
        }
        else
        {
          C2xSetTokenBitOfBitString(packetHandle, "TollAdvertisementMessage", newPath, j, 1);
        }
        result = CheckLastError("TollAdvertisementMessage", gkFuncRefGet, result);
      }
      result = CheckLastError("TollAdvertisementMessage", gkFuncRefGet, result);
    }
    break;
    case 5:
    {
      snprintf(newPath, elcount(newPath), "%s.%s", oldPath, "striping");
      for(j=0; j<value.striping.stringLength; j++)
      {
        if(value.striping.string[j] == '0')
        {
          C2xSetTokenBitOfBitString(packetHandle, "TollAdvertisementMessage", newPath, j, 0);
        }
        else
        {
          C2xSetTokenBitOfBitString(packetHandle, "TollAdvertisementMessage", newPath, j, 1);
        }
        result = CheckLastError("TollAdvertisementMessage", gkFuncRefGet, result);
      }
      result = CheckLastError("TollAdvertisementMessage", gkFuncRefGet, result);
    }
    break;
    case 6:
    {
      snprintf(newPath, elcount(newPath), "%s.%s", oldPath, "trackedVehicle");
      for(j=0; j<value.trackedVehicle.stringLength; j++)
      {
        if(value.trackedVehicle.string[j] == '0')
        {
          C2xSetTokenBitOfBitString(packetHandle, "TollAdvertisementMessage", newPath, j, 0);
        }
        else
        {
          C2xSetTokenBitOfBitString(packetHandle, "TollAdvertisementMessage", newPath, j, 1);
        }
        result = CheckLastError("TollAdvertisementMessage", gkFuncRefGet, result);
      }
      result = CheckLastError("TollAdvertisementMessage", gkFuncRefGet, result);
    }
    break;
    case 7:
    {
      snprintf(newPath, elcount(newPath), "%s.%s", oldPath, "parking");
      for(j=0; j<value.parking.stringLength; j++)
      {
        if(value.parking.string[j] == '0')
        {
          C2xSetTokenBitOfBitString(packetHandle, "TollAdvertisementMessage", newPath, j, 0);
        }
        else
        {
          C2xSetTokenBitOfBitString(packetHandle, "TollAdvertisementMessage", newPath, j, 1);
        }
        result = CheckLastError("TollAdvertisementMessage", gkFuncRefGet, result);
      }
      result = CheckLastError("TollAdvertisementMessage", gkFuncRefGet, result);
    }
    break;
  }
  return result;
}

int GetTollAdvertisementMessageCommon_RegionalExtension_Reg_LaneAttributesParams(LONG packetHandle, struct TollAdvertisementMessageCommon_RegionalExtension_Reg_LaneAttributes value, char oldPath[])
{
  char newPath[300];
  int result;

  result = 0;

  snprintf(newPath, elcount(newPath), "%s.%s", oldPath, "regionId");
  value.regionId = C2xGetTokenInt(packetHandle, "TollAdvertisementMessage", newPath);
  result = CheckLastError("TollAdvertisementMessage", gkFuncRefGet, result);

  return result;
}

int SetTollAdvertisementMessageCommon_RegionalExtension_Reg_LaneAttributesParams(LONG packetHandle, struct TollAdvertisementMessageCommon_RegionalExtension_Reg_LaneAttributes value, char oldPath[])
{
  char newPath[300];
  int result;

  result = 0;


  return result;
}

int GetTollAdvertisementMessageMapData_LaneAttributesParams(LONG packetHandle, struct TollAdvertisementMessageMapData_LaneAttributes value, char oldPath[])
{
  char newPath[300]; 
  int j; 
  int k;
  int result;

  result = 0;

  snprintf(newPath, elcount(newPath), "%s.%s", oldPath, "directionalUse");
  value.directionalUse.isValidFlag = 1;
  value.directionalUse.stringLength = C2xGetTokenLengthBit(packetHandle, "TollAdvertisementMessage", newPath);
  if ((result = CheckLastError("TollAdvertisementMessage", gkFuncRefGet, result))==0)
  {
    if(value.directionalUse.stringLength > 0)
    {
      for(j=0; j<value.directionalUse.stringLength; j++)
      {
        if(C2xGetTokenBitOfBitString(packetHandle, "TollAdvertisementMessage", newPath, j) == 0)
        {
          value.directionalUse.string[j] = '0';
        }
        else if(C2xGetTokenBitOfBitString(packetHandle, "TollAdvertisementMessage", newPath, j) == 1)
        {
          value.directionalUse.string[j] = '1';
        }

        if(value.directionalUse.stringLength == 1)
        {
          value.directionalUse.string[1] = '0';
        }
        result = CheckLastError("TollAdvertisementMessage", gkFuncRefGet, result);
      }
    }
    else
    {
      for(k = value.directionalUse.stringLength+1; k > -1; k--)
      {
        if(value.directionalUse.string[k] == '1')
        {
          value.directionalUse.string[k] = '0';
        }
      }
    }
  }

  snprintf(newPath, elcount(newPath), "%s.%s", oldPath, "sharedWith");
  value.sharedWith.isValidFlag = 1;
  value.sharedWith.stringLength = C2xGetTokenLengthBit(packetHandle, "TollAdvertisementMessage", newPath);
  if ((result = CheckLastError("TollAdvertisementMessage", gkFuncRefGet, result))==0)
  {
    if(value.sharedWith.stringLength > 0)
    {
      for(j=0; j<value.sharedWith.stringLength; j++)
      {
        if(C2xGetTokenBitOfBitString(packetHandle, "TollAdvertisementMessage", newPath, j) == 0)
        {
          value.sharedWith.string[j] = '0';
        }
        else if(C2xGetTokenBitOfBitString(packetHandle, "TollAdvertisementMessage", newPath, j) == 1)
        {
          value.sharedWith.string[j] = '1';
        }

        if(value.sharedWith.stringLength == 1)
        {
          value.sharedWith.string[1] = '0';
        }
        result = CheckLastError("TollAdvertisementMessage", gkFuncRefGet, result);
      }
    }
    else
    {
      for(k = value.sharedWith.stringLength+1; k > -1; k--)
      {
        if(value.sharedWith.string[k] == '1')
        {
          value.sharedWith.string[k] = '0';
        }
      }
    }
  }

  snprintf(newPath, elcount(newPath), "%s.%s", oldPath, "laneType");
  GetTollAdvertisementMessageMapData_LaneTypeAttributesParams(packetHandle, value.laneType, newPath);
  result = CheckLastError("TollAdvertisementMessage", gkFuncRefGet, result);

  snprintf(newPath, elcount(newPath), "%s.%s", oldPath, "regional");
  value.regional.isValidFlag = C2xIsTokenAvailable(packetHandle, "TollAdvertisementMessage", newPath);
  if(value.regional.isValidFlag==1)
  {
    GetTollAdvertisementMessageCommon_RegionalExtension_Reg_LaneAttributesParams(packetHandle, value.regional, newPath);
    result = CheckLastError("TollAdvertisementMessage", gkFuncRefGet, result);
  }
  return result;
}

int SetTollAdvertisementMessageMapData_LaneAttributesParams(LONG packetHandle, struct TollAdvertisementMessageMapData_LaneAttributes value, char oldPath[])
{
  char newPath[300]; 
  int j;
  int result;

  result = 0;

  snprintf(newPath, elcount(newPath), "%s.%s", oldPath, "directionalUse");
    for(j=0; j<value.directionalUse.stringLength; j++)
    {
      if(value.directionalUse.string[j] == '0')
      {
        C2xSetTokenBitOfBitString(packetHandle, "TollAdvertisementMessage", newPath, j, 0);
      }
      else
      {
        C2xSetTokenBitOfBitString(packetHandle, "TollAdvertisementMessage", newPath, j, 1);
      }
      result = CheckLastError("TollAdvertisementMessage", gkFuncRefGet, result);
    }

  snprintf(newPath, elcount(newPath), "%s.%s", oldPath, "sharedWith");
    for(j=0; j<value.sharedWith.stringLength; j++)
    {
      if(value.sharedWith.string[j] == '0')
      {
        C2xSetTokenBitOfBitString(packetHandle, "TollAdvertisementMessage", newPath, j, 0);
      }
      else
      {
        C2xSetTokenBitOfBitString(packetHandle, "TollAdvertisementMessage", newPath, j, 1);
      }
      result = CheckLastError("TollAdvertisementMessage", gkFuncRefGet, result);
    }

  snprintf(newPath, elcount(newPath), "%s.%s", oldPath, "laneType");
  SetTollAdvertisementMessageMapData_LaneTypeAttributesParams(packetHandle, value.laneType, newPath);
  result = CheckLastError("TollAdvertisementMessage", gkFuncRefGet, result);

  snprintf(newPath, elcount(newPath), "%s.%s", oldPath, "regional");
  if(value.regional.isValidFlag==1)
  {
    SetTollAdvertisementMessageCommon_RegionalExtension_Reg_LaneAttributesParams(packetHandle, value.regional, newPath);
    result = CheckLastError("TollAdvertisementMessage", gkFuncRefGet, result);
  }
  else
  {
    if( C2xIsTokenAvailable(packetHandle, "TollAdvertisementMessage", newPath) )
    {
      C2xRemoveToken(packetHandle, "TollAdvertisementMessage", newPath);
    }
  }

  return result;
}

int GetTollAdvertisementMessageCommon_Node_XY_20bParams(LONG packetHandle, struct TollAdvertisementMessageCommon_Node_XY_20b value, char oldPath[])
{
  char newPath[300];
  int result;

  result = 0;

  snprintf(newPath, elcount(newPath), "%s.%s", oldPath, "x");
  value.x = C2xGetTokenInt(packetHandle, "TollAdvertisementMessage", newPath);
  result = CheckLastError("TollAdvertisementMessage", gkFuncRefGet, result);

  snprintf(newPath, elcount(newPath), "%s.%s", oldPath, "y");
  value.y = C2xGetTokenInt(packetHandle, "TollAdvertisementMessage", newPath);
  result = CheckLastError("TollAdvertisementMessage", gkFuncRefGet, result);

  return result;
}

int SetTollAdvertisementMessageCommon_Node_XY_20bParams(LONG packetHandle, struct TollAdvertisementMessageCommon_Node_XY_20b value, char oldPath[])
{
  char newPath[300];
  int result;

  result = 0;

  snprintf(newPath, elcount(newPath), "%s.%s", oldPath, "x");
  C2xSetTokenInt(packetHandle, "TollAdvertisementMessage", newPath, value.x);
  result = CheckLastError("TollAdvertisementMessage", gkFuncRefGet, result);

  snprintf(newPath, elcount(newPath), "%s.%s", oldPath, "y");
  C2xSetTokenInt(packetHandle, "TollAdvertisementMessage", newPath, value.y);
  result = CheckLastError("TollAdvertisementMessage", gkFuncRefGet, result);

  return result;
}

int GetTollAdvertisementMessageCommon_Node_XY_22bParams(LONG packetHandle, struct TollAdvertisementMessageCommon_Node_XY_22b value, char oldPath[])
{
  char newPath[300];
  int result;

  result = 0;

  snprintf(newPath, elcount(newPath), "%s.%s", oldPath, "x");
  value.x = C2xGetTokenInt(packetHandle, "TollAdvertisementMessage", newPath);
  result = CheckLastError("TollAdvertisementMessage", gkFuncRefGet, result);

  snprintf(newPath, elcount(newPath), "%s.%s", oldPath, "y");
  value.y = C2xGetTokenInt(packetHandle, "TollAdvertisementMessage", newPath);
  result = CheckLastError("TollAdvertisementMessage", gkFuncRefGet, result);

  return result;
}

int SetTollAdvertisementMessageCommon_Node_XY_22bParams(LONG packetHandle, struct TollAdvertisementMessageCommon_Node_XY_22b value, char oldPath[])
{
  char newPath[300];
  int result;

  result = 0;

  snprintf(newPath, elcount(newPath), "%s.%s", oldPath, "x");
  C2xSetTokenInt(packetHandle, "TollAdvertisementMessage", newPath, value.x);
  result = CheckLastError("TollAdvertisementMessage", gkFuncRefGet, result);

  snprintf(newPath, elcount(newPath), "%s.%s", oldPath, "y");
  C2xSetTokenInt(packetHandle, "TollAdvertisementMessage", newPath, value.y);
  result = CheckLastError("TollAdvertisementMessage", gkFuncRefGet, result);

  return result;
}

int GetTollAdvertisementMessageCommon_Node_XY_24bParams(LONG packetHandle, struct TollAdvertisementMessageCommon_Node_XY_24b value, char oldPath[])
{
  char newPath[300];
  int result;

  result = 0;

  snprintf(newPath, elcount(newPath), "%s.%s", oldPath, "x");
  value.x = C2xGetTokenInt(packetHandle, "TollAdvertisementMessage", newPath);
  result = CheckLastError("TollAdvertisementMessage", gkFuncRefGet, result);

  snprintf(newPath, elcount(newPath), "%s.%s", oldPath, "y");
  value.y = C2xGetTokenInt(packetHandle, "TollAdvertisementMessage", newPath);
  result = CheckLastError("TollAdvertisementMessage", gkFuncRefGet, result);

  return result;
}

int SetTollAdvertisementMessageCommon_Node_XY_24bParams(LONG packetHandle, struct TollAdvertisementMessageCommon_Node_XY_24b value, char oldPath[])
{
  char newPath[300];
  int result;

  result = 0;

  snprintf(newPath, elcount(newPath), "%s.%s", oldPath, "x");
  C2xSetTokenInt(packetHandle, "TollAdvertisementMessage", newPath, value.x);
  result = CheckLastError("TollAdvertisementMessage", gkFuncRefGet, result);

  snprintf(newPath, elcount(newPath), "%s.%s", oldPath, "y");
  C2xSetTokenInt(packetHandle, "TollAdvertisementMessage", newPath, value.y);
  result = CheckLastError("TollAdvertisementMessage", gkFuncRefGet, result);

  return result;
}

int GetTollAdvertisementMessageCommon_Node_XY_26bParams(LONG packetHandle, struct TollAdvertisementMessageCommon_Node_XY_26b value, char oldPath[])
{
  char newPath[300];
  int result;

  result = 0;

  snprintf(newPath, elcount(newPath), "%s.%s", oldPath, "x");
  value.x = C2xGetTokenInt(packetHandle, "TollAdvertisementMessage", newPath);
  result = CheckLastError("TollAdvertisementMessage", gkFuncRefGet, result);

  snprintf(newPath, elcount(newPath), "%s.%s", oldPath, "y");
  value.y = C2xGetTokenInt(packetHandle, "TollAdvertisementMessage", newPath);
  result = CheckLastError("TollAdvertisementMessage", gkFuncRefGet, result);

  return result;
}

int SetTollAdvertisementMessageCommon_Node_XY_26bParams(LONG packetHandle, struct TollAdvertisementMessageCommon_Node_XY_26b value, char oldPath[])
{
  char newPath[300];
  int result;

  result = 0;

  snprintf(newPath, elcount(newPath), "%s.%s", oldPath, "x");
  C2xSetTokenInt(packetHandle, "TollAdvertisementMessage", newPath, value.x);
  result = CheckLastError("TollAdvertisementMessage", gkFuncRefGet, result);

  snprintf(newPath, elcount(newPath), "%s.%s", oldPath, "y");
  C2xSetTokenInt(packetHandle, "TollAdvertisementMessage", newPath, value.y);
  result = CheckLastError("TollAdvertisementMessage", gkFuncRefGet, result);

  return result;
}

int GetTollAdvertisementMessageCommon_Node_XY_28bParams(LONG packetHandle, struct TollAdvertisementMessageCommon_Node_XY_28b value, char oldPath[])
{
  char newPath[300];
  int result;

  result = 0;

  snprintf(newPath, elcount(newPath), "%s.%s", oldPath, "x");
  value.x = C2xGetTokenInt(packetHandle, "TollAdvertisementMessage", newPath);
  result = CheckLastError("TollAdvertisementMessage", gkFuncRefGet, result);

  snprintf(newPath, elcount(newPath), "%s.%s", oldPath, "y");
  value.y = C2xGetTokenInt(packetHandle, "TollAdvertisementMessage", newPath);
  result = CheckLastError("TollAdvertisementMessage", gkFuncRefGet, result);

  return result;
}

int SetTollAdvertisementMessageCommon_Node_XY_28bParams(LONG packetHandle, struct TollAdvertisementMessageCommon_Node_XY_28b value, char oldPath[])
{
  char newPath[300];
  int result;

  result = 0;

  snprintf(newPath, elcount(newPath), "%s.%s", oldPath, "x");
  C2xSetTokenInt(packetHandle, "TollAdvertisementMessage", newPath, value.x);
  result = CheckLastError("TollAdvertisementMessage", gkFuncRefGet, result);

  snprintf(newPath, elcount(newPath), "%s.%s", oldPath, "y");
  C2xSetTokenInt(packetHandle, "TollAdvertisementMessage", newPath, value.y);
  result = CheckLastError("TollAdvertisementMessage", gkFuncRefGet, result);

  return result;
}

int GetTollAdvertisementMessageCommon_Node_XY_32bParams(LONG packetHandle, struct TollAdvertisementMessageCommon_Node_XY_32b value, char oldPath[])
{
  char newPath[300];
  int result;

  result = 0;

  snprintf(newPath, elcount(newPath), "%s.%s", oldPath, "x");
  value.x = C2xGetTokenInt(packetHandle, "TollAdvertisementMessage", newPath);
  result = CheckLastError("TollAdvertisementMessage", gkFuncRefGet, result);

  snprintf(newPath, elcount(newPath), "%s.%s", oldPath, "y");
  value.y = C2xGetTokenInt(packetHandle, "TollAdvertisementMessage", newPath);
  result = CheckLastError("TollAdvertisementMessage", gkFuncRefGet, result);

  return result;
}

int SetTollAdvertisementMessageCommon_Node_XY_32bParams(LONG packetHandle, struct TollAdvertisementMessageCommon_Node_XY_32b value, char oldPath[])
{
  char newPath[300];
  int result;

  result = 0;

  snprintf(newPath, elcount(newPath), "%s.%s", oldPath, "x");
  C2xSetTokenInt(packetHandle, "TollAdvertisementMessage", newPath, value.x);
  result = CheckLastError("TollAdvertisementMessage", gkFuncRefGet, result);

  snprintf(newPath, elcount(newPath), "%s.%s", oldPath, "y");
  C2xSetTokenInt(packetHandle, "TollAdvertisementMessage", newPath, value.y);
  result = CheckLastError("TollAdvertisementMessage", gkFuncRefGet, result);

  return result;
}

int GetTollAdvertisementMessageCommon_Node_LLmD_64bParams(LONG packetHandle, struct TollAdvertisementMessageCommon_Node_LLmD_64b value, char oldPath[])
{
  char newPath[300];
  int result;

  result = 0;

  snprintf(newPath, elcount(newPath), "%s.%s", oldPath, "lon");
  value.lon = C2xGetTokenInt(packetHandle, "TollAdvertisementMessage", newPath);
  result = CheckLastError("TollAdvertisementMessage", gkFuncRefGet, result);

  snprintf(newPath, elcount(newPath), "%s.%s", oldPath, "lat");
  value.lat = C2xGetTokenInt(packetHandle, "TollAdvertisementMessage", newPath);
  result = CheckLastError("TollAdvertisementMessage", gkFuncRefGet, result);

  return result;
}

int SetTollAdvertisementMessageCommon_Node_LLmD_64bParams(LONG packetHandle, struct TollAdvertisementMessageCommon_Node_LLmD_64b value, char oldPath[])
{
  char newPath[300];
  int result;

  result = 0;

  snprintf(newPath, elcount(newPath), "%s.%s", oldPath, "lon");
  C2xSetTokenInt(packetHandle, "TollAdvertisementMessage", newPath, value.lon);
  result = CheckLastError("TollAdvertisementMessage", gkFuncRefGet, result);

  snprintf(newPath, elcount(newPath), "%s.%s", oldPath, "lat");
  C2xSetTokenInt(packetHandle, "TollAdvertisementMessage", newPath, value.lat);
  result = CheckLastError("TollAdvertisementMessage", gkFuncRefGet, result);

  return result;
}

int GetTollAdvertisementMessageAddGrpB_Node_LLdms_48bParams(LONG packetHandle, struct TollAdvertisementMessageAddGrpB_Node_LLdms_48b value, char oldPath[])
{
  char newPath[300];
  int result;

  result = 0;

  snprintf(newPath, elcount(newPath), "%s.%s", oldPath, "lon");
  value.lon = C2xGetTokenInt(packetHandle, "TollAdvertisementMessage", newPath);
  result = CheckLastError("TollAdvertisementMessage", gkFuncRefGet, result);

  snprintf(newPath, elcount(newPath), "%s.%s", oldPath, "lat");
  value.lat = C2xGetTokenInt(packetHandle, "TollAdvertisementMessage", newPath);
  result = CheckLastError("TollAdvertisementMessage", gkFuncRefGet, result);

  return result;
}

int SetTollAdvertisementMessageAddGrpB_Node_LLdms_48bParams(LONG packetHandle, struct TollAdvertisementMessageAddGrpB_Node_LLdms_48b value, char oldPath[])
{
  char newPath[300];
  int result;

  result = 0;

  snprintf(newPath, elcount(newPath), "%s.%s", oldPath, "lon");
  C2xSetTokenInt(packetHandle, "TollAdvertisementMessage", newPath, value.lon);
  result = CheckLastError("TollAdvertisementMessage", gkFuncRefGet, result);

  snprintf(newPath, elcount(newPath), "%s.%s", oldPath, "lat");
  C2xSetTokenInt(packetHandle, "TollAdvertisementMessage", newPath, value.lat);
  result = CheckLastError("TollAdvertisementMessage", gkFuncRefGet, result);

  return result;
}

int GetTollAdvertisementMessageAddGrpB_Node_LLdms_80bParams(LONG packetHandle, struct TollAdvertisementMessageAddGrpB_Node_LLdms_80b value, char oldPath[])
{
  char newPath[300];
  int result;

  result = 0;

  snprintf(newPath, elcount(newPath), "%s.%s", oldPath, "lon");
  GetTollAdvertisementMessageAddGrpB_LongitudeDMS2Params(packetHandle, value.lon, newPath);
  result = CheckLastError("TollAdvertisementMessage", gkFuncRefGet, result);

  snprintf(newPath, elcount(newPath), "%s.%s", oldPath, "lat");
  GetTollAdvertisementMessageAddGrpB_LatitudeDMS2Params(packetHandle, value.lat, newPath);
  result = CheckLastError("TollAdvertisementMessage", gkFuncRefGet, result);

  return result;
}

int SetTollAdvertisementMessageAddGrpB_Node_LLdms_80bParams(LONG packetHandle, struct TollAdvertisementMessageAddGrpB_Node_LLdms_80b value, char oldPath[])
{
  char newPath[300];
  int result;

  result = 0;

  snprintf(newPath, elcount(newPath), "%s.%s", oldPath, "lon");
  SetTollAdvertisementMessageAddGrpB_LongitudeDMS2Params(packetHandle, value.lon, newPath);
  result = CheckLastError("TollAdvertisementMessage", gkFuncRefGet, result);

  snprintf(newPath, elcount(newPath), "%s.%s", oldPath, "lat");
  SetTollAdvertisementMessageAddGrpB_LatitudeDMS2Params(packetHandle, value.lat, newPath);
  result = CheckLastError("TollAdvertisementMessage", gkFuncRefGet, result);

  return result;
}

int GetTollAdvertisementMessageAddGrpB_NodeOffsetPointXY_addGrpBParams(LONG packetHandle, struct TollAdvertisementMessageAddGrpB_NodeOffsetPointXY_addGrpB value, char oldPath[])
{
  char newPath[300];
  int result;

  result = 0;

  value.choice = C2xGetTokenInt(packetHandle, "TollAdvertisementMessage", oldPath);

  switch(value.choice)
  {
    case 0:
    {
      snprintf(newPath, elcount(newPath), "%s.%s", oldPath, "posA");
      GetTollAdvertisementMessageAddGrpB_Node_LLdms_48bParams(packetHandle, value.posA, newPath);
      result = CheckLastError("TollAdvertisementMessage", gkFuncRefGet, result);
    }
    break;
    case 1:
    {
      snprintf(newPath, elcount(newPath), "%s.%s", oldPath, "posB");
      GetTollAdvertisementMessageAddGrpB_Node_LLdms_80bParams(packetHandle, value.posB, newPath);
      result = CheckLastError("TollAdvertisementMessage", gkFuncRefGet, result);
    }
    break;
  }
  return result;
}

int SetTollAdvertisementMessageAddGrpB_NodeOffsetPointXY_addGrpBParams(LONG packetHandle, struct TollAdvertisementMessageAddGrpB_NodeOffsetPointXY_addGrpB value, char oldPath[])
{
  char newPath[300];
  int result;

  result = 0;

  switch(value.choice)
  {
    case 0:
    {
      snprintf(newPath, elcount(newPath), "%s.%s", oldPath, "posA");
      SetTollAdvertisementMessageAddGrpB_Node_LLdms_48bParams(packetHandle, value.posA, newPath);
      result = CheckLastError("TollAdvertisementMessage", gkFuncRefGet, result);
    }
    break;
    case 1:
    {
      snprintf(newPath, elcount(newPath), "%s.%s", oldPath, "posB");
      SetTollAdvertisementMessageAddGrpB_Node_LLdms_80bParams(packetHandle, value.posB, newPath);
      result = CheckLastError("TollAdvertisementMessage", gkFuncRefGet, result);
    }
    break;
  }
  return result;
}

int GetTollAdvertisementMessageCommon_RegionalExtension_Reg_NodeOffsetPointXY_tableParams(LONG packetHandle, WORD tableKey, struct TollAdvertisementMessageCommon_RegionalExtension_Reg_NodeOffsetPointXY_table value, char oldPath[])
{
  char newPath[300];
  int result;

  result = 0;

  switch(tableKey)
  {
    case 2:
    {
      snprintf(newPath, elcount(newPath), "%s.%s", oldPath, "addGrpB");
      GetTollAdvertisementMessageAddGrpB_NodeOffsetPointXY_addGrpBParams(packetHandle, value.addGrpB, newPath);
      result = CheckLastError("TollAdvertisementMessage", gkFuncRefGet, result);
    }
    break;
  }
  return result;
}

int SetTollAdvertisementMessageCommon_RegionalExtension_Reg_NodeOffsetPointXY_tableParams(LONG packetHandle, WORD tableKey, struct TollAdvertisementMessageCommon_RegionalExtension_Reg_NodeOffsetPointXY_table value, char oldPath[])
{
  char newPath[300];
  int result;

  result = 0;

  switch(tableKey)
  {
    case 2:
    {
      snprintf(newPath, elcount(newPath), "%s.%s", oldPath, "addGrpB");
      SetTollAdvertisementMessageAddGrpB_NodeOffsetPointXY_addGrpBParams(packetHandle, value.addGrpB, newPath);
      result = CheckLastError("TollAdvertisementMessage", gkFuncRefGet, result);
    }
    break;
  }
  return result;
}

int GetTollAdvertisementMessageCommon_RegionalExtension_Reg_NodeOffsetPointXYParams(LONG packetHandle, struct TollAdvertisementMessageCommon_RegionalExtension_Reg_NodeOffsetPointXY value, char oldPath[])
{
  char newPath[300];
  int result;

  result = 0;

  snprintf(newPath, elcount(newPath), "%s.%s", oldPath, "regionId");
  value.regionId = C2xGetTokenInt(packetHandle, "TollAdvertisementMessage", newPath);
  result = CheckLastError("TollAdvertisementMessage", gkFuncRefGet, result);

  snprintf(newPath, elcount(newPath), "%s.%s", oldPath, "regExtvalue");
  GetTollAdvertisementMessageCommon_RegionalExtension_Reg_NodeOffsetPointXY_tableParams(packetHandle, value.regionId, value.regExtvalue, newPath);
  result = CheckLastError("TollAdvertisementMessage", gkFuncRefGet, result);

  return result;
}

int SetTollAdvertisementMessageCommon_RegionalExtension_Reg_NodeOffsetPointXYParams(LONG packetHandle, struct TollAdvertisementMessageCommon_RegionalExtension_Reg_NodeOffsetPointXY value, char oldPath[])
{
  char newPath[300];
  int result;

  result = 0;


  snprintf(newPath, elcount(newPath), "%s.%s", oldPath, "regExtvalue");
  SetTollAdvertisementMessageCommon_RegionalExtension_Reg_NodeOffsetPointXY_tableParams(packetHandle, value.regionId, value.regExtvalue, newPath);
  result = CheckLastError("TollAdvertisementMessage", gkFuncRefGet, result);

  return result;
}

int GetTollAdvertisementMessageCommon_NodeOffsetPointXYParams(LONG packetHandle, struct TollAdvertisementMessageCommon_NodeOffsetPointXY value, char oldPath[])
{
  char newPath[300];
  int result;

  result = 0;

  value.choice = C2xGetTokenInt(packetHandle, "TollAdvertisementMessage", oldPath);

  switch(value.choice)
  {
    case 0:
    {
      snprintf(newPath, elcount(newPath), "%s.%s", oldPath, "node_XY1");
      GetTollAdvertisementMessageCommon_Node_XY_20bParams(packetHandle, value.node_XY1, newPath);
      result = CheckLastError("TollAdvertisementMessage", gkFuncRefGet, result);
    }
    break;
    case 1:
    {
      snprintf(newPath, elcount(newPath), "%s.%s", oldPath, "node_XY2");
      GetTollAdvertisementMessageCommon_Node_XY_22bParams(packetHandle, value.node_XY2, newPath);
      result = CheckLastError("TollAdvertisementMessage", gkFuncRefGet, result);
    }
    break;
    case 2:
    {
      snprintf(newPath, elcount(newPath), "%s.%s", oldPath, "node_XY3");
      GetTollAdvertisementMessageCommon_Node_XY_24bParams(packetHandle, value.node_XY3, newPath);
      result = CheckLastError("TollAdvertisementMessage", gkFuncRefGet, result);
    }
    break;
    case 3:
    {
      snprintf(newPath, elcount(newPath), "%s.%s", oldPath, "node_XY4");
      GetTollAdvertisementMessageCommon_Node_XY_26bParams(packetHandle, value.node_XY4, newPath);
      result = CheckLastError("TollAdvertisementMessage", gkFuncRefGet, result);
    }
    break;
    case 4:
    {
      snprintf(newPath, elcount(newPath), "%s.%s", oldPath, "node_XY5");
      GetTollAdvertisementMessageCommon_Node_XY_28bParams(packetHandle, value.node_XY5, newPath);
      result = CheckLastError("TollAdvertisementMessage", gkFuncRefGet, result);
    }
    break;
    case 5:
    {
      snprintf(newPath, elcount(newPath), "%s.%s", oldPath, "node_XY6");
      GetTollAdvertisementMessageCommon_Node_XY_32bParams(packetHandle, value.node_XY6, newPath);
      result = CheckLastError("TollAdvertisementMessage", gkFuncRefGet, result);
    }
    break;
    case 6:
    {
      snprintf(newPath, elcount(newPath), "%s.%s", oldPath, "node_LatLon");
      GetTollAdvertisementMessageCommon_Node_LLmD_64bParams(packetHandle, value.node_LatLon, newPath);
      result = CheckLastError("TollAdvertisementMessage", gkFuncRefGet, result);
    }
    break;
    case 7:
    {
      snprintf(newPath, elcount(newPath), "%s.%s", oldPath, "regional");
      GetTollAdvertisementMessageCommon_RegionalExtension_Reg_NodeOffsetPointXYParams(packetHandle, value.regional, newPath);
      result = CheckLastError("TollAdvertisementMessage", gkFuncRefGet, result);
    }
    break;
  }
  return result;
}

int SetTollAdvertisementMessageCommon_NodeOffsetPointXYParams(LONG packetHandle, struct TollAdvertisementMessageCommon_NodeOffsetPointXY value, char oldPath[])
{
  char newPath[300];
  int result;

  result = 0;

  switch(value.choice)
  {
    case 0:
    {
      snprintf(newPath, elcount(newPath), "%s.%s", oldPath, "node_XY1");
      SetTollAdvertisementMessageCommon_Node_XY_20bParams(packetHandle, value.node_XY1, newPath);
      result = CheckLastError("TollAdvertisementMessage", gkFuncRefGet, result);
    }
    break;
    case 1:
    {
      snprintf(newPath, elcount(newPath), "%s.%s", oldPath, "node_XY2");
      SetTollAdvertisementMessageCommon_Node_XY_22bParams(packetHandle, value.node_XY2, newPath);
      result = CheckLastError("TollAdvertisementMessage", gkFuncRefGet, result);
    }
    break;
    case 2:
    {
      snprintf(newPath, elcount(newPath), "%s.%s", oldPath, "node_XY3");
      SetTollAdvertisementMessageCommon_Node_XY_24bParams(packetHandle, value.node_XY3, newPath);
      result = CheckLastError("TollAdvertisementMessage", gkFuncRefGet, result);
    }
    break;
    case 3:
    {
      snprintf(newPath, elcount(newPath), "%s.%s", oldPath, "node_XY4");
      SetTollAdvertisementMessageCommon_Node_XY_26bParams(packetHandle, value.node_XY4, newPath);
      result = CheckLastError("TollAdvertisementMessage", gkFuncRefGet, result);
    }
    break;
    case 4:
    {
      snprintf(newPath, elcount(newPath), "%s.%s", oldPath, "node_XY5");
      SetTollAdvertisementMessageCommon_Node_XY_28bParams(packetHandle, value.node_XY5, newPath);
      result = CheckLastError("TollAdvertisementMessage", gkFuncRefGet, result);
    }
    break;
    case 5:
    {
      snprintf(newPath, elcount(newPath), "%s.%s", oldPath, "node_XY6");
      SetTollAdvertisementMessageCommon_Node_XY_32bParams(packetHandle, value.node_XY6, newPath);
      result = CheckLastError("TollAdvertisementMessage", gkFuncRefGet, result);
    }
    break;
    case 6:
    {
      snprintf(newPath, elcount(newPath), "%s.%s", oldPath, "node_LatLon");
      SetTollAdvertisementMessageCommon_Node_LLmD_64bParams(packetHandle, value.node_LatLon, newPath);
      result = CheckLastError("TollAdvertisementMessage", gkFuncRefGet, result);
    }
    break;
    case 7:
    {
      snprintf(newPath, elcount(newPath), "%s.%s", oldPath, "regional");
      SetTollAdvertisementMessageCommon_RegionalExtension_Reg_NodeOffsetPointXYParams(packetHandle, value.regional, newPath);
      result = CheckLastError("TollAdvertisementMessage", gkFuncRefGet, result);
    }
    break;
  }
  return result;
}

int GetTollAdvertisementMessageCommon_NodeAttributeXYListParams(LONG packetHandle, struct TollAdvertisementMessageCommon_NodeAttributeXYList value, char oldPath[])
{
  char newPath[300]; 
  int i;
  int result;

  result = 0;

  value.length = C2xGetTokenInt(packetHandle, "TollAdvertisementMessage", oldPath);
  if((result = CheckLastError("TollAdvertisementMessage", gkFuncRefGet, result))==0)
  {
    for(i=0; i<value.length; i++)
    {
      snprintf(newPath, elcount(newPath), "%s[%d]", oldPath, i);
      value.arrayValue[i] = C2xGetTokenInt64(packetHandle, "TollAdvertisementMessage", newPath);
      result = CheckLastError("TollAdvertisementMessage", gkFuncRefGet, result);
    }
  }
  return result;
}

int SetTollAdvertisementMessageCommon_NodeAttributeXYListParams(LONG packetHandle, struct TollAdvertisementMessageCommon_NodeAttributeXYList value, char oldPath[])
{
  char newPath[300]; 
  int i;
  int result;

  result = 0;

  C2xRemoveToken(packetHandle, "TollAdvertisementMessage", oldPath);
  for(i=0; i<value.length; i++)
  {
    snprintf(newPath, elcount(newPath), "%s[%d]", oldPath, i);
    C2xSetTokenInt64(packetHandle, "TollAdvertisementMessage", newPath, value.arrayValue[i]);
    result = CheckLastError("TollAdvertisementMessage", gkFuncRefGet, result);
  }
  return result;
}

int GetTollAdvertisementMessageCommon_SegmentAttributeXYListParams(LONG packetHandle, struct TollAdvertisementMessageCommon_SegmentAttributeXYList value, char oldPath[])
{
  char newPath[300]; 
  int i;
  int result;

  result = 0;

  value.length = C2xGetTokenInt(packetHandle, "TollAdvertisementMessage", oldPath);
  if((result = CheckLastError("TollAdvertisementMessage", gkFuncRefGet, result))==0)
  {
    for(i=0; i<value.length; i++)
    {
      snprintf(newPath, elcount(newPath), "%s[%d]", oldPath, i);
      value.arrayValue[i] = C2xGetTokenInt64(packetHandle, "TollAdvertisementMessage", newPath);
      result = CheckLastError("TollAdvertisementMessage", gkFuncRefGet, result);
    }
  }
  return result;
}

int SetTollAdvertisementMessageCommon_SegmentAttributeXYListParams(LONG packetHandle, struct TollAdvertisementMessageCommon_SegmentAttributeXYList value, char oldPath[])
{
  char newPath[300]; 
  int i;
  int result;

  result = 0;

  C2xRemoveToken(packetHandle, "TollAdvertisementMessage", oldPath);
  for(i=0; i<value.length; i++)
  {
    snprintf(newPath, elcount(newPath), "%s[%d]", oldPath, i);
    C2xSetTokenInt64(packetHandle, "TollAdvertisementMessage", newPath, value.arrayValue[i]);
    result = CheckLastError("TollAdvertisementMessage", gkFuncRefGet, result);
  }
  return result;
}

int GetTollAdvertisementMessageCommon_SpeedLimitListParams(LONG packetHandle, struct TollAdvertisementMessageCommon_SpeedLimitList value, char oldPath[])
{
  char newPath[300]; 
  int i;
  int result;

  result = 0;

  value.length = C2xGetTokenInt(packetHandle, "TollAdvertisementMessage", oldPath);
  if((result = CheckLastError("TollAdvertisementMessage", gkFuncRefGet, result))==0)
  {
    for(i=0; i<value.length; i++)
    {
      snprintf(newPath, elcount(newPath), "%s[%d]", oldPath, i);
      GetTollAdvertisementMessageCommon_RegulatorySpeedLimitParams(packetHandle, value.arrayValue[i], newPath);
      result = CheckLastError("TollAdvertisementMessage", gkFuncRefGet, result);
    }
  }
  return result;
}

int SetTollAdvertisementMessageCommon_SpeedLimitListParams(LONG packetHandle, struct TollAdvertisementMessageCommon_SpeedLimitList value, char oldPath[])
{
  char newPath[300]; 
  int i;
  int result;

  result = 0;

  C2xRemoveToken(packetHandle, "TollAdvertisementMessage", oldPath);
  for(i=0; i<value.length; i++)
  {
    snprintf(newPath, elcount(newPath), "%s[%d]", oldPath, i);
    SetTollAdvertisementMessageCommon_RegulatorySpeedLimitParams(packetHandle, value.arrayValue[i], newPath);
    result = CheckLastError("TollAdvertisementMessage", gkFuncRefGet, result);
  }
  return result;
}

int GetTollAdvertisementMessageCommon_RegionalExtension_Reg_LaneDataAttributeParams(LONG packetHandle, struct TollAdvertisementMessageCommon_RegionalExtension_Reg_LaneDataAttribute value, char oldPath[])
{
  char newPath[300];
  int result;

  result = 0;

  snprintf(newPath, elcount(newPath), "%s.%s", oldPath, "regionId");
  value.regionId = C2xGetTokenInt(packetHandle, "TollAdvertisementMessage", newPath);
  result = CheckLastError("TollAdvertisementMessage", gkFuncRefGet, result);

  return result;
}

int SetTollAdvertisementMessageCommon_RegionalExtension_Reg_LaneDataAttributeParams(LONG packetHandle, struct TollAdvertisementMessageCommon_RegionalExtension_Reg_LaneDataAttribute value, char oldPath[])
{
  char newPath[300];
  int result;

  result = 0;


  return result;
}

int GetTollAdvertisementMessageCommon_LaneDataAttribute_regionalParams(LONG packetHandle, struct TollAdvertisementMessageCommon_LaneDataAttribute_regional value, char oldPath[])
{
  char newPath[300]; 
  int i;
  int result;

  result = 0;

  value.length = C2xGetTokenInt(packetHandle, "TollAdvertisementMessage", oldPath);
  if((result = CheckLastError("TollAdvertisementMessage", gkFuncRefGet, result))==0)
  {
    for(i=0; i<value.length; i++)
    {
      snprintf(newPath, elcount(newPath), "%s[%d]", oldPath, i);
      GetTollAdvertisementMessageCommon_RegionalExtension_Reg_LaneDataAttributeParams(packetHandle, value.arrayValue[i], newPath);
      result = CheckLastError("TollAdvertisementMessage", gkFuncRefGet, result);
    }
  }
  return result;
}

int SetTollAdvertisementMessageCommon_LaneDataAttribute_regionalParams(LONG packetHandle, struct TollAdvertisementMessageCommon_LaneDataAttribute_regional value, char oldPath[])
{
  char newPath[300]; 
  int i;
  int result;

  result = 0;

  C2xRemoveToken(packetHandle, "TollAdvertisementMessage", oldPath);
  for(i=0; i<value.length; i++)
  {
    snprintf(newPath, elcount(newPath), "%s[%d]", oldPath, i);
    SetTollAdvertisementMessageCommon_RegionalExtension_Reg_LaneDataAttributeParams(packetHandle, value.arrayValue[i], newPath);
    result = CheckLastError("TollAdvertisementMessage", gkFuncRefGet, result);
  }
  return result;
}

int GetTollAdvertisementMessageCommon_LaneDataAttributeParams(LONG packetHandle, struct TollAdvertisementMessageCommon_LaneDataAttribute value, char oldPath[])
{
  char newPath[300];
  int result;

  result = 0;

  value.choice = C2xGetTokenInt(packetHandle, "TollAdvertisementMessage", oldPath);

  switch(value.choice)
  {
    case 0:
    {
      snprintf(newPath, elcount(newPath), "%s.%s", oldPath, "pathEndPointAngle");
      value.pathEndPointAngle = C2xGetTokenInt(packetHandle, "TollAdvertisementMessage", newPath);
      result = CheckLastError("TollAdvertisementMessage", gkFuncRefGet, result);
    }
    break;
    case 1:
    {
      snprintf(newPath, elcount(newPath), "%s.%s", oldPath, "laneCrownPointCenter");
      value.laneCrownPointCenter = C2xGetTokenInt(packetHandle, "TollAdvertisementMessage", newPath);
      result = CheckLastError("TollAdvertisementMessage", gkFuncRefGet, result);
    }
    break;
    case 2:
    {
      snprintf(newPath, elcount(newPath), "%s.%s", oldPath, "laneCrownPointLeft");
      value.laneCrownPointLeft = C2xGetTokenInt(packetHandle, "TollAdvertisementMessage", newPath);
      result = CheckLastError("TollAdvertisementMessage", gkFuncRefGet, result);
    }
    break;
    case 3:
    {
      snprintf(newPath, elcount(newPath), "%s.%s", oldPath, "laneCrownPointRight");
      value.laneCrownPointRight = C2xGetTokenInt(packetHandle, "TollAdvertisementMessage", newPath);
      result = CheckLastError("TollAdvertisementMessage", gkFuncRefGet, result);
    }
    break;
    case 4:
    {
      snprintf(newPath, elcount(newPath), "%s.%s", oldPath, "laneAngle");
      value.laneAngle = C2xGetTokenInt(packetHandle, "TollAdvertisementMessage", newPath);
      result = CheckLastError("TollAdvertisementMessage", gkFuncRefGet, result);
    }
    break;
    case 5:
    {
      snprintf(newPath, elcount(newPath), "%s.%s", oldPath, "speedLimits");
      GetTollAdvertisementMessageCommon_SpeedLimitListParams(packetHandle, value.speedLimits, newPath);
      result = CheckLastError("TollAdvertisementMessage", gkFuncRefGet, result);
    }
    break;
    case 6:
    {
      snprintf(newPath, elcount(newPath), "%s.%s", oldPath, "regional");
      GetTollAdvertisementMessageCommon_LaneDataAttribute_regionalParams(packetHandle, value.regional, newPath);
      result = CheckLastError("TollAdvertisementMessage", gkFuncRefGet, result);
    }
    break;
  }
  return result;
}

int SetTollAdvertisementMessageCommon_LaneDataAttributeParams(LONG packetHandle, struct TollAdvertisementMessageCommon_LaneDataAttribute value, char oldPath[])
{
  char newPath[300];
  int result;

  result = 0;

  switch(value.choice)
  {
    case 0:
    {
      snprintf(newPath, elcount(newPath), "%s.%s", oldPath, "pathEndPointAngle");
      C2xSetTokenInt(packetHandle, "TollAdvertisementMessage", newPath, value.pathEndPointAngle);
      result = CheckLastError("TollAdvertisementMessage", gkFuncRefGet, result);
    }
    break;
    case 1:
    {
      snprintf(newPath, elcount(newPath), "%s.%s", oldPath, "laneCrownPointCenter");
      C2xSetTokenInt(packetHandle, "TollAdvertisementMessage", newPath, value.laneCrownPointCenter);
      result = CheckLastError("TollAdvertisementMessage", gkFuncRefGet, result);
    }
    break;
    case 2:
    {
      snprintf(newPath, elcount(newPath), "%s.%s", oldPath, "laneCrownPointLeft");
      C2xSetTokenInt(packetHandle, "TollAdvertisementMessage", newPath, value.laneCrownPointLeft);
      result = CheckLastError("TollAdvertisementMessage", gkFuncRefGet, result);
    }
    break;
    case 3:
    {
      snprintf(newPath, elcount(newPath), "%s.%s", oldPath, "laneCrownPointRight");
      C2xSetTokenInt(packetHandle, "TollAdvertisementMessage", newPath, value.laneCrownPointRight);
      result = CheckLastError("TollAdvertisementMessage", gkFuncRefGet, result);
    }
    break;
    case 4:
    {
      snprintf(newPath, elcount(newPath), "%s.%s", oldPath, "laneAngle");
      C2xSetTokenInt(packetHandle, "TollAdvertisementMessage", newPath, value.laneAngle);
      result = CheckLastError("TollAdvertisementMessage", gkFuncRefGet, result);
    }
    break;
    case 5:
    {
      snprintf(newPath, elcount(newPath), "%s.%s", oldPath, "speedLimits");
      SetTollAdvertisementMessageCommon_SpeedLimitListParams(packetHandle, value.speedLimits, newPath);
      result = CheckLastError("TollAdvertisementMessage", gkFuncRefGet, result);
    }
    break;
    case 6:
    {
      snprintf(newPath, elcount(newPath), "%s.%s", oldPath, "regional");
      SetTollAdvertisementMessageCommon_LaneDataAttribute_regionalParams(packetHandle, value.regional, newPath);
      result = CheckLastError("TollAdvertisementMessage", gkFuncRefGet, result);
    }
    break;
  }
  return result;
}

int GetTollAdvertisementMessageCommon_LaneDataAttributeListParams(LONG packetHandle, struct TollAdvertisementMessageCommon_LaneDataAttributeList value, char oldPath[])
{
  char newPath[300]; 
  int i;
  int result;

  result = 0;

  value.length = C2xGetTokenInt(packetHandle, "TollAdvertisementMessage", oldPath);
  if((result = CheckLastError("TollAdvertisementMessage", gkFuncRefGet, result))==0)
  {
    for(i=0; i<value.length; i++)
    {
      snprintf(newPath, elcount(newPath), "%s[%d]", oldPath, i);
      GetTollAdvertisementMessageCommon_LaneDataAttributeParams(packetHandle, value.arrayValue[i], newPath);
      result = CheckLastError("TollAdvertisementMessage", gkFuncRefGet, result);
    }
  }
  return result;
}

int SetTollAdvertisementMessageCommon_LaneDataAttributeListParams(LONG packetHandle, struct TollAdvertisementMessageCommon_LaneDataAttributeList value, char oldPath[])
{
  char newPath[300]; 
  int i;
  int result;

  result = 0;

  C2xRemoveToken(packetHandle, "TollAdvertisementMessage", oldPath);
  for(i=0; i<value.length; i++)
  {
    snprintf(newPath, elcount(newPath), "%s[%d]", oldPath, i);
    SetTollAdvertisementMessageCommon_LaneDataAttributeParams(packetHandle, value.arrayValue[i], newPath);
    result = CheckLastError("TollAdvertisementMessage", gkFuncRefGet, result);
  }
  return result;
}

int GetTollAdvertisementMessageCommon_RegionalExtension_Reg_NodeAttributeSetXYParams(LONG packetHandle, struct TollAdvertisementMessageCommon_RegionalExtension_Reg_NodeAttributeSetXY value, char oldPath[])
{
  char newPath[300];
  int result;

  result = 0;

  snprintf(newPath, elcount(newPath), "%s.%s", oldPath, "regionId");
  value.regionId = C2xGetTokenInt(packetHandle, "TollAdvertisementMessage", newPath);
  result = CheckLastError("TollAdvertisementMessage", gkFuncRefGet, result);

  return result;
}

int SetTollAdvertisementMessageCommon_RegionalExtension_Reg_NodeAttributeSetXYParams(LONG packetHandle, struct TollAdvertisementMessageCommon_RegionalExtension_Reg_NodeAttributeSetXY value, char oldPath[])
{
  char newPath[300];
  int result;

  result = 0;


  return result;
}

int GetTollAdvertisementMessageCommon_NodeAttributeSetXY_regionalParams(LONG packetHandle, struct TollAdvertisementMessageCommon_NodeAttributeSetXY_regional value, char oldPath[])
{
  char newPath[300]; 
  int i;
  int result;

  result = 0;

  value.length = C2xGetTokenInt(packetHandle, "TollAdvertisementMessage", oldPath);
  if((result = CheckLastError("TollAdvertisementMessage", gkFuncRefGet, result))==0)
  {
    for(i=0; i<value.length; i++)
    {
      snprintf(newPath, elcount(newPath), "%s[%d]", oldPath, i);
      GetTollAdvertisementMessageCommon_RegionalExtension_Reg_NodeAttributeSetXYParams(packetHandle, value.arrayValue[i], newPath);
      result = CheckLastError("TollAdvertisementMessage", gkFuncRefGet, result);
    }
  }
  return result;
}

int SetTollAdvertisementMessageCommon_NodeAttributeSetXY_regionalParams(LONG packetHandle, struct TollAdvertisementMessageCommon_NodeAttributeSetXY_regional value, char oldPath[])
{
  char newPath[300]; 
  int i;
  int result;

  result = 0;

  C2xRemoveToken(packetHandle, "TollAdvertisementMessage", oldPath);
  for(i=0; i<value.length; i++)
  {
    snprintf(newPath, elcount(newPath), "%s[%d]", oldPath, i);
    SetTollAdvertisementMessageCommon_RegionalExtension_Reg_NodeAttributeSetXYParams(packetHandle, value.arrayValue[i], newPath);
    result = CheckLastError("TollAdvertisementMessage", gkFuncRefGet, result);
  }
  return result;
}

int GetTollAdvertisementMessageCommon_NodeAttributeSetXYParams(LONG packetHandle, struct TollAdvertisementMessageCommon_NodeAttributeSetXY value, char oldPath[])
{
  char newPath[300];
  int result;

  result = 0;

  snprintf(newPath, elcount(newPath), "%s.%s", oldPath, "localNode");
  value.localNode.isValidFlag = C2xIsTokenAvailable(packetHandle, "TollAdvertisementMessage", newPath);
  if(value.localNode.isValidFlag==1)
  {
    GetTollAdvertisementMessageCommon_NodeAttributeXYListParams(packetHandle, value.localNode, newPath);
    result = CheckLastError("TollAdvertisementMessage", gkFuncRefGet, result);
  }
  snprintf(newPath, elcount(newPath), "%s.%s", oldPath, "disabled");
  value.disabled.isValidFlag = C2xIsTokenAvailable(packetHandle, "TollAdvertisementMessage", newPath);
  if(value.disabled.isValidFlag==1)
  {
    GetTollAdvertisementMessageCommon_SegmentAttributeXYListParams(packetHandle, value.disabled, newPath);
    result = CheckLastError("TollAdvertisementMessage", gkFuncRefGet, result);
  }
  snprintf(newPath, elcount(newPath), "%s.%s", oldPath, "enabled");
  value.enabled.isValidFlag = C2xIsTokenAvailable(packetHandle, "TollAdvertisementMessage", newPath);
  if(value.enabled.isValidFlag==1)
  {
    GetTollAdvertisementMessageCommon_SegmentAttributeXYListParams(packetHandle, value.enabled, newPath);
    result = CheckLastError("TollAdvertisementMessage", gkFuncRefGet, result);
  }
  snprintf(newPath, elcount(newPath), "%s.%s", oldPath, "data");
  value.data.isValidFlag = C2xIsTokenAvailable(packetHandle, "TollAdvertisementMessage", newPath);
  if(value.data.isValidFlag==1)
  {
    GetTollAdvertisementMessageCommon_LaneDataAttributeListParams(packetHandle, value.data, newPath);
    result = CheckLastError("TollAdvertisementMessage", gkFuncRefGet, result);
  }
  snprintf(newPath, elcount(newPath), "%s.%s", oldPath, "dWidth");
  value.dWidth.isValidFlag = C2xIsTokenAvailable(packetHandle, "TollAdvertisementMessage", newPath);
  if(value.dWidth.isValidFlag==1)
  {
    value.dWidth.value = C2xGetTokenInt(packetHandle, "TollAdvertisementMessage", newPath);
    result = CheckLastError("TollAdvertisementMessage", gkFuncRefGet, result);
  }
  snprintf(newPath, elcount(newPath), "%s.%s", oldPath, "dElevation");
  value.dElevation.isValidFlag = C2xIsTokenAvailable(packetHandle, "TollAdvertisementMessage", newPath);
  if(value.dElevation.isValidFlag==1)
  {
    value.dElevation.value = C2xGetTokenInt(packetHandle, "TollAdvertisementMessage", newPath);
    result = CheckLastError("TollAdvertisementMessage", gkFuncRefGet, result);
  }
  snprintf(newPath, elcount(newPath), "%s.%s", oldPath, "regional");
  value.regional.isValidFlag = C2xIsTokenAvailable(packetHandle, "TollAdvertisementMessage", newPath);
  if(value.regional.isValidFlag==1)
  {
    GetTollAdvertisementMessageCommon_NodeAttributeSetXY_regionalParams(packetHandle, value.regional, newPath);
    result = CheckLastError("TollAdvertisementMessage", gkFuncRefGet, result);
  }
  return result;
}

int SetTollAdvertisementMessageCommon_NodeAttributeSetXYParams(LONG packetHandle, struct TollAdvertisementMessageCommon_NodeAttributeSetXY value, char oldPath[])
{
  char newPath[300];
  int result;

  result = 0;

  snprintf(newPath, elcount(newPath), "%s.%s", oldPath, "localNode");
  if(value.localNode.isValidFlag==1)
  {
    SetTollAdvertisementMessageCommon_NodeAttributeXYListParams(packetHandle, value.localNode, newPath);
    result = CheckLastError("TollAdvertisementMessage", gkFuncRefGet, result);
  }
  else
  {
    if( C2xIsTokenAvailable(packetHandle, "TollAdvertisementMessage", newPath) )
    {
      C2xRemoveToken(packetHandle, "TollAdvertisementMessage", newPath);
    }
  }

  snprintf(newPath, elcount(newPath), "%s.%s", oldPath, "disabled");
  if(value.disabled.isValidFlag==1)
  {
    SetTollAdvertisementMessageCommon_SegmentAttributeXYListParams(packetHandle, value.disabled, newPath);
    result = CheckLastError("TollAdvertisementMessage", gkFuncRefGet, result);
  }
  else
  {
    if( C2xIsTokenAvailable(packetHandle, "TollAdvertisementMessage", newPath) )
    {
      C2xRemoveToken(packetHandle, "TollAdvertisementMessage", newPath);
    }
  }

  snprintf(newPath, elcount(newPath), "%s.%s", oldPath, "enabled");
  if(value.enabled.isValidFlag==1)
  {
    SetTollAdvertisementMessageCommon_SegmentAttributeXYListParams(packetHandle, value.enabled, newPath);
    result = CheckLastError("TollAdvertisementMessage", gkFuncRefGet, result);
  }
  else
  {
    if( C2xIsTokenAvailable(packetHandle, "TollAdvertisementMessage", newPath) )
    {
      C2xRemoveToken(packetHandle, "TollAdvertisementMessage", newPath);
    }
  }

  snprintf(newPath, elcount(newPath), "%s.%s", oldPath, "data");
  if(value.data.isValidFlag==1)
  {
    SetTollAdvertisementMessageCommon_LaneDataAttributeListParams(packetHandle, value.data, newPath);
    result = CheckLastError("TollAdvertisementMessage", gkFuncRefGet, result);
  }
  else
  {
    if( C2xIsTokenAvailable(packetHandle, "TollAdvertisementMessage", newPath) )
    {
      C2xRemoveToken(packetHandle, "TollAdvertisementMessage", newPath);
    }
  }

  snprintf(newPath, elcount(newPath), "%s.%s", oldPath, "dWidth");
  if(value.dWidth.isValidFlag==1)
  {
    C2xSetTokenInt(packetHandle, "TollAdvertisementMessage", newPath, value.dWidth.value);
    result = CheckLastError("TollAdvertisementMessage", gkFuncRefGet, result);
  }
  else
  {
    if( C2xIsTokenAvailable(packetHandle, "TollAdvertisementMessage", newPath) )
    {
      C2xRemoveToken(packetHandle, "TollAdvertisementMessage", newPath);
    }
  }

  snprintf(newPath, elcount(newPath), "%s.%s", oldPath, "dElevation");
  if(value.dElevation.isValidFlag==1)
  {
    C2xSetTokenInt(packetHandle, "TollAdvertisementMessage", newPath, value.dElevation.value);
    result = CheckLastError("TollAdvertisementMessage", gkFuncRefGet, result);
  }
  else
  {
    if( C2xIsTokenAvailable(packetHandle, "TollAdvertisementMessage", newPath) )
    {
      C2xRemoveToken(packetHandle, "TollAdvertisementMessage", newPath);
    }
  }

  snprintf(newPath, elcount(newPath), "%s.%s", oldPath, "regional");
  if(value.regional.isValidFlag==1)
  {
    SetTollAdvertisementMessageCommon_NodeAttributeSetXY_regionalParams(packetHandle, value.regional, newPath);
    result = CheckLastError("TollAdvertisementMessage", gkFuncRefGet, result);
  }
  else
  {
    if( C2xIsTokenAvailable(packetHandle, "TollAdvertisementMessage", newPath) )
    {
      C2xRemoveToken(packetHandle, "TollAdvertisementMessage", newPath);
    }
  }

  return result;
}

int GetTollAdvertisementMessageCommon_NodeXYParams(LONG packetHandle, struct TollAdvertisementMessageCommon_NodeXY value, char oldPath[])
{
  char newPath[300];
  int result;

  result = 0;

  snprintf(newPath, elcount(newPath), "%s.%s", oldPath, "delta");
  GetTollAdvertisementMessageCommon_NodeOffsetPointXYParams(packetHandle, value.delta, newPath);
  result = CheckLastError("TollAdvertisementMessage", gkFuncRefGet, result);

  snprintf(newPath, elcount(newPath), "%s.%s", oldPath, "attributes");
  value.attributes.isValidFlag = C2xIsTokenAvailable(packetHandle, "TollAdvertisementMessage", newPath);
  if(value.attributes.isValidFlag==1)
  {
    GetTollAdvertisementMessageCommon_NodeAttributeSetXYParams(packetHandle, value.attributes, newPath);
    result = CheckLastError("TollAdvertisementMessage", gkFuncRefGet, result);
  }
  return result;
}

int SetTollAdvertisementMessageCommon_NodeXYParams(LONG packetHandle, struct TollAdvertisementMessageCommon_NodeXY value, char oldPath[])
{
  char newPath[300];
  int result;

  result = 0;

  snprintf(newPath, elcount(newPath), "%s.%s", oldPath, "delta");
  SetTollAdvertisementMessageCommon_NodeOffsetPointXYParams(packetHandle, value.delta, newPath);
  result = CheckLastError("TollAdvertisementMessage", gkFuncRefGet, result);

  snprintf(newPath, elcount(newPath), "%s.%s", oldPath, "attributes");
  if(value.attributes.isValidFlag==1)
  {
    SetTollAdvertisementMessageCommon_NodeAttributeSetXYParams(packetHandle, value.attributes, newPath);
    result = CheckLastError("TollAdvertisementMessage", gkFuncRefGet, result);
  }
  else
  {
    if( C2xIsTokenAvailable(packetHandle, "TollAdvertisementMessage", newPath) )
    {
      C2xRemoveToken(packetHandle, "TollAdvertisementMessage", newPath);
    }
  }

  return result;
}

int GetTollAdvertisementMessageCommon_NodeSetXYParams(LONG packetHandle, struct TollAdvertisementMessageCommon_NodeSetXY value, char oldPath[])
{
  char newPath[300]; 
  int i;
  int result;

  result = 0;

  value.length = C2xGetTokenInt(packetHandle, "TollAdvertisementMessage", oldPath);
  if((result = CheckLastError("TollAdvertisementMessage", gkFuncRefGet, result))==0)
  {
    for(i=0; i<value.length; i++)
    {
      snprintf(newPath, elcount(newPath), "%s[%d]", oldPath, i);
      GetTollAdvertisementMessageCommon_NodeXYParams(packetHandle, value.arrayValue[i], newPath);
      result = CheckLastError("TollAdvertisementMessage", gkFuncRefGet, result);
    }
  }
  return result;
}

int SetTollAdvertisementMessageCommon_NodeSetXYParams(LONG packetHandle, struct TollAdvertisementMessageCommon_NodeSetXY value, char oldPath[])
{
  char newPath[300]; 
  int i;
  int result;

  result = 0;

  C2xRemoveToken(packetHandle, "TollAdvertisementMessage", oldPath);
  for(i=0; i<value.length; i++)
  {
    snprintf(newPath, elcount(newPath), "%s[%d]", oldPath, i);
    SetTollAdvertisementMessageCommon_NodeXYParams(packetHandle, value.arrayValue[i], newPath);
    result = CheckLastError("TollAdvertisementMessage", gkFuncRefGet, result);
  }
  return result;
}

int GetTollAdvertisementMessageCommon_ComputedLane_offsetXaxisParams(LONG packetHandle, struct TollAdvertisementMessageCommon_ComputedLane_offsetXaxis value, char oldPath[])
{
  char newPath[300];
  int result;

  result = 0;

  value.choice = C2xGetTokenInt(packetHandle, "TollAdvertisementMessage", oldPath);

  switch(value.choice)
  {
    case 0:
    {
      snprintf(newPath, elcount(newPath), "%s.%s", oldPath, "small");
      value.small = C2xGetTokenInt(packetHandle, "TollAdvertisementMessage", newPath);
      result = CheckLastError("TollAdvertisementMessage", gkFuncRefGet, result);
    }
    break;
    case 1:
    {
      snprintf(newPath, elcount(newPath), "%s.%s", oldPath, "large");
      value.large = C2xGetTokenInt(packetHandle, "TollAdvertisementMessage", newPath);
      result = CheckLastError("TollAdvertisementMessage", gkFuncRefGet, result);
    }
    break;
  }
  return result;
}

int SetTollAdvertisementMessageCommon_ComputedLane_offsetXaxisParams(LONG packetHandle, struct TollAdvertisementMessageCommon_ComputedLane_offsetXaxis value, char oldPath[])
{
  char newPath[300];
  int result;

  result = 0;

  switch(value.choice)
  {
    case 0:
    {
      snprintf(newPath, elcount(newPath), "%s.%s", oldPath, "small");
      C2xSetTokenInt(packetHandle, "TollAdvertisementMessage", newPath, value.small);
      result = CheckLastError("TollAdvertisementMessage", gkFuncRefGet, result);
    }
    break;
    case 1:
    {
      snprintf(newPath, elcount(newPath), "%s.%s", oldPath, "large");
      C2xSetTokenInt(packetHandle, "TollAdvertisementMessage", newPath, value.large);
      result = CheckLastError("TollAdvertisementMessage", gkFuncRefGet, result);
    }
    break;
  }
  return result;
}

int GetTollAdvertisementMessageCommon_ComputedLane_offsetYaxisParams(LONG packetHandle, struct TollAdvertisementMessageCommon_ComputedLane_offsetYaxis value, char oldPath[])
{
  char newPath[300];
  int result;

  result = 0;

  value.choice = C2xGetTokenInt(packetHandle, "TollAdvertisementMessage", oldPath);

  switch(value.choice)
  {
    case 0:
    {
      snprintf(newPath, elcount(newPath), "%s.%s", oldPath, "small");
      value.small = C2xGetTokenInt(packetHandle, "TollAdvertisementMessage", newPath);
      result = CheckLastError("TollAdvertisementMessage", gkFuncRefGet, result);
    }
    break;
    case 1:
    {
      snprintf(newPath, elcount(newPath), "%s.%s", oldPath, "large");
      value.large = C2xGetTokenInt(packetHandle, "TollAdvertisementMessage", newPath);
      result = CheckLastError("TollAdvertisementMessage", gkFuncRefGet, result);
    }
    break;
  }
  return result;
}

int SetTollAdvertisementMessageCommon_ComputedLane_offsetYaxisParams(LONG packetHandle, struct TollAdvertisementMessageCommon_ComputedLane_offsetYaxis value, char oldPath[])
{
  char newPath[300];
  int result;

  result = 0;

  switch(value.choice)
  {
    case 0:
    {
      snprintf(newPath, elcount(newPath), "%s.%s", oldPath, "small");
      C2xSetTokenInt(packetHandle, "TollAdvertisementMessage", newPath, value.small);
      result = CheckLastError("TollAdvertisementMessage", gkFuncRefGet, result);
    }
    break;
    case 1:
    {
      snprintf(newPath, elcount(newPath), "%s.%s", oldPath, "large");
      C2xSetTokenInt(packetHandle, "TollAdvertisementMessage", newPath, value.large);
      result = CheckLastError("TollAdvertisementMessage", gkFuncRefGet, result);
    }
    break;
  }
  return result;
}

int GetTollAdvertisementMessageCommon_RegionalExtension_Reg_ComputedLaneParams(LONG packetHandle, struct TollAdvertisementMessageCommon_RegionalExtension_Reg_ComputedLane value, char oldPath[])
{
  char newPath[300];
  int result;

  result = 0;

  snprintf(newPath, elcount(newPath), "%s.%s", oldPath, "regionId");
  value.regionId = C2xGetTokenInt(packetHandle, "TollAdvertisementMessage", newPath);
  result = CheckLastError("TollAdvertisementMessage", gkFuncRefGet, result);

  return result;
}

int SetTollAdvertisementMessageCommon_RegionalExtension_Reg_ComputedLaneParams(LONG packetHandle, struct TollAdvertisementMessageCommon_RegionalExtension_Reg_ComputedLane value, char oldPath[])
{
  char newPath[300];
  int result;

  result = 0;


  return result;
}

int GetTollAdvertisementMessageCommon_ComputedLane_regionalParams(LONG packetHandle, struct TollAdvertisementMessageCommon_ComputedLane_regional value, char oldPath[])
{
  char newPath[300]; 
  int i;
  int result;

  result = 0;

  value.length = C2xGetTokenInt(packetHandle, "TollAdvertisementMessage", oldPath);
  if((result = CheckLastError("TollAdvertisementMessage", gkFuncRefGet, result))==0)
  {
    for(i=0; i<value.length; i++)
    {
      snprintf(newPath, elcount(newPath), "%s[%d]", oldPath, i);
      GetTollAdvertisementMessageCommon_RegionalExtension_Reg_ComputedLaneParams(packetHandle, value.arrayValue[i], newPath);
      result = CheckLastError("TollAdvertisementMessage", gkFuncRefGet, result);
    }
  }
  return result;
}

int SetTollAdvertisementMessageCommon_ComputedLane_regionalParams(LONG packetHandle, struct TollAdvertisementMessageCommon_ComputedLane_regional value, char oldPath[])
{
  char newPath[300]; 
  int i;
  int result;

  result = 0;

  C2xRemoveToken(packetHandle, "TollAdvertisementMessage", oldPath);
  for(i=0; i<value.length; i++)
  {
    snprintf(newPath, elcount(newPath), "%s[%d]", oldPath, i);
    SetTollAdvertisementMessageCommon_RegionalExtension_Reg_ComputedLaneParams(packetHandle, value.arrayValue[i], newPath);
    result = CheckLastError("TollAdvertisementMessage", gkFuncRefGet, result);
  }
  return result;
}

int GetTollAdvertisementMessageCommon_ComputedLaneParams(LONG packetHandle, struct TollAdvertisementMessageCommon_ComputedLane value, char oldPath[])
{
  char newPath[300];
  int result;

  result = 0;

  snprintf(newPath, elcount(newPath), "%s.%s", oldPath, "referenceLaneId");
  value.referenceLaneId = C2xGetTokenInt(packetHandle, "TollAdvertisementMessage", newPath);
  result = CheckLastError("TollAdvertisementMessage", gkFuncRefGet, result);

  snprintf(newPath, elcount(newPath), "%s.%s", oldPath, "offsetXaxis");
  GetTollAdvertisementMessageCommon_ComputedLane_offsetXaxisParams(packetHandle, value.offsetXaxis, newPath);
  result = CheckLastError("TollAdvertisementMessage", gkFuncRefGet, result);

  snprintf(newPath, elcount(newPath), "%s.%s", oldPath, "offsetYaxis");
  GetTollAdvertisementMessageCommon_ComputedLane_offsetYaxisParams(packetHandle, value.offsetYaxis, newPath);
  result = CheckLastError("TollAdvertisementMessage", gkFuncRefGet, result);

  snprintf(newPath, elcount(newPath), "%s.%s", oldPath, "rotateXY");
  value.rotateXY.isValidFlag = C2xIsTokenAvailable(packetHandle, "TollAdvertisementMessage", newPath);
  if(value.rotateXY.isValidFlag==1)
  {
    value.rotateXY.value = C2xGetTokenInt(packetHandle, "TollAdvertisementMessage", newPath);
    result = CheckLastError("TollAdvertisementMessage", gkFuncRefGet, result);
  }
  snprintf(newPath, elcount(newPath), "%s.%s", oldPath, "scaleXaxis");
  value.scaleXaxis.isValidFlag = C2xIsTokenAvailable(packetHandle, "TollAdvertisementMessage", newPath);
  if(value.scaleXaxis.isValidFlag==1)
  {
    value.scaleXaxis.value = C2xGetTokenInt(packetHandle, "TollAdvertisementMessage", newPath);
    result = CheckLastError("TollAdvertisementMessage", gkFuncRefGet, result);
  }
  snprintf(newPath, elcount(newPath), "%s.%s", oldPath, "scaleYaxis");
  value.scaleYaxis.isValidFlag = C2xIsTokenAvailable(packetHandle, "TollAdvertisementMessage", newPath);
  if(value.scaleYaxis.isValidFlag==1)
  {
    value.scaleYaxis.value = C2xGetTokenInt(packetHandle, "TollAdvertisementMessage", newPath);
    result = CheckLastError("TollAdvertisementMessage", gkFuncRefGet, result);
  }
  snprintf(newPath, elcount(newPath), "%s.%s", oldPath, "regional");
  value.regional.isValidFlag = C2xIsTokenAvailable(packetHandle, "TollAdvertisementMessage", newPath);
  if(value.regional.isValidFlag==1)
  {
    GetTollAdvertisementMessageCommon_ComputedLane_regionalParams(packetHandle, value.regional, newPath);
    result = CheckLastError("TollAdvertisementMessage", gkFuncRefGet, result);
  }
  return result;
}

int SetTollAdvertisementMessageCommon_ComputedLaneParams(LONG packetHandle, struct TollAdvertisementMessageCommon_ComputedLane value, char oldPath[])
{
  char newPath[300];
  int result;

  result = 0;

  snprintf(newPath, elcount(newPath), "%s.%s", oldPath, "referenceLaneId");
  C2xSetTokenInt(packetHandle, "TollAdvertisementMessage", newPath, value.referenceLaneId);
  result = CheckLastError("TollAdvertisementMessage", gkFuncRefGet, result);

  snprintf(newPath, elcount(newPath), "%s.%s", oldPath, "offsetXaxis");
  SetTollAdvertisementMessageCommon_ComputedLane_offsetXaxisParams(packetHandle, value.offsetXaxis, newPath);
  result = CheckLastError("TollAdvertisementMessage", gkFuncRefGet, result);

  snprintf(newPath, elcount(newPath), "%s.%s", oldPath, "offsetYaxis");
  SetTollAdvertisementMessageCommon_ComputedLane_offsetYaxisParams(packetHandle, value.offsetYaxis, newPath);
  result = CheckLastError("TollAdvertisementMessage", gkFuncRefGet, result);

  snprintf(newPath, elcount(newPath), "%s.%s", oldPath, "rotateXY");
  if(value.rotateXY.isValidFlag==1)
  {
    C2xSetTokenInt(packetHandle, "TollAdvertisementMessage", newPath, value.rotateXY.value);
    result = CheckLastError("TollAdvertisementMessage", gkFuncRefGet, result);
  }
  else
  {
    if( C2xIsTokenAvailable(packetHandle, "TollAdvertisementMessage", newPath) )
    {
      C2xRemoveToken(packetHandle, "TollAdvertisementMessage", newPath);
    }
  }

  snprintf(newPath, elcount(newPath), "%s.%s", oldPath, "scaleXaxis");
  if(value.scaleXaxis.isValidFlag==1)
  {
    C2xSetTokenInt(packetHandle, "TollAdvertisementMessage", newPath, value.scaleXaxis.value);
    result = CheckLastError("TollAdvertisementMessage", gkFuncRefGet, result);
  }
  else
  {
    if( C2xIsTokenAvailable(packetHandle, "TollAdvertisementMessage", newPath) )
    {
      C2xRemoveToken(packetHandle, "TollAdvertisementMessage", newPath);
    }
  }

  snprintf(newPath, elcount(newPath), "%s.%s", oldPath, "scaleYaxis");
  if(value.scaleYaxis.isValidFlag==1)
  {
    C2xSetTokenInt(packetHandle, "TollAdvertisementMessage", newPath, value.scaleYaxis.value);
    result = CheckLastError("TollAdvertisementMessage", gkFuncRefGet, result);
  }
  else
  {
    if( C2xIsTokenAvailable(packetHandle, "TollAdvertisementMessage", newPath) )
    {
      C2xRemoveToken(packetHandle, "TollAdvertisementMessage", newPath);
    }
  }

  snprintf(newPath, elcount(newPath), "%s.%s", oldPath, "regional");
  if(value.regional.isValidFlag==1)
  {
    SetTollAdvertisementMessageCommon_ComputedLane_regionalParams(packetHandle, value.regional, newPath);
    result = CheckLastError("TollAdvertisementMessage", gkFuncRefGet, result);
  }
  else
  {
    if( C2xIsTokenAvailable(packetHandle, "TollAdvertisementMessage", newPath) )
    {
      C2xRemoveToken(packetHandle, "TollAdvertisementMessage", newPath);
    }
  }

  return result;
}

int GetTollAdvertisementMessageCommon_NodeListXYParams(LONG packetHandle, struct TollAdvertisementMessageCommon_NodeListXY value, char oldPath[])
{
  char newPath[300];
  int result;

  result = 0;

  value.choice = C2xGetTokenInt(packetHandle, "TollAdvertisementMessage", oldPath);

  switch(value.choice)
  {
    case 0:
    {
      snprintf(newPath, elcount(newPath), "%s.%s", oldPath, "nodes");
      GetTollAdvertisementMessageCommon_NodeSetXYParams(packetHandle, value.nodes, newPath);
      result = CheckLastError("TollAdvertisementMessage", gkFuncRefGet, result);
    }
    break;
    case 1:
    {
      snprintf(newPath, elcount(newPath), "%s.%s", oldPath, "computed");
      GetTollAdvertisementMessageCommon_ComputedLaneParams(packetHandle, value.computed, newPath);
      result = CheckLastError("TollAdvertisementMessage", gkFuncRefGet, result);
    }
    break;
  }
  return result;
}

int SetTollAdvertisementMessageCommon_NodeListXYParams(LONG packetHandle, struct TollAdvertisementMessageCommon_NodeListXY value, char oldPath[])
{
  char newPath[300];
  int result;

  result = 0;

  switch(value.choice)
  {
    case 0:
    {
      snprintf(newPath, elcount(newPath), "%s.%s", oldPath, "nodes");
      SetTollAdvertisementMessageCommon_NodeSetXYParams(packetHandle, value.nodes, newPath);
      result = CheckLastError("TollAdvertisementMessage", gkFuncRefGet, result);
    }
    break;
    case 1:
    {
      snprintf(newPath, elcount(newPath), "%s.%s", oldPath, "computed");
      SetTollAdvertisementMessageCommon_ComputedLaneParams(packetHandle, value.computed, newPath);
      result = CheckLastError("TollAdvertisementMessage", gkFuncRefGet, result);
    }
    break;
  }
  return result;
}

int GetTollAdvertisementMessageMapData_ConnectingLaneParams(LONG packetHandle, struct TollAdvertisementMessageMapData_ConnectingLane value, char oldPath[])
{
  char newPath[300]; 
  int j; 
  int k;
  int result;

  result = 0;

  snprintf(newPath, elcount(newPath), "%s.%s", oldPath, "lane");
  value.lane = C2xGetTokenInt(packetHandle, "TollAdvertisementMessage", newPath);
  result = CheckLastError("TollAdvertisementMessage", gkFuncRefGet, result);

  snprintf(newPath, elcount(newPath), "%s.%s", oldPath, "maneuver");
  value.maneuver.isValidFlag = C2xIsTokenAvailable(packetHandle, "TollAdvertisementMessage", newPath);
  if(value.maneuver.isValidFlag==1)
  {
    value.maneuver.isValidFlag = 1;
    value.maneuver.stringLength = C2xGetTokenLengthBit(packetHandle, "TollAdvertisementMessage", newPath);
    if ((result = CheckLastError("TollAdvertisementMessage", gkFuncRefGet, result))==0)
    {
      if(value.maneuver.stringLength > 0)
      {
        for(j=0; j<value.maneuver.stringLength; j++)
        {
          if(C2xGetTokenBitOfBitString(packetHandle, "TollAdvertisementMessage", newPath, j) == 0)
          {
            value.maneuver.string[j] = '0';
          }
          else if(C2xGetTokenBitOfBitString(packetHandle, "TollAdvertisementMessage", newPath, j) == 1)
          {
            value.maneuver.string[j] = '1';
          }

          if(value.maneuver.stringLength == 1)
          {
            value.maneuver.string[1] = '0';
          }
          result = CheckLastError("TollAdvertisementMessage", gkFuncRefGet, result);
        }
      }
      else
      {
        for(k = value.maneuver.stringLength+1; k > -1; k--)
        {
          if(value.maneuver.string[k] == '1')
          {
            value.maneuver.string[k] = '0';
          }
        }
      }
    }

  }
  return result;
}

int SetTollAdvertisementMessageMapData_ConnectingLaneParams(LONG packetHandle, struct TollAdvertisementMessageMapData_ConnectingLane value, char oldPath[])
{
  char newPath[300]; 
  int j;
  int result;

  result = 0;

  snprintf(newPath, elcount(newPath), "%s.%s", oldPath, "lane");
  C2xSetTokenInt(packetHandle, "TollAdvertisementMessage", newPath, value.lane);
  result = CheckLastError("TollAdvertisementMessage", gkFuncRefGet, result);

  snprintf(newPath, elcount(newPath), "%s.%s", oldPath, "maneuver");
  if(value.maneuver.isValidFlag==1)
  {
      for(j=0; j<value.maneuver.stringLength; j++)
      {
        if(value.maneuver.string[j] == '0')
        {
          C2xSetTokenBitOfBitString(packetHandle, "TollAdvertisementMessage", newPath, j, 0);
        }
        else
        {
          C2xSetTokenBitOfBitString(packetHandle, "TollAdvertisementMessage", newPath, j, 1);
        }
        result = CheckLastError("TollAdvertisementMessage", gkFuncRefGet, result);
      }
  }
  else
  {
    if( C2xIsTokenAvailable(packetHandle, "TollAdvertisementMessage", newPath) )
    {
      C2xRemoveToken(packetHandle, "TollAdvertisementMessage", newPath);
    }
  }

  return result;
}

int GetTollAdvertisementMessageCommon_IntersectionReferenceIDParams(LONG packetHandle, struct TollAdvertisementMessageCommon_IntersectionReferenceID value, char oldPath[])
{
  char newPath[300];
  int result;

  result = 0;

  snprintf(newPath, elcount(newPath), "%s.%s", oldPath, "region");
  value.region.isValidFlag = C2xIsTokenAvailable(packetHandle, "TollAdvertisementMessage", newPath);
  if(value.region.isValidFlag==1)
  {
    value.region.value = C2xGetTokenInt(packetHandle, "TollAdvertisementMessage", newPath);
    result = CheckLastError("TollAdvertisementMessage", gkFuncRefGet, result);
  }
  snprintf(newPath, elcount(newPath), "%s.%s", oldPath, "id");
  value.id = C2xGetTokenInt(packetHandle, "TollAdvertisementMessage", newPath);
  result = CheckLastError("TollAdvertisementMessage", gkFuncRefGet, result);

  return result;
}

int SetTollAdvertisementMessageCommon_IntersectionReferenceIDParams(LONG packetHandle, struct TollAdvertisementMessageCommon_IntersectionReferenceID value, char oldPath[])
{
  char newPath[300];
  int result;

  result = 0;

  snprintf(newPath, elcount(newPath), "%s.%s", oldPath, "region");
  if(value.region.isValidFlag==1)
  {
    C2xSetTokenInt(packetHandle, "TollAdvertisementMessage", newPath, value.region.value);
    result = CheckLastError("TollAdvertisementMessage", gkFuncRefGet, result);
  }
  else
  {
    if( C2xIsTokenAvailable(packetHandle, "TollAdvertisementMessage", newPath) )
    {
      C2xRemoveToken(packetHandle, "TollAdvertisementMessage", newPath);
    }
  }

  snprintf(newPath, elcount(newPath), "%s.%s", oldPath, "id");
  C2xSetTokenInt(packetHandle, "TollAdvertisementMessage", newPath, value.id);
  result = CheckLastError("TollAdvertisementMessage", gkFuncRefGet, result);

  return result;
}

int GetTollAdvertisementMessageMapData_ConnectionParams(LONG packetHandle, struct TollAdvertisementMessageMapData_Connection value, char oldPath[])
{
  char newPath[300];
  int result;

  result = 0;

  snprintf(newPath, elcount(newPath), "%s.%s", oldPath, "connectingLane");
  GetTollAdvertisementMessageMapData_ConnectingLaneParams(packetHandle, value.connectingLane, newPath);
  result = CheckLastError("TollAdvertisementMessage", gkFuncRefGet, result);

  snprintf(newPath, elcount(newPath), "%s.%s", oldPath, "remoteIntersection");
  value.remoteIntersection.isValidFlag = C2xIsTokenAvailable(packetHandle, "TollAdvertisementMessage", newPath);
  if(value.remoteIntersection.isValidFlag==1)
  {
    GetTollAdvertisementMessageCommon_IntersectionReferenceIDParams(packetHandle, value.remoteIntersection, newPath);
    result = CheckLastError("TollAdvertisementMessage", gkFuncRefGet, result);
  }
  snprintf(newPath, elcount(newPath), "%s.%s", oldPath, "signalGroup");
  value.signalGroup.isValidFlag = C2xIsTokenAvailable(packetHandle, "TollAdvertisementMessage", newPath);
  if(value.signalGroup.isValidFlag==1)
  {
    value.signalGroup.value = C2xGetTokenInt(packetHandle, "TollAdvertisementMessage", newPath);
    result = CheckLastError("TollAdvertisementMessage", gkFuncRefGet, result);
  }
  snprintf(newPath, elcount(newPath), "%s.%s", oldPath, "userClass");
  value.userClass.isValidFlag = C2xIsTokenAvailable(packetHandle, "TollAdvertisementMessage", newPath);
  if(value.userClass.isValidFlag==1)
  {
    value.userClass.value = C2xGetTokenInt(packetHandle, "TollAdvertisementMessage", newPath);
    result = CheckLastError("TollAdvertisementMessage", gkFuncRefGet, result);
  }
  snprintf(newPath, elcount(newPath), "%s.%s", oldPath, "connectionID");
  value.connectionID.isValidFlag = C2xIsTokenAvailable(packetHandle, "TollAdvertisementMessage", newPath);
  if(value.connectionID.isValidFlag==1)
  {
    value.connectionID.value = C2xGetTokenInt(packetHandle, "TollAdvertisementMessage", newPath);
    result = CheckLastError("TollAdvertisementMessage", gkFuncRefGet, result);
  }
  return result;
}

int SetTollAdvertisementMessageMapData_ConnectionParams(LONG packetHandle, struct TollAdvertisementMessageMapData_Connection value, char oldPath[])
{
  char newPath[300];
  int result;

  result = 0;

  snprintf(newPath, elcount(newPath), "%s.%s", oldPath, "connectingLane");
  SetTollAdvertisementMessageMapData_ConnectingLaneParams(packetHandle, value.connectingLane, newPath);
  result = CheckLastError("TollAdvertisementMessage", gkFuncRefGet, result);

  snprintf(newPath, elcount(newPath), "%s.%s", oldPath, "remoteIntersection");
  if(value.remoteIntersection.isValidFlag==1)
  {
    SetTollAdvertisementMessageCommon_IntersectionReferenceIDParams(packetHandle, value.remoteIntersection, newPath);
    result = CheckLastError("TollAdvertisementMessage", gkFuncRefGet, result);
  }
  else
  {
    if( C2xIsTokenAvailable(packetHandle, "TollAdvertisementMessage", newPath) )
    {
      C2xRemoveToken(packetHandle, "TollAdvertisementMessage", newPath);
    }
  }

  snprintf(newPath, elcount(newPath), "%s.%s", oldPath, "signalGroup");
  if(value.signalGroup.isValidFlag==1)
  {
    C2xSetTokenInt(packetHandle, "TollAdvertisementMessage", newPath, value.signalGroup.value);
    result = CheckLastError("TollAdvertisementMessage", gkFuncRefGet, result);
  }
  else
  {
    if( C2xIsTokenAvailable(packetHandle, "TollAdvertisementMessage", newPath) )
    {
      C2xRemoveToken(packetHandle, "TollAdvertisementMessage", newPath);
    }
  }

  snprintf(newPath, elcount(newPath), "%s.%s", oldPath, "userClass");
  if(value.userClass.isValidFlag==1)
  {
    C2xSetTokenInt(packetHandle, "TollAdvertisementMessage", newPath, value.userClass.value);
    result = CheckLastError("TollAdvertisementMessage", gkFuncRefGet, result);
  }
  else
  {
    if( C2xIsTokenAvailable(packetHandle, "TollAdvertisementMessage", newPath) )
    {
      C2xRemoveToken(packetHandle, "TollAdvertisementMessage", newPath);
    }
  }

  snprintf(newPath, elcount(newPath), "%s.%s", oldPath, "connectionID");
  if(value.connectionID.isValidFlag==1)
  {
    C2xSetTokenInt(packetHandle, "TollAdvertisementMessage", newPath, value.connectionID.value);
    result = CheckLastError("TollAdvertisementMessage", gkFuncRefGet, result);
  }
  else
  {
    if( C2xIsTokenAvailable(packetHandle, "TollAdvertisementMessage", newPath) )
    {
      C2xRemoveToken(packetHandle, "TollAdvertisementMessage", newPath);
    }
  }

  return result;
}

int GetTollAdvertisementMessageMapData_ConnectsToListParams(LONG packetHandle, struct TollAdvertisementMessageMapData_ConnectsToList value, char oldPath[])
{
  char newPath[300]; 
  int i;
  int result;

  result = 0;

  value.length = C2xGetTokenInt(packetHandle, "TollAdvertisementMessage", oldPath);
  if((result = CheckLastError("TollAdvertisementMessage", gkFuncRefGet, result))==0)
  {
    for(i=0; i<value.length; i++)
    {
      snprintf(newPath, elcount(newPath), "%s[%d]", oldPath, i);
      GetTollAdvertisementMessageMapData_ConnectionParams(packetHandle, value.arrayValue[i], newPath);
      result = CheckLastError("TollAdvertisementMessage", gkFuncRefGet, result);
    }
  }
  return result;
}

int SetTollAdvertisementMessageMapData_ConnectsToListParams(LONG packetHandle, struct TollAdvertisementMessageMapData_ConnectsToList value, char oldPath[])
{
  char newPath[300]; 
  int i;
  int result;

  result = 0;

  C2xRemoveToken(packetHandle, "TollAdvertisementMessage", oldPath);
  for(i=0; i<value.length; i++)
  {
    snprintf(newPath, elcount(newPath), "%s[%d]", oldPath, i);
    SetTollAdvertisementMessageMapData_ConnectionParams(packetHandle, value.arrayValue[i], newPath);
    result = CheckLastError("TollAdvertisementMessage", gkFuncRefGet, result);
  }
  return result;
}

int GetTollAdvertisementMessageMapData_OverlayLaneListParams(LONG packetHandle, struct TollAdvertisementMessageMapData_OverlayLaneList value, char oldPath[])
{
  char newPath[300]; 
  int i;
  int result;

  result = 0;

  value.length = C2xGetTokenInt(packetHandle, "TollAdvertisementMessage", oldPath);
  if((result = CheckLastError("TollAdvertisementMessage", gkFuncRefGet, result))==0)
  {
    for(i=0; i<value.length; i++)
    {
      snprintf(newPath, elcount(newPath), "%s[%d]", oldPath, i);
      value.arrayValue[i] = C2xGetTokenInt64(packetHandle, "TollAdvertisementMessage", newPath);
      result = CheckLastError("TollAdvertisementMessage", gkFuncRefGet, result);
    }
  }
  return result;
}

int SetTollAdvertisementMessageMapData_OverlayLaneListParams(LONG packetHandle, struct TollAdvertisementMessageMapData_OverlayLaneList value, char oldPath[])
{
  char newPath[300]; 
  int i;
  int result;

  result = 0;

  C2xRemoveToken(packetHandle, "TollAdvertisementMessage", oldPath);
  for(i=0; i<value.length; i++)
  {
    snprintf(newPath, elcount(newPath), "%s[%d]", oldPath, i);
    C2xSetTokenInt64(packetHandle, "TollAdvertisementMessage", newPath, value.arrayValue[i]);
    result = CheckLastError("TollAdvertisementMessage", gkFuncRefGet, result);
  }
  return result;
}

int GetTollAdvertisementMessageCommon_RegionalExtension_Reg_GenericLaneParams(LONG packetHandle, struct TollAdvertisementMessageCommon_RegionalExtension_Reg_GenericLane value, char oldPath[])
{
  char newPath[300];
  int result;

  result = 0;

  snprintf(newPath, elcount(newPath), "%s.%s", oldPath, "regionId");
  value.regionId = C2xGetTokenInt(packetHandle, "TollAdvertisementMessage", newPath);
  result = CheckLastError("TollAdvertisementMessage", gkFuncRefGet, result);

  return result;
}

int SetTollAdvertisementMessageCommon_RegionalExtension_Reg_GenericLaneParams(LONG packetHandle, struct TollAdvertisementMessageCommon_RegionalExtension_Reg_GenericLane value, char oldPath[])
{
  char newPath[300];
  int result;

  result = 0;


  return result;
}

int GetTollAdvertisementMessageMapData_GenericLane_regionalParams(LONG packetHandle, struct TollAdvertisementMessageMapData_GenericLane_regional value, char oldPath[])
{
  char newPath[300]; 
  int i;
  int result;

  result = 0;

  value.length = C2xGetTokenInt(packetHandle, "TollAdvertisementMessage", oldPath);
  if((result = CheckLastError("TollAdvertisementMessage", gkFuncRefGet, result))==0)
  {
    for(i=0; i<value.length; i++)
    {
      snprintf(newPath, elcount(newPath), "%s[%d]", oldPath, i);
      GetTollAdvertisementMessageCommon_RegionalExtension_Reg_GenericLaneParams(packetHandle, value.arrayValue[i], newPath);
      result = CheckLastError("TollAdvertisementMessage", gkFuncRefGet, result);
    }
  }
  return result;
}

int SetTollAdvertisementMessageMapData_GenericLane_regionalParams(LONG packetHandle, struct TollAdvertisementMessageMapData_GenericLane_regional value, char oldPath[])
{
  char newPath[300]; 
  int i;
  int result;

  result = 0;

  C2xRemoveToken(packetHandle, "TollAdvertisementMessage", oldPath);
  for(i=0; i<value.length; i++)
  {
    snprintf(newPath, elcount(newPath), "%s[%d]", oldPath, i);
    SetTollAdvertisementMessageCommon_RegionalExtension_Reg_GenericLaneParams(packetHandle, value.arrayValue[i], newPath);
    result = CheckLastError("TollAdvertisementMessage", gkFuncRefGet, result);
  }
  return result;
}

int GetTollAdvertisementMessageMapData_GenericLaneParams(LONG packetHandle, struct TollAdvertisementMessageMapData_GenericLane value, char oldPath[])
{
  char newPath[300]; 
  int j; 
  int k;
  int result;

  result = 0;

  snprintf(newPath, elcount(newPath), "%s.%s", oldPath, "laneID");
  value.laneID = C2xGetTokenInt(packetHandle, "TollAdvertisementMessage", newPath);
  result = CheckLastError("TollAdvertisementMessage", gkFuncRefGet, result);

  snprintf(newPath, elcount(newPath), "%s.%s", oldPath, "name");
  value.name.isValidFlag = C2xIsTokenAvailable(packetHandle, "TollAdvertisementMessage", newPath);
  if(value.name.isValidFlag==1)
  {
    value.name.stringLength = C2xGetTokenData(packetHandle, "TollAdvertisementMessage", newPath, elcount(value.name.string), value.name.string);
    result = CheckLastError("TollAdvertisementMessage", gkFuncRefGet, result);
  }
  snprintf(newPath, elcount(newPath), "%s.%s", oldPath, "ingressApproach");
  value.ingressApproach.isValidFlag = C2xIsTokenAvailable(packetHandle, "TollAdvertisementMessage", newPath);
  if(value.ingressApproach.isValidFlag==1)
  {
    value.ingressApproach.value = C2xGetTokenInt(packetHandle, "TollAdvertisementMessage", newPath);
    result = CheckLastError("TollAdvertisementMessage", gkFuncRefGet, result);
  }
  snprintf(newPath, elcount(newPath), "%s.%s", oldPath, "egressApproach");
  value.egressApproach.isValidFlag = C2xIsTokenAvailable(packetHandle, "TollAdvertisementMessage", newPath);
  if(value.egressApproach.isValidFlag==1)
  {
    value.egressApproach.value = C2xGetTokenInt(packetHandle, "TollAdvertisementMessage", newPath);
    result = CheckLastError("TollAdvertisementMessage", gkFuncRefGet, result);
  }
  snprintf(newPath, elcount(newPath), "%s.%s", oldPath, "laneAttributes");
  GetTollAdvertisementMessageMapData_LaneAttributesParams(packetHandle, value.laneAttributes, newPath);
  result = CheckLastError("TollAdvertisementMessage", gkFuncRefGet, result);

  snprintf(newPath, elcount(newPath), "%s.%s", oldPath, "maneuvers");
  value.maneuvers.isValidFlag = C2xIsTokenAvailable(packetHandle, "TollAdvertisementMessage", newPath);
  if(value.maneuvers.isValidFlag==1)
  {
    value.maneuvers.isValidFlag = 1;
    value.maneuvers.stringLength = C2xGetTokenLengthBit(packetHandle, "TollAdvertisementMessage", newPath);
    if ((result = CheckLastError("TollAdvertisementMessage", gkFuncRefGet, result))==0)
    {
      if(value.maneuvers.stringLength > 0)
      {
        for(j=0; j<value.maneuvers.stringLength; j++)
        {
          if(C2xGetTokenBitOfBitString(packetHandle, "TollAdvertisementMessage", newPath, j) == 0)
          {
            value.maneuvers.string[j] = '0';
          }
          else if(C2xGetTokenBitOfBitString(packetHandle, "TollAdvertisementMessage", newPath, j) == 1)
          {
            value.maneuvers.string[j] = '1';
          }

          if(value.maneuvers.stringLength == 1)
          {
            value.maneuvers.string[1] = '0';
          }
          result = CheckLastError("TollAdvertisementMessage", gkFuncRefGet, result);
        }
      }
      else
      {
        for(k = value.maneuvers.stringLength+1; k > -1; k--)
        {
          if(value.maneuvers.string[k] == '1')
          {
            value.maneuvers.string[k] = '0';
          }
        }
      }
    }

  }
  snprintf(newPath, elcount(newPath), "%s.%s", oldPath, "nodeList");
  GetTollAdvertisementMessageCommon_NodeListXYParams(packetHandle, value.nodeList, newPath);
  result = CheckLastError("TollAdvertisementMessage", gkFuncRefGet, result);

  snprintf(newPath, elcount(newPath), "%s.%s", oldPath, "connectsTo");
  value.connectsTo.isValidFlag = C2xIsTokenAvailable(packetHandle, "TollAdvertisementMessage", newPath);
  if(value.connectsTo.isValidFlag==1)
  {
    GetTollAdvertisementMessageMapData_ConnectsToListParams(packetHandle, value.connectsTo, newPath);
    result = CheckLastError("TollAdvertisementMessage", gkFuncRefGet, result);
  }
  snprintf(newPath, elcount(newPath), "%s.%s", oldPath, "overlays");
  value.overlays.isValidFlag = C2xIsTokenAvailable(packetHandle, "TollAdvertisementMessage", newPath);
  if(value.overlays.isValidFlag==1)
  {
    GetTollAdvertisementMessageMapData_OverlayLaneListParams(packetHandle, value.overlays, newPath);
    result = CheckLastError("TollAdvertisementMessage", gkFuncRefGet, result);
  }
  snprintf(newPath, elcount(newPath), "%s.%s", oldPath, "regional");
  value.regional.isValidFlag = C2xIsTokenAvailable(packetHandle, "TollAdvertisementMessage", newPath);
  if(value.regional.isValidFlag==1)
  {
    GetTollAdvertisementMessageMapData_GenericLane_regionalParams(packetHandle, value.regional, newPath);
    result = CheckLastError("TollAdvertisementMessage", gkFuncRefGet, result);
  }
  return result;
}

int SetTollAdvertisementMessageMapData_GenericLaneParams(LONG packetHandle, struct TollAdvertisementMessageMapData_GenericLane value, char oldPath[])
{
  char newPath[300]; 
  int j;
  int result;

  result = 0;

  snprintf(newPath, elcount(newPath), "%s.%s", oldPath, "laneID");
  C2xSetTokenInt(packetHandle, "TollAdvertisementMessage", newPath, value.laneID);
  result = CheckLastError("TollAdvertisementMessage", gkFuncRefGet, result);

  snprintf(newPath, elcount(newPath), "%s.%s", oldPath, "name");
  if(value.name.isValidFlag==1)
  {
    C2xSetTokenData(packetHandle, "TollAdvertisementMessage", newPath, value.name.stringLength, value.name.string);
    result = CheckLastError("TollAdvertisementMessage", gkFuncRefGet, result);
  }
  else
  {
    if( C2xIsTokenAvailable(packetHandle, "TollAdvertisementMessage", newPath) )
    {
      C2xRemoveToken(packetHandle, "TollAdvertisementMessage", newPath);
    }
  }

  snprintf(newPath, elcount(newPath), "%s.%s", oldPath, "ingressApproach");
  if(value.ingressApproach.isValidFlag==1)
  {
    C2xSetTokenInt(packetHandle, "TollAdvertisementMessage", newPath, value.ingressApproach.value);
    result = CheckLastError("TollAdvertisementMessage", gkFuncRefGet, result);
  }
  else
  {
    if( C2xIsTokenAvailable(packetHandle, "TollAdvertisementMessage", newPath) )
    {
      C2xRemoveToken(packetHandle, "TollAdvertisementMessage", newPath);
    }
  }

  snprintf(newPath, elcount(newPath), "%s.%s", oldPath, "egressApproach");
  if(value.egressApproach.isValidFlag==1)
  {
    C2xSetTokenInt(packetHandle, "TollAdvertisementMessage", newPath, value.egressApproach.value);
    result = CheckLastError("TollAdvertisementMessage", gkFuncRefGet, result);
  }
  else
  {
    if( C2xIsTokenAvailable(packetHandle, "TollAdvertisementMessage", newPath) )
    {
      C2xRemoveToken(packetHandle, "TollAdvertisementMessage", newPath);
    }
  }

  snprintf(newPath, elcount(newPath), "%s.%s", oldPath, "laneAttributes");
  SetTollAdvertisementMessageMapData_LaneAttributesParams(packetHandle, value.laneAttributes, newPath);
  result = CheckLastError("TollAdvertisementMessage", gkFuncRefGet, result);

  snprintf(newPath, elcount(newPath), "%s.%s", oldPath, "maneuvers");
  if(value.maneuvers.isValidFlag==1)
  {
      for(j=0; j<value.maneuvers.stringLength; j++)
      {
        if(value.maneuvers.string[j] == '0')
        {
          C2xSetTokenBitOfBitString(packetHandle, "TollAdvertisementMessage", newPath, j, 0);
        }
        else
        {
          C2xSetTokenBitOfBitString(packetHandle, "TollAdvertisementMessage", newPath, j, 1);
        }
        result = CheckLastError("TollAdvertisementMessage", gkFuncRefGet, result);
      }
  }
  else
  {
    if( C2xIsTokenAvailable(packetHandle, "TollAdvertisementMessage", newPath) )
    {
      C2xRemoveToken(packetHandle, "TollAdvertisementMessage", newPath);
    }
  }

  snprintf(newPath, elcount(newPath), "%s.%s", oldPath, "nodeList");
  SetTollAdvertisementMessageCommon_NodeListXYParams(packetHandle, value.nodeList, newPath);
  result = CheckLastError("TollAdvertisementMessage", gkFuncRefGet, result);

  snprintf(newPath, elcount(newPath), "%s.%s", oldPath, "connectsTo");
  if(value.connectsTo.isValidFlag==1)
  {
    SetTollAdvertisementMessageMapData_ConnectsToListParams(packetHandle, value.connectsTo, newPath);
    result = CheckLastError("TollAdvertisementMessage", gkFuncRefGet, result);
  }
  else
  {
    if( C2xIsTokenAvailable(packetHandle, "TollAdvertisementMessage", newPath) )
    {
      C2xRemoveToken(packetHandle, "TollAdvertisementMessage", newPath);
    }
  }

  snprintf(newPath, elcount(newPath), "%s.%s", oldPath, "overlays");
  if(value.overlays.isValidFlag==1)
  {
    SetTollAdvertisementMessageMapData_OverlayLaneListParams(packetHandle, value.overlays, newPath);
    result = CheckLastError("TollAdvertisementMessage", gkFuncRefGet, result);
  }
  else
  {
    if( C2xIsTokenAvailable(packetHandle, "TollAdvertisementMessage", newPath) )
    {
      C2xRemoveToken(packetHandle, "TollAdvertisementMessage", newPath);
    }
  }

  snprintf(newPath, elcount(newPath), "%s.%s", oldPath, "regional");
  if(value.regional.isValidFlag==1)
  {
    SetTollAdvertisementMessageMapData_GenericLane_regionalParams(packetHandle, value.regional, newPath);
    result = CheckLastError("TollAdvertisementMessage", gkFuncRefGet, result);
  }
  else
  {
    if( C2xIsTokenAvailable(packetHandle, "TollAdvertisementMessage", newPath) )
    {
      C2xRemoveToken(packetHandle, "TollAdvertisementMessage", newPath);
    }
  }

  return result;
}

int GetTollAdvertisementMessageTollPointMap_approachLanesMapParams(LONG packetHandle, struct TollAdvertisementMessageTollPointMap_approachLanesMap value, char oldPath[])
{
  char newPath[300]; 
  int i;
  int result;

  result = 0;

  value.length = C2xGetTokenInt(packetHandle, "TollAdvertisementMessage", oldPath);
  if((result = CheckLastError("TollAdvertisementMessage", gkFuncRefGet, result))==0)
  {
    for(i=0; i<value.length; i++)
    {
      snprintf(newPath, elcount(newPath), "%s[%d]", oldPath, i);
      GetTollAdvertisementMessageMapData_GenericLaneParams(packetHandle, value.arrayValue[i], newPath);
      result = CheckLastError("TollAdvertisementMessage", gkFuncRefGet, result);
    }
  }
  return result;
}

int SetTollAdvertisementMessageTollPointMap_approachLanesMapParams(LONG packetHandle, struct TollAdvertisementMessageTollPointMap_approachLanesMap value, char oldPath[])
{
  char newPath[300]; 
  int i;
  int result;

  result = 0;

  C2xRemoveToken(packetHandle, "TollAdvertisementMessage", oldPath);
  for(i=0; i<value.length; i++)
  {
    snprintf(newPath, elcount(newPath), "%s[%d]", oldPath, i);
    SetTollAdvertisementMessageMapData_GenericLaneParams(packetHandle, value.arrayValue[i], newPath);
    result = CheckLastError("TollAdvertisementMessage", gkFuncRefGet, result);
  }
  return result;
}

int GetTollAdvertisementMessageTollPointMap_tollZoneLanesMapParams(LONG packetHandle, struct TollAdvertisementMessageTollPointMap_tollZoneLanesMap value, char oldPath[])
{
  char newPath[300]; 
  int i;
  int result;

  result = 0;

  value.length = C2xGetTokenInt(packetHandle, "TollAdvertisementMessage", oldPath);
  if((result = CheckLastError("TollAdvertisementMessage", gkFuncRefGet, result))==0)
  {
    for(i=0; i<value.length; i++)
    {
      snprintf(newPath, elcount(newPath), "%s[%d]", oldPath, i);
      GetTollAdvertisementMessageMapData_GenericLaneParams(packetHandle, value.arrayValue[i], newPath);
      result = CheckLastError("TollAdvertisementMessage", gkFuncRefGet, result);
    }
  }
  return result;
}

int SetTollAdvertisementMessageTollPointMap_tollZoneLanesMapParams(LONG packetHandle, struct TollAdvertisementMessageTollPointMap_tollZoneLanesMap value, char oldPath[])
{
  char newPath[300]; 
  int i;
  int result;

  result = 0;

  C2xRemoveToken(packetHandle, "TollAdvertisementMessage", oldPath);
  for(i=0; i<value.length; i++)
  {
    snprintf(newPath, elcount(newPath), "%s[%d]", oldPath, i);
    SetTollAdvertisementMessageMapData_GenericLaneParams(packetHandle, value.arrayValue[i], newPath);
    result = CheckLastError("TollAdvertisementMessage", gkFuncRefGet, result);
  }
  return result;
}

int GetTollAdvertisementMessageTollPointMapParams(LONG packetHandle, struct TollAdvertisementMessageTollPointMap value, char oldPath[])
{
  char newPath[300];
  int result;

  result = 0;

  snprintf(newPath, elcount(newPath), "%s.%s", oldPath, "revisionNum");
  value.revisionNum = C2xGetTokenInt(packetHandle, "TollAdvertisementMessage", newPath);
  result = CheckLastError("TollAdvertisementMessage", gkFuncRefGet, result);

  snprintf(newPath, elcount(newPath), "%s.%s", oldPath, "referencePoint");
  GetTollAdvertisementMessageCommon_Position3DParams(packetHandle, value.referencePoint, newPath);
  result = CheckLastError("TollAdvertisementMessage", gkFuncRefGet, result);

  snprintf(newPath, elcount(newPath), "%s.%s", oldPath, "speedLimit");
  GetTollAdvertisementMessageCommon_RegulatorySpeedLimitParams(packetHandle, value.speedLimit, newPath);
  result = CheckLastError("TollAdvertisementMessage", gkFuncRefGet, result);

  snprintf(newPath, elcount(newPath), "%s.%s", oldPath, "laneWidth");
  value.laneWidth = C2xGetTokenInt(packetHandle, "TollAdvertisementMessage", newPath);
  result = CheckLastError("TollAdvertisementMessage", gkFuncRefGet, result);

  snprintf(newPath, elcount(newPath), "%s.%s", oldPath, "approachLanesMap");
  GetTollAdvertisementMessageTollPointMap_approachLanesMapParams(packetHandle, value.approachLanesMap, newPath);
  result = CheckLastError("TollAdvertisementMessage", gkFuncRefGet, result);

  snprintf(newPath, elcount(newPath), "%s.%s", oldPath, "tollZoneLanesMap");
  GetTollAdvertisementMessageTollPointMap_tollZoneLanesMapParams(packetHandle, value.tollZoneLanesMap, newPath);
  result = CheckLastError("TollAdvertisementMessage", gkFuncRefGet, result);

  return result;
}

int SetTollAdvertisementMessageTollPointMapParams(LONG packetHandle, struct TollAdvertisementMessageTollPointMap value, char oldPath[])
{
  char newPath[300];
  int result;

  result = 0;

  snprintf(newPath, elcount(newPath), "%s.%s", oldPath, "revisionNum");
  if (value.revisionNum < 1)
  {
    C2xSetTokenInt(packetHandle, "TollAdvertisementMessage", newPath, 1);
  }
  else if (value.revisionNum > 10)
  {
    C2xSetTokenInt(packetHandle, "TollAdvertisementMessage", newPath, 10);
  }
  else
  {
    C2xSetTokenInt(packetHandle, "TollAdvertisementMessage", newPath, value.revisionNum);
  }
  result = CheckLastError("TollAdvertisementMessage", gkFuncRefGet, result);

  snprintf(newPath, elcount(newPath), "%s.%s", oldPath, "referencePoint");
  SetTollAdvertisementMessageCommon_Position3DParams(packetHandle, value.referencePoint, newPath);
  result = CheckLastError("TollAdvertisementMessage", gkFuncRefGet, result);

  snprintf(newPath, elcount(newPath), "%s.%s", oldPath, "speedLimit");
  SetTollAdvertisementMessageCommon_RegulatorySpeedLimitParams(packetHandle, value.speedLimit, newPath);
  result = CheckLastError("TollAdvertisementMessage", gkFuncRefGet, result);

  snprintf(newPath, elcount(newPath), "%s.%s", oldPath, "laneWidth");
  C2xSetTokenInt(packetHandle, "TollAdvertisementMessage", newPath, value.laneWidth);
  result = CheckLastError("TollAdvertisementMessage", gkFuncRefGet, result);

  snprintf(newPath, elcount(newPath), "%s.%s", oldPath, "approachLanesMap");
  SetTollAdvertisementMessageTollPointMap_approachLanesMapParams(packetHandle, value.approachLanesMap, newPath);
  result = CheckLastError("TollAdvertisementMessage", gkFuncRefGet, result);

  snprintf(newPath, elcount(newPath), "%s.%s", oldPath, "tollZoneLanesMap");
  SetTollAdvertisementMessageTollPointMap_tollZoneLanesMapParams(packetHandle, value.tollZoneLanesMap, newPath);
  result = CheckLastError("TollAdvertisementMessage", gkFuncRefGet, result);

  return result;
}

int GetTollAdvertisementMessageAckPolicyParams(LONG packetHandle, struct TollAdvertisementMessageAckPolicy value, char oldPath[])
{
  char newPath[300];
  int result;

  result = 0;

  snprintf(newPath, elcount(newPath), "%s.%s", oldPath, "timeout");
  value.timeout = C2xGetTokenInt(packetHandle, "TollAdvertisementMessage", newPath);
  result = CheckLastError("TollAdvertisementMessage", gkFuncRefGet, result);

  snprintf(newPath, elcount(newPath), "%s.%s", oldPath, "numOfRetries");
  value.numOfRetries = C2xGetTokenInt(packetHandle, "TollAdvertisementMessage", newPath);
  result = CheckLastError("TollAdvertisementMessage", gkFuncRefGet, result);

  return result;
}

int SetTollAdvertisementMessageAckPolicyParams(LONG packetHandle, struct TollAdvertisementMessageAckPolicy value, char oldPath[])
{
  char newPath[300];
  int result;

  result = 0;

  snprintf(newPath, elcount(newPath), "%s.%s", oldPath, "timeout");
  if (value.timeout < 100)
  {
    C2xSetTokenInt(packetHandle, "TollAdvertisementMessage", newPath, 100);
  }
  else if (value.timeout > 10000)
  {
    C2xSetTokenInt(packetHandle, "TollAdvertisementMessage", newPath, 10000);
  }
  else
  {
    C2xSetTokenInt(packetHandle, "TollAdvertisementMessage", newPath, value.timeout);
  }
  result = CheckLastError("TollAdvertisementMessage", gkFuncRefGet, result);

  snprintf(newPath, elcount(newPath), "%s.%s", oldPath, "numOfRetries");
  if (value.numOfRetries < 1)
  {
    C2xSetTokenInt(packetHandle, "TollAdvertisementMessage", newPath, 1);
  }
  else if (value.numOfRetries > 5)
  {
    C2xSetTokenInt(packetHandle, "TollAdvertisementMessage", newPath, 5);
  }
  else
  {
    C2xSetTokenInt(packetHandle, "TollAdvertisementMessage", newPath, value.numOfRetries);
  }
  result = CheckLastError("TollAdvertisementMessage", gkFuncRefGet, result);

  return result;
}

int GetTollAdvertisementMessageTollAdvertisementInfoParams(LONG packetHandle, struct TollAdvertisementMessageTollAdvertisementInfo value, char oldPath[])
{
  char newPath[300];
  int result;

  result = 0;

  snprintf(newPath, elcount(newPath), "%s.%s", oldPath, "tamSequenceNum");
  value.tamSequenceNum = C2xGetTokenInt(packetHandle, "TollAdvertisementMessage", newPath);
  result = CheckLastError("TollAdvertisementMessage", gkFuncRefGet, result);

  snprintf(newPath, elcount(newPath), "%s.%s", oldPath, "totalTams");
  value.totalTams = C2xGetTokenInt(packetHandle, "TollAdvertisementMessage", newPath);
  result = CheckLastError("TollAdvertisementMessage", gkFuncRefGet, result);

  snprintf(newPath, elcount(newPath), "%s.%s", oldPath, "tamNum");
  value.tamNum = C2xGetTokenInt(packetHandle, "TollAdvertisementMessage", newPath);
  result = CheckLastError("TollAdvertisementMessage", gkFuncRefGet, result);

  snprintf(newPath, elcount(newPath), "%s.%s", oldPath, "tollChargerInfo");
  GetTollAdvertisementMessageTollChargerInfoParams(packetHandle, value.tollChargerInfo, newPath);
  result = CheckLastError("TollAdvertisementMessage", gkFuncRefGet, result);

  snprintf(newPath, elcount(newPath), "%s.%s", oldPath, "timestamp");
  GetTollAdvertisementMessageCommon_DDateTimeParams(packetHandle, value.timestamp, newPath);
  result = CheckLastError("TollAdvertisementMessage", gkFuncRefGet, result);

  snprintf(newPath, elcount(newPath), "%s.%s", oldPath, "tumInstructions");
  value.tumInstructions.isValidFlag = C2xIsTokenAvailable(packetHandle, "TollAdvertisementMessage", newPath);
  if(value.tumInstructions.isValidFlag==1)
  {
    GetTollAdvertisementMessageTumInstructionsParams(packetHandle, value.tumInstructions, newPath);
    result = CheckLastError("TollAdvertisementMessage", gkFuncRefGet, result);
  }
  snprintf(newPath, elcount(newPath), "%s.%s", oldPath, "tollPointMap");
  GetTollAdvertisementMessageTollPointMapParams(packetHandle, value.tollPointMap, newPath);
  result = CheckLastError("TollAdvertisementMessage", gkFuncRefGet, result);

  snprintf(newPath, elcount(newPath), "%s.%s", oldPath, "tumPublicKey");
  value.tumPublicKey.stringLength = C2xGetTokenData(packetHandle, "TollAdvertisementMessage", newPath, elcount(value.tumPublicKey.string), value.tumPublicKey.string);
  snprintf(newPath, elcount(newPath), "%s.%s", oldPath, "ackPolicy");
  GetTollAdvertisementMessageAckPolicyParams(packetHandle, value.ackPolicy, newPath);
  result = CheckLastError("TollAdvertisementMessage", gkFuncRefGet, result);

  snprintf(newPath, elcount(newPath), "%s.%s", oldPath, "lastTollPtDataReq");
  value.lastTollPtDataReq.isValidFlag = C2xIsTokenAvailable(packetHandle, "TollAdvertisementMessage", newPath);
  if(value.lastTollPtDataReq.isValidFlag==1)
  {
    value.lastTollPtDataReq.value = C2xGetTokenInt64(packetHandle, "TollAdvertisementMessage", newPath);
    result = CheckLastError("TollAdvertisementMessage", gkFuncRefGet, result);
  }
  return result;
}

int SetTollAdvertisementMessageTollAdvertisementInfoParams(LONG packetHandle, struct TollAdvertisementMessageTollAdvertisementInfo value, char oldPath[])
{
  char newPath[300];
  int result;

  result = 0;

  snprintf(newPath, elcount(newPath), "%s.%s", oldPath, "tamSequenceNum");
  C2xSetTokenInt(packetHandle, "TollAdvertisementMessage", newPath, value.tamSequenceNum);
  result = CheckLastError("TollAdvertisementMessage", gkFuncRefGet, result);

  snprintf(newPath, elcount(newPath), "%s.%s", oldPath, "totalTams");
  if (value.totalTams < 1)
  {
    C2xSetTokenInt(packetHandle, "TollAdvertisementMessage", newPath, 1);
  }
  else if (value.totalTams > 10)
  {
    C2xSetTokenInt(packetHandle, "TollAdvertisementMessage", newPath, 10);
  }
  else
  {
    C2xSetTokenInt(packetHandle, "TollAdvertisementMessage", newPath, value.totalTams);
  }
  result = CheckLastError("TollAdvertisementMessage", gkFuncRefGet, result);

  snprintf(newPath, elcount(newPath), "%s.%s", oldPath, "tamNum");
  if (value.tamNum < 1)
  {
    C2xSetTokenInt(packetHandle, "TollAdvertisementMessage", newPath, 1);
  }
  else if (value.tamNum > 10)
  {
    C2xSetTokenInt(packetHandle, "TollAdvertisementMessage", newPath, 10);
  }
  else
  {
    C2xSetTokenInt(packetHandle, "TollAdvertisementMessage", newPath, value.tamNum);
  }
  result = CheckLastError("TollAdvertisementMessage", gkFuncRefGet, result);

  snprintf(newPath, elcount(newPath), "%s.%s", oldPath, "tollChargerInfo");
  SetTollAdvertisementMessageTollChargerInfoParams(packetHandle, value.tollChargerInfo, newPath);
  result = CheckLastError("TollAdvertisementMessage", gkFuncRefGet, result);

  snprintf(newPath, elcount(newPath), "%s.%s", oldPath, "timestamp");
  SetTollAdvertisementMessageCommon_DDateTimeParams(packetHandle, value.timestamp, newPath);
  result = CheckLastError("TollAdvertisementMessage", gkFuncRefGet, result);

  snprintf(newPath, elcount(newPath), "%s.%s", oldPath, "tumInstructions");
  if(value.tumInstructions.isValidFlag==1)
  {
    SetTollAdvertisementMessageTumInstructionsParams(packetHandle, value.tumInstructions, newPath);
    result = CheckLastError("TollAdvertisementMessage", gkFuncRefGet, result);
  }
  else
  {
    if( C2xIsTokenAvailable(packetHandle, "TollAdvertisementMessage", newPath) )
    {
      C2xRemoveToken(packetHandle, "TollAdvertisementMessage", newPath);
    }
  }

  snprintf(newPath, elcount(newPath), "%s.%s", oldPath, "tollPointMap");
  SetTollAdvertisementMessageTollPointMapParams(packetHandle, value.tollPointMap, newPath);
  result = CheckLastError("TollAdvertisementMessage", gkFuncRefGet, result);

  snprintf(newPath, elcount(newPath), "%s.%s", oldPath, "tumPublicKey");
  C2xSetTokenData(packetHandle, "TollAdvertisementMessage", newPath, value.tumPublicKey.stringLength, value.tumPublicKey.string);

  snprintf(newPath, elcount(newPath), "%s.%s", oldPath, "ackPolicy");
  SetTollAdvertisementMessageAckPolicyParams(packetHandle, value.ackPolicy, newPath);
  result = CheckLastError("TollAdvertisementMessage", gkFuncRefGet, result);

  snprintf(newPath, elcount(newPath), "%s.%s", oldPath, "lastTollPtDataReq");
  if(value.lastTollPtDataReq.isValidFlag==1)
  {
    C2xSetTokenInt64(packetHandle, "TollAdvertisementMessage", newPath, value.lastTollPtDataReq.value);
    result = CheckLastError("TollAdvertisementMessage", gkFuncRefGet, result);
  }
  else
  {
    if( C2xIsTokenAvailable(packetHandle, "TollAdvertisementMessage", newPath) )
    {
      C2xRemoveToken(packetHandle, "TollAdvertisementMessage", newPath);
    }
  }

  return result;
}

int GetTollAdvertisementMessage_TollAdvertisementMessageParams(LONG packetHandle, struct TollAdvertisementMessage_TollAdvertisementMessage value, char oldPath[])
{
  char newPath[300];
  int result;

  result = 0;

  snprintf(newPath, elcount(newPath), "%s.%s", oldPath, "tollChargesTable");
  GetTollAdvertisementMessageTollChargesTableParams(packetHandle, value.tollChargesTable, newPath);
  result = CheckLastError("TollAdvertisementMessage", gkFuncRefGet, result);

  snprintf(newPath, elcount(newPath), "%s.%s", oldPath, "tollAdvInfo");
  value.tollAdvInfo.isValidFlag = C2xIsTokenAvailable(packetHandle, "TollAdvertisementMessage", newPath);
  if(value.tollAdvInfo.isValidFlag==1)
  {
    GetTollAdvertisementMessageTollAdvertisementInfoParams(packetHandle, value.tollAdvInfo, newPath);
    result = CheckLastError("TollAdvertisementMessage", gkFuncRefGet, result);
  }
  return result;
}

int SetTollAdvertisementMessage_TollAdvertisementMessageParams(LONG packetHandle, struct TollAdvertisementMessage_TollAdvertisementMessage value, char oldPath[])
{
  char newPath[300];
  int result;

  result = 0;

  snprintf(newPath, elcount(newPath), "%s.%s", oldPath, "tollChargesTable");
  SetTollAdvertisementMessageTollChargesTableParams(packetHandle, value.tollChargesTable, newPath);
  result = CheckLastError("TollAdvertisementMessage", gkFuncRefGet, result);

  snprintf(newPath, elcount(newPath), "%s.%s", oldPath, "tollAdvInfo");
  if(value.tollAdvInfo.isValidFlag==1)
  {
    SetTollAdvertisementMessageTollAdvertisementInfoParams(packetHandle, value.tollAdvInfo, newPath);
    result = CheckLastError("TollAdvertisementMessage", gkFuncRefGet, result);
  }
  else
  {
    if( C2xIsTokenAvailable(packetHandle, "TollAdvertisementMessage", newPath) )
    {
      C2xRemoveToken(packetHandle, "TollAdvertisementMessage", newPath);
    }
  }

  return result;
}

int GetTollAdvertisementMessageMESSAGE_ID_AND_TYPEParams(LONG packetHandle, WORD tableKey, struct TollAdvertisementMessageMESSAGE_ID_AND_TYPE value, char oldPath[])
{
  char newPath[300];
  int result;

  result = 0;

  switch(tableKey)
  {
    case 37:
    {
      snprintf(newPath, elcount(newPath), "%s.%s", oldPath, "tollAdvertisementMessage");
      GetTollAdvertisementMessage_TollAdvertisementMessageParams(packetHandle, value.tollAdvertisementMessage, newPath);
      result = CheckLastError("TollAdvertisementMessage", gkFuncRefGet, result);
    }
    break;
  }
  return result;
}

int SetTollAdvertisementMessageMESSAGE_ID_AND_TYPEParams(LONG packetHandle, WORD tableKey, struct TollAdvertisementMessageMESSAGE_ID_AND_TYPE value, char oldPath[])
{
  char newPath[300];
  int result;

  result = 0;

  switch(tableKey)
  {
    case 37:
    {
      snprintf(newPath, elcount(newPath), "%s.%s", oldPath, "tollAdvertisementMessage");
      SetTollAdvertisementMessage_TollAdvertisementMessageParams(packetHandle, value.tollAdvertisementMessage, newPath);
      result = CheckLastError("TollAdvertisementMessage", gkFuncRefGet, result);
    }
    break;
  }
  return result;
}

int API_GetTollAdvertisementMessageParams(LONG packetHandle, struct TollAdvertisementMessage value)
{
  int result;
  result = 0;

  value.messageId = C2xGetTokenInt(packetHandle, "TollAdvertisementMessage", "messageId");
  result = CheckLastError("TollAdvertisementMessage", gkFuncRefGet, result);

  GetTollAdvertisementMessageMESSAGE_ID_AND_TYPEParams(packetHandle, value.messageId, value.value, "value");
  result = CheckLastError("TollAdvertisementMessage", gkFuncRefGet, result);

  return result;
}

int API_SetTollAdvertisementMessageParams(LONG packetHandle, struct TollAdvertisementMessage value)
{
  int result;
  result = 0;

  value.messageId = 37;

  SetTollAdvertisementMessageMESSAGE_ID_AND_TYPEParams(packetHandle, value.messageId, value.value, "value");
  result = CheckLastError("TollAdvertisementMessage", gkFuncRefGet, result);

  return result;
}

