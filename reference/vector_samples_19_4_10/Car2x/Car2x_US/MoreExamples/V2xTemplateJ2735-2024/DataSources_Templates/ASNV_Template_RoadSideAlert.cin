/*@!Encoding:1252*/
/*
//  (c) Vector Informatik GmbH. All rights reserved.
//
//  This file contains definitions of structs and methods that may be used
//  to set and get the values of an ASN.1 defined packet's payload.
//
//  //This example demonstrates how to set a packet's payload:
//  LONG packetHandle;
//  struct RoadSideAlert payload;
//  //you need to set the values of the variable "payload" yourself
//  packetHandle = API_InitRoadSideAlertPacket();
//  if (packetHandle!=0) {
//    if (API_SetRoadSideAlertParams(packetHandle, payload)==0) {
//      if (C2xCompletePacket(packetHandle)==0) {
//        C2xOutputPacket(packetHandle);
//      }
//    }
//  }
//                                                                             */
includes
{
  #include "ASNV_Template_BaseDatatypes.cin"  // If warning "Duplicate #include, ignoring this include" appears, please remove the ASNV_Template_BaseDatatypes.cin include from your other *.cin files in the project.
}
variables
{
    struct RoadSideAlertRoadSideAlert_description {
        INT isValidFlag;   // necessary if this struct is used as an optional field of a SEQUENCE
        INT length;
        WORD arrayValue[8];  // INTEGER, 0..65535;
    };
    
    struct RoadSideAlertCommon_Priority {
        INT isValidFlag;   // necessary if this struct is used as an optional field of a SEQUENCE
        CHAR string[2];
        INT  stringLength;
    };
    
    struct RoadSideAlertCommon_HeadingSlice {
        INT isValidFlag;   // necessary if this struct is used as an optional field of a SEQUENCE
        CHAR string[17];
        INT  stringLength;
    };
    
    struct RoadSideAlertCommon_DDateTime {
        INT isValidFlag;   // necessary if this struct is used as an optional field of a SEQUENCE
        struct OPT_WORD_ASN year;  // INTEGER, OPTIONAL, 0..4095;
        struct OPT_BYTE_ASN month;  // INTEGER, OPTIONAL, 0..12;
        struct OPT_BYTE_ASN day;  // INTEGER, OPTIONAL, 0..31;
        struct OPT_BYTE_ASN hour;  // INTEGER, OPTIONAL, 0..31;
        struct OPT_BYTE_ASN minute;  // INTEGER, OPTIONAL, 0..60;
        struct OPT_WORD_ASN second;  // INTEGER, OPTIONAL, 0..65535;
        struct OPT_INT_ASN offset;  // INTEGER, OPTIONAL, -840..840;
    };
    
    struct RoadSideAlertCommon_TransmissionAndSpeed {
        INT isValidFlag;   // necessary if this struct is used as an optional field of a SEQUENCE
        INT transmisson;  // ENUMERATED, neutral(0), park(1), forwardGears(2), reverseGears(3), reserved1(4), reserved2(5), reserved3(6), unavailable(7);
        WORD speed;  // INTEGER, 0..8191;
    };
    
    struct RoadSideAlertCommon_PositionalAccuracy {
        INT isValidFlag;   // necessary if this struct is used as an optional field of a SEQUENCE
        BYTE semiMajor;  // INTEGER, 0..255;
        BYTE semiMinor;  // INTEGER, 0..255;
        WORD orientation;  // INTEGER, 0..65535;
    };
    
    struct RoadSideAlertCommon_PositionConfidenceSet {
        INT isValidFlag;   // necessary if this struct is used as an optional field of a SEQUENCE
        INT pos;  // ENUMERATED, unavailable(0), a500m(1), a200m(2), a100m(3), a50m(4), a20m(5), a10m(6), a5m(7), a2m(8), a1m(9), a50cm(10), a20cm(11), a10cm(12), a5cm(13), a2cm(14), a1cm(15);
        INT elevation;  // ENUMERATED, unavailable(0), elev_500_00(1), elev_200_00(2), elev_100_00(3), elev_050_00(4), elev_020_00(5), elev_010_00(6), elev_005_00(7), elev_002_00(8), elev_001_00(9), elev_000_50(10), elev_000_20(11), elev_000_10(12), elev_000_05(13), elev_000_02(14), elev_000_01(15);
    };
    
    struct RoadSideAlertCommon_SpeedandHeadingandThrottleConfidence {
        INT isValidFlag;   // necessary if this struct is used as an optional field of a SEQUENCE
        INT heading;  // ENUMERATED, unavailable(0), prec10deg(1), prec05deg(2), prec01deg(3), prec0_1deg(4), prec0_05deg(5), prec0_01deg(6), prec0_0125deg(7);
        INT speed;  // ENUMERATED, unavailable(0), prec100ms(1), prec10ms(2), prec5ms(3), prec1ms(4), prec0_1ms(5), prec0_05ms(6), prec0_01ms(7);
        INT throttle;  // ENUMERATED, unavailable(0), prec10percent(1), prec1percent(2), prec0_5percent(3);
    };
    
    struct RoadSideAlertCommon_FullPositionVector {
        INT isValidFlag;   // necessary if this struct is used as an optional field of a SEQUENCE
        struct RoadSideAlertCommon_DDateTime utcTime;  // SEQUENCE, OPTIONAL;
        LONG lon;  // INTEGER, -1799999999..1800000001;
        LONG lat;  // INTEGER, -900000000..900000001;
        struct OPT_LONG_ASN elevation;  // INTEGER, OPTIONAL, -4096..61439;
        struct OPT_WORD_ASN heading;  // INTEGER, OPTIONAL, 0..28800;
        struct RoadSideAlertCommon_TransmissionAndSpeed speed;  // SEQUENCE, OPTIONAL;
        struct RoadSideAlertCommon_PositionalAccuracy posAccuracy;  // SEQUENCE, OPTIONAL;
        struct OPT_ENUM_ASN timeConfidence;  // ENUMERATED, OPTIONAL, unavailable(0), time_100_000(1), time_050_000(2), time_020_000(3), time_010_000(4), time_002_000(5), time_001_000(6), time_000_500(7), time_000_200(8), time_000_100(9), time_000_050(10), time_000_020(11), time_000_010(12), time_000_005(13), time_000_002(14), time_000_001(15), time_000_000_5(16), time_000_000_2(17), time_000_000_1(18), time_000_000_05(19), time_000_000_02(20), time_000_000_01(21), time_000_000_005(22), time_000_000_002(23), time_000_000_001(24), time_000_000_000_5(25), time_000_000_000_2(26), time_000_000_000_1(27), time_000_000_000_05(28), time_000_000_000_02(29), time_000_000_000_01(30), time_000_000_000_005(31), time_000_000_000_002(32), time_000_000_000_001(33), time_000_000_000_000_5(34), time_000_000_000_000_2(35), time_000_000_000_000_1(36), time_000_000_000_000_05(37), time_000_000_000_000_02(38), time_000_000_000_000_01(39);
        struct RoadSideAlertCommon_PositionConfidenceSet posConfidence;  // SEQUENCE, OPTIONAL;
        struct RoadSideAlertCommon_SpeedandHeadingandThrottleConfidence speedConfidence;  // SEQUENCE, OPTIONAL;
    };
    
    struct RoadSideAlertCommon_FurtherInfoID {
        INT isValidFlag;   // necessary if this struct is used as an optional field of a SEQUENCE
        CHAR string[3];
        INT  stringLength;
    };
    
    struct RoadSideAlertCommon_RegionalExtension_Reg_RoadSideAlert_table {
    };
    
    struct RoadSideAlertCommon_RegionalExtension_Reg_RoadSideAlert {
        INT isValidFlag;   // necessary if this struct is used as an optional field of a SEQUENCE
        BYTE regionId;  // INTEGER, 0..255, noRegion(0), addGrpA(1), addGrpB(2), addGrpC(3), addGrpD(4);
        struct RoadSideAlertCommon_RegionalExtension_Reg_RoadSideAlert_table regExtvalue;  // TABLE;
    };
    
    struct RoadSideAlertRoadSideAlert_regional {
        INT isValidFlag;   // necessary if this struct is used as an optional field of a SEQUENCE
        INT length;
        struct RoadSideAlertCommon_RegionalExtension_Reg_RoadSideAlert arrayValue[4];  // SEQUENCE;
    };
    
    struct RoadSideAlert_RoadSideAlert {
        INT isValidFlag;   // necessary if this struct is used as an optional field of a SEQUENCE
        BYTE msgCnt;  // INTEGER, 0..127;
        struct OPT_DWORD_ASN timeStamp;  // INTEGER, OPTIONAL, 0..527040;
        WORD typeEvent;  // INTEGER, 0..65535;
        struct RoadSideAlertRoadSideAlert_description description;  // SEQUENCEOF, OPTIONAL;
        struct RoadSideAlertCommon_Priority priority;  // OCTETSTRING, OPTIONAL;
        struct RoadSideAlertCommon_HeadingSlice heading;  // BITSTRING, OPTIONAL;
        struct OPT_ENUM_ASN extent;  // ENUMERATED, OPTIONAL, useInstantlyOnly(0), useFor3meters(1), useFor10meters(2), useFor50meters(3), useFor100meters(4), useFor500meters(5), useFor1000meters(6), useFor5000meters(7), useFor10000meters(8), useFor50000meters(9), useFor100000meters(10), useFor500000meters(11), useFor1000000meters(12), useFor5000000meters(13), useFor10000000meters(14), forever(15);
        struct RoadSideAlertCommon_FullPositionVector position;  // SEQUENCE, OPTIONAL;
        struct RoadSideAlertCommon_FurtherInfoID furtherInfoID;  // OCTETSTRING, OPTIONAL;
        struct RoadSideAlertRoadSideAlert_regional regional;  // SEQUENCEOF, OPTIONAL;
    };
    
    struct RoadSideAlertMESSAGE_ID_AND_TYPE {
        struct RoadSideAlert_RoadSideAlert roadSideAlert;  // SEQUENCE;
    };
    
    struct RoadSideAlert {
        INT isValidFlag;   // necessary if this struct is used as an optional field of a SEQUENCE
        WORD messageId;  // INTEGER, 0..32767, mapData(18), signalPhaseAndTimingMessage(19), basicSafetyMessage(20), commonSafetyRequest(21), emergencyVehicleAlert(22), intersectionCollision(23), nmeaCorrections(24), probeDataManagement(25), probeVehicleData(26), roadSideAlert(27), rtcmCorrections(28), signalRequestMessage(29), signalStatusMessage(30), travelerInformation(31), personalSafetyMessage(32), roadSafetyMessage(33), roadWeatherMessage(34), probeDataConfigMessage(35), probeDataReportMessage(36), tollAdvertisementMessage(37), tollUsageMessage(38), tollUsageAckMessage(39), cooperativeControlMessage(40), sensorDataSharingMessage(41), maneuverSharingAndCoordinatingMessage(42), roadGeometryAndAttributes(43), personalSafetyMessage2(44), trafficSignalPhaseAndTiming(45), signalControlAndPrioritizationRequest(46), signalControlAndPrioritizationStatus(47), roadUserChargingConfigMessage(48), roadUserChargingReportMessage(49), trafficLightStatusMessage(50);
        struct RoadSideAlertMESSAGE_ID_AND_TYPE value;  // TABLE;
    };
    
}

/*
// init function to create a simple packet handle
*/ 
LONG API_InitRoadSideAlertPacket()
{
  return C2xInitPacket("RoadSideAlert"); 
}

/*
// init function to create a simple packet handle and
// initialize the struct with valid data
*/ 
LONG API_InitRoadSideAlertPacket(struct RoadSideAlert msgStruct)
{
  long pktHandle;

  pktHandle = API_InitRoadSideAlertPacket();

  if (pktHandle != 0)
  {
    // create valid message and application data
    if (C2xCompletePacket(pktHandle) == 0) 
    {
      API_GetRoadSideAlertParams(pktHandle, msgStruct);
    }
  }
  return pktHandle;
}

/*
// init function to create a packet with security layer and
// initialize the struct with valid data
*/ 
LONG API_InitRoadSideAlertPacket(struct RoadSideAlert msgStruct, char packetTypeDesignator[], char certificateName[])
{
  long pktHandle, certHdl;

  // initialize the packet
  pktHandle = C2xInitPacket("RoadSideAlert", packetTypeDesignator);

  if (pktHandle != 0)
  {
    certHdl = C2xSecCertificateGetHandle(certificateName);  // get the certificate handle for the cert with name "certificateName"
    if (certHdl != 0) 
    {
      C2xSecPacketSetSignerHandle(pktHandle, certHdl); // set the certHdl to the packet
    }

    // create valid message and application data
    if (C2xCompletePacket(pktHandle) == 0) 
    {
      // copy application data to the application structure
      API_GetRoadSideAlertParams(pktHandle, msgStruct);
    }
  }
  return pktHandle;
}
    

int GetRoadSideAlertRoadSideAlert_descriptionParams(LONG packetHandle, struct RoadSideAlertRoadSideAlert_description value, char oldPath[])
{
  char newPath[300]; 
  int i;
  int result;

  result = 0;

  value.length = C2xGetTokenInt(packetHandle, "RoadSideAlert", oldPath);
  if((result = CheckLastError("RoadSideAlert", gkFuncRefGet, result))==0)
  {
    for(i=0; i<value.length; i++)
    {
      snprintf(newPath, elcount(newPath), "%s[%d]", oldPath, i);
      value.arrayValue[i] = C2xGetTokenInt64(packetHandle, "RoadSideAlert", newPath);
      result = CheckLastError("RoadSideAlert", gkFuncRefGet, result);
    }
  }
  return result;
}

int SetRoadSideAlertRoadSideAlert_descriptionParams(LONG packetHandle, struct RoadSideAlertRoadSideAlert_description value, char oldPath[])
{
  char newPath[300]; 
  int i;
  int result;

  result = 0;

  C2xRemoveToken(packetHandle, "RoadSideAlert", oldPath);
  for(i=0; i<value.length; i++)
  {
    snprintf(newPath, elcount(newPath), "%s[%d]", oldPath, i);
    C2xSetTokenInt64(packetHandle, "RoadSideAlert", newPath, value.arrayValue[i]);
    result = CheckLastError("RoadSideAlert", gkFuncRefGet, result);
  }
  return result;
}

int GetRoadSideAlertCommon_DDateTimeParams(LONG packetHandle, struct RoadSideAlertCommon_DDateTime value, char oldPath[])
{
  char newPath[300];
  int result;

  result = 0;

  snprintf(newPath, elcount(newPath), "%s.%s", oldPath, "year");
  value.year.isValidFlag = C2xIsTokenAvailable(packetHandle, "RoadSideAlert", newPath);
  if(value.year.isValidFlag==1)
  {
    value.year.value = C2xGetTokenInt(packetHandle, "RoadSideAlert", newPath);
    result = CheckLastError("RoadSideAlert", gkFuncRefGet, result);
  }
  snprintf(newPath, elcount(newPath), "%s.%s", oldPath, "month");
  value.month.isValidFlag = C2xIsTokenAvailable(packetHandle, "RoadSideAlert", newPath);
  if(value.month.isValidFlag==1)
  {
    value.month.value = C2xGetTokenInt(packetHandle, "RoadSideAlert", newPath);
    result = CheckLastError("RoadSideAlert", gkFuncRefGet, result);
  }
  snprintf(newPath, elcount(newPath), "%s.%s", oldPath, "day");
  value.day.isValidFlag = C2xIsTokenAvailable(packetHandle, "RoadSideAlert", newPath);
  if(value.day.isValidFlag==1)
  {
    value.day.value = C2xGetTokenInt(packetHandle, "RoadSideAlert", newPath);
    result = CheckLastError("RoadSideAlert", gkFuncRefGet, result);
  }
  snprintf(newPath, elcount(newPath), "%s.%s", oldPath, "hour");
  value.hour.isValidFlag = C2xIsTokenAvailable(packetHandle, "RoadSideAlert", newPath);
  if(value.hour.isValidFlag==1)
  {
    value.hour.value = C2xGetTokenInt(packetHandle, "RoadSideAlert", newPath);
    result = CheckLastError("RoadSideAlert", gkFuncRefGet, result);
  }
  snprintf(newPath, elcount(newPath), "%s.%s", oldPath, "minute");
  value.minute.isValidFlag = C2xIsTokenAvailable(packetHandle, "RoadSideAlert", newPath);
  if(value.minute.isValidFlag==1)
  {
    value.minute.value = C2xGetTokenInt(packetHandle, "RoadSideAlert", newPath);
    result = CheckLastError("RoadSideAlert", gkFuncRefGet, result);
  }
  snprintf(newPath, elcount(newPath), "%s.%s", oldPath, "second");
  value.second.isValidFlag = C2xIsTokenAvailable(packetHandle, "RoadSideAlert", newPath);
  if(value.second.isValidFlag==1)
  {
    value.second.value = C2xGetTokenInt(packetHandle, "RoadSideAlert", newPath);
    result = CheckLastError("RoadSideAlert", gkFuncRefGet, result);
  }
  snprintf(newPath, elcount(newPath), "%s.%s", oldPath, "offset");
  value.offset.isValidFlag = C2xIsTokenAvailable(packetHandle, "RoadSideAlert", newPath);
  if(value.offset.isValidFlag==1)
  {
    value.offset.value = C2xGetTokenInt(packetHandle, "RoadSideAlert", newPath);
    result = CheckLastError("RoadSideAlert", gkFuncRefGet, result);
  }
  return result;
}

int SetRoadSideAlertCommon_DDateTimeParams(LONG packetHandle, struct RoadSideAlertCommon_DDateTime value, char oldPath[])
{
  char newPath[300];
  int result;

  result = 0;

  snprintf(newPath, elcount(newPath), "%s.%s", oldPath, "year");
  if(value.year.isValidFlag==1)
  {
    C2xSetTokenInt(packetHandle, "RoadSideAlert", newPath, value.year.value);
    result = CheckLastError("RoadSideAlert", gkFuncRefGet, result);
  }
  else
  {
    if( C2xIsTokenAvailable(packetHandle, "RoadSideAlert", newPath) )
    {
      C2xRemoveToken(packetHandle, "RoadSideAlert", newPath);
    }
  }

  snprintf(newPath, elcount(newPath), "%s.%s", oldPath, "month");
  if(value.month.isValidFlag==1)
  {
    C2xSetTokenInt(packetHandle, "RoadSideAlert", newPath, value.month.value);
    result = CheckLastError("RoadSideAlert", gkFuncRefGet, result);
  }
  else
  {
    if( C2xIsTokenAvailable(packetHandle, "RoadSideAlert", newPath) )
    {
      C2xRemoveToken(packetHandle, "RoadSideAlert", newPath);
    }
  }

  snprintf(newPath, elcount(newPath), "%s.%s", oldPath, "day");
  if(value.day.isValidFlag==1)
  {
    C2xSetTokenInt(packetHandle, "RoadSideAlert", newPath, value.day.value);
    result = CheckLastError("RoadSideAlert", gkFuncRefGet, result);
  }
  else
  {
    if( C2xIsTokenAvailable(packetHandle, "RoadSideAlert", newPath) )
    {
      C2xRemoveToken(packetHandle, "RoadSideAlert", newPath);
    }
  }

  snprintf(newPath, elcount(newPath), "%s.%s", oldPath, "hour");
  if(value.hour.isValidFlag==1)
  {
    C2xSetTokenInt(packetHandle, "RoadSideAlert", newPath, value.hour.value);
    result = CheckLastError("RoadSideAlert", gkFuncRefGet, result);
  }
  else
  {
    if( C2xIsTokenAvailable(packetHandle, "RoadSideAlert", newPath) )
    {
      C2xRemoveToken(packetHandle, "RoadSideAlert", newPath);
    }
  }

  snprintf(newPath, elcount(newPath), "%s.%s", oldPath, "minute");
  if(value.minute.isValidFlag==1)
  {
    C2xSetTokenInt(packetHandle, "RoadSideAlert", newPath, value.minute.value);
    result = CheckLastError("RoadSideAlert", gkFuncRefGet, result);
  }
  else
  {
    if( C2xIsTokenAvailable(packetHandle, "RoadSideAlert", newPath) )
    {
      C2xRemoveToken(packetHandle, "RoadSideAlert", newPath);
    }
  }

  snprintf(newPath, elcount(newPath), "%s.%s", oldPath, "second");
  if(value.second.isValidFlag==1)
  {
    C2xSetTokenInt(packetHandle, "RoadSideAlert", newPath, value.second.value);
    result = CheckLastError("RoadSideAlert", gkFuncRefGet, result);
  }
  else
  {
    if( C2xIsTokenAvailable(packetHandle, "RoadSideAlert", newPath) )
    {
      C2xRemoveToken(packetHandle, "RoadSideAlert", newPath);
    }
  }

  snprintf(newPath, elcount(newPath), "%s.%s", oldPath, "offset");
  if(value.offset.isValidFlag==1)
  {
    C2xSetTokenInt(packetHandle, "RoadSideAlert", newPath, value.offset.value);
    result = CheckLastError("RoadSideAlert", gkFuncRefGet, result);
  }
  else
  {
    if( C2xIsTokenAvailable(packetHandle, "RoadSideAlert", newPath) )
    {
      C2xRemoveToken(packetHandle, "RoadSideAlert", newPath);
    }
  }

  return result;
}

int GetRoadSideAlertCommon_TransmissionAndSpeedParams(LONG packetHandle, struct RoadSideAlertCommon_TransmissionAndSpeed value, char oldPath[])
{
  char newPath[300];
  int result;

  result = 0;

  snprintf(newPath, elcount(newPath), "%s.%s", oldPath, "transmisson");
  value.transmisson = C2xGetTokenInt(packetHandle, "RoadSideAlert", newPath);
  result = CheckLastError("RoadSideAlert", gkFuncRefGet, result);

  snprintf(newPath, elcount(newPath), "%s.%s", oldPath, "speed");
  value.speed = C2xGetTokenInt(packetHandle, "RoadSideAlert", newPath);
  result = CheckLastError("RoadSideAlert", gkFuncRefGet, result);

  return result;
}

int SetRoadSideAlertCommon_TransmissionAndSpeedParams(LONG packetHandle, struct RoadSideAlertCommon_TransmissionAndSpeed value, char oldPath[])
{
  char newPath[300];
  int result;

  result = 0;

  snprintf(newPath, elcount(newPath), "%s.%s", oldPath, "transmisson");
  C2xSetTokenInt(packetHandle, "RoadSideAlert", newPath, value.transmisson);
  result = CheckLastError("RoadSideAlert", gkFuncRefGet, result);

  snprintf(newPath, elcount(newPath), "%s.%s", oldPath, "speed");
  C2xSetTokenInt(packetHandle, "RoadSideAlert", newPath, value.speed);
  result = CheckLastError("RoadSideAlert", gkFuncRefGet, result);

  return result;
}

int GetRoadSideAlertCommon_PositionalAccuracyParams(LONG packetHandle, struct RoadSideAlertCommon_PositionalAccuracy value, char oldPath[])
{
  char newPath[300];
  int result;

  result = 0;

  snprintf(newPath, elcount(newPath), "%s.%s", oldPath, "semiMajor");
  value.semiMajor = C2xGetTokenInt(packetHandle, "RoadSideAlert", newPath);
  result = CheckLastError("RoadSideAlert", gkFuncRefGet, result);

  snprintf(newPath, elcount(newPath), "%s.%s", oldPath, "semiMinor");
  value.semiMinor = C2xGetTokenInt(packetHandle, "RoadSideAlert", newPath);
  result = CheckLastError("RoadSideAlert", gkFuncRefGet, result);

  snprintf(newPath, elcount(newPath), "%s.%s", oldPath, "orientation");
  value.orientation = C2xGetTokenInt(packetHandle, "RoadSideAlert", newPath);
  result = CheckLastError("RoadSideAlert", gkFuncRefGet, result);

  return result;
}

int SetRoadSideAlertCommon_PositionalAccuracyParams(LONG packetHandle, struct RoadSideAlertCommon_PositionalAccuracy value, char oldPath[])
{
  char newPath[300];
  int result;

  result = 0;

  snprintf(newPath, elcount(newPath), "%s.%s", oldPath, "semiMajor");
  C2xSetTokenInt(packetHandle, "RoadSideAlert", newPath, value.semiMajor);
  result = CheckLastError("RoadSideAlert", gkFuncRefGet, result);

  snprintf(newPath, elcount(newPath), "%s.%s", oldPath, "semiMinor");
  C2xSetTokenInt(packetHandle, "RoadSideAlert", newPath, value.semiMinor);
  result = CheckLastError("RoadSideAlert", gkFuncRefGet, result);

  snprintf(newPath, elcount(newPath), "%s.%s", oldPath, "orientation");
  C2xSetTokenInt(packetHandle, "RoadSideAlert", newPath, value.orientation);
  result = CheckLastError("RoadSideAlert", gkFuncRefGet, result);

  return result;
}

int GetRoadSideAlertCommon_PositionConfidenceSetParams(LONG packetHandle, struct RoadSideAlertCommon_PositionConfidenceSet value, char oldPath[])
{
  char newPath[300];
  int result;

  result = 0;

  snprintf(newPath, elcount(newPath), "%s.%s", oldPath, "pos");
  value.pos = C2xGetTokenInt(packetHandle, "RoadSideAlert", newPath);
  result = CheckLastError("RoadSideAlert", gkFuncRefGet, result);

  snprintf(newPath, elcount(newPath), "%s.%s", oldPath, "elevation");
  value.elevation = C2xGetTokenInt(packetHandle, "RoadSideAlert", newPath);
  result = CheckLastError("RoadSideAlert", gkFuncRefGet, result);

  return result;
}

int SetRoadSideAlertCommon_PositionConfidenceSetParams(LONG packetHandle, struct RoadSideAlertCommon_PositionConfidenceSet value, char oldPath[])
{
  char newPath[300];
  int result;

  result = 0;

  snprintf(newPath, elcount(newPath), "%s.%s", oldPath, "pos");
  C2xSetTokenInt(packetHandle, "RoadSideAlert", newPath, value.pos);
  result = CheckLastError("RoadSideAlert", gkFuncRefGet, result);

  snprintf(newPath, elcount(newPath), "%s.%s", oldPath, "elevation");
  C2xSetTokenInt(packetHandle, "RoadSideAlert", newPath, value.elevation);
  result = CheckLastError("RoadSideAlert", gkFuncRefGet, result);

  return result;
}

int GetRoadSideAlertCommon_SpeedandHeadingandThrottleConfidenceParams(LONG packetHandle, struct RoadSideAlertCommon_SpeedandHeadingandThrottleConfidence value, char oldPath[])
{
  char newPath[300];
  int result;

  result = 0;

  snprintf(newPath, elcount(newPath), "%s.%s", oldPath, "heading");
  value.heading = C2xGetTokenInt(packetHandle, "RoadSideAlert", newPath);
  result = CheckLastError("RoadSideAlert", gkFuncRefGet, result);

  snprintf(newPath, elcount(newPath), "%s.%s", oldPath, "speed");
  value.speed = C2xGetTokenInt(packetHandle, "RoadSideAlert", newPath);
  result = CheckLastError("RoadSideAlert", gkFuncRefGet, result);

  snprintf(newPath, elcount(newPath), "%s.%s", oldPath, "throttle");
  value.throttle = C2xGetTokenInt(packetHandle, "RoadSideAlert", newPath);
  result = CheckLastError("RoadSideAlert", gkFuncRefGet, result);

  return result;
}

int SetRoadSideAlertCommon_SpeedandHeadingandThrottleConfidenceParams(LONG packetHandle, struct RoadSideAlertCommon_SpeedandHeadingandThrottleConfidence value, char oldPath[])
{
  char newPath[300];
  int result;

  result = 0;

  snprintf(newPath, elcount(newPath), "%s.%s", oldPath, "heading");
  C2xSetTokenInt(packetHandle, "RoadSideAlert", newPath, value.heading);
  result = CheckLastError("RoadSideAlert", gkFuncRefGet, result);

  snprintf(newPath, elcount(newPath), "%s.%s", oldPath, "speed");
  C2xSetTokenInt(packetHandle, "RoadSideAlert", newPath, value.speed);
  result = CheckLastError("RoadSideAlert", gkFuncRefGet, result);

  snprintf(newPath, elcount(newPath), "%s.%s", oldPath, "throttle");
  C2xSetTokenInt(packetHandle, "RoadSideAlert", newPath, value.throttle);
  result = CheckLastError("RoadSideAlert", gkFuncRefGet, result);

  return result;
}

int GetRoadSideAlertCommon_FullPositionVectorParams(LONG packetHandle, struct RoadSideAlertCommon_FullPositionVector value, char oldPath[])
{
  char newPath[300];
  int result;

  result = 0;

  snprintf(newPath, elcount(newPath), "%s.%s", oldPath, "utcTime");
  value.utcTime.isValidFlag = C2xIsTokenAvailable(packetHandle, "RoadSideAlert", newPath);
  if(value.utcTime.isValidFlag==1)
  {
    GetRoadSideAlertCommon_DDateTimeParams(packetHandle, value.utcTime, newPath);
    result = CheckLastError("RoadSideAlert", gkFuncRefGet, result);
  }
  snprintf(newPath, elcount(newPath), "%s.%s", oldPath, "lon");
  value.lon = C2xGetTokenInt(packetHandle, "RoadSideAlert", newPath);
  result = CheckLastError("RoadSideAlert", gkFuncRefGet, result);

  snprintf(newPath, elcount(newPath), "%s.%s", oldPath, "lat");
  value.lat = C2xGetTokenInt(packetHandle, "RoadSideAlert", newPath);
  result = CheckLastError("RoadSideAlert", gkFuncRefGet, result);

  snprintf(newPath, elcount(newPath), "%s.%s", oldPath, "elevation");
  value.elevation.isValidFlag = C2xIsTokenAvailable(packetHandle, "RoadSideAlert", newPath);
  if(value.elevation.isValidFlag==1)
  {
    value.elevation.value = C2xGetTokenInt(packetHandle, "RoadSideAlert", newPath);
    result = CheckLastError("RoadSideAlert", gkFuncRefGet, result);
  }
  snprintf(newPath, elcount(newPath), "%s.%s", oldPath, "heading");
  value.heading.isValidFlag = C2xIsTokenAvailable(packetHandle, "RoadSideAlert", newPath);
  if(value.heading.isValidFlag==1)
  {
    value.heading.value = C2xGetTokenInt(packetHandle, "RoadSideAlert", newPath);
    result = CheckLastError("RoadSideAlert", gkFuncRefGet, result);
  }
  snprintf(newPath, elcount(newPath), "%s.%s", oldPath, "speed");
  value.speed.isValidFlag = C2xIsTokenAvailable(packetHandle, "RoadSideAlert", newPath);
  if(value.speed.isValidFlag==1)
  {
    GetRoadSideAlertCommon_TransmissionAndSpeedParams(packetHandle, value.speed, newPath);
    result = CheckLastError("RoadSideAlert", gkFuncRefGet, result);
  }
  snprintf(newPath, elcount(newPath), "%s.%s", oldPath, "posAccuracy");
  value.posAccuracy.isValidFlag = C2xIsTokenAvailable(packetHandle, "RoadSideAlert", newPath);
  if(value.posAccuracy.isValidFlag==1)
  {
    GetRoadSideAlertCommon_PositionalAccuracyParams(packetHandle, value.posAccuracy, newPath);
    result = CheckLastError("RoadSideAlert", gkFuncRefGet, result);
  }
  snprintf(newPath, elcount(newPath), "%s.%s", oldPath, "timeConfidence");
  value.timeConfidence.isValidFlag = C2xIsTokenAvailable(packetHandle, "RoadSideAlert", newPath);
  if(value.timeConfidence.isValidFlag==1)
  {
    value.timeConfidence.value = C2xGetTokenInt(packetHandle, "RoadSideAlert", newPath);
    result = CheckLastError("RoadSideAlert", gkFuncRefGet, result);
  }
  snprintf(newPath, elcount(newPath), "%s.%s", oldPath, "posConfidence");
  value.posConfidence.isValidFlag = C2xIsTokenAvailable(packetHandle, "RoadSideAlert", newPath);
  if(value.posConfidence.isValidFlag==1)
  {
    GetRoadSideAlertCommon_PositionConfidenceSetParams(packetHandle, value.posConfidence, newPath);
    result = CheckLastError("RoadSideAlert", gkFuncRefGet, result);
  }
  snprintf(newPath, elcount(newPath), "%s.%s", oldPath, "speedConfidence");
  value.speedConfidence.isValidFlag = C2xIsTokenAvailable(packetHandle, "RoadSideAlert", newPath);
  if(value.speedConfidence.isValidFlag==1)
  {
    GetRoadSideAlertCommon_SpeedandHeadingandThrottleConfidenceParams(packetHandle, value.speedConfidence, newPath);
    result = CheckLastError("RoadSideAlert", gkFuncRefGet, result);
  }
  return result;
}

int SetRoadSideAlertCommon_FullPositionVectorParams(LONG packetHandle, struct RoadSideAlertCommon_FullPositionVector value, char oldPath[])
{
  char newPath[300];
  int result;

  result = 0;

  snprintf(newPath, elcount(newPath), "%s.%s", oldPath, "utcTime");
  if(value.utcTime.isValidFlag==1)
  {
    SetRoadSideAlertCommon_DDateTimeParams(packetHandle, value.utcTime, newPath);
    result = CheckLastError("RoadSideAlert", gkFuncRefGet, result);
  }
  else
  {
    if( C2xIsTokenAvailable(packetHandle, "RoadSideAlert", newPath) )
    {
      C2xRemoveToken(packetHandle, "RoadSideAlert", newPath);
    }
  }

  snprintf(newPath, elcount(newPath), "%s.%s", oldPath, "lon");
  C2xSetTokenInt(packetHandle, "RoadSideAlert", newPath, value.lon);
  result = CheckLastError("RoadSideAlert", gkFuncRefGet, result);

  snprintf(newPath, elcount(newPath), "%s.%s", oldPath, "lat");
  C2xSetTokenInt(packetHandle, "RoadSideAlert", newPath, value.lat);
  result = CheckLastError("RoadSideAlert", gkFuncRefGet, result);

  snprintf(newPath, elcount(newPath), "%s.%s", oldPath, "elevation");
  if(value.elevation.isValidFlag==1)
  {
    C2xSetTokenInt(packetHandle, "RoadSideAlert", newPath, value.elevation.value);
    result = CheckLastError("RoadSideAlert", gkFuncRefGet, result);
  }
  else
  {
    if( C2xIsTokenAvailable(packetHandle, "RoadSideAlert", newPath) )
    {
      C2xRemoveToken(packetHandle, "RoadSideAlert", newPath);
    }
  }

  snprintf(newPath, elcount(newPath), "%s.%s", oldPath, "heading");
  if(value.heading.isValidFlag==1)
  {
    C2xSetTokenInt(packetHandle, "RoadSideAlert", newPath, value.heading.value);
    result = CheckLastError("RoadSideAlert", gkFuncRefGet, result);
  }
  else
  {
    if( C2xIsTokenAvailable(packetHandle, "RoadSideAlert", newPath) )
    {
      C2xRemoveToken(packetHandle, "RoadSideAlert", newPath);
    }
  }

  snprintf(newPath, elcount(newPath), "%s.%s", oldPath, "speed");
  if(value.speed.isValidFlag==1)
  {
    SetRoadSideAlertCommon_TransmissionAndSpeedParams(packetHandle, value.speed, newPath);
    result = CheckLastError("RoadSideAlert", gkFuncRefGet, result);
  }
  else
  {
    if( C2xIsTokenAvailable(packetHandle, "RoadSideAlert", newPath) )
    {
      C2xRemoveToken(packetHandle, "RoadSideAlert", newPath);
    }
  }

  snprintf(newPath, elcount(newPath), "%s.%s", oldPath, "posAccuracy");
  if(value.posAccuracy.isValidFlag==1)
  {
    SetRoadSideAlertCommon_PositionalAccuracyParams(packetHandle, value.posAccuracy, newPath);
    result = CheckLastError("RoadSideAlert", gkFuncRefGet, result);
  }
  else
  {
    if( C2xIsTokenAvailable(packetHandle, "RoadSideAlert", newPath) )
    {
      C2xRemoveToken(packetHandle, "RoadSideAlert", newPath);
    }
  }

  snprintf(newPath, elcount(newPath), "%s.%s", oldPath, "timeConfidence");
  if(value.timeConfidence.isValidFlag==1)
  {
    C2xSetTokenInt(packetHandle, "RoadSideAlert", newPath, value.timeConfidence.value);
    result = CheckLastError("RoadSideAlert", gkFuncRefGet, result);
  }
  else
  {
    if( C2xIsTokenAvailable(packetHandle, "RoadSideAlert", newPath) )
    {
      C2xRemoveToken(packetHandle, "RoadSideAlert", newPath);
    }
  }

  snprintf(newPath, elcount(newPath), "%s.%s", oldPath, "posConfidence");
  if(value.posConfidence.isValidFlag==1)
  {
    SetRoadSideAlertCommon_PositionConfidenceSetParams(packetHandle, value.posConfidence, newPath);
    result = CheckLastError("RoadSideAlert", gkFuncRefGet, result);
  }
  else
  {
    if( C2xIsTokenAvailable(packetHandle, "RoadSideAlert", newPath) )
    {
      C2xRemoveToken(packetHandle, "RoadSideAlert", newPath);
    }
  }

  snprintf(newPath, elcount(newPath), "%s.%s", oldPath, "speedConfidence");
  if(value.speedConfidence.isValidFlag==1)
  {
    SetRoadSideAlertCommon_SpeedandHeadingandThrottleConfidenceParams(packetHandle, value.speedConfidence, newPath);
    result = CheckLastError("RoadSideAlert", gkFuncRefGet, result);
  }
  else
  {
    if( C2xIsTokenAvailable(packetHandle, "RoadSideAlert", newPath) )
    {
      C2xRemoveToken(packetHandle, "RoadSideAlert", newPath);
    }
  }

  return result;
}

int GetRoadSideAlertCommon_RegionalExtension_Reg_RoadSideAlertParams(LONG packetHandle, struct RoadSideAlertCommon_RegionalExtension_Reg_RoadSideAlert value, char oldPath[])
{
  char newPath[300];
  int result;

  result = 0;

  snprintf(newPath, elcount(newPath), "%s.%s", oldPath, "regionId");
  value.regionId = C2xGetTokenInt(packetHandle, "RoadSideAlert", newPath);
  result = CheckLastError("RoadSideAlert", gkFuncRefGet, result);

  return result;
}

int SetRoadSideAlertCommon_RegionalExtension_Reg_RoadSideAlertParams(LONG packetHandle, struct RoadSideAlertCommon_RegionalExtension_Reg_RoadSideAlert value, char oldPath[])
{
  char newPath[300];
  int result;

  result = 0;


  return result;
}

int GetRoadSideAlertRoadSideAlert_regionalParams(LONG packetHandle, struct RoadSideAlertRoadSideAlert_regional value, char oldPath[])
{
  char newPath[300]; 
  int i;
  int result;

  result = 0;

  value.length = C2xGetTokenInt(packetHandle, "RoadSideAlert", oldPath);
  if((result = CheckLastError("RoadSideAlert", gkFuncRefGet, result))==0)
  {
    for(i=0; i<value.length; i++)
    {
      snprintf(newPath, elcount(newPath), "%s[%d]", oldPath, i);
      GetRoadSideAlertCommon_RegionalExtension_Reg_RoadSideAlertParams(packetHandle, value.arrayValue[i], newPath);
      result = CheckLastError("RoadSideAlert", gkFuncRefGet, result);
    }
  }
  return result;
}

int SetRoadSideAlertRoadSideAlert_regionalParams(LONG packetHandle, struct RoadSideAlertRoadSideAlert_regional value, char oldPath[])
{
  char newPath[300]; 
  int i;
  int result;

  result = 0;

  C2xRemoveToken(packetHandle, "RoadSideAlert", oldPath);
  for(i=0; i<value.length; i++)
  {
    snprintf(newPath, elcount(newPath), "%s[%d]", oldPath, i);
    SetRoadSideAlertCommon_RegionalExtension_Reg_RoadSideAlertParams(packetHandle, value.arrayValue[i], newPath);
    result = CheckLastError("RoadSideAlert", gkFuncRefGet, result);
  }
  return result;
}

int GetRoadSideAlert_RoadSideAlertParams(LONG packetHandle, struct RoadSideAlert_RoadSideAlert value, char oldPath[])
{
  char newPath[300]; 
  int j; 
  int k;
  int result;

  result = 0;

  snprintf(newPath, elcount(newPath), "%s.%s", oldPath, "msgCnt");
  value.msgCnt = C2xGetTokenInt(packetHandle, "RoadSideAlert", newPath);
  result = CheckLastError("RoadSideAlert", gkFuncRefGet, result);

  snprintf(newPath, elcount(newPath), "%s.%s", oldPath, "timeStamp");
  value.timeStamp.isValidFlag = C2xIsTokenAvailable(packetHandle, "RoadSideAlert", newPath);
  if(value.timeStamp.isValidFlag==1)
  {
    value.timeStamp.value = C2xGetTokenInt(packetHandle, "RoadSideAlert", newPath);
    result = CheckLastError("RoadSideAlert", gkFuncRefGet, result);
  }
  snprintf(newPath, elcount(newPath), "%s.%s", oldPath, "typeEvent");
  value.typeEvent = C2xGetTokenInt(packetHandle, "RoadSideAlert", newPath);
  result = CheckLastError("RoadSideAlert", gkFuncRefGet, result);

  snprintf(newPath, elcount(newPath), "%s.%s", oldPath, "description");
  value.description.isValidFlag = C2xIsTokenAvailable(packetHandle, "RoadSideAlert", newPath);
  if(value.description.isValidFlag==1)
  {
    GetRoadSideAlertRoadSideAlert_descriptionParams(packetHandle, value.description, newPath);
    result = CheckLastError("RoadSideAlert", gkFuncRefGet, result);
  }
  snprintf(newPath, elcount(newPath), "%s.%s", oldPath, "priority");
  value.priority.isValidFlag = C2xIsTokenAvailable(packetHandle, "RoadSideAlert", newPath);
  if(value.priority.isValidFlag==1)
  {
    value.priority.isValidFlag = 1;
    value.priority.stringLength = C2xGetTokenData(packetHandle, "RoadSideAlert", newPath, elcount(value.priority.string), value.priority.string);
  }
  snprintf(newPath, elcount(newPath), "%s.%s", oldPath, "heading");
  value.heading.isValidFlag = C2xIsTokenAvailable(packetHandle, "RoadSideAlert", newPath);
  if(value.heading.isValidFlag==1)
  {
    value.heading.isValidFlag = 1;
    value.heading.stringLength = C2xGetTokenLengthBit(packetHandle, "RoadSideAlert", newPath);
    if ((result = CheckLastError("RoadSideAlert", gkFuncRefGet, result))==0)
    {
      if(value.heading.stringLength > 0)
      {
        for(j=0; j<value.heading.stringLength; j++)
        {
          if(C2xGetTokenBitOfBitString(packetHandle, "RoadSideAlert", newPath, j) == 0)
          {
            value.heading.string[j] = '0';
          }
          else if(C2xGetTokenBitOfBitString(packetHandle, "RoadSideAlert", newPath, j) == 1)
          {
            value.heading.string[j] = '1';
          }

          if(value.heading.stringLength == 1)
          {
            value.heading.string[1] = '0';
          }
          result = CheckLastError("RoadSideAlert", gkFuncRefGet, result);
        }
      }
      else
      {
        for(k = value.heading.stringLength+1; k > -1; k--)
        {
          if(value.heading.string[k] == '1')
          {
            value.heading.string[k] = '0';
          }
        }
      }
    }

  }
  snprintf(newPath, elcount(newPath), "%s.%s", oldPath, "extent");
  value.extent.isValidFlag = C2xIsTokenAvailable(packetHandle, "RoadSideAlert", newPath);
  if(value.extent.isValidFlag==1)
  {
    value.extent.value = C2xGetTokenInt(packetHandle, "RoadSideAlert", newPath);
    result = CheckLastError("RoadSideAlert", gkFuncRefGet, result);
  }
  snprintf(newPath, elcount(newPath), "%s.%s", oldPath, "position");
  value.position.isValidFlag = C2xIsTokenAvailable(packetHandle, "RoadSideAlert", newPath);
  if(value.position.isValidFlag==1)
  {
    GetRoadSideAlertCommon_FullPositionVectorParams(packetHandle, value.position, newPath);
    result = CheckLastError("RoadSideAlert", gkFuncRefGet, result);
  }
  snprintf(newPath, elcount(newPath), "%s.%s", oldPath, "furtherInfoID");
  value.furtherInfoID.isValidFlag = C2xIsTokenAvailable(packetHandle, "RoadSideAlert", newPath);
  if(value.furtherInfoID.isValidFlag==1)
  {
    value.furtherInfoID.isValidFlag = 1;
    value.furtherInfoID.stringLength = C2xGetTokenData(packetHandle, "RoadSideAlert", newPath, elcount(value.furtherInfoID.string), value.furtherInfoID.string);
  }
  snprintf(newPath, elcount(newPath), "%s.%s", oldPath, "regional");
  value.regional.isValidFlag = C2xIsTokenAvailable(packetHandle, "RoadSideAlert", newPath);
  if(value.regional.isValidFlag==1)
  {
    GetRoadSideAlertRoadSideAlert_regionalParams(packetHandle, value.regional, newPath);
    result = CheckLastError("RoadSideAlert", gkFuncRefGet, result);
  }
  return result;
}

int SetRoadSideAlert_RoadSideAlertParams(LONG packetHandle, struct RoadSideAlert_RoadSideAlert value, char oldPath[])
{
  char newPath[300]; 
  int j;
  int result;

  result = 0;

  snprintf(newPath, elcount(newPath), "%s.%s", oldPath, "msgCnt");
  C2xSetTokenInt(packetHandle, "RoadSideAlert", newPath, value.msgCnt);
  result = CheckLastError("RoadSideAlert", gkFuncRefGet, result);

  snprintf(newPath, elcount(newPath), "%s.%s", oldPath, "timeStamp");
  if(value.timeStamp.isValidFlag==1)
  {
    C2xSetTokenInt(packetHandle, "RoadSideAlert", newPath, value.timeStamp.value);
    result = CheckLastError("RoadSideAlert", gkFuncRefGet, result);
  }
  else
  {
    if( C2xIsTokenAvailable(packetHandle, "RoadSideAlert", newPath) )
    {
      C2xRemoveToken(packetHandle, "RoadSideAlert", newPath);
    }
  }

  snprintf(newPath, elcount(newPath), "%s.%s", oldPath, "typeEvent");
  C2xSetTokenInt(packetHandle, "RoadSideAlert", newPath, value.typeEvent);
  result = CheckLastError("RoadSideAlert", gkFuncRefGet, result);

  snprintf(newPath, elcount(newPath), "%s.%s", oldPath, "description");
  if(value.description.isValidFlag==1)
  {
    SetRoadSideAlertRoadSideAlert_descriptionParams(packetHandle, value.description, newPath);
    result = CheckLastError("RoadSideAlert", gkFuncRefGet, result);
  }
  else
  {
    if( C2xIsTokenAvailable(packetHandle, "RoadSideAlert", newPath) )
    {
      C2xRemoveToken(packetHandle, "RoadSideAlert", newPath);
    }
  }

  snprintf(newPath, elcount(newPath), "%s.%s", oldPath, "priority");
  if(value.priority.isValidFlag==1)
  {
    C2xSetTokenData(packetHandle, "RoadSideAlert", newPath, value.priority.stringLength, value.priority.string);
  }
  else
  {
    if( C2xIsTokenAvailable(packetHandle, "RoadSideAlert", newPath) )
    {
      C2xRemoveToken(packetHandle, "RoadSideAlert", newPath);
    }
  }

  snprintf(newPath, elcount(newPath), "%s.%s", oldPath, "heading");
  if(value.heading.isValidFlag==1)
  {
      for(j=0; j<value.heading.stringLength; j++)
      {
        if(value.heading.string[j] == '0')
        {
          C2xSetTokenBitOfBitString(packetHandle, "RoadSideAlert", newPath, j, 0);
        }
        else
        {
          C2xSetTokenBitOfBitString(packetHandle, "RoadSideAlert", newPath, j, 1);
        }
        result = CheckLastError("RoadSideAlert", gkFuncRefGet, result);
      }
  }
  else
  {
    if( C2xIsTokenAvailable(packetHandle, "RoadSideAlert", newPath) )
    {
      C2xRemoveToken(packetHandle, "RoadSideAlert", newPath);
    }
  }

  snprintf(newPath, elcount(newPath), "%s.%s", oldPath, "extent");
  if(value.extent.isValidFlag==1)
  {
    C2xSetTokenInt(packetHandle, "RoadSideAlert", newPath, value.extent.value);
    result = CheckLastError("RoadSideAlert", gkFuncRefGet, result);
  }
  else
  {
    if( C2xIsTokenAvailable(packetHandle, "RoadSideAlert", newPath) )
    {
      C2xRemoveToken(packetHandle, "RoadSideAlert", newPath);
    }
  }

  snprintf(newPath, elcount(newPath), "%s.%s", oldPath, "position");
  if(value.position.isValidFlag==1)
  {
    SetRoadSideAlertCommon_FullPositionVectorParams(packetHandle, value.position, newPath);
    result = CheckLastError("RoadSideAlert", gkFuncRefGet, result);
  }
  else
  {
    if( C2xIsTokenAvailable(packetHandle, "RoadSideAlert", newPath) )
    {
      C2xRemoveToken(packetHandle, "RoadSideAlert", newPath);
    }
  }

  snprintf(newPath, elcount(newPath), "%s.%s", oldPath, "furtherInfoID");
  if(value.furtherInfoID.isValidFlag==1)
  {
    C2xSetTokenData(packetHandle, "RoadSideAlert", newPath, value.furtherInfoID.stringLength, value.furtherInfoID.string);
  }
  else
  {
    if( C2xIsTokenAvailable(packetHandle, "RoadSideAlert", newPath) )
    {
      C2xRemoveToken(packetHandle, "RoadSideAlert", newPath);
    }
  }

  snprintf(newPath, elcount(newPath), "%s.%s", oldPath, "regional");
  if(value.regional.isValidFlag==1)
  {
    SetRoadSideAlertRoadSideAlert_regionalParams(packetHandle, value.regional, newPath);
    result = CheckLastError("RoadSideAlert", gkFuncRefGet, result);
  }
  else
  {
    if( C2xIsTokenAvailable(packetHandle, "RoadSideAlert", newPath) )
    {
      C2xRemoveToken(packetHandle, "RoadSideAlert", newPath);
    }
  }

  return result;
}

int GetRoadSideAlertMESSAGE_ID_AND_TYPEParams(LONG packetHandle, WORD tableKey, struct RoadSideAlertMESSAGE_ID_AND_TYPE value, char oldPath[])
{
  char newPath[300];
  int result;

  result = 0;

  switch(tableKey)
  {
    case 27:
    {
      snprintf(newPath, elcount(newPath), "%s.%s", oldPath, "roadSideAlert");
      GetRoadSideAlert_RoadSideAlertParams(packetHandle, value.roadSideAlert, newPath);
      result = CheckLastError("RoadSideAlert", gkFuncRefGet, result);
    }
    break;
  }
  return result;
}

int SetRoadSideAlertMESSAGE_ID_AND_TYPEParams(LONG packetHandle, WORD tableKey, struct RoadSideAlertMESSAGE_ID_AND_TYPE value, char oldPath[])
{
  char newPath[300];
  int result;

  result = 0;

  switch(tableKey)
  {
    case 27:
    {
      snprintf(newPath, elcount(newPath), "%s.%s", oldPath, "roadSideAlert");
      SetRoadSideAlert_RoadSideAlertParams(packetHandle, value.roadSideAlert, newPath);
      result = CheckLastError("RoadSideAlert", gkFuncRefGet, result);
    }
    break;
  }
  return result;
}

int API_GetRoadSideAlertParams(LONG packetHandle, struct RoadSideAlert value)
{
  int result;
  result = 0;

  value.messageId = C2xGetTokenInt(packetHandle, "RoadSideAlert", "messageId");
  result = CheckLastError("RoadSideAlert", gkFuncRefGet, result);

  GetRoadSideAlertMESSAGE_ID_AND_TYPEParams(packetHandle, value.messageId, value.value, "value");
  result = CheckLastError("RoadSideAlert", gkFuncRefGet, result);

  return result;
}

int API_SetRoadSideAlertParams(LONG packetHandle, struct RoadSideAlert value)
{
  int result;
  result = 0;

  value.messageId = 27;

  SetRoadSideAlertMESSAGE_ID_AND_TYPEParams(packetHandle, value.messageId, value.value, "value");
  result = CheckLastError("RoadSideAlert", gkFuncRefGet, result);

  return result;
}

