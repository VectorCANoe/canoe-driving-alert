/*@!Encoding:1252*/
/*
//  (c) Vector Informatik GmbH. All rights reserved.
//
//  This file contains definitions of structs and methods that may be used
//  to set and get the values of an ASN.1 defined packet's payload.
//
//  //This example demonstrates how to set a packet's payload:
//  LONG packetHandle;
//  struct TollUsageMessage payload;
//  //you need to set the values of the variable "payload" yourself
//  packetHandle = API_InitTollUsageMessagePacket();
//  if (packetHandle!=0) {
//    if (API_SetTollUsageMessageParams(packetHandle, payload)==0) {
//      if (C2xCompletePacket(packetHandle)==0) {
//        C2xOutputPacket(packetHandle);
//      }
//    }
//  }
//                                                                             */
includes
{
  #include "ASNV_Template_BaseDatatypes.cin"  // If warning "Duplicate #include, ignoring this include" appears, please remove the ASNV_Template_BaseDatatypes.cin include from your other *.cin files in the project.
}
variables
{
    struct TollUsageMessageTollAdvertisementMessage_TollChargerInfo_tollChargerId_id {
        INT isValidFlag;   // necessary if this struct is used as an optional field of a SEQUENCE
        INT length;
        INT id;
    };
    
    struct TollUsageMessageTollAdvertisementMessage_TollChargerInfo_tollChargerId {
        INT isValidFlag;   // necessary if this struct is used as an optional field of a SEQUENCE
        INT length;
        struct TollUsageMessageTollAdvertisementMessage_TollChargerInfo_tollChargerId_id arrayValue[16];
    };
    
    struct TollUsageMessageCommon_DescriptiveName {
        INT isValidFlag;   // necessary if this struct is used as an optional field of a SEQUENCE
        CHAR string[64];
        INT  stringLength;
    };
    
    struct TollUsageMessageTollAdvertisementMessage_TollChargerInfo {
        INT isValidFlag;   // necessary if this struct is used as an optional field of a SEQUENCE
        struct TollUsageMessageTollAdvertisementMessage_TollChargerInfo_tollChargerId tollChargerId;  // OBJECTIDENTIFIER;
        WORD tollPointId;  // INTEGER, 1..2048;
        struct TollUsageMessageCommon_DescriptiveName descriptiveName;  // IA5STRING, OPTIONAL;
    };
    
    struct TollUsageMessageCommon_TemporaryID {
        INT isValidFlag;   // necessary if this struct is used as an optional field of a SEQUENCE
        CHAR string[5];
        INT  stringLength;
    };
    
    struct TollUsageMessageTumHash {
        INT isValidFlag;   // necessary if this struct is used as an optional field of a SEQUENCE
        CHAR string[33];
        INT  stringLength;
    };
    
    struct TollUsageMessageEncryptedTumData {
        INT isValidFlag;   // necessary if this struct is used as an optional field of a SEQUENCE
        CHAR string[1024];
        INT  stringLength;
    };
    
    struct TollUsageMessage_TollUsageMessage {
        INT isValidFlag;   // necessary if this struct is used as an optional field of a SEQUENCE
        struct TollUsageMessageTollAdvertisementMessage_TollChargerInfo tollPointInfo;  // SEQUENCE;
        struct TollUsageMessageCommon_TemporaryID tempID;  // OCTETSTRING;
        BYTE tumSequenceNum;  // INTEGER, 0..127;
        BYTE tamSequenceNum;  // INTEGER, 0..127;
        struct TollUsageMessageTumHash tumHash;  // OCTETSTRING, OPTIONAL;
        struct TollUsageMessageEncryptedTumData encryptedTumData;  // OCTETSTRING;
    };
    
    struct TollUsageMessageMESSAGE_ID_AND_TYPE {
        struct TollUsageMessage_TollUsageMessage tollUsageMessage;  // SEQUENCE;
    };
    
    struct TollUsageMessage {
        INT isValidFlag;   // necessary if this struct is used as an optional field of a SEQUENCE
        WORD messageId;  // INTEGER, 0..32767, mapData(18), signalPhaseAndTimingMessage(19), basicSafetyMessage(20), commonSafetyRequest(21), emergencyVehicleAlert(22), intersectionCollision(23), nmeaCorrections(24), probeDataManagement(25), probeVehicleData(26), roadSideAlert(27), rtcmCorrections(28), signalRequestMessage(29), signalStatusMessage(30), travelerInformation(31), personalSafetyMessage(32), roadSafetyMessage(33), roadWeatherMessage(34), probeDataConfigMessage(35), probeDataReportMessage(36), tollAdvertisementMessage(37), tollUsageMessage(38), tollUsageAckMessage(39), cooperativeControlMessage(40), sensorDataSharingMessage(41), maneuverSharingAndCoordinatingMessage(42), roadGeometryAndAttributes(43), personalSafetyMessage2(44), trafficSignalPhaseAndTiming(45), signalControlAndPrioritizationRequest(46), signalControlAndPrioritizationStatus(47), roadUserChargingConfigMessage(48), roadUserChargingReportMessage(49), trafficLightStatusMessage(50);
        struct TollUsageMessageMESSAGE_ID_AND_TYPE value;  // TABLE;
    };
    
}

/*
// init function to create a simple packet handle
*/ 
LONG API_InitTollUsageMessagePacket()
{
  return C2xInitPacket("TollUsageMessage"); 
}

/*
// init function to create a simple packet handle and
// initialize the struct with valid data
*/ 
LONG API_InitTollUsageMessagePacket(struct TollUsageMessage msgStruct)
{
  long pktHandle;

  pktHandle = API_InitTollUsageMessagePacket();

  if (pktHandle != 0)
  {
    // create valid message and application data
    if (C2xCompletePacket(pktHandle) == 0) 
    {
      API_GetTollUsageMessageParams(pktHandle, msgStruct);
    }
  }
  return pktHandle;
}

/*
// init function to create a packet with security layer and
// initialize the struct with valid data
*/ 
LONG API_InitTollUsageMessagePacket(struct TollUsageMessage msgStruct, char packetTypeDesignator[], char certificateName[])
{
  long pktHandle, certHdl;

  // initialize the packet
  pktHandle = C2xInitPacket("TollUsageMessage", packetTypeDesignator);

  if (pktHandle != 0)
  {
    certHdl = C2xSecCertificateGetHandle(certificateName);  // get the certificate handle for the cert with name "certificateName"
    if (certHdl != 0) 
    {
      C2xSecPacketSetSignerHandle(pktHandle, certHdl); // set the certHdl to the packet
    }

    // create valid message and application data
    if (C2xCompletePacket(pktHandle) == 0) 
    {
      // copy application data to the application structure
      API_GetTollUsageMessageParams(pktHandle, msgStruct);
    }
  }
  return pktHandle;
}
    

int GetTollUsageMessageTollAdvertisementMessage_TollChargerInfoParams(LONG packetHandle, struct TollUsageMessageTollAdvertisementMessage_TollChargerInfo value, char oldPath[])
{
  char newPath[300];
  int i;
  int result;

  result = 0;

  snprintf(newPath, elcount(newPath), "%s.%s", oldPath, "tollChargerId");
  value.tollChargerId.length = C2xGetTokenInt(packetHandle, "TollUsageMessage", newPath);
  if((result = CheckLastError("TollUsageMessage", gkFuncRefGet, result))==0)
  {
    if(value.tollChargerId.length > 0)
    {
      for(i=0; i<value.tollChargerId.length; i++)
      {
        value.tollChargerId.arrayValue[i].id = C2xGetTokenOidElement(packetHandle, "TollUsageMessage", newPath, i);
      }
    }
  }
  snprintf(newPath, elcount(newPath), "%s.%s", oldPath, "tollPointId");
  value.tollPointId = C2xGetTokenInt(packetHandle, "TollUsageMessage", newPath);
  result = CheckLastError("TollUsageMessage", gkFuncRefGet, result);

  snprintf(newPath, elcount(newPath), "%s.%s", oldPath, "descriptiveName");
  value.descriptiveName.isValidFlag = C2xIsTokenAvailable(packetHandle, "TollUsageMessage", newPath);
  if(value.descriptiveName.isValidFlag==1)
  {
    value.descriptiveName.stringLength = C2xGetTokenData(packetHandle, "TollUsageMessage", newPath, elcount(value.descriptiveName.string), value.descriptiveName.string);
    result = CheckLastError("TollUsageMessage", gkFuncRefGet, result);
  }
  return result;
}

int SetTollUsageMessageTollAdvertisementMessage_TollChargerInfoParams(LONG packetHandle, struct TollUsageMessageTollAdvertisementMessage_TollChargerInfo value, char oldPath[])
{
  char newPath[300];
  int i;
  int result;

  result = 0;

  snprintf(newPath, elcount(newPath), "%s.%s", oldPath, "tollChargerId");
  C2xRemoveToken(packetHandle, "TollUsageMessage", newPath);
  if(value.tollChargerId.length > 0)
  {
    for(i=0; i<value.tollChargerId.length; i++)
    {
      C2xSetTokenOidElement(packetHandle, "TollUsageMessage", newPath, i, value.tollChargerId.arrayValue[i].id);
    }
  }
  result = CheckLastError("TollUsageMessage", gkFuncRefGet, result);

  snprintf(newPath, elcount(newPath), "%s.%s", oldPath, "tollPointId");
  if (value.tollPointId < 1)
  {
    C2xSetTokenInt(packetHandle, "TollUsageMessage", newPath, 1);
  }
  else if (value.tollPointId > 2048)
  {
    C2xSetTokenInt(packetHandle, "TollUsageMessage", newPath, 2048);
  }
  else
  {
    C2xSetTokenInt(packetHandle, "TollUsageMessage", newPath, value.tollPointId);
  }
  result = CheckLastError("TollUsageMessage", gkFuncRefGet, result);

  snprintf(newPath, elcount(newPath), "%s.%s", oldPath, "descriptiveName");
  if(value.descriptiveName.isValidFlag==1)
  {
    C2xSetTokenData(packetHandle, "TollUsageMessage", newPath, value.descriptiveName.stringLength, value.descriptiveName.string);
    result = CheckLastError("TollUsageMessage", gkFuncRefGet, result);
  }
  else
  {
    if( C2xIsTokenAvailable(packetHandle, "TollUsageMessage", newPath) )
    {
      C2xRemoveToken(packetHandle, "TollUsageMessage", newPath);
    }
  }

  return result;
}

int GetTollUsageMessage_TollUsageMessageParams(LONG packetHandle, struct TollUsageMessage_TollUsageMessage value, char oldPath[])
{
  char newPath[300];
  int result;

  result = 0;

  snprintf(newPath, elcount(newPath), "%s.%s", oldPath, "tollPointInfo");
  GetTollUsageMessageTollAdvertisementMessage_TollChargerInfoParams(packetHandle, value.tollPointInfo, newPath);
  result = CheckLastError("TollUsageMessage", gkFuncRefGet, result);

  snprintf(newPath, elcount(newPath), "%s.%s", oldPath, "tempID");
  value.tempID.stringLength = C2xGetTokenData(packetHandle, "TollUsageMessage", newPath, elcount(value.tempID.string), value.tempID.string);
  snprintf(newPath, elcount(newPath), "%s.%s", oldPath, "tumSequenceNum");
  value.tumSequenceNum = C2xGetTokenInt(packetHandle, "TollUsageMessage", newPath);
  result = CheckLastError("TollUsageMessage", gkFuncRefGet, result);

  snprintf(newPath, elcount(newPath), "%s.%s", oldPath, "tamSequenceNum");
  value.tamSequenceNum = C2xGetTokenInt(packetHandle, "TollUsageMessage", newPath);
  result = CheckLastError("TollUsageMessage", gkFuncRefGet, result);

  snprintf(newPath, elcount(newPath), "%s.%s", oldPath, "tumHash");
  value.tumHash.isValidFlag = C2xIsTokenAvailable(packetHandle, "TollUsageMessage", newPath);
  if(value.tumHash.isValidFlag==1)
  {
    value.tumHash.isValidFlag = 1;
    value.tumHash.stringLength = C2xGetTokenData(packetHandle, "TollUsageMessage", newPath, elcount(value.tumHash.string), value.tumHash.string);
  }
  snprintf(newPath, elcount(newPath), "%s.%s", oldPath, "encryptedTumData");
  value.encryptedTumData.stringLength = C2xGetTokenData(packetHandle, "TollUsageMessage", newPath, elcount(value.encryptedTumData.string), value.encryptedTumData.string);
  return result;
}

int SetTollUsageMessage_TollUsageMessageParams(LONG packetHandle, struct TollUsageMessage_TollUsageMessage value, char oldPath[])
{
  char newPath[300];
  int result;

  result = 0;

  snprintf(newPath, elcount(newPath), "%s.%s", oldPath, "tollPointInfo");
  SetTollUsageMessageTollAdvertisementMessage_TollChargerInfoParams(packetHandle, value.tollPointInfo, newPath);
  result = CheckLastError("TollUsageMessage", gkFuncRefGet, result);

  snprintf(newPath, elcount(newPath), "%s.%s", oldPath, "tempID");
  C2xSetTokenData(packetHandle, "TollUsageMessage", newPath, value.tempID.stringLength, value.tempID.string);

  snprintf(newPath, elcount(newPath), "%s.%s", oldPath, "tumSequenceNum");
  C2xSetTokenInt(packetHandle, "TollUsageMessage", newPath, value.tumSequenceNum);
  result = CheckLastError("TollUsageMessage", gkFuncRefGet, result);

  snprintf(newPath, elcount(newPath), "%s.%s", oldPath, "tamSequenceNum");
  C2xSetTokenInt(packetHandle, "TollUsageMessage", newPath, value.tamSequenceNum);
  result = CheckLastError("TollUsageMessage", gkFuncRefGet, result);

  snprintf(newPath, elcount(newPath), "%s.%s", oldPath, "tumHash");
  if(value.tumHash.isValidFlag==1)
  {
    C2xSetTokenData(packetHandle, "TollUsageMessage", newPath, value.tumHash.stringLength, value.tumHash.string);
  }
  else
  {
    if( C2xIsTokenAvailable(packetHandle, "TollUsageMessage", newPath) )
    {
      C2xRemoveToken(packetHandle, "TollUsageMessage", newPath);
    }
  }

  snprintf(newPath, elcount(newPath), "%s.%s", oldPath, "encryptedTumData");
  C2xSetTokenData(packetHandle, "TollUsageMessage", newPath, value.encryptedTumData.stringLength, value.encryptedTumData.string);

  return result;
}

int GetTollUsageMessageMESSAGE_ID_AND_TYPEParams(LONG packetHandle, WORD tableKey, struct TollUsageMessageMESSAGE_ID_AND_TYPE value, char oldPath[])
{
  char newPath[300];
  int result;

  result = 0;

  switch(tableKey)
  {
    case 38:
    {
      snprintf(newPath, elcount(newPath), "%s.%s", oldPath, "tollUsageMessage");
      GetTollUsageMessage_TollUsageMessageParams(packetHandle, value.tollUsageMessage, newPath);
      result = CheckLastError("TollUsageMessage", gkFuncRefGet, result);
    }
    break;
  }
  return result;
}

int SetTollUsageMessageMESSAGE_ID_AND_TYPEParams(LONG packetHandle, WORD tableKey, struct TollUsageMessageMESSAGE_ID_AND_TYPE value, char oldPath[])
{
  char newPath[300];
  int result;

  result = 0;

  switch(tableKey)
  {
    case 38:
    {
      snprintf(newPath, elcount(newPath), "%s.%s", oldPath, "tollUsageMessage");
      SetTollUsageMessage_TollUsageMessageParams(packetHandle, value.tollUsageMessage, newPath);
      result = CheckLastError("TollUsageMessage", gkFuncRefGet, result);
    }
    break;
  }
  return result;
}

int API_GetTollUsageMessageParams(LONG packetHandle, struct TollUsageMessage value)
{
  int result;
  result = 0;

  value.messageId = C2xGetTokenInt(packetHandle, "TollUsageMessage", "messageId");
  result = CheckLastError("TollUsageMessage", gkFuncRefGet, result);

  GetTollUsageMessageMESSAGE_ID_AND_TYPEParams(packetHandle, value.messageId, value.value, "value");
  result = CheckLastError("TollUsageMessage", gkFuncRefGet, result);

  return result;
}

int API_SetTollUsageMessageParams(LONG packetHandle, struct TollUsageMessage value)
{
  int result;
  result = 0;

  value.messageId = 38;

  SetTollUsageMessageMESSAGE_ID_AND_TYPEParams(packetHandle, value.messageId, value.value, "value");
  result = CheckLastError("TollUsageMessage", gkFuncRefGet, result);

  return result;
}

