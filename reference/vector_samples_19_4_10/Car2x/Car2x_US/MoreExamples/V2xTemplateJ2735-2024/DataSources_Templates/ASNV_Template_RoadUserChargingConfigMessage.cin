/*@!Encoding:1252*/
/*
//  (c) Vector Informatik GmbH. All rights reserved.
//
//  This file contains definitions of structs and methods that may be used
//  to set and get the values of an ASN.1 defined packet's payload.
//
//  //This example demonstrates how to set a packet's payload:
//  LONG packetHandle;
//  struct RoadUserChargingConfigMessage payload;
//  //you need to set the values of the variable "payload" yourself
//  packetHandle = API_InitRoadUserChargingConfigMessagePacket();
//  if (packetHandle!=0) {
//    if (API_SetRoadUserChargingConfigMessageParams(packetHandle, payload)==0) {
//      if (C2xCompletePacket(packetHandle)==0) {
//        C2xOutputPacket(packetHandle);
//      }
//    }
//  }
//                                                                             */
includes
{
  #include "ASNV_Template_BaseDatatypes.cin"  // If warning "Duplicate #include, ignoring this include" appears, please remove the ASNV_Template_BaseDatatypes.cin include from your other *.cin files in the project.
}
variables
{
    struct RoadUserChargingConfigMessageChargerInfo_chargerID_id {
        INT isValidFlag;   // necessary if this struct is used as an optional field of a SEQUENCE
        INT length;
        INT id;
    };
    
    struct RoadUserChargingConfigMessageChargerInfo_chargerID {
        INT isValidFlag;   // necessary if this struct is used as an optional field of a SEQUENCE
        INT length;
        struct RoadUserChargingConfigMessageChargerInfo_chargerID_id arrayValue[16];
    };
    
    struct RoadUserChargingConfigMessageCommon_DescriptiveName {
        INT isValidFlag;   // necessary if this struct is used as an optional field of a SEQUENCE
        CHAR string[64];
        INT  stringLength;
    };
    
    struct RoadUserChargingConfigMessageCommon_DDateTime {
        INT isValidFlag;   // necessary if this struct is used as an optional field of a SEQUENCE
        struct OPT_WORD_ASN year;  // INTEGER, OPTIONAL, 0..4095;
        struct OPT_BYTE_ASN month;  // INTEGER, OPTIONAL, 0..12;
        struct OPT_BYTE_ASN day;  // INTEGER, OPTIONAL, 0..31;
        struct OPT_BYTE_ASN hour;  // INTEGER, OPTIONAL, 0..31;
        struct OPT_BYTE_ASN minute;  // INTEGER, OPTIONAL, 0..60;
        struct OPT_WORD_ASN second;  // INTEGER, OPTIONAL, 0..65535;
        struct OPT_INT_ASN offset;  // INTEGER, OPTIONAL, -840..840;
    };
    
    struct RoadUserChargingConfigMessageConfigInfo {
        INT isValidFlag;   // necessary if this struct is used as an optional field of a SEQUENCE
        BYTE configID;  // INTEGER, 0..64;
        BYTE configVersion;  // INTEGER, 0..64;
        struct RoadUserChargingConfigMessageCommon_DDateTime startDate;  // SEQUENCE;
        struct RoadUserChargingConfigMessageCommon_DDateTime expirationDate;  // SEQUENCE;
        INT configurationFeeType;  // ENUMERATED, excluded(0), replacesOtherCharges(1), addedToOtherCharges(2);
    };
    
    struct RoadUserChargingConfigMessageEfcDataDictionary_CountryCode {
        INT isValidFlag;   // necessary if this struct is used as an optional field of a SEQUENCE
        CHAR string[11];
        INT  stringLength;
    };
    
    struct RoadUserChargingConfigMessagePrimaryRegionState_usCanMexState {
        INT isValidFlag;   // necessary if this struct is used as an optional field of a SEQUENCE
        CHAR string[3];
        INT  stringLength;
    };
    
    struct RoadUserChargingConfigMessageCommon_DTime {
        INT isValidFlag;   // necessary if this struct is used as an optional field of a SEQUENCE
        BYTE hour;  // INTEGER, 0..31;
        BYTE minute;  // INTEGER, 0..60;
        WORD second;  // INTEGER, 0..65535;
        struct OPT_INT_ASN offset;  // INTEGER, OPTIONAL, -840..840;
    };
    
    struct RoadUserChargingConfigMessageCommon_DDate {
        INT isValidFlag;   // necessary if this struct is used as an optional field of a SEQUENCE
        WORD year;  // INTEGER, 0..4095;
        BYTE month;  // INTEGER, 0..12;
        BYTE day;  // INTEGER, 0..31;
    };
    
    struct RoadUserChargingConfigMessageRoadSafetyMessage_EventRecurrence {
        INT isValidFlag;   // necessary if this struct is used as an optional field of a SEQUENCE
        struct RoadUserChargingConfigMessageCommon_DTime startTime;  // SEQUENCE, OPTIONAL;
        struct RoadUserChargingConfigMessageCommon_DTime endTime;  // SEQUENCE, OPTIONAL;
        struct RoadUserChargingConfigMessageCommon_DDate startDate;  // SEQUENCE, OPTIONAL;
        struct RoadUserChargingConfigMessageCommon_DDate endDate;  // SEQUENCE, OPTIONAL;
        INT monday;  // BOOLEAN;
        INT tuesday;  // BOOLEAN;
        INT wednesday;  // BOOLEAN;
        INT thursday;  // BOOLEAN;
        INT friday;  // BOOLEAN;
        INT saturday;  // BOOLEAN;
        INT sunday;  // BOOLEAN;
        struct OPT_BOOL_ASN exclusion;  // BOOLEAN, OPTIONAL;
    };
    
    struct RoadUserChargingConfigMessageChargingFees_chargingSchedule {
        INT isValidFlag;   // necessary if this struct is used as an optional field of a SEQUENCE
        INT length;
        struct RoadUserChargingConfigMessageRoadSafetyMessage_EventRecurrence arrayValue[5];  // SEQUENCE;
    };
    
    struct RoadUserChargingConfigMessageEfcDataDictionary_PayUnit {
        INT isValidFlag;   // necessary if this struct is used as an optional field of a SEQUENCE
        CHAR string[3];
        INT  stringLength;
    };
    
    struct RoadUserChargingConfigMessageEfcDataDictionary_PaymentFee {
        INT isValidFlag;   // necessary if this struct is used as an optional field of a SEQUENCE
        WORD paymentFeeAmount;  // INTEGER, 0..65535;
        struct RoadUserChargingConfigMessageEfcDataDictionary_PayUnit paymentFeeUnit;  // OCTETSTRING;
    };
    
    struct RoadUserChargingConfigMessageTollAdvertisementMessage_OperatorDefined {
        INT isValidFlag;   // necessary if this struct is used as an optional field of a SEQUENCE
        struct RoadUserChargingConfigMessageEfcDataDictionary_PaymentFee opDefCharge1;  // SEQUENCE, OPTIONAL;
        struct RoadUserChargingConfigMessageEfcDataDictionary_PaymentFee opDefCharge2;  // SEQUENCE, OPTIONAL;
        struct RoadUserChargingConfigMessageEfcDataDictionary_PaymentFee opDefCharge3;  // SEQUENCE, OPTIONAL;
        struct RoadUserChargingConfigMessageEfcDataDictionary_PaymentFee opDefCharge4;  // SEQUENCE, OPTIONAL;
        struct RoadUserChargingConfigMessageEfcDataDictionary_PaymentFee opDefCharge5;  // SEQUENCE, OPTIONAL;
        struct RoadUserChargingConfigMessageEfcDataDictionary_PaymentFee opDefCharge6;  // SEQUENCE, OPTIONAL;
        struct RoadUserChargingConfigMessageEfcDataDictionary_PaymentFee opDefCharge7;  // SEQUENCE, OPTIONAL;
        struct RoadUserChargingConfigMessageEfcDataDictionary_PaymentFee opDefCharge8;  // SEQUENCE, OPTIONAL;
        struct RoadUserChargingConfigMessageEfcDataDictionary_PaymentFee opDefCharge9;  // SEQUENCE, OPTIONAL;
        struct RoadUserChargingConfigMessageEfcDataDictionary_PaymentFee opDefCharge10;  // SEQUENCE, OPTIONAL;
        struct RoadUserChargingConfigMessageEfcDataDictionary_PaymentFee opDefCharge11;  // SEQUENCE, OPTIONAL;
        struct RoadUserChargingConfigMessageEfcDataDictionary_PaymentFee opDefCharge12;  // SEQUENCE, OPTIONAL;
        struct RoadUserChargingConfigMessageEfcDataDictionary_PaymentFee opDefCharge13;  // SEQUENCE, OPTIONAL;
        struct RoadUserChargingConfigMessageEfcDataDictionary_PaymentFee opDefCharge14;  // SEQUENCE, OPTIONAL;
        struct RoadUserChargingConfigMessageEfcDataDictionary_PaymentFee opDefCharge15;  // SEQUENCE, OPTIONAL;
        struct RoadUserChargingConfigMessageEfcDataDictionary_PaymentFee opDefCharge16;  // SEQUENCE, OPTIONAL;
    };
    
    struct RoadUserChargingConfigMessageTollAdvertisementMessage_SpecialCharges {
        INT isValidFlag;   // necessary if this struct is used as an optional field of a SEQUENCE
        struct RoadUserChargingConfigMessageEfcDataDictionary_PaymentFee hov2Charge;  // SEQUENCE, OPTIONAL;
        struct RoadUserChargingConfigMessageEfcDataDictionary_PaymentFee hov3Charge;  // SEQUENCE, OPTIONAL;
        struct RoadUserChargingConfigMessageEfcDataDictionary_PaymentFee hov4Charge;  // SEQUENCE, OPTIONAL;
        struct RoadUserChargingConfigMessageEfcDataDictionary_PaymentFee hov5PlusCharge;  // SEQUENCE, OPTIONAL;
        struct RoadUserChargingConfigMessageEfcDataDictionary_PaymentFee cleanAirCharge;  // SEQUENCE, OPTIONAL;
        struct RoadUserChargingConfigMessageTollAdvertisementMessage_OperatorDefined operatorDefined;  // SEQUENCE, OPTIONAL;
        struct OPT_BYTE_ASN engineCharacteristics;  // INTEGER, OPTIONAL, 0..255, noEntry(0), noEngine(1), petrolUnleaded(2), petrolLeaded(3), diesel(4), lpg(5), battery(6), solar(7), hybrid(8), hydrogen(9), multiFuel(10), bivalentPetrolLpg(11), bivalentPetrolCng(12), combinedPetrolElectric(13), cng(14), lng(15), combinedDieselElectric(16), combinedHydrogenElectric(17), bivalentHydrogenPetrol(18), bivalentHydrogenPetrolElectricEngine(19), fuelCellHydrogen(20), fuelCellPetrol(21), fuelCellMethanol(22), fuelCellEthanol(23), fuelCellDiesel(24), combinedMultiFuelElectricEngine(25), combinedCngElectricEngine(26), combinedLngElectricEngine(27), petrolEthanol(28), combinedLpgElectricEngine(29), hybridPetrolExternalBattery(30), hybridDieselExternalBattery(31), hybridLpgExternalBattery(32), hybridHydrogenExternalBattery(33), hybridMultiFuelExternalBattery(34), hybridCngExternalBattery(35), hybridLngExternalBattery(36), hybridBivalentHydrogenPetrolExternalBattery(37), hydrogenCng(38), hydrogenLng(39), hybridHydrogenCngExternalBattery(40), hybridHydrogenLngExternalBattery(41), ethanol(42), hybridFuelCellHydrogen(43), hybridFuelCellHydrogenExternalBattery(44), dualFuelLngDiesel(45), electricExternal(46), biogas(47), bioDiesel(48), bioPetrol(49), bivalentPetrolBiogas(50), combinedBiogasElectricEngine(51), dualFuelCngDiesel(52), other(255);
    };
    
    struct RoadUserChargingConfigMessageTollAdvertisementMessage_VehTypeCharges {
        INT isValidFlag;   // necessary if this struct is used as an optional field of a SEQUENCE
        INT vehType;  // ENUMERATED, motorcycles(1), passengerCars(2), fourTireSingleUnit(3), buses(4), twoAxleSixTireSingleUnit(5), threeAxleSingleUnit(6), fourOrMoreAxleSingleUnit(7), fourOrLessAxleSingleTrailer(8), fiveAxleTractorSemitrailer(9), sixOrMoreAxleSingleTrailer(10), fiveOrLessAxleMultiTrailer(11), sixAxleMultiTrailer(12), sevenOrMoreAxleMultiTrailer(13);
        struct RoadUserChargingConfigMessageEfcDataDictionary_PaymentFee charges;  // SEQUENCE;
        struct RoadUserChargingConfigMessageTollAdvertisementMessage_SpecialCharges specialCharges;  // SEQUENCE, OPTIONAL;
    };
    
    struct RoadUserChargingConfigMessageTollAdvertisementMessage_VehTypeChargesTable {
        INT isValidFlag;   // necessary if this struct is used as an optional field of a SEQUENCE
        INT length;
        struct RoadUserChargingConfigMessageTollAdvertisementMessage_VehTypeCharges arrayValue[13];  // SEQUENCE;
    };
    
    struct RoadUserChargingConfigMessageTollAdvertisementMessage_AxlesCharges {
        INT isValidFlag;   // necessary if this struct is used as an optional field of a SEQUENCE
        BYTE axlesLimit;  // INTEGER, 2..10;
        struct RoadUserChargingConfigMessageEfcDataDictionary_PaymentFee axlesCharge;  // SEQUENCE;
    };
    
    struct RoadUserChargingConfigMessageTollAdvertisementMessage_AxlesChargesTable {
        INT isValidFlag;   // necessary if this struct is used as an optional field of a SEQUENCE
        INT length;
        struct RoadUserChargingConfigMessageTollAdvertisementMessage_AxlesCharges arrayValue[10];  // SEQUENCE;
    };
    
    struct RoadUserChargingConfigMessageTollAdvertisementMessage_TotalWeightCharges {
        INT isValidFlag;   // necessary if this struct is used as an optional field of a SEQUENCE
        DWORD weightLimit;  // INTEGER, 0..16777215;
        INT weightLimitUnits;  // ENUMERATED, pounds(-0), kilograms(1);
        struct RoadUserChargingConfigMessageEfcDataDictionary_PaymentFee weightCharge;  // SEQUENCE;
    };
    
    struct RoadUserChargingConfigMessageTollAdvertisementMessage_PerAxleWeightCharges {
        INT isValidFlag;   // necessary if this struct is used as an optional field of a SEQUENCE
        DWORD totalWeightLimit;  // INTEGER, 0..16777215;
        WORD maxLadenWeightOnAxle;  // INTEGER, 0..65535;
        INT weightLimitUnits;  // ENUMERATED, pounds(-0), kilograms(1);
        struct RoadUserChargingConfigMessageEfcDataDictionary_PaymentFee axleWeightCharge;  // SEQUENCE;
    };
    
    struct RoadUserChargingConfigMessageTollAdvertisementMessage_WeightCharges {
        INT isValidFlag;   // necessary if this struct is used as an optional field of a SEQUENCE
        INT choice;
        struct RoadUserChargingConfigMessageTollAdvertisementMessage_TotalWeightCharges totalWeightCharges;  // SEQUENCE;
        struct RoadUserChargingConfigMessageTollAdvertisementMessage_PerAxleWeightCharges perAxleWeightCharges;  // SEQUENCE;
    };
    
    struct RoadUserChargingConfigMessageTollAdvertisementMessage_WeightChargesTable {
        INT isValidFlag;   // necessary if this struct is used as an optional field of a SEQUENCE
        INT length;
        struct RoadUserChargingConfigMessageTollAdvertisementMessage_WeightCharges arrayValue[10];  // CHOICE;
    };
    
    struct RoadUserChargingConfigMessageTollAdvertisementMessage_ChargesTable {
        INT isValidFlag;   // necessary if this struct is used as an optional field of a SEQUENCE
        INT choice;
        struct RoadUserChargingConfigMessageTollAdvertisementMessage_VehTypeChargesTable vehTypeBased;  // SEQUENCEOF;
        struct RoadUserChargingConfigMessageTollAdvertisementMessage_AxlesChargesTable numAxlesBased;  // SEQUENCEOF;
        struct RoadUserChargingConfigMessageTollAdvertisementMessage_WeightChargesTable weightBased;  // SEQUENCEOF;
    };
    
    struct RoadUserChargingConfigMessageChargingUnits {
        INT isValidFlag;   // necessary if this struct is used as an optional field of a SEQUENCE
        INT choice;
        INT driven;  // ENUMERATED, perMin(0), perHour(1), perDay(2), perDistMile(3), perDistKilo(4);
        INT parked;  // ENUMERATED, perMin(0), perHour(1), perDay(2);
    };
    
    struct RoadUserChargingConfigMessageChargingFees {
        INT isValidFlag;   // necessary if this struct is used as an optional field of a SEQUENCE
        struct RoadUserChargingConfigMessageChargingFees_chargingSchedule chargingSchedule;  // SEQUENCEOF, OPTIONAL;
        struct RoadUserChargingConfigMessageTollAdvertisementMessage_ChargesTable chargesTable;  // CHOICE;
        struct RoadUserChargingConfigMessageChargingUnits chargingUnits;  // CHOICE;
    };
    
    struct RoadUserChargingConfigMessagePrimaryRegionState {
        INT isValidFlag;   // necessary if this struct is used as an optional field of a SEQUENCE
        struct RoadUserChargingConfigMessagePrimaryRegionState_usCanMexState usCanMexState;  // IA5STRING;
        struct RoadUserChargingConfigMessageChargingFees chargingFees;  // SEQUENCE, OPTIONAL;
    };
    
    struct RoadUserChargingConfigMessagePrimaryRegionChargingInfo_chargingPrimaryRegion {
        INT isValidFlag;   // necessary if this struct is used as an optional field of a SEQUENCE
        INT choice;
        struct RoadUserChargingConfigMessagePrimaryRegionState state;  // SEQUENCE;
    };
    
    struct RoadUserChargingConfigMessagePrimaryRegionChargingInfo {
        INT isValidFlag;   // necessary if this struct is used as an optional field of a SEQUENCE
        struct RoadUserChargingConfigMessageEfcDataDictionary_CountryCode primaryRegionCountry;  // BITSTRING;
        struct RoadUserChargingConfigMessagePrimaryRegionChargingInfo_chargingPrimaryRegion chargingPrimaryRegion;  // CHOICE;
    };
    
    struct RoadUserChargingConfigMessageSubRegionChargingInfo_subRegion_id {
        INT isValidFlag;   // necessary if this struct is used as an optional field of a SEQUENCE
        INT length;
        INT id;
    };
    
    struct RoadUserChargingConfigMessageSubRegionChargingInfo_subRegion {
        INT isValidFlag;   // necessary if this struct is used as an optional field of a SEQUENCE
        INT length;
        struct RoadUserChargingConfigMessageSubRegionChargingInfo_subRegion_id arrayValue[16];
    };
    
    struct RoadUserChargingConfigMessageSubRegionChargingInfo {
        INT isValidFlag;   // necessary if this struct is used as an optional field of a SEQUENCE
        struct RoadUserChargingConfigMessageSubRegionChargingInfo_subRegion subRegion;  // OBJECTIDENTIFIER;
        struct RoadUserChargingConfigMessageChargingFees chargingFees;  // SEQUENCE;
    };
    
    struct RoadUserChargingConfigMessageChargingConfig_bySubRegion {
        INT isValidFlag;   // necessary if this struct is used as an optional field of a SEQUENCE
        INT length;
        struct RoadUserChargingConfigMessageSubRegionChargingInfo arrayValue[999];  // SEQUENCE;
    };
    
    struct RoadUserChargingConfigMessageArea_areaID_id {
        INT isValidFlag;   // necessary if this struct is used as an optional field of a SEQUENCE
        INT length;
        INT id;
    };
    
    struct RoadUserChargingConfigMessageArea_areaID {
        INT isValidFlag;   // necessary if this struct is used as an optional field of a SEQUENCE
        INT length;
        struct RoadUserChargingConfigMessageArea_areaID_id arrayValue[16];
    };
    
    struct RoadUserChargingConfigMessageCommon_HeadingSlice {
        INT isValidFlag;   // necessary if this struct is used as an optional field of a SEQUENCE
        CHAR string[17];
        INT  stringLength;
    };
    
    struct RoadUserChargingConfigMessageAddGrpB_LatitudeDMS2 {
        INT isValidFlag;   // necessary if this struct is used as an optional field of a SEQUENCE
        INT d;  // INTEGER, -90..90;
        BYTE m;  // INTEGER, 0..59;
        WORD s;  // INTEGER, 0..5999;
    };
    
    struct RoadUserChargingConfigMessageAddGrpB_LongitudeDMS2 {
        INT isValidFlag;   // necessary if this struct is used as an optional field of a SEQUENCE
        INT d;  // INTEGER, -180..180;
        BYTE m;  // INTEGER, 0..59;
        WORD s;  // INTEGER, 0..5999;
    };
    
    struct RoadUserChargingConfigMessageAddGrpB_Position3D_addGrpB {
        INT isValidFlag;   // necessary if this struct is used as an optional field of a SEQUENCE
        struct RoadUserChargingConfigMessageAddGrpB_LatitudeDMS2 latitude;  // SEQUENCE;
        struct RoadUserChargingConfigMessageAddGrpB_LongitudeDMS2 longitude;  // SEQUENCE;
        INT elevation;  // INTEGER, -32768..32767;
    };
    
    struct RoadUserChargingConfigMessageAddGrpC_Altitude {
        INT isValidFlag;   // necessary if this struct is used as an optional field of a SEQUENCE
        LONG value;  // INTEGER, -100000..800001;
        INT confidence;  // ENUMERATED, alt_000_01(-0), alt_000_02(1), alt_000_05(2), alt_000_10(3), alt_000_20(4), alt_000_50(5), alt_001_00(6), alt_002_00(7), alt_005_00(8), alt_010_00(9), alt_020_00(10), alt_050_00(11), alt_100_00(12), alt_200_00(13), outOfRange(14), unavailable(15);
    };
    
    struct RoadUserChargingConfigMessageAddGrpC_Position3D_addGrpC {
        INT isValidFlag;   // necessary if this struct is used as an optional field of a SEQUENCE
        struct RoadUserChargingConfigMessageAddGrpC_Altitude altitude;  // SEQUENCE;
    };
    
    struct RoadUserChargingConfigMessageCommon_RegionalExtension_Reg_Position3D_table {
        struct RoadUserChargingConfigMessageAddGrpB_Position3D_addGrpB addGrpB;  // SEQUENCE;
        struct RoadUserChargingConfigMessageAddGrpC_Position3D_addGrpC addGrpC;  // SEQUENCE;
    };
    
    struct RoadUserChargingConfigMessageCommon_RegionalExtension_Reg_Position3D {
        INT isValidFlag;   // necessary if this struct is used as an optional field of a SEQUENCE
        BYTE regionId;  // INTEGER, 0..255, noRegion(0), addGrpA(1), addGrpB(2), addGrpC(3), addGrpD(4);
        struct RoadUserChargingConfigMessageCommon_RegionalExtension_Reg_Position3D_table regExtvalue;  // TABLE;
    };
    
    struct RoadUserChargingConfigMessageCommon_Position3D_regional {
        INT isValidFlag;   // necessary if this struct is used as an optional field of a SEQUENCE
        INT length;
        struct RoadUserChargingConfigMessageCommon_RegionalExtension_Reg_Position3D arrayValue[4];  // SEQUENCE;
    };
    
    struct RoadUserChargingConfigMessageCommon_Position3D {
        INT isValidFlag;   // necessary if this struct is used as an optional field of a SEQUENCE
        LONG lat;  // INTEGER, -900000000..900000001;
        LONG lon;  // INTEGER, -1799999999..1800000001;
        struct OPT_LONG_ASN elevation;  // INTEGER, OPTIONAL, -4096..61439;
        struct RoadUserChargingConfigMessageCommon_Position3D_regional regional;  // SEQUENCEOF, OPTIONAL;
    };
    
    struct RoadUserChargingConfigMessageCommon_Node_XY_20b {
        INT isValidFlag;   // necessary if this struct is used as an optional field of a SEQUENCE
        INT x;  // INTEGER, -512..511;
        INT y;  // INTEGER, -512..511;
    };
    
    struct RoadUserChargingConfigMessageCommon_Node_XY_22b {
        INT isValidFlag;   // necessary if this struct is used as an optional field of a SEQUENCE
        INT x;  // INTEGER, -1024..1023;
        INT y;  // INTEGER, -1024..1023;
    };
    
    struct RoadUserChargingConfigMessageCommon_Node_XY_24b {
        INT isValidFlag;   // necessary if this struct is used as an optional field of a SEQUENCE
        INT x;  // INTEGER, -2048..2047;
        INT y;  // INTEGER, -2048..2047;
    };
    
    struct RoadUserChargingConfigMessageCommon_Node_XY_26b {
        INT isValidFlag;   // necessary if this struct is used as an optional field of a SEQUENCE
        INT x;  // INTEGER, -4096..4095;
        INT y;  // INTEGER, -4096..4095;
    };
    
    struct RoadUserChargingConfigMessageCommon_Node_XY_28b {
        INT isValidFlag;   // necessary if this struct is used as an optional field of a SEQUENCE
        INT x;  // INTEGER, -8192..8191;
        INT y;  // INTEGER, -8192..8191;
    };
    
    struct RoadUserChargingConfigMessageCommon_Node_XY_32b {
        INT isValidFlag;   // necessary if this struct is used as an optional field of a SEQUENCE
        INT x;  // INTEGER, -32768..32767;
        INT y;  // INTEGER, -32768..32767;
    };
    
    struct RoadUserChargingConfigMessageCommon_Node_LLmD_64b {
        INT isValidFlag;   // necessary if this struct is used as an optional field of a SEQUENCE
        LONG lon;  // INTEGER, -1799999999..1800000001;
        LONG lat;  // INTEGER, -900000000..900000001;
    };
    
    struct RoadUserChargingConfigMessageAddGrpB_Node_LLdms_48b {
        INT isValidFlag;   // necessary if this struct is used as an optional field of a SEQUENCE
        LONG lon;  // INTEGER, -64800000..64800000;
        LONG lat;  // INTEGER, -32400000..32400000;
    };
    
    struct RoadUserChargingConfigMessageAddGrpB_Node_LLdms_80b {
        INT isValidFlag;   // necessary if this struct is used as an optional field of a SEQUENCE
        struct RoadUserChargingConfigMessageAddGrpB_LongitudeDMS2 lon;  // SEQUENCE;
        struct RoadUserChargingConfigMessageAddGrpB_LatitudeDMS2 lat;  // SEQUENCE;
    };
    
    struct RoadUserChargingConfigMessageAddGrpB_NodeOffsetPointXY_addGrpB {
        INT isValidFlag;   // necessary if this struct is used as an optional field of a SEQUENCE
        INT choice;
        struct RoadUserChargingConfigMessageAddGrpB_Node_LLdms_48b posA;  // SEQUENCE;
        struct RoadUserChargingConfigMessageAddGrpB_Node_LLdms_80b posB;  // SEQUENCE;
    };
    
    struct RoadUserChargingConfigMessageCommon_RegionalExtension_Reg_NodeOffsetPointXY_table {
        struct RoadUserChargingConfigMessageAddGrpB_NodeOffsetPointXY_addGrpB addGrpB;  // CHOICE;
    };
    
    struct RoadUserChargingConfigMessageCommon_RegionalExtension_Reg_NodeOffsetPointXY {
        INT isValidFlag;   // necessary if this struct is used as an optional field of a SEQUENCE
        BYTE regionId;  // INTEGER, 0..255, noRegion(0), addGrpA(1), addGrpB(2), addGrpC(3), addGrpD(4);
        struct RoadUserChargingConfigMessageCommon_RegionalExtension_Reg_NodeOffsetPointXY_table regExtvalue;  // TABLE;
    };
    
    struct RoadUserChargingConfigMessageCommon_NodeOffsetPointXY {
        INT isValidFlag;   // necessary if this struct is used as an optional field of a SEQUENCE
        INT choice;
        struct RoadUserChargingConfigMessageCommon_Node_XY_20b node_XY1;  // SEQUENCE;
        struct RoadUserChargingConfigMessageCommon_Node_XY_22b node_XY2;  // SEQUENCE;
        struct RoadUserChargingConfigMessageCommon_Node_XY_24b node_XY3;  // SEQUENCE;
        struct RoadUserChargingConfigMessageCommon_Node_XY_26b node_XY4;  // SEQUENCE;
        struct RoadUserChargingConfigMessageCommon_Node_XY_28b node_XY5;  // SEQUENCE;
        struct RoadUserChargingConfigMessageCommon_Node_XY_32b node_XY6;  // SEQUENCE;
        struct RoadUserChargingConfigMessageCommon_Node_LLmD_64b node_LatLon;  // SEQUENCE;
        struct RoadUserChargingConfigMessageCommon_RegionalExtension_Reg_NodeOffsetPointXY regional;  // SEQUENCE;
    };
    
    struct RoadUserChargingConfigMessageCommon_NodeAttributeXYList {
        INT isValidFlag;   // necessary if this struct is used as an optional field of a SEQUENCE
        INT length;
        INT arrayValue[8];  // ENUMERATED, reserved(-0), stopLine(1), roundedCapStyleA(2), roundedCapStyleB(3), mergePoint(4), divergePoint(5), downstreamStopLine(6), downstreamStartNode(7), closedToTraffic(8), safeIsland(9), curbPresentAtStepOff(10), hydrantPresent(11);
    };
    
    struct RoadUserChargingConfigMessageCommon_SegmentAttributeXYList {
        INT isValidFlag;   // necessary if this struct is used as an optional field of a SEQUENCE
        INT length;
        INT arrayValue[8];  // ENUMERATED, reserved(-0), doNotBlock(1), whiteLine(2), mergingLaneLeft(3), mergingLaneRight(4), curbOnLeft(5), curbOnRight(6), loadingzoneOnLeft(7), loadingzoneOnRight(8), turnOutPointOnLeft(9), turnOutPointOnRight(10), adjacentParkingOnLeft(11), adjacentParkingOnRight(12), adjacentBikeLaneOnLeft(13), adjacentBikeLaneOnRight(14), sharedBikeLane(15), bikeBoxInFront(16), transitStopOnLeft(17), transitStopOnRight(18), transitStopInLane(19), sharedWithTrackedVehicle(20), safeIsland(21), lowCurbsPresent(22), rumbleStripPresent(23), audibleSignalingPresent(24), adaptiveTimingPresent(25), rfSignalRequestPresent(26), partialCurbIntrusion(27), taperToLeft(28), taperToRight(29), taperToCenterLine(30), parallelParking(31), headInParking(32), freeParking(33), timeRestrictionsOnParking(34), costToPark(35), midBlockCurbPresent(36), unEvenPavementPresent(37);
    };
    
    struct RoadUserChargingConfigMessageCommon_RegulatorySpeedLimit {
        INT isValidFlag;   // necessary if this struct is used as an optional field of a SEQUENCE
        INT type;  // ENUMERATED, unknown(-0), maxSpeedInSchoolZone(1), maxSpeedInSchoolZoneWhenChildrenArePresent(2), maxSpeedInConstructionZone(3), vehicleMinSpeed(4), vehicleMaxSpeed(5), vehicleNightMaxSpeed(6), truckMinSpeed(7), truckMaxSpeed(8), truckNightMaxSpeed(9), vehiclesWithTrailersMinSpeed(10), vehiclesWithTrailersMaxSpeed(11), vehiclesWithTrailersNightMaxSpeed(12);
        WORD speed;  // INTEGER, 0..8191;
    };
    
    struct RoadUserChargingConfigMessageCommon_SpeedLimitList {
        INT isValidFlag;   // necessary if this struct is used as an optional field of a SEQUENCE
        INT length;
        struct RoadUserChargingConfigMessageCommon_RegulatorySpeedLimit arrayValue[9];  // SEQUENCE;
    };
    
    struct RoadUserChargingConfigMessageAddGrpB_LaneDataAttribute_addGrpB {
        INT isValidFlag;   // necessary if this struct is used as an optional field of a SEQUENCE
    };
    
    struct RoadUserChargingConfigMessageCommon_RegionalExtension_Reg_LaneDataAttribute_table {
        struct RoadUserChargingConfigMessageAddGrpB_LaneDataAttribute_addGrpB addGrpB;  // SEQUENCE;
    };
    
    struct RoadUserChargingConfigMessageCommon_RegionalExtension_Reg_LaneDataAttribute {
        INT isValidFlag;   // necessary if this struct is used as an optional field of a SEQUENCE
        BYTE regionId;  // INTEGER, 0..255, noRegion(0), addGrpA(1), addGrpB(2), addGrpC(3), addGrpD(4);
        struct RoadUserChargingConfigMessageCommon_RegionalExtension_Reg_LaneDataAttribute_table regExtvalue;  // TABLE;
    };
    
    struct RoadUserChargingConfigMessageCommon_LaneDataAttribute_regional {
        INT isValidFlag;   // necessary if this struct is used as an optional field of a SEQUENCE
        INT length;
        struct RoadUserChargingConfigMessageCommon_RegionalExtension_Reg_LaneDataAttribute arrayValue[4];  // SEQUENCE;
    };
    
    struct RoadUserChargingConfigMessageCommon_LaneDataAttribute {
        INT isValidFlag;   // necessary if this struct is used as an optional field of a SEQUENCE
        INT choice;
        INT pathEndPointAngle;  // INTEGER, -150..150;
        INT laneCrownPointCenter;  // INTEGER, -128..127;
        INT laneCrownPointLeft;  // INTEGER, -128..127;
        INT laneCrownPointRight;  // INTEGER, -128..127;
        INT laneAngle;  // INTEGER, -180..180;
        struct RoadUserChargingConfigMessageCommon_SpeedLimitList speedLimits;  // SEQUENCEOF;
        struct RoadUserChargingConfigMessageCommon_LaneDataAttribute_regional regional;  // SEQUENCEOF;
    };
    
    struct RoadUserChargingConfigMessageCommon_LaneDataAttributeList {
        INT isValidFlag;   // necessary if this struct is used as an optional field of a SEQUENCE
        INT length;
        struct RoadUserChargingConfigMessageCommon_LaneDataAttribute arrayValue[8];  // CHOICE;
    };
    
    struct RoadUserChargingConfigMessageCommon_RegionalExtension_Reg_NodeAttributeSetXY_table {
    };
    
    struct RoadUserChargingConfigMessageCommon_RegionalExtension_Reg_NodeAttributeSetXY {
        INT isValidFlag;   // necessary if this struct is used as an optional field of a SEQUENCE
        BYTE regionId;  // INTEGER, 0..255, noRegion(0), addGrpA(1), addGrpB(2), addGrpC(3), addGrpD(4);
        struct RoadUserChargingConfigMessageCommon_RegionalExtension_Reg_NodeAttributeSetXY_table regExtvalue;  // TABLE;
    };
    
    struct RoadUserChargingConfigMessageCommon_NodeAttributeSetXY_regional {
        INT isValidFlag;   // necessary if this struct is used as an optional field of a SEQUENCE
        INT length;
        struct RoadUserChargingConfigMessageCommon_RegionalExtension_Reg_NodeAttributeSetXY arrayValue[4];  // SEQUENCE;
    };
    
    struct RoadUserChargingConfigMessageCommon_NodeAttributeSetXY {
        INT isValidFlag;   // necessary if this struct is used as an optional field of a SEQUENCE
        struct RoadUserChargingConfigMessageCommon_NodeAttributeXYList localNode;  // SEQUENCEOF, OPTIONAL;
        struct RoadUserChargingConfigMessageCommon_SegmentAttributeXYList disabled;  // SEQUENCEOF, OPTIONAL;
        struct RoadUserChargingConfigMessageCommon_SegmentAttributeXYList enabled;  // SEQUENCEOF, OPTIONAL;
        struct RoadUserChargingConfigMessageCommon_LaneDataAttributeList data;  // SEQUENCEOF, OPTIONAL;
        struct OPT_INT_ASN dWidth;  // INTEGER, OPTIONAL, -512..511;
        struct OPT_INT_ASN dElevation;  // INTEGER, OPTIONAL, -512..511;
        struct RoadUserChargingConfigMessageCommon_NodeAttributeSetXY_regional regional;  // SEQUENCEOF, OPTIONAL;
    };
    
    struct RoadUserChargingConfigMessageCommon_NodeXY {
        INT isValidFlag;   // necessary if this struct is used as an optional field of a SEQUENCE
        struct RoadUserChargingConfigMessageCommon_NodeOffsetPointXY delta;  // CHOICE;
        struct RoadUserChargingConfigMessageCommon_NodeAttributeSetXY attributes;  // SEQUENCE, OPTIONAL;
    };
    
    struct RoadUserChargingConfigMessageCommon_NodeSetXY {
        INT isValidFlag;   // necessary if this struct is used as an optional field of a SEQUENCE
        INT length;
        struct RoadUserChargingConfigMessageCommon_NodeXY arrayValue[63];  // SEQUENCE;
    };
    
    struct RoadUserChargingConfigMessageCommon_ComputedLane_offsetXaxis {
        INT isValidFlag;   // necessary if this struct is used as an optional field of a SEQUENCE
        INT choice;
        INT small;  // INTEGER, -2047..2047;
        INT large;  // INTEGER, -32767..32767;
    };
    
    struct RoadUserChargingConfigMessageCommon_ComputedLane_offsetYaxis {
        INT isValidFlag;   // necessary if this struct is used as an optional field of a SEQUENCE
        INT choice;
        INT small;  // INTEGER, -2047..2047;
        INT large;  // INTEGER, -32767..32767;
    };
    
    struct RoadUserChargingConfigMessageCommon_RegionalExtension_Reg_ComputedLane_table {
    };
    
    struct RoadUserChargingConfigMessageCommon_RegionalExtension_Reg_ComputedLane {
        INT isValidFlag;   // necessary if this struct is used as an optional field of a SEQUENCE
        BYTE regionId;  // INTEGER, 0..255, noRegion(0), addGrpA(1), addGrpB(2), addGrpC(3), addGrpD(4);
        struct RoadUserChargingConfigMessageCommon_RegionalExtension_Reg_ComputedLane_table regExtvalue;  // TABLE;
    };
    
    struct RoadUserChargingConfigMessageCommon_ComputedLane_regional {
        INT isValidFlag;   // necessary if this struct is used as an optional field of a SEQUENCE
        INT length;
        struct RoadUserChargingConfigMessageCommon_RegionalExtension_Reg_ComputedLane arrayValue[4];  // SEQUENCE;
    };
    
    struct RoadUserChargingConfigMessageCommon_ComputedLane {
        INT isValidFlag;   // necessary if this struct is used as an optional field of a SEQUENCE
        BYTE referenceLaneId;  // INTEGER, 0..255;
        struct RoadUserChargingConfigMessageCommon_ComputedLane_offsetXaxis offsetXaxis;  // CHOICE;
        struct RoadUserChargingConfigMessageCommon_ComputedLane_offsetYaxis offsetYaxis;  // CHOICE;
        struct OPT_WORD_ASN rotateXY;  // INTEGER, OPTIONAL, 0..28800;
        struct OPT_INT_ASN scaleXaxis;  // INTEGER, OPTIONAL, -2048..2047;
        struct OPT_INT_ASN scaleYaxis;  // INTEGER, OPTIONAL, -2048..2047;
        struct RoadUserChargingConfigMessageCommon_ComputedLane_regional regional;  // SEQUENCEOF, OPTIONAL;
    };
    
    struct RoadUserChargingConfigMessageCommon_NodeListXY {
        INT isValidFlag;   // necessary if this struct is used as an optional field of a SEQUENCE
        INT choice;
        struct RoadUserChargingConfigMessageCommon_NodeSetXY nodes;  // SEQUENCEOF;
        struct RoadUserChargingConfigMessageCommon_ComputedLane computed;  // SEQUENCE;
    };
    
    struct RoadUserChargingConfigMessageTravelerInformation_ShapePointSet {
        INT isValidFlag;   // necessary if this struct is used as an optional field of a SEQUENCE
        struct RoadUserChargingConfigMessageCommon_Position3D anchor;  // SEQUENCE, OPTIONAL;
        struct OPT_WORD_ASN laneWidth;  // INTEGER, OPTIONAL, 0..32767;
        struct OPT_ENUM_ASN directionality;  // ENUMERATED, OPTIONAL, unavailable(0), forward(1), reverse(2), both(3);
        struct RoadUserChargingConfigMessageCommon_NodeListXY nodeList;  // CHOICE;
    };
    
    struct RoadUserChargingConfigMessageTravelerInformation_Circle {
        INT isValidFlag;   // necessary if this struct is used as an optional field of a SEQUENCE
        struct RoadUserChargingConfigMessageCommon_Position3D center;  // SEQUENCE;
        WORD radius;  // INTEGER, 0..4095;
        INT units;  // ENUMERATED, centimeter(0), cm2_5(1), decimeter(2), meter(3), kilometer(4), foot(5), yard(6), mile(7);
    };
    
    struct RoadUserChargingConfigMessageTravelerInformation_RegionOffsets {
        INT isValidFlag;   // necessary if this struct is used as an optional field of a SEQUENCE
        INT xOffset;  // INTEGER, -32768..32767;
        INT yOffset;  // INTEGER, -32768..32767;
        struct OPT_INT_ASN zOffset;  // INTEGER, OPTIONAL, -32768..32767;
    };
    
    struct RoadUserChargingConfigMessageTravelerInformation_RegionList {
        INT isValidFlag;   // necessary if this struct is used as an optional field of a SEQUENCE
        INT length;
        struct RoadUserChargingConfigMessageTravelerInformation_RegionOffsets arrayValue[64];  // SEQUENCE;
    };
    
    struct RoadUserChargingConfigMessageTravelerInformation_RegionPointSet {
        INT isValidFlag;   // necessary if this struct is used as an optional field of a SEQUENCE
        struct RoadUserChargingConfigMessageCommon_Position3D anchor;  // SEQUENCE, OPTIONAL;
        struct OPT_BYTE_ASN scale;  // INTEGER, OPTIONAL, 0..15;
        struct RoadUserChargingConfigMessageTravelerInformation_RegionList nodeList;  // SEQUENCEOF;
    };
    
    struct RoadUserChargingConfigMessageTravelerInformation_ValidRegion_area {
        INT isValidFlag;   // necessary if this struct is used as an optional field of a SEQUENCE
        INT choice;
        struct RoadUserChargingConfigMessageTravelerInformation_ShapePointSet shapePointSet;  // SEQUENCE;
        struct RoadUserChargingConfigMessageTravelerInformation_Circle circle;  // SEQUENCE;
        struct RoadUserChargingConfigMessageTravelerInformation_RegionPointSet regionPointSet;  // SEQUENCE;
    };
    
    struct RoadUserChargingConfigMessageTravelerInformation_ValidRegion {
        INT isValidFlag;   // necessary if this struct is used as an optional field of a SEQUENCE
        struct RoadUserChargingConfigMessageCommon_HeadingSlice direction;  // BITSTRING;
        struct OPT_ENUM_ASN extent;  // ENUMERATED, OPTIONAL, useInstantlyOnly(0), useFor3meters(1), useFor10meters(2), useFor50meters(3), useFor100meters(4), useFor500meters(5), useFor1000meters(6), useFor5000meters(7), useFor10000meters(8), useFor50000meters(9), useFor100000meters(10), useFor500000meters(11), useFor1000000meters(12), useFor5000000meters(13), useFor10000000meters(14), forever(15);
        struct RoadUserChargingConfigMessageTravelerInformation_ValidRegion_area area;  // CHOICE;
    };
    
    struct RoadUserChargingConfigMessageArea {
        INT isValidFlag;   // necessary if this struct is used as an optional field of a SEQUENCE
        struct RoadUserChargingConfigMessageArea_areaID areaID;  // OBJECTIDENTIFIER;
        struct RoadUserChargingConfigMessageTravelerInformation_ValidRegion chargingArea;  // SEQUENCE;
        struct RoadUserChargingConfigMessageChargingFees chargingFees;  // SEQUENCE;
    };
    
    struct RoadUserChargingConfigMessageSegment_segmentID_id {
        INT isValidFlag;   // necessary if this struct is used as an optional field of a SEQUENCE
        INT length;
        INT id;
    };
    
    struct RoadUserChargingConfigMessageSegment_segmentID {
        INT isValidFlag;   // necessary if this struct is used as an optional field of a SEQUENCE
        INT length;
        struct RoadUserChargingConfigMessageSegment_segmentID_id arrayValue[16];
    };
    
    struct RoadUserChargingConfigMessageTollAdvertisementMessage_LaneChargesTable {
        INT isValidFlag;   // necessary if this struct is used as an optional field of a SEQUENCE
        BYTE laneId;  // INTEGER, 0..255;
        struct RoadUserChargingConfigMessageTollAdvertisementMessage_ChargesTable chargesTable;  // CHOICE;
    };
    
    struct RoadUserChargingConfigMessageTollAdvertisementMessage_TollChargesTable_tollTypeCharge_perLaneCharges {
        INT isValidFlag;   // necessary if this struct is used as an optional field of a SEQUENCE
        INT length;
        struct RoadUserChargingConfigMessageTollAdvertisementMessage_LaneChargesTable arrayValue[64];  // SEQUENCE;
    };
    
    struct RoadUserChargingConfigMessageTollAdvertisementMessage_ExitInfo {
        INT isValidFlag;   // necessary if this struct is used as an optional field of a SEQUENCE
        WORD exitNumber;  // INTEGER, 1..999;
        struct OPT_BYTE_ASN exitLetter;  // INTEGER, OPTIONAL, 65..90;
        struct OPT_WORD_ASN tollPointID;  // INTEGER, OPTIONAL, 1..2048;
    };
    
    struct RoadUserChargingConfigMessageTollAdvertisementMessage_EntryChargesTable {
        INT isValidFlag;   // necessary if this struct is used as an optional field of a SEQUENCE
        struct RoadUserChargingConfigMessageTollAdvertisementMessage_ExitInfo exitInfo;  // SEQUENCE;
        struct RoadUserChargingConfigMessageTollAdvertisementMessage_ChargesTable chargesTable;  // CHOICE;
    };
    
    struct RoadUserChargingConfigMessageTollAdvertisementMessage_ExitChargesTable {
        INT isValidFlag;   // necessary if this struct is used as an optional field of a SEQUENCE
        struct OPT_WORD_ASN entryInfo;  // INTEGER, OPTIONAL, 1..2048;
        struct RoadUserChargingConfigMessageTollAdvertisementMessage_ChargesTable chargesTable;  // CHOICE;
    };
    
    struct RoadUserChargingConfigMessageTollAdvertisementMessage_ClosedNetworkChargesTable {
        INT isValidFlag;   // necessary if this struct is used as an optional field of a SEQUENCE
        INT choice;
        struct RoadUserChargingConfigMessageTollAdvertisementMessage_EntryChargesTable entryChargesTable;  // SEQUENCE;
        struct RoadUserChargingConfigMessageTollAdvertisementMessage_ExitChargesTable exitChargesTable;  // SEQUENCE;
    };
    
    struct RoadUserChargingConfigMessageTollAdvertisementMessage_TollChargesTable_tollTypeCharge_closedNetworkCharges {
        INT isValidFlag;   // necessary if this struct is used as an optional field of a SEQUENCE
        INT length;
        struct RoadUserChargingConfigMessageTollAdvertisementMessage_ClosedNetworkChargesTable arrayValue[64];  // CHOICE;
    };
    
    struct RoadUserChargingConfigMessageTollAdvertisementMessage_TimeChargesTable {
        INT isValidFlag;   // necessary if this struct is used as an optional field of a SEQUENCE
        WORD maxTime;  // INTEGER, 1..1440;
        struct RoadUserChargingConfigMessageTollAdvertisementMessage_ChargesTable chargesTable;  // CHOICE;
    };
    
    struct RoadUserChargingConfigMessageTollAdvertisementMessage_TollChargesTable_tollTypeCharge {
        INT isValidFlag;   // necessary if this struct is used as an optional field of a SEQUENCE
        INT choice;
        struct RoadUserChargingConfigMessageTollAdvertisementMessage_ChargesTable pointCharges;  // CHOICE;
        struct RoadUserChargingConfigMessageTollAdvertisementMessage_TollChargesTable_tollTypeCharge_perLaneCharges perLaneCharges;  // SEQUENCEOF;
        struct RoadUserChargingConfigMessageTollAdvertisementMessage_TollChargesTable_tollTypeCharge_closedNetworkCharges closedNetworkCharges;  // SEQUENCEOF;
        struct RoadUserChargingConfigMessageTollAdvertisementMessage_TimeChargesTable timeBasedCharges;  // SEQUENCE;
    };
    
    struct RoadUserChargingConfigMessageTollAdvertisementMessage_TollChargesTable {
        INT isValidFlag;   // necessary if this struct is used as an optional field of a SEQUENCE
        struct RoadUserChargingConfigMessageTollAdvertisementMessage_TollChargesTable_tollTypeCharge tollTypeCharge;  // CHOICE;
    };
    
    struct RoadUserChargingConfigMessageTollAdvertisementMessage_TollChargerInfo_tollChargerId_id {
        INT isValidFlag;   // necessary if this struct is used as an optional field of a SEQUENCE
        INT length;
        INT id;
    };
    
    struct RoadUserChargingConfigMessageTollAdvertisementMessage_TollChargerInfo_tollChargerId {
        INT isValidFlag;   // necessary if this struct is used as an optional field of a SEQUENCE
        INT length;
        struct RoadUserChargingConfigMessageTollAdvertisementMessage_TollChargerInfo_tollChargerId_id arrayValue[16];
    };
    
    struct RoadUserChargingConfigMessageTollAdvertisementMessage_TollChargerInfo {
        INT isValidFlag;   // necessary if this struct is used as an optional field of a SEQUENCE
        struct RoadUserChargingConfigMessageTollAdvertisementMessage_TollChargerInfo_tollChargerId tollChargerId;  // OBJECTIDENTIFIER;
        WORD tollPointId;  // INTEGER, 1..2048;
        struct RoadUserChargingConfigMessageCommon_DescriptiveName descriptiveName;  // IA5STRING, OPTIONAL;
    };
    
    struct RoadUserChargingConfigMessageTollAdvertisementMessage_TumInstructions {
        INT isValidFlag;   // necessary if this struct is used as an optional field of a SEQUENCE
        BYTE maxNumOfLocTimeStamps;  // INTEGER, 1..5;
        BYTE locTimeStampRate;  // INTEGER, 1..10;
    };
    
    struct RoadUserChargingConfigMessageMapData_LaneDirection {
        INT isValidFlag;   // necessary if this struct is used as an optional field of a SEQUENCE
        CHAR string[3];
        INT  stringLength;
    };
    
    struct RoadUserChargingConfigMessageMapData_LaneSharing {
        INT isValidFlag;   // necessary if this struct is used as an optional field of a SEQUENCE
        CHAR string[11];
        INT  stringLength;
    };
    
    struct RoadUserChargingConfigMessageMapData_LaneAttributes_Vehicle {
        INT isValidFlag;   // necessary if this struct is used as an optional field of a SEQUENCE
        CHAR string[9];
        INT  stringLength;
    };
    
    struct RoadUserChargingConfigMessageMapData_LaneAttributes_Crosswalk {
        INT isValidFlag;   // necessary if this struct is used as an optional field of a SEQUENCE
        CHAR string[17];
        INT  stringLength;
    };
    
    struct RoadUserChargingConfigMessageMapData_LaneAttributes_Bike {
        INT isValidFlag;   // necessary if this struct is used as an optional field of a SEQUENCE
        CHAR string[17];
        INT  stringLength;
    };
    
    struct RoadUserChargingConfigMessageMapData_LaneAttributes_Sidewalk {
        INT isValidFlag;   // necessary if this struct is used as an optional field of a SEQUENCE
        CHAR string[17];
        INT  stringLength;
    };
    
    struct RoadUserChargingConfigMessageMapData_LaneAttributes_Barrier {
        INT isValidFlag;   // necessary if this struct is used as an optional field of a SEQUENCE
        CHAR string[17];
        INT  stringLength;
    };
    
    struct RoadUserChargingConfigMessageMapData_LaneAttributes_Striping {
        INT isValidFlag;   // necessary if this struct is used as an optional field of a SEQUENCE
        CHAR string[17];
        INT  stringLength;
    };
    
    struct RoadUserChargingConfigMessageMapData_LaneAttributes_TrackedVehicle {
        INT isValidFlag;   // necessary if this struct is used as an optional field of a SEQUENCE
        CHAR string[17];
        INT  stringLength;
    };
    
    struct RoadUserChargingConfigMessageMapData_LaneAttributes_Parking {
        INT isValidFlag;   // necessary if this struct is used as an optional field of a SEQUENCE
        CHAR string[17];
        INT  stringLength;
    };
    
    struct RoadUserChargingConfigMessageMapData_LaneTypeAttributes {
        INT isValidFlag;   // necessary if this struct is used as an optional field of a SEQUENCE
        INT choice;
        struct RoadUserChargingConfigMessageMapData_LaneAttributes_Vehicle vehicle;  // BITSTRING;
        struct RoadUserChargingConfigMessageMapData_LaneAttributes_Crosswalk crosswalk;  // BITSTRING;
        struct RoadUserChargingConfigMessageMapData_LaneAttributes_Bike bikeLane;  // BITSTRING;
        struct RoadUserChargingConfigMessageMapData_LaneAttributes_Sidewalk sidewalk;  // BITSTRING;
        struct RoadUserChargingConfigMessageMapData_LaneAttributes_Barrier median;  // BITSTRING;
        struct RoadUserChargingConfigMessageMapData_LaneAttributes_Striping striping;  // BITSTRING;
        struct RoadUserChargingConfigMessageMapData_LaneAttributes_TrackedVehicle trackedVehicle;  // BITSTRING;
        struct RoadUserChargingConfigMessageMapData_LaneAttributes_Parking parking;  // BITSTRING;
    };
    
    struct RoadUserChargingConfigMessageCommon_RegionalExtension_Reg_LaneAttributes_table {
    };
    
    struct RoadUserChargingConfigMessageCommon_RegionalExtension_Reg_LaneAttributes {
        INT isValidFlag;   // necessary if this struct is used as an optional field of a SEQUENCE
        BYTE regionId;  // INTEGER, 0..255, noRegion(0), addGrpA(1), addGrpB(2), addGrpC(3), addGrpD(4);
        struct RoadUserChargingConfigMessageCommon_RegionalExtension_Reg_LaneAttributes_table regExtvalue;  // TABLE;
    };
    
    struct RoadUserChargingConfigMessageMapData_LaneAttributes {
        INT isValidFlag;   // necessary if this struct is used as an optional field of a SEQUENCE
        struct RoadUserChargingConfigMessageMapData_LaneDirection directionalUse;  // BITSTRING;
        struct RoadUserChargingConfigMessageMapData_LaneSharing sharedWith;  // BITSTRING;
        struct RoadUserChargingConfigMessageMapData_LaneTypeAttributes laneType;  // CHOICE;
        struct RoadUserChargingConfigMessageCommon_RegionalExtension_Reg_LaneAttributes regional;  // SEQUENCE, OPTIONAL;
    };
    
    struct RoadUserChargingConfigMessageMapData_AllowedManeuvers {
        INT isValidFlag;   // necessary if this struct is used as an optional field of a SEQUENCE
        CHAR string[13];
        INT  stringLength;
    };
    
    struct RoadUserChargingConfigMessageMapData_ConnectingLane {
        INT isValidFlag;   // necessary if this struct is used as an optional field of a SEQUENCE
        BYTE lane;  // INTEGER, 0..255;
        struct RoadUserChargingConfigMessageMapData_AllowedManeuvers maneuver;  // BITSTRING, OPTIONAL;
    };
    
    struct RoadUserChargingConfigMessageCommon_IntersectionReferenceID {
        INT isValidFlag;   // necessary if this struct is used as an optional field of a SEQUENCE
        struct OPT_WORD_ASN region;  // INTEGER, OPTIONAL, 0..65535;
        WORD id;  // INTEGER, 0..65535;
    };
    
    struct RoadUserChargingConfigMessageMapData_Connection {
        INT isValidFlag;   // necessary if this struct is used as an optional field of a SEQUENCE
        struct RoadUserChargingConfigMessageMapData_ConnectingLane connectingLane;  // SEQUENCE;
        struct RoadUserChargingConfigMessageCommon_IntersectionReferenceID remoteIntersection;  // SEQUENCE, OPTIONAL;
        struct OPT_BYTE_ASN signalGroup;  // INTEGER, OPTIONAL, 0..255;
        struct OPT_BYTE_ASN userClass;  // INTEGER, OPTIONAL, 0..255;
        struct OPT_BYTE_ASN connectionID;  // INTEGER, OPTIONAL, 0..255;
    };
    
    struct RoadUserChargingConfigMessageMapData_ConnectsToList {
        INT isValidFlag;   // necessary if this struct is used as an optional field of a SEQUENCE
        INT length;
        struct RoadUserChargingConfigMessageMapData_Connection arrayValue[16];  // SEQUENCE;
    };
    
    struct RoadUserChargingConfigMessageMapData_OverlayLaneList {
        INT isValidFlag;   // necessary if this struct is used as an optional field of a SEQUENCE
        INT length;
        BYTE arrayValue[5];  // INTEGER, 0..255;
    };
    
    struct RoadUserChargingConfigMessageCommon_RegionalExtension_Reg_GenericLane_table {
    };
    
    struct RoadUserChargingConfigMessageCommon_RegionalExtension_Reg_GenericLane {
        INT isValidFlag;   // necessary if this struct is used as an optional field of a SEQUENCE
        BYTE regionId;  // INTEGER, 0..255, noRegion(0), addGrpA(1), addGrpB(2), addGrpC(3), addGrpD(4);
        struct RoadUserChargingConfigMessageCommon_RegionalExtension_Reg_GenericLane_table regExtvalue;  // TABLE;
    };
    
    struct RoadUserChargingConfigMessageMapData_GenericLane_regional {
        INT isValidFlag;   // necessary if this struct is used as an optional field of a SEQUENCE
        INT length;
        struct RoadUserChargingConfigMessageCommon_RegionalExtension_Reg_GenericLane arrayValue[4];  // SEQUENCE;
    };
    
    struct RoadUserChargingConfigMessageMapData_GenericLane {
        INT isValidFlag;   // necessary if this struct is used as an optional field of a SEQUENCE
        BYTE laneID;  // INTEGER, 0..255;
        struct RoadUserChargingConfigMessageCommon_DescriptiveName name;  // IA5STRING, OPTIONAL;
        struct OPT_BYTE_ASN ingressApproach;  // INTEGER, OPTIONAL, 0..15;
        struct OPT_BYTE_ASN egressApproach;  // INTEGER, OPTIONAL, 0..15;
        struct RoadUserChargingConfigMessageMapData_LaneAttributes laneAttributes;  // SEQUENCE;
        struct RoadUserChargingConfigMessageMapData_AllowedManeuvers maneuvers;  // BITSTRING, OPTIONAL;
        struct RoadUserChargingConfigMessageCommon_NodeListXY nodeList;  // CHOICE;
        struct RoadUserChargingConfigMessageMapData_ConnectsToList connectsTo;  // SEQUENCEOF, OPTIONAL;
        struct RoadUserChargingConfigMessageMapData_OverlayLaneList overlays;  // SEQUENCEOF, OPTIONAL;
        struct RoadUserChargingConfigMessageMapData_GenericLane_regional regional;  // SEQUENCEOF, OPTIONAL;
    };
    
    struct RoadUserChargingConfigMessageTollAdvertisementMessage_TollPointMap_approachLanesMap {
        INT isValidFlag;   // necessary if this struct is used as an optional field of a SEQUENCE
        INT length;
        struct RoadUserChargingConfigMessageMapData_GenericLane arrayValue[64];  // SEQUENCE;
    };
    
    struct RoadUserChargingConfigMessageTollAdvertisementMessage_TollPointMap_tollZoneLanesMap {
        INT isValidFlag;   // necessary if this struct is used as an optional field of a SEQUENCE
        INT length;
        struct RoadUserChargingConfigMessageMapData_GenericLane arrayValue[64];  // SEQUENCE;
    };
    
    struct RoadUserChargingConfigMessageTollAdvertisementMessage_TollPointMap {
        INT isValidFlag;   // necessary if this struct is used as an optional field of a SEQUENCE
        BYTE revisionNum;  // INTEGER, 1..10;
        struct RoadUserChargingConfigMessageCommon_Position3D referencePoint;  // SEQUENCE;
        struct RoadUserChargingConfigMessageCommon_RegulatorySpeedLimit speedLimit;  // SEQUENCE;
        WORD laneWidth;  // INTEGER, 0..32767;
        struct RoadUserChargingConfigMessageTollAdvertisementMessage_TollPointMap_approachLanesMap approachLanesMap;  // SEQUENCEOF;
        struct RoadUserChargingConfigMessageTollAdvertisementMessage_TollPointMap_tollZoneLanesMap tollZoneLanesMap;  // SEQUENCEOF;
    };
    
    struct RoadUserChargingConfigMessageTollAdvertisementMessage_TollAdvertisementInfo_tumPublicKey {
        INT isValidFlag;   // necessary if this struct is used as an optional field of a SEQUENCE
        CHAR string[33];
        INT  stringLength;
    };
    
    struct RoadUserChargingConfigMessageTollAdvertisementMessage_AckPolicy {
        INT isValidFlag;   // necessary if this struct is used as an optional field of a SEQUENCE
        WORD timeout;  // INTEGER, 100..10000;
        BYTE numOfRetries;  // INTEGER, 1..5;
    };
    
    struct RoadUserChargingConfigMessageTollAdvertisementMessage_TollAdvertisementInfo {
        INT isValidFlag;   // necessary if this struct is used as an optional field of a SEQUENCE
        BYTE tamSequenceNum;  // INTEGER, 0..127;
        BYTE totalTams;  // INTEGER, 1..10;
        BYTE tamNum;  // INTEGER, 1..10;
        struct RoadUserChargingConfigMessageTollAdvertisementMessage_TollChargerInfo tollChargerInfo;  // SEQUENCE;
        struct RoadUserChargingConfigMessageCommon_DDateTime timestamp;  // SEQUENCE;
        struct RoadUserChargingConfigMessageTollAdvertisementMessage_TumInstructions tumInstructions;  // SEQUENCE, OPTIONAL;
        struct RoadUserChargingConfigMessageTollAdvertisementMessage_TollPointMap tollPointMap;  // SEQUENCE;
        struct RoadUserChargingConfigMessageTollAdvertisementMessage_TollAdvertisementInfo_tumPublicKey tumPublicKey;  // OCTETSTRING;
        struct RoadUserChargingConfigMessageTollAdvertisementMessage_AckPolicy ackPolicy;  // SEQUENCE;
        struct OPT_BOOL_ASN lastTollPtDataReq;  // BOOLEAN, OPTIONAL;
    };
    
    struct RoadUserChargingConfigMessageTollAdvertisementMessage_TollAdvertisementMessage {
        INT isValidFlag;   // necessary if this struct is used as an optional field of a SEQUENCE
        struct RoadUserChargingConfigMessageTollAdvertisementMessage_TollChargesTable tollChargesTable;  // SEQUENCE;
        struct RoadUserChargingConfigMessageTollAdvertisementMessage_TollAdvertisementInfo tollAdvInfo;  // SEQUENCE, OPTIONAL;
    };
    
    struct RoadUserChargingConfigMessageSegment_chargingSegment {
        INT isValidFlag;   // necessary if this struct is used as an optional field of a SEQUENCE
        INT length;
        struct RoadUserChargingConfigMessageTollAdvertisementMessage_TollAdvertisementMessage arrayValue[999];  // SEQUENCE;
    };
    
    struct RoadUserChargingConfigMessageSegment {
        INT isValidFlag;   // necessary if this struct is used as an optional field of a SEQUENCE
        struct RoadUserChargingConfigMessageSegment_segmentID segmentID;  // OBJECTIDENTIFIER;
        struct RoadUserChargingConfigMessageSegment_chargingSegment chargingSegment;  // SEQUENCEOF;
        struct RoadUserChargingConfigMessageChargingUnits chargingUnits;  // CHOICE, OPTIONAL;
    };
    
    struct RoadUserChargingConfigMessageChargingAreaOrSegment {
        INT isValidFlag;   // necessary if this struct is used as an optional field of a SEQUENCE
        INT choice;
        struct RoadUserChargingConfigMessageArea area;  // SEQUENCE;
        struct RoadUserChargingConfigMessageSegment segment;  // SEQUENCE;
    };
    
    struct RoadUserChargingConfigMessageAreaOrSegmentChargingInfo_chargingAreaOrSegment {
        INT isValidFlag;   // necessary if this struct is used as an optional field of a SEQUENCE
        INT length;
        struct RoadUserChargingConfigMessageChargingAreaOrSegment arrayValue[999];  // CHOICE;
    };
    
    struct RoadUserChargingConfigMessageAreaOrSegmentChargingInfo {
        INT isValidFlag;   // necessary if this struct is used as an optional field of a SEQUENCE
        struct RoadUserChargingConfigMessageAreaOrSegmentChargingInfo_chargingAreaOrSegment chargingAreaOrSegment;  // SEQUENCEOF;
    };
    
    struct RoadUserChargingConfigMessageChargingConfig {
        INT isValidFlag;   // necessary if this struct is used as an optional field of a SEQUENCE
        struct RoadUserChargingConfigMessageConfigInfo configInfo;  // SEQUENCE;
        INT reportSched;  // ENUMERATED, hourly(0), weekly(1), monthly(2), quarterly(3);
        struct RoadUserChargingConfigMessagePrimaryRegionChargingInfo byPrimaryRegion;  // SEQUENCE;
        struct RoadUserChargingConfigMessageChargingConfig_bySubRegion bySubRegion;  // SEQUENCEOF, OPTIONAL;
        struct RoadUserChargingConfigMessageAreaOrSegmentChargingInfo byAreaOrSegment;  // SEQUENCE, OPTIONAL;
    };
    
    struct RoadUserChargingConfigMessageChargerInfo {
        INT isValidFlag;   // necessary if this struct is used as an optional field of a SEQUENCE
        struct RoadUserChargingConfigMessageChargerInfo_chargerID chargerID;  // OBJECTIDENTIFIER;
        struct RoadUserChargingConfigMessageCommon_DescriptiveName descriptiveName;  // IA5STRING, OPTIONAL;
        struct RoadUserChargingConfigMessageCommon_DDateTime timeStamp;  // SEQUENCE, OPTIONAL;
        struct RoadUserChargingConfigMessageChargingConfig chargingConfig;  // SEQUENCE;
    };
    
    struct RoadUserChargingConfigMessageRoadUserChargingConfigMessage_chargerInfoTable {
        INT isValidFlag;   // necessary if this struct is used as an optional field of a SEQUENCE
        INT length;
        struct RoadUserChargingConfigMessageChargerInfo arrayValue[999];  // SEQUENCE;
    };
    
    struct RoadUserChargingConfigMessage_RoadUserChargingConfigMessage {
        INT isValidFlag;   // necessary if this struct is used as an optional field of a SEQUENCE
        struct RoadUserChargingConfigMessageRoadUserChargingConfigMessage_chargerInfoTable chargerInfoTable;  // SEQUENCEOF;
    };
    
    struct RoadUserChargingConfigMessageMESSAGE_ID_AND_TYPE {
        struct RoadUserChargingConfigMessage_RoadUserChargingConfigMessage roadUserChargingConfigMessage;  // SEQUENCE;
    };
    
    struct RoadUserChargingConfigMessage {
        INT isValidFlag;   // necessary if this struct is used as an optional field of a SEQUENCE
        WORD messageId;  // INTEGER, 0..32767, mapData(18), signalPhaseAndTimingMessage(19), basicSafetyMessage(20), commonSafetyRequest(21), emergencyVehicleAlert(22), intersectionCollision(23), nmeaCorrections(24), probeDataManagement(25), probeVehicleData(26), roadSideAlert(27), rtcmCorrections(28), signalRequestMessage(29), signalStatusMessage(30), travelerInformation(31), personalSafetyMessage(32), roadSafetyMessage(33), roadWeatherMessage(34), probeDataConfigMessage(35), probeDataReportMessage(36), tollAdvertisementMessage(37), tollUsageMessage(38), tollUsageAckMessage(39), cooperativeControlMessage(40), sensorDataSharingMessage(41), maneuverSharingAndCoordinatingMessage(42), roadGeometryAndAttributes(43), personalSafetyMessage2(44), trafficSignalPhaseAndTiming(45), signalControlAndPrioritizationRequest(46), signalControlAndPrioritizationStatus(47), roadUserChargingConfigMessage(48), roadUserChargingReportMessage(49), trafficLightStatusMessage(50);
        struct RoadUserChargingConfigMessageMESSAGE_ID_AND_TYPE value;  // TABLE;
    };
    
}

/*
// init function to create a simple packet handle
*/ 
LONG API_InitRoadUserChargingConfigMessagePacket()
{
  return C2xInitPacket("RoadUserChargingConfigMessage"); 
}

/*
// init function to create a simple packet handle and
// initialize the struct with valid data
*/ 
LONG API_InitRoadUserChargingConfigMessagePacket(struct RoadUserChargingConfigMessage msgStruct)
{
  long pktHandle;

  pktHandle = API_InitRoadUserChargingConfigMessagePacket();

  if (pktHandle != 0)
  {
    // create valid message and application data
    if (C2xCompletePacket(pktHandle) == 0) 
    {
      API_GetRoadUserChargingConfigMessageParams(pktHandle, msgStruct);
    }
  }
  return pktHandle;
}

/*
// init function to create a packet with security layer and
// initialize the struct with valid data
*/ 
LONG API_InitRoadUserChargingConfigMessagePacket(struct RoadUserChargingConfigMessage msgStruct, char packetTypeDesignator[], char certificateName[])
{
  long pktHandle, certHdl;

  // initialize the packet
  pktHandle = C2xInitPacket("RoadUserChargingConfigMessage", packetTypeDesignator);

  if (pktHandle != 0)
  {
    certHdl = C2xSecCertificateGetHandle(certificateName);  // get the certificate handle for the cert with name "certificateName"
    if (certHdl != 0) 
    {
      C2xSecPacketSetSignerHandle(pktHandle, certHdl); // set the certHdl to the packet
    }

    // create valid message and application data
    if (C2xCompletePacket(pktHandle) == 0) 
    {
      // copy application data to the application structure
      API_GetRoadUserChargingConfigMessageParams(pktHandle, msgStruct);
    }
  }
  return pktHandle;
}
    

int GetRoadUserChargingConfigMessageCommon_DDateTimeParams(LONG packetHandle, struct RoadUserChargingConfigMessageCommon_DDateTime value, char oldPath[])
{
  char newPath[300];
  int result;

  result = 0;

  snprintf(newPath, elcount(newPath), "%s.%s", oldPath, "year");
  value.year.isValidFlag = C2xIsTokenAvailable(packetHandle, "RoadUserChargingConfigMessage", newPath);
  if(value.year.isValidFlag==1)
  {
    value.year.value = C2xGetTokenInt(packetHandle, "RoadUserChargingConfigMessage", newPath);
    result = CheckLastError("RoadUserChargingConfigMessage", gkFuncRefGet, result);
  }
  snprintf(newPath, elcount(newPath), "%s.%s", oldPath, "month");
  value.month.isValidFlag = C2xIsTokenAvailable(packetHandle, "RoadUserChargingConfigMessage", newPath);
  if(value.month.isValidFlag==1)
  {
    value.month.value = C2xGetTokenInt(packetHandle, "RoadUserChargingConfigMessage", newPath);
    result = CheckLastError("RoadUserChargingConfigMessage", gkFuncRefGet, result);
  }
  snprintf(newPath, elcount(newPath), "%s.%s", oldPath, "day");
  value.day.isValidFlag = C2xIsTokenAvailable(packetHandle, "RoadUserChargingConfigMessage", newPath);
  if(value.day.isValidFlag==1)
  {
    value.day.value = C2xGetTokenInt(packetHandle, "RoadUserChargingConfigMessage", newPath);
    result = CheckLastError("RoadUserChargingConfigMessage", gkFuncRefGet, result);
  }
  snprintf(newPath, elcount(newPath), "%s.%s", oldPath, "hour");
  value.hour.isValidFlag = C2xIsTokenAvailable(packetHandle, "RoadUserChargingConfigMessage", newPath);
  if(value.hour.isValidFlag==1)
  {
    value.hour.value = C2xGetTokenInt(packetHandle, "RoadUserChargingConfigMessage", newPath);
    result = CheckLastError("RoadUserChargingConfigMessage", gkFuncRefGet, result);
  }
  snprintf(newPath, elcount(newPath), "%s.%s", oldPath, "minute");
  value.minute.isValidFlag = C2xIsTokenAvailable(packetHandle, "RoadUserChargingConfigMessage", newPath);
  if(value.minute.isValidFlag==1)
  {
    value.minute.value = C2xGetTokenInt(packetHandle, "RoadUserChargingConfigMessage", newPath);
    result = CheckLastError("RoadUserChargingConfigMessage", gkFuncRefGet, result);
  }
  snprintf(newPath, elcount(newPath), "%s.%s", oldPath, "second");
  value.second.isValidFlag = C2xIsTokenAvailable(packetHandle, "RoadUserChargingConfigMessage", newPath);
  if(value.second.isValidFlag==1)
  {
    value.second.value = C2xGetTokenInt(packetHandle, "RoadUserChargingConfigMessage", newPath);
    result = CheckLastError("RoadUserChargingConfigMessage", gkFuncRefGet, result);
  }
  snprintf(newPath, elcount(newPath), "%s.%s", oldPath, "offset");
  value.offset.isValidFlag = C2xIsTokenAvailable(packetHandle, "RoadUserChargingConfigMessage", newPath);
  if(value.offset.isValidFlag==1)
  {
    value.offset.value = C2xGetTokenInt(packetHandle, "RoadUserChargingConfigMessage", newPath);
    result = CheckLastError("RoadUserChargingConfigMessage", gkFuncRefGet, result);
  }
  return result;
}

int SetRoadUserChargingConfigMessageCommon_DDateTimeParams(LONG packetHandle, struct RoadUserChargingConfigMessageCommon_DDateTime value, char oldPath[])
{
  char newPath[300];
  int result;

  result = 0;

  snprintf(newPath, elcount(newPath), "%s.%s", oldPath, "year");
  if(value.year.isValidFlag==1)
  {
    C2xSetTokenInt(packetHandle, "RoadUserChargingConfigMessage", newPath, value.year.value);
    result = CheckLastError("RoadUserChargingConfigMessage", gkFuncRefGet, result);
  }
  else
  {
    if( C2xIsTokenAvailable(packetHandle, "RoadUserChargingConfigMessage", newPath) )
    {
      C2xRemoveToken(packetHandle, "RoadUserChargingConfigMessage", newPath);
    }
  }

  snprintf(newPath, elcount(newPath), "%s.%s", oldPath, "month");
  if(value.month.isValidFlag==1)
  {
    C2xSetTokenInt(packetHandle, "RoadUserChargingConfigMessage", newPath, value.month.value);
    result = CheckLastError("RoadUserChargingConfigMessage", gkFuncRefGet, result);
  }
  else
  {
    if( C2xIsTokenAvailable(packetHandle, "RoadUserChargingConfigMessage", newPath) )
    {
      C2xRemoveToken(packetHandle, "RoadUserChargingConfigMessage", newPath);
    }
  }

  snprintf(newPath, elcount(newPath), "%s.%s", oldPath, "day");
  if(value.day.isValidFlag==1)
  {
    C2xSetTokenInt(packetHandle, "RoadUserChargingConfigMessage", newPath, value.day.value);
    result = CheckLastError("RoadUserChargingConfigMessage", gkFuncRefGet, result);
  }
  else
  {
    if( C2xIsTokenAvailable(packetHandle, "RoadUserChargingConfigMessage", newPath) )
    {
      C2xRemoveToken(packetHandle, "RoadUserChargingConfigMessage", newPath);
    }
  }

  snprintf(newPath, elcount(newPath), "%s.%s", oldPath, "hour");
  if(value.hour.isValidFlag==1)
  {
    C2xSetTokenInt(packetHandle, "RoadUserChargingConfigMessage", newPath, value.hour.value);
    result = CheckLastError("RoadUserChargingConfigMessage", gkFuncRefGet, result);
  }
  else
  {
    if( C2xIsTokenAvailable(packetHandle, "RoadUserChargingConfigMessage", newPath) )
    {
      C2xRemoveToken(packetHandle, "RoadUserChargingConfigMessage", newPath);
    }
  }

  snprintf(newPath, elcount(newPath), "%s.%s", oldPath, "minute");
  if(value.minute.isValidFlag==1)
  {
    C2xSetTokenInt(packetHandle, "RoadUserChargingConfigMessage", newPath, value.minute.value);
    result = CheckLastError("RoadUserChargingConfigMessage", gkFuncRefGet, result);
  }
  else
  {
    if( C2xIsTokenAvailable(packetHandle, "RoadUserChargingConfigMessage", newPath) )
    {
      C2xRemoveToken(packetHandle, "RoadUserChargingConfigMessage", newPath);
    }
  }

  snprintf(newPath, elcount(newPath), "%s.%s", oldPath, "second");
  if(value.second.isValidFlag==1)
  {
    C2xSetTokenInt(packetHandle, "RoadUserChargingConfigMessage", newPath, value.second.value);
    result = CheckLastError("RoadUserChargingConfigMessage", gkFuncRefGet, result);
  }
  else
  {
    if( C2xIsTokenAvailable(packetHandle, "RoadUserChargingConfigMessage", newPath) )
    {
      C2xRemoveToken(packetHandle, "RoadUserChargingConfigMessage", newPath);
    }
  }

  snprintf(newPath, elcount(newPath), "%s.%s", oldPath, "offset");
  if(value.offset.isValidFlag==1)
  {
    C2xSetTokenInt(packetHandle, "RoadUserChargingConfigMessage", newPath, value.offset.value);
    result = CheckLastError("RoadUserChargingConfigMessage", gkFuncRefGet, result);
  }
  else
  {
    if( C2xIsTokenAvailable(packetHandle, "RoadUserChargingConfigMessage", newPath) )
    {
      C2xRemoveToken(packetHandle, "RoadUserChargingConfigMessage", newPath);
    }
  }

  return result;
}

int GetRoadUserChargingConfigMessageConfigInfoParams(LONG packetHandle, struct RoadUserChargingConfigMessageConfigInfo value, char oldPath[])
{
  char newPath[300];
  int result;

  result = 0;

  snprintf(newPath, elcount(newPath), "%s.%s", oldPath, "configID");
  value.configID = C2xGetTokenInt(packetHandle, "RoadUserChargingConfigMessage", newPath);
  result = CheckLastError("RoadUserChargingConfigMessage", gkFuncRefGet, result);

  snprintf(newPath, elcount(newPath), "%s.%s", oldPath, "configVersion");
  value.configVersion = C2xGetTokenInt(packetHandle, "RoadUserChargingConfigMessage", newPath);
  result = CheckLastError("RoadUserChargingConfigMessage", gkFuncRefGet, result);

  snprintf(newPath, elcount(newPath), "%s.%s", oldPath, "startDate");
  GetRoadUserChargingConfigMessageCommon_DDateTimeParams(packetHandle, value.startDate, newPath);
  result = CheckLastError("RoadUserChargingConfigMessage", gkFuncRefGet, result);

  snprintf(newPath, elcount(newPath), "%s.%s", oldPath, "expirationDate");
  GetRoadUserChargingConfigMessageCommon_DDateTimeParams(packetHandle, value.expirationDate, newPath);
  result = CheckLastError("RoadUserChargingConfigMessage", gkFuncRefGet, result);

  snprintf(newPath, elcount(newPath), "%s.%s", oldPath, "configurationFeeType");
  value.configurationFeeType = C2xGetTokenInt(packetHandle, "RoadUserChargingConfigMessage", newPath);
  result = CheckLastError("RoadUserChargingConfigMessage", gkFuncRefGet, result);

  return result;
}

int SetRoadUserChargingConfigMessageConfigInfoParams(LONG packetHandle, struct RoadUserChargingConfigMessageConfigInfo value, char oldPath[])
{
  char newPath[300];
  int result;

  result = 0;

  snprintf(newPath, elcount(newPath), "%s.%s", oldPath, "configID");
  C2xSetTokenInt(packetHandle, "RoadUserChargingConfigMessage", newPath, value.configID);
  result = CheckLastError("RoadUserChargingConfigMessage", gkFuncRefGet, result);

  snprintf(newPath, elcount(newPath), "%s.%s", oldPath, "configVersion");
  C2xSetTokenInt(packetHandle, "RoadUserChargingConfigMessage", newPath, value.configVersion);
  result = CheckLastError("RoadUserChargingConfigMessage", gkFuncRefGet, result);

  snprintf(newPath, elcount(newPath), "%s.%s", oldPath, "startDate");
  SetRoadUserChargingConfigMessageCommon_DDateTimeParams(packetHandle, value.startDate, newPath);
  result = CheckLastError("RoadUserChargingConfigMessage", gkFuncRefGet, result);

  snprintf(newPath, elcount(newPath), "%s.%s", oldPath, "expirationDate");
  SetRoadUserChargingConfigMessageCommon_DDateTimeParams(packetHandle, value.expirationDate, newPath);
  result = CheckLastError("RoadUserChargingConfigMessage", gkFuncRefGet, result);

  snprintf(newPath, elcount(newPath), "%s.%s", oldPath, "configurationFeeType");
  C2xSetTokenInt(packetHandle, "RoadUserChargingConfigMessage", newPath, value.configurationFeeType);
  result = CheckLastError("RoadUserChargingConfigMessage", gkFuncRefGet, result);

  return result;
}

int GetRoadUserChargingConfigMessageCommon_DTimeParams(LONG packetHandle, struct RoadUserChargingConfigMessageCommon_DTime value, char oldPath[])
{
  char newPath[300];
  int result;

  result = 0;

  snprintf(newPath, elcount(newPath), "%s.%s", oldPath, "hour");
  value.hour = C2xGetTokenInt(packetHandle, "RoadUserChargingConfigMessage", newPath);
  result = CheckLastError("RoadUserChargingConfigMessage", gkFuncRefGet, result);

  snprintf(newPath, elcount(newPath), "%s.%s", oldPath, "minute");
  value.minute = C2xGetTokenInt(packetHandle, "RoadUserChargingConfigMessage", newPath);
  result = CheckLastError("RoadUserChargingConfigMessage", gkFuncRefGet, result);

  snprintf(newPath, elcount(newPath), "%s.%s", oldPath, "second");
  value.second = C2xGetTokenInt(packetHandle, "RoadUserChargingConfigMessage", newPath);
  result = CheckLastError("RoadUserChargingConfigMessage", gkFuncRefGet, result);

  snprintf(newPath, elcount(newPath), "%s.%s", oldPath, "offset");
  value.offset.isValidFlag = C2xIsTokenAvailable(packetHandle, "RoadUserChargingConfigMessage", newPath);
  if(value.offset.isValidFlag==1)
  {
    value.offset.value = C2xGetTokenInt(packetHandle, "RoadUserChargingConfigMessage", newPath);
    result = CheckLastError("RoadUserChargingConfigMessage", gkFuncRefGet, result);
  }
  return result;
}

int SetRoadUserChargingConfigMessageCommon_DTimeParams(LONG packetHandle, struct RoadUserChargingConfigMessageCommon_DTime value, char oldPath[])
{
  char newPath[300];
  int result;

  result = 0;

  snprintf(newPath, elcount(newPath), "%s.%s", oldPath, "hour");
  C2xSetTokenInt(packetHandle, "RoadUserChargingConfigMessage", newPath, value.hour);
  result = CheckLastError("RoadUserChargingConfigMessage", gkFuncRefGet, result);

  snprintf(newPath, elcount(newPath), "%s.%s", oldPath, "minute");
  C2xSetTokenInt(packetHandle, "RoadUserChargingConfigMessage", newPath, value.minute);
  result = CheckLastError("RoadUserChargingConfigMessage", gkFuncRefGet, result);

  snprintf(newPath, elcount(newPath), "%s.%s", oldPath, "second");
  C2xSetTokenInt(packetHandle, "RoadUserChargingConfigMessage", newPath, value.second);
  result = CheckLastError("RoadUserChargingConfigMessage", gkFuncRefGet, result);

  snprintf(newPath, elcount(newPath), "%s.%s", oldPath, "offset");
  if(value.offset.isValidFlag==1)
  {
    C2xSetTokenInt(packetHandle, "RoadUserChargingConfigMessage", newPath, value.offset.value);
    result = CheckLastError("RoadUserChargingConfigMessage", gkFuncRefGet, result);
  }
  else
  {
    if( C2xIsTokenAvailable(packetHandle, "RoadUserChargingConfigMessage", newPath) )
    {
      C2xRemoveToken(packetHandle, "RoadUserChargingConfigMessage", newPath);
    }
  }

  return result;
}

int GetRoadUserChargingConfigMessageCommon_DDateParams(LONG packetHandle, struct RoadUserChargingConfigMessageCommon_DDate value, char oldPath[])
{
  char newPath[300];
  int result;

  result = 0;

  snprintf(newPath, elcount(newPath), "%s.%s", oldPath, "year");
  value.year = C2xGetTokenInt(packetHandle, "RoadUserChargingConfigMessage", newPath);
  result = CheckLastError("RoadUserChargingConfigMessage", gkFuncRefGet, result);

  snprintf(newPath, elcount(newPath), "%s.%s", oldPath, "month");
  value.month = C2xGetTokenInt(packetHandle, "RoadUserChargingConfigMessage", newPath);
  result = CheckLastError("RoadUserChargingConfigMessage", gkFuncRefGet, result);

  snprintf(newPath, elcount(newPath), "%s.%s", oldPath, "day");
  value.day = C2xGetTokenInt(packetHandle, "RoadUserChargingConfigMessage", newPath);
  result = CheckLastError("RoadUserChargingConfigMessage", gkFuncRefGet, result);

  return result;
}

int SetRoadUserChargingConfigMessageCommon_DDateParams(LONG packetHandle, struct RoadUserChargingConfigMessageCommon_DDate value, char oldPath[])
{
  char newPath[300];
  int result;

  result = 0;

  snprintf(newPath, elcount(newPath), "%s.%s", oldPath, "year");
  C2xSetTokenInt(packetHandle, "RoadUserChargingConfigMessage", newPath, value.year);
  result = CheckLastError("RoadUserChargingConfigMessage", gkFuncRefGet, result);

  snprintf(newPath, elcount(newPath), "%s.%s", oldPath, "month");
  C2xSetTokenInt(packetHandle, "RoadUserChargingConfigMessage", newPath, value.month);
  result = CheckLastError("RoadUserChargingConfigMessage", gkFuncRefGet, result);

  snprintf(newPath, elcount(newPath), "%s.%s", oldPath, "day");
  C2xSetTokenInt(packetHandle, "RoadUserChargingConfigMessage", newPath, value.day);
  result = CheckLastError("RoadUserChargingConfigMessage", gkFuncRefGet, result);

  return result;
}

int GetRoadUserChargingConfigMessageRoadSafetyMessage_EventRecurrenceParams(LONG packetHandle, struct RoadUserChargingConfigMessageRoadSafetyMessage_EventRecurrence value, char oldPath[])
{
  char newPath[300];
  int result;

  result = 0;

  snprintf(newPath, elcount(newPath), "%s.%s", oldPath, "startTime");
  value.startTime.isValidFlag = C2xIsTokenAvailable(packetHandle, "RoadUserChargingConfigMessage", newPath);
  if(value.startTime.isValidFlag==1)
  {
    GetRoadUserChargingConfigMessageCommon_DTimeParams(packetHandle, value.startTime, newPath);
    result = CheckLastError("RoadUserChargingConfigMessage", gkFuncRefGet, result);
  }
  snprintf(newPath, elcount(newPath), "%s.%s", oldPath, "endTime");
  value.endTime.isValidFlag = C2xIsTokenAvailable(packetHandle, "RoadUserChargingConfigMessage", newPath);
  if(value.endTime.isValidFlag==1)
  {
    GetRoadUserChargingConfigMessageCommon_DTimeParams(packetHandle, value.endTime, newPath);
    result = CheckLastError("RoadUserChargingConfigMessage", gkFuncRefGet, result);
  }
  snprintf(newPath, elcount(newPath), "%s.%s", oldPath, "startDate");
  value.startDate.isValidFlag = C2xIsTokenAvailable(packetHandle, "RoadUserChargingConfigMessage", newPath);
  if(value.startDate.isValidFlag==1)
  {
    GetRoadUserChargingConfigMessageCommon_DDateParams(packetHandle, value.startDate, newPath);
    result = CheckLastError("RoadUserChargingConfigMessage", gkFuncRefGet, result);
  }
  snprintf(newPath, elcount(newPath), "%s.%s", oldPath, "endDate");
  value.endDate.isValidFlag = C2xIsTokenAvailable(packetHandle, "RoadUserChargingConfigMessage", newPath);
  if(value.endDate.isValidFlag==1)
  {
    GetRoadUserChargingConfigMessageCommon_DDateParams(packetHandle, value.endDate, newPath);
    result = CheckLastError("RoadUserChargingConfigMessage", gkFuncRefGet, result);
  }
  snprintf(newPath, elcount(newPath), "%s.%s", oldPath, "monday");
  value.monday = C2xGetTokenInt64(packetHandle, "RoadUserChargingConfigMessage", newPath);
  result = CheckLastError("RoadUserChargingConfigMessage", gkFuncRefGet, result);

  snprintf(newPath, elcount(newPath), "%s.%s", oldPath, "tuesday");
  value.tuesday = C2xGetTokenInt64(packetHandle, "RoadUserChargingConfigMessage", newPath);
  result = CheckLastError("RoadUserChargingConfigMessage", gkFuncRefGet, result);

  snprintf(newPath, elcount(newPath), "%s.%s", oldPath, "wednesday");
  value.wednesday = C2xGetTokenInt64(packetHandle, "RoadUserChargingConfigMessage", newPath);
  result = CheckLastError("RoadUserChargingConfigMessage", gkFuncRefGet, result);

  snprintf(newPath, elcount(newPath), "%s.%s", oldPath, "thursday");
  value.thursday = C2xGetTokenInt64(packetHandle, "RoadUserChargingConfigMessage", newPath);
  result = CheckLastError("RoadUserChargingConfigMessage", gkFuncRefGet, result);

  snprintf(newPath, elcount(newPath), "%s.%s", oldPath, "friday");
  value.friday = C2xGetTokenInt64(packetHandle, "RoadUserChargingConfigMessage", newPath);
  result = CheckLastError("RoadUserChargingConfigMessage", gkFuncRefGet, result);

  snprintf(newPath, elcount(newPath), "%s.%s", oldPath, "saturday");
  value.saturday = C2xGetTokenInt64(packetHandle, "RoadUserChargingConfigMessage", newPath);
  result = CheckLastError("RoadUserChargingConfigMessage", gkFuncRefGet, result);

  snprintf(newPath, elcount(newPath), "%s.%s", oldPath, "sunday");
  value.sunday = C2xGetTokenInt64(packetHandle, "RoadUserChargingConfigMessage", newPath);
  result = CheckLastError("RoadUserChargingConfigMessage", gkFuncRefGet, result);

  snprintf(newPath, elcount(newPath), "%s.%s", oldPath, "exclusion");
  value.exclusion.isValidFlag = C2xIsTokenAvailable(packetHandle, "RoadUserChargingConfigMessage", newPath);
  if(value.exclusion.isValidFlag==1)
  {
    value.exclusion.value = C2xGetTokenInt64(packetHandle, "RoadUserChargingConfigMessage", newPath);
    result = CheckLastError("RoadUserChargingConfigMessage", gkFuncRefGet, result);
  }
  return result;
}

int SetRoadUserChargingConfigMessageRoadSafetyMessage_EventRecurrenceParams(LONG packetHandle, struct RoadUserChargingConfigMessageRoadSafetyMessage_EventRecurrence value, char oldPath[])
{
  char newPath[300];
  int result;

  result = 0;

  snprintf(newPath, elcount(newPath), "%s.%s", oldPath, "startTime");
  if(value.startTime.isValidFlag==1)
  {
    SetRoadUserChargingConfigMessageCommon_DTimeParams(packetHandle, value.startTime, newPath);
    result = CheckLastError("RoadUserChargingConfigMessage", gkFuncRefGet, result);
  }
  else
  {
    if( C2xIsTokenAvailable(packetHandle, "RoadUserChargingConfigMessage", newPath) )
    {
      C2xRemoveToken(packetHandle, "RoadUserChargingConfigMessage", newPath);
    }
  }

  snprintf(newPath, elcount(newPath), "%s.%s", oldPath, "endTime");
  if(value.endTime.isValidFlag==1)
  {
    SetRoadUserChargingConfigMessageCommon_DTimeParams(packetHandle, value.endTime, newPath);
    result = CheckLastError("RoadUserChargingConfigMessage", gkFuncRefGet, result);
  }
  else
  {
    if( C2xIsTokenAvailable(packetHandle, "RoadUserChargingConfigMessage", newPath) )
    {
      C2xRemoveToken(packetHandle, "RoadUserChargingConfigMessage", newPath);
    }
  }

  snprintf(newPath, elcount(newPath), "%s.%s", oldPath, "startDate");
  if(value.startDate.isValidFlag==1)
  {
    SetRoadUserChargingConfigMessageCommon_DDateParams(packetHandle, value.startDate, newPath);
    result = CheckLastError("RoadUserChargingConfigMessage", gkFuncRefGet, result);
  }
  else
  {
    if( C2xIsTokenAvailable(packetHandle, "RoadUserChargingConfigMessage", newPath) )
    {
      C2xRemoveToken(packetHandle, "RoadUserChargingConfigMessage", newPath);
    }
  }

  snprintf(newPath, elcount(newPath), "%s.%s", oldPath, "endDate");
  if(value.endDate.isValidFlag==1)
  {
    SetRoadUserChargingConfigMessageCommon_DDateParams(packetHandle, value.endDate, newPath);
    result = CheckLastError("RoadUserChargingConfigMessage", gkFuncRefGet, result);
  }
  else
  {
    if( C2xIsTokenAvailable(packetHandle, "RoadUserChargingConfigMessage", newPath) )
    {
      C2xRemoveToken(packetHandle, "RoadUserChargingConfigMessage", newPath);
    }
  }

  snprintf(newPath, elcount(newPath), "%s.%s", oldPath, "monday");
  C2xSetTokenInt64(packetHandle, "RoadUserChargingConfigMessage", newPath, value.monday);
  result = CheckLastError("RoadUserChargingConfigMessage", gkFuncRefGet, result);

  snprintf(newPath, elcount(newPath), "%s.%s", oldPath, "tuesday");
  C2xSetTokenInt64(packetHandle, "RoadUserChargingConfigMessage", newPath, value.tuesday);
  result = CheckLastError("RoadUserChargingConfigMessage", gkFuncRefGet, result);

  snprintf(newPath, elcount(newPath), "%s.%s", oldPath, "wednesday");
  C2xSetTokenInt64(packetHandle, "RoadUserChargingConfigMessage", newPath, value.wednesday);
  result = CheckLastError("RoadUserChargingConfigMessage", gkFuncRefGet, result);

  snprintf(newPath, elcount(newPath), "%s.%s", oldPath, "thursday");
  C2xSetTokenInt64(packetHandle, "RoadUserChargingConfigMessage", newPath, value.thursday);
  result = CheckLastError("RoadUserChargingConfigMessage", gkFuncRefGet, result);

  snprintf(newPath, elcount(newPath), "%s.%s", oldPath, "friday");
  C2xSetTokenInt64(packetHandle, "RoadUserChargingConfigMessage", newPath, value.friday);
  result = CheckLastError("RoadUserChargingConfigMessage", gkFuncRefGet, result);

  snprintf(newPath, elcount(newPath), "%s.%s", oldPath, "saturday");
  C2xSetTokenInt64(packetHandle, "RoadUserChargingConfigMessage", newPath, value.saturday);
  result = CheckLastError("RoadUserChargingConfigMessage", gkFuncRefGet, result);

  snprintf(newPath, elcount(newPath), "%s.%s", oldPath, "sunday");
  C2xSetTokenInt64(packetHandle, "RoadUserChargingConfigMessage", newPath, value.sunday);
  result = CheckLastError("RoadUserChargingConfigMessage", gkFuncRefGet, result);

  snprintf(newPath, elcount(newPath), "%s.%s", oldPath, "exclusion");
  if(value.exclusion.isValidFlag==1)
  {
    C2xSetTokenInt64(packetHandle, "RoadUserChargingConfigMessage", newPath, value.exclusion.value);
    result = CheckLastError("RoadUserChargingConfigMessage", gkFuncRefGet, result);
  }
  else
  {
    if( C2xIsTokenAvailable(packetHandle, "RoadUserChargingConfigMessage", newPath) )
    {
      C2xRemoveToken(packetHandle, "RoadUserChargingConfigMessage", newPath);
    }
  }

  return result;
}

int GetRoadUserChargingConfigMessageChargingFees_chargingScheduleParams(LONG packetHandle, struct RoadUserChargingConfigMessageChargingFees_chargingSchedule value, char oldPath[])
{
  char newPath[300]; 
  int i;
  int result;

  result = 0;

  value.length = C2xGetTokenInt(packetHandle, "RoadUserChargingConfigMessage", oldPath);
  if((result = CheckLastError("RoadUserChargingConfigMessage", gkFuncRefGet, result))==0)
  {
    for(i=0; i<value.length; i++)
    {
      snprintf(newPath, elcount(newPath), "%s[%d]", oldPath, i);
      GetRoadUserChargingConfigMessageRoadSafetyMessage_EventRecurrenceParams(packetHandle, value.arrayValue[i], newPath);
      result = CheckLastError("RoadUserChargingConfigMessage", gkFuncRefGet, result);
    }
  }
  return result;
}

int SetRoadUserChargingConfigMessageChargingFees_chargingScheduleParams(LONG packetHandle, struct RoadUserChargingConfigMessageChargingFees_chargingSchedule value, char oldPath[])
{
  char newPath[300]; 
  int i;
  int result;

  result = 0;

  C2xRemoveToken(packetHandle, "RoadUserChargingConfigMessage", oldPath);
  for(i=0; i<value.length; i++)
  {
    snprintf(newPath, elcount(newPath), "%s[%d]", oldPath, i);
    SetRoadUserChargingConfigMessageRoadSafetyMessage_EventRecurrenceParams(packetHandle, value.arrayValue[i], newPath);
    result = CheckLastError("RoadUserChargingConfigMessage", gkFuncRefGet, result);
  }
  return result;
}

int GetRoadUserChargingConfigMessageEfcDataDictionary_PaymentFeeParams(LONG packetHandle, struct RoadUserChargingConfigMessageEfcDataDictionary_PaymentFee value, char oldPath[])
{
  char newPath[300];
  int result;

  result = 0;

  snprintf(newPath, elcount(newPath), "%s.%s", oldPath, "paymentFeeAmount");
  value.paymentFeeAmount = C2xGetTokenInt(packetHandle, "RoadUserChargingConfigMessage", newPath);
  result = CheckLastError("RoadUserChargingConfigMessage", gkFuncRefGet, result);

  snprintf(newPath, elcount(newPath), "%s.%s", oldPath, "paymentFeeUnit");
  value.paymentFeeUnit.stringLength = C2xGetTokenData(packetHandle, "RoadUserChargingConfigMessage", newPath, elcount(value.paymentFeeUnit.string), value.paymentFeeUnit.string);
  return result;
}

int SetRoadUserChargingConfigMessageEfcDataDictionary_PaymentFeeParams(LONG packetHandle, struct RoadUserChargingConfigMessageEfcDataDictionary_PaymentFee value, char oldPath[])
{
  char newPath[300];
  int result;

  result = 0;

  snprintf(newPath, elcount(newPath), "%s.%s", oldPath, "paymentFeeAmount");
  C2xSetTokenInt(packetHandle, "RoadUserChargingConfigMessage", newPath, value.paymentFeeAmount);
  result = CheckLastError("RoadUserChargingConfigMessage", gkFuncRefGet, result);

  snprintf(newPath, elcount(newPath), "%s.%s", oldPath, "paymentFeeUnit");
  C2xSetTokenData(packetHandle, "RoadUserChargingConfigMessage", newPath, value.paymentFeeUnit.stringLength, value.paymentFeeUnit.string);

  return result;
}

int GetRoadUserChargingConfigMessageTollAdvertisementMessage_OperatorDefinedParams(LONG packetHandle, struct RoadUserChargingConfigMessageTollAdvertisementMessage_OperatorDefined value, char oldPath[])
{
  char newPath[300];
  int result;

  result = 0;

  snprintf(newPath, elcount(newPath), "%s.%s", oldPath, "opDefCharge1");
  value.opDefCharge1.isValidFlag = C2xIsTokenAvailable(packetHandle, "RoadUserChargingConfigMessage", newPath);
  if(value.opDefCharge1.isValidFlag==1)
  {
    GetRoadUserChargingConfigMessageEfcDataDictionary_PaymentFeeParams(packetHandle, value.opDefCharge1, newPath);
    result = CheckLastError("RoadUserChargingConfigMessage", gkFuncRefGet, result);
  }
  snprintf(newPath, elcount(newPath), "%s.%s", oldPath, "opDefCharge2");
  value.opDefCharge2.isValidFlag = C2xIsTokenAvailable(packetHandle, "RoadUserChargingConfigMessage", newPath);
  if(value.opDefCharge2.isValidFlag==1)
  {
    GetRoadUserChargingConfigMessageEfcDataDictionary_PaymentFeeParams(packetHandle, value.opDefCharge2, newPath);
    result = CheckLastError("RoadUserChargingConfigMessage", gkFuncRefGet, result);
  }
  snprintf(newPath, elcount(newPath), "%s.%s", oldPath, "opDefCharge3");
  value.opDefCharge3.isValidFlag = C2xIsTokenAvailable(packetHandle, "RoadUserChargingConfigMessage", newPath);
  if(value.opDefCharge3.isValidFlag==1)
  {
    GetRoadUserChargingConfigMessageEfcDataDictionary_PaymentFeeParams(packetHandle, value.opDefCharge3, newPath);
    result = CheckLastError("RoadUserChargingConfigMessage", gkFuncRefGet, result);
  }
  snprintf(newPath, elcount(newPath), "%s.%s", oldPath, "opDefCharge4");
  value.opDefCharge4.isValidFlag = C2xIsTokenAvailable(packetHandle, "RoadUserChargingConfigMessage", newPath);
  if(value.opDefCharge4.isValidFlag==1)
  {
    GetRoadUserChargingConfigMessageEfcDataDictionary_PaymentFeeParams(packetHandle, value.opDefCharge4, newPath);
    result = CheckLastError("RoadUserChargingConfigMessage", gkFuncRefGet, result);
  }
  snprintf(newPath, elcount(newPath), "%s.%s", oldPath, "opDefCharge5");
  value.opDefCharge5.isValidFlag = C2xIsTokenAvailable(packetHandle, "RoadUserChargingConfigMessage", newPath);
  if(value.opDefCharge5.isValidFlag==1)
  {
    GetRoadUserChargingConfigMessageEfcDataDictionary_PaymentFeeParams(packetHandle, value.opDefCharge5, newPath);
    result = CheckLastError("RoadUserChargingConfigMessage", gkFuncRefGet, result);
  }
  snprintf(newPath, elcount(newPath), "%s.%s", oldPath, "opDefCharge6");
  value.opDefCharge6.isValidFlag = C2xIsTokenAvailable(packetHandle, "RoadUserChargingConfigMessage", newPath);
  if(value.opDefCharge6.isValidFlag==1)
  {
    GetRoadUserChargingConfigMessageEfcDataDictionary_PaymentFeeParams(packetHandle, value.opDefCharge6, newPath);
    result = CheckLastError("RoadUserChargingConfigMessage", gkFuncRefGet, result);
  }
  snprintf(newPath, elcount(newPath), "%s.%s", oldPath, "opDefCharge7");
  value.opDefCharge7.isValidFlag = C2xIsTokenAvailable(packetHandle, "RoadUserChargingConfigMessage", newPath);
  if(value.opDefCharge7.isValidFlag==1)
  {
    GetRoadUserChargingConfigMessageEfcDataDictionary_PaymentFeeParams(packetHandle, value.opDefCharge7, newPath);
    result = CheckLastError("RoadUserChargingConfigMessage", gkFuncRefGet, result);
  }
  snprintf(newPath, elcount(newPath), "%s.%s", oldPath, "opDefCharge8");
  value.opDefCharge8.isValidFlag = C2xIsTokenAvailable(packetHandle, "RoadUserChargingConfigMessage", newPath);
  if(value.opDefCharge8.isValidFlag==1)
  {
    GetRoadUserChargingConfigMessageEfcDataDictionary_PaymentFeeParams(packetHandle, value.opDefCharge8, newPath);
    result = CheckLastError("RoadUserChargingConfigMessage", gkFuncRefGet, result);
  }
  snprintf(newPath, elcount(newPath), "%s.%s", oldPath, "opDefCharge9");
  value.opDefCharge9.isValidFlag = C2xIsTokenAvailable(packetHandle, "RoadUserChargingConfigMessage", newPath);
  if(value.opDefCharge9.isValidFlag==1)
  {
    GetRoadUserChargingConfigMessageEfcDataDictionary_PaymentFeeParams(packetHandle, value.opDefCharge9, newPath);
    result = CheckLastError("RoadUserChargingConfigMessage", gkFuncRefGet, result);
  }
  snprintf(newPath, elcount(newPath), "%s.%s", oldPath, "opDefCharge10");
  value.opDefCharge10.isValidFlag = C2xIsTokenAvailable(packetHandle, "RoadUserChargingConfigMessage", newPath);
  if(value.opDefCharge10.isValidFlag==1)
  {
    GetRoadUserChargingConfigMessageEfcDataDictionary_PaymentFeeParams(packetHandle, value.opDefCharge10, newPath);
    result = CheckLastError("RoadUserChargingConfigMessage", gkFuncRefGet, result);
  }
  snprintf(newPath, elcount(newPath), "%s.%s", oldPath, "opDefCharge11");
  value.opDefCharge11.isValidFlag = C2xIsTokenAvailable(packetHandle, "RoadUserChargingConfigMessage", newPath);
  if(value.opDefCharge11.isValidFlag==1)
  {
    GetRoadUserChargingConfigMessageEfcDataDictionary_PaymentFeeParams(packetHandle, value.opDefCharge11, newPath);
    result = CheckLastError("RoadUserChargingConfigMessage", gkFuncRefGet, result);
  }
  snprintf(newPath, elcount(newPath), "%s.%s", oldPath, "opDefCharge12");
  value.opDefCharge12.isValidFlag = C2xIsTokenAvailable(packetHandle, "RoadUserChargingConfigMessage", newPath);
  if(value.opDefCharge12.isValidFlag==1)
  {
    GetRoadUserChargingConfigMessageEfcDataDictionary_PaymentFeeParams(packetHandle, value.opDefCharge12, newPath);
    result = CheckLastError("RoadUserChargingConfigMessage", gkFuncRefGet, result);
  }
  snprintf(newPath, elcount(newPath), "%s.%s", oldPath, "opDefCharge13");
  value.opDefCharge13.isValidFlag = C2xIsTokenAvailable(packetHandle, "RoadUserChargingConfigMessage", newPath);
  if(value.opDefCharge13.isValidFlag==1)
  {
    GetRoadUserChargingConfigMessageEfcDataDictionary_PaymentFeeParams(packetHandle, value.opDefCharge13, newPath);
    result = CheckLastError("RoadUserChargingConfigMessage", gkFuncRefGet, result);
  }
  snprintf(newPath, elcount(newPath), "%s.%s", oldPath, "opDefCharge14");
  value.opDefCharge14.isValidFlag = C2xIsTokenAvailable(packetHandle, "RoadUserChargingConfigMessage", newPath);
  if(value.opDefCharge14.isValidFlag==1)
  {
    GetRoadUserChargingConfigMessageEfcDataDictionary_PaymentFeeParams(packetHandle, value.opDefCharge14, newPath);
    result = CheckLastError("RoadUserChargingConfigMessage", gkFuncRefGet, result);
  }
  snprintf(newPath, elcount(newPath), "%s.%s", oldPath, "opDefCharge15");
  value.opDefCharge15.isValidFlag = C2xIsTokenAvailable(packetHandle, "RoadUserChargingConfigMessage", newPath);
  if(value.opDefCharge15.isValidFlag==1)
  {
    GetRoadUserChargingConfigMessageEfcDataDictionary_PaymentFeeParams(packetHandle, value.opDefCharge15, newPath);
    result = CheckLastError("RoadUserChargingConfigMessage", gkFuncRefGet, result);
  }
  snprintf(newPath, elcount(newPath), "%s.%s", oldPath, "opDefCharge16");
  value.opDefCharge16.isValidFlag = C2xIsTokenAvailable(packetHandle, "RoadUserChargingConfigMessage", newPath);
  if(value.opDefCharge16.isValidFlag==1)
  {
    GetRoadUserChargingConfigMessageEfcDataDictionary_PaymentFeeParams(packetHandle, value.opDefCharge16, newPath);
    result = CheckLastError("RoadUserChargingConfigMessage", gkFuncRefGet, result);
  }
  return result;
}

int SetRoadUserChargingConfigMessageTollAdvertisementMessage_OperatorDefinedParams(LONG packetHandle, struct RoadUserChargingConfigMessageTollAdvertisementMessage_OperatorDefined value, char oldPath[])
{
  char newPath[300];
  int result;

  result = 0;

  snprintf(newPath, elcount(newPath), "%s.%s", oldPath, "opDefCharge1");
  if(value.opDefCharge1.isValidFlag==1)
  {
    SetRoadUserChargingConfigMessageEfcDataDictionary_PaymentFeeParams(packetHandle, value.opDefCharge1, newPath);
    result = CheckLastError("RoadUserChargingConfigMessage", gkFuncRefGet, result);
  }
  else
  {
    if( C2xIsTokenAvailable(packetHandle, "RoadUserChargingConfigMessage", newPath) )
    {
      C2xRemoveToken(packetHandle, "RoadUserChargingConfigMessage", newPath);
    }
  }

  snprintf(newPath, elcount(newPath), "%s.%s", oldPath, "opDefCharge2");
  if(value.opDefCharge2.isValidFlag==1)
  {
    SetRoadUserChargingConfigMessageEfcDataDictionary_PaymentFeeParams(packetHandle, value.opDefCharge2, newPath);
    result = CheckLastError("RoadUserChargingConfigMessage", gkFuncRefGet, result);
  }
  else
  {
    if( C2xIsTokenAvailable(packetHandle, "RoadUserChargingConfigMessage", newPath) )
    {
      C2xRemoveToken(packetHandle, "RoadUserChargingConfigMessage", newPath);
    }
  }

  snprintf(newPath, elcount(newPath), "%s.%s", oldPath, "opDefCharge3");
  if(value.opDefCharge3.isValidFlag==1)
  {
    SetRoadUserChargingConfigMessageEfcDataDictionary_PaymentFeeParams(packetHandle, value.opDefCharge3, newPath);
    result = CheckLastError("RoadUserChargingConfigMessage", gkFuncRefGet, result);
  }
  else
  {
    if( C2xIsTokenAvailable(packetHandle, "RoadUserChargingConfigMessage", newPath) )
    {
      C2xRemoveToken(packetHandle, "RoadUserChargingConfigMessage", newPath);
    }
  }

  snprintf(newPath, elcount(newPath), "%s.%s", oldPath, "opDefCharge4");
  if(value.opDefCharge4.isValidFlag==1)
  {
    SetRoadUserChargingConfigMessageEfcDataDictionary_PaymentFeeParams(packetHandle, value.opDefCharge4, newPath);
    result = CheckLastError("RoadUserChargingConfigMessage", gkFuncRefGet, result);
  }
  else
  {
    if( C2xIsTokenAvailable(packetHandle, "RoadUserChargingConfigMessage", newPath) )
    {
      C2xRemoveToken(packetHandle, "RoadUserChargingConfigMessage", newPath);
    }
  }

  snprintf(newPath, elcount(newPath), "%s.%s", oldPath, "opDefCharge5");
  if(value.opDefCharge5.isValidFlag==1)
  {
    SetRoadUserChargingConfigMessageEfcDataDictionary_PaymentFeeParams(packetHandle, value.opDefCharge5, newPath);
    result = CheckLastError("RoadUserChargingConfigMessage", gkFuncRefGet, result);
  }
  else
  {
    if( C2xIsTokenAvailable(packetHandle, "RoadUserChargingConfigMessage", newPath) )
    {
      C2xRemoveToken(packetHandle, "RoadUserChargingConfigMessage", newPath);
    }
  }

  snprintf(newPath, elcount(newPath), "%s.%s", oldPath, "opDefCharge6");
  if(value.opDefCharge6.isValidFlag==1)
  {
    SetRoadUserChargingConfigMessageEfcDataDictionary_PaymentFeeParams(packetHandle, value.opDefCharge6, newPath);
    result = CheckLastError("RoadUserChargingConfigMessage", gkFuncRefGet, result);
  }
  else
  {
    if( C2xIsTokenAvailable(packetHandle, "RoadUserChargingConfigMessage", newPath) )
    {
      C2xRemoveToken(packetHandle, "RoadUserChargingConfigMessage", newPath);
    }
  }

  snprintf(newPath, elcount(newPath), "%s.%s", oldPath, "opDefCharge7");
  if(value.opDefCharge7.isValidFlag==1)
  {
    SetRoadUserChargingConfigMessageEfcDataDictionary_PaymentFeeParams(packetHandle, value.opDefCharge7, newPath);
    result = CheckLastError("RoadUserChargingConfigMessage", gkFuncRefGet, result);
  }
  else
  {
    if( C2xIsTokenAvailable(packetHandle, "RoadUserChargingConfigMessage", newPath) )
    {
      C2xRemoveToken(packetHandle, "RoadUserChargingConfigMessage", newPath);
    }
  }

  snprintf(newPath, elcount(newPath), "%s.%s", oldPath, "opDefCharge8");
  if(value.opDefCharge8.isValidFlag==1)
  {
    SetRoadUserChargingConfigMessageEfcDataDictionary_PaymentFeeParams(packetHandle, value.opDefCharge8, newPath);
    result = CheckLastError("RoadUserChargingConfigMessage", gkFuncRefGet, result);
  }
  else
  {
    if( C2xIsTokenAvailable(packetHandle, "RoadUserChargingConfigMessage", newPath) )
    {
      C2xRemoveToken(packetHandle, "RoadUserChargingConfigMessage", newPath);
    }
  }

  snprintf(newPath, elcount(newPath), "%s.%s", oldPath, "opDefCharge9");
  if(value.opDefCharge9.isValidFlag==1)
  {
    SetRoadUserChargingConfigMessageEfcDataDictionary_PaymentFeeParams(packetHandle, value.opDefCharge9, newPath);
    result = CheckLastError("RoadUserChargingConfigMessage", gkFuncRefGet, result);
  }
  else
  {
    if( C2xIsTokenAvailable(packetHandle, "RoadUserChargingConfigMessage", newPath) )
    {
      C2xRemoveToken(packetHandle, "RoadUserChargingConfigMessage", newPath);
    }
  }

  snprintf(newPath, elcount(newPath), "%s.%s", oldPath, "opDefCharge10");
  if(value.opDefCharge10.isValidFlag==1)
  {
    SetRoadUserChargingConfigMessageEfcDataDictionary_PaymentFeeParams(packetHandle, value.opDefCharge10, newPath);
    result = CheckLastError("RoadUserChargingConfigMessage", gkFuncRefGet, result);
  }
  else
  {
    if( C2xIsTokenAvailable(packetHandle, "RoadUserChargingConfigMessage", newPath) )
    {
      C2xRemoveToken(packetHandle, "RoadUserChargingConfigMessage", newPath);
    }
  }

  snprintf(newPath, elcount(newPath), "%s.%s", oldPath, "opDefCharge11");
  if(value.opDefCharge11.isValidFlag==1)
  {
    SetRoadUserChargingConfigMessageEfcDataDictionary_PaymentFeeParams(packetHandle, value.opDefCharge11, newPath);
    result = CheckLastError("RoadUserChargingConfigMessage", gkFuncRefGet, result);
  }
  else
  {
    if( C2xIsTokenAvailable(packetHandle, "RoadUserChargingConfigMessage", newPath) )
    {
      C2xRemoveToken(packetHandle, "RoadUserChargingConfigMessage", newPath);
    }
  }

  snprintf(newPath, elcount(newPath), "%s.%s", oldPath, "opDefCharge12");
  if(value.opDefCharge12.isValidFlag==1)
  {
    SetRoadUserChargingConfigMessageEfcDataDictionary_PaymentFeeParams(packetHandle, value.opDefCharge12, newPath);
    result = CheckLastError("RoadUserChargingConfigMessage", gkFuncRefGet, result);
  }
  else
  {
    if( C2xIsTokenAvailable(packetHandle, "RoadUserChargingConfigMessage", newPath) )
    {
      C2xRemoveToken(packetHandle, "RoadUserChargingConfigMessage", newPath);
    }
  }

  snprintf(newPath, elcount(newPath), "%s.%s", oldPath, "opDefCharge13");
  if(value.opDefCharge13.isValidFlag==1)
  {
    SetRoadUserChargingConfigMessageEfcDataDictionary_PaymentFeeParams(packetHandle, value.opDefCharge13, newPath);
    result = CheckLastError("RoadUserChargingConfigMessage", gkFuncRefGet, result);
  }
  else
  {
    if( C2xIsTokenAvailable(packetHandle, "RoadUserChargingConfigMessage", newPath) )
    {
      C2xRemoveToken(packetHandle, "RoadUserChargingConfigMessage", newPath);
    }
  }

  snprintf(newPath, elcount(newPath), "%s.%s", oldPath, "opDefCharge14");
  if(value.opDefCharge14.isValidFlag==1)
  {
    SetRoadUserChargingConfigMessageEfcDataDictionary_PaymentFeeParams(packetHandle, value.opDefCharge14, newPath);
    result = CheckLastError("RoadUserChargingConfigMessage", gkFuncRefGet, result);
  }
  else
  {
    if( C2xIsTokenAvailable(packetHandle, "RoadUserChargingConfigMessage", newPath) )
    {
      C2xRemoveToken(packetHandle, "RoadUserChargingConfigMessage", newPath);
    }
  }

  snprintf(newPath, elcount(newPath), "%s.%s", oldPath, "opDefCharge15");
  if(value.opDefCharge15.isValidFlag==1)
  {
    SetRoadUserChargingConfigMessageEfcDataDictionary_PaymentFeeParams(packetHandle, value.opDefCharge15, newPath);
    result = CheckLastError("RoadUserChargingConfigMessage", gkFuncRefGet, result);
  }
  else
  {
    if( C2xIsTokenAvailable(packetHandle, "RoadUserChargingConfigMessage", newPath) )
    {
      C2xRemoveToken(packetHandle, "RoadUserChargingConfigMessage", newPath);
    }
  }

  snprintf(newPath, elcount(newPath), "%s.%s", oldPath, "opDefCharge16");
  if(value.opDefCharge16.isValidFlag==1)
  {
    SetRoadUserChargingConfigMessageEfcDataDictionary_PaymentFeeParams(packetHandle, value.opDefCharge16, newPath);
    result = CheckLastError("RoadUserChargingConfigMessage", gkFuncRefGet, result);
  }
  else
  {
    if( C2xIsTokenAvailable(packetHandle, "RoadUserChargingConfigMessage", newPath) )
    {
      C2xRemoveToken(packetHandle, "RoadUserChargingConfigMessage", newPath);
    }
  }

  return result;
}

int GetRoadUserChargingConfigMessageTollAdvertisementMessage_SpecialChargesParams(LONG packetHandle, struct RoadUserChargingConfigMessageTollAdvertisementMessage_SpecialCharges value, char oldPath[])
{
  char newPath[300];
  int result;

  result = 0;

  snprintf(newPath, elcount(newPath), "%s.%s", oldPath, "hov2Charge");
  value.hov2Charge.isValidFlag = C2xIsTokenAvailable(packetHandle, "RoadUserChargingConfigMessage", newPath);
  if(value.hov2Charge.isValidFlag==1)
  {
    GetRoadUserChargingConfigMessageEfcDataDictionary_PaymentFeeParams(packetHandle, value.hov2Charge, newPath);
    result = CheckLastError("RoadUserChargingConfigMessage", gkFuncRefGet, result);
  }
  snprintf(newPath, elcount(newPath), "%s.%s", oldPath, "hov3Charge");
  value.hov3Charge.isValidFlag = C2xIsTokenAvailable(packetHandle, "RoadUserChargingConfigMessage", newPath);
  if(value.hov3Charge.isValidFlag==1)
  {
    GetRoadUserChargingConfigMessageEfcDataDictionary_PaymentFeeParams(packetHandle, value.hov3Charge, newPath);
    result = CheckLastError("RoadUserChargingConfigMessage", gkFuncRefGet, result);
  }
  snprintf(newPath, elcount(newPath), "%s.%s", oldPath, "hov4Charge");
  value.hov4Charge.isValidFlag = C2xIsTokenAvailable(packetHandle, "RoadUserChargingConfigMessage", newPath);
  if(value.hov4Charge.isValidFlag==1)
  {
    GetRoadUserChargingConfigMessageEfcDataDictionary_PaymentFeeParams(packetHandle, value.hov4Charge, newPath);
    result = CheckLastError("RoadUserChargingConfigMessage", gkFuncRefGet, result);
  }
  snprintf(newPath, elcount(newPath), "%s.%s", oldPath, "hov5PlusCharge");
  value.hov5PlusCharge.isValidFlag = C2xIsTokenAvailable(packetHandle, "RoadUserChargingConfigMessage", newPath);
  if(value.hov5PlusCharge.isValidFlag==1)
  {
    GetRoadUserChargingConfigMessageEfcDataDictionary_PaymentFeeParams(packetHandle, value.hov5PlusCharge, newPath);
    result = CheckLastError("RoadUserChargingConfigMessage", gkFuncRefGet, result);
  }
  snprintf(newPath, elcount(newPath), "%s.%s", oldPath, "cleanAirCharge");
  value.cleanAirCharge.isValidFlag = C2xIsTokenAvailable(packetHandle, "RoadUserChargingConfigMessage", newPath);
  if(value.cleanAirCharge.isValidFlag==1)
  {
    GetRoadUserChargingConfigMessageEfcDataDictionary_PaymentFeeParams(packetHandle, value.cleanAirCharge, newPath);
    result = CheckLastError("RoadUserChargingConfigMessage", gkFuncRefGet, result);
  }
  snprintf(newPath, elcount(newPath), "%s.%s", oldPath, "operatorDefined");
  value.operatorDefined.isValidFlag = C2xIsTokenAvailable(packetHandle, "RoadUserChargingConfigMessage", newPath);
  if(value.operatorDefined.isValidFlag==1)
  {
    GetRoadUserChargingConfigMessageTollAdvertisementMessage_OperatorDefinedParams(packetHandle, value.operatorDefined, newPath);
    result = CheckLastError("RoadUserChargingConfigMessage", gkFuncRefGet, result);
  }
  snprintf(newPath, elcount(newPath), "%s.%s", oldPath, "engineCharacteristics");
  value.engineCharacteristics.isValidFlag = C2xIsTokenAvailable(packetHandle, "RoadUserChargingConfigMessage", newPath);
  if(value.engineCharacteristics.isValidFlag==1)
  {
    value.engineCharacteristics.value = C2xGetTokenInt(packetHandle, "RoadUserChargingConfigMessage", newPath);
    result = CheckLastError("RoadUserChargingConfigMessage", gkFuncRefGet, result);
  }
  return result;
}

int SetRoadUserChargingConfigMessageTollAdvertisementMessage_SpecialChargesParams(LONG packetHandle, struct RoadUserChargingConfigMessageTollAdvertisementMessage_SpecialCharges value, char oldPath[])
{
  char newPath[300];
  int result;

  result = 0;

  snprintf(newPath, elcount(newPath), "%s.%s", oldPath, "hov2Charge");
  if(value.hov2Charge.isValidFlag==1)
  {
    SetRoadUserChargingConfigMessageEfcDataDictionary_PaymentFeeParams(packetHandle, value.hov2Charge, newPath);
    result = CheckLastError("RoadUserChargingConfigMessage", gkFuncRefGet, result);
  }
  else
  {
    if( C2xIsTokenAvailable(packetHandle, "RoadUserChargingConfigMessage", newPath) )
    {
      C2xRemoveToken(packetHandle, "RoadUserChargingConfigMessage", newPath);
    }
  }

  snprintf(newPath, elcount(newPath), "%s.%s", oldPath, "hov3Charge");
  if(value.hov3Charge.isValidFlag==1)
  {
    SetRoadUserChargingConfigMessageEfcDataDictionary_PaymentFeeParams(packetHandle, value.hov3Charge, newPath);
    result = CheckLastError("RoadUserChargingConfigMessage", gkFuncRefGet, result);
  }
  else
  {
    if( C2xIsTokenAvailable(packetHandle, "RoadUserChargingConfigMessage", newPath) )
    {
      C2xRemoveToken(packetHandle, "RoadUserChargingConfigMessage", newPath);
    }
  }

  snprintf(newPath, elcount(newPath), "%s.%s", oldPath, "hov4Charge");
  if(value.hov4Charge.isValidFlag==1)
  {
    SetRoadUserChargingConfigMessageEfcDataDictionary_PaymentFeeParams(packetHandle, value.hov4Charge, newPath);
    result = CheckLastError("RoadUserChargingConfigMessage", gkFuncRefGet, result);
  }
  else
  {
    if( C2xIsTokenAvailable(packetHandle, "RoadUserChargingConfigMessage", newPath) )
    {
      C2xRemoveToken(packetHandle, "RoadUserChargingConfigMessage", newPath);
    }
  }

  snprintf(newPath, elcount(newPath), "%s.%s", oldPath, "hov5PlusCharge");
  if(value.hov5PlusCharge.isValidFlag==1)
  {
    SetRoadUserChargingConfigMessageEfcDataDictionary_PaymentFeeParams(packetHandle, value.hov5PlusCharge, newPath);
    result = CheckLastError("RoadUserChargingConfigMessage", gkFuncRefGet, result);
  }
  else
  {
    if( C2xIsTokenAvailable(packetHandle, "RoadUserChargingConfigMessage", newPath) )
    {
      C2xRemoveToken(packetHandle, "RoadUserChargingConfigMessage", newPath);
    }
  }

  snprintf(newPath, elcount(newPath), "%s.%s", oldPath, "cleanAirCharge");
  if(value.cleanAirCharge.isValidFlag==1)
  {
    SetRoadUserChargingConfigMessageEfcDataDictionary_PaymentFeeParams(packetHandle, value.cleanAirCharge, newPath);
    result = CheckLastError("RoadUserChargingConfigMessage", gkFuncRefGet, result);
  }
  else
  {
    if( C2xIsTokenAvailable(packetHandle, "RoadUserChargingConfigMessage", newPath) )
    {
      C2xRemoveToken(packetHandle, "RoadUserChargingConfigMessage", newPath);
    }
  }

  snprintf(newPath, elcount(newPath), "%s.%s", oldPath, "operatorDefined");
  if(value.operatorDefined.isValidFlag==1)
  {
    SetRoadUserChargingConfigMessageTollAdvertisementMessage_OperatorDefinedParams(packetHandle, value.operatorDefined, newPath);
    result = CheckLastError("RoadUserChargingConfigMessage", gkFuncRefGet, result);
  }
  else
  {
    if( C2xIsTokenAvailable(packetHandle, "RoadUserChargingConfigMessage", newPath) )
    {
      C2xRemoveToken(packetHandle, "RoadUserChargingConfigMessage", newPath);
    }
  }

  snprintf(newPath, elcount(newPath), "%s.%s", oldPath, "engineCharacteristics");
  if(value.engineCharacteristics.isValidFlag==1)
  {
    C2xSetTokenInt(packetHandle, "RoadUserChargingConfigMessage", newPath, value.engineCharacteristics.value);
    result = CheckLastError("RoadUserChargingConfigMessage", gkFuncRefGet, result);
  }
  else
  {
    if( C2xIsTokenAvailable(packetHandle, "RoadUserChargingConfigMessage", newPath) )
    {
      C2xRemoveToken(packetHandle, "RoadUserChargingConfigMessage", newPath);
    }
  }

  return result;
}

int GetRoadUserChargingConfigMessageTollAdvertisementMessage_VehTypeChargesParams(LONG packetHandle, struct RoadUserChargingConfigMessageTollAdvertisementMessage_VehTypeCharges value, char oldPath[])
{
  char newPath[300];
  int result;

  result = 0;

  snprintf(newPath, elcount(newPath), "%s.%s", oldPath, "vehType");
  value.vehType = C2xGetTokenInt(packetHandle, "RoadUserChargingConfigMessage", newPath);
  result = CheckLastError("RoadUserChargingConfigMessage", gkFuncRefGet, result);

  snprintf(newPath, elcount(newPath), "%s.%s", oldPath, "charges");
  GetRoadUserChargingConfigMessageEfcDataDictionary_PaymentFeeParams(packetHandle, value.charges, newPath);
  result = CheckLastError("RoadUserChargingConfigMessage", gkFuncRefGet, result);

  snprintf(newPath, elcount(newPath), "%s.%s", oldPath, "specialCharges");
  value.specialCharges.isValidFlag = C2xIsTokenAvailable(packetHandle, "RoadUserChargingConfigMessage", newPath);
  if(value.specialCharges.isValidFlag==1)
  {
    GetRoadUserChargingConfigMessageTollAdvertisementMessage_SpecialChargesParams(packetHandle, value.specialCharges, newPath);
    result = CheckLastError("RoadUserChargingConfigMessage", gkFuncRefGet, result);
  }
  return result;
}

int SetRoadUserChargingConfigMessageTollAdvertisementMessage_VehTypeChargesParams(LONG packetHandle, struct RoadUserChargingConfigMessageTollAdvertisementMessage_VehTypeCharges value, char oldPath[])
{
  char newPath[300];
  int result;

  result = 0;

  snprintf(newPath, elcount(newPath), "%s.%s", oldPath, "vehType");
  if (value.vehType < 1)
  {
    C2xSetTokenInt(packetHandle, "RoadUserChargingConfigMessage", newPath, 1);
  }
  else if (value.vehType > 13)
  {
    C2xSetTokenInt(packetHandle, "RoadUserChargingConfigMessage", newPath, 13);
  }
  else
  {
    C2xSetTokenInt(packetHandle, "RoadUserChargingConfigMessage", newPath, value.vehType);
  }
  result = CheckLastError("RoadUserChargingConfigMessage", gkFuncRefGet, result);

  snprintf(newPath, elcount(newPath), "%s.%s", oldPath, "charges");
  SetRoadUserChargingConfigMessageEfcDataDictionary_PaymentFeeParams(packetHandle, value.charges, newPath);
  result = CheckLastError("RoadUserChargingConfigMessage", gkFuncRefGet, result);

  snprintf(newPath, elcount(newPath), "%s.%s", oldPath, "specialCharges");
  if(value.specialCharges.isValidFlag==1)
  {
    SetRoadUserChargingConfigMessageTollAdvertisementMessage_SpecialChargesParams(packetHandle, value.specialCharges, newPath);
    result = CheckLastError("RoadUserChargingConfigMessage", gkFuncRefGet, result);
  }
  else
  {
    if( C2xIsTokenAvailable(packetHandle, "RoadUserChargingConfigMessage", newPath) )
    {
      C2xRemoveToken(packetHandle, "RoadUserChargingConfigMessage", newPath);
    }
  }

  return result;
}

int GetRoadUserChargingConfigMessageTollAdvertisementMessage_VehTypeChargesTableParams(LONG packetHandle, struct RoadUserChargingConfigMessageTollAdvertisementMessage_VehTypeChargesTable value, char oldPath[])
{
  char newPath[300]; 
  int i;
  int result;

  result = 0;

  value.length = C2xGetTokenInt(packetHandle, "RoadUserChargingConfigMessage", oldPath);
  if((result = CheckLastError("RoadUserChargingConfigMessage", gkFuncRefGet, result))==0)
  {
    for(i=0; i<value.length; i++)
    {
      snprintf(newPath, elcount(newPath), "%s[%d]", oldPath, i);
      GetRoadUserChargingConfigMessageTollAdvertisementMessage_VehTypeChargesParams(packetHandle, value.arrayValue[i], newPath);
      result = CheckLastError("RoadUserChargingConfigMessage", gkFuncRefGet, result);
    }
  }
  return result;
}

int SetRoadUserChargingConfigMessageTollAdvertisementMessage_VehTypeChargesTableParams(LONG packetHandle, struct RoadUserChargingConfigMessageTollAdvertisementMessage_VehTypeChargesTable value, char oldPath[])
{
  char newPath[300]; 
  int i;
  int result;

  result = 0;

  C2xRemoveToken(packetHandle, "RoadUserChargingConfigMessage", oldPath);
  for(i=0; i<value.length; i++)
  {
    snprintf(newPath, elcount(newPath), "%s[%d]", oldPath, i);
    SetRoadUserChargingConfigMessageTollAdvertisementMessage_VehTypeChargesParams(packetHandle, value.arrayValue[i], newPath);
    result = CheckLastError("RoadUserChargingConfigMessage", gkFuncRefGet, result);
  }
  return result;
}

int GetRoadUserChargingConfigMessageTollAdvertisementMessage_AxlesChargesParams(LONG packetHandle, struct RoadUserChargingConfigMessageTollAdvertisementMessage_AxlesCharges value, char oldPath[])
{
  char newPath[300];
  int result;

  result = 0;

  snprintf(newPath, elcount(newPath), "%s.%s", oldPath, "axlesLimit");
  value.axlesLimit = C2xGetTokenInt(packetHandle, "RoadUserChargingConfigMessage", newPath);
  result = CheckLastError("RoadUserChargingConfigMessage", gkFuncRefGet, result);

  snprintf(newPath, elcount(newPath), "%s.%s", oldPath, "axlesCharge");
  GetRoadUserChargingConfigMessageEfcDataDictionary_PaymentFeeParams(packetHandle, value.axlesCharge, newPath);
  result = CheckLastError("RoadUserChargingConfigMessage", gkFuncRefGet, result);

  return result;
}

int SetRoadUserChargingConfigMessageTollAdvertisementMessage_AxlesChargesParams(LONG packetHandle, struct RoadUserChargingConfigMessageTollAdvertisementMessage_AxlesCharges value, char oldPath[])
{
  char newPath[300];
  int result;

  result = 0;

  snprintf(newPath, elcount(newPath), "%s.%s", oldPath, "axlesLimit");
  if (value.axlesLimit < 2)
  {
    C2xSetTokenInt(packetHandle, "RoadUserChargingConfigMessage", newPath, 2);
  }
  else if (value.axlesLimit > 10)
  {
    C2xSetTokenInt(packetHandle, "RoadUserChargingConfigMessage", newPath, 10);
  }
  else
  {
    C2xSetTokenInt(packetHandle, "RoadUserChargingConfigMessage", newPath, value.axlesLimit);
  }
  result = CheckLastError("RoadUserChargingConfigMessage", gkFuncRefGet, result);

  snprintf(newPath, elcount(newPath), "%s.%s", oldPath, "axlesCharge");
  SetRoadUserChargingConfigMessageEfcDataDictionary_PaymentFeeParams(packetHandle, value.axlesCharge, newPath);
  result = CheckLastError("RoadUserChargingConfigMessage", gkFuncRefGet, result);

  return result;
}

int GetRoadUserChargingConfigMessageTollAdvertisementMessage_AxlesChargesTableParams(LONG packetHandle, struct RoadUserChargingConfigMessageTollAdvertisementMessage_AxlesChargesTable value, char oldPath[])
{
  char newPath[300]; 
  int i;
  int result;

  result = 0;

  value.length = C2xGetTokenInt(packetHandle, "RoadUserChargingConfigMessage", oldPath);
  if((result = CheckLastError("RoadUserChargingConfigMessage", gkFuncRefGet, result))==0)
  {
    for(i=0; i<value.length; i++)
    {
      snprintf(newPath, elcount(newPath), "%s[%d]", oldPath, i);
      GetRoadUserChargingConfigMessageTollAdvertisementMessage_AxlesChargesParams(packetHandle, value.arrayValue[i], newPath);
      result = CheckLastError("RoadUserChargingConfigMessage", gkFuncRefGet, result);
    }
  }
  return result;
}

int SetRoadUserChargingConfigMessageTollAdvertisementMessage_AxlesChargesTableParams(LONG packetHandle, struct RoadUserChargingConfigMessageTollAdvertisementMessage_AxlesChargesTable value, char oldPath[])
{
  char newPath[300]; 
  int i;
  int result;

  result = 0;

  C2xRemoveToken(packetHandle, "RoadUserChargingConfigMessage", oldPath);
  for(i=0; i<value.length; i++)
  {
    snprintf(newPath, elcount(newPath), "%s[%d]", oldPath, i);
    SetRoadUserChargingConfigMessageTollAdvertisementMessage_AxlesChargesParams(packetHandle, value.arrayValue[i], newPath);
    result = CheckLastError("RoadUserChargingConfigMessage", gkFuncRefGet, result);
  }
  return result;
}

int GetRoadUserChargingConfigMessageTollAdvertisementMessage_TotalWeightChargesParams(LONG packetHandle, struct RoadUserChargingConfigMessageTollAdvertisementMessage_TotalWeightCharges value, char oldPath[])
{
  char newPath[300];
  int result;

  result = 0;

  snprintf(newPath, elcount(newPath), "%s.%s", oldPath, "weightLimit");
  value.weightLimit = C2xGetTokenInt(packetHandle, "RoadUserChargingConfigMessage", newPath);
  result = CheckLastError("RoadUserChargingConfigMessage", gkFuncRefGet, result);

  snprintf(newPath, elcount(newPath), "%s.%s", oldPath, "weightLimitUnits");
  value.weightLimitUnits = C2xGetTokenInt(packetHandle, "RoadUserChargingConfigMessage", newPath);
  result = CheckLastError("RoadUserChargingConfigMessage", gkFuncRefGet, result);

  snprintf(newPath, elcount(newPath), "%s.%s", oldPath, "weightCharge");
  GetRoadUserChargingConfigMessageEfcDataDictionary_PaymentFeeParams(packetHandle, value.weightCharge, newPath);
  result = CheckLastError("RoadUserChargingConfigMessage", gkFuncRefGet, result);

  return result;
}

int SetRoadUserChargingConfigMessageTollAdvertisementMessage_TotalWeightChargesParams(LONG packetHandle, struct RoadUserChargingConfigMessageTollAdvertisementMessage_TotalWeightCharges value, char oldPath[])
{
  char newPath[300];
  int result;

  result = 0;

  snprintf(newPath, elcount(newPath), "%s.%s", oldPath, "weightLimit");
  C2xSetTokenInt(packetHandle, "RoadUserChargingConfigMessage", newPath, value.weightLimit);
  result = CheckLastError("RoadUserChargingConfigMessage", gkFuncRefGet, result);

  snprintf(newPath, elcount(newPath), "%s.%s", oldPath, "weightLimitUnits");
  C2xSetTokenInt(packetHandle, "RoadUserChargingConfigMessage", newPath, value.weightLimitUnits);
  result = CheckLastError("RoadUserChargingConfigMessage", gkFuncRefGet, result);

  snprintf(newPath, elcount(newPath), "%s.%s", oldPath, "weightCharge");
  SetRoadUserChargingConfigMessageEfcDataDictionary_PaymentFeeParams(packetHandle, value.weightCharge, newPath);
  result = CheckLastError("RoadUserChargingConfigMessage", gkFuncRefGet, result);

  return result;
}

int GetRoadUserChargingConfigMessageTollAdvertisementMessage_PerAxleWeightChargesParams(LONG packetHandle, struct RoadUserChargingConfigMessageTollAdvertisementMessage_PerAxleWeightCharges value, char oldPath[])
{
  char newPath[300];
  int result;

  result = 0;

  snprintf(newPath, elcount(newPath), "%s.%s", oldPath, "totalWeightLimit");
  value.totalWeightLimit = C2xGetTokenInt(packetHandle, "RoadUserChargingConfigMessage", newPath);
  result = CheckLastError("RoadUserChargingConfigMessage", gkFuncRefGet, result);

  snprintf(newPath, elcount(newPath), "%s.%s", oldPath, "maxLadenWeightOnAxle");
  value.maxLadenWeightOnAxle = C2xGetTokenInt(packetHandle, "RoadUserChargingConfigMessage", newPath);
  result = CheckLastError("RoadUserChargingConfigMessage", gkFuncRefGet, result);

  snprintf(newPath, elcount(newPath), "%s.%s", oldPath, "weightLimitUnits");
  value.weightLimitUnits = C2xGetTokenInt(packetHandle, "RoadUserChargingConfigMessage", newPath);
  result = CheckLastError("RoadUserChargingConfigMessage", gkFuncRefGet, result);

  snprintf(newPath, elcount(newPath), "%s.%s", oldPath, "axleWeightCharge");
  GetRoadUserChargingConfigMessageEfcDataDictionary_PaymentFeeParams(packetHandle, value.axleWeightCharge, newPath);
  result = CheckLastError("RoadUserChargingConfigMessage", gkFuncRefGet, result);

  return result;
}

int SetRoadUserChargingConfigMessageTollAdvertisementMessage_PerAxleWeightChargesParams(LONG packetHandle, struct RoadUserChargingConfigMessageTollAdvertisementMessage_PerAxleWeightCharges value, char oldPath[])
{
  char newPath[300];
  int result;

  result = 0;

  snprintf(newPath, elcount(newPath), "%s.%s", oldPath, "totalWeightLimit");
  C2xSetTokenInt(packetHandle, "RoadUserChargingConfigMessage", newPath, value.totalWeightLimit);
  result = CheckLastError("RoadUserChargingConfigMessage", gkFuncRefGet, result);

  snprintf(newPath, elcount(newPath), "%s.%s", oldPath, "maxLadenWeightOnAxle");
  C2xSetTokenInt(packetHandle, "RoadUserChargingConfigMessage", newPath, value.maxLadenWeightOnAxle);
  result = CheckLastError("RoadUserChargingConfigMessage", gkFuncRefGet, result);

  snprintf(newPath, elcount(newPath), "%s.%s", oldPath, "weightLimitUnits");
  C2xSetTokenInt(packetHandle, "RoadUserChargingConfigMessage", newPath, value.weightLimitUnits);
  result = CheckLastError("RoadUserChargingConfigMessage", gkFuncRefGet, result);

  snprintf(newPath, elcount(newPath), "%s.%s", oldPath, "axleWeightCharge");
  SetRoadUserChargingConfigMessageEfcDataDictionary_PaymentFeeParams(packetHandle, value.axleWeightCharge, newPath);
  result = CheckLastError("RoadUserChargingConfigMessage", gkFuncRefGet, result);

  return result;
}

int GetRoadUserChargingConfigMessageTollAdvertisementMessage_WeightChargesParams(LONG packetHandle, struct RoadUserChargingConfigMessageTollAdvertisementMessage_WeightCharges value, char oldPath[])
{
  char newPath[300];
  int result;

  result = 0;

  value.choice = C2xGetTokenInt(packetHandle, "RoadUserChargingConfigMessage", oldPath);

  switch(value.choice)
  {
    case 0:
    {
      snprintf(newPath, elcount(newPath), "%s.%s", oldPath, "totalWeightCharges");
      GetRoadUserChargingConfigMessageTollAdvertisementMessage_TotalWeightChargesParams(packetHandle, value.totalWeightCharges, newPath);
      result = CheckLastError("RoadUserChargingConfigMessage", gkFuncRefGet, result);
    }
    break;
    case 1:
    {
      snprintf(newPath, elcount(newPath), "%s.%s", oldPath, "perAxleWeightCharges");
      GetRoadUserChargingConfigMessageTollAdvertisementMessage_PerAxleWeightChargesParams(packetHandle, value.perAxleWeightCharges, newPath);
      result = CheckLastError("RoadUserChargingConfigMessage", gkFuncRefGet, result);
    }
    break;
  }
  return result;
}

int SetRoadUserChargingConfigMessageTollAdvertisementMessage_WeightChargesParams(LONG packetHandle, struct RoadUserChargingConfigMessageTollAdvertisementMessage_WeightCharges value, char oldPath[])
{
  char newPath[300];
  int result;

  result = 0;

  switch(value.choice)
  {
    case 0:
    {
      snprintf(newPath, elcount(newPath), "%s.%s", oldPath, "totalWeightCharges");
      SetRoadUserChargingConfigMessageTollAdvertisementMessage_TotalWeightChargesParams(packetHandle, value.totalWeightCharges, newPath);
      result = CheckLastError("RoadUserChargingConfigMessage", gkFuncRefGet, result);
    }
    break;
    case 1:
    {
      snprintf(newPath, elcount(newPath), "%s.%s", oldPath, "perAxleWeightCharges");
      SetRoadUserChargingConfigMessageTollAdvertisementMessage_PerAxleWeightChargesParams(packetHandle, value.perAxleWeightCharges, newPath);
      result = CheckLastError("RoadUserChargingConfigMessage", gkFuncRefGet, result);
    }
    break;
  }
  return result;
}

int GetRoadUserChargingConfigMessageTollAdvertisementMessage_WeightChargesTableParams(LONG packetHandle, struct RoadUserChargingConfigMessageTollAdvertisementMessage_WeightChargesTable value, char oldPath[])
{
  char newPath[300]; 
  int i;
  int result;

  result = 0;

  value.length = C2xGetTokenInt(packetHandle, "RoadUserChargingConfigMessage", oldPath);
  if((result = CheckLastError("RoadUserChargingConfigMessage", gkFuncRefGet, result))==0)
  {
    for(i=0; i<value.length; i++)
    {
      snprintf(newPath, elcount(newPath), "%s[%d]", oldPath, i);
      GetRoadUserChargingConfigMessageTollAdvertisementMessage_WeightChargesParams(packetHandle, value.arrayValue[i], newPath);
      result = CheckLastError("RoadUserChargingConfigMessage", gkFuncRefGet, result);
    }
  }
  return result;
}

int SetRoadUserChargingConfigMessageTollAdvertisementMessage_WeightChargesTableParams(LONG packetHandle, struct RoadUserChargingConfigMessageTollAdvertisementMessage_WeightChargesTable value, char oldPath[])
{
  char newPath[300]; 
  int i;
  int result;

  result = 0;

  C2xRemoveToken(packetHandle, "RoadUserChargingConfigMessage", oldPath);
  for(i=0; i<value.length; i++)
  {
    snprintf(newPath, elcount(newPath), "%s[%d]", oldPath, i);
    SetRoadUserChargingConfigMessageTollAdvertisementMessage_WeightChargesParams(packetHandle, value.arrayValue[i], newPath);
    result = CheckLastError("RoadUserChargingConfigMessage", gkFuncRefGet, result);
  }
  return result;
}

int GetRoadUserChargingConfigMessageTollAdvertisementMessage_ChargesTableParams(LONG packetHandle, struct RoadUserChargingConfigMessageTollAdvertisementMessage_ChargesTable value, char oldPath[])
{
  char newPath[300];
  int result;

  result = 0;

  value.choice = C2xGetTokenInt(packetHandle, "RoadUserChargingConfigMessage", oldPath);

  switch(value.choice)
  {
    case 0:
    {
      snprintf(newPath, elcount(newPath), "%s.%s", oldPath, "vehTypeBased");
      GetRoadUserChargingConfigMessageTollAdvertisementMessage_VehTypeChargesTableParams(packetHandle, value.vehTypeBased, newPath);
      result = CheckLastError("RoadUserChargingConfigMessage", gkFuncRefGet, result);
    }
    break;
    case 1:
    {
      snprintf(newPath, elcount(newPath), "%s.%s", oldPath, "numAxlesBased");
      GetRoadUserChargingConfigMessageTollAdvertisementMessage_AxlesChargesTableParams(packetHandle, value.numAxlesBased, newPath);
      result = CheckLastError("RoadUserChargingConfigMessage", gkFuncRefGet, result);
    }
    break;
    case 2:
    {
      snprintf(newPath, elcount(newPath), "%s.%s", oldPath, "weightBased");
      GetRoadUserChargingConfigMessageTollAdvertisementMessage_WeightChargesTableParams(packetHandle, value.weightBased, newPath);
      result = CheckLastError("RoadUserChargingConfigMessage", gkFuncRefGet, result);
    }
    break;
  }
  return result;
}

int SetRoadUserChargingConfigMessageTollAdvertisementMessage_ChargesTableParams(LONG packetHandle, struct RoadUserChargingConfigMessageTollAdvertisementMessage_ChargesTable value, char oldPath[])
{
  char newPath[300];
  int result;

  result = 0;

  switch(value.choice)
  {
    case 0:
    {
      snprintf(newPath, elcount(newPath), "%s.%s", oldPath, "vehTypeBased");
      SetRoadUserChargingConfigMessageTollAdvertisementMessage_VehTypeChargesTableParams(packetHandle, value.vehTypeBased, newPath);
      result = CheckLastError("RoadUserChargingConfigMessage", gkFuncRefGet, result);
    }
    break;
    case 1:
    {
      snprintf(newPath, elcount(newPath), "%s.%s", oldPath, "numAxlesBased");
      SetRoadUserChargingConfigMessageTollAdvertisementMessage_AxlesChargesTableParams(packetHandle, value.numAxlesBased, newPath);
      result = CheckLastError("RoadUserChargingConfigMessage", gkFuncRefGet, result);
    }
    break;
    case 2:
    {
      snprintf(newPath, elcount(newPath), "%s.%s", oldPath, "weightBased");
      SetRoadUserChargingConfigMessageTollAdvertisementMessage_WeightChargesTableParams(packetHandle, value.weightBased, newPath);
      result = CheckLastError("RoadUserChargingConfigMessage", gkFuncRefGet, result);
    }
    break;
  }
  return result;
}

int GetRoadUserChargingConfigMessageChargingUnitsParams(LONG packetHandle, struct RoadUserChargingConfigMessageChargingUnits value, char oldPath[])
{
  char newPath[300];
  int result;

  result = 0;

  value.choice = C2xGetTokenInt(packetHandle, "RoadUserChargingConfigMessage", oldPath);

  switch(value.choice)
  {
    case 0:
    {
      snprintf(newPath, elcount(newPath), "%s.%s", oldPath, "driven");
      value.driven = C2xGetTokenInt(packetHandle, "RoadUserChargingConfigMessage", newPath);
      result = CheckLastError("RoadUserChargingConfigMessage", gkFuncRefGet, result);
    }
    break;
    case 1:
    {
      snprintf(newPath, elcount(newPath), "%s.%s", oldPath, "parked");
      value.parked = C2xGetTokenInt(packetHandle, "RoadUserChargingConfigMessage", newPath);
      result = CheckLastError("RoadUserChargingConfigMessage", gkFuncRefGet, result);
    }
    break;
  }
  return result;
}

int SetRoadUserChargingConfigMessageChargingUnitsParams(LONG packetHandle, struct RoadUserChargingConfigMessageChargingUnits value, char oldPath[])
{
  char newPath[300];
  int result;

  result = 0;

  switch(value.choice)
  {
    case 0:
    {
      snprintf(newPath, elcount(newPath), "%s.%s", oldPath, "driven");
      C2xSetTokenInt(packetHandle, "RoadUserChargingConfigMessage", newPath, value.driven);
      result = CheckLastError("RoadUserChargingConfigMessage", gkFuncRefGet, result);
    }
    break;
    case 1:
    {
      snprintf(newPath, elcount(newPath), "%s.%s", oldPath, "parked");
      C2xSetTokenInt(packetHandle, "RoadUserChargingConfigMessage", newPath, value.parked);
      result = CheckLastError("RoadUserChargingConfigMessage", gkFuncRefGet, result);
    }
    break;
  }
  return result;
}

int GetRoadUserChargingConfigMessageChargingFeesParams(LONG packetHandle, struct RoadUserChargingConfigMessageChargingFees value, char oldPath[])
{
  char newPath[300];
  int result;

  result = 0;

  snprintf(newPath, elcount(newPath), "%s.%s", oldPath, "chargingSchedule");
  value.chargingSchedule.isValidFlag = C2xIsTokenAvailable(packetHandle, "RoadUserChargingConfigMessage", newPath);
  if(value.chargingSchedule.isValidFlag==1)
  {
    GetRoadUserChargingConfigMessageChargingFees_chargingScheduleParams(packetHandle, value.chargingSchedule, newPath);
    result = CheckLastError("RoadUserChargingConfigMessage", gkFuncRefGet, result);
  }
  snprintf(newPath, elcount(newPath), "%s.%s", oldPath, "chargesTable");
  GetRoadUserChargingConfigMessageTollAdvertisementMessage_ChargesTableParams(packetHandle, value.chargesTable, newPath);
  result = CheckLastError("RoadUserChargingConfigMessage", gkFuncRefGet, result);

  snprintf(newPath, elcount(newPath), "%s.%s", oldPath, "chargingUnits");
  GetRoadUserChargingConfigMessageChargingUnitsParams(packetHandle, value.chargingUnits, newPath);
  result = CheckLastError("RoadUserChargingConfigMessage", gkFuncRefGet, result);

  return result;
}

int SetRoadUserChargingConfigMessageChargingFeesParams(LONG packetHandle, struct RoadUserChargingConfigMessageChargingFees value, char oldPath[])
{
  char newPath[300];
  int result;

  result = 0;

  snprintf(newPath, elcount(newPath), "%s.%s", oldPath, "chargingSchedule");
  if(value.chargingSchedule.isValidFlag==1)
  {
    SetRoadUserChargingConfigMessageChargingFees_chargingScheduleParams(packetHandle, value.chargingSchedule, newPath);
    result = CheckLastError("RoadUserChargingConfigMessage", gkFuncRefGet, result);
  }
  else
  {
    if( C2xIsTokenAvailable(packetHandle, "RoadUserChargingConfigMessage", newPath) )
    {
      C2xRemoveToken(packetHandle, "RoadUserChargingConfigMessage", newPath);
    }
  }

  snprintf(newPath, elcount(newPath), "%s.%s", oldPath, "chargesTable");
  SetRoadUserChargingConfigMessageTollAdvertisementMessage_ChargesTableParams(packetHandle, value.chargesTable, newPath);
  result = CheckLastError("RoadUserChargingConfigMessage", gkFuncRefGet, result);

  snprintf(newPath, elcount(newPath), "%s.%s", oldPath, "chargingUnits");
  SetRoadUserChargingConfigMessageChargingUnitsParams(packetHandle, value.chargingUnits, newPath);
  result = CheckLastError("RoadUserChargingConfigMessage", gkFuncRefGet, result);

  return result;
}

int GetRoadUserChargingConfigMessagePrimaryRegionStateParams(LONG packetHandle, struct RoadUserChargingConfigMessagePrimaryRegionState value, char oldPath[])
{
  char newPath[300];
  int result;

  result = 0;

  snprintf(newPath, elcount(newPath), "%s.%s", oldPath, "usCanMexState");
  value.usCanMexState.stringLength = C2xGetTokenData(packetHandle, "RoadUserChargingConfigMessage", newPath, elcount(value.usCanMexState.string), value.usCanMexState.string);
  result = CheckLastError("RoadUserChargingConfigMessage", gkFuncRefGet, result);
  snprintf(newPath, elcount(newPath), "%s.%s", oldPath, "chargingFees");
  value.chargingFees.isValidFlag = C2xIsTokenAvailable(packetHandle, "RoadUserChargingConfigMessage", newPath);
  if(value.chargingFees.isValidFlag==1)
  {
    GetRoadUserChargingConfigMessageChargingFeesParams(packetHandle, value.chargingFees, newPath);
    result = CheckLastError("RoadUserChargingConfigMessage", gkFuncRefGet, result);
  }
  return result;
}

int SetRoadUserChargingConfigMessagePrimaryRegionStateParams(LONG packetHandle, struct RoadUserChargingConfigMessagePrimaryRegionState value, char oldPath[])
{
  char newPath[300];
  int result;

  result = 0;

  snprintf(newPath, elcount(newPath), "%s.%s", oldPath, "usCanMexState");
  C2xSetTokenData(packetHandle, "RoadUserChargingConfigMessage", newPath, value.usCanMexState.stringLength, value.usCanMexState.string);
  result = CheckLastError("RoadUserChargingConfigMessage", gkFuncRefGet, result);

  snprintf(newPath, elcount(newPath), "%s.%s", oldPath, "chargingFees");
  if(value.chargingFees.isValidFlag==1)
  {
    SetRoadUserChargingConfigMessageChargingFeesParams(packetHandle, value.chargingFees, newPath);
    result = CheckLastError("RoadUserChargingConfigMessage", gkFuncRefGet, result);
  }
  else
  {
    if( C2xIsTokenAvailable(packetHandle, "RoadUserChargingConfigMessage", newPath) )
    {
      C2xRemoveToken(packetHandle, "RoadUserChargingConfigMessage", newPath);
    }
  }

  return result;
}

int GetRoadUserChargingConfigMessagePrimaryRegionChargingInfo_chargingPrimaryRegionParams(LONG packetHandle, struct RoadUserChargingConfigMessagePrimaryRegionChargingInfo_chargingPrimaryRegion value, char oldPath[])
{
  char newPath[300];
  int result;

  result = 0;

  value.choice = C2xGetTokenInt(packetHandle, "RoadUserChargingConfigMessage", oldPath);

  switch(value.choice)
  {
    case 0:
    {
      snprintf(newPath, elcount(newPath), "%s.%s", oldPath, "state");
      GetRoadUserChargingConfigMessagePrimaryRegionStateParams(packetHandle, value.state, newPath);
      result = CheckLastError("RoadUserChargingConfigMessage", gkFuncRefGet, result);
    }
    break;
  }
  return result;
}

int SetRoadUserChargingConfigMessagePrimaryRegionChargingInfo_chargingPrimaryRegionParams(LONG packetHandle, struct RoadUserChargingConfigMessagePrimaryRegionChargingInfo_chargingPrimaryRegion value, char oldPath[])
{
  char newPath[300];
  int result;

  result = 0;

  switch(value.choice)
  {
    case 0:
    {
      snprintf(newPath, elcount(newPath), "%s.%s", oldPath, "state");
      SetRoadUserChargingConfigMessagePrimaryRegionStateParams(packetHandle, value.state, newPath);
      result = CheckLastError("RoadUserChargingConfigMessage", gkFuncRefGet, result);
    }
    break;
  }
  return result;
}

int GetRoadUserChargingConfigMessagePrimaryRegionChargingInfoParams(LONG packetHandle, struct RoadUserChargingConfigMessagePrimaryRegionChargingInfo value, char oldPath[])
{
  char newPath[300]; 
  int j; 
  int k;
  int result;

  result = 0;

  snprintf(newPath, elcount(newPath), "%s.%s", oldPath, "primaryRegionCountry");
  value.primaryRegionCountry.isValidFlag = 1;
  value.primaryRegionCountry.stringLength = C2xGetTokenLengthBit(packetHandle, "RoadUserChargingConfigMessage", newPath);
  if ((result = CheckLastError("RoadUserChargingConfigMessage", gkFuncRefGet, result))==0)
  {
    if(value.primaryRegionCountry.stringLength > 0)
    {
      for(j=0; j<value.primaryRegionCountry.stringLength; j++)
      {
        if(C2xGetTokenBitOfBitString(packetHandle, "RoadUserChargingConfigMessage", newPath, j) == 0)
        {
          value.primaryRegionCountry.string[j] = '0';
        }
        else if(C2xGetTokenBitOfBitString(packetHandle, "RoadUserChargingConfigMessage", newPath, j) == 1)
        {
          value.primaryRegionCountry.string[j] = '1';
        }

        if(value.primaryRegionCountry.stringLength == 1)
        {
          value.primaryRegionCountry.string[1] = '0';
        }
        result = CheckLastError("RoadUserChargingConfigMessage", gkFuncRefGet, result);
      }
    }
    else
    {
      for(k = value.primaryRegionCountry.stringLength+1; k > -1; k--)
      {
        if(value.primaryRegionCountry.string[k] == '1')
        {
          value.primaryRegionCountry.string[k] = '0';
        }
      }
    }
  }

  snprintf(newPath, elcount(newPath), "%s.%s", oldPath, "chargingPrimaryRegion");
  GetRoadUserChargingConfigMessagePrimaryRegionChargingInfo_chargingPrimaryRegionParams(packetHandle, value.chargingPrimaryRegion, newPath);
  result = CheckLastError("RoadUserChargingConfigMessage", gkFuncRefGet, result);

  return result;
}

int SetRoadUserChargingConfigMessagePrimaryRegionChargingInfoParams(LONG packetHandle, struct RoadUserChargingConfigMessagePrimaryRegionChargingInfo value, char oldPath[])
{
  char newPath[300]; 
  int j;
  int result;

  result = 0;

  snprintf(newPath, elcount(newPath), "%s.%s", oldPath, "primaryRegionCountry");
    for(j=0; j<value.primaryRegionCountry.stringLength; j++)
    {
      if(value.primaryRegionCountry.string[j] == '0')
      {
        C2xSetTokenBitOfBitString(packetHandle, "RoadUserChargingConfigMessage", newPath, j, 0);
      }
      else
      {
        C2xSetTokenBitOfBitString(packetHandle, "RoadUserChargingConfigMessage", newPath, j, 1);
      }
      result = CheckLastError("RoadUserChargingConfigMessage", gkFuncRefGet, result);
    }

  snprintf(newPath, elcount(newPath), "%s.%s", oldPath, "chargingPrimaryRegion");
  SetRoadUserChargingConfigMessagePrimaryRegionChargingInfo_chargingPrimaryRegionParams(packetHandle, value.chargingPrimaryRegion, newPath);
  result = CheckLastError("RoadUserChargingConfigMessage", gkFuncRefGet, result);

  return result;
}

int GetRoadUserChargingConfigMessageSubRegionChargingInfoParams(LONG packetHandle, struct RoadUserChargingConfigMessageSubRegionChargingInfo value, char oldPath[])
{
  char newPath[300];
  int i;
  int result;

  result = 0;

  snprintf(newPath, elcount(newPath), "%s.%s", oldPath, "subRegion");
  value.subRegion.length = C2xGetTokenInt(packetHandle, "RoadUserChargingConfigMessage", newPath);
  if((result = CheckLastError("RoadUserChargingConfigMessage", gkFuncRefGet, result))==0)
  {
    if(value.subRegion.length > 0)
    {
      for(i=0; i<value.subRegion.length; i++)
      {
        value.subRegion.arrayValue[i].id = C2xGetTokenOidElement(packetHandle, "RoadUserChargingConfigMessage", newPath, i);
      }
    }
  }
  snprintf(newPath, elcount(newPath), "%s.%s", oldPath, "chargingFees");
  GetRoadUserChargingConfigMessageChargingFeesParams(packetHandle, value.chargingFees, newPath);
  result = CheckLastError("RoadUserChargingConfigMessage", gkFuncRefGet, result);

  return result;
}

int SetRoadUserChargingConfigMessageSubRegionChargingInfoParams(LONG packetHandle, struct RoadUserChargingConfigMessageSubRegionChargingInfo value, char oldPath[])
{
  char newPath[300];
  int i;
  int result;

  result = 0;

  snprintf(newPath, elcount(newPath), "%s.%s", oldPath, "subRegion");
  C2xRemoveToken(packetHandle, "RoadUserChargingConfigMessage", newPath);
  if(value.subRegion.length > 0)
  {
    for(i=0; i<value.subRegion.length; i++)
    {
      C2xSetTokenOidElement(packetHandle, "RoadUserChargingConfigMessage", newPath, i, value.subRegion.arrayValue[i].id);
    }
  }
  result = CheckLastError("RoadUserChargingConfigMessage", gkFuncRefGet, result);

  snprintf(newPath, elcount(newPath), "%s.%s", oldPath, "chargingFees");
  SetRoadUserChargingConfigMessageChargingFeesParams(packetHandle, value.chargingFees, newPath);
  result = CheckLastError("RoadUserChargingConfigMessage", gkFuncRefGet, result);

  return result;
}

int GetRoadUserChargingConfigMessageChargingConfig_bySubRegionParams(LONG packetHandle, struct RoadUserChargingConfigMessageChargingConfig_bySubRegion value, char oldPath[])
{
  char newPath[300]; 
  int i;
  int result;

  result = 0;

  value.length = C2xGetTokenInt(packetHandle, "RoadUserChargingConfigMessage", oldPath);
  if((result = CheckLastError("RoadUserChargingConfigMessage", gkFuncRefGet, result))==0)
  {
    for(i=0; i<value.length; i++)
    {
      snprintf(newPath, elcount(newPath), "%s[%d]", oldPath, i);
      GetRoadUserChargingConfigMessageSubRegionChargingInfoParams(packetHandle, value.arrayValue[i], newPath);
      result = CheckLastError("RoadUserChargingConfigMessage", gkFuncRefGet, result);
    }
  }
  return result;
}

int SetRoadUserChargingConfigMessageChargingConfig_bySubRegionParams(LONG packetHandle, struct RoadUserChargingConfigMessageChargingConfig_bySubRegion value, char oldPath[])
{
  char newPath[300]; 
  int i;
  int result;

  result = 0;

  C2xRemoveToken(packetHandle, "RoadUserChargingConfigMessage", oldPath);
  for(i=0; i<value.length; i++)
  {
    snprintf(newPath, elcount(newPath), "%s[%d]", oldPath, i);
    SetRoadUserChargingConfigMessageSubRegionChargingInfoParams(packetHandle, value.arrayValue[i], newPath);
    result = CheckLastError("RoadUserChargingConfigMessage", gkFuncRefGet, result);
  }
  return result;
}

int GetRoadUserChargingConfigMessageAddGrpB_LatitudeDMS2Params(LONG packetHandle, struct RoadUserChargingConfigMessageAddGrpB_LatitudeDMS2 value, char oldPath[])
{
  char newPath[300];
  int result;

  result = 0;

  snprintf(newPath, elcount(newPath), "%s.%s", oldPath, "d");
  value.d = C2xGetTokenInt(packetHandle, "RoadUserChargingConfigMessage", newPath);
  result = CheckLastError("RoadUserChargingConfigMessage", gkFuncRefGet, result);

  snprintf(newPath, elcount(newPath), "%s.%s", oldPath, "m");
  value.m = C2xGetTokenInt(packetHandle, "RoadUserChargingConfigMessage", newPath);
  result = CheckLastError("RoadUserChargingConfigMessage", gkFuncRefGet, result);

  snprintf(newPath, elcount(newPath), "%s.%s", oldPath, "s");
  value.s = C2xGetTokenInt(packetHandle, "RoadUserChargingConfigMessage", newPath);
  result = CheckLastError("RoadUserChargingConfigMessage", gkFuncRefGet, result);

  return result;
}

int SetRoadUserChargingConfigMessageAddGrpB_LatitudeDMS2Params(LONG packetHandle, struct RoadUserChargingConfigMessageAddGrpB_LatitudeDMS2 value, char oldPath[])
{
  char newPath[300];
  int result;

  result = 0;

  snprintf(newPath, elcount(newPath), "%s.%s", oldPath, "d");
  C2xSetTokenInt(packetHandle, "RoadUserChargingConfigMessage", newPath, value.d);
  result = CheckLastError("RoadUserChargingConfigMessage", gkFuncRefGet, result);

  snprintf(newPath, elcount(newPath), "%s.%s", oldPath, "m");
  C2xSetTokenInt(packetHandle, "RoadUserChargingConfigMessage", newPath, value.m);
  result = CheckLastError("RoadUserChargingConfigMessage", gkFuncRefGet, result);

  snprintf(newPath, elcount(newPath), "%s.%s", oldPath, "s");
  C2xSetTokenInt(packetHandle, "RoadUserChargingConfigMessage", newPath, value.s);
  result = CheckLastError("RoadUserChargingConfigMessage", gkFuncRefGet, result);

  return result;
}

int GetRoadUserChargingConfigMessageAddGrpB_LongitudeDMS2Params(LONG packetHandle, struct RoadUserChargingConfigMessageAddGrpB_LongitudeDMS2 value, char oldPath[])
{
  char newPath[300];
  int result;

  result = 0;

  snprintf(newPath, elcount(newPath), "%s.%s", oldPath, "d");
  value.d = C2xGetTokenInt(packetHandle, "RoadUserChargingConfigMessage", newPath);
  result = CheckLastError("RoadUserChargingConfigMessage", gkFuncRefGet, result);

  snprintf(newPath, elcount(newPath), "%s.%s", oldPath, "m");
  value.m = C2xGetTokenInt(packetHandle, "RoadUserChargingConfigMessage", newPath);
  result = CheckLastError("RoadUserChargingConfigMessage", gkFuncRefGet, result);

  snprintf(newPath, elcount(newPath), "%s.%s", oldPath, "s");
  value.s = C2xGetTokenInt(packetHandle, "RoadUserChargingConfigMessage", newPath);
  result = CheckLastError("RoadUserChargingConfigMessage", gkFuncRefGet, result);

  return result;
}

int SetRoadUserChargingConfigMessageAddGrpB_LongitudeDMS2Params(LONG packetHandle, struct RoadUserChargingConfigMessageAddGrpB_LongitudeDMS2 value, char oldPath[])
{
  char newPath[300];
  int result;

  result = 0;

  snprintf(newPath, elcount(newPath), "%s.%s", oldPath, "d");
  C2xSetTokenInt(packetHandle, "RoadUserChargingConfigMessage", newPath, value.d);
  result = CheckLastError("RoadUserChargingConfigMessage", gkFuncRefGet, result);

  snprintf(newPath, elcount(newPath), "%s.%s", oldPath, "m");
  C2xSetTokenInt(packetHandle, "RoadUserChargingConfigMessage", newPath, value.m);
  result = CheckLastError("RoadUserChargingConfigMessage", gkFuncRefGet, result);

  snprintf(newPath, elcount(newPath), "%s.%s", oldPath, "s");
  C2xSetTokenInt(packetHandle, "RoadUserChargingConfigMessage", newPath, value.s);
  result = CheckLastError("RoadUserChargingConfigMessage", gkFuncRefGet, result);

  return result;
}

int GetRoadUserChargingConfigMessageAddGrpB_Position3D_addGrpBParams(LONG packetHandle, struct RoadUserChargingConfigMessageAddGrpB_Position3D_addGrpB value, char oldPath[])
{
  char newPath[300];
  int result;

  result = 0;

  snprintf(newPath, elcount(newPath), "%s.%s", oldPath, "latitude");
  GetRoadUserChargingConfigMessageAddGrpB_LatitudeDMS2Params(packetHandle, value.latitude, newPath);
  result = CheckLastError("RoadUserChargingConfigMessage", gkFuncRefGet, result);

  snprintf(newPath, elcount(newPath), "%s.%s", oldPath, "longitude");
  GetRoadUserChargingConfigMessageAddGrpB_LongitudeDMS2Params(packetHandle, value.longitude, newPath);
  result = CheckLastError("RoadUserChargingConfigMessage", gkFuncRefGet, result);

  snprintf(newPath, elcount(newPath), "%s.%s", oldPath, "elevation");
  value.elevation = C2xGetTokenInt(packetHandle, "RoadUserChargingConfigMessage", newPath);
  result = CheckLastError("RoadUserChargingConfigMessage", gkFuncRefGet, result);

  return result;
}

int SetRoadUserChargingConfigMessageAddGrpB_Position3D_addGrpBParams(LONG packetHandle, struct RoadUserChargingConfigMessageAddGrpB_Position3D_addGrpB value, char oldPath[])
{
  char newPath[300];
  int result;

  result = 0;

  snprintf(newPath, elcount(newPath), "%s.%s", oldPath, "latitude");
  SetRoadUserChargingConfigMessageAddGrpB_LatitudeDMS2Params(packetHandle, value.latitude, newPath);
  result = CheckLastError("RoadUserChargingConfigMessage", gkFuncRefGet, result);

  snprintf(newPath, elcount(newPath), "%s.%s", oldPath, "longitude");
  SetRoadUserChargingConfigMessageAddGrpB_LongitudeDMS2Params(packetHandle, value.longitude, newPath);
  result = CheckLastError("RoadUserChargingConfigMessage", gkFuncRefGet, result);

  snprintf(newPath, elcount(newPath), "%s.%s", oldPath, "elevation");
  C2xSetTokenInt(packetHandle, "RoadUserChargingConfigMessage", newPath, value.elevation);
  result = CheckLastError("RoadUserChargingConfigMessage", gkFuncRefGet, result);

  return result;
}

int GetRoadUserChargingConfigMessageAddGrpC_AltitudeParams(LONG packetHandle, struct RoadUserChargingConfigMessageAddGrpC_Altitude value, char oldPath[])
{
  char newPath[300];
  int result;

  result = 0;

  snprintf(newPath, elcount(newPath), "%s.%s", oldPath, "value");
  value.value = C2xGetTokenInt(packetHandle, "RoadUserChargingConfigMessage", newPath);
  result = CheckLastError("RoadUserChargingConfigMessage", gkFuncRefGet, result);

  snprintf(newPath, elcount(newPath), "%s.%s", oldPath, "confidence");
  value.confidence = C2xGetTokenInt(packetHandle, "RoadUserChargingConfigMessage", newPath);
  result = CheckLastError("RoadUserChargingConfigMessage", gkFuncRefGet, result);

  return result;
}

int SetRoadUserChargingConfigMessageAddGrpC_AltitudeParams(LONG packetHandle, struct RoadUserChargingConfigMessageAddGrpC_Altitude value, char oldPath[])
{
  char newPath[300];
  int result;

  result = 0;

  snprintf(newPath, elcount(newPath), "%s.%s", oldPath, "value");
  C2xSetTokenInt(packetHandle, "RoadUserChargingConfigMessage", newPath, value.value);
  result = CheckLastError("RoadUserChargingConfigMessage", gkFuncRefGet, result);

  snprintf(newPath, elcount(newPath), "%s.%s", oldPath, "confidence");
  C2xSetTokenInt(packetHandle, "RoadUserChargingConfigMessage", newPath, value.confidence);
  result = CheckLastError("RoadUserChargingConfigMessage", gkFuncRefGet, result);

  return result;
}

int GetRoadUserChargingConfigMessageAddGrpC_Position3D_addGrpCParams(LONG packetHandle, struct RoadUserChargingConfigMessageAddGrpC_Position3D_addGrpC value, char oldPath[])
{
  char newPath[300];
  int result;

  result = 0;

  snprintf(newPath, elcount(newPath), "%s.%s", oldPath, "altitude");
  GetRoadUserChargingConfigMessageAddGrpC_AltitudeParams(packetHandle, value.altitude, newPath);
  result = CheckLastError("RoadUserChargingConfigMessage", gkFuncRefGet, result);

  return result;
}

int SetRoadUserChargingConfigMessageAddGrpC_Position3D_addGrpCParams(LONG packetHandle, struct RoadUserChargingConfigMessageAddGrpC_Position3D_addGrpC value, char oldPath[])
{
  char newPath[300];
  int result;

  result = 0;

  snprintf(newPath, elcount(newPath), "%s.%s", oldPath, "altitude");
  SetRoadUserChargingConfigMessageAddGrpC_AltitudeParams(packetHandle, value.altitude, newPath);
  result = CheckLastError("RoadUserChargingConfigMessage", gkFuncRefGet, result);

  return result;
}

int GetRoadUserChargingConfigMessageCommon_RegionalExtension_Reg_Position3D_tableParams(LONG packetHandle, WORD tableKey, struct RoadUserChargingConfigMessageCommon_RegionalExtension_Reg_Position3D_table value, char oldPath[])
{
  char newPath[300];
  int result;

  result = 0;

  switch(tableKey)
  {
    case 2:
    {
      snprintf(newPath, elcount(newPath), "%s.%s", oldPath, "addGrpB");
      GetRoadUserChargingConfigMessageAddGrpB_Position3D_addGrpBParams(packetHandle, value.addGrpB, newPath);
      result = CheckLastError("RoadUserChargingConfigMessage", gkFuncRefGet, result);
    }
    break;
    case 3:
    {
      snprintf(newPath, elcount(newPath), "%s.%s", oldPath, "addGrpC");
      GetRoadUserChargingConfigMessageAddGrpC_Position3D_addGrpCParams(packetHandle, value.addGrpC, newPath);
      result = CheckLastError("RoadUserChargingConfigMessage", gkFuncRefGet, result);
    }
    break;
  }
  return result;
}

int SetRoadUserChargingConfigMessageCommon_RegionalExtension_Reg_Position3D_tableParams(LONG packetHandle, WORD tableKey, struct RoadUserChargingConfigMessageCommon_RegionalExtension_Reg_Position3D_table value, char oldPath[])
{
  char newPath[300];
  int result;

  result = 0;

  switch(tableKey)
  {
    case 2:
    {
      snprintf(newPath, elcount(newPath), "%s.%s", oldPath, "addGrpB");
      SetRoadUserChargingConfigMessageAddGrpB_Position3D_addGrpBParams(packetHandle, value.addGrpB, newPath);
      result = CheckLastError("RoadUserChargingConfigMessage", gkFuncRefGet, result);
    }
    break;
    case 3:
    {
      snprintf(newPath, elcount(newPath), "%s.%s", oldPath, "addGrpC");
      SetRoadUserChargingConfigMessageAddGrpC_Position3D_addGrpCParams(packetHandle, value.addGrpC, newPath);
      result = CheckLastError("RoadUserChargingConfigMessage", gkFuncRefGet, result);
    }
    break;
  }
  return result;
}

int GetRoadUserChargingConfigMessageCommon_RegionalExtension_Reg_Position3DParams(LONG packetHandle, struct RoadUserChargingConfigMessageCommon_RegionalExtension_Reg_Position3D value, char oldPath[])
{
  char newPath[300];
  int result;

  result = 0;

  snprintf(newPath, elcount(newPath), "%s.%s", oldPath, "regionId");
  value.regionId = C2xGetTokenInt(packetHandle, "RoadUserChargingConfigMessage", newPath);
  result = CheckLastError("RoadUserChargingConfigMessage", gkFuncRefGet, result);

  snprintf(newPath, elcount(newPath), "%s.%s", oldPath, "regExtvalue");
  GetRoadUserChargingConfigMessageCommon_RegionalExtension_Reg_Position3D_tableParams(packetHandle, value.regionId, value.regExtvalue, newPath);
  result = CheckLastError("RoadUserChargingConfigMessage", gkFuncRefGet, result);

  return result;
}

int SetRoadUserChargingConfigMessageCommon_RegionalExtension_Reg_Position3DParams(LONG packetHandle, struct RoadUserChargingConfigMessageCommon_RegionalExtension_Reg_Position3D value, char oldPath[])
{
  char newPath[300];
  int result;

  result = 0;


  snprintf(newPath, elcount(newPath), "%s.%s", oldPath, "regExtvalue");
  SetRoadUserChargingConfigMessageCommon_RegionalExtension_Reg_Position3D_tableParams(packetHandle, value.regionId, value.regExtvalue, newPath);
  result = CheckLastError("RoadUserChargingConfigMessage", gkFuncRefGet, result);

  return result;
}

int GetRoadUserChargingConfigMessageCommon_Position3D_regionalParams(LONG packetHandle, struct RoadUserChargingConfigMessageCommon_Position3D_regional value, char oldPath[])
{
  char newPath[300]; 
  int i;
  int result;

  result = 0;

  value.length = C2xGetTokenInt(packetHandle, "RoadUserChargingConfigMessage", oldPath);
  if((result = CheckLastError("RoadUserChargingConfigMessage", gkFuncRefGet, result))==0)
  {
    for(i=0; i<value.length; i++)
    {
      snprintf(newPath, elcount(newPath), "%s[%d]", oldPath, i);
      GetRoadUserChargingConfigMessageCommon_RegionalExtension_Reg_Position3DParams(packetHandle, value.arrayValue[i], newPath);
      result = CheckLastError("RoadUserChargingConfigMessage", gkFuncRefGet, result);
    }
  }
  return result;
}

int SetRoadUserChargingConfigMessageCommon_Position3D_regionalParams(LONG packetHandle, struct RoadUserChargingConfigMessageCommon_Position3D_regional value, char oldPath[])
{
  char newPath[300]; 
  int i;
  int result;

  result = 0;

  C2xRemoveToken(packetHandle, "RoadUserChargingConfigMessage", oldPath);
  for(i=0; i<value.length; i++)
  {
    snprintf(newPath, elcount(newPath), "%s[%d]", oldPath, i);
    SetRoadUserChargingConfigMessageCommon_RegionalExtension_Reg_Position3DParams(packetHandle, value.arrayValue[i], newPath);
    result = CheckLastError("RoadUserChargingConfigMessage", gkFuncRefGet, result);
  }
  return result;
}

int GetRoadUserChargingConfigMessageCommon_Position3DParams(LONG packetHandle, struct RoadUserChargingConfigMessageCommon_Position3D value, char oldPath[])
{
  char newPath[300];
  int result;

  result = 0;

  snprintf(newPath, elcount(newPath), "%s.%s", oldPath, "lat");
  value.lat = C2xGetTokenInt(packetHandle, "RoadUserChargingConfigMessage", newPath);
  result = CheckLastError("RoadUserChargingConfigMessage", gkFuncRefGet, result);

  snprintf(newPath, elcount(newPath), "%s.%s", oldPath, "lon");
  value.lon = C2xGetTokenInt(packetHandle, "RoadUserChargingConfigMessage", newPath);
  result = CheckLastError("RoadUserChargingConfigMessage", gkFuncRefGet, result);

  snprintf(newPath, elcount(newPath), "%s.%s", oldPath, "elevation");
  value.elevation.isValidFlag = C2xIsTokenAvailable(packetHandle, "RoadUserChargingConfigMessage", newPath);
  if(value.elevation.isValidFlag==1)
  {
    value.elevation.value = C2xGetTokenInt(packetHandle, "RoadUserChargingConfigMessage", newPath);
    result = CheckLastError("RoadUserChargingConfigMessage", gkFuncRefGet, result);
  }
  snprintf(newPath, elcount(newPath), "%s.%s", oldPath, "regional");
  value.regional.isValidFlag = C2xIsTokenAvailable(packetHandle, "RoadUserChargingConfigMessage", newPath);
  if(value.regional.isValidFlag==1)
  {
    GetRoadUserChargingConfigMessageCommon_Position3D_regionalParams(packetHandle, value.regional, newPath);
    result = CheckLastError("RoadUserChargingConfigMessage", gkFuncRefGet, result);
  }
  return result;
}

int SetRoadUserChargingConfigMessageCommon_Position3DParams(LONG packetHandle, struct RoadUserChargingConfigMessageCommon_Position3D value, char oldPath[])
{
  char newPath[300];
  int result;

  result = 0;

  snprintf(newPath, elcount(newPath), "%s.%s", oldPath, "lat");
  C2xSetTokenInt(packetHandle, "RoadUserChargingConfigMessage", newPath, value.lat);
  result = CheckLastError("RoadUserChargingConfigMessage", gkFuncRefGet, result);

  snprintf(newPath, elcount(newPath), "%s.%s", oldPath, "lon");
  C2xSetTokenInt(packetHandle, "RoadUserChargingConfigMessage", newPath, value.lon);
  result = CheckLastError("RoadUserChargingConfigMessage", gkFuncRefGet, result);

  snprintf(newPath, elcount(newPath), "%s.%s", oldPath, "elevation");
  if(value.elevation.isValidFlag==1)
  {
    C2xSetTokenInt(packetHandle, "RoadUserChargingConfigMessage", newPath, value.elevation.value);
    result = CheckLastError("RoadUserChargingConfigMessage", gkFuncRefGet, result);
  }
  else
  {
    if( C2xIsTokenAvailable(packetHandle, "RoadUserChargingConfigMessage", newPath) )
    {
      C2xRemoveToken(packetHandle, "RoadUserChargingConfigMessage", newPath);
    }
  }

  snprintf(newPath, elcount(newPath), "%s.%s", oldPath, "regional");
  if(value.regional.isValidFlag==1)
  {
    SetRoadUserChargingConfigMessageCommon_Position3D_regionalParams(packetHandle, value.regional, newPath);
    result = CheckLastError("RoadUserChargingConfigMessage", gkFuncRefGet, result);
  }
  else
  {
    if( C2xIsTokenAvailable(packetHandle, "RoadUserChargingConfigMessage", newPath) )
    {
      C2xRemoveToken(packetHandle, "RoadUserChargingConfigMessage", newPath);
    }
  }

  return result;
}

int GetRoadUserChargingConfigMessageCommon_Node_XY_20bParams(LONG packetHandle, struct RoadUserChargingConfigMessageCommon_Node_XY_20b value, char oldPath[])
{
  char newPath[300];
  int result;

  result = 0;

  snprintf(newPath, elcount(newPath), "%s.%s", oldPath, "x");
  value.x = C2xGetTokenInt(packetHandle, "RoadUserChargingConfigMessage", newPath);
  result = CheckLastError("RoadUserChargingConfigMessage", gkFuncRefGet, result);

  snprintf(newPath, elcount(newPath), "%s.%s", oldPath, "y");
  value.y = C2xGetTokenInt(packetHandle, "RoadUserChargingConfigMessage", newPath);
  result = CheckLastError("RoadUserChargingConfigMessage", gkFuncRefGet, result);

  return result;
}

int SetRoadUserChargingConfigMessageCommon_Node_XY_20bParams(LONG packetHandle, struct RoadUserChargingConfigMessageCommon_Node_XY_20b value, char oldPath[])
{
  char newPath[300];
  int result;

  result = 0;

  snprintf(newPath, elcount(newPath), "%s.%s", oldPath, "x");
  C2xSetTokenInt(packetHandle, "RoadUserChargingConfigMessage", newPath, value.x);
  result = CheckLastError("RoadUserChargingConfigMessage", gkFuncRefGet, result);

  snprintf(newPath, elcount(newPath), "%s.%s", oldPath, "y");
  C2xSetTokenInt(packetHandle, "RoadUserChargingConfigMessage", newPath, value.y);
  result = CheckLastError("RoadUserChargingConfigMessage", gkFuncRefGet, result);

  return result;
}

int GetRoadUserChargingConfigMessageCommon_Node_XY_22bParams(LONG packetHandle, struct RoadUserChargingConfigMessageCommon_Node_XY_22b value, char oldPath[])
{
  char newPath[300];
  int result;

  result = 0;

  snprintf(newPath, elcount(newPath), "%s.%s", oldPath, "x");
  value.x = C2xGetTokenInt(packetHandle, "RoadUserChargingConfigMessage", newPath);
  result = CheckLastError("RoadUserChargingConfigMessage", gkFuncRefGet, result);

  snprintf(newPath, elcount(newPath), "%s.%s", oldPath, "y");
  value.y = C2xGetTokenInt(packetHandle, "RoadUserChargingConfigMessage", newPath);
  result = CheckLastError("RoadUserChargingConfigMessage", gkFuncRefGet, result);

  return result;
}

int SetRoadUserChargingConfigMessageCommon_Node_XY_22bParams(LONG packetHandle, struct RoadUserChargingConfigMessageCommon_Node_XY_22b value, char oldPath[])
{
  char newPath[300];
  int result;

  result = 0;

  snprintf(newPath, elcount(newPath), "%s.%s", oldPath, "x");
  C2xSetTokenInt(packetHandle, "RoadUserChargingConfigMessage", newPath, value.x);
  result = CheckLastError("RoadUserChargingConfigMessage", gkFuncRefGet, result);

  snprintf(newPath, elcount(newPath), "%s.%s", oldPath, "y");
  C2xSetTokenInt(packetHandle, "RoadUserChargingConfigMessage", newPath, value.y);
  result = CheckLastError("RoadUserChargingConfigMessage", gkFuncRefGet, result);

  return result;
}

int GetRoadUserChargingConfigMessageCommon_Node_XY_24bParams(LONG packetHandle, struct RoadUserChargingConfigMessageCommon_Node_XY_24b value, char oldPath[])
{
  char newPath[300];
  int result;

  result = 0;

  snprintf(newPath, elcount(newPath), "%s.%s", oldPath, "x");
  value.x = C2xGetTokenInt(packetHandle, "RoadUserChargingConfigMessage", newPath);
  result = CheckLastError("RoadUserChargingConfigMessage", gkFuncRefGet, result);

  snprintf(newPath, elcount(newPath), "%s.%s", oldPath, "y");
  value.y = C2xGetTokenInt(packetHandle, "RoadUserChargingConfigMessage", newPath);
  result = CheckLastError("RoadUserChargingConfigMessage", gkFuncRefGet, result);

  return result;
}

int SetRoadUserChargingConfigMessageCommon_Node_XY_24bParams(LONG packetHandle, struct RoadUserChargingConfigMessageCommon_Node_XY_24b value, char oldPath[])
{
  char newPath[300];
  int result;

  result = 0;

  snprintf(newPath, elcount(newPath), "%s.%s", oldPath, "x");
  C2xSetTokenInt(packetHandle, "RoadUserChargingConfigMessage", newPath, value.x);
  result = CheckLastError("RoadUserChargingConfigMessage", gkFuncRefGet, result);

  snprintf(newPath, elcount(newPath), "%s.%s", oldPath, "y");
  C2xSetTokenInt(packetHandle, "RoadUserChargingConfigMessage", newPath, value.y);
  result = CheckLastError("RoadUserChargingConfigMessage", gkFuncRefGet, result);

  return result;
}

int GetRoadUserChargingConfigMessageCommon_Node_XY_26bParams(LONG packetHandle, struct RoadUserChargingConfigMessageCommon_Node_XY_26b value, char oldPath[])
{
  char newPath[300];
  int result;

  result = 0;

  snprintf(newPath, elcount(newPath), "%s.%s", oldPath, "x");
  value.x = C2xGetTokenInt(packetHandle, "RoadUserChargingConfigMessage", newPath);
  result = CheckLastError("RoadUserChargingConfigMessage", gkFuncRefGet, result);

  snprintf(newPath, elcount(newPath), "%s.%s", oldPath, "y");
  value.y = C2xGetTokenInt(packetHandle, "RoadUserChargingConfigMessage", newPath);
  result = CheckLastError("RoadUserChargingConfigMessage", gkFuncRefGet, result);

  return result;
}

int SetRoadUserChargingConfigMessageCommon_Node_XY_26bParams(LONG packetHandle, struct RoadUserChargingConfigMessageCommon_Node_XY_26b value, char oldPath[])
{
  char newPath[300];
  int result;

  result = 0;

  snprintf(newPath, elcount(newPath), "%s.%s", oldPath, "x");
  C2xSetTokenInt(packetHandle, "RoadUserChargingConfigMessage", newPath, value.x);
  result = CheckLastError("RoadUserChargingConfigMessage", gkFuncRefGet, result);

  snprintf(newPath, elcount(newPath), "%s.%s", oldPath, "y");
  C2xSetTokenInt(packetHandle, "RoadUserChargingConfigMessage", newPath, value.y);
  result = CheckLastError("RoadUserChargingConfigMessage", gkFuncRefGet, result);

  return result;
}

int GetRoadUserChargingConfigMessageCommon_Node_XY_28bParams(LONG packetHandle, struct RoadUserChargingConfigMessageCommon_Node_XY_28b value, char oldPath[])
{
  char newPath[300];
  int result;

  result = 0;

  snprintf(newPath, elcount(newPath), "%s.%s", oldPath, "x");
  value.x = C2xGetTokenInt(packetHandle, "RoadUserChargingConfigMessage", newPath);
  result = CheckLastError("RoadUserChargingConfigMessage", gkFuncRefGet, result);

  snprintf(newPath, elcount(newPath), "%s.%s", oldPath, "y");
  value.y = C2xGetTokenInt(packetHandle, "RoadUserChargingConfigMessage", newPath);
  result = CheckLastError("RoadUserChargingConfigMessage", gkFuncRefGet, result);

  return result;
}

int SetRoadUserChargingConfigMessageCommon_Node_XY_28bParams(LONG packetHandle, struct RoadUserChargingConfigMessageCommon_Node_XY_28b value, char oldPath[])
{
  char newPath[300];
  int result;

  result = 0;

  snprintf(newPath, elcount(newPath), "%s.%s", oldPath, "x");
  C2xSetTokenInt(packetHandle, "RoadUserChargingConfigMessage", newPath, value.x);
  result = CheckLastError("RoadUserChargingConfigMessage", gkFuncRefGet, result);

  snprintf(newPath, elcount(newPath), "%s.%s", oldPath, "y");
  C2xSetTokenInt(packetHandle, "RoadUserChargingConfigMessage", newPath, value.y);
  result = CheckLastError("RoadUserChargingConfigMessage", gkFuncRefGet, result);

  return result;
}

int GetRoadUserChargingConfigMessageCommon_Node_XY_32bParams(LONG packetHandle, struct RoadUserChargingConfigMessageCommon_Node_XY_32b value, char oldPath[])
{
  char newPath[300];
  int result;

  result = 0;

  snprintf(newPath, elcount(newPath), "%s.%s", oldPath, "x");
  value.x = C2xGetTokenInt(packetHandle, "RoadUserChargingConfigMessage", newPath);
  result = CheckLastError("RoadUserChargingConfigMessage", gkFuncRefGet, result);

  snprintf(newPath, elcount(newPath), "%s.%s", oldPath, "y");
  value.y = C2xGetTokenInt(packetHandle, "RoadUserChargingConfigMessage", newPath);
  result = CheckLastError("RoadUserChargingConfigMessage", gkFuncRefGet, result);

  return result;
}

int SetRoadUserChargingConfigMessageCommon_Node_XY_32bParams(LONG packetHandle, struct RoadUserChargingConfigMessageCommon_Node_XY_32b value, char oldPath[])
{
  char newPath[300];
  int result;

  result = 0;

  snprintf(newPath, elcount(newPath), "%s.%s", oldPath, "x");
  C2xSetTokenInt(packetHandle, "RoadUserChargingConfigMessage", newPath, value.x);
  result = CheckLastError("RoadUserChargingConfigMessage", gkFuncRefGet, result);

  snprintf(newPath, elcount(newPath), "%s.%s", oldPath, "y");
  C2xSetTokenInt(packetHandle, "RoadUserChargingConfigMessage", newPath, value.y);
  result = CheckLastError("RoadUserChargingConfigMessage", gkFuncRefGet, result);

  return result;
}

int GetRoadUserChargingConfigMessageCommon_Node_LLmD_64bParams(LONG packetHandle, struct RoadUserChargingConfigMessageCommon_Node_LLmD_64b value, char oldPath[])
{
  char newPath[300];
  int result;

  result = 0;

  snprintf(newPath, elcount(newPath), "%s.%s", oldPath, "lon");
  value.lon = C2xGetTokenInt(packetHandle, "RoadUserChargingConfigMessage", newPath);
  result = CheckLastError("RoadUserChargingConfigMessage", gkFuncRefGet, result);

  snprintf(newPath, elcount(newPath), "%s.%s", oldPath, "lat");
  value.lat = C2xGetTokenInt(packetHandle, "RoadUserChargingConfigMessage", newPath);
  result = CheckLastError("RoadUserChargingConfigMessage", gkFuncRefGet, result);

  return result;
}

int SetRoadUserChargingConfigMessageCommon_Node_LLmD_64bParams(LONG packetHandle, struct RoadUserChargingConfigMessageCommon_Node_LLmD_64b value, char oldPath[])
{
  char newPath[300];
  int result;

  result = 0;

  snprintf(newPath, elcount(newPath), "%s.%s", oldPath, "lon");
  C2xSetTokenInt(packetHandle, "RoadUserChargingConfigMessage", newPath, value.lon);
  result = CheckLastError("RoadUserChargingConfigMessage", gkFuncRefGet, result);

  snprintf(newPath, elcount(newPath), "%s.%s", oldPath, "lat");
  C2xSetTokenInt(packetHandle, "RoadUserChargingConfigMessage", newPath, value.lat);
  result = CheckLastError("RoadUserChargingConfigMessage", gkFuncRefGet, result);

  return result;
}

int GetRoadUserChargingConfigMessageAddGrpB_Node_LLdms_48bParams(LONG packetHandle, struct RoadUserChargingConfigMessageAddGrpB_Node_LLdms_48b value, char oldPath[])
{
  char newPath[300];
  int result;

  result = 0;

  snprintf(newPath, elcount(newPath), "%s.%s", oldPath, "lon");
  value.lon = C2xGetTokenInt(packetHandle, "RoadUserChargingConfigMessage", newPath);
  result = CheckLastError("RoadUserChargingConfigMessage", gkFuncRefGet, result);

  snprintf(newPath, elcount(newPath), "%s.%s", oldPath, "lat");
  value.lat = C2xGetTokenInt(packetHandle, "RoadUserChargingConfigMessage", newPath);
  result = CheckLastError("RoadUserChargingConfigMessage", gkFuncRefGet, result);

  return result;
}

int SetRoadUserChargingConfigMessageAddGrpB_Node_LLdms_48bParams(LONG packetHandle, struct RoadUserChargingConfigMessageAddGrpB_Node_LLdms_48b value, char oldPath[])
{
  char newPath[300];
  int result;

  result = 0;

  snprintf(newPath, elcount(newPath), "%s.%s", oldPath, "lon");
  C2xSetTokenInt(packetHandle, "RoadUserChargingConfigMessage", newPath, value.lon);
  result = CheckLastError("RoadUserChargingConfigMessage", gkFuncRefGet, result);

  snprintf(newPath, elcount(newPath), "%s.%s", oldPath, "lat");
  C2xSetTokenInt(packetHandle, "RoadUserChargingConfigMessage", newPath, value.lat);
  result = CheckLastError("RoadUserChargingConfigMessage", gkFuncRefGet, result);

  return result;
}

int GetRoadUserChargingConfigMessageAddGrpB_Node_LLdms_80bParams(LONG packetHandle, struct RoadUserChargingConfigMessageAddGrpB_Node_LLdms_80b value, char oldPath[])
{
  char newPath[300];
  int result;

  result = 0;

  snprintf(newPath, elcount(newPath), "%s.%s", oldPath, "lon");
  GetRoadUserChargingConfigMessageAddGrpB_LongitudeDMS2Params(packetHandle, value.lon, newPath);
  result = CheckLastError("RoadUserChargingConfigMessage", gkFuncRefGet, result);

  snprintf(newPath, elcount(newPath), "%s.%s", oldPath, "lat");
  GetRoadUserChargingConfigMessageAddGrpB_LatitudeDMS2Params(packetHandle, value.lat, newPath);
  result = CheckLastError("RoadUserChargingConfigMessage", gkFuncRefGet, result);

  return result;
}

int SetRoadUserChargingConfigMessageAddGrpB_Node_LLdms_80bParams(LONG packetHandle, struct RoadUserChargingConfigMessageAddGrpB_Node_LLdms_80b value, char oldPath[])
{
  char newPath[300];
  int result;

  result = 0;

  snprintf(newPath, elcount(newPath), "%s.%s", oldPath, "lon");
  SetRoadUserChargingConfigMessageAddGrpB_LongitudeDMS2Params(packetHandle, value.lon, newPath);
  result = CheckLastError("RoadUserChargingConfigMessage", gkFuncRefGet, result);

  snprintf(newPath, elcount(newPath), "%s.%s", oldPath, "lat");
  SetRoadUserChargingConfigMessageAddGrpB_LatitudeDMS2Params(packetHandle, value.lat, newPath);
  result = CheckLastError("RoadUserChargingConfigMessage", gkFuncRefGet, result);

  return result;
}

int GetRoadUserChargingConfigMessageAddGrpB_NodeOffsetPointXY_addGrpBParams(LONG packetHandle, struct RoadUserChargingConfigMessageAddGrpB_NodeOffsetPointXY_addGrpB value, char oldPath[])
{
  char newPath[300];
  int result;

  result = 0;

  value.choice = C2xGetTokenInt(packetHandle, "RoadUserChargingConfigMessage", oldPath);

  switch(value.choice)
  {
    case 0:
    {
      snprintf(newPath, elcount(newPath), "%s.%s", oldPath, "posA");
      GetRoadUserChargingConfigMessageAddGrpB_Node_LLdms_48bParams(packetHandle, value.posA, newPath);
      result = CheckLastError("RoadUserChargingConfigMessage", gkFuncRefGet, result);
    }
    break;
    case 1:
    {
      snprintf(newPath, elcount(newPath), "%s.%s", oldPath, "posB");
      GetRoadUserChargingConfigMessageAddGrpB_Node_LLdms_80bParams(packetHandle, value.posB, newPath);
      result = CheckLastError("RoadUserChargingConfigMessage", gkFuncRefGet, result);
    }
    break;
  }
  return result;
}

int SetRoadUserChargingConfigMessageAddGrpB_NodeOffsetPointXY_addGrpBParams(LONG packetHandle, struct RoadUserChargingConfigMessageAddGrpB_NodeOffsetPointXY_addGrpB value, char oldPath[])
{
  char newPath[300];
  int result;

  result = 0;

  switch(value.choice)
  {
    case 0:
    {
      snprintf(newPath, elcount(newPath), "%s.%s", oldPath, "posA");
      SetRoadUserChargingConfigMessageAddGrpB_Node_LLdms_48bParams(packetHandle, value.posA, newPath);
      result = CheckLastError("RoadUserChargingConfigMessage", gkFuncRefGet, result);
    }
    break;
    case 1:
    {
      snprintf(newPath, elcount(newPath), "%s.%s", oldPath, "posB");
      SetRoadUserChargingConfigMessageAddGrpB_Node_LLdms_80bParams(packetHandle, value.posB, newPath);
      result = CheckLastError("RoadUserChargingConfigMessage", gkFuncRefGet, result);
    }
    break;
  }
  return result;
}

int GetRoadUserChargingConfigMessageCommon_RegionalExtension_Reg_NodeOffsetPointXY_tableParams(LONG packetHandle, WORD tableKey, struct RoadUserChargingConfigMessageCommon_RegionalExtension_Reg_NodeOffsetPointXY_table value, char oldPath[])
{
  char newPath[300];
  int result;

  result = 0;

  switch(tableKey)
  {
    case 2:
    {
      snprintf(newPath, elcount(newPath), "%s.%s", oldPath, "addGrpB");
      GetRoadUserChargingConfigMessageAddGrpB_NodeOffsetPointXY_addGrpBParams(packetHandle, value.addGrpB, newPath);
      result = CheckLastError("RoadUserChargingConfigMessage", gkFuncRefGet, result);
    }
    break;
  }
  return result;
}

int SetRoadUserChargingConfigMessageCommon_RegionalExtension_Reg_NodeOffsetPointXY_tableParams(LONG packetHandle, WORD tableKey, struct RoadUserChargingConfigMessageCommon_RegionalExtension_Reg_NodeOffsetPointXY_table value, char oldPath[])
{
  char newPath[300];
  int result;

  result = 0;

  switch(tableKey)
  {
    case 2:
    {
      snprintf(newPath, elcount(newPath), "%s.%s", oldPath, "addGrpB");
      SetRoadUserChargingConfigMessageAddGrpB_NodeOffsetPointXY_addGrpBParams(packetHandle, value.addGrpB, newPath);
      result = CheckLastError("RoadUserChargingConfigMessage", gkFuncRefGet, result);
    }
    break;
  }
  return result;
}

int GetRoadUserChargingConfigMessageCommon_RegionalExtension_Reg_NodeOffsetPointXYParams(LONG packetHandle, struct RoadUserChargingConfigMessageCommon_RegionalExtension_Reg_NodeOffsetPointXY value, char oldPath[])
{
  char newPath[300];
  int result;

  result = 0;

  snprintf(newPath, elcount(newPath), "%s.%s", oldPath, "regionId");
  value.regionId = C2xGetTokenInt(packetHandle, "RoadUserChargingConfigMessage", newPath);
  result = CheckLastError("RoadUserChargingConfigMessage", gkFuncRefGet, result);

  snprintf(newPath, elcount(newPath), "%s.%s", oldPath, "regExtvalue");
  GetRoadUserChargingConfigMessageCommon_RegionalExtension_Reg_NodeOffsetPointXY_tableParams(packetHandle, value.regionId, value.regExtvalue, newPath);
  result = CheckLastError("RoadUserChargingConfigMessage", gkFuncRefGet, result);

  return result;
}

int SetRoadUserChargingConfigMessageCommon_RegionalExtension_Reg_NodeOffsetPointXYParams(LONG packetHandle, struct RoadUserChargingConfigMessageCommon_RegionalExtension_Reg_NodeOffsetPointXY value, char oldPath[])
{
  char newPath[300];
  int result;

  result = 0;


  snprintf(newPath, elcount(newPath), "%s.%s", oldPath, "regExtvalue");
  SetRoadUserChargingConfigMessageCommon_RegionalExtension_Reg_NodeOffsetPointXY_tableParams(packetHandle, value.regionId, value.regExtvalue, newPath);
  result = CheckLastError("RoadUserChargingConfigMessage", gkFuncRefGet, result);

  return result;
}

int GetRoadUserChargingConfigMessageCommon_NodeOffsetPointXYParams(LONG packetHandle, struct RoadUserChargingConfigMessageCommon_NodeOffsetPointXY value, char oldPath[])
{
  char newPath[300];
  int result;

  result = 0;

  value.choice = C2xGetTokenInt(packetHandle, "RoadUserChargingConfigMessage", oldPath);

  switch(value.choice)
  {
    case 0:
    {
      snprintf(newPath, elcount(newPath), "%s.%s", oldPath, "node_XY1");
      GetRoadUserChargingConfigMessageCommon_Node_XY_20bParams(packetHandle, value.node_XY1, newPath);
      result = CheckLastError("RoadUserChargingConfigMessage", gkFuncRefGet, result);
    }
    break;
    case 1:
    {
      snprintf(newPath, elcount(newPath), "%s.%s", oldPath, "node_XY2");
      GetRoadUserChargingConfigMessageCommon_Node_XY_22bParams(packetHandle, value.node_XY2, newPath);
      result = CheckLastError("RoadUserChargingConfigMessage", gkFuncRefGet, result);
    }
    break;
    case 2:
    {
      snprintf(newPath, elcount(newPath), "%s.%s", oldPath, "node_XY3");
      GetRoadUserChargingConfigMessageCommon_Node_XY_24bParams(packetHandle, value.node_XY3, newPath);
      result = CheckLastError("RoadUserChargingConfigMessage", gkFuncRefGet, result);
    }
    break;
    case 3:
    {
      snprintf(newPath, elcount(newPath), "%s.%s", oldPath, "node_XY4");
      GetRoadUserChargingConfigMessageCommon_Node_XY_26bParams(packetHandle, value.node_XY4, newPath);
      result = CheckLastError("RoadUserChargingConfigMessage", gkFuncRefGet, result);
    }
    break;
    case 4:
    {
      snprintf(newPath, elcount(newPath), "%s.%s", oldPath, "node_XY5");
      GetRoadUserChargingConfigMessageCommon_Node_XY_28bParams(packetHandle, value.node_XY5, newPath);
      result = CheckLastError("RoadUserChargingConfigMessage", gkFuncRefGet, result);
    }
    break;
    case 5:
    {
      snprintf(newPath, elcount(newPath), "%s.%s", oldPath, "node_XY6");
      GetRoadUserChargingConfigMessageCommon_Node_XY_32bParams(packetHandle, value.node_XY6, newPath);
      result = CheckLastError("RoadUserChargingConfigMessage", gkFuncRefGet, result);
    }
    break;
    case 6:
    {
      snprintf(newPath, elcount(newPath), "%s.%s", oldPath, "node_LatLon");
      GetRoadUserChargingConfigMessageCommon_Node_LLmD_64bParams(packetHandle, value.node_LatLon, newPath);
      result = CheckLastError("RoadUserChargingConfigMessage", gkFuncRefGet, result);
    }
    break;
    case 7:
    {
      snprintf(newPath, elcount(newPath), "%s.%s", oldPath, "regional");
      GetRoadUserChargingConfigMessageCommon_RegionalExtension_Reg_NodeOffsetPointXYParams(packetHandle, value.regional, newPath);
      result = CheckLastError("RoadUserChargingConfigMessage", gkFuncRefGet, result);
    }
    break;
  }
  return result;
}

int SetRoadUserChargingConfigMessageCommon_NodeOffsetPointXYParams(LONG packetHandle, struct RoadUserChargingConfigMessageCommon_NodeOffsetPointXY value, char oldPath[])
{
  char newPath[300];
  int result;

  result = 0;

  switch(value.choice)
  {
    case 0:
    {
      snprintf(newPath, elcount(newPath), "%s.%s", oldPath, "node_XY1");
      SetRoadUserChargingConfigMessageCommon_Node_XY_20bParams(packetHandle, value.node_XY1, newPath);
      result = CheckLastError("RoadUserChargingConfigMessage", gkFuncRefGet, result);
    }
    break;
    case 1:
    {
      snprintf(newPath, elcount(newPath), "%s.%s", oldPath, "node_XY2");
      SetRoadUserChargingConfigMessageCommon_Node_XY_22bParams(packetHandle, value.node_XY2, newPath);
      result = CheckLastError("RoadUserChargingConfigMessage", gkFuncRefGet, result);
    }
    break;
    case 2:
    {
      snprintf(newPath, elcount(newPath), "%s.%s", oldPath, "node_XY3");
      SetRoadUserChargingConfigMessageCommon_Node_XY_24bParams(packetHandle, value.node_XY3, newPath);
      result = CheckLastError("RoadUserChargingConfigMessage", gkFuncRefGet, result);
    }
    break;
    case 3:
    {
      snprintf(newPath, elcount(newPath), "%s.%s", oldPath, "node_XY4");
      SetRoadUserChargingConfigMessageCommon_Node_XY_26bParams(packetHandle, value.node_XY4, newPath);
      result = CheckLastError("RoadUserChargingConfigMessage", gkFuncRefGet, result);
    }
    break;
    case 4:
    {
      snprintf(newPath, elcount(newPath), "%s.%s", oldPath, "node_XY5");
      SetRoadUserChargingConfigMessageCommon_Node_XY_28bParams(packetHandle, value.node_XY5, newPath);
      result = CheckLastError("RoadUserChargingConfigMessage", gkFuncRefGet, result);
    }
    break;
    case 5:
    {
      snprintf(newPath, elcount(newPath), "%s.%s", oldPath, "node_XY6");
      SetRoadUserChargingConfigMessageCommon_Node_XY_32bParams(packetHandle, value.node_XY6, newPath);
      result = CheckLastError("RoadUserChargingConfigMessage", gkFuncRefGet, result);
    }
    break;
    case 6:
    {
      snprintf(newPath, elcount(newPath), "%s.%s", oldPath, "node_LatLon");
      SetRoadUserChargingConfigMessageCommon_Node_LLmD_64bParams(packetHandle, value.node_LatLon, newPath);
      result = CheckLastError("RoadUserChargingConfigMessage", gkFuncRefGet, result);
    }
    break;
    case 7:
    {
      snprintf(newPath, elcount(newPath), "%s.%s", oldPath, "regional");
      SetRoadUserChargingConfigMessageCommon_RegionalExtension_Reg_NodeOffsetPointXYParams(packetHandle, value.regional, newPath);
      result = CheckLastError("RoadUserChargingConfigMessage", gkFuncRefGet, result);
    }
    break;
  }
  return result;
}

int GetRoadUserChargingConfigMessageCommon_NodeAttributeXYListParams(LONG packetHandle, struct RoadUserChargingConfigMessageCommon_NodeAttributeXYList value, char oldPath[])
{
  char newPath[300]; 
  int i;
  int result;

  result = 0;

  value.length = C2xGetTokenInt(packetHandle, "RoadUserChargingConfigMessage", oldPath);
  if((result = CheckLastError("RoadUserChargingConfigMessage", gkFuncRefGet, result))==0)
  {
    for(i=0; i<value.length; i++)
    {
      snprintf(newPath, elcount(newPath), "%s[%d]", oldPath, i);
      value.arrayValue[i] = C2xGetTokenInt64(packetHandle, "RoadUserChargingConfigMessage", newPath);
      result = CheckLastError("RoadUserChargingConfigMessage", gkFuncRefGet, result);
    }
  }
  return result;
}

int SetRoadUserChargingConfigMessageCommon_NodeAttributeXYListParams(LONG packetHandle, struct RoadUserChargingConfigMessageCommon_NodeAttributeXYList value, char oldPath[])
{
  char newPath[300]; 
  int i;
  int result;

  result = 0;

  C2xRemoveToken(packetHandle, "RoadUserChargingConfigMessage", oldPath);
  for(i=0; i<value.length; i++)
  {
    snprintf(newPath, elcount(newPath), "%s[%d]", oldPath, i);
    C2xSetTokenInt64(packetHandle, "RoadUserChargingConfigMessage", newPath, value.arrayValue[i]);
    result = CheckLastError("RoadUserChargingConfigMessage", gkFuncRefGet, result);
  }
  return result;
}

int GetRoadUserChargingConfigMessageCommon_SegmentAttributeXYListParams(LONG packetHandle, struct RoadUserChargingConfigMessageCommon_SegmentAttributeXYList value, char oldPath[])
{
  char newPath[300]; 
  int i;
  int result;

  result = 0;

  value.length = C2xGetTokenInt(packetHandle, "RoadUserChargingConfigMessage", oldPath);
  if((result = CheckLastError("RoadUserChargingConfigMessage", gkFuncRefGet, result))==0)
  {
    for(i=0; i<value.length; i++)
    {
      snprintf(newPath, elcount(newPath), "%s[%d]", oldPath, i);
      value.arrayValue[i] = C2xGetTokenInt64(packetHandle, "RoadUserChargingConfigMessage", newPath);
      result = CheckLastError("RoadUserChargingConfigMessage", gkFuncRefGet, result);
    }
  }
  return result;
}

int SetRoadUserChargingConfigMessageCommon_SegmentAttributeXYListParams(LONG packetHandle, struct RoadUserChargingConfigMessageCommon_SegmentAttributeXYList value, char oldPath[])
{
  char newPath[300]; 
  int i;
  int result;

  result = 0;

  C2xRemoveToken(packetHandle, "RoadUserChargingConfigMessage", oldPath);
  for(i=0; i<value.length; i++)
  {
    snprintf(newPath, elcount(newPath), "%s[%d]", oldPath, i);
    C2xSetTokenInt64(packetHandle, "RoadUserChargingConfigMessage", newPath, value.arrayValue[i]);
    result = CheckLastError("RoadUserChargingConfigMessage", gkFuncRefGet, result);
  }
  return result;
}

int GetRoadUserChargingConfigMessageCommon_RegulatorySpeedLimitParams(LONG packetHandle, struct RoadUserChargingConfigMessageCommon_RegulatorySpeedLimit value, char oldPath[])
{
  char newPath[300];
  int result;

  result = 0;

  snprintf(newPath, elcount(newPath), "%s.%s", oldPath, "type");
  value.type = C2xGetTokenInt(packetHandle, "RoadUserChargingConfigMessage", newPath);
  result = CheckLastError("RoadUserChargingConfigMessage", gkFuncRefGet, result);

  snprintf(newPath, elcount(newPath), "%s.%s", oldPath, "speed");
  value.speed = C2xGetTokenInt(packetHandle, "RoadUserChargingConfigMessage", newPath);
  result = CheckLastError("RoadUserChargingConfigMessage", gkFuncRefGet, result);

  return result;
}

int SetRoadUserChargingConfigMessageCommon_RegulatorySpeedLimitParams(LONG packetHandle, struct RoadUserChargingConfigMessageCommon_RegulatorySpeedLimit value, char oldPath[])
{
  char newPath[300];
  int result;

  result = 0;

  snprintf(newPath, elcount(newPath), "%s.%s", oldPath, "type");
  C2xSetTokenInt(packetHandle, "RoadUserChargingConfigMessage", newPath, value.type);
  result = CheckLastError("RoadUserChargingConfigMessage", gkFuncRefGet, result);

  snprintf(newPath, elcount(newPath), "%s.%s", oldPath, "speed");
  C2xSetTokenInt(packetHandle, "RoadUserChargingConfigMessage", newPath, value.speed);
  result = CheckLastError("RoadUserChargingConfigMessage", gkFuncRefGet, result);

  return result;
}

int GetRoadUserChargingConfigMessageCommon_SpeedLimitListParams(LONG packetHandle, struct RoadUserChargingConfigMessageCommon_SpeedLimitList value, char oldPath[])
{
  char newPath[300]; 
  int i;
  int result;

  result = 0;

  value.length = C2xGetTokenInt(packetHandle, "RoadUserChargingConfigMessage", oldPath);
  if((result = CheckLastError("RoadUserChargingConfigMessage", gkFuncRefGet, result))==0)
  {
    for(i=0; i<value.length; i++)
    {
      snprintf(newPath, elcount(newPath), "%s[%d]", oldPath, i);
      GetRoadUserChargingConfigMessageCommon_RegulatorySpeedLimitParams(packetHandle, value.arrayValue[i], newPath);
      result = CheckLastError("RoadUserChargingConfigMessage", gkFuncRefGet, result);
    }
  }
  return result;
}

int SetRoadUserChargingConfigMessageCommon_SpeedLimitListParams(LONG packetHandle, struct RoadUserChargingConfigMessageCommon_SpeedLimitList value, char oldPath[])
{
  char newPath[300]; 
  int i;
  int result;

  result = 0;

  C2xRemoveToken(packetHandle, "RoadUserChargingConfigMessage", oldPath);
  for(i=0; i<value.length; i++)
  {
    snprintf(newPath, elcount(newPath), "%s[%d]", oldPath, i);
    SetRoadUserChargingConfigMessageCommon_RegulatorySpeedLimitParams(packetHandle, value.arrayValue[i], newPath);
    result = CheckLastError("RoadUserChargingConfigMessage", gkFuncRefGet, result);
  }
  return result;
}

int GetRoadUserChargingConfigMessageCommon_RegionalExtension_Reg_LaneDataAttributeParams(LONG packetHandle, struct RoadUserChargingConfigMessageCommon_RegionalExtension_Reg_LaneDataAttribute value, char oldPath[])
{
  char newPath[300];
  int result;

  result = 0;

  snprintf(newPath, elcount(newPath), "%s.%s", oldPath, "regionId");
  value.regionId = C2xGetTokenInt(packetHandle, "RoadUserChargingConfigMessage", newPath);
  result = CheckLastError("RoadUserChargingConfigMessage", gkFuncRefGet, result);

  return result;
}

int SetRoadUserChargingConfigMessageCommon_RegionalExtension_Reg_LaneDataAttributeParams(LONG packetHandle, struct RoadUserChargingConfigMessageCommon_RegionalExtension_Reg_LaneDataAttribute value, char oldPath[])
{
  char newPath[300];
  int result;

  result = 0;


  return result;
}

int GetRoadUserChargingConfigMessageCommon_LaneDataAttribute_regionalParams(LONG packetHandle, struct RoadUserChargingConfigMessageCommon_LaneDataAttribute_regional value, char oldPath[])
{
  char newPath[300]; 
  int i;
  int result;

  result = 0;

  value.length = C2xGetTokenInt(packetHandle, "RoadUserChargingConfigMessage", oldPath);
  if((result = CheckLastError("RoadUserChargingConfigMessage", gkFuncRefGet, result))==0)
  {
    for(i=0; i<value.length; i++)
    {
      snprintf(newPath, elcount(newPath), "%s[%d]", oldPath, i);
      GetRoadUserChargingConfigMessageCommon_RegionalExtension_Reg_LaneDataAttributeParams(packetHandle, value.arrayValue[i], newPath);
      result = CheckLastError("RoadUserChargingConfigMessage", gkFuncRefGet, result);
    }
  }
  return result;
}

int SetRoadUserChargingConfigMessageCommon_LaneDataAttribute_regionalParams(LONG packetHandle, struct RoadUserChargingConfigMessageCommon_LaneDataAttribute_regional value, char oldPath[])
{
  char newPath[300]; 
  int i;
  int result;

  result = 0;

  C2xRemoveToken(packetHandle, "RoadUserChargingConfigMessage", oldPath);
  for(i=0; i<value.length; i++)
  {
    snprintf(newPath, elcount(newPath), "%s[%d]", oldPath, i);
    SetRoadUserChargingConfigMessageCommon_RegionalExtension_Reg_LaneDataAttributeParams(packetHandle, value.arrayValue[i], newPath);
    result = CheckLastError("RoadUserChargingConfigMessage", gkFuncRefGet, result);
  }
  return result;
}

int GetRoadUserChargingConfigMessageCommon_LaneDataAttributeParams(LONG packetHandle, struct RoadUserChargingConfigMessageCommon_LaneDataAttribute value, char oldPath[])
{
  char newPath[300];
  int result;

  result = 0;

  value.choice = C2xGetTokenInt(packetHandle, "RoadUserChargingConfigMessage", oldPath);

  switch(value.choice)
  {
    case 0:
    {
      snprintf(newPath, elcount(newPath), "%s.%s", oldPath, "pathEndPointAngle");
      value.pathEndPointAngle = C2xGetTokenInt(packetHandle, "RoadUserChargingConfigMessage", newPath);
      result = CheckLastError("RoadUserChargingConfigMessage", gkFuncRefGet, result);
    }
    break;
    case 1:
    {
      snprintf(newPath, elcount(newPath), "%s.%s", oldPath, "laneCrownPointCenter");
      value.laneCrownPointCenter = C2xGetTokenInt(packetHandle, "RoadUserChargingConfigMessage", newPath);
      result = CheckLastError("RoadUserChargingConfigMessage", gkFuncRefGet, result);
    }
    break;
    case 2:
    {
      snprintf(newPath, elcount(newPath), "%s.%s", oldPath, "laneCrownPointLeft");
      value.laneCrownPointLeft = C2xGetTokenInt(packetHandle, "RoadUserChargingConfigMessage", newPath);
      result = CheckLastError("RoadUserChargingConfigMessage", gkFuncRefGet, result);
    }
    break;
    case 3:
    {
      snprintf(newPath, elcount(newPath), "%s.%s", oldPath, "laneCrownPointRight");
      value.laneCrownPointRight = C2xGetTokenInt(packetHandle, "RoadUserChargingConfigMessage", newPath);
      result = CheckLastError("RoadUserChargingConfigMessage", gkFuncRefGet, result);
    }
    break;
    case 4:
    {
      snprintf(newPath, elcount(newPath), "%s.%s", oldPath, "laneAngle");
      value.laneAngle = C2xGetTokenInt(packetHandle, "RoadUserChargingConfigMessage", newPath);
      result = CheckLastError("RoadUserChargingConfigMessage", gkFuncRefGet, result);
    }
    break;
    case 5:
    {
      snprintf(newPath, elcount(newPath), "%s.%s", oldPath, "speedLimits");
      GetRoadUserChargingConfigMessageCommon_SpeedLimitListParams(packetHandle, value.speedLimits, newPath);
      result = CheckLastError("RoadUserChargingConfigMessage", gkFuncRefGet, result);
    }
    break;
    case 6:
    {
      snprintf(newPath, elcount(newPath), "%s.%s", oldPath, "regional");
      GetRoadUserChargingConfigMessageCommon_LaneDataAttribute_regionalParams(packetHandle, value.regional, newPath);
      result = CheckLastError("RoadUserChargingConfigMessage", gkFuncRefGet, result);
    }
    break;
  }
  return result;
}

int SetRoadUserChargingConfigMessageCommon_LaneDataAttributeParams(LONG packetHandle, struct RoadUserChargingConfigMessageCommon_LaneDataAttribute value, char oldPath[])
{
  char newPath[300];
  int result;

  result = 0;

  switch(value.choice)
  {
    case 0:
    {
      snprintf(newPath, elcount(newPath), "%s.%s", oldPath, "pathEndPointAngle");
      C2xSetTokenInt(packetHandle, "RoadUserChargingConfigMessage", newPath, value.pathEndPointAngle);
      result = CheckLastError("RoadUserChargingConfigMessage", gkFuncRefGet, result);
    }
    break;
    case 1:
    {
      snprintf(newPath, elcount(newPath), "%s.%s", oldPath, "laneCrownPointCenter");
      C2xSetTokenInt(packetHandle, "RoadUserChargingConfigMessage", newPath, value.laneCrownPointCenter);
      result = CheckLastError("RoadUserChargingConfigMessage", gkFuncRefGet, result);
    }
    break;
    case 2:
    {
      snprintf(newPath, elcount(newPath), "%s.%s", oldPath, "laneCrownPointLeft");
      C2xSetTokenInt(packetHandle, "RoadUserChargingConfigMessage", newPath, value.laneCrownPointLeft);
      result = CheckLastError("RoadUserChargingConfigMessage", gkFuncRefGet, result);
    }
    break;
    case 3:
    {
      snprintf(newPath, elcount(newPath), "%s.%s", oldPath, "laneCrownPointRight");
      C2xSetTokenInt(packetHandle, "RoadUserChargingConfigMessage", newPath, value.laneCrownPointRight);
      result = CheckLastError("RoadUserChargingConfigMessage", gkFuncRefGet, result);
    }
    break;
    case 4:
    {
      snprintf(newPath, elcount(newPath), "%s.%s", oldPath, "laneAngle");
      C2xSetTokenInt(packetHandle, "RoadUserChargingConfigMessage", newPath, value.laneAngle);
      result = CheckLastError("RoadUserChargingConfigMessage", gkFuncRefGet, result);
    }
    break;
    case 5:
    {
      snprintf(newPath, elcount(newPath), "%s.%s", oldPath, "speedLimits");
      SetRoadUserChargingConfigMessageCommon_SpeedLimitListParams(packetHandle, value.speedLimits, newPath);
      result = CheckLastError("RoadUserChargingConfigMessage", gkFuncRefGet, result);
    }
    break;
    case 6:
    {
      snprintf(newPath, elcount(newPath), "%s.%s", oldPath, "regional");
      SetRoadUserChargingConfigMessageCommon_LaneDataAttribute_regionalParams(packetHandle, value.regional, newPath);
      result = CheckLastError("RoadUserChargingConfigMessage", gkFuncRefGet, result);
    }
    break;
  }
  return result;
}

int GetRoadUserChargingConfigMessageCommon_LaneDataAttributeListParams(LONG packetHandle, struct RoadUserChargingConfigMessageCommon_LaneDataAttributeList value, char oldPath[])
{
  char newPath[300]; 
  int i;
  int result;

  result = 0;

  value.length = C2xGetTokenInt(packetHandle, "RoadUserChargingConfigMessage", oldPath);
  if((result = CheckLastError("RoadUserChargingConfigMessage", gkFuncRefGet, result))==0)
  {
    for(i=0; i<value.length; i++)
    {
      snprintf(newPath, elcount(newPath), "%s[%d]", oldPath, i);
      GetRoadUserChargingConfigMessageCommon_LaneDataAttributeParams(packetHandle, value.arrayValue[i], newPath);
      result = CheckLastError("RoadUserChargingConfigMessage", gkFuncRefGet, result);
    }
  }
  return result;
}

int SetRoadUserChargingConfigMessageCommon_LaneDataAttributeListParams(LONG packetHandle, struct RoadUserChargingConfigMessageCommon_LaneDataAttributeList value, char oldPath[])
{
  char newPath[300]; 
  int i;
  int result;

  result = 0;

  C2xRemoveToken(packetHandle, "RoadUserChargingConfigMessage", oldPath);
  for(i=0; i<value.length; i++)
  {
    snprintf(newPath, elcount(newPath), "%s[%d]", oldPath, i);
    SetRoadUserChargingConfigMessageCommon_LaneDataAttributeParams(packetHandle, value.arrayValue[i], newPath);
    result = CheckLastError("RoadUserChargingConfigMessage", gkFuncRefGet, result);
  }
  return result;
}

int GetRoadUserChargingConfigMessageCommon_RegionalExtension_Reg_NodeAttributeSetXYParams(LONG packetHandle, struct RoadUserChargingConfigMessageCommon_RegionalExtension_Reg_NodeAttributeSetXY value, char oldPath[])
{
  char newPath[300];
  int result;

  result = 0;

  snprintf(newPath, elcount(newPath), "%s.%s", oldPath, "regionId");
  value.regionId = C2xGetTokenInt(packetHandle, "RoadUserChargingConfigMessage", newPath);
  result = CheckLastError("RoadUserChargingConfigMessage", gkFuncRefGet, result);

  return result;
}

int SetRoadUserChargingConfigMessageCommon_RegionalExtension_Reg_NodeAttributeSetXYParams(LONG packetHandle, struct RoadUserChargingConfigMessageCommon_RegionalExtension_Reg_NodeAttributeSetXY value, char oldPath[])
{
  char newPath[300];
  int result;

  result = 0;


  return result;
}

int GetRoadUserChargingConfigMessageCommon_NodeAttributeSetXY_regionalParams(LONG packetHandle, struct RoadUserChargingConfigMessageCommon_NodeAttributeSetXY_regional value, char oldPath[])
{
  char newPath[300]; 
  int i;
  int result;

  result = 0;

  value.length = C2xGetTokenInt(packetHandle, "RoadUserChargingConfigMessage", oldPath);
  if((result = CheckLastError("RoadUserChargingConfigMessage", gkFuncRefGet, result))==0)
  {
    for(i=0; i<value.length; i++)
    {
      snprintf(newPath, elcount(newPath), "%s[%d]", oldPath, i);
      GetRoadUserChargingConfigMessageCommon_RegionalExtension_Reg_NodeAttributeSetXYParams(packetHandle, value.arrayValue[i], newPath);
      result = CheckLastError("RoadUserChargingConfigMessage", gkFuncRefGet, result);
    }
  }
  return result;
}

int SetRoadUserChargingConfigMessageCommon_NodeAttributeSetXY_regionalParams(LONG packetHandle, struct RoadUserChargingConfigMessageCommon_NodeAttributeSetXY_regional value, char oldPath[])
{
  char newPath[300]; 
  int i;
  int result;

  result = 0;

  C2xRemoveToken(packetHandle, "RoadUserChargingConfigMessage", oldPath);
  for(i=0; i<value.length; i++)
  {
    snprintf(newPath, elcount(newPath), "%s[%d]", oldPath, i);
    SetRoadUserChargingConfigMessageCommon_RegionalExtension_Reg_NodeAttributeSetXYParams(packetHandle, value.arrayValue[i], newPath);
    result = CheckLastError("RoadUserChargingConfigMessage", gkFuncRefGet, result);
  }
  return result;
}

int GetRoadUserChargingConfigMessageCommon_NodeAttributeSetXYParams(LONG packetHandle, struct RoadUserChargingConfigMessageCommon_NodeAttributeSetXY value, char oldPath[])
{
  char newPath[300];
  int result;

  result = 0;

  snprintf(newPath, elcount(newPath), "%s.%s", oldPath, "localNode");
  value.localNode.isValidFlag = C2xIsTokenAvailable(packetHandle, "RoadUserChargingConfigMessage", newPath);
  if(value.localNode.isValidFlag==1)
  {
    GetRoadUserChargingConfigMessageCommon_NodeAttributeXYListParams(packetHandle, value.localNode, newPath);
    result = CheckLastError("RoadUserChargingConfigMessage", gkFuncRefGet, result);
  }
  snprintf(newPath, elcount(newPath), "%s.%s", oldPath, "disabled");
  value.disabled.isValidFlag = C2xIsTokenAvailable(packetHandle, "RoadUserChargingConfigMessage", newPath);
  if(value.disabled.isValidFlag==1)
  {
    GetRoadUserChargingConfigMessageCommon_SegmentAttributeXYListParams(packetHandle, value.disabled, newPath);
    result = CheckLastError("RoadUserChargingConfigMessage", gkFuncRefGet, result);
  }
  snprintf(newPath, elcount(newPath), "%s.%s", oldPath, "enabled");
  value.enabled.isValidFlag = C2xIsTokenAvailable(packetHandle, "RoadUserChargingConfigMessage", newPath);
  if(value.enabled.isValidFlag==1)
  {
    GetRoadUserChargingConfigMessageCommon_SegmentAttributeXYListParams(packetHandle, value.enabled, newPath);
    result = CheckLastError("RoadUserChargingConfigMessage", gkFuncRefGet, result);
  }
  snprintf(newPath, elcount(newPath), "%s.%s", oldPath, "data");
  value.data.isValidFlag = C2xIsTokenAvailable(packetHandle, "RoadUserChargingConfigMessage", newPath);
  if(value.data.isValidFlag==1)
  {
    GetRoadUserChargingConfigMessageCommon_LaneDataAttributeListParams(packetHandle, value.data, newPath);
    result = CheckLastError("RoadUserChargingConfigMessage", gkFuncRefGet, result);
  }
  snprintf(newPath, elcount(newPath), "%s.%s", oldPath, "dWidth");
  value.dWidth.isValidFlag = C2xIsTokenAvailable(packetHandle, "RoadUserChargingConfigMessage", newPath);
  if(value.dWidth.isValidFlag==1)
  {
    value.dWidth.value = C2xGetTokenInt(packetHandle, "RoadUserChargingConfigMessage", newPath);
    result = CheckLastError("RoadUserChargingConfigMessage", gkFuncRefGet, result);
  }
  snprintf(newPath, elcount(newPath), "%s.%s", oldPath, "dElevation");
  value.dElevation.isValidFlag = C2xIsTokenAvailable(packetHandle, "RoadUserChargingConfigMessage", newPath);
  if(value.dElevation.isValidFlag==1)
  {
    value.dElevation.value = C2xGetTokenInt(packetHandle, "RoadUserChargingConfigMessage", newPath);
    result = CheckLastError("RoadUserChargingConfigMessage", gkFuncRefGet, result);
  }
  snprintf(newPath, elcount(newPath), "%s.%s", oldPath, "regional");
  value.regional.isValidFlag = C2xIsTokenAvailable(packetHandle, "RoadUserChargingConfigMessage", newPath);
  if(value.regional.isValidFlag==1)
  {
    GetRoadUserChargingConfigMessageCommon_NodeAttributeSetXY_regionalParams(packetHandle, value.regional, newPath);
    result = CheckLastError("RoadUserChargingConfigMessage", gkFuncRefGet, result);
  }
  return result;
}

int SetRoadUserChargingConfigMessageCommon_NodeAttributeSetXYParams(LONG packetHandle, struct RoadUserChargingConfigMessageCommon_NodeAttributeSetXY value, char oldPath[])
{
  char newPath[300];
  int result;

  result = 0;

  snprintf(newPath, elcount(newPath), "%s.%s", oldPath, "localNode");
  if(value.localNode.isValidFlag==1)
  {
    SetRoadUserChargingConfigMessageCommon_NodeAttributeXYListParams(packetHandle, value.localNode, newPath);
    result = CheckLastError("RoadUserChargingConfigMessage", gkFuncRefGet, result);
  }
  else
  {
    if( C2xIsTokenAvailable(packetHandle, "RoadUserChargingConfigMessage", newPath) )
    {
      C2xRemoveToken(packetHandle, "RoadUserChargingConfigMessage", newPath);
    }
  }

  snprintf(newPath, elcount(newPath), "%s.%s", oldPath, "disabled");
  if(value.disabled.isValidFlag==1)
  {
    SetRoadUserChargingConfigMessageCommon_SegmentAttributeXYListParams(packetHandle, value.disabled, newPath);
    result = CheckLastError("RoadUserChargingConfigMessage", gkFuncRefGet, result);
  }
  else
  {
    if( C2xIsTokenAvailable(packetHandle, "RoadUserChargingConfigMessage", newPath) )
    {
      C2xRemoveToken(packetHandle, "RoadUserChargingConfigMessage", newPath);
    }
  }

  snprintf(newPath, elcount(newPath), "%s.%s", oldPath, "enabled");
  if(value.enabled.isValidFlag==1)
  {
    SetRoadUserChargingConfigMessageCommon_SegmentAttributeXYListParams(packetHandle, value.enabled, newPath);
    result = CheckLastError("RoadUserChargingConfigMessage", gkFuncRefGet, result);
  }
  else
  {
    if( C2xIsTokenAvailable(packetHandle, "RoadUserChargingConfigMessage", newPath) )
    {
      C2xRemoveToken(packetHandle, "RoadUserChargingConfigMessage", newPath);
    }
  }

  snprintf(newPath, elcount(newPath), "%s.%s", oldPath, "data");
  if(value.data.isValidFlag==1)
  {
    SetRoadUserChargingConfigMessageCommon_LaneDataAttributeListParams(packetHandle, value.data, newPath);
    result = CheckLastError("RoadUserChargingConfigMessage", gkFuncRefGet, result);
  }
  else
  {
    if( C2xIsTokenAvailable(packetHandle, "RoadUserChargingConfigMessage", newPath) )
    {
      C2xRemoveToken(packetHandle, "RoadUserChargingConfigMessage", newPath);
    }
  }

  snprintf(newPath, elcount(newPath), "%s.%s", oldPath, "dWidth");
  if(value.dWidth.isValidFlag==1)
  {
    C2xSetTokenInt(packetHandle, "RoadUserChargingConfigMessage", newPath, value.dWidth.value);
    result = CheckLastError("RoadUserChargingConfigMessage", gkFuncRefGet, result);
  }
  else
  {
    if( C2xIsTokenAvailable(packetHandle, "RoadUserChargingConfigMessage", newPath) )
    {
      C2xRemoveToken(packetHandle, "RoadUserChargingConfigMessage", newPath);
    }
  }

  snprintf(newPath, elcount(newPath), "%s.%s", oldPath, "dElevation");
  if(value.dElevation.isValidFlag==1)
  {
    C2xSetTokenInt(packetHandle, "RoadUserChargingConfigMessage", newPath, value.dElevation.value);
    result = CheckLastError("RoadUserChargingConfigMessage", gkFuncRefGet, result);
  }
  else
  {
    if( C2xIsTokenAvailable(packetHandle, "RoadUserChargingConfigMessage", newPath) )
    {
      C2xRemoveToken(packetHandle, "RoadUserChargingConfigMessage", newPath);
    }
  }

  snprintf(newPath, elcount(newPath), "%s.%s", oldPath, "regional");
  if(value.regional.isValidFlag==1)
  {
    SetRoadUserChargingConfigMessageCommon_NodeAttributeSetXY_regionalParams(packetHandle, value.regional, newPath);
    result = CheckLastError("RoadUserChargingConfigMessage", gkFuncRefGet, result);
  }
  else
  {
    if( C2xIsTokenAvailable(packetHandle, "RoadUserChargingConfigMessage", newPath) )
    {
      C2xRemoveToken(packetHandle, "RoadUserChargingConfigMessage", newPath);
    }
  }

  return result;
}

int GetRoadUserChargingConfigMessageCommon_NodeXYParams(LONG packetHandle, struct RoadUserChargingConfigMessageCommon_NodeXY value, char oldPath[])
{
  char newPath[300];
  int result;

  result = 0;

  snprintf(newPath, elcount(newPath), "%s.%s", oldPath, "delta");
  GetRoadUserChargingConfigMessageCommon_NodeOffsetPointXYParams(packetHandle, value.delta, newPath);
  result = CheckLastError("RoadUserChargingConfigMessage", gkFuncRefGet, result);

  snprintf(newPath, elcount(newPath), "%s.%s", oldPath, "attributes");
  value.attributes.isValidFlag = C2xIsTokenAvailable(packetHandle, "RoadUserChargingConfigMessage", newPath);
  if(value.attributes.isValidFlag==1)
  {
    GetRoadUserChargingConfigMessageCommon_NodeAttributeSetXYParams(packetHandle, value.attributes, newPath);
    result = CheckLastError("RoadUserChargingConfigMessage", gkFuncRefGet, result);
  }
  return result;
}

int SetRoadUserChargingConfigMessageCommon_NodeXYParams(LONG packetHandle, struct RoadUserChargingConfigMessageCommon_NodeXY value, char oldPath[])
{
  char newPath[300];
  int result;

  result = 0;

  snprintf(newPath, elcount(newPath), "%s.%s", oldPath, "delta");
  SetRoadUserChargingConfigMessageCommon_NodeOffsetPointXYParams(packetHandle, value.delta, newPath);
  result = CheckLastError("RoadUserChargingConfigMessage", gkFuncRefGet, result);

  snprintf(newPath, elcount(newPath), "%s.%s", oldPath, "attributes");
  if(value.attributes.isValidFlag==1)
  {
    SetRoadUserChargingConfigMessageCommon_NodeAttributeSetXYParams(packetHandle, value.attributes, newPath);
    result = CheckLastError("RoadUserChargingConfigMessage", gkFuncRefGet, result);
  }
  else
  {
    if( C2xIsTokenAvailable(packetHandle, "RoadUserChargingConfigMessage", newPath) )
    {
      C2xRemoveToken(packetHandle, "RoadUserChargingConfigMessage", newPath);
    }
  }

  return result;
}

int GetRoadUserChargingConfigMessageCommon_NodeSetXYParams(LONG packetHandle, struct RoadUserChargingConfigMessageCommon_NodeSetXY value, char oldPath[])
{
  char newPath[300]; 
  int i;
  int result;

  result = 0;

  value.length = C2xGetTokenInt(packetHandle, "RoadUserChargingConfigMessage", oldPath);
  if((result = CheckLastError("RoadUserChargingConfigMessage", gkFuncRefGet, result))==0)
  {
    for(i=0; i<value.length; i++)
    {
      snprintf(newPath, elcount(newPath), "%s[%d]", oldPath, i);
      GetRoadUserChargingConfigMessageCommon_NodeXYParams(packetHandle, value.arrayValue[i], newPath);
      result = CheckLastError("RoadUserChargingConfigMessage", gkFuncRefGet, result);
    }
  }
  return result;
}

int SetRoadUserChargingConfigMessageCommon_NodeSetXYParams(LONG packetHandle, struct RoadUserChargingConfigMessageCommon_NodeSetXY value, char oldPath[])
{
  char newPath[300]; 
  int i;
  int result;

  result = 0;

  C2xRemoveToken(packetHandle, "RoadUserChargingConfigMessage", oldPath);
  for(i=0; i<value.length; i++)
  {
    snprintf(newPath, elcount(newPath), "%s[%d]", oldPath, i);
    SetRoadUserChargingConfigMessageCommon_NodeXYParams(packetHandle, value.arrayValue[i], newPath);
    result = CheckLastError("RoadUserChargingConfigMessage", gkFuncRefGet, result);
  }
  return result;
}

int GetRoadUserChargingConfigMessageCommon_ComputedLane_offsetXaxisParams(LONG packetHandle, struct RoadUserChargingConfigMessageCommon_ComputedLane_offsetXaxis value, char oldPath[])
{
  char newPath[300];
  int result;

  result = 0;

  value.choice = C2xGetTokenInt(packetHandle, "RoadUserChargingConfigMessage", oldPath);

  switch(value.choice)
  {
    case 0:
    {
      snprintf(newPath, elcount(newPath), "%s.%s", oldPath, "small");
      value.small = C2xGetTokenInt(packetHandle, "RoadUserChargingConfigMessage", newPath);
      result = CheckLastError("RoadUserChargingConfigMessage", gkFuncRefGet, result);
    }
    break;
    case 1:
    {
      snprintf(newPath, elcount(newPath), "%s.%s", oldPath, "large");
      value.large = C2xGetTokenInt(packetHandle, "RoadUserChargingConfigMessage", newPath);
      result = CheckLastError("RoadUserChargingConfigMessage", gkFuncRefGet, result);
    }
    break;
  }
  return result;
}

int SetRoadUserChargingConfigMessageCommon_ComputedLane_offsetXaxisParams(LONG packetHandle, struct RoadUserChargingConfigMessageCommon_ComputedLane_offsetXaxis value, char oldPath[])
{
  char newPath[300];
  int result;

  result = 0;

  switch(value.choice)
  {
    case 0:
    {
      snprintf(newPath, elcount(newPath), "%s.%s", oldPath, "small");
      C2xSetTokenInt(packetHandle, "RoadUserChargingConfigMessage", newPath, value.small);
      result = CheckLastError("RoadUserChargingConfigMessage", gkFuncRefGet, result);
    }
    break;
    case 1:
    {
      snprintf(newPath, elcount(newPath), "%s.%s", oldPath, "large");
      C2xSetTokenInt(packetHandle, "RoadUserChargingConfigMessage", newPath, value.large);
      result = CheckLastError("RoadUserChargingConfigMessage", gkFuncRefGet, result);
    }
    break;
  }
  return result;
}

int GetRoadUserChargingConfigMessageCommon_ComputedLane_offsetYaxisParams(LONG packetHandle, struct RoadUserChargingConfigMessageCommon_ComputedLane_offsetYaxis value, char oldPath[])
{
  char newPath[300];
  int result;

  result = 0;

  value.choice = C2xGetTokenInt(packetHandle, "RoadUserChargingConfigMessage", oldPath);

  switch(value.choice)
  {
    case 0:
    {
      snprintf(newPath, elcount(newPath), "%s.%s", oldPath, "small");
      value.small = C2xGetTokenInt(packetHandle, "RoadUserChargingConfigMessage", newPath);
      result = CheckLastError("RoadUserChargingConfigMessage", gkFuncRefGet, result);
    }
    break;
    case 1:
    {
      snprintf(newPath, elcount(newPath), "%s.%s", oldPath, "large");
      value.large = C2xGetTokenInt(packetHandle, "RoadUserChargingConfigMessage", newPath);
      result = CheckLastError("RoadUserChargingConfigMessage", gkFuncRefGet, result);
    }
    break;
  }
  return result;
}

int SetRoadUserChargingConfigMessageCommon_ComputedLane_offsetYaxisParams(LONG packetHandle, struct RoadUserChargingConfigMessageCommon_ComputedLane_offsetYaxis value, char oldPath[])
{
  char newPath[300];
  int result;

  result = 0;

  switch(value.choice)
  {
    case 0:
    {
      snprintf(newPath, elcount(newPath), "%s.%s", oldPath, "small");
      C2xSetTokenInt(packetHandle, "RoadUserChargingConfigMessage", newPath, value.small);
      result = CheckLastError("RoadUserChargingConfigMessage", gkFuncRefGet, result);
    }
    break;
    case 1:
    {
      snprintf(newPath, elcount(newPath), "%s.%s", oldPath, "large");
      C2xSetTokenInt(packetHandle, "RoadUserChargingConfigMessage", newPath, value.large);
      result = CheckLastError("RoadUserChargingConfigMessage", gkFuncRefGet, result);
    }
    break;
  }
  return result;
}

int GetRoadUserChargingConfigMessageCommon_RegionalExtension_Reg_ComputedLaneParams(LONG packetHandle, struct RoadUserChargingConfigMessageCommon_RegionalExtension_Reg_ComputedLane value, char oldPath[])
{
  char newPath[300];
  int result;

  result = 0;

  snprintf(newPath, elcount(newPath), "%s.%s", oldPath, "regionId");
  value.regionId = C2xGetTokenInt(packetHandle, "RoadUserChargingConfigMessage", newPath);
  result = CheckLastError("RoadUserChargingConfigMessage", gkFuncRefGet, result);

  return result;
}

int SetRoadUserChargingConfigMessageCommon_RegionalExtension_Reg_ComputedLaneParams(LONG packetHandle, struct RoadUserChargingConfigMessageCommon_RegionalExtension_Reg_ComputedLane value, char oldPath[])
{
  char newPath[300];
  int result;

  result = 0;


  return result;
}

int GetRoadUserChargingConfigMessageCommon_ComputedLane_regionalParams(LONG packetHandle, struct RoadUserChargingConfigMessageCommon_ComputedLane_regional value, char oldPath[])
{
  char newPath[300]; 
  int i;
  int result;

  result = 0;

  value.length = C2xGetTokenInt(packetHandle, "RoadUserChargingConfigMessage", oldPath);
  if((result = CheckLastError("RoadUserChargingConfigMessage", gkFuncRefGet, result))==0)
  {
    for(i=0; i<value.length; i++)
    {
      snprintf(newPath, elcount(newPath), "%s[%d]", oldPath, i);
      GetRoadUserChargingConfigMessageCommon_RegionalExtension_Reg_ComputedLaneParams(packetHandle, value.arrayValue[i], newPath);
      result = CheckLastError("RoadUserChargingConfigMessage", gkFuncRefGet, result);
    }
  }
  return result;
}

int SetRoadUserChargingConfigMessageCommon_ComputedLane_regionalParams(LONG packetHandle, struct RoadUserChargingConfigMessageCommon_ComputedLane_regional value, char oldPath[])
{
  char newPath[300]; 
  int i;
  int result;

  result = 0;

  C2xRemoveToken(packetHandle, "RoadUserChargingConfigMessage", oldPath);
  for(i=0; i<value.length; i++)
  {
    snprintf(newPath, elcount(newPath), "%s[%d]", oldPath, i);
    SetRoadUserChargingConfigMessageCommon_RegionalExtension_Reg_ComputedLaneParams(packetHandle, value.arrayValue[i], newPath);
    result = CheckLastError("RoadUserChargingConfigMessage", gkFuncRefGet, result);
  }
  return result;
}

int GetRoadUserChargingConfigMessageCommon_ComputedLaneParams(LONG packetHandle, struct RoadUserChargingConfigMessageCommon_ComputedLane value, char oldPath[])
{
  char newPath[300];
  int result;

  result = 0;

  snprintf(newPath, elcount(newPath), "%s.%s", oldPath, "referenceLaneId");
  value.referenceLaneId = C2xGetTokenInt(packetHandle, "RoadUserChargingConfigMessage", newPath);
  result = CheckLastError("RoadUserChargingConfigMessage", gkFuncRefGet, result);

  snprintf(newPath, elcount(newPath), "%s.%s", oldPath, "offsetXaxis");
  GetRoadUserChargingConfigMessageCommon_ComputedLane_offsetXaxisParams(packetHandle, value.offsetXaxis, newPath);
  result = CheckLastError("RoadUserChargingConfigMessage", gkFuncRefGet, result);

  snprintf(newPath, elcount(newPath), "%s.%s", oldPath, "offsetYaxis");
  GetRoadUserChargingConfigMessageCommon_ComputedLane_offsetYaxisParams(packetHandle, value.offsetYaxis, newPath);
  result = CheckLastError("RoadUserChargingConfigMessage", gkFuncRefGet, result);

  snprintf(newPath, elcount(newPath), "%s.%s", oldPath, "rotateXY");
  value.rotateXY.isValidFlag = C2xIsTokenAvailable(packetHandle, "RoadUserChargingConfigMessage", newPath);
  if(value.rotateXY.isValidFlag==1)
  {
    value.rotateXY.value = C2xGetTokenInt(packetHandle, "RoadUserChargingConfigMessage", newPath);
    result = CheckLastError("RoadUserChargingConfigMessage", gkFuncRefGet, result);
  }
  snprintf(newPath, elcount(newPath), "%s.%s", oldPath, "scaleXaxis");
  value.scaleXaxis.isValidFlag = C2xIsTokenAvailable(packetHandle, "RoadUserChargingConfigMessage", newPath);
  if(value.scaleXaxis.isValidFlag==1)
  {
    value.scaleXaxis.value = C2xGetTokenInt(packetHandle, "RoadUserChargingConfigMessage", newPath);
    result = CheckLastError("RoadUserChargingConfigMessage", gkFuncRefGet, result);
  }
  snprintf(newPath, elcount(newPath), "%s.%s", oldPath, "scaleYaxis");
  value.scaleYaxis.isValidFlag = C2xIsTokenAvailable(packetHandle, "RoadUserChargingConfigMessage", newPath);
  if(value.scaleYaxis.isValidFlag==1)
  {
    value.scaleYaxis.value = C2xGetTokenInt(packetHandle, "RoadUserChargingConfigMessage", newPath);
    result = CheckLastError("RoadUserChargingConfigMessage", gkFuncRefGet, result);
  }
  snprintf(newPath, elcount(newPath), "%s.%s", oldPath, "regional");
  value.regional.isValidFlag = C2xIsTokenAvailable(packetHandle, "RoadUserChargingConfigMessage", newPath);
  if(value.regional.isValidFlag==1)
  {
    GetRoadUserChargingConfigMessageCommon_ComputedLane_regionalParams(packetHandle, value.regional, newPath);
    result = CheckLastError("RoadUserChargingConfigMessage", gkFuncRefGet, result);
  }
  return result;
}

int SetRoadUserChargingConfigMessageCommon_ComputedLaneParams(LONG packetHandle, struct RoadUserChargingConfigMessageCommon_ComputedLane value, char oldPath[])
{
  char newPath[300];
  int result;

  result = 0;

  snprintf(newPath, elcount(newPath), "%s.%s", oldPath, "referenceLaneId");
  C2xSetTokenInt(packetHandle, "RoadUserChargingConfigMessage", newPath, value.referenceLaneId);
  result = CheckLastError("RoadUserChargingConfigMessage", gkFuncRefGet, result);

  snprintf(newPath, elcount(newPath), "%s.%s", oldPath, "offsetXaxis");
  SetRoadUserChargingConfigMessageCommon_ComputedLane_offsetXaxisParams(packetHandle, value.offsetXaxis, newPath);
  result = CheckLastError("RoadUserChargingConfigMessage", gkFuncRefGet, result);

  snprintf(newPath, elcount(newPath), "%s.%s", oldPath, "offsetYaxis");
  SetRoadUserChargingConfigMessageCommon_ComputedLane_offsetYaxisParams(packetHandle, value.offsetYaxis, newPath);
  result = CheckLastError("RoadUserChargingConfigMessage", gkFuncRefGet, result);

  snprintf(newPath, elcount(newPath), "%s.%s", oldPath, "rotateXY");
  if(value.rotateXY.isValidFlag==1)
  {
    C2xSetTokenInt(packetHandle, "RoadUserChargingConfigMessage", newPath, value.rotateXY.value);
    result = CheckLastError("RoadUserChargingConfigMessage", gkFuncRefGet, result);
  }
  else
  {
    if( C2xIsTokenAvailable(packetHandle, "RoadUserChargingConfigMessage", newPath) )
    {
      C2xRemoveToken(packetHandle, "RoadUserChargingConfigMessage", newPath);
    }
  }

  snprintf(newPath, elcount(newPath), "%s.%s", oldPath, "scaleXaxis");
  if(value.scaleXaxis.isValidFlag==1)
  {
    C2xSetTokenInt(packetHandle, "RoadUserChargingConfigMessage", newPath, value.scaleXaxis.value);
    result = CheckLastError("RoadUserChargingConfigMessage", gkFuncRefGet, result);
  }
  else
  {
    if( C2xIsTokenAvailable(packetHandle, "RoadUserChargingConfigMessage", newPath) )
    {
      C2xRemoveToken(packetHandle, "RoadUserChargingConfigMessage", newPath);
    }
  }

  snprintf(newPath, elcount(newPath), "%s.%s", oldPath, "scaleYaxis");
  if(value.scaleYaxis.isValidFlag==1)
  {
    C2xSetTokenInt(packetHandle, "RoadUserChargingConfigMessage", newPath, value.scaleYaxis.value);
    result = CheckLastError("RoadUserChargingConfigMessage", gkFuncRefGet, result);
  }
  else
  {
    if( C2xIsTokenAvailable(packetHandle, "RoadUserChargingConfigMessage", newPath) )
    {
      C2xRemoveToken(packetHandle, "RoadUserChargingConfigMessage", newPath);
    }
  }

  snprintf(newPath, elcount(newPath), "%s.%s", oldPath, "regional");
  if(value.regional.isValidFlag==1)
  {
    SetRoadUserChargingConfigMessageCommon_ComputedLane_regionalParams(packetHandle, value.regional, newPath);
    result = CheckLastError("RoadUserChargingConfigMessage", gkFuncRefGet, result);
  }
  else
  {
    if( C2xIsTokenAvailable(packetHandle, "RoadUserChargingConfigMessage", newPath) )
    {
      C2xRemoveToken(packetHandle, "RoadUserChargingConfigMessage", newPath);
    }
  }

  return result;
}

int GetRoadUserChargingConfigMessageCommon_NodeListXYParams(LONG packetHandle, struct RoadUserChargingConfigMessageCommon_NodeListXY value, char oldPath[])
{
  char newPath[300];
  int result;

  result = 0;

  value.choice = C2xGetTokenInt(packetHandle, "RoadUserChargingConfigMessage", oldPath);

  switch(value.choice)
  {
    case 0:
    {
      snprintf(newPath, elcount(newPath), "%s.%s", oldPath, "nodes");
      GetRoadUserChargingConfigMessageCommon_NodeSetXYParams(packetHandle, value.nodes, newPath);
      result = CheckLastError("RoadUserChargingConfigMessage", gkFuncRefGet, result);
    }
    break;
    case 1:
    {
      snprintf(newPath, elcount(newPath), "%s.%s", oldPath, "computed");
      GetRoadUserChargingConfigMessageCommon_ComputedLaneParams(packetHandle, value.computed, newPath);
      result = CheckLastError("RoadUserChargingConfigMessage", gkFuncRefGet, result);
    }
    break;
  }
  return result;
}

int SetRoadUserChargingConfigMessageCommon_NodeListXYParams(LONG packetHandle, struct RoadUserChargingConfigMessageCommon_NodeListXY value, char oldPath[])
{
  char newPath[300];
  int result;

  result = 0;

  switch(value.choice)
  {
    case 0:
    {
      snprintf(newPath, elcount(newPath), "%s.%s", oldPath, "nodes");
      SetRoadUserChargingConfigMessageCommon_NodeSetXYParams(packetHandle, value.nodes, newPath);
      result = CheckLastError("RoadUserChargingConfigMessage", gkFuncRefGet, result);
    }
    break;
    case 1:
    {
      snprintf(newPath, elcount(newPath), "%s.%s", oldPath, "computed");
      SetRoadUserChargingConfigMessageCommon_ComputedLaneParams(packetHandle, value.computed, newPath);
      result = CheckLastError("RoadUserChargingConfigMessage", gkFuncRefGet, result);
    }
    break;
  }
  return result;
}

int GetRoadUserChargingConfigMessageTravelerInformation_ShapePointSetParams(LONG packetHandle, struct RoadUserChargingConfigMessageTravelerInformation_ShapePointSet value, char oldPath[])
{
  char newPath[300];
  int result;

  result = 0;

  snprintf(newPath, elcount(newPath), "%s.%s", oldPath, "anchor");
  value.anchor.isValidFlag = C2xIsTokenAvailable(packetHandle, "RoadUserChargingConfigMessage", newPath);
  if(value.anchor.isValidFlag==1)
  {
    GetRoadUserChargingConfigMessageCommon_Position3DParams(packetHandle, value.anchor, newPath);
    result = CheckLastError("RoadUserChargingConfigMessage", gkFuncRefGet, result);
  }
  snprintf(newPath, elcount(newPath), "%s.%s", oldPath, "laneWidth");
  value.laneWidth.isValidFlag = C2xIsTokenAvailable(packetHandle, "RoadUserChargingConfigMessage", newPath);
  if(value.laneWidth.isValidFlag==1)
  {
    value.laneWidth.value = C2xGetTokenInt(packetHandle, "RoadUserChargingConfigMessage", newPath);
    result = CheckLastError("RoadUserChargingConfigMessage", gkFuncRefGet, result);
  }
  snprintf(newPath, elcount(newPath), "%s.%s", oldPath, "directionality");
  value.directionality.isValidFlag = C2xIsTokenAvailable(packetHandle, "RoadUserChargingConfigMessage", newPath);
  if(value.directionality.isValidFlag==1)
  {
    value.directionality.value = C2xGetTokenInt(packetHandle, "RoadUserChargingConfigMessage", newPath);
    result = CheckLastError("RoadUserChargingConfigMessage", gkFuncRefGet, result);
  }
  snprintf(newPath, elcount(newPath), "%s.%s", oldPath, "nodeList");
  GetRoadUserChargingConfigMessageCommon_NodeListXYParams(packetHandle, value.nodeList, newPath);
  result = CheckLastError("RoadUserChargingConfigMessage", gkFuncRefGet, result);

  return result;
}

int SetRoadUserChargingConfigMessageTravelerInformation_ShapePointSetParams(LONG packetHandle, struct RoadUserChargingConfigMessageTravelerInformation_ShapePointSet value, char oldPath[])
{
  char newPath[300];
  int result;

  result = 0;

  snprintf(newPath, elcount(newPath), "%s.%s", oldPath, "anchor");
  if(value.anchor.isValidFlag==1)
  {
    SetRoadUserChargingConfigMessageCommon_Position3DParams(packetHandle, value.anchor, newPath);
    result = CheckLastError("RoadUserChargingConfigMessage", gkFuncRefGet, result);
  }
  else
  {
    if( C2xIsTokenAvailable(packetHandle, "RoadUserChargingConfigMessage", newPath) )
    {
      C2xRemoveToken(packetHandle, "RoadUserChargingConfigMessage", newPath);
    }
  }

  snprintf(newPath, elcount(newPath), "%s.%s", oldPath, "laneWidth");
  if(value.laneWidth.isValidFlag==1)
  {
    C2xSetTokenInt(packetHandle, "RoadUserChargingConfigMessage", newPath, value.laneWidth.value);
    result = CheckLastError("RoadUserChargingConfigMessage", gkFuncRefGet, result);
  }
  else
  {
    if( C2xIsTokenAvailable(packetHandle, "RoadUserChargingConfigMessage", newPath) )
    {
      C2xRemoveToken(packetHandle, "RoadUserChargingConfigMessage", newPath);
    }
  }

  snprintf(newPath, elcount(newPath), "%s.%s", oldPath, "directionality");
  if(value.directionality.isValidFlag==1)
  {
    C2xSetTokenInt(packetHandle, "RoadUserChargingConfigMessage", newPath, value.directionality.value);
    result = CheckLastError("RoadUserChargingConfigMessage", gkFuncRefGet, result);
  }
  else
  {
    if( C2xIsTokenAvailable(packetHandle, "RoadUserChargingConfigMessage", newPath) )
    {
      C2xRemoveToken(packetHandle, "RoadUserChargingConfigMessage", newPath);
    }
  }

  snprintf(newPath, elcount(newPath), "%s.%s", oldPath, "nodeList");
  SetRoadUserChargingConfigMessageCommon_NodeListXYParams(packetHandle, value.nodeList, newPath);
  result = CheckLastError("RoadUserChargingConfigMessage", gkFuncRefGet, result);

  return result;
}

int GetRoadUserChargingConfigMessageTravelerInformation_CircleParams(LONG packetHandle, struct RoadUserChargingConfigMessageTravelerInformation_Circle value, char oldPath[])
{
  char newPath[300];
  int result;

  result = 0;

  snprintf(newPath, elcount(newPath), "%s.%s", oldPath, "center");
  GetRoadUserChargingConfigMessageCommon_Position3DParams(packetHandle, value.center, newPath);
  result = CheckLastError("RoadUserChargingConfigMessage", gkFuncRefGet, result);

  snprintf(newPath, elcount(newPath), "%s.%s", oldPath, "radius");
  value.radius = C2xGetTokenInt(packetHandle, "RoadUserChargingConfigMessage", newPath);
  result = CheckLastError("RoadUserChargingConfigMessage", gkFuncRefGet, result);

  snprintf(newPath, elcount(newPath), "%s.%s", oldPath, "units");
  value.units = C2xGetTokenInt(packetHandle, "RoadUserChargingConfigMessage", newPath);
  result = CheckLastError("RoadUserChargingConfigMessage", gkFuncRefGet, result);

  return result;
}

int SetRoadUserChargingConfigMessageTravelerInformation_CircleParams(LONG packetHandle, struct RoadUserChargingConfigMessageTravelerInformation_Circle value, char oldPath[])
{
  char newPath[300];
  int result;

  result = 0;

  snprintf(newPath, elcount(newPath), "%s.%s", oldPath, "center");
  SetRoadUserChargingConfigMessageCommon_Position3DParams(packetHandle, value.center, newPath);
  result = CheckLastError("RoadUserChargingConfigMessage", gkFuncRefGet, result);

  snprintf(newPath, elcount(newPath), "%s.%s", oldPath, "radius");
  C2xSetTokenInt(packetHandle, "RoadUserChargingConfigMessage", newPath, value.radius);
  result = CheckLastError("RoadUserChargingConfigMessage", gkFuncRefGet, result);

  snprintf(newPath, elcount(newPath), "%s.%s", oldPath, "units");
  C2xSetTokenInt(packetHandle, "RoadUserChargingConfigMessage", newPath, value.units);
  result = CheckLastError("RoadUserChargingConfigMessage", gkFuncRefGet, result);

  return result;
}

int GetRoadUserChargingConfigMessageTravelerInformation_RegionOffsetsParams(LONG packetHandle, struct RoadUserChargingConfigMessageTravelerInformation_RegionOffsets value, char oldPath[])
{
  char newPath[300];
  int result;

  result = 0;

  snprintf(newPath, elcount(newPath), "%s.%s", oldPath, "xOffset");
  value.xOffset = C2xGetTokenInt(packetHandle, "RoadUserChargingConfigMessage", newPath);
  result = CheckLastError("RoadUserChargingConfigMessage", gkFuncRefGet, result);

  snprintf(newPath, elcount(newPath), "%s.%s", oldPath, "yOffset");
  value.yOffset = C2xGetTokenInt(packetHandle, "RoadUserChargingConfigMessage", newPath);
  result = CheckLastError("RoadUserChargingConfigMessage", gkFuncRefGet, result);

  snprintf(newPath, elcount(newPath), "%s.%s", oldPath, "zOffset");
  value.zOffset.isValidFlag = C2xIsTokenAvailable(packetHandle, "RoadUserChargingConfigMessage", newPath);
  if(value.zOffset.isValidFlag==1)
  {
    value.zOffset.value = C2xGetTokenInt(packetHandle, "RoadUserChargingConfigMessage", newPath);
    result = CheckLastError("RoadUserChargingConfigMessage", gkFuncRefGet, result);
  }
  return result;
}

int SetRoadUserChargingConfigMessageTravelerInformation_RegionOffsetsParams(LONG packetHandle, struct RoadUserChargingConfigMessageTravelerInformation_RegionOffsets value, char oldPath[])
{
  char newPath[300];
  int result;

  result = 0;

  snprintf(newPath, elcount(newPath), "%s.%s", oldPath, "xOffset");
  C2xSetTokenInt(packetHandle, "RoadUserChargingConfigMessage", newPath, value.xOffset);
  result = CheckLastError("RoadUserChargingConfigMessage", gkFuncRefGet, result);

  snprintf(newPath, elcount(newPath), "%s.%s", oldPath, "yOffset");
  C2xSetTokenInt(packetHandle, "RoadUserChargingConfigMessage", newPath, value.yOffset);
  result = CheckLastError("RoadUserChargingConfigMessage", gkFuncRefGet, result);

  snprintf(newPath, elcount(newPath), "%s.%s", oldPath, "zOffset");
  if(value.zOffset.isValidFlag==1)
  {
    C2xSetTokenInt(packetHandle, "RoadUserChargingConfigMessage", newPath, value.zOffset.value);
    result = CheckLastError("RoadUserChargingConfigMessage", gkFuncRefGet, result);
  }
  else
  {
    if( C2xIsTokenAvailable(packetHandle, "RoadUserChargingConfigMessage", newPath) )
    {
      C2xRemoveToken(packetHandle, "RoadUserChargingConfigMessage", newPath);
    }
  }

  return result;
}

int GetRoadUserChargingConfigMessageTravelerInformation_RegionListParams(LONG packetHandle, struct RoadUserChargingConfigMessageTravelerInformation_RegionList value, char oldPath[])
{
  char newPath[300]; 
  int i;
  int result;

  result = 0;

  value.length = C2xGetTokenInt(packetHandle, "RoadUserChargingConfigMessage", oldPath);
  if((result = CheckLastError("RoadUserChargingConfigMessage", gkFuncRefGet, result))==0)
  {
    for(i=0; i<value.length; i++)
    {
      snprintf(newPath, elcount(newPath), "%s[%d]", oldPath, i);
      GetRoadUserChargingConfigMessageTravelerInformation_RegionOffsetsParams(packetHandle, value.arrayValue[i], newPath);
      result = CheckLastError("RoadUserChargingConfigMessage", gkFuncRefGet, result);
    }
  }
  return result;
}

int SetRoadUserChargingConfigMessageTravelerInformation_RegionListParams(LONG packetHandle, struct RoadUserChargingConfigMessageTravelerInformation_RegionList value, char oldPath[])
{
  char newPath[300]; 
  int i;
  int result;

  result = 0;

  C2xRemoveToken(packetHandle, "RoadUserChargingConfigMessage", oldPath);
  for(i=0; i<value.length; i++)
  {
    snprintf(newPath, elcount(newPath), "%s[%d]", oldPath, i);
    SetRoadUserChargingConfigMessageTravelerInformation_RegionOffsetsParams(packetHandle, value.arrayValue[i], newPath);
    result = CheckLastError("RoadUserChargingConfigMessage", gkFuncRefGet, result);
  }
  return result;
}

int GetRoadUserChargingConfigMessageTravelerInformation_RegionPointSetParams(LONG packetHandle, struct RoadUserChargingConfigMessageTravelerInformation_RegionPointSet value, char oldPath[])
{
  char newPath[300];
  int result;

  result = 0;

  snprintf(newPath, elcount(newPath), "%s.%s", oldPath, "anchor");
  value.anchor.isValidFlag = C2xIsTokenAvailable(packetHandle, "RoadUserChargingConfigMessage", newPath);
  if(value.anchor.isValidFlag==1)
  {
    GetRoadUserChargingConfigMessageCommon_Position3DParams(packetHandle, value.anchor, newPath);
    result = CheckLastError("RoadUserChargingConfigMessage", gkFuncRefGet, result);
  }
  snprintf(newPath, elcount(newPath), "%s.%s", oldPath, "scale");
  value.scale.isValidFlag = C2xIsTokenAvailable(packetHandle, "RoadUserChargingConfigMessage", newPath);
  if(value.scale.isValidFlag==1)
  {
    value.scale.value = C2xGetTokenInt(packetHandle, "RoadUserChargingConfigMessage", newPath);
    result = CheckLastError("RoadUserChargingConfigMessage", gkFuncRefGet, result);
  }
  snprintf(newPath, elcount(newPath), "%s.%s", oldPath, "nodeList");
  GetRoadUserChargingConfigMessageTravelerInformation_RegionListParams(packetHandle, value.nodeList, newPath);
  result = CheckLastError("RoadUserChargingConfigMessage", gkFuncRefGet, result);

  return result;
}

int SetRoadUserChargingConfigMessageTravelerInformation_RegionPointSetParams(LONG packetHandle, struct RoadUserChargingConfigMessageTravelerInformation_RegionPointSet value, char oldPath[])
{
  char newPath[300];
  int result;

  result = 0;

  snprintf(newPath, elcount(newPath), "%s.%s", oldPath, "anchor");
  if(value.anchor.isValidFlag==1)
  {
    SetRoadUserChargingConfigMessageCommon_Position3DParams(packetHandle, value.anchor, newPath);
    result = CheckLastError("RoadUserChargingConfigMessage", gkFuncRefGet, result);
  }
  else
  {
    if( C2xIsTokenAvailable(packetHandle, "RoadUserChargingConfigMessage", newPath) )
    {
      C2xRemoveToken(packetHandle, "RoadUserChargingConfigMessage", newPath);
    }
  }

  snprintf(newPath, elcount(newPath), "%s.%s", oldPath, "scale");
  if(value.scale.isValidFlag==1)
  {
    C2xSetTokenInt(packetHandle, "RoadUserChargingConfigMessage", newPath, value.scale.value);
    result = CheckLastError("RoadUserChargingConfigMessage", gkFuncRefGet, result);
  }
  else
  {
    if( C2xIsTokenAvailable(packetHandle, "RoadUserChargingConfigMessage", newPath) )
    {
      C2xRemoveToken(packetHandle, "RoadUserChargingConfigMessage", newPath);
    }
  }

  snprintf(newPath, elcount(newPath), "%s.%s", oldPath, "nodeList");
  SetRoadUserChargingConfigMessageTravelerInformation_RegionListParams(packetHandle, value.nodeList, newPath);
  result = CheckLastError("RoadUserChargingConfigMessage", gkFuncRefGet, result);

  return result;
}

int GetRoadUserChargingConfigMessageTravelerInformation_ValidRegion_areaParams(LONG packetHandle, struct RoadUserChargingConfigMessageTravelerInformation_ValidRegion_area value, char oldPath[])
{
  char newPath[300];
  int result;

  result = 0;

  value.choice = C2xGetTokenInt(packetHandle, "RoadUserChargingConfigMessage", oldPath);

  switch(value.choice)
  {
    case 0:
    {
      snprintf(newPath, elcount(newPath), "%s.%s", oldPath, "shapePointSet");
      GetRoadUserChargingConfigMessageTravelerInformation_ShapePointSetParams(packetHandle, value.shapePointSet, newPath);
      result = CheckLastError("RoadUserChargingConfigMessage", gkFuncRefGet, result);
    }
    break;
    case 1:
    {
      snprintf(newPath, elcount(newPath), "%s.%s", oldPath, "circle");
      GetRoadUserChargingConfigMessageTravelerInformation_CircleParams(packetHandle, value.circle, newPath);
      result = CheckLastError("RoadUserChargingConfigMessage", gkFuncRefGet, result);
    }
    break;
    case 2:
    {
      snprintf(newPath, elcount(newPath), "%s.%s", oldPath, "regionPointSet");
      GetRoadUserChargingConfigMessageTravelerInformation_RegionPointSetParams(packetHandle, value.regionPointSet, newPath);
      result = CheckLastError("RoadUserChargingConfigMessage", gkFuncRefGet, result);
    }
    break;
  }
  return result;
}

int SetRoadUserChargingConfigMessageTravelerInformation_ValidRegion_areaParams(LONG packetHandle, struct RoadUserChargingConfigMessageTravelerInformation_ValidRegion_area value, char oldPath[])
{
  char newPath[300];
  int result;

  result = 0;

  switch(value.choice)
  {
    case 0:
    {
      snprintf(newPath, elcount(newPath), "%s.%s", oldPath, "shapePointSet");
      SetRoadUserChargingConfigMessageTravelerInformation_ShapePointSetParams(packetHandle, value.shapePointSet, newPath);
      result = CheckLastError("RoadUserChargingConfigMessage", gkFuncRefGet, result);
    }
    break;
    case 1:
    {
      snprintf(newPath, elcount(newPath), "%s.%s", oldPath, "circle");
      SetRoadUserChargingConfigMessageTravelerInformation_CircleParams(packetHandle, value.circle, newPath);
      result = CheckLastError("RoadUserChargingConfigMessage", gkFuncRefGet, result);
    }
    break;
    case 2:
    {
      snprintf(newPath, elcount(newPath), "%s.%s", oldPath, "regionPointSet");
      SetRoadUserChargingConfigMessageTravelerInformation_RegionPointSetParams(packetHandle, value.regionPointSet, newPath);
      result = CheckLastError("RoadUserChargingConfigMessage", gkFuncRefGet, result);
    }
    break;
  }
  return result;
}

int GetRoadUserChargingConfigMessageTravelerInformation_ValidRegionParams(LONG packetHandle, struct RoadUserChargingConfigMessageTravelerInformation_ValidRegion value, char oldPath[])
{
  char newPath[300]; 
  int j; 
  int k;
  int result;

  result = 0;

  snprintf(newPath, elcount(newPath), "%s.%s", oldPath, "direction");
  value.direction.isValidFlag = 1;
  value.direction.stringLength = C2xGetTokenLengthBit(packetHandle, "RoadUserChargingConfigMessage", newPath);
  if ((result = CheckLastError("RoadUserChargingConfigMessage", gkFuncRefGet, result))==0)
  {
    if(value.direction.stringLength > 0)
    {
      for(j=0; j<value.direction.stringLength; j++)
      {
        if(C2xGetTokenBitOfBitString(packetHandle, "RoadUserChargingConfigMessage", newPath, j) == 0)
        {
          value.direction.string[j] = '0';
        }
        else if(C2xGetTokenBitOfBitString(packetHandle, "RoadUserChargingConfigMessage", newPath, j) == 1)
        {
          value.direction.string[j] = '1';
        }

        if(value.direction.stringLength == 1)
        {
          value.direction.string[1] = '0';
        }
        result = CheckLastError("RoadUserChargingConfigMessage", gkFuncRefGet, result);
      }
    }
    else
    {
      for(k = value.direction.stringLength+1; k > -1; k--)
      {
        if(value.direction.string[k] == '1')
        {
          value.direction.string[k] = '0';
        }
      }
    }
  }

  snprintf(newPath, elcount(newPath), "%s.%s", oldPath, "extent");
  value.extent.isValidFlag = C2xIsTokenAvailable(packetHandle, "RoadUserChargingConfigMessage", newPath);
  if(value.extent.isValidFlag==1)
  {
    value.extent.value = C2xGetTokenInt(packetHandle, "RoadUserChargingConfigMessage", newPath);
    result = CheckLastError("RoadUserChargingConfigMessage", gkFuncRefGet, result);
  }
  snprintf(newPath, elcount(newPath), "%s.%s", oldPath, "area");
  GetRoadUserChargingConfigMessageTravelerInformation_ValidRegion_areaParams(packetHandle, value.area, newPath);
  result = CheckLastError("RoadUserChargingConfigMessage", gkFuncRefGet, result);

  return result;
}

int SetRoadUserChargingConfigMessageTravelerInformation_ValidRegionParams(LONG packetHandle, struct RoadUserChargingConfigMessageTravelerInformation_ValidRegion value, char oldPath[])
{
  char newPath[300]; 
  int j;
  int result;

  result = 0;

  snprintf(newPath, elcount(newPath), "%s.%s", oldPath, "direction");
    for(j=0; j<value.direction.stringLength; j++)
    {
      if(value.direction.string[j] == '0')
      {
        C2xSetTokenBitOfBitString(packetHandle, "RoadUserChargingConfigMessage", newPath, j, 0);
      }
      else
      {
        C2xSetTokenBitOfBitString(packetHandle, "RoadUserChargingConfigMessage", newPath, j, 1);
      }
      result = CheckLastError("RoadUserChargingConfigMessage", gkFuncRefGet, result);
    }

  snprintf(newPath, elcount(newPath), "%s.%s", oldPath, "extent");
  if(value.extent.isValidFlag==1)
  {
    C2xSetTokenInt(packetHandle, "RoadUserChargingConfigMessage", newPath, value.extent.value);
    result = CheckLastError("RoadUserChargingConfigMessage", gkFuncRefGet, result);
  }
  else
  {
    if( C2xIsTokenAvailable(packetHandle, "RoadUserChargingConfigMessage", newPath) )
    {
      C2xRemoveToken(packetHandle, "RoadUserChargingConfigMessage", newPath);
    }
  }

  snprintf(newPath, elcount(newPath), "%s.%s", oldPath, "area");
  SetRoadUserChargingConfigMessageTravelerInformation_ValidRegion_areaParams(packetHandle, value.area, newPath);
  result = CheckLastError("RoadUserChargingConfigMessage", gkFuncRefGet, result);

  return result;
}

int GetRoadUserChargingConfigMessageAreaParams(LONG packetHandle, struct RoadUserChargingConfigMessageArea value, char oldPath[])
{
  char newPath[300];
  int i;
  int result;

  result = 0;

  snprintf(newPath, elcount(newPath), "%s.%s", oldPath, "areaID");
  value.areaID.length = C2xGetTokenInt(packetHandle, "RoadUserChargingConfigMessage", newPath);
  if((result = CheckLastError("RoadUserChargingConfigMessage", gkFuncRefGet, result))==0)
  {
    if(value.areaID.length > 0)
    {
      for(i=0; i<value.areaID.length; i++)
      {
        value.areaID.arrayValue[i].id = C2xGetTokenOidElement(packetHandle, "RoadUserChargingConfigMessage", newPath, i);
      }
    }
  }
  snprintf(newPath, elcount(newPath), "%s.%s", oldPath, "chargingArea");
  GetRoadUserChargingConfigMessageTravelerInformation_ValidRegionParams(packetHandle, value.chargingArea, newPath);
  result = CheckLastError("RoadUserChargingConfigMessage", gkFuncRefGet, result);

  snprintf(newPath, elcount(newPath), "%s.%s", oldPath, "chargingFees");
  GetRoadUserChargingConfigMessageChargingFeesParams(packetHandle, value.chargingFees, newPath);
  result = CheckLastError("RoadUserChargingConfigMessage", gkFuncRefGet, result);

  return result;
}

int SetRoadUserChargingConfigMessageAreaParams(LONG packetHandle, struct RoadUserChargingConfigMessageArea value, char oldPath[])
{
  char newPath[300];
  int i;
  int result;

  result = 0;

  snprintf(newPath, elcount(newPath), "%s.%s", oldPath, "areaID");
  C2xRemoveToken(packetHandle, "RoadUserChargingConfigMessage", newPath);
  if(value.areaID.length > 0)
  {
    for(i=0; i<value.areaID.length; i++)
    {
      C2xSetTokenOidElement(packetHandle, "RoadUserChargingConfigMessage", newPath, i, value.areaID.arrayValue[i].id);
    }
  }
  result = CheckLastError("RoadUserChargingConfigMessage", gkFuncRefGet, result);

  snprintf(newPath, elcount(newPath), "%s.%s", oldPath, "chargingArea");
  SetRoadUserChargingConfigMessageTravelerInformation_ValidRegionParams(packetHandle, value.chargingArea, newPath);
  result = CheckLastError("RoadUserChargingConfigMessage", gkFuncRefGet, result);

  snprintf(newPath, elcount(newPath), "%s.%s", oldPath, "chargingFees");
  SetRoadUserChargingConfigMessageChargingFeesParams(packetHandle, value.chargingFees, newPath);
  result = CheckLastError("RoadUserChargingConfigMessage", gkFuncRefGet, result);

  return result;
}

int GetRoadUserChargingConfigMessageTollAdvertisementMessage_LaneChargesTableParams(LONG packetHandle, struct RoadUserChargingConfigMessageTollAdvertisementMessage_LaneChargesTable value, char oldPath[])
{
  char newPath[300];
  int result;

  result = 0;

  snprintf(newPath, elcount(newPath), "%s.%s", oldPath, "laneId");
  value.laneId = C2xGetTokenInt(packetHandle, "RoadUserChargingConfigMessage", newPath);
  result = CheckLastError("RoadUserChargingConfigMessage", gkFuncRefGet, result);

  snprintf(newPath, elcount(newPath), "%s.%s", oldPath, "chargesTable");
  GetRoadUserChargingConfigMessageTollAdvertisementMessage_ChargesTableParams(packetHandle, value.chargesTable, newPath);
  result = CheckLastError("RoadUserChargingConfigMessage", gkFuncRefGet, result);

  return result;
}

int SetRoadUserChargingConfigMessageTollAdvertisementMessage_LaneChargesTableParams(LONG packetHandle, struct RoadUserChargingConfigMessageTollAdvertisementMessage_LaneChargesTable value, char oldPath[])
{
  char newPath[300];
  int result;

  result = 0;

  snprintf(newPath, elcount(newPath), "%s.%s", oldPath, "laneId");
  C2xSetTokenInt(packetHandle, "RoadUserChargingConfigMessage", newPath, value.laneId);
  result = CheckLastError("RoadUserChargingConfigMessage", gkFuncRefGet, result);

  snprintf(newPath, elcount(newPath), "%s.%s", oldPath, "chargesTable");
  SetRoadUserChargingConfigMessageTollAdvertisementMessage_ChargesTableParams(packetHandle, value.chargesTable, newPath);
  result = CheckLastError("RoadUserChargingConfigMessage", gkFuncRefGet, result);

  return result;
}

int GetRoadUserChargingConfigMessageTollAdvertisementMessage_TollChargesTable_tollTypeCharge_perLaneChargesParams(LONG packetHandle, struct RoadUserChargingConfigMessageTollAdvertisementMessage_TollChargesTable_tollTypeCharge_perLaneCharges value, char oldPath[])
{
  char newPath[300]; 
  int i;
  int result;

  result = 0;

  value.length = C2xGetTokenInt(packetHandle, "RoadUserChargingConfigMessage", oldPath);
  if((result = CheckLastError("RoadUserChargingConfigMessage", gkFuncRefGet, result))==0)
  {
    for(i=0; i<value.length; i++)
    {
      snprintf(newPath, elcount(newPath), "%s[%d]", oldPath, i);
      GetRoadUserChargingConfigMessageTollAdvertisementMessage_LaneChargesTableParams(packetHandle, value.arrayValue[i], newPath);
      result = CheckLastError("RoadUserChargingConfigMessage", gkFuncRefGet, result);
    }
  }
  return result;
}

int SetRoadUserChargingConfigMessageTollAdvertisementMessage_TollChargesTable_tollTypeCharge_perLaneChargesParams(LONG packetHandle, struct RoadUserChargingConfigMessageTollAdvertisementMessage_TollChargesTable_tollTypeCharge_perLaneCharges value, char oldPath[])
{
  char newPath[300]; 
  int i;
  int result;

  result = 0;

  C2xRemoveToken(packetHandle, "RoadUserChargingConfigMessage", oldPath);
  for(i=0; i<value.length; i++)
  {
    snprintf(newPath, elcount(newPath), "%s[%d]", oldPath, i);
    SetRoadUserChargingConfigMessageTollAdvertisementMessage_LaneChargesTableParams(packetHandle, value.arrayValue[i], newPath);
    result = CheckLastError("RoadUserChargingConfigMessage", gkFuncRefGet, result);
  }
  return result;
}

int GetRoadUserChargingConfigMessageTollAdvertisementMessage_ExitInfoParams(LONG packetHandle, struct RoadUserChargingConfigMessageTollAdvertisementMessage_ExitInfo value, char oldPath[])
{
  char newPath[300];
  int result;

  result = 0;

  snprintf(newPath, elcount(newPath), "%s.%s", oldPath, "exitNumber");
  value.exitNumber = C2xGetTokenInt(packetHandle, "RoadUserChargingConfigMessage", newPath);
  result = CheckLastError("RoadUserChargingConfigMessage", gkFuncRefGet, result);

  snprintf(newPath, elcount(newPath), "%s.%s", oldPath, "exitLetter");
  value.exitLetter.isValidFlag = C2xIsTokenAvailable(packetHandle, "RoadUserChargingConfigMessage", newPath);
  if(value.exitLetter.isValidFlag==1)
  {
    value.exitLetter.value = C2xGetTokenInt(packetHandle, "RoadUserChargingConfigMessage", newPath);
    result = CheckLastError("RoadUserChargingConfigMessage", gkFuncRefGet, result);
  }
  snprintf(newPath, elcount(newPath), "%s.%s", oldPath, "tollPointID");
  value.tollPointID.isValidFlag = C2xIsTokenAvailable(packetHandle, "RoadUserChargingConfigMessage", newPath);
  if(value.tollPointID.isValidFlag==1)
  {
    value.tollPointID.value = C2xGetTokenInt(packetHandle, "RoadUserChargingConfigMessage", newPath);
    result = CheckLastError("RoadUserChargingConfigMessage", gkFuncRefGet, result);
  }
  return result;
}

int SetRoadUserChargingConfigMessageTollAdvertisementMessage_ExitInfoParams(LONG packetHandle, struct RoadUserChargingConfigMessageTollAdvertisementMessage_ExitInfo value, char oldPath[])
{
  char newPath[300];
  int result;

  result = 0;

  snprintf(newPath, elcount(newPath), "%s.%s", oldPath, "exitNumber");
  if (value.exitNumber < 1)
  {
    C2xSetTokenInt(packetHandle, "RoadUserChargingConfigMessage", newPath, 1);
  }
  else if (value.exitNumber > 999)
  {
    C2xSetTokenInt(packetHandle, "RoadUserChargingConfigMessage", newPath, 999);
  }
  else
  {
    C2xSetTokenInt(packetHandle, "RoadUserChargingConfigMessage", newPath, value.exitNumber);
  }
  result = CheckLastError("RoadUserChargingConfigMessage", gkFuncRefGet, result);

  snprintf(newPath, elcount(newPath), "%s.%s", oldPath, "exitLetter");
  if(value.exitLetter.isValidFlag==1)
  {
    if (value.exitLetter.value < 65)
    {
        C2xSetTokenInt(packetHandle, "RoadUserChargingConfigMessage", newPath, 65);
    }
    else if (value.exitLetter.value > 90)
    {
        C2xSetTokenInt(packetHandle, "RoadUserChargingConfigMessage", newPath, 90);
    }
    else
    {
        C2xSetTokenInt(packetHandle, "RoadUserChargingConfigMessage", newPath, value.exitLetter.value);
    }
    result = CheckLastError("RoadUserChargingConfigMessage", gkFuncRefGet, result);
  }
  else
  {
    if( C2xIsTokenAvailable(packetHandle, "RoadUserChargingConfigMessage", newPath) )
    {
      C2xRemoveToken(packetHandle, "RoadUserChargingConfigMessage", newPath);
    }
  }

  snprintf(newPath, elcount(newPath), "%s.%s", oldPath, "tollPointID");
  if(value.tollPointID.isValidFlag==1)
  {
    if (value.tollPointID.value < 1)
    {
        C2xSetTokenInt(packetHandle, "RoadUserChargingConfigMessage", newPath, 1);
    }
    else if (value.tollPointID.value > 2048)
    {
        C2xSetTokenInt(packetHandle, "RoadUserChargingConfigMessage", newPath, 2048);
    }
    else
    {
        C2xSetTokenInt(packetHandle, "RoadUserChargingConfigMessage", newPath, value.tollPointID.value);
    }
    result = CheckLastError("RoadUserChargingConfigMessage", gkFuncRefGet, result);
  }
  else
  {
    if( C2xIsTokenAvailable(packetHandle, "RoadUserChargingConfigMessage", newPath) )
    {
      C2xRemoveToken(packetHandle, "RoadUserChargingConfigMessage", newPath);
    }
  }

  return result;
}

int GetRoadUserChargingConfigMessageTollAdvertisementMessage_EntryChargesTableParams(LONG packetHandle, struct RoadUserChargingConfigMessageTollAdvertisementMessage_EntryChargesTable value, char oldPath[])
{
  char newPath[300];
  int result;

  result = 0;

  snprintf(newPath, elcount(newPath), "%s.%s", oldPath, "exitInfo");
  GetRoadUserChargingConfigMessageTollAdvertisementMessage_ExitInfoParams(packetHandle, value.exitInfo, newPath);
  result = CheckLastError("RoadUserChargingConfigMessage", gkFuncRefGet, result);

  snprintf(newPath, elcount(newPath), "%s.%s", oldPath, "chargesTable");
  GetRoadUserChargingConfigMessageTollAdvertisementMessage_ChargesTableParams(packetHandle, value.chargesTable, newPath);
  result = CheckLastError("RoadUserChargingConfigMessage", gkFuncRefGet, result);

  return result;
}

int SetRoadUserChargingConfigMessageTollAdvertisementMessage_EntryChargesTableParams(LONG packetHandle, struct RoadUserChargingConfigMessageTollAdvertisementMessage_EntryChargesTable value, char oldPath[])
{
  char newPath[300];
  int result;

  result = 0;

  snprintf(newPath, elcount(newPath), "%s.%s", oldPath, "exitInfo");
  SetRoadUserChargingConfigMessageTollAdvertisementMessage_ExitInfoParams(packetHandle, value.exitInfo, newPath);
  result = CheckLastError("RoadUserChargingConfigMessage", gkFuncRefGet, result);

  snprintf(newPath, elcount(newPath), "%s.%s", oldPath, "chargesTable");
  SetRoadUserChargingConfigMessageTollAdvertisementMessage_ChargesTableParams(packetHandle, value.chargesTable, newPath);
  result = CheckLastError("RoadUserChargingConfigMessage", gkFuncRefGet, result);

  return result;
}

int GetRoadUserChargingConfigMessageTollAdvertisementMessage_ExitChargesTableParams(LONG packetHandle, struct RoadUserChargingConfigMessageTollAdvertisementMessage_ExitChargesTable value, char oldPath[])
{
  char newPath[300];
  int result;

  result = 0;

  snprintf(newPath, elcount(newPath), "%s.%s", oldPath, "entryInfo");
  value.entryInfo.isValidFlag = C2xIsTokenAvailable(packetHandle, "RoadUserChargingConfigMessage", newPath);
  if(value.entryInfo.isValidFlag==1)
  {
    value.entryInfo.value = C2xGetTokenInt(packetHandle, "RoadUserChargingConfigMessage", newPath);
    result = CheckLastError("RoadUserChargingConfigMessage", gkFuncRefGet, result);
  }
  snprintf(newPath, elcount(newPath), "%s.%s", oldPath, "chargesTable");
  GetRoadUserChargingConfigMessageTollAdvertisementMessage_ChargesTableParams(packetHandle, value.chargesTable, newPath);
  result = CheckLastError("RoadUserChargingConfigMessage", gkFuncRefGet, result);

  return result;
}

int SetRoadUserChargingConfigMessageTollAdvertisementMessage_ExitChargesTableParams(LONG packetHandle, struct RoadUserChargingConfigMessageTollAdvertisementMessage_ExitChargesTable value, char oldPath[])
{
  char newPath[300];
  int result;

  result = 0;

  snprintf(newPath, elcount(newPath), "%s.%s", oldPath, "entryInfo");
  if(value.entryInfo.isValidFlag==1)
  {
    if (value.entryInfo.value < 1)
    {
        C2xSetTokenInt(packetHandle, "RoadUserChargingConfigMessage", newPath, 1);
    }
    else if (value.entryInfo.value > 2048)
    {
        C2xSetTokenInt(packetHandle, "RoadUserChargingConfigMessage", newPath, 2048);
    }
    else
    {
        C2xSetTokenInt(packetHandle, "RoadUserChargingConfigMessage", newPath, value.entryInfo.value);
    }
    result = CheckLastError("RoadUserChargingConfigMessage", gkFuncRefGet, result);
  }
  else
  {
    if( C2xIsTokenAvailable(packetHandle, "RoadUserChargingConfigMessage", newPath) )
    {
      C2xRemoveToken(packetHandle, "RoadUserChargingConfigMessage", newPath);
    }
  }

  snprintf(newPath, elcount(newPath), "%s.%s", oldPath, "chargesTable");
  SetRoadUserChargingConfigMessageTollAdvertisementMessage_ChargesTableParams(packetHandle, value.chargesTable, newPath);
  result = CheckLastError("RoadUserChargingConfigMessage", gkFuncRefGet, result);

  return result;
}

int GetRoadUserChargingConfigMessageTollAdvertisementMessage_ClosedNetworkChargesTableParams(LONG packetHandle, struct RoadUserChargingConfigMessageTollAdvertisementMessage_ClosedNetworkChargesTable value, char oldPath[])
{
  char newPath[300];
  int result;

  result = 0;

  value.choice = C2xGetTokenInt(packetHandle, "RoadUserChargingConfigMessage", oldPath);

  switch(value.choice)
  {
    case 0:
    {
      snprintf(newPath, elcount(newPath), "%s.%s", oldPath, "entryChargesTable");
      GetRoadUserChargingConfigMessageTollAdvertisementMessage_EntryChargesTableParams(packetHandle, value.entryChargesTable, newPath);
      result = CheckLastError("RoadUserChargingConfigMessage", gkFuncRefGet, result);
    }
    break;
    case 1:
    {
      snprintf(newPath, elcount(newPath), "%s.%s", oldPath, "exitChargesTable");
      GetRoadUserChargingConfigMessageTollAdvertisementMessage_ExitChargesTableParams(packetHandle, value.exitChargesTable, newPath);
      result = CheckLastError("RoadUserChargingConfigMessage", gkFuncRefGet, result);
    }
    break;
  }
  return result;
}

int SetRoadUserChargingConfigMessageTollAdvertisementMessage_ClosedNetworkChargesTableParams(LONG packetHandle, struct RoadUserChargingConfigMessageTollAdvertisementMessage_ClosedNetworkChargesTable value, char oldPath[])
{
  char newPath[300];
  int result;

  result = 0;

  switch(value.choice)
  {
    case 0:
    {
      snprintf(newPath, elcount(newPath), "%s.%s", oldPath, "entryChargesTable");
      SetRoadUserChargingConfigMessageTollAdvertisementMessage_EntryChargesTableParams(packetHandle, value.entryChargesTable, newPath);
      result = CheckLastError("RoadUserChargingConfigMessage", gkFuncRefGet, result);
    }
    break;
    case 1:
    {
      snprintf(newPath, elcount(newPath), "%s.%s", oldPath, "exitChargesTable");
      SetRoadUserChargingConfigMessageTollAdvertisementMessage_ExitChargesTableParams(packetHandle, value.exitChargesTable, newPath);
      result = CheckLastError("RoadUserChargingConfigMessage", gkFuncRefGet, result);
    }
    break;
  }
  return result;
}

int GetRoadUserChargingConfigMessageTollAdvertisementMessage_TollChargesTable_tollTypeCharge_closedNetworkChargesParams(LONG packetHandle, struct RoadUserChargingConfigMessageTollAdvertisementMessage_TollChargesTable_tollTypeCharge_closedNetworkCharges value, char oldPath[])
{
  char newPath[300]; 
  int i;
  int result;

  result = 0;

  value.length = C2xGetTokenInt(packetHandle, "RoadUserChargingConfigMessage", oldPath);
  if((result = CheckLastError("RoadUserChargingConfigMessage", gkFuncRefGet, result))==0)
  {
    for(i=0; i<value.length; i++)
    {
      snprintf(newPath, elcount(newPath), "%s[%d]", oldPath, i);
      GetRoadUserChargingConfigMessageTollAdvertisementMessage_ClosedNetworkChargesTableParams(packetHandle, value.arrayValue[i], newPath);
      result = CheckLastError("RoadUserChargingConfigMessage", gkFuncRefGet, result);
    }
  }
  return result;
}

int SetRoadUserChargingConfigMessageTollAdvertisementMessage_TollChargesTable_tollTypeCharge_closedNetworkChargesParams(LONG packetHandle, struct RoadUserChargingConfigMessageTollAdvertisementMessage_TollChargesTable_tollTypeCharge_closedNetworkCharges value, char oldPath[])
{
  char newPath[300]; 
  int i;
  int result;

  result = 0;

  C2xRemoveToken(packetHandle, "RoadUserChargingConfigMessage", oldPath);
  for(i=0; i<value.length; i++)
  {
    snprintf(newPath, elcount(newPath), "%s[%d]", oldPath, i);
    SetRoadUserChargingConfigMessageTollAdvertisementMessage_ClosedNetworkChargesTableParams(packetHandle, value.arrayValue[i], newPath);
    result = CheckLastError("RoadUserChargingConfigMessage", gkFuncRefGet, result);
  }
  return result;
}

int GetRoadUserChargingConfigMessageTollAdvertisementMessage_TimeChargesTableParams(LONG packetHandle, struct RoadUserChargingConfigMessageTollAdvertisementMessage_TimeChargesTable value, char oldPath[])
{
  char newPath[300];
  int result;

  result = 0;

  snprintf(newPath, elcount(newPath), "%s.%s", oldPath, "maxTime");
  value.maxTime = C2xGetTokenInt(packetHandle, "RoadUserChargingConfigMessage", newPath);
  result = CheckLastError("RoadUserChargingConfigMessage", gkFuncRefGet, result);

  snprintf(newPath, elcount(newPath), "%s.%s", oldPath, "chargesTable");
  GetRoadUserChargingConfigMessageTollAdvertisementMessage_ChargesTableParams(packetHandle, value.chargesTable, newPath);
  result = CheckLastError("RoadUserChargingConfigMessage", gkFuncRefGet, result);

  return result;
}

int SetRoadUserChargingConfigMessageTollAdvertisementMessage_TimeChargesTableParams(LONG packetHandle, struct RoadUserChargingConfigMessageTollAdvertisementMessage_TimeChargesTable value, char oldPath[])
{
  char newPath[300];
  int result;

  result = 0;

  snprintf(newPath, elcount(newPath), "%s.%s", oldPath, "maxTime");
  if (value.maxTime < 1)
  {
    C2xSetTokenInt(packetHandle, "RoadUserChargingConfigMessage", newPath, 1);
  }
  else if (value.maxTime > 1440)
  {
    C2xSetTokenInt(packetHandle, "RoadUserChargingConfigMessage", newPath, 1440);
  }
  else
  {
    C2xSetTokenInt(packetHandle, "RoadUserChargingConfigMessage", newPath, value.maxTime);
  }
  result = CheckLastError("RoadUserChargingConfigMessage", gkFuncRefGet, result);

  snprintf(newPath, elcount(newPath), "%s.%s", oldPath, "chargesTable");
  SetRoadUserChargingConfigMessageTollAdvertisementMessage_ChargesTableParams(packetHandle, value.chargesTable, newPath);
  result = CheckLastError("RoadUserChargingConfigMessage", gkFuncRefGet, result);

  return result;
}

int GetRoadUserChargingConfigMessageTollAdvertisementMessage_TollChargesTable_tollTypeChargeParams(LONG packetHandle, struct RoadUserChargingConfigMessageTollAdvertisementMessage_TollChargesTable_tollTypeCharge value, char oldPath[])
{
  char newPath[300];
  int result;

  result = 0;

  value.choice = C2xGetTokenInt(packetHandle, "RoadUserChargingConfigMessage", oldPath);

  switch(value.choice)
  {
    case 0:
    {
      snprintf(newPath, elcount(newPath), "%s.%s", oldPath, "pointCharges");
      GetRoadUserChargingConfigMessageTollAdvertisementMessage_ChargesTableParams(packetHandle, value.pointCharges, newPath);
      result = CheckLastError("RoadUserChargingConfigMessage", gkFuncRefGet, result);
    }
    break;
    case 1:
    {
      snprintf(newPath, elcount(newPath), "%s.%s", oldPath, "perLaneCharges");
      GetRoadUserChargingConfigMessageTollAdvertisementMessage_TollChargesTable_tollTypeCharge_perLaneChargesParams(packetHandle, value.perLaneCharges, newPath);
      result = CheckLastError("RoadUserChargingConfigMessage", gkFuncRefGet, result);
    }
    break;
    case 2:
    {
      snprintf(newPath, elcount(newPath), "%s.%s", oldPath, "closedNetworkCharges");
      GetRoadUserChargingConfigMessageTollAdvertisementMessage_TollChargesTable_tollTypeCharge_closedNetworkChargesParams(packetHandle, value.closedNetworkCharges, newPath);
      result = CheckLastError("RoadUserChargingConfigMessage", gkFuncRefGet, result);
    }
    break;
    case 3:
    {
      snprintf(newPath, elcount(newPath), "%s.%s", oldPath, "timeBasedCharges");
      GetRoadUserChargingConfigMessageTollAdvertisementMessage_TimeChargesTableParams(packetHandle, value.timeBasedCharges, newPath);
      result = CheckLastError("RoadUserChargingConfigMessage", gkFuncRefGet, result);
    }
    break;
  }
  return result;
}

int SetRoadUserChargingConfigMessageTollAdvertisementMessage_TollChargesTable_tollTypeChargeParams(LONG packetHandle, struct RoadUserChargingConfigMessageTollAdvertisementMessage_TollChargesTable_tollTypeCharge value, char oldPath[])
{
  char newPath[300];
  int result;

  result = 0;

  switch(value.choice)
  {
    case 0:
    {
      snprintf(newPath, elcount(newPath), "%s.%s", oldPath, "pointCharges");
      SetRoadUserChargingConfigMessageTollAdvertisementMessage_ChargesTableParams(packetHandle, value.pointCharges, newPath);
      result = CheckLastError("RoadUserChargingConfigMessage", gkFuncRefGet, result);
    }
    break;
    case 1:
    {
      snprintf(newPath, elcount(newPath), "%s.%s", oldPath, "perLaneCharges");
      SetRoadUserChargingConfigMessageTollAdvertisementMessage_TollChargesTable_tollTypeCharge_perLaneChargesParams(packetHandle, value.perLaneCharges, newPath);
      result = CheckLastError("RoadUserChargingConfigMessage", gkFuncRefGet, result);
    }
    break;
    case 2:
    {
      snprintf(newPath, elcount(newPath), "%s.%s", oldPath, "closedNetworkCharges");
      SetRoadUserChargingConfigMessageTollAdvertisementMessage_TollChargesTable_tollTypeCharge_closedNetworkChargesParams(packetHandle, value.closedNetworkCharges, newPath);
      result = CheckLastError("RoadUserChargingConfigMessage", gkFuncRefGet, result);
    }
    break;
    case 3:
    {
      snprintf(newPath, elcount(newPath), "%s.%s", oldPath, "timeBasedCharges");
      SetRoadUserChargingConfigMessageTollAdvertisementMessage_TimeChargesTableParams(packetHandle, value.timeBasedCharges, newPath);
      result = CheckLastError("RoadUserChargingConfigMessage", gkFuncRefGet, result);
    }
    break;
  }
  return result;
}

int GetRoadUserChargingConfigMessageTollAdvertisementMessage_TollChargesTableParams(LONG packetHandle, struct RoadUserChargingConfigMessageTollAdvertisementMessage_TollChargesTable value, char oldPath[])
{
  char newPath[300];
  int result;

  result = 0;

  snprintf(newPath, elcount(newPath), "%s.%s", oldPath, "tollTypeCharge");
  GetRoadUserChargingConfigMessageTollAdvertisementMessage_TollChargesTable_tollTypeChargeParams(packetHandle, value.tollTypeCharge, newPath);
  result = CheckLastError("RoadUserChargingConfigMessage", gkFuncRefGet, result);

  return result;
}

int SetRoadUserChargingConfigMessageTollAdvertisementMessage_TollChargesTableParams(LONG packetHandle, struct RoadUserChargingConfigMessageTollAdvertisementMessage_TollChargesTable value, char oldPath[])
{
  char newPath[300];
  int result;

  result = 0;

  snprintf(newPath, elcount(newPath), "%s.%s", oldPath, "tollTypeCharge");
  SetRoadUserChargingConfigMessageTollAdvertisementMessage_TollChargesTable_tollTypeChargeParams(packetHandle, value.tollTypeCharge, newPath);
  result = CheckLastError("RoadUserChargingConfigMessage", gkFuncRefGet, result);

  return result;
}

int GetRoadUserChargingConfigMessageTollAdvertisementMessage_TollChargerInfoParams(LONG packetHandle, struct RoadUserChargingConfigMessageTollAdvertisementMessage_TollChargerInfo value, char oldPath[])
{
  char newPath[300];
  int i;
  int result;

  result = 0;

  snprintf(newPath, elcount(newPath), "%s.%s", oldPath, "tollChargerId");
  value.tollChargerId.length = C2xGetTokenInt(packetHandle, "RoadUserChargingConfigMessage", newPath);
  if((result = CheckLastError("RoadUserChargingConfigMessage", gkFuncRefGet, result))==0)
  {
    if(value.tollChargerId.length > 0)
    {
      for(i=0; i<value.tollChargerId.length; i++)
      {
        value.tollChargerId.arrayValue[i].id = C2xGetTokenOidElement(packetHandle, "RoadUserChargingConfigMessage", newPath, i);
      }
    }
  }
  snprintf(newPath, elcount(newPath), "%s.%s", oldPath, "tollPointId");
  value.tollPointId = C2xGetTokenInt(packetHandle, "RoadUserChargingConfigMessage", newPath);
  result = CheckLastError("RoadUserChargingConfigMessage", gkFuncRefGet, result);

  snprintf(newPath, elcount(newPath), "%s.%s", oldPath, "descriptiveName");
  value.descriptiveName.isValidFlag = C2xIsTokenAvailable(packetHandle, "RoadUserChargingConfigMessage", newPath);
  if(value.descriptiveName.isValidFlag==1)
  {
    value.descriptiveName.stringLength = C2xGetTokenData(packetHandle, "RoadUserChargingConfigMessage", newPath, elcount(value.descriptiveName.string), value.descriptiveName.string);
    result = CheckLastError("RoadUserChargingConfigMessage", gkFuncRefGet, result);
  }
  return result;
}

int SetRoadUserChargingConfigMessageTollAdvertisementMessage_TollChargerInfoParams(LONG packetHandle, struct RoadUserChargingConfigMessageTollAdvertisementMessage_TollChargerInfo value, char oldPath[])
{
  char newPath[300];
  int i;
  int result;

  result = 0;

  snprintf(newPath, elcount(newPath), "%s.%s", oldPath, "tollChargerId");
  C2xRemoveToken(packetHandle, "RoadUserChargingConfigMessage", newPath);
  if(value.tollChargerId.length > 0)
  {
    for(i=0; i<value.tollChargerId.length; i++)
    {
      C2xSetTokenOidElement(packetHandle, "RoadUserChargingConfigMessage", newPath, i, value.tollChargerId.arrayValue[i].id);
    }
  }
  result = CheckLastError("RoadUserChargingConfigMessage", gkFuncRefGet, result);

  snprintf(newPath, elcount(newPath), "%s.%s", oldPath, "tollPointId");
  if (value.tollPointId < 1)
  {
    C2xSetTokenInt(packetHandle, "RoadUserChargingConfigMessage", newPath, 1);
  }
  else if (value.tollPointId > 2048)
  {
    C2xSetTokenInt(packetHandle, "RoadUserChargingConfigMessage", newPath, 2048);
  }
  else
  {
    C2xSetTokenInt(packetHandle, "RoadUserChargingConfigMessage", newPath, value.tollPointId);
  }
  result = CheckLastError("RoadUserChargingConfigMessage", gkFuncRefGet, result);

  snprintf(newPath, elcount(newPath), "%s.%s", oldPath, "descriptiveName");
  if(value.descriptiveName.isValidFlag==1)
  {
    C2xSetTokenData(packetHandle, "RoadUserChargingConfigMessage", newPath, value.descriptiveName.stringLength, value.descriptiveName.string);
    result = CheckLastError("RoadUserChargingConfigMessage", gkFuncRefGet, result);
  }
  else
  {
    if( C2xIsTokenAvailable(packetHandle, "RoadUserChargingConfigMessage", newPath) )
    {
      C2xRemoveToken(packetHandle, "RoadUserChargingConfigMessage", newPath);
    }
  }

  return result;
}

int GetRoadUserChargingConfigMessageTollAdvertisementMessage_TumInstructionsParams(LONG packetHandle, struct RoadUserChargingConfigMessageTollAdvertisementMessage_TumInstructions value, char oldPath[])
{
  char newPath[300];
  int result;

  result = 0;

  snprintf(newPath, elcount(newPath), "%s.%s", oldPath, "maxNumOfLocTimeStamps");
  value.maxNumOfLocTimeStamps = C2xGetTokenInt(packetHandle, "RoadUserChargingConfigMessage", newPath);
  result = CheckLastError("RoadUserChargingConfigMessage", gkFuncRefGet, result);

  snprintf(newPath, elcount(newPath), "%s.%s", oldPath, "locTimeStampRate");
  value.locTimeStampRate = C2xGetTokenInt(packetHandle, "RoadUserChargingConfigMessage", newPath);
  result = CheckLastError("RoadUserChargingConfigMessage", gkFuncRefGet, result);

  return result;
}

int SetRoadUserChargingConfigMessageTollAdvertisementMessage_TumInstructionsParams(LONG packetHandle, struct RoadUserChargingConfigMessageTollAdvertisementMessage_TumInstructions value, char oldPath[])
{
  char newPath[300];
  int result;

  result = 0;

  snprintf(newPath, elcount(newPath), "%s.%s", oldPath, "maxNumOfLocTimeStamps");
  if (value.maxNumOfLocTimeStamps < 1)
  {
    C2xSetTokenInt(packetHandle, "RoadUserChargingConfigMessage", newPath, 1);
  }
  else if (value.maxNumOfLocTimeStamps > 5)
  {
    C2xSetTokenInt(packetHandle, "RoadUserChargingConfigMessage", newPath, 5);
  }
  else
  {
    C2xSetTokenInt(packetHandle, "RoadUserChargingConfigMessage", newPath, value.maxNumOfLocTimeStamps);
  }
  result = CheckLastError("RoadUserChargingConfigMessage", gkFuncRefGet, result);

  snprintf(newPath, elcount(newPath), "%s.%s", oldPath, "locTimeStampRate");
  if (value.locTimeStampRate < 1)
  {
    C2xSetTokenInt(packetHandle, "RoadUserChargingConfigMessage", newPath, 1);
  }
  else if (value.locTimeStampRate > 10)
  {
    C2xSetTokenInt(packetHandle, "RoadUserChargingConfigMessage", newPath, 10);
  }
  else
  {
    C2xSetTokenInt(packetHandle, "RoadUserChargingConfigMessage", newPath, value.locTimeStampRate);
  }
  result = CheckLastError("RoadUserChargingConfigMessage", gkFuncRefGet, result);

  return result;
}

int GetRoadUserChargingConfigMessageMapData_LaneTypeAttributesParams(LONG packetHandle, struct RoadUserChargingConfigMessageMapData_LaneTypeAttributes value, char oldPath[])
{
  char newPath[300]; 
  int j;
  int result;

  result = 0;

  value.choice = C2xGetTokenInt(packetHandle, "RoadUserChargingConfigMessage", oldPath);

  switch(value.choice)
  {
    case 0:
    {
      snprintf(newPath, elcount(newPath), "%s.%s", oldPath, "vehicle");
      value.vehicle.isValidFlag = 1;
      value.vehicle.stringLength = C2xGetTokenLengthBit(packetHandle, "RoadUserChargingConfigMessage", newPath);
      if ((result = CheckLastError("RoadUserChargingConfigMessage", gkFuncRefGet, result))==0)
      {
        for(j=0; j<value.vehicle.stringLength; j++)
        {
          if(C2xGetTokenBitOfBitString(packetHandle, "RoadUserChargingConfigMessage", newPath, j) == 0)
          {
            value.vehicle.string[j] = '0';
          }
          else
          {
            value.vehicle.string[j] = '1';
          }
          result = CheckLastError("RoadUserChargingConfigMessage", gkFuncRefGet, result);
        }
      }

      result = CheckLastError("RoadUserChargingConfigMessage", gkFuncRefGet, result);
    }
    break;
    case 1:
    {
      snprintf(newPath, elcount(newPath), "%s.%s", oldPath, "crosswalk");
      value.crosswalk.isValidFlag = 1;
      value.crosswalk.stringLength = C2xGetTokenLengthBit(packetHandle, "RoadUserChargingConfigMessage", newPath);
      if ((result = CheckLastError("RoadUserChargingConfigMessage", gkFuncRefGet, result))==0)
      {
        for(j=0; j<value.crosswalk.stringLength; j++)
        {
          if(C2xGetTokenBitOfBitString(packetHandle, "RoadUserChargingConfigMessage", newPath, j) == 0)
          {
            value.crosswalk.string[j] = '0';
          }
          else
          {
            value.crosswalk.string[j] = '1';
          }
          result = CheckLastError("RoadUserChargingConfigMessage", gkFuncRefGet, result);
        }
      }

      result = CheckLastError("RoadUserChargingConfigMessage", gkFuncRefGet, result);
    }
    break;
    case 2:
    {
      snprintf(newPath, elcount(newPath), "%s.%s", oldPath, "bikeLane");
      value.bikeLane.isValidFlag = 1;
      value.bikeLane.stringLength = C2xGetTokenLengthBit(packetHandle, "RoadUserChargingConfigMessage", newPath);
      if ((result = CheckLastError("RoadUserChargingConfigMessage", gkFuncRefGet, result))==0)
      {
        for(j=0; j<value.bikeLane.stringLength; j++)
        {
          if(C2xGetTokenBitOfBitString(packetHandle, "RoadUserChargingConfigMessage", newPath, j) == 0)
          {
            value.bikeLane.string[j] = '0';
          }
          else
          {
            value.bikeLane.string[j] = '1';
          }
          result = CheckLastError("RoadUserChargingConfigMessage", gkFuncRefGet, result);
        }
      }

      result = CheckLastError("RoadUserChargingConfigMessage", gkFuncRefGet, result);
    }
    break;
    case 3:
    {
      snprintf(newPath, elcount(newPath), "%s.%s", oldPath, "sidewalk");
      value.sidewalk.isValidFlag = 1;
      value.sidewalk.stringLength = C2xGetTokenLengthBit(packetHandle, "RoadUserChargingConfigMessage", newPath);
      if ((result = CheckLastError("RoadUserChargingConfigMessage", gkFuncRefGet, result))==0)
      {
        for(j=0; j<value.sidewalk.stringLength; j++)
        {
          if(C2xGetTokenBitOfBitString(packetHandle, "RoadUserChargingConfigMessage", newPath, j) == 0)
          {
            value.sidewalk.string[j] = '0';
          }
          else
          {
            value.sidewalk.string[j] = '1';
          }
          result = CheckLastError("RoadUserChargingConfigMessage", gkFuncRefGet, result);
        }
      }

      result = CheckLastError("RoadUserChargingConfigMessage", gkFuncRefGet, result);
    }
    break;
    case 4:
    {
      snprintf(newPath, elcount(newPath), "%s.%s", oldPath, "median");
      value.median.isValidFlag = 1;
      value.median.stringLength = C2xGetTokenLengthBit(packetHandle, "RoadUserChargingConfigMessage", newPath);
      if ((result = CheckLastError("RoadUserChargingConfigMessage", gkFuncRefGet, result))==0)
      {
        for(j=0; j<value.median.stringLength; j++)
        {
          if(C2xGetTokenBitOfBitString(packetHandle, "RoadUserChargingConfigMessage", newPath, j) == 0)
          {
            value.median.string[j] = '0';
          }
          else
          {
            value.median.string[j] = '1';
          }
          result = CheckLastError("RoadUserChargingConfigMessage", gkFuncRefGet, result);
        }
      }

      result = CheckLastError("RoadUserChargingConfigMessage", gkFuncRefGet, result);
    }
    break;
    case 5:
    {
      snprintf(newPath, elcount(newPath), "%s.%s", oldPath, "striping");
      value.striping.isValidFlag = 1;
      value.striping.stringLength = C2xGetTokenLengthBit(packetHandle, "RoadUserChargingConfigMessage", newPath);
      if ((result = CheckLastError("RoadUserChargingConfigMessage", gkFuncRefGet, result))==0)
      {
        for(j=0; j<value.striping.stringLength; j++)
        {
          if(C2xGetTokenBitOfBitString(packetHandle, "RoadUserChargingConfigMessage", newPath, j) == 0)
          {
            value.striping.string[j] = '0';
          }
          else
          {
            value.striping.string[j] = '1';
          }
          result = CheckLastError("RoadUserChargingConfigMessage", gkFuncRefGet, result);
        }
      }

      result = CheckLastError("RoadUserChargingConfigMessage", gkFuncRefGet, result);
    }
    break;
    case 6:
    {
      snprintf(newPath, elcount(newPath), "%s.%s", oldPath, "trackedVehicle");
      value.trackedVehicle.isValidFlag = 1;
      value.trackedVehicle.stringLength = C2xGetTokenLengthBit(packetHandle, "RoadUserChargingConfigMessage", newPath);
      if ((result = CheckLastError("RoadUserChargingConfigMessage", gkFuncRefGet, result))==0)
      {
        for(j=0; j<value.trackedVehicle.stringLength; j++)
        {
          if(C2xGetTokenBitOfBitString(packetHandle, "RoadUserChargingConfigMessage", newPath, j) == 0)
          {
            value.trackedVehicle.string[j] = '0';
          }
          else
          {
            value.trackedVehicle.string[j] = '1';
          }
          result = CheckLastError("RoadUserChargingConfigMessage", gkFuncRefGet, result);
        }
      }

      result = CheckLastError("RoadUserChargingConfigMessage", gkFuncRefGet, result);
    }
    break;
    case 7:
    {
      snprintf(newPath, elcount(newPath), "%s.%s", oldPath, "parking");
      value.parking.isValidFlag = 1;
      value.parking.stringLength = C2xGetTokenLengthBit(packetHandle, "RoadUserChargingConfigMessage", newPath);
      if ((result = CheckLastError("RoadUserChargingConfigMessage", gkFuncRefGet, result))==0)
      {
        for(j=0; j<value.parking.stringLength; j++)
        {
          if(C2xGetTokenBitOfBitString(packetHandle, "RoadUserChargingConfigMessage", newPath, j) == 0)
          {
            value.parking.string[j] = '0';
          }
          else
          {
            value.parking.string[j] = '1';
          }
          result = CheckLastError("RoadUserChargingConfigMessage", gkFuncRefGet, result);
        }
      }

      result = CheckLastError("RoadUserChargingConfigMessage", gkFuncRefGet, result);
    }
    break;
  }
  return result;
}

int SetRoadUserChargingConfigMessageMapData_LaneTypeAttributesParams(LONG packetHandle, struct RoadUserChargingConfigMessageMapData_LaneTypeAttributes value, char oldPath[])
{
  char newPath[300]; 
  int j;
  int result;

  result = 0;

  switch(value.choice)
  {
    case 0:
    {
      snprintf(newPath, elcount(newPath), "%s.%s", oldPath, "vehicle");
      for(j=0; j<value.vehicle.stringLength; j++)
      {
        if(value.vehicle.string[j] == '0')
        {
          C2xSetTokenBitOfBitString(packetHandle, "RoadUserChargingConfigMessage", newPath, j, 0);
        }
        else
        {
          C2xSetTokenBitOfBitString(packetHandle, "RoadUserChargingConfigMessage", newPath, j, 1);
        }
        result = CheckLastError("RoadUserChargingConfigMessage", gkFuncRefGet, result);
      }
      result = CheckLastError("RoadUserChargingConfigMessage", gkFuncRefGet, result);
    }
    break;
    case 1:
    {
      snprintf(newPath, elcount(newPath), "%s.%s", oldPath, "crosswalk");
      for(j=0; j<value.crosswalk.stringLength; j++)
      {
        if(value.crosswalk.string[j] == '0')
        {
          C2xSetTokenBitOfBitString(packetHandle, "RoadUserChargingConfigMessage", newPath, j, 0);
        }
        else
        {
          C2xSetTokenBitOfBitString(packetHandle, "RoadUserChargingConfigMessage", newPath, j, 1);
        }
        result = CheckLastError("RoadUserChargingConfigMessage", gkFuncRefGet, result);
      }
      result = CheckLastError("RoadUserChargingConfigMessage", gkFuncRefGet, result);
    }
    break;
    case 2:
    {
      snprintf(newPath, elcount(newPath), "%s.%s", oldPath, "bikeLane");
      for(j=0; j<value.bikeLane.stringLength; j++)
      {
        if(value.bikeLane.string[j] == '0')
        {
          C2xSetTokenBitOfBitString(packetHandle, "RoadUserChargingConfigMessage", newPath, j, 0);
        }
        else
        {
          C2xSetTokenBitOfBitString(packetHandle, "RoadUserChargingConfigMessage", newPath, j, 1);
        }
        result = CheckLastError("RoadUserChargingConfigMessage", gkFuncRefGet, result);
      }
      result = CheckLastError("RoadUserChargingConfigMessage", gkFuncRefGet, result);
    }
    break;
    case 3:
    {
      snprintf(newPath, elcount(newPath), "%s.%s", oldPath, "sidewalk");
      for(j=0; j<value.sidewalk.stringLength; j++)
      {
        if(value.sidewalk.string[j] == '0')
        {
          C2xSetTokenBitOfBitString(packetHandle, "RoadUserChargingConfigMessage", newPath, j, 0);
        }
        else
        {
          C2xSetTokenBitOfBitString(packetHandle, "RoadUserChargingConfigMessage", newPath, j, 1);
        }
        result = CheckLastError("RoadUserChargingConfigMessage", gkFuncRefGet, result);
      }
      result = CheckLastError("RoadUserChargingConfigMessage", gkFuncRefGet, result);
    }
    break;
    case 4:
    {
      snprintf(newPath, elcount(newPath), "%s.%s", oldPath, "median");
      for(j=0; j<value.median.stringLength; j++)
      {
        if(value.median.string[j] == '0')
        {
          C2xSetTokenBitOfBitString(packetHandle, "RoadUserChargingConfigMessage", newPath, j, 0);
        }
        else
        {
          C2xSetTokenBitOfBitString(packetHandle, "RoadUserChargingConfigMessage", newPath, j, 1);
        }
        result = CheckLastError("RoadUserChargingConfigMessage", gkFuncRefGet, result);
      }
      result = CheckLastError("RoadUserChargingConfigMessage", gkFuncRefGet, result);
    }
    break;
    case 5:
    {
      snprintf(newPath, elcount(newPath), "%s.%s", oldPath, "striping");
      for(j=0; j<value.striping.stringLength; j++)
      {
        if(value.striping.string[j] == '0')
        {
          C2xSetTokenBitOfBitString(packetHandle, "RoadUserChargingConfigMessage", newPath, j, 0);
        }
        else
        {
          C2xSetTokenBitOfBitString(packetHandle, "RoadUserChargingConfigMessage", newPath, j, 1);
        }
        result = CheckLastError("RoadUserChargingConfigMessage", gkFuncRefGet, result);
      }
      result = CheckLastError("RoadUserChargingConfigMessage", gkFuncRefGet, result);
    }
    break;
    case 6:
    {
      snprintf(newPath, elcount(newPath), "%s.%s", oldPath, "trackedVehicle");
      for(j=0; j<value.trackedVehicle.stringLength; j++)
      {
        if(value.trackedVehicle.string[j] == '0')
        {
          C2xSetTokenBitOfBitString(packetHandle, "RoadUserChargingConfigMessage", newPath, j, 0);
        }
        else
        {
          C2xSetTokenBitOfBitString(packetHandle, "RoadUserChargingConfigMessage", newPath, j, 1);
        }
        result = CheckLastError("RoadUserChargingConfigMessage", gkFuncRefGet, result);
      }
      result = CheckLastError("RoadUserChargingConfigMessage", gkFuncRefGet, result);
    }
    break;
    case 7:
    {
      snprintf(newPath, elcount(newPath), "%s.%s", oldPath, "parking");
      for(j=0; j<value.parking.stringLength; j++)
      {
        if(value.parking.string[j] == '0')
        {
          C2xSetTokenBitOfBitString(packetHandle, "RoadUserChargingConfigMessage", newPath, j, 0);
        }
        else
        {
          C2xSetTokenBitOfBitString(packetHandle, "RoadUserChargingConfigMessage", newPath, j, 1);
        }
        result = CheckLastError("RoadUserChargingConfigMessage", gkFuncRefGet, result);
      }
      result = CheckLastError("RoadUserChargingConfigMessage", gkFuncRefGet, result);
    }
    break;
  }
  return result;
}

int GetRoadUserChargingConfigMessageCommon_RegionalExtension_Reg_LaneAttributesParams(LONG packetHandle, struct RoadUserChargingConfigMessageCommon_RegionalExtension_Reg_LaneAttributes value, char oldPath[])
{
  char newPath[300];
  int result;

  result = 0;

  snprintf(newPath, elcount(newPath), "%s.%s", oldPath, "regionId");
  value.regionId = C2xGetTokenInt(packetHandle, "RoadUserChargingConfigMessage", newPath);
  result = CheckLastError("RoadUserChargingConfigMessage", gkFuncRefGet, result);

  return result;
}

int SetRoadUserChargingConfigMessageCommon_RegionalExtension_Reg_LaneAttributesParams(LONG packetHandle, struct RoadUserChargingConfigMessageCommon_RegionalExtension_Reg_LaneAttributes value, char oldPath[])
{
  char newPath[300];
  int result;

  result = 0;


  return result;
}

int GetRoadUserChargingConfigMessageMapData_LaneAttributesParams(LONG packetHandle, struct RoadUserChargingConfigMessageMapData_LaneAttributes value, char oldPath[])
{
  char newPath[300]; 
  int j; 
  int k;
  int result;

  result = 0;

  snprintf(newPath, elcount(newPath), "%s.%s", oldPath, "directionalUse");
  value.directionalUse.isValidFlag = 1;
  value.directionalUse.stringLength = C2xGetTokenLengthBit(packetHandle, "RoadUserChargingConfigMessage", newPath);
  if ((result = CheckLastError("RoadUserChargingConfigMessage", gkFuncRefGet, result))==0)
  {
    if(value.directionalUse.stringLength > 0)
    {
      for(j=0; j<value.directionalUse.stringLength; j++)
      {
        if(C2xGetTokenBitOfBitString(packetHandle, "RoadUserChargingConfigMessage", newPath, j) == 0)
        {
          value.directionalUse.string[j] = '0';
        }
        else if(C2xGetTokenBitOfBitString(packetHandle, "RoadUserChargingConfigMessage", newPath, j) == 1)
        {
          value.directionalUse.string[j] = '1';
        }

        if(value.directionalUse.stringLength == 1)
        {
          value.directionalUse.string[1] = '0';
        }
        result = CheckLastError("RoadUserChargingConfigMessage", gkFuncRefGet, result);
      }
    }
    else
    {
      for(k = value.directionalUse.stringLength+1; k > -1; k--)
      {
        if(value.directionalUse.string[k] == '1')
        {
          value.directionalUse.string[k] = '0';
        }
      }
    }
  }

  snprintf(newPath, elcount(newPath), "%s.%s", oldPath, "sharedWith");
  value.sharedWith.isValidFlag = 1;
  value.sharedWith.stringLength = C2xGetTokenLengthBit(packetHandle, "RoadUserChargingConfigMessage", newPath);
  if ((result = CheckLastError("RoadUserChargingConfigMessage", gkFuncRefGet, result))==0)
  {
    if(value.sharedWith.stringLength > 0)
    {
      for(j=0; j<value.sharedWith.stringLength; j++)
      {
        if(C2xGetTokenBitOfBitString(packetHandle, "RoadUserChargingConfigMessage", newPath, j) == 0)
        {
          value.sharedWith.string[j] = '0';
        }
        else if(C2xGetTokenBitOfBitString(packetHandle, "RoadUserChargingConfigMessage", newPath, j) == 1)
        {
          value.sharedWith.string[j] = '1';
        }

        if(value.sharedWith.stringLength == 1)
        {
          value.sharedWith.string[1] = '0';
        }
        result = CheckLastError("RoadUserChargingConfigMessage", gkFuncRefGet, result);
      }
    }
    else
    {
      for(k = value.sharedWith.stringLength+1; k > -1; k--)
      {
        if(value.sharedWith.string[k] == '1')
        {
          value.sharedWith.string[k] = '0';
        }
      }
    }
  }

  snprintf(newPath, elcount(newPath), "%s.%s", oldPath, "laneType");
  GetRoadUserChargingConfigMessageMapData_LaneTypeAttributesParams(packetHandle, value.laneType, newPath);
  result = CheckLastError("RoadUserChargingConfigMessage", gkFuncRefGet, result);

  snprintf(newPath, elcount(newPath), "%s.%s", oldPath, "regional");
  value.regional.isValidFlag = C2xIsTokenAvailable(packetHandle, "RoadUserChargingConfigMessage", newPath);
  if(value.regional.isValidFlag==1)
  {
    GetRoadUserChargingConfigMessageCommon_RegionalExtension_Reg_LaneAttributesParams(packetHandle, value.regional, newPath);
    result = CheckLastError("RoadUserChargingConfigMessage", gkFuncRefGet, result);
  }
  return result;
}

int SetRoadUserChargingConfigMessageMapData_LaneAttributesParams(LONG packetHandle, struct RoadUserChargingConfigMessageMapData_LaneAttributes value, char oldPath[])
{
  char newPath[300]; 
  int j;
  int result;

  result = 0;

  snprintf(newPath, elcount(newPath), "%s.%s", oldPath, "directionalUse");
    for(j=0; j<value.directionalUse.stringLength; j++)
    {
      if(value.directionalUse.string[j] == '0')
      {
        C2xSetTokenBitOfBitString(packetHandle, "RoadUserChargingConfigMessage", newPath, j, 0);
      }
      else
      {
        C2xSetTokenBitOfBitString(packetHandle, "RoadUserChargingConfigMessage", newPath, j, 1);
      }
      result = CheckLastError("RoadUserChargingConfigMessage", gkFuncRefGet, result);
    }

  snprintf(newPath, elcount(newPath), "%s.%s", oldPath, "sharedWith");
    for(j=0; j<value.sharedWith.stringLength; j++)
    {
      if(value.sharedWith.string[j] == '0')
      {
        C2xSetTokenBitOfBitString(packetHandle, "RoadUserChargingConfigMessage", newPath, j, 0);
      }
      else
      {
        C2xSetTokenBitOfBitString(packetHandle, "RoadUserChargingConfigMessage", newPath, j, 1);
      }
      result = CheckLastError("RoadUserChargingConfigMessage", gkFuncRefGet, result);
    }

  snprintf(newPath, elcount(newPath), "%s.%s", oldPath, "laneType");
  SetRoadUserChargingConfigMessageMapData_LaneTypeAttributesParams(packetHandle, value.laneType, newPath);
  result = CheckLastError("RoadUserChargingConfigMessage", gkFuncRefGet, result);

  snprintf(newPath, elcount(newPath), "%s.%s", oldPath, "regional");
  if(value.regional.isValidFlag==1)
  {
    SetRoadUserChargingConfigMessageCommon_RegionalExtension_Reg_LaneAttributesParams(packetHandle, value.regional, newPath);
    result = CheckLastError("RoadUserChargingConfigMessage", gkFuncRefGet, result);
  }
  else
  {
    if( C2xIsTokenAvailable(packetHandle, "RoadUserChargingConfigMessage", newPath) )
    {
      C2xRemoveToken(packetHandle, "RoadUserChargingConfigMessage", newPath);
    }
  }

  return result;
}

int GetRoadUserChargingConfigMessageMapData_ConnectingLaneParams(LONG packetHandle, struct RoadUserChargingConfigMessageMapData_ConnectingLane value, char oldPath[])
{
  char newPath[300]; 
  int j; 
  int k;
  int result;

  result = 0;

  snprintf(newPath, elcount(newPath), "%s.%s", oldPath, "lane");
  value.lane = C2xGetTokenInt(packetHandle, "RoadUserChargingConfigMessage", newPath);
  result = CheckLastError("RoadUserChargingConfigMessage", gkFuncRefGet, result);

  snprintf(newPath, elcount(newPath), "%s.%s", oldPath, "maneuver");
  value.maneuver.isValidFlag = C2xIsTokenAvailable(packetHandle, "RoadUserChargingConfigMessage", newPath);
  if(value.maneuver.isValidFlag==1)
  {
    value.maneuver.isValidFlag = 1;
    value.maneuver.stringLength = C2xGetTokenLengthBit(packetHandle, "RoadUserChargingConfigMessage", newPath);
    if ((result = CheckLastError("RoadUserChargingConfigMessage", gkFuncRefGet, result))==0)
    {
      if(value.maneuver.stringLength > 0)
      {
        for(j=0; j<value.maneuver.stringLength; j++)
        {
          if(C2xGetTokenBitOfBitString(packetHandle, "RoadUserChargingConfigMessage", newPath, j) == 0)
          {
            value.maneuver.string[j] = '0';
          }
          else if(C2xGetTokenBitOfBitString(packetHandle, "RoadUserChargingConfigMessage", newPath, j) == 1)
          {
            value.maneuver.string[j] = '1';
          }

          if(value.maneuver.stringLength == 1)
          {
            value.maneuver.string[1] = '0';
          }
          result = CheckLastError("RoadUserChargingConfigMessage", gkFuncRefGet, result);
        }
      }
      else
      {
        for(k = value.maneuver.stringLength+1; k > -1; k--)
        {
          if(value.maneuver.string[k] == '1')
          {
            value.maneuver.string[k] = '0';
          }
        }
      }
    }

  }
  return result;
}

int SetRoadUserChargingConfigMessageMapData_ConnectingLaneParams(LONG packetHandle, struct RoadUserChargingConfigMessageMapData_ConnectingLane value, char oldPath[])
{
  char newPath[300]; 
  int j;
  int result;

  result = 0;

  snprintf(newPath, elcount(newPath), "%s.%s", oldPath, "lane");
  C2xSetTokenInt(packetHandle, "RoadUserChargingConfigMessage", newPath, value.lane);
  result = CheckLastError("RoadUserChargingConfigMessage", gkFuncRefGet, result);

  snprintf(newPath, elcount(newPath), "%s.%s", oldPath, "maneuver");
  if(value.maneuver.isValidFlag==1)
  {
      for(j=0; j<value.maneuver.stringLength; j++)
      {
        if(value.maneuver.string[j] == '0')
        {
          C2xSetTokenBitOfBitString(packetHandle, "RoadUserChargingConfigMessage", newPath, j, 0);
        }
        else
        {
          C2xSetTokenBitOfBitString(packetHandle, "RoadUserChargingConfigMessage", newPath, j, 1);
        }
        result = CheckLastError("RoadUserChargingConfigMessage", gkFuncRefGet, result);
      }
  }
  else
  {
    if( C2xIsTokenAvailable(packetHandle, "RoadUserChargingConfigMessage", newPath) )
    {
      C2xRemoveToken(packetHandle, "RoadUserChargingConfigMessage", newPath);
    }
  }

  return result;
}

int GetRoadUserChargingConfigMessageCommon_IntersectionReferenceIDParams(LONG packetHandle, struct RoadUserChargingConfigMessageCommon_IntersectionReferenceID value, char oldPath[])
{
  char newPath[300];
  int result;

  result = 0;

  snprintf(newPath, elcount(newPath), "%s.%s", oldPath, "region");
  value.region.isValidFlag = C2xIsTokenAvailable(packetHandle, "RoadUserChargingConfigMessage", newPath);
  if(value.region.isValidFlag==1)
  {
    value.region.value = C2xGetTokenInt(packetHandle, "RoadUserChargingConfigMessage", newPath);
    result = CheckLastError("RoadUserChargingConfigMessage", gkFuncRefGet, result);
  }
  snprintf(newPath, elcount(newPath), "%s.%s", oldPath, "id");
  value.id = C2xGetTokenInt(packetHandle, "RoadUserChargingConfigMessage", newPath);
  result = CheckLastError("RoadUserChargingConfigMessage", gkFuncRefGet, result);

  return result;
}

int SetRoadUserChargingConfigMessageCommon_IntersectionReferenceIDParams(LONG packetHandle, struct RoadUserChargingConfigMessageCommon_IntersectionReferenceID value, char oldPath[])
{
  char newPath[300];
  int result;

  result = 0;

  snprintf(newPath, elcount(newPath), "%s.%s", oldPath, "region");
  if(value.region.isValidFlag==1)
  {
    C2xSetTokenInt(packetHandle, "RoadUserChargingConfigMessage", newPath, value.region.value);
    result = CheckLastError("RoadUserChargingConfigMessage", gkFuncRefGet, result);
  }
  else
  {
    if( C2xIsTokenAvailable(packetHandle, "RoadUserChargingConfigMessage", newPath) )
    {
      C2xRemoveToken(packetHandle, "RoadUserChargingConfigMessage", newPath);
    }
  }

  snprintf(newPath, elcount(newPath), "%s.%s", oldPath, "id");
  C2xSetTokenInt(packetHandle, "RoadUserChargingConfigMessage", newPath, value.id);
  result = CheckLastError("RoadUserChargingConfigMessage", gkFuncRefGet, result);

  return result;
}

int GetRoadUserChargingConfigMessageMapData_ConnectionParams(LONG packetHandle, struct RoadUserChargingConfigMessageMapData_Connection value, char oldPath[])
{
  char newPath[300];
  int result;

  result = 0;

  snprintf(newPath, elcount(newPath), "%s.%s", oldPath, "connectingLane");
  GetRoadUserChargingConfigMessageMapData_ConnectingLaneParams(packetHandle, value.connectingLane, newPath);
  result = CheckLastError("RoadUserChargingConfigMessage", gkFuncRefGet, result);

  snprintf(newPath, elcount(newPath), "%s.%s", oldPath, "remoteIntersection");
  value.remoteIntersection.isValidFlag = C2xIsTokenAvailable(packetHandle, "RoadUserChargingConfigMessage", newPath);
  if(value.remoteIntersection.isValidFlag==1)
  {
    GetRoadUserChargingConfigMessageCommon_IntersectionReferenceIDParams(packetHandle, value.remoteIntersection, newPath);
    result = CheckLastError("RoadUserChargingConfigMessage", gkFuncRefGet, result);
  }
  snprintf(newPath, elcount(newPath), "%s.%s", oldPath, "signalGroup");
  value.signalGroup.isValidFlag = C2xIsTokenAvailable(packetHandle, "RoadUserChargingConfigMessage", newPath);
  if(value.signalGroup.isValidFlag==1)
  {
    value.signalGroup.value = C2xGetTokenInt(packetHandle, "RoadUserChargingConfigMessage", newPath);
    result = CheckLastError("RoadUserChargingConfigMessage", gkFuncRefGet, result);
  }
  snprintf(newPath, elcount(newPath), "%s.%s", oldPath, "userClass");
  value.userClass.isValidFlag = C2xIsTokenAvailable(packetHandle, "RoadUserChargingConfigMessage", newPath);
  if(value.userClass.isValidFlag==1)
  {
    value.userClass.value = C2xGetTokenInt(packetHandle, "RoadUserChargingConfigMessage", newPath);
    result = CheckLastError("RoadUserChargingConfigMessage", gkFuncRefGet, result);
  }
  snprintf(newPath, elcount(newPath), "%s.%s", oldPath, "connectionID");
  value.connectionID.isValidFlag = C2xIsTokenAvailable(packetHandle, "RoadUserChargingConfigMessage", newPath);
  if(value.connectionID.isValidFlag==1)
  {
    value.connectionID.value = C2xGetTokenInt(packetHandle, "RoadUserChargingConfigMessage", newPath);
    result = CheckLastError("RoadUserChargingConfigMessage", gkFuncRefGet, result);
  }
  return result;
}

int SetRoadUserChargingConfigMessageMapData_ConnectionParams(LONG packetHandle, struct RoadUserChargingConfigMessageMapData_Connection value, char oldPath[])
{
  char newPath[300];
  int result;

  result = 0;

  snprintf(newPath, elcount(newPath), "%s.%s", oldPath, "connectingLane");
  SetRoadUserChargingConfigMessageMapData_ConnectingLaneParams(packetHandle, value.connectingLane, newPath);
  result = CheckLastError("RoadUserChargingConfigMessage", gkFuncRefGet, result);

  snprintf(newPath, elcount(newPath), "%s.%s", oldPath, "remoteIntersection");
  if(value.remoteIntersection.isValidFlag==1)
  {
    SetRoadUserChargingConfigMessageCommon_IntersectionReferenceIDParams(packetHandle, value.remoteIntersection, newPath);
    result = CheckLastError("RoadUserChargingConfigMessage", gkFuncRefGet, result);
  }
  else
  {
    if( C2xIsTokenAvailable(packetHandle, "RoadUserChargingConfigMessage", newPath) )
    {
      C2xRemoveToken(packetHandle, "RoadUserChargingConfigMessage", newPath);
    }
  }

  snprintf(newPath, elcount(newPath), "%s.%s", oldPath, "signalGroup");
  if(value.signalGroup.isValidFlag==1)
  {
    C2xSetTokenInt(packetHandle, "RoadUserChargingConfigMessage", newPath, value.signalGroup.value);
    result = CheckLastError("RoadUserChargingConfigMessage", gkFuncRefGet, result);
  }
  else
  {
    if( C2xIsTokenAvailable(packetHandle, "RoadUserChargingConfigMessage", newPath) )
    {
      C2xRemoveToken(packetHandle, "RoadUserChargingConfigMessage", newPath);
    }
  }

  snprintf(newPath, elcount(newPath), "%s.%s", oldPath, "userClass");
  if(value.userClass.isValidFlag==1)
  {
    C2xSetTokenInt(packetHandle, "RoadUserChargingConfigMessage", newPath, value.userClass.value);
    result = CheckLastError("RoadUserChargingConfigMessage", gkFuncRefGet, result);
  }
  else
  {
    if( C2xIsTokenAvailable(packetHandle, "RoadUserChargingConfigMessage", newPath) )
    {
      C2xRemoveToken(packetHandle, "RoadUserChargingConfigMessage", newPath);
    }
  }

  snprintf(newPath, elcount(newPath), "%s.%s", oldPath, "connectionID");
  if(value.connectionID.isValidFlag==1)
  {
    C2xSetTokenInt(packetHandle, "RoadUserChargingConfigMessage", newPath, value.connectionID.value);
    result = CheckLastError("RoadUserChargingConfigMessage", gkFuncRefGet, result);
  }
  else
  {
    if( C2xIsTokenAvailable(packetHandle, "RoadUserChargingConfigMessage", newPath) )
    {
      C2xRemoveToken(packetHandle, "RoadUserChargingConfigMessage", newPath);
    }
  }

  return result;
}

int GetRoadUserChargingConfigMessageMapData_ConnectsToListParams(LONG packetHandle, struct RoadUserChargingConfigMessageMapData_ConnectsToList value, char oldPath[])
{
  char newPath[300]; 
  int i;
  int result;

  result = 0;

  value.length = C2xGetTokenInt(packetHandle, "RoadUserChargingConfigMessage", oldPath);
  if((result = CheckLastError("RoadUserChargingConfigMessage", gkFuncRefGet, result))==0)
  {
    for(i=0; i<value.length; i++)
    {
      snprintf(newPath, elcount(newPath), "%s[%d]", oldPath, i);
      GetRoadUserChargingConfigMessageMapData_ConnectionParams(packetHandle, value.arrayValue[i], newPath);
      result = CheckLastError("RoadUserChargingConfigMessage", gkFuncRefGet, result);
    }
  }
  return result;
}

int SetRoadUserChargingConfigMessageMapData_ConnectsToListParams(LONG packetHandle, struct RoadUserChargingConfigMessageMapData_ConnectsToList value, char oldPath[])
{
  char newPath[300]; 
  int i;
  int result;

  result = 0;

  C2xRemoveToken(packetHandle, "RoadUserChargingConfigMessage", oldPath);
  for(i=0; i<value.length; i++)
  {
    snprintf(newPath, elcount(newPath), "%s[%d]", oldPath, i);
    SetRoadUserChargingConfigMessageMapData_ConnectionParams(packetHandle, value.arrayValue[i], newPath);
    result = CheckLastError("RoadUserChargingConfigMessage", gkFuncRefGet, result);
  }
  return result;
}

int GetRoadUserChargingConfigMessageMapData_OverlayLaneListParams(LONG packetHandle, struct RoadUserChargingConfigMessageMapData_OverlayLaneList value, char oldPath[])
{
  char newPath[300]; 
  int i;
  int result;

  result = 0;

  value.length = C2xGetTokenInt(packetHandle, "RoadUserChargingConfigMessage", oldPath);
  if((result = CheckLastError("RoadUserChargingConfigMessage", gkFuncRefGet, result))==0)
  {
    for(i=0; i<value.length; i++)
    {
      snprintf(newPath, elcount(newPath), "%s[%d]", oldPath, i);
      value.arrayValue[i] = C2xGetTokenInt64(packetHandle, "RoadUserChargingConfigMessage", newPath);
      result = CheckLastError("RoadUserChargingConfigMessage", gkFuncRefGet, result);
    }
  }
  return result;
}

int SetRoadUserChargingConfigMessageMapData_OverlayLaneListParams(LONG packetHandle, struct RoadUserChargingConfigMessageMapData_OverlayLaneList value, char oldPath[])
{
  char newPath[300]; 
  int i;
  int result;

  result = 0;

  C2xRemoveToken(packetHandle, "RoadUserChargingConfigMessage", oldPath);
  for(i=0; i<value.length; i++)
  {
    snprintf(newPath, elcount(newPath), "%s[%d]", oldPath, i);
    C2xSetTokenInt64(packetHandle, "RoadUserChargingConfigMessage", newPath, value.arrayValue[i]);
    result = CheckLastError("RoadUserChargingConfigMessage", gkFuncRefGet, result);
  }
  return result;
}

int GetRoadUserChargingConfigMessageCommon_RegionalExtension_Reg_GenericLaneParams(LONG packetHandle, struct RoadUserChargingConfigMessageCommon_RegionalExtension_Reg_GenericLane value, char oldPath[])
{
  char newPath[300];
  int result;

  result = 0;

  snprintf(newPath, elcount(newPath), "%s.%s", oldPath, "regionId");
  value.regionId = C2xGetTokenInt(packetHandle, "RoadUserChargingConfigMessage", newPath);
  result = CheckLastError("RoadUserChargingConfigMessage", gkFuncRefGet, result);

  return result;
}

int SetRoadUserChargingConfigMessageCommon_RegionalExtension_Reg_GenericLaneParams(LONG packetHandle, struct RoadUserChargingConfigMessageCommon_RegionalExtension_Reg_GenericLane value, char oldPath[])
{
  char newPath[300];
  int result;

  result = 0;


  return result;
}

int GetRoadUserChargingConfigMessageMapData_GenericLane_regionalParams(LONG packetHandle, struct RoadUserChargingConfigMessageMapData_GenericLane_regional value, char oldPath[])
{
  char newPath[300]; 
  int i;
  int result;

  result = 0;

  value.length = C2xGetTokenInt(packetHandle, "RoadUserChargingConfigMessage", oldPath);
  if((result = CheckLastError("RoadUserChargingConfigMessage", gkFuncRefGet, result))==0)
  {
    for(i=0; i<value.length; i++)
    {
      snprintf(newPath, elcount(newPath), "%s[%d]", oldPath, i);
      GetRoadUserChargingConfigMessageCommon_RegionalExtension_Reg_GenericLaneParams(packetHandle, value.arrayValue[i], newPath);
      result = CheckLastError("RoadUserChargingConfigMessage", gkFuncRefGet, result);
    }
  }
  return result;
}

int SetRoadUserChargingConfigMessageMapData_GenericLane_regionalParams(LONG packetHandle, struct RoadUserChargingConfigMessageMapData_GenericLane_regional value, char oldPath[])
{
  char newPath[300]; 
  int i;
  int result;

  result = 0;

  C2xRemoveToken(packetHandle, "RoadUserChargingConfigMessage", oldPath);
  for(i=0; i<value.length; i++)
  {
    snprintf(newPath, elcount(newPath), "%s[%d]", oldPath, i);
    SetRoadUserChargingConfigMessageCommon_RegionalExtension_Reg_GenericLaneParams(packetHandle, value.arrayValue[i], newPath);
    result = CheckLastError("RoadUserChargingConfigMessage", gkFuncRefGet, result);
  }
  return result;
}

int GetRoadUserChargingConfigMessageMapData_GenericLaneParams(LONG packetHandle, struct RoadUserChargingConfigMessageMapData_GenericLane value, char oldPath[])
{
  char newPath[300]; 
  int j; 
  int k;
  int result;

  result = 0;

  snprintf(newPath, elcount(newPath), "%s.%s", oldPath, "laneID");
  value.laneID = C2xGetTokenInt(packetHandle, "RoadUserChargingConfigMessage", newPath);
  result = CheckLastError("RoadUserChargingConfigMessage", gkFuncRefGet, result);

  snprintf(newPath, elcount(newPath), "%s.%s", oldPath, "name");
  value.name.isValidFlag = C2xIsTokenAvailable(packetHandle, "RoadUserChargingConfigMessage", newPath);
  if(value.name.isValidFlag==1)
  {
    value.name.stringLength = C2xGetTokenData(packetHandle, "RoadUserChargingConfigMessage", newPath, elcount(value.name.string), value.name.string);
    result = CheckLastError("RoadUserChargingConfigMessage", gkFuncRefGet, result);
  }
  snprintf(newPath, elcount(newPath), "%s.%s", oldPath, "ingressApproach");
  value.ingressApproach.isValidFlag = C2xIsTokenAvailable(packetHandle, "RoadUserChargingConfigMessage", newPath);
  if(value.ingressApproach.isValidFlag==1)
  {
    value.ingressApproach.value = C2xGetTokenInt(packetHandle, "RoadUserChargingConfigMessage", newPath);
    result = CheckLastError("RoadUserChargingConfigMessage", gkFuncRefGet, result);
  }
  snprintf(newPath, elcount(newPath), "%s.%s", oldPath, "egressApproach");
  value.egressApproach.isValidFlag = C2xIsTokenAvailable(packetHandle, "RoadUserChargingConfigMessage", newPath);
  if(value.egressApproach.isValidFlag==1)
  {
    value.egressApproach.value = C2xGetTokenInt(packetHandle, "RoadUserChargingConfigMessage", newPath);
    result = CheckLastError("RoadUserChargingConfigMessage", gkFuncRefGet, result);
  }
  snprintf(newPath, elcount(newPath), "%s.%s", oldPath, "laneAttributes");
  GetRoadUserChargingConfigMessageMapData_LaneAttributesParams(packetHandle, value.laneAttributes, newPath);
  result = CheckLastError("RoadUserChargingConfigMessage", gkFuncRefGet, result);

  snprintf(newPath, elcount(newPath), "%s.%s", oldPath, "maneuvers");
  value.maneuvers.isValidFlag = C2xIsTokenAvailable(packetHandle, "RoadUserChargingConfigMessage", newPath);
  if(value.maneuvers.isValidFlag==1)
  {
    value.maneuvers.isValidFlag = 1;
    value.maneuvers.stringLength = C2xGetTokenLengthBit(packetHandle, "RoadUserChargingConfigMessage", newPath);
    if ((result = CheckLastError("RoadUserChargingConfigMessage", gkFuncRefGet, result))==0)
    {
      if(value.maneuvers.stringLength > 0)
      {
        for(j=0; j<value.maneuvers.stringLength; j++)
        {
          if(C2xGetTokenBitOfBitString(packetHandle, "RoadUserChargingConfigMessage", newPath, j) == 0)
          {
            value.maneuvers.string[j] = '0';
          }
          else if(C2xGetTokenBitOfBitString(packetHandle, "RoadUserChargingConfigMessage", newPath, j) == 1)
          {
            value.maneuvers.string[j] = '1';
          }

          if(value.maneuvers.stringLength == 1)
          {
            value.maneuvers.string[1] = '0';
          }
          result = CheckLastError("RoadUserChargingConfigMessage", gkFuncRefGet, result);
        }
      }
      else
      {
        for(k = value.maneuvers.stringLength+1; k > -1; k--)
        {
          if(value.maneuvers.string[k] == '1')
          {
            value.maneuvers.string[k] = '0';
          }
        }
      }
    }

  }
  snprintf(newPath, elcount(newPath), "%s.%s", oldPath, "nodeList");
  GetRoadUserChargingConfigMessageCommon_NodeListXYParams(packetHandle, value.nodeList, newPath);
  result = CheckLastError("RoadUserChargingConfigMessage", gkFuncRefGet, result);

  snprintf(newPath, elcount(newPath), "%s.%s", oldPath, "connectsTo");
  value.connectsTo.isValidFlag = C2xIsTokenAvailable(packetHandle, "RoadUserChargingConfigMessage", newPath);
  if(value.connectsTo.isValidFlag==1)
  {
    GetRoadUserChargingConfigMessageMapData_ConnectsToListParams(packetHandle, value.connectsTo, newPath);
    result = CheckLastError("RoadUserChargingConfigMessage", gkFuncRefGet, result);
  }
  snprintf(newPath, elcount(newPath), "%s.%s", oldPath, "overlays");
  value.overlays.isValidFlag = C2xIsTokenAvailable(packetHandle, "RoadUserChargingConfigMessage", newPath);
  if(value.overlays.isValidFlag==1)
  {
    GetRoadUserChargingConfigMessageMapData_OverlayLaneListParams(packetHandle, value.overlays, newPath);
    result = CheckLastError("RoadUserChargingConfigMessage", gkFuncRefGet, result);
  }
  snprintf(newPath, elcount(newPath), "%s.%s", oldPath, "regional");
  value.regional.isValidFlag = C2xIsTokenAvailable(packetHandle, "RoadUserChargingConfigMessage", newPath);
  if(value.regional.isValidFlag==1)
  {
    GetRoadUserChargingConfigMessageMapData_GenericLane_regionalParams(packetHandle, value.regional, newPath);
    result = CheckLastError("RoadUserChargingConfigMessage", gkFuncRefGet, result);
  }
  return result;
}

int SetRoadUserChargingConfigMessageMapData_GenericLaneParams(LONG packetHandle, struct RoadUserChargingConfigMessageMapData_GenericLane value, char oldPath[])
{
  char newPath[300]; 
  int j;
  int result;

  result = 0;

  snprintf(newPath, elcount(newPath), "%s.%s", oldPath, "laneID");
  C2xSetTokenInt(packetHandle, "RoadUserChargingConfigMessage", newPath, value.laneID);
  result = CheckLastError("RoadUserChargingConfigMessage", gkFuncRefGet, result);

  snprintf(newPath, elcount(newPath), "%s.%s", oldPath, "name");
  if(value.name.isValidFlag==1)
  {
    C2xSetTokenData(packetHandle, "RoadUserChargingConfigMessage", newPath, value.name.stringLength, value.name.string);
    result = CheckLastError("RoadUserChargingConfigMessage", gkFuncRefGet, result);
  }
  else
  {
    if( C2xIsTokenAvailable(packetHandle, "RoadUserChargingConfigMessage", newPath) )
    {
      C2xRemoveToken(packetHandle, "RoadUserChargingConfigMessage", newPath);
    }
  }

  snprintf(newPath, elcount(newPath), "%s.%s", oldPath, "ingressApproach");
  if(value.ingressApproach.isValidFlag==1)
  {
    C2xSetTokenInt(packetHandle, "RoadUserChargingConfigMessage", newPath, value.ingressApproach.value);
    result = CheckLastError("RoadUserChargingConfigMessage", gkFuncRefGet, result);
  }
  else
  {
    if( C2xIsTokenAvailable(packetHandle, "RoadUserChargingConfigMessage", newPath) )
    {
      C2xRemoveToken(packetHandle, "RoadUserChargingConfigMessage", newPath);
    }
  }

  snprintf(newPath, elcount(newPath), "%s.%s", oldPath, "egressApproach");
  if(value.egressApproach.isValidFlag==1)
  {
    C2xSetTokenInt(packetHandle, "RoadUserChargingConfigMessage", newPath, value.egressApproach.value);
    result = CheckLastError("RoadUserChargingConfigMessage", gkFuncRefGet, result);
  }
  else
  {
    if( C2xIsTokenAvailable(packetHandle, "RoadUserChargingConfigMessage", newPath) )
    {
      C2xRemoveToken(packetHandle, "RoadUserChargingConfigMessage", newPath);
    }
  }

  snprintf(newPath, elcount(newPath), "%s.%s", oldPath, "laneAttributes");
  SetRoadUserChargingConfigMessageMapData_LaneAttributesParams(packetHandle, value.laneAttributes, newPath);
  result = CheckLastError("RoadUserChargingConfigMessage", gkFuncRefGet, result);

  snprintf(newPath, elcount(newPath), "%s.%s", oldPath, "maneuvers");
  if(value.maneuvers.isValidFlag==1)
  {
      for(j=0; j<value.maneuvers.stringLength; j++)
      {
        if(value.maneuvers.string[j] == '0')
        {
          C2xSetTokenBitOfBitString(packetHandle, "RoadUserChargingConfigMessage", newPath, j, 0);
        }
        else
        {
          C2xSetTokenBitOfBitString(packetHandle, "RoadUserChargingConfigMessage", newPath, j, 1);
        }
        result = CheckLastError("RoadUserChargingConfigMessage", gkFuncRefGet, result);
      }
  }
  else
  {
    if( C2xIsTokenAvailable(packetHandle, "RoadUserChargingConfigMessage", newPath) )
    {
      C2xRemoveToken(packetHandle, "RoadUserChargingConfigMessage", newPath);
    }
  }

  snprintf(newPath, elcount(newPath), "%s.%s", oldPath, "nodeList");
  SetRoadUserChargingConfigMessageCommon_NodeListXYParams(packetHandle, value.nodeList, newPath);
  result = CheckLastError("RoadUserChargingConfigMessage", gkFuncRefGet, result);

  snprintf(newPath, elcount(newPath), "%s.%s", oldPath, "connectsTo");
  if(value.connectsTo.isValidFlag==1)
  {
    SetRoadUserChargingConfigMessageMapData_ConnectsToListParams(packetHandle, value.connectsTo, newPath);
    result = CheckLastError("RoadUserChargingConfigMessage", gkFuncRefGet, result);
  }
  else
  {
    if( C2xIsTokenAvailable(packetHandle, "RoadUserChargingConfigMessage", newPath) )
    {
      C2xRemoveToken(packetHandle, "RoadUserChargingConfigMessage", newPath);
    }
  }

  snprintf(newPath, elcount(newPath), "%s.%s", oldPath, "overlays");
  if(value.overlays.isValidFlag==1)
  {
    SetRoadUserChargingConfigMessageMapData_OverlayLaneListParams(packetHandle, value.overlays, newPath);
    result = CheckLastError("RoadUserChargingConfigMessage", gkFuncRefGet, result);
  }
  else
  {
    if( C2xIsTokenAvailable(packetHandle, "RoadUserChargingConfigMessage", newPath) )
    {
      C2xRemoveToken(packetHandle, "RoadUserChargingConfigMessage", newPath);
    }
  }

  snprintf(newPath, elcount(newPath), "%s.%s", oldPath, "regional");
  if(value.regional.isValidFlag==1)
  {
    SetRoadUserChargingConfigMessageMapData_GenericLane_regionalParams(packetHandle, value.regional, newPath);
    result = CheckLastError("RoadUserChargingConfigMessage", gkFuncRefGet, result);
  }
  else
  {
    if( C2xIsTokenAvailable(packetHandle, "RoadUserChargingConfigMessage", newPath) )
    {
      C2xRemoveToken(packetHandle, "RoadUserChargingConfigMessage", newPath);
    }
  }

  return result;
}

int GetRoadUserChargingConfigMessageTollAdvertisementMessage_TollPointMap_approachLanesMapParams(LONG packetHandle, struct RoadUserChargingConfigMessageTollAdvertisementMessage_TollPointMap_approachLanesMap value, char oldPath[])
{
  char newPath[300]; 
  int i;
  int result;

  result = 0;

  value.length = C2xGetTokenInt(packetHandle, "RoadUserChargingConfigMessage", oldPath);
  if((result = CheckLastError("RoadUserChargingConfigMessage", gkFuncRefGet, result))==0)
  {
    for(i=0; i<value.length; i++)
    {
      snprintf(newPath, elcount(newPath), "%s[%d]", oldPath, i);
      GetRoadUserChargingConfigMessageMapData_GenericLaneParams(packetHandle, value.arrayValue[i], newPath);
      result = CheckLastError("RoadUserChargingConfigMessage", gkFuncRefGet, result);
    }
  }
  return result;
}

int SetRoadUserChargingConfigMessageTollAdvertisementMessage_TollPointMap_approachLanesMapParams(LONG packetHandle, struct RoadUserChargingConfigMessageTollAdvertisementMessage_TollPointMap_approachLanesMap value, char oldPath[])
{
  char newPath[300]; 
  int i;
  int result;

  result = 0;

  C2xRemoveToken(packetHandle, "RoadUserChargingConfigMessage", oldPath);
  for(i=0; i<value.length; i++)
  {
    snprintf(newPath, elcount(newPath), "%s[%d]", oldPath, i);
    SetRoadUserChargingConfigMessageMapData_GenericLaneParams(packetHandle, value.arrayValue[i], newPath);
    result = CheckLastError("RoadUserChargingConfigMessage", gkFuncRefGet, result);
  }
  return result;
}

int GetRoadUserChargingConfigMessageTollAdvertisementMessage_TollPointMap_tollZoneLanesMapParams(LONG packetHandle, struct RoadUserChargingConfigMessageTollAdvertisementMessage_TollPointMap_tollZoneLanesMap value, char oldPath[])
{
  char newPath[300]; 
  int i;
  int result;

  result = 0;

  value.length = C2xGetTokenInt(packetHandle, "RoadUserChargingConfigMessage", oldPath);
  if((result = CheckLastError("RoadUserChargingConfigMessage", gkFuncRefGet, result))==0)
  {
    for(i=0; i<value.length; i++)
    {
      snprintf(newPath, elcount(newPath), "%s[%d]", oldPath, i);
      GetRoadUserChargingConfigMessageMapData_GenericLaneParams(packetHandle, value.arrayValue[i], newPath);
      result = CheckLastError("RoadUserChargingConfigMessage", gkFuncRefGet, result);
    }
  }
  return result;
}

int SetRoadUserChargingConfigMessageTollAdvertisementMessage_TollPointMap_tollZoneLanesMapParams(LONG packetHandle, struct RoadUserChargingConfigMessageTollAdvertisementMessage_TollPointMap_tollZoneLanesMap value, char oldPath[])
{
  char newPath[300]; 
  int i;
  int result;

  result = 0;

  C2xRemoveToken(packetHandle, "RoadUserChargingConfigMessage", oldPath);
  for(i=0; i<value.length; i++)
  {
    snprintf(newPath, elcount(newPath), "%s[%d]", oldPath, i);
    SetRoadUserChargingConfigMessageMapData_GenericLaneParams(packetHandle, value.arrayValue[i], newPath);
    result = CheckLastError("RoadUserChargingConfigMessage", gkFuncRefGet, result);
  }
  return result;
}

int GetRoadUserChargingConfigMessageTollAdvertisementMessage_TollPointMapParams(LONG packetHandle, struct RoadUserChargingConfigMessageTollAdvertisementMessage_TollPointMap value, char oldPath[])
{
  char newPath[300];
  int result;

  result = 0;

  snprintf(newPath, elcount(newPath), "%s.%s", oldPath, "revisionNum");
  value.revisionNum = C2xGetTokenInt(packetHandle, "RoadUserChargingConfigMessage", newPath);
  result = CheckLastError("RoadUserChargingConfigMessage", gkFuncRefGet, result);

  snprintf(newPath, elcount(newPath), "%s.%s", oldPath, "referencePoint");
  GetRoadUserChargingConfigMessageCommon_Position3DParams(packetHandle, value.referencePoint, newPath);
  result = CheckLastError("RoadUserChargingConfigMessage", gkFuncRefGet, result);

  snprintf(newPath, elcount(newPath), "%s.%s", oldPath, "speedLimit");
  GetRoadUserChargingConfigMessageCommon_RegulatorySpeedLimitParams(packetHandle, value.speedLimit, newPath);
  result = CheckLastError("RoadUserChargingConfigMessage", gkFuncRefGet, result);

  snprintf(newPath, elcount(newPath), "%s.%s", oldPath, "laneWidth");
  value.laneWidth = C2xGetTokenInt(packetHandle, "RoadUserChargingConfigMessage", newPath);
  result = CheckLastError("RoadUserChargingConfigMessage", gkFuncRefGet, result);

  snprintf(newPath, elcount(newPath), "%s.%s", oldPath, "approachLanesMap");
  GetRoadUserChargingConfigMessageTollAdvertisementMessage_TollPointMap_approachLanesMapParams(packetHandle, value.approachLanesMap, newPath);
  result = CheckLastError("RoadUserChargingConfigMessage", gkFuncRefGet, result);

  snprintf(newPath, elcount(newPath), "%s.%s", oldPath, "tollZoneLanesMap");
  GetRoadUserChargingConfigMessageTollAdvertisementMessage_TollPointMap_tollZoneLanesMapParams(packetHandle, value.tollZoneLanesMap, newPath);
  result = CheckLastError("RoadUserChargingConfigMessage", gkFuncRefGet, result);

  return result;
}

int SetRoadUserChargingConfigMessageTollAdvertisementMessage_TollPointMapParams(LONG packetHandle, struct RoadUserChargingConfigMessageTollAdvertisementMessage_TollPointMap value, char oldPath[])
{
  char newPath[300];
  int result;

  result = 0;

  snprintf(newPath, elcount(newPath), "%s.%s", oldPath, "revisionNum");
  if (value.revisionNum < 1)
  {
    C2xSetTokenInt(packetHandle, "RoadUserChargingConfigMessage", newPath, 1);
  }
  else if (value.revisionNum > 10)
  {
    C2xSetTokenInt(packetHandle, "RoadUserChargingConfigMessage", newPath, 10);
  }
  else
  {
    C2xSetTokenInt(packetHandle, "RoadUserChargingConfigMessage", newPath, value.revisionNum);
  }
  result = CheckLastError("RoadUserChargingConfigMessage", gkFuncRefGet, result);

  snprintf(newPath, elcount(newPath), "%s.%s", oldPath, "referencePoint");
  SetRoadUserChargingConfigMessageCommon_Position3DParams(packetHandle, value.referencePoint, newPath);
  result = CheckLastError("RoadUserChargingConfigMessage", gkFuncRefGet, result);

  snprintf(newPath, elcount(newPath), "%s.%s", oldPath, "speedLimit");
  SetRoadUserChargingConfigMessageCommon_RegulatorySpeedLimitParams(packetHandle, value.speedLimit, newPath);
  result = CheckLastError("RoadUserChargingConfigMessage", gkFuncRefGet, result);

  snprintf(newPath, elcount(newPath), "%s.%s", oldPath, "laneWidth");
  C2xSetTokenInt(packetHandle, "RoadUserChargingConfigMessage", newPath, value.laneWidth);
  result = CheckLastError("RoadUserChargingConfigMessage", gkFuncRefGet, result);

  snprintf(newPath, elcount(newPath), "%s.%s", oldPath, "approachLanesMap");
  SetRoadUserChargingConfigMessageTollAdvertisementMessage_TollPointMap_approachLanesMapParams(packetHandle, value.approachLanesMap, newPath);
  result = CheckLastError("RoadUserChargingConfigMessage", gkFuncRefGet, result);

  snprintf(newPath, elcount(newPath), "%s.%s", oldPath, "tollZoneLanesMap");
  SetRoadUserChargingConfigMessageTollAdvertisementMessage_TollPointMap_tollZoneLanesMapParams(packetHandle, value.tollZoneLanesMap, newPath);
  result = CheckLastError("RoadUserChargingConfigMessage", gkFuncRefGet, result);

  return result;
}

int GetRoadUserChargingConfigMessageTollAdvertisementMessage_AckPolicyParams(LONG packetHandle, struct RoadUserChargingConfigMessageTollAdvertisementMessage_AckPolicy value, char oldPath[])
{
  char newPath[300];
  int result;

  result = 0;

  snprintf(newPath, elcount(newPath), "%s.%s", oldPath, "timeout");
  value.timeout = C2xGetTokenInt(packetHandle, "RoadUserChargingConfigMessage", newPath);
  result = CheckLastError("RoadUserChargingConfigMessage", gkFuncRefGet, result);

  snprintf(newPath, elcount(newPath), "%s.%s", oldPath, "numOfRetries");
  value.numOfRetries = C2xGetTokenInt(packetHandle, "RoadUserChargingConfigMessage", newPath);
  result = CheckLastError("RoadUserChargingConfigMessage", gkFuncRefGet, result);

  return result;
}

int SetRoadUserChargingConfigMessageTollAdvertisementMessage_AckPolicyParams(LONG packetHandle, struct RoadUserChargingConfigMessageTollAdvertisementMessage_AckPolicy value, char oldPath[])
{
  char newPath[300];
  int result;

  result = 0;

  snprintf(newPath, elcount(newPath), "%s.%s", oldPath, "timeout");
  if (value.timeout < 100)
  {
    C2xSetTokenInt(packetHandle, "RoadUserChargingConfigMessage", newPath, 100);
  }
  else if (value.timeout > 10000)
  {
    C2xSetTokenInt(packetHandle, "RoadUserChargingConfigMessage", newPath, 10000);
  }
  else
  {
    C2xSetTokenInt(packetHandle, "RoadUserChargingConfigMessage", newPath, value.timeout);
  }
  result = CheckLastError("RoadUserChargingConfigMessage", gkFuncRefGet, result);

  snprintf(newPath, elcount(newPath), "%s.%s", oldPath, "numOfRetries");
  if (value.numOfRetries < 1)
  {
    C2xSetTokenInt(packetHandle, "RoadUserChargingConfigMessage", newPath, 1);
  }
  else if (value.numOfRetries > 5)
  {
    C2xSetTokenInt(packetHandle, "RoadUserChargingConfigMessage", newPath, 5);
  }
  else
  {
    C2xSetTokenInt(packetHandle, "RoadUserChargingConfigMessage", newPath, value.numOfRetries);
  }
  result = CheckLastError("RoadUserChargingConfigMessage", gkFuncRefGet, result);

  return result;
}

int GetRoadUserChargingConfigMessageTollAdvertisementMessage_TollAdvertisementInfoParams(LONG packetHandle, struct RoadUserChargingConfigMessageTollAdvertisementMessage_TollAdvertisementInfo value, char oldPath[])
{
  char newPath[300];
  int result;

  result = 0;

  snprintf(newPath, elcount(newPath), "%s.%s", oldPath, "tamSequenceNum");
  value.tamSequenceNum = C2xGetTokenInt(packetHandle, "RoadUserChargingConfigMessage", newPath);
  result = CheckLastError("RoadUserChargingConfigMessage", gkFuncRefGet, result);

  snprintf(newPath, elcount(newPath), "%s.%s", oldPath, "totalTams");
  value.totalTams = C2xGetTokenInt(packetHandle, "RoadUserChargingConfigMessage", newPath);
  result = CheckLastError("RoadUserChargingConfigMessage", gkFuncRefGet, result);

  snprintf(newPath, elcount(newPath), "%s.%s", oldPath, "tamNum");
  value.tamNum = C2xGetTokenInt(packetHandle, "RoadUserChargingConfigMessage", newPath);
  result = CheckLastError("RoadUserChargingConfigMessage", gkFuncRefGet, result);

  snprintf(newPath, elcount(newPath), "%s.%s", oldPath, "tollChargerInfo");
  GetRoadUserChargingConfigMessageTollAdvertisementMessage_TollChargerInfoParams(packetHandle, value.tollChargerInfo, newPath);
  result = CheckLastError("RoadUserChargingConfigMessage", gkFuncRefGet, result);

  snprintf(newPath, elcount(newPath), "%s.%s", oldPath, "timestamp");
  GetRoadUserChargingConfigMessageCommon_DDateTimeParams(packetHandle, value.timestamp, newPath);
  result = CheckLastError("RoadUserChargingConfigMessage", gkFuncRefGet, result);

  snprintf(newPath, elcount(newPath), "%s.%s", oldPath, "tumInstructions");
  value.tumInstructions.isValidFlag = C2xIsTokenAvailable(packetHandle, "RoadUserChargingConfigMessage", newPath);
  if(value.tumInstructions.isValidFlag==1)
  {
    GetRoadUserChargingConfigMessageTollAdvertisementMessage_TumInstructionsParams(packetHandle, value.tumInstructions, newPath);
    result = CheckLastError("RoadUserChargingConfigMessage", gkFuncRefGet, result);
  }
  snprintf(newPath, elcount(newPath), "%s.%s", oldPath, "tollPointMap");
  GetRoadUserChargingConfigMessageTollAdvertisementMessage_TollPointMapParams(packetHandle, value.tollPointMap, newPath);
  result = CheckLastError("RoadUserChargingConfigMessage", gkFuncRefGet, result);

  snprintf(newPath, elcount(newPath), "%s.%s", oldPath, "tumPublicKey");
  value.tumPublicKey.stringLength = C2xGetTokenData(packetHandle, "RoadUserChargingConfigMessage", newPath, elcount(value.tumPublicKey.string), value.tumPublicKey.string);
  snprintf(newPath, elcount(newPath), "%s.%s", oldPath, "ackPolicy");
  GetRoadUserChargingConfigMessageTollAdvertisementMessage_AckPolicyParams(packetHandle, value.ackPolicy, newPath);
  result = CheckLastError("RoadUserChargingConfigMessage", gkFuncRefGet, result);

  snprintf(newPath, elcount(newPath), "%s.%s", oldPath, "lastTollPtDataReq");
  value.lastTollPtDataReq.isValidFlag = C2xIsTokenAvailable(packetHandle, "RoadUserChargingConfigMessage", newPath);
  if(value.lastTollPtDataReq.isValidFlag==1)
  {
    value.lastTollPtDataReq.value = C2xGetTokenInt64(packetHandle, "RoadUserChargingConfigMessage", newPath);
    result = CheckLastError("RoadUserChargingConfigMessage", gkFuncRefGet, result);
  }
  return result;
}

int SetRoadUserChargingConfigMessageTollAdvertisementMessage_TollAdvertisementInfoParams(LONG packetHandle, struct RoadUserChargingConfigMessageTollAdvertisementMessage_TollAdvertisementInfo value, char oldPath[])
{
  char newPath[300];
  int result;

  result = 0;

  snprintf(newPath, elcount(newPath), "%s.%s", oldPath, "tamSequenceNum");
  C2xSetTokenInt(packetHandle, "RoadUserChargingConfigMessage", newPath, value.tamSequenceNum);
  result = CheckLastError("RoadUserChargingConfigMessage", gkFuncRefGet, result);

  snprintf(newPath, elcount(newPath), "%s.%s", oldPath, "totalTams");
  if (value.totalTams < 1)
  {
    C2xSetTokenInt(packetHandle, "RoadUserChargingConfigMessage", newPath, 1);
  }
  else if (value.totalTams > 10)
  {
    C2xSetTokenInt(packetHandle, "RoadUserChargingConfigMessage", newPath, 10);
  }
  else
  {
    C2xSetTokenInt(packetHandle, "RoadUserChargingConfigMessage", newPath, value.totalTams);
  }
  result = CheckLastError("RoadUserChargingConfigMessage", gkFuncRefGet, result);

  snprintf(newPath, elcount(newPath), "%s.%s", oldPath, "tamNum");
  if (value.tamNum < 1)
  {
    C2xSetTokenInt(packetHandle, "RoadUserChargingConfigMessage", newPath, 1);
  }
  else if (value.tamNum > 10)
  {
    C2xSetTokenInt(packetHandle, "RoadUserChargingConfigMessage", newPath, 10);
  }
  else
  {
    C2xSetTokenInt(packetHandle, "RoadUserChargingConfigMessage", newPath, value.tamNum);
  }
  result = CheckLastError("RoadUserChargingConfigMessage", gkFuncRefGet, result);

  snprintf(newPath, elcount(newPath), "%s.%s", oldPath, "tollChargerInfo");
  SetRoadUserChargingConfigMessageTollAdvertisementMessage_TollChargerInfoParams(packetHandle, value.tollChargerInfo, newPath);
  result = CheckLastError("RoadUserChargingConfigMessage", gkFuncRefGet, result);

  snprintf(newPath, elcount(newPath), "%s.%s", oldPath, "timestamp");
  SetRoadUserChargingConfigMessageCommon_DDateTimeParams(packetHandle, value.timestamp, newPath);
  result = CheckLastError("RoadUserChargingConfigMessage", gkFuncRefGet, result);

  snprintf(newPath, elcount(newPath), "%s.%s", oldPath, "tumInstructions");
  if(value.tumInstructions.isValidFlag==1)
  {
    SetRoadUserChargingConfigMessageTollAdvertisementMessage_TumInstructionsParams(packetHandle, value.tumInstructions, newPath);
    result = CheckLastError("RoadUserChargingConfigMessage", gkFuncRefGet, result);
  }
  else
  {
    if( C2xIsTokenAvailable(packetHandle, "RoadUserChargingConfigMessage", newPath) )
    {
      C2xRemoveToken(packetHandle, "RoadUserChargingConfigMessage", newPath);
    }
  }

  snprintf(newPath, elcount(newPath), "%s.%s", oldPath, "tollPointMap");
  SetRoadUserChargingConfigMessageTollAdvertisementMessage_TollPointMapParams(packetHandle, value.tollPointMap, newPath);
  result = CheckLastError("RoadUserChargingConfigMessage", gkFuncRefGet, result);

  snprintf(newPath, elcount(newPath), "%s.%s", oldPath, "tumPublicKey");
  C2xSetTokenData(packetHandle, "RoadUserChargingConfigMessage", newPath, value.tumPublicKey.stringLength, value.tumPublicKey.string);

  snprintf(newPath, elcount(newPath), "%s.%s", oldPath, "ackPolicy");
  SetRoadUserChargingConfigMessageTollAdvertisementMessage_AckPolicyParams(packetHandle, value.ackPolicy, newPath);
  result = CheckLastError("RoadUserChargingConfigMessage", gkFuncRefGet, result);

  snprintf(newPath, elcount(newPath), "%s.%s", oldPath, "lastTollPtDataReq");
  if(value.lastTollPtDataReq.isValidFlag==1)
  {
    C2xSetTokenInt64(packetHandle, "RoadUserChargingConfigMessage", newPath, value.lastTollPtDataReq.value);
    result = CheckLastError("RoadUserChargingConfigMessage", gkFuncRefGet, result);
  }
  else
  {
    if( C2xIsTokenAvailable(packetHandle, "RoadUserChargingConfigMessage", newPath) )
    {
      C2xRemoveToken(packetHandle, "RoadUserChargingConfigMessage", newPath);
    }
  }

  return result;
}

int GetRoadUserChargingConfigMessageTollAdvertisementMessage_TollAdvertisementMessageParams(LONG packetHandle, struct RoadUserChargingConfigMessageTollAdvertisementMessage_TollAdvertisementMessage value, char oldPath[])
{
  char newPath[300];
  int result;

  result = 0;

  snprintf(newPath, elcount(newPath), "%s.%s", oldPath, "tollChargesTable");
  GetRoadUserChargingConfigMessageTollAdvertisementMessage_TollChargesTableParams(packetHandle, value.tollChargesTable, newPath);
  result = CheckLastError("RoadUserChargingConfigMessage", gkFuncRefGet, result);

  snprintf(newPath, elcount(newPath), "%s.%s", oldPath, "tollAdvInfo");
  value.tollAdvInfo.isValidFlag = C2xIsTokenAvailable(packetHandle, "RoadUserChargingConfigMessage", newPath);
  if(value.tollAdvInfo.isValidFlag==1)
  {
    GetRoadUserChargingConfigMessageTollAdvertisementMessage_TollAdvertisementInfoParams(packetHandle, value.tollAdvInfo, newPath);
    result = CheckLastError("RoadUserChargingConfigMessage", gkFuncRefGet, result);
  }
  return result;
}

int SetRoadUserChargingConfigMessageTollAdvertisementMessage_TollAdvertisementMessageParams(LONG packetHandle, struct RoadUserChargingConfigMessageTollAdvertisementMessage_TollAdvertisementMessage value, char oldPath[])
{
  char newPath[300];
  int result;

  result = 0;

  snprintf(newPath, elcount(newPath), "%s.%s", oldPath, "tollChargesTable");
  SetRoadUserChargingConfigMessageTollAdvertisementMessage_TollChargesTableParams(packetHandle, value.tollChargesTable, newPath);
  result = CheckLastError("RoadUserChargingConfigMessage", gkFuncRefGet, result);

  snprintf(newPath, elcount(newPath), "%s.%s", oldPath, "tollAdvInfo");
  if(value.tollAdvInfo.isValidFlag==1)
  {
    SetRoadUserChargingConfigMessageTollAdvertisementMessage_TollAdvertisementInfoParams(packetHandle, value.tollAdvInfo, newPath);
    result = CheckLastError("RoadUserChargingConfigMessage", gkFuncRefGet, result);
  }
  else
  {
    if( C2xIsTokenAvailable(packetHandle, "RoadUserChargingConfigMessage", newPath) )
    {
      C2xRemoveToken(packetHandle, "RoadUserChargingConfigMessage", newPath);
    }
  }

  return result;
}

int GetRoadUserChargingConfigMessageSegment_chargingSegmentParams(LONG packetHandle, struct RoadUserChargingConfigMessageSegment_chargingSegment value, char oldPath[])
{
  char newPath[300]; 
  int i;
  int result;

  result = 0;

  value.length = C2xGetTokenInt(packetHandle, "RoadUserChargingConfigMessage", oldPath);
  if((result = CheckLastError("RoadUserChargingConfigMessage", gkFuncRefGet, result))==0)
  {
    for(i=0; i<value.length; i++)
    {
      snprintf(newPath, elcount(newPath), "%s[%d]", oldPath, i);
      GetRoadUserChargingConfigMessageTollAdvertisementMessage_TollAdvertisementMessageParams(packetHandle, value.arrayValue[i], newPath);
      result = CheckLastError("RoadUserChargingConfigMessage", gkFuncRefGet, result);
    }
  }
  return result;
}

int SetRoadUserChargingConfigMessageSegment_chargingSegmentParams(LONG packetHandle, struct RoadUserChargingConfigMessageSegment_chargingSegment value, char oldPath[])
{
  char newPath[300]; 
  int i;
  int result;

  result = 0;

  C2xRemoveToken(packetHandle, "RoadUserChargingConfigMessage", oldPath);
  for(i=0; i<value.length; i++)
  {
    snprintf(newPath, elcount(newPath), "%s[%d]", oldPath, i);
    SetRoadUserChargingConfigMessageTollAdvertisementMessage_TollAdvertisementMessageParams(packetHandle, value.arrayValue[i], newPath);
    result = CheckLastError("RoadUserChargingConfigMessage", gkFuncRefGet, result);
  }
  return result;
}

int GetRoadUserChargingConfigMessageSegmentParams(LONG packetHandle, struct RoadUserChargingConfigMessageSegment value, char oldPath[])
{
  char newPath[300];
  int i;
  int result;

  result = 0;

  snprintf(newPath, elcount(newPath), "%s.%s", oldPath, "segmentID");
  value.segmentID.length = C2xGetTokenInt(packetHandle, "RoadUserChargingConfigMessage", newPath);
  if((result = CheckLastError("RoadUserChargingConfigMessage", gkFuncRefGet, result))==0)
  {
    if(value.segmentID.length > 0)
    {
      for(i=0; i<value.segmentID.length; i++)
      {
        value.segmentID.arrayValue[i].id = C2xGetTokenOidElement(packetHandle, "RoadUserChargingConfigMessage", newPath, i);
      }
    }
  }
  snprintf(newPath, elcount(newPath), "%s.%s", oldPath, "chargingSegment");
  GetRoadUserChargingConfigMessageSegment_chargingSegmentParams(packetHandle, value.chargingSegment, newPath);
  result = CheckLastError("RoadUserChargingConfigMessage", gkFuncRefGet, result);

  snprintf(newPath, elcount(newPath), "%s.%s", oldPath, "chargingUnits");
  value.chargingUnits.isValidFlag = C2xIsTokenAvailable(packetHandle, "RoadUserChargingConfigMessage", newPath);
  if(value.chargingUnits.isValidFlag==1)
  {
    GetRoadUserChargingConfigMessageChargingUnitsParams(packetHandle, value.chargingUnits, newPath);
    result = CheckLastError("RoadUserChargingConfigMessage", gkFuncRefGet, result);
  }
  return result;
}

int SetRoadUserChargingConfigMessageSegmentParams(LONG packetHandle, struct RoadUserChargingConfigMessageSegment value, char oldPath[])
{
  char newPath[300];
  int i;
  int result;

  result = 0;

  snprintf(newPath, elcount(newPath), "%s.%s", oldPath, "segmentID");
  C2xRemoveToken(packetHandle, "RoadUserChargingConfigMessage", newPath);
  if(value.segmentID.length > 0)
  {
    for(i=0; i<value.segmentID.length; i++)
    {
      C2xSetTokenOidElement(packetHandle, "RoadUserChargingConfigMessage", newPath, i, value.segmentID.arrayValue[i].id);
    }
  }
  result = CheckLastError("RoadUserChargingConfigMessage", gkFuncRefGet, result);

  snprintf(newPath, elcount(newPath), "%s.%s", oldPath, "chargingSegment");
  SetRoadUserChargingConfigMessageSegment_chargingSegmentParams(packetHandle, value.chargingSegment, newPath);
  result = CheckLastError("RoadUserChargingConfigMessage", gkFuncRefGet, result);

  snprintf(newPath, elcount(newPath), "%s.%s", oldPath, "chargingUnits");
  if(value.chargingUnits.isValidFlag==1)
  {
    SetRoadUserChargingConfigMessageChargingUnitsParams(packetHandle, value.chargingUnits, newPath);
    result = CheckLastError("RoadUserChargingConfigMessage", gkFuncRefGet, result);
  }
  else
  {
    if( C2xIsTokenAvailable(packetHandle, "RoadUserChargingConfigMessage", newPath) )
    {
      C2xRemoveToken(packetHandle, "RoadUserChargingConfigMessage", newPath);
    }
  }

  return result;
}

int GetRoadUserChargingConfigMessageChargingAreaOrSegmentParams(LONG packetHandle, struct RoadUserChargingConfigMessageChargingAreaOrSegment value, char oldPath[])
{
  char newPath[300];
  int result;

  result = 0;

  value.choice = C2xGetTokenInt(packetHandle, "RoadUserChargingConfigMessage", oldPath);

  switch(value.choice)
  {
    case 0:
    {
      snprintf(newPath, elcount(newPath), "%s.%s", oldPath, "area");
      GetRoadUserChargingConfigMessageAreaParams(packetHandle, value.area, newPath);
      result = CheckLastError("RoadUserChargingConfigMessage", gkFuncRefGet, result);
    }
    break;
    case 1:
    {
      snprintf(newPath, elcount(newPath), "%s.%s", oldPath, "segment");
      GetRoadUserChargingConfigMessageSegmentParams(packetHandle, value.segment, newPath);
      result = CheckLastError("RoadUserChargingConfigMessage", gkFuncRefGet, result);
    }
    break;
  }
  return result;
}

int SetRoadUserChargingConfigMessageChargingAreaOrSegmentParams(LONG packetHandle, struct RoadUserChargingConfigMessageChargingAreaOrSegment value, char oldPath[])
{
  char newPath[300];
  int result;

  result = 0;

  switch(value.choice)
  {
    case 0:
    {
      snprintf(newPath, elcount(newPath), "%s.%s", oldPath, "area");
      SetRoadUserChargingConfigMessageAreaParams(packetHandle, value.area, newPath);
      result = CheckLastError("RoadUserChargingConfigMessage", gkFuncRefGet, result);
    }
    break;
    case 1:
    {
      snprintf(newPath, elcount(newPath), "%s.%s", oldPath, "segment");
      SetRoadUserChargingConfigMessageSegmentParams(packetHandle, value.segment, newPath);
      result = CheckLastError("RoadUserChargingConfigMessage", gkFuncRefGet, result);
    }
    break;
  }
  return result;
}

int GetRoadUserChargingConfigMessageAreaOrSegmentChargingInfo_chargingAreaOrSegmentParams(LONG packetHandle, struct RoadUserChargingConfigMessageAreaOrSegmentChargingInfo_chargingAreaOrSegment value, char oldPath[])
{
  char newPath[300]; 
  int i;
  int result;

  result = 0;

  value.length = C2xGetTokenInt(packetHandle, "RoadUserChargingConfigMessage", oldPath);
  if((result = CheckLastError("RoadUserChargingConfigMessage", gkFuncRefGet, result))==0)
  {
    for(i=0; i<value.length; i++)
    {
      snprintf(newPath, elcount(newPath), "%s[%d]", oldPath, i);
      GetRoadUserChargingConfigMessageChargingAreaOrSegmentParams(packetHandle, value.arrayValue[i], newPath);
      result = CheckLastError("RoadUserChargingConfigMessage", gkFuncRefGet, result);
    }
  }
  return result;
}

int SetRoadUserChargingConfigMessageAreaOrSegmentChargingInfo_chargingAreaOrSegmentParams(LONG packetHandle, struct RoadUserChargingConfigMessageAreaOrSegmentChargingInfo_chargingAreaOrSegment value, char oldPath[])
{
  char newPath[300]; 
  int i;
  int result;

  result = 0;

  C2xRemoveToken(packetHandle, "RoadUserChargingConfigMessage", oldPath);
  for(i=0; i<value.length; i++)
  {
    snprintf(newPath, elcount(newPath), "%s[%d]", oldPath, i);
    SetRoadUserChargingConfigMessageChargingAreaOrSegmentParams(packetHandle, value.arrayValue[i], newPath);
    result = CheckLastError("RoadUserChargingConfigMessage", gkFuncRefGet, result);
  }
  return result;
}

int GetRoadUserChargingConfigMessageAreaOrSegmentChargingInfoParams(LONG packetHandle, struct RoadUserChargingConfigMessageAreaOrSegmentChargingInfo value, char oldPath[])
{
  char newPath[300];
  int result;

  result = 0;

  snprintf(newPath, elcount(newPath), "%s.%s", oldPath, "chargingAreaOrSegment");
  GetRoadUserChargingConfigMessageAreaOrSegmentChargingInfo_chargingAreaOrSegmentParams(packetHandle, value.chargingAreaOrSegment, newPath);
  result = CheckLastError("RoadUserChargingConfigMessage", gkFuncRefGet, result);

  return result;
}

int SetRoadUserChargingConfigMessageAreaOrSegmentChargingInfoParams(LONG packetHandle, struct RoadUserChargingConfigMessageAreaOrSegmentChargingInfo value, char oldPath[])
{
  char newPath[300];
  int result;

  result = 0;

  snprintf(newPath, elcount(newPath), "%s.%s", oldPath, "chargingAreaOrSegment");
  SetRoadUserChargingConfigMessageAreaOrSegmentChargingInfo_chargingAreaOrSegmentParams(packetHandle, value.chargingAreaOrSegment, newPath);
  result = CheckLastError("RoadUserChargingConfigMessage", gkFuncRefGet, result);

  return result;
}

int GetRoadUserChargingConfigMessageChargingConfigParams(LONG packetHandle, struct RoadUserChargingConfigMessageChargingConfig value, char oldPath[])
{
  char newPath[300];
  int result;

  result = 0;

  snprintf(newPath, elcount(newPath), "%s.%s", oldPath, "configInfo");
  GetRoadUserChargingConfigMessageConfigInfoParams(packetHandle, value.configInfo, newPath);
  result = CheckLastError("RoadUserChargingConfigMessage", gkFuncRefGet, result);

  snprintf(newPath, elcount(newPath), "%s.%s", oldPath, "reportSched");
  value.reportSched = C2xGetTokenInt(packetHandle, "RoadUserChargingConfigMessage", newPath);
  result = CheckLastError("RoadUserChargingConfigMessage", gkFuncRefGet, result);

  snprintf(newPath, elcount(newPath), "%s.%s", oldPath, "byPrimaryRegion");
  GetRoadUserChargingConfigMessagePrimaryRegionChargingInfoParams(packetHandle, value.byPrimaryRegion, newPath);
  result = CheckLastError("RoadUserChargingConfigMessage", gkFuncRefGet, result);

  snprintf(newPath, elcount(newPath), "%s.%s", oldPath, "bySubRegion");
  value.bySubRegion.isValidFlag = C2xIsTokenAvailable(packetHandle, "RoadUserChargingConfigMessage", newPath);
  if(value.bySubRegion.isValidFlag==1)
  {
    GetRoadUserChargingConfigMessageChargingConfig_bySubRegionParams(packetHandle, value.bySubRegion, newPath);
    result = CheckLastError("RoadUserChargingConfigMessage", gkFuncRefGet, result);
  }
  snprintf(newPath, elcount(newPath), "%s.%s", oldPath, "byAreaOrSegment");
  value.byAreaOrSegment.isValidFlag = C2xIsTokenAvailable(packetHandle, "RoadUserChargingConfigMessage", newPath);
  if(value.byAreaOrSegment.isValidFlag==1)
  {
    GetRoadUserChargingConfigMessageAreaOrSegmentChargingInfoParams(packetHandle, value.byAreaOrSegment, newPath);
    result = CheckLastError("RoadUserChargingConfigMessage", gkFuncRefGet, result);
  }
  return result;
}

int SetRoadUserChargingConfigMessageChargingConfigParams(LONG packetHandle, struct RoadUserChargingConfigMessageChargingConfig value, char oldPath[])
{
  char newPath[300];
  int result;

  result = 0;

  snprintf(newPath, elcount(newPath), "%s.%s", oldPath, "configInfo");
  SetRoadUserChargingConfigMessageConfigInfoParams(packetHandle, value.configInfo, newPath);
  result = CheckLastError("RoadUserChargingConfigMessage", gkFuncRefGet, result);

  snprintf(newPath, elcount(newPath), "%s.%s", oldPath, "reportSched");
  C2xSetTokenInt(packetHandle, "RoadUserChargingConfigMessage", newPath, value.reportSched);
  result = CheckLastError("RoadUserChargingConfigMessage", gkFuncRefGet, result);

  snprintf(newPath, elcount(newPath), "%s.%s", oldPath, "byPrimaryRegion");
  SetRoadUserChargingConfigMessagePrimaryRegionChargingInfoParams(packetHandle, value.byPrimaryRegion, newPath);
  result = CheckLastError("RoadUserChargingConfigMessage", gkFuncRefGet, result);

  snprintf(newPath, elcount(newPath), "%s.%s", oldPath, "bySubRegion");
  if(value.bySubRegion.isValidFlag==1)
  {
    SetRoadUserChargingConfigMessageChargingConfig_bySubRegionParams(packetHandle, value.bySubRegion, newPath);
    result = CheckLastError("RoadUserChargingConfigMessage", gkFuncRefGet, result);
  }
  else
  {
    if( C2xIsTokenAvailable(packetHandle, "RoadUserChargingConfigMessage", newPath) )
    {
      C2xRemoveToken(packetHandle, "RoadUserChargingConfigMessage", newPath);
    }
  }

  snprintf(newPath, elcount(newPath), "%s.%s", oldPath, "byAreaOrSegment");
  if(value.byAreaOrSegment.isValidFlag==1)
  {
    SetRoadUserChargingConfigMessageAreaOrSegmentChargingInfoParams(packetHandle, value.byAreaOrSegment, newPath);
    result = CheckLastError("RoadUserChargingConfigMessage", gkFuncRefGet, result);
  }
  else
  {
    if( C2xIsTokenAvailable(packetHandle, "RoadUserChargingConfigMessage", newPath) )
    {
      C2xRemoveToken(packetHandle, "RoadUserChargingConfigMessage", newPath);
    }
  }

  return result;
}

int GetRoadUserChargingConfigMessageChargerInfoParams(LONG packetHandle, struct RoadUserChargingConfigMessageChargerInfo value, char oldPath[])
{
  char newPath[300];
  int i;
  int result;

  result = 0;

  snprintf(newPath, elcount(newPath), "%s.%s", oldPath, "chargerID");
  value.chargerID.length = C2xGetTokenInt(packetHandle, "RoadUserChargingConfigMessage", newPath);
  if((result = CheckLastError("RoadUserChargingConfigMessage", gkFuncRefGet, result))==0)
  {
    if(value.chargerID.length > 0)
    {
      for(i=0; i<value.chargerID.length; i++)
      {
        value.chargerID.arrayValue[i].id = C2xGetTokenOidElement(packetHandle, "RoadUserChargingConfigMessage", newPath, i);
      }
    }
  }
  snprintf(newPath, elcount(newPath), "%s.%s", oldPath, "descriptiveName");
  value.descriptiveName.isValidFlag = C2xIsTokenAvailable(packetHandle, "RoadUserChargingConfigMessage", newPath);
  if(value.descriptiveName.isValidFlag==1)
  {
    value.descriptiveName.stringLength = C2xGetTokenData(packetHandle, "RoadUserChargingConfigMessage", newPath, elcount(value.descriptiveName.string), value.descriptiveName.string);
    result = CheckLastError("RoadUserChargingConfigMessage", gkFuncRefGet, result);
  }
  snprintf(newPath, elcount(newPath), "%s.%s", oldPath, "timeStamp");
  value.timeStamp.isValidFlag = C2xIsTokenAvailable(packetHandle, "RoadUserChargingConfigMessage", newPath);
  if(value.timeStamp.isValidFlag==1)
  {
    GetRoadUserChargingConfigMessageCommon_DDateTimeParams(packetHandle, value.timeStamp, newPath);
    result = CheckLastError("RoadUserChargingConfigMessage", gkFuncRefGet, result);
  }
  snprintf(newPath, elcount(newPath), "%s.%s", oldPath, "chargingConfig");
  GetRoadUserChargingConfigMessageChargingConfigParams(packetHandle, value.chargingConfig, newPath);
  result = CheckLastError("RoadUserChargingConfigMessage", gkFuncRefGet, result);

  return result;
}

int SetRoadUserChargingConfigMessageChargerInfoParams(LONG packetHandle, struct RoadUserChargingConfigMessageChargerInfo value, char oldPath[])
{
  char newPath[300];
  int i;
  int result;

  result = 0;

  snprintf(newPath, elcount(newPath), "%s.%s", oldPath, "chargerID");
  C2xRemoveToken(packetHandle, "RoadUserChargingConfigMessage", newPath);
  if(value.chargerID.length > 0)
  {
    for(i=0; i<value.chargerID.length; i++)
    {
      C2xSetTokenOidElement(packetHandle, "RoadUserChargingConfigMessage", newPath, i, value.chargerID.arrayValue[i].id);
    }
  }
  result = CheckLastError("RoadUserChargingConfigMessage", gkFuncRefGet, result);

  snprintf(newPath, elcount(newPath), "%s.%s", oldPath, "descriptiveName");
  if(value.descriptiveName.isValidFlag==1)
  {
    C2xSetTokenData(packetHandle, "RoadUserChargingConfigMessage", newPath, value.descriptiveName.stringLength, value.descriptiveName.string);
    result = CheckLastError("RoadUserChargingConfigMessage", gkFuncRefGet, result);
  }
  else
  {
    if( C2xIsTokenAvailable(packetHandle, "RoadUserChargingConfigMessage", newPath) )
    {
      C2xRemoveToken(packetHandle, "RoadUserChargingConfigMessage", newPath);
    }
  }

  snprintf(newPath, elcount(newPath), "%s.%s", oldPath, "timeStamp");
  if(value.timeStamp.isValidFlag==1)
  {
    SetRoadUserChargingConfigMessageCommon_DDateTimeParams(packetHandle, value.timeStamp, newPath);
    result = CheckLastError("RoadUserChargingConfigMessage", gkFuncRefGet, result);
  }
  else
  {
    if( C2xIsTokenAvailable(packetHandle, "RoadUserChargingConfigMessage", newPath) )
    {
      C2xRemoveToken(packetHandle, "RoadUserChargingConfigMessage", newPath);
    }
  }

  snprintf(newPath, elcount(newPath), "%s.%s", oldPath, "chargingConfig");
  SetRoadUserChargingConfigMessageChargingConfigParams(packetHandle, value.chargingConfig, newPath);
  result = CheckLastError("RoadUserChargingConfigMessage", gkFuncRefGet, result);

  return result;
}

int GetRoadUserChargingConfigMessageRoadUserChargingConfigMessage_chargerInfoTableParams(LONG packetHandle, struct RoadUserChargingConfigMessageRoadUserChargingConfigMessage_chargerInfoTable value, char oldPath[])
{
  char newPath[300]; 
  int i;
  int result;

  result = 0;

  value.length = C2xGetTokenInt(packetHandle, "RoadUserChargingConfigMessage", oldPath);
  if((result = CheckLastError("RoadUserChargingConfigMessage", gkFuncRefGet, result))==0)
  {
    for(i=0; i<value.length; i++)
    {
      snprintf(newPath, elcount(newPath), "%s[%d]", oldPath, i);
      GetRoadUserChargingConfigMessageChargerInfoParams(packetHandle, value.arrayValue[i], newPath);
      result = CheckLastError("RoadUserChargingConfigMessage", gkFuncRefGet, result);
    }
  }
  return result;
}

int SetRoadUserChargingConfigMessageRoadUserChargingConfigMessage_chargerInfoTableParams(LONG packetHandle, struct RoadUserChargingConfigMessageRoadUserChargingConfigMessage_chargerInfoTable value, char oldPath[])
{
  char newPath[300]; 
  int i;
  int result;

  result = 0;

  C2xRemoveToken(packetHandle, "RoadUserChargingConfigMessage", oldPath);
  for(i=0; i<value.length; i++)
  {
    snprintf(newPath, elcount(newPath), "%s[%d]", oldPath, i);
    SetRoadUserChargingConfigMessageChargerInfoParams(packetHandle, value.arrayValue[i], newPath);
    result = CheckLastError("RoadUserChargingConfigMessage", gkFuncRefGet, result);
  }
  return result;
}

int GetRoadUserChargingConfigMessage_RoadUserChargingConfigMessageParams(LONG packetHandle, struct RoadUserChargingConfigMessage_RoadUserChargingConfigMessage value, char oldPath[])
{
  char newPath[300];
  int result;

  result = 0;

  snprintf(newPath, elcount(newPath), "%s.%s", oldPath, "chargerInfoTable");
  GetRoadUserChargingConfigMessageRoadUserChargingConfigMessage_chargerInfoTableParams(packetHandle, value.chargerInfoTable, newPath);
  result = CheckLastError("RoadUserChargingConfigMessage", gkFuncRefGet, result);

  return result;
}

int SetRoadUserChargingConfigMessage_RoadUserChargingConfigMessageParams(LONG packetHandle, struct RoadUserChargingConfigMessage_RoadUserChargingConfigMessage value, char oldPath[])
{
  char newPath[300];
  int result;

  result = 0;

  snprintf(newPath, elcount(newPath), "%s.%s", oldPath, "chargerInfoTable");
  SetRoadUserChargingConfigMessageRoadUserChargingConfigMessage_chargerInfoTableParams(packetHandle, value.chargerInfoTable, newPath);
  result = CheckLastError("RoadUserChargingConfigMessage", gkFuncRefGet, result);

  return result;
}

int GetRoadUserChargingConfigMessageMESSAGE_ID_AND_TYPEParams(LONG packetHandle, WORD tableKey, struct RoadUserChargingConfigMessageMESSAGE_ID_AND_TYPE value, char oldPath[])
{
  char newPath[300];
  int result;

  result = 0;

  switch(tableKey)
  {
    case 48:
    {
      snprintf(newPath, elcount(newPath), "%s.%s", oldPath, "roadUserChargingConfigMessage");
      GetRoadUserChargingConfigMessage_RoadUserChargingConfigMessageParams(packetHandle, value.roadUserChargingConfigMessage, newPath);
      result = CheckLastError("RoadUserChargingConfigMessage", gkFuncRefGet, result);
    }
    break;
  }
  return result;
}

int SetRoadUserChargingConfigMessageMESSAGE_ID_AND_TYPEParams(LONG packetHandle, WORD tableKey, struct RoadUserChargingConfigMessageMESSAGE_ID_AND_TYPE value, char oldPath[])
{
  char newPath[300];
  int result;

  result = 0;

  switch(tableKey)
  {
    case 48:
    {
      snprintf(newPath, elcount(newPath), "%s.%s", oldPath, "roadUserChargingConfigMessage");
      SetRoadUserChargingConfigMessage_RoadUserChargingConfigMessageParams(packetHandle, value.roadUserChargingConfigMessage, newPath);
      result = CheckLastError("RoadUserChargingConfigMessage", gkFuncRefGet, result);
    }
    break;
  }
  return result;
}

int API_GetRoadUserChargingConfigMessageParams(LONG packetHandle, struct RoadUserChargingConfigMessage value)
{
  int result;
  result = 0;

  value.messageId = C2xGetTokenInt(packetHandle, "RoadUserChargingConfigMessage", "messageId");
  result = CheckLastError("RoadUserChargingConfigMessage", gkFuncRefGet, result);

  GetRoadUserChargingConfigMessageMESSAGE_ID_AND_TYPEParams(packetHandle, value.messageId, value.value, "value");
  result = CheckLastError("RoadUserChargingConfigMessage", gkFuncRefGet, result);

  return result;
}

int API_SetRoadUserChargingConfigMessageParams(LONG packetHandle, struct RoadUserChargingConfigMessage value)
{
  int result;
  result = 0;

  value.messageId = 48;

  SetRoadUserChargingConfigMessageMESSAGE_ID_AND_TYPEParams(packetHandle, value.messageId, value.value, "value");
  result = CheckLastError("RoadUserChargingConfigMessage", gkFuncRefGet, result);

  return result;
}

