/*@!Encoding:1252*/
/*
//  (c) Vector Informatik GmbH. All rights reserved.
//
//  This file contains definitions of structs and methods that may be used
//  to set and get the values of an ASN.1 defined packet's payload.
//
//  //This example demonstrates how to set a packet's payload:
//  LONG packetHandle;
//  struct RoadWeatherMessage payload;
//  //you need to set the values of the variable "payload" yourself
//  packetHandle = API_InitRoadWeatherMessagePacket();
//  if (packetHandle!=0) {
//    if (API_SetRoadWeatherMessageParams(packetHandle, payload)==0) {
//      if (C2xCompletePacket(packetHandle)==0) {
//        C2xOutputPacket(packetHandle);
//      }
//    }
//  }
//                                                                             */
includes
{
  #include "ASNV_Template_BaseDatatypes.cin"  // If warning "Duplicate #include, ignoring this include" appears, please remove the ASNV_Template_BaseDatatypes.cin include from your other *.cin files in the project.
}
variables
{
    struct RoadWeatherMessageCommon_DDateTime {
        INT isValidFlag;   // necessary if this struct is used as an optional field of a SEQUENCE
        struct OPT_WORD_ASN year;  // INTEGER, OPTIONAL, 0..4095;
        struct OPT_BYTE_ASN month;  // INTEGER, OPTIONAL, 0..12;
        struct OPT_BYTE_ASN day;  // INTEGER, OPTIONAL, 0..31;
        struct OPT_BYTE_ASN hour;  // INTEGER, OPTIONAL, 0..31;
        struct OPT_BYTE_ASN minute;  // INTEGER, OPTIONAL, 0..60;
        struct OPT_WORD_ASN second;  // INTEGER, OPTIONAL, 0..65535;
        struct OPT_INT_ASN offset;  // INTEGER, OPTIONAL, -840..840;
    };
    
    struct RoadWeatherMessageCommon_TransmissionAndSpeed {
        INT isValidFlag;   // necessary if this struct is used as an optional field of a SEQUENCE
        INT transmisson;  // ENUMERATED, neutral(0), park(1), forwardGears(2), reverseGears(3), reserved1(4), reserved2(5), reserved3(6), unavailable(7);
        WORD speed;  // INTEGER, 0..8191;
    };
    
    struct RoadWeatherMessageCommon_PositionalAccuracy {
        INT isValidFlag;   // necessary if this struct is used as an optional field of a SEQUENCE
        BYTE semiMajor;  // INTEGER, 0..255;
        BYTE semiMinor;  // INTEGER, 0..255;
        WORD orientation;  // INTEGER, 0..65535;
    };
    
    struct RoadWeatherMessageCommon_PositionConfidenceSet {
        INT isValidFlag;   // necessary if this struct is used as an optional field of a SEQUENCE
        INT pos;  // ENUMERATED, unavailable(0), a500m(1), a200m(2), a100m(3), a50m(4), a20m(5), a10m(6), a5m(7), a2m(8), a1m(9), a50cm(10), a20cm(11), a10cm(12), a5cm(13), a2cm(14), a1cm(15);
        INT elevation;  // ENUMERATED, unavailable(0), elev_500_00(1), elev_200_00(2), elev_100_00(3), elev_050_00(4), elev_020_00(5), elev_010_00(6), elev_005_00(7), elev_002_00(8), elev_001_00(9), elev_000_50(10), elev_000_20(11), elev_000_10(12), elev_000_05(13), elev_000_02(14), elev_000_01(15);
    };
    
    struct RoadWeatherMessageCommon_SpeedandHeadingandThrottleConfidence {
        INT isValidFlag;   // necessary if this struct is used as an optional field of a SEQUENCE
        INT heading;  // ENUMERATED, unavailable(0), prec10deg(1), prec05deg(2), prec01deg(3), prec0_1deg(4), prec0_05deg(5), prec0_01deg(6), prec0_0125deg(7);
        INT speed;  // ENUMERATED, unavailable(0), prec100ms(1), prec10ms(2), prec5ms(3), prec1ms(4), prec0_1ms(5), prec0_05ms(6), prec0_01ms(7);
        INT throttle;  // ENUMERATED, unavailable(0), prec10percent(1), prec1percent(2), prec0_5percent(3);
    };
    
    struct RoadWeatherMessageCommon_FullPositionVector {
        INT isValidFlag;   // necessary if this struct is used as an optional field of a SEQUENCE
        struct RoadWeatherMessageCommon_DDateTime utcTime;  // SEQUENCE, OPTIONAL;
        LONG lon;  // INTEGER, -1799999999..1800000001;
        LONG lat;  // INTEGER, -900000000..900000001;
        struct OPT_LONG_ASN elevation;  // INTEGER, OPTIONAL, -4096..61439;
        struct OPT_WORD_ASN heading;  // INTEGER, OPTIONAL, 0..28800;
        struct RoadWeatherMessageCommon_TransmissionAndSpeed speed;  // SEQUENCE, OPTIONAL;
        struct RoadWeatherMessageCommon_PositionalAccuracy posAccuracy;  // SEQUENCE, OPTIONAL;
        struct OPT_ENUM_ASN timeConfidence;  // ENUMERATED, OPTIONAL, unavailable(0), time_100_000(1), time_050_000(2), time_020_000(3), time_010_000(4), time_002_000(5), time_001_000(6), time_000_500(7), time_000_200(8), time_000_100(9), time_000_050(10), time_000_020(11), time_000_010(12), time_000_005(13), time_000_002(14), time_000_001(15), time_000_000_5(16), time_000_000_2(17), time_000_000_1(18), time_000_000_05(19), time_000_000_02(20), time_000_000_01(21), time_000_000_005(22), time_000_000_002(23), time_000_000_001(24), time_000_000_000_5(25), time_000_000_000_2(26), time_000_000_000_1(27), time_000_000_000_05(28), time_000_000_000_02(29), time_000_000_000_01(30), time_000_000_000_005(31), time_000_000_000_002(32), time_000_000_000_001(33), time_000_000_000_000_5(34), time_000_000_000_000_2(35), time_000_000_000_000_1(36), time_000_000_000_000_05(37), time_000_000_000_000_02(38), time_000_000_000_000_01(39);
        struct RoadWeatherMessageCommon_PositionConfidenceSet posConfidence;  // SEQUENCE, OPTIONAL;
        struct RoadWeatherMessageCommon_SpeedandHeadingandThrottleConfidence speedConfidence;  // SEQUENCE, OPTIONAL;
    };
    
    struct RoadWeatherMessageCommon_VehicleEventFlags {
        INT isValidFlag;   // necessary if this struct is used as an optional field of a SEQUENCE
        CHAR string[15];
        INT  stringLength;
    };
    
    struct RoadWeatherMessageCommon_GNSSstatus {
        INT isValidFlag;   // necessary if this struct is used as an optional field of a SEQUENCE
        CHAR string[9];
        INT  stringLength;
    };
    
    struct RoadWeatherMessageCommon_PathHistoryPoint {
        INT isValidFlag;   // necessary if this struct is used as an optional field of a SEQUENCE
        LONG latOffset;  // INTEGER, -131072..131071;
        LONG lonOffset;  // INTEGER, -131072..131071;
        INT elevationOffset;  // INTEGER, -2048..2047;
        WORD timeOffset;  // INTEGER, 1..65535;
        struct OPT_WORD_ASN speed;  // INTEGER, OPTIONAL, 0..8191;
        struct RoadWeatherMessageCommon_PositionalAccuracy posAccuracy;  // SEQUENCE, OPTIONAL;
        struct OPT_BYTE_ASN heading;  // INTEGER, OPTIONAL, 0..240;
    };
    
    struct RoadWeatherMessageCommon_PathHistoryPointList {
        INT isValidFlag;   // necessary if this struct is used as an optional field of a SEQUENCE
        INT length;
        struct RoadWeatherMessageCommon_PathHistoryPoint arrayValue[23];  // SEQUENCE;
    };
    
    struct RoadWeatherMessageCommon_PathHistory {
        INT isValidFlag;   // necessary if this struct is used as an optional field of a SEQUENCE
        struct RoadWeatherMessageCommon_FullPositionVector initialPosition;  // SEQUENCE, OPTIONAL;
        struct RoadWeatherMessageCommon_GNSSstatus currGNSSstatus;  // BITSTRING, OPTIONAL;
        struct RoadWeatherMessageCommon_PathHistoryPointList crumbData;  // SEQUENCEOF;
    };
    
    struct RoadWeatherMessageCommon_PathPrediction {
        INT isValidFlag;   // necessary if this struct is used as an optional field of a SEQUENCE
        INT radiusOfCurve;  // INTEGER, -32767..32767;
        BYTE confidence;  // INTEGER, 0..200;
    };
    
    struct RoadWeatherMessageCommon_ExteriorLights {
        INT isValidFlag;   // necessary if this struct is used as an optional field of a SEQUENCE
        CHAR string[10];
        INT  stringLength;
    };
    
    struct RoadWeatherMessageCommon_VehicleSafetyExtensions {
        INT isValidFlag;   // necessary if this struct is used as an optional field of a SEQUENCE
        struct RoadWeatherMessageCommon_VehicleEventFlags events;  // BITSTRING, OPTIONAL;
        struct RoadWeatherMessageCommon_PathHistory pathHistory;  // SEQUENCE, OPTIONAL;
        struct RoadWeatherMessageCommon_PathPrediction pathPrediction;  // SEQUENCE, OPTIONAL;
        struct RoadWeatherMessageCommon_ExteriorLights lights;  // BITSTRING, OPTIONAL;
    };
    
    struct RoadWeatherMessageCommon_WiperSet {
        INT isValidFlag;   // necessary if this struct is used as an optional field of a SEQUENCE
        INT statusFront;  // ENUMERATED, unavailable(0), off(1), intermittent(2), low(3), high(4), washerInUse(5), automaticPresent(6);
        BYTE rateFront;  // INTEGER, 0..127;
        struct OPT_ENUM_ASN statusRear;  // ENUMERATED, OPTIONAL, unavailable(0), off(1), intermittent(2), low(3), high(4), washerInUse(5), automaticPresent(6);
        struct OPT_BYTE_ASN rateRear;  // INTEGER, OPTIONAL, 0..127;
    };
    
    struct RoadWeatherMessageCommon_BrakeAppliedStatus {
        INT isValidFlag;   // necessary if this struct is used as an optional field of a SEQUENCE
        CHAR string[6];
        INT  stringLength;
    };
    
    struct RoadWeatherMessageCommon_BrakeSystemStatus {
        INT isValidFlag;   // necessary if this struct is used as an optional field of a SEQUENCE
        struct RoadWeatherMessageCommon_BrakeAppliedStatus wheelBrakes;  // BITSTRING;
        INT traction;  // ENUMERATED, unavailable(0), off(1), on(2), engaged(3);
        INT antiLockBrake;  // ENUMERATED, unavailable(0), off(1), on(2), engaged(3);
        INT scs;  // ENUMERATED, unavailable(0), off(1), on(2), engaged(3);
        INT brakeBoost;  // ENUMERATED, unavailable(0), off(1), on(2);
        INT auxBrakes;  // ENUMERATED, unavailable(0), off(1), on(2), reserved(3);
    };
    
    struct RoadWeatherMessageProbeVehicleData_VehicleStatus_steering {
        INT isValidFlag;   // necessary if this struct is used as an optional field of a SEQUENCE
        INT angle;  // INTEGER, -126..127;
        struct OPT_ENUM_ASN confidence;  // ENUMERATED, OPTIONAL, unavailable(0), prec2deg(1), prec1deg(2), prec0_02deg(3);
        struct OPT_INT_ASN rate;  // INTEGER, OPTIONAL, -127..127;
        struct OPT_INT_ASN wheels;  // INTEGER, OPTIONAL, -128..127;
    };
    
    struct RoadWeatherMessageCommon_AccelerationSet4Way {
        INT isValidFlag;   // necessary if this struct is used as an optional field of a SEQUENCE
        INT lon;  // INTEGER, -2000..2001;
        INT lat;  // INTEGER, -2000..2001;
        INT vert;  // INTEGER, -127..127;
        INT yaw;  // INTEGER, -32767..32767;
    };
    
    struct RoadWeatherMessageCommon_VerticalAccelerationThreshold {
        INT isValidFlag;   // necessary if this struct is used as an optional field of a SEQUENCE
        CHAR string[6];
        INT  stringLength;
    };
    
    struct RoadWeatherMessageProbeVehicleData_AccelSteerYawRateConfidence {
        INT isValidFlag;   // necessary if this struct is used as an optional field of a SEQUENCE
        INT yawRate;  // ENUMERATED, unavailable(0), degSec_100_00(1), degSec_010_00(2), degSec_005_00(3), degSec_001_00(4), degSec_000_10(5), degSec_000_05(6), degSec_000_01(7);
        INT acceleration;  // ENUMERATED, unavailable(0), accl_100_00(1), accl_010_00(2), accl_005_00(3), accl_001_00(4), accl_000_10(5), accl_000_05(6), accl_000_01(7);
        INT steeringWheelAngle;  // ENUMERATED, unavailable(0), prec2deg(1), prec1deg(2), prec0_02deg(3);
    };
    
    struct RoadWeatherMessageProbeVehicleData_ConfidenceSet {
        INT isValidFlag;   // necessary if this struct is used as an optional field of a SEQUENCE
        struct RoadWeatherMessageProbeVehicleData_AccelSteerYawRateConfidence accelConfidence;  // SEQUENCE, OPTIONAL;
        struct RoadWeatherMessageCommon_SpeedandHeadingandThrottleConfidence speedConfidence;  // SEQUENCE, OPTIONAL;
        struct OPT_ENUM_ASN timeConfidence;  // ENUMERATED, OPTIONAL, unavailable(0), time_100_000(1), time_050_000(2), time_020_000(3), time_010_000(4), time_002_000(5), time_001_000(6), time_000_500(7), time_000_200(8), time_000_100(9), time_000_050(10), time_000_020(11), time_000_010(12), time_000_005(13), time_000_002(14), time_000_001(15), time_000_000_5(16), time_000_000_2(17), time_000_000_1(18), time_000_000_05(19), time_000_000_02(20), time_000_000_01(21), time_000_000_005(22), time_000_000_002(23), time_000_000_001(24), time_000_000_000_5(25), time_000_000_000_2(26), time_000_000_000_1(27), time_000_000_000_05(28), time_000_000_000_02(29), time_000_000_000_01(30), time_000_000_000_005(31), time_000_000_000_002(32), time_000_000_000_001(33), time_000_000_000_000_5(34), time_000_000_000_000_2(35), time_000_000_000_000_1(36), time_000_000_000_000_05(37), time_000_000_000_000_02(38), time_000_000_000_000_01(39);
        struct RoadWeatherMessageCommon_PositionConfidenceSet posConfidence;  // SEQUENCE, OPTIONAL;
        struct OPT_ENUM_ASN steerConfidence;  // ENUMERATED, OPTIONAL, unavailable(0), prec2deg(1), prec1deg(2), prec0_02deg(3);
        struct OPT_ENUM_ASN headingConfidence;  // ENUMERATED, OPTIONAL, unavailable(0), prec10deg(1), prec05deg(2), prec01deg(3), prec0_1deg(4), prec0_05deg(5), prec0_01deg(6), prec0_0125deg(7);
        struct OPT_ENUM_ASN throttleConfidence;  // ENUMERATED, OPTIONAL, unavailable(0), prec10percent(1), prec1percent(2), prec0_5percent(3);
    };
    
    struct RoadWeatherMessageProbeVehicleData_VehicleStatus_accelSets {
        INT isValidFlag;   // necessary if this struct is used as an optional field of a SEQUENCE
        struct RoadWeatherMessageCommon_AccelerationSet4Way accel4way;  // SEQUENCE, OPTIONAL;
        struct RoadWeatherMessageCommon_VerticalAccelerationThreshold vertAccelThres;  // BITSTRING, OPTIONAL;
        struct OPT_ENUM_ASN yawRateCon;  // ENUMERATED, OPTIONAL, unavailable(0), degSec_100_00(1), degSec_010_00(2), degSec_005_00(3), degSec_001_00(4), degSec_000_10(5), degSec_000_05(6), degSec_000_01(7);
        struct OPT_ENUM_ASN hozAccelCon;  // ENUMERATED, OPTIONAL, unavailable(0), accl_100_00(1), accl_010_00(2), accl_005_00(3), accl_001_00(4), accl_000_10(5), accl_000_05(6), accl_000_01(7);
        struct RoadWeatherMessageProbeVehicleData_ConfidenceSet confidenceSet;  // SEQUENCE, OPTIONAL;
    };
    
    struct RoadWeatherMessageProbeVehicleData_VehicleStatus_object {
        INT isValidFlag;   // necessary if this struct is used as an optional field of a SEQUENCE
        WORD obDist;  // INTEGER, 0..32767;
        WORD obDirect;  // INTEGER, 0..28800;
        struct RoadWeatherMessageCommon_DDateTime dateTime;  // SEQUENCE;
    };
    
    struct RoadWeatherMessageCommon_BumperHeights {
        INT isValidFlag;   // necessary if this struct is used as an optional field of a SEQUENCE
        BYTE front;  // INTEGER, 0..127;
        BYTE rear;  // INTEGER, 0..127;
    };
    
    struct RoadWeatherMessageProbeVehicleData_VehicleStatus_vehicleData {
        INT isValidFlag;   // necessary if this struct is used as an optional field of a SEQUENCE
        BYTE height;  // INTEGER, 0..127;
        struct RoadWeatherMessageCommon_BumperHeights bumpers;  // SEQUENCE;
        BYTE mass;  // INTEGER, 0..255;
        WORD trailerWeight;  // INTEGER, 0..64255;
        INT type;  // ENUMERATED, none(0), unknown(1), special(2), moto(3), car(4), carOther(5), bus(6), axleCnt2(7), axleCnt3(8), axleCnt4(9), axleCnt4Trailer(10), axleCnt5Trailer(11), axleCnt6Trailer(12), axleCnt5MultiTrailer(13), axleCnt6MultiTrailer(14), axleCnt7MultiTrailer(15);
    };
    
    struct RoadWeatherMessageCommon_DescriptiveName {
        INT isValidFlag;   // necessary if this struct is used as an optional field of a SEQUENCE
        CHAR string[64];
        INT  stringLength;
    };
    
    struct RoadWeatherMessageProbeVehicleData_VINstring {
        INT isValidFlag;   // necessary if this struct is used as an optional field of a SEQUENCE
        CHAR string[18];
        INT  stringLength;
    };
    
    struct RoadWeatherMessageProbeVehicleData_VehicleIdent_ownerCode {
        INT isValidFlag;   // necessary if this struct is used as an optional field of a SEQUENCE
        CHAR string[33];
        INT  stringLength;
    };
    
    struct RoadWeatherMessageCommon_TemporaryID {
        INT isValidFlag;   // necessary if this struct is used as an optional field of a SEQUENCE
        CHAR string[5];
        INT  stringLength;
    };
    
    struct RoadWeatherMessageCommon_VehicleID {
        INT isValidFlag;   // necessary if this struct is used as an optional field of a SEQUENCE
        INT choice;
        struct RoadWeatherMessageCommon_TemporaryID entityID;  // OCTETSTRING;
        DWORD stationID;  // INTEGER, 0..4294967295;
    };
    
    struct RoadWeatherMessageProbeVehicleData_VehicleIdent_vehicleClass {
        INT isValidFlag;   // necessary if this struct is used as an optional field of a SEQUENCE
        INT choice;
        INT vGroup;  // ENUMERATED, all_vehicles(9217), bicycles(9218), motorcycles(9219), cars(9220), light_vehicles(9221), cars_and_light_vehicles(9222), cars_with_trailers(9223), cars_with_recreational_trailers(9224), vehicles_with_trailers(9225), heavy_vehicles(9226), trucks(9227), buses(9228), articulated_buses(9229), school_buses(9230), vehicles_with_semi_trailers(9231), vehicles_with_double_trailers(9232), high_profile_vehicles(9233), wide_vehicles(9234), long_vehicles(9235), hazardous_loads(9236), exceptional_loads(9237), abnormal_loads(9238), convoys(9239), maintenance_vehicles(9240), delivery_vehicles(9241), vehicles_with_even_numbered_license_plates(9242), vehicles_with_odd_numbered_license_plates(9243), vehicles_with_parking_permits(9244), vehicles_with_catalytic_converters(9245), vehicles_without_catalytic_converters(9246), gas_powered_vehicles(9247), diesel_powered_vehicles(9248), lPG_vehicles(9249), military_convoys(9250), military_vehicles(9251);
        INT rGroup;  // ENUMERATED, emergency_vehicle_units(9729), federal_law_enforcement_units(9730), state_police_units(9731), county_police_units(9732), local_police_units(9733), ambulance_units(9734), rescue_units(9735), fire_units(9736), hAZMAT_units(9737), light_tow_unit(9738), heavy_tow_unit(9739), freeway_service_patrols(9740), transportation_response_units(9741), private_contractor_response_units(9742);
        INT rEquip;  // ENUMERATED, ground_fire_suppression(9985), heavy_ground_equipment(9986), aircraft(9988), marine_equipment(9989), support_equipment(9990), medical_rescue_unit(9991), other(9993), ground_fire_suppression_other(9994), engine(9995), truck_or_aerial(9996), quint(9997), tanker_pumper_combination(9998), brush_truck(10000), aircraft_rescue_firefighting(10001), heavy_ground_equipment_other(10004), dozer_or_plow(10005), tractor(10006), tanker_or_tender(10008), aircraft_other(10024), aircraft_fixed_wing_tanker(10025), helitanker(10026), helicopter(10027), marine_equipment_other(10034), fire_boat_with_pump(10035), boat_no_pump(10036), support_apparatus_other(10044), breathing_apparatus_support(10045), light_and_air_unit(10046), medical_rescue_unit_other(10054), rescue_unit(10055), urban_search_rescue_unit(10056), high_angle_rescue(10057), crash_fire_rescue(10058), bLS_unit(10059), aLS_unit(10060), mobile_command_post(10075), chief_officer_car(10076), hAZMAT_unit(10077), type_i_hand_crew(10078), type_ii_hand_crew(10079), privately_owned_vehicle(10083), other_apparatus_resource(10084), ambulance(10085), bomb_squad_van(10086), combine_harvester(10087), construction_vehicle(10088), farm_tractor(10089), grass_cutting_machines(10090), hAZMAT_containment_tow(10091), heavy_tow(10092), light_tow(10094), flatbed_tow(10114), hedge_cutting_machines(10093), mobile_crane(10095), refuse_collection_vehicle(10096), resurfacing_vehicle(10097), road_sweeper(10098), roadside_litter_collection_crews(10099), salvage_vehicle(10100), sand_truck(10101), snowplow(10102), steam_roller(10103), swat_team_van(10104), track_laying_vehicle(10105), unknown_vehicle(10106), white_lining_vehicle(10107), dump_truck(10108), supervisor_vehicle(10109), snow_blower(10110), rotary_snow_blower(10111), road_grader(10112), steam_truck(10113);
    };
    
    struct RoadWeatherMessageProbeVehicleData_VehicleIdent {
        INT isValidFlag;   // necessary if this struct is used as an optional field of a SEQUENCE
        struct RoadWeatherMessageCommon_DescriptiveName name;  // IA5STRING, OPTIONAL;
        struct RoadWeatherMessageProbeVehicleData_VINstring vin;  // OCTETSTRING, OPTIONAL;
        struct RoadWeatherMessageProbeVehicleData_VehicleIdent_ownerCode ownerCode;  // IA5STRING, OPTIONAL;
        struct RoadWeatherMessageCommon_VehicleID id;  // CHOICE, OPTIONAL;
        struct OPT_ENUM_ASN vehicleType;  // ENUMERATED, OPTIONAL, none(0), unknown(1), special(2), moto(3), car(4), carOther(5), bus(6), axleCnt2(7), axleCnt3(8), axleCnt4(9), axleCnt4Trailer(10), axleCnt5Trailer(11), axleCnt6Trailer(12), axleCnt5MultiTrailer(13), axleCnt6MultiTrailer(14), axleCnt7MultiTrailer(15);
        struct RoadWeatherMessageProbeVehicleData_VehicleIdent_vehicleClass vehicleClass;  // CHOICE, OPTIONAL;
    };
    
    struct RoadWeatherMessageProbeVehicleData_TireData {
        INT isValidFlag;   // necessary if this struct is used as an optional field of a SEQUENCE
        struct OPT_BYTE_ASN location;  // INTEGER, OPTIONAL, 0..255;
        struct OPT_BYTE_ASN pressure;  // INTEGER, OPTIONAL, 0..250;
        struct OPT_LONG_ASN temp;  // INTEGER, OPTIONAL, -8736..55519;
        struct OPT_ENUM_ASN wheelSensorStatus;  // ENUMERATED, OPTIONAL, off(0), on(1), notDefined(2), notSupported(3);
        struct OPT_ENUM_ASN wheelEndElectFault;  // ENUMERATED, OPTIONAL, isOk(0), isNotDefined(1), isError(2), isNotSupported(3);
        struct OPT_WORD_ASN leakageRate;  // INTEGER, OPTIONAL, 0..64255;
        struct OPT_ENUM_ASN detection;  // ENUMERATED, OPTIONAL, noData(0), overPressure(1), noWarningPressure(2), underPressure(3), extremeUnderPressure(4), undefined(5), errorIndicator(6), notAvailable(7);
    };
    
    struct RoadWeatherMessageProbeVehicleData_TireDataList {
        INT isValidFlag;   // necessary if this struct is used as an optional field of a SEQUENCE
        INT length;
        struct RoadWeatherMessageProbeVehicleData_TireData arrayValue[16];  // SEQUENCE;
    };
    
    struct RoadWeatherMessageProbeVehicleData_AxleWeightSet {
        INT isValidFlag;   // necessary if this struct is used as an optional field of a SEQUENCE
        struct OPT_BYTE_ASN location;  // INTEGER, OPTIONAL, 0..255;
        struct OPT_WORD_ASN weight;  // INTEGER, OPTIONAL, 0..64255;
    };
    
    struct RoadWeatherMessageProbeVehicleData_AxleWeightList {
        INT isValidFlag;   // necessary if this struct is used as an optional field of a SEQUENCE
        INT length;
        struct RoadWeatherMessageProbeVehicleData_AxleWeightSet arrayValue[16];  // SEQUENCE;
    };
    
    struct RoadWeatherMessageProbeVehicleData_J1939data {
        INT isValidFlag;   // necessary if this struct is used as an optional field of a SEQUENCE
        struct RoadWeatherMessageProbeVehicleData_TireDataList tires;  // SEQUENCEOF, OPTIONAL;
        struct RoadWeatherMessageProbeVehicleData_AxleWeightList axles;  // SEQUENCEOF, OPTIONAL;
        struct OPT_WORD_ASN trailerWeight;  // INTEGER, OPTIONAL, 0..64255;
        struct OPT_WORD_ASN cargoWeight;  // INTEGER, OPTIONAL, 0..64255;
        struct OPT_INT_ASN steeringAxleTemperature;  // INTEGER, OPTIONAL, -40..210;
        struct OPT_BYTE_ASN driveAxleLocation;  // INTEGER, OPTIONAL, 0..255;
        struct OPT_WORD_ASN driveAxleLiftAirPressure;  // INTEGER, OPTIONAL, 0..1000;
        struct OPT_INT_ASN driveAxleTemperature;  // INTEGER, OPTIONAL, -40..210;
        struct OPT_BYTE_ASN driveAxleLubePressure;  // INTEGER, OPTIONAL, 0..250;
        struct OPT_BYTE_ASN steeringAxleLubePressure;  // INTEGER, OPTIONAL, 0..250;
    };
    
    struct RoadWeatherMessageProbeVehicleData_VehicleStatus_weatherReport {
        INT isValidFlag;   // necessary if this struct is used as an optional field of a SEQUENCE
        INT isRaining;  // ENUMERATED, precip(1), noPrecip(2), error(3);
        struct OPT_WORD_ASN rainRate;  // INTEGER, OPTIONAL, 0..65535;
        struct OPT_ENUM_ASN precipSituation;  // ENUMERATED, OPTIONAL, other(1), unknown(2), noPrecipitation(3), unidentifiedSlight(4), unidentifiedModerate(5), unidentifiedHeavy(6), snowSlight(7), snowModerate(8), snowHeavy(9), rainSlight(10), rainModerate(11), rainHeavy(12), frozenPrecipitationSlight(13), frozenPrecipitationModerate(14), frozenPrecipitationHeavy(15);
        struct OPT_WORD_ASN solarRadiation;  // INTEGER, OPTIONAL, 0..65535;
        struct OPT_BYTE_ASN friction;  // INTEGER, OPTIONAL, 0..101;
    };
    
    struct RoadWeatherMessageProbeVehicleData_VehicleStatus {
        INT isValidFlag;   // necessary if this struct is used as an optional field of a SEQUENCE
        struct RoadWeatherMessageCommon_ExteriorLights lights;  // BITSTRING, OPTIONAL;
        struct OPT_ENUM_ASN lightBar;  // ENUMERATED, OPTIONAL, unavailable(0), notInUse(1), inUse(2), yellowCautionLights(3), schooldBusLights(4), arrowSignsActive(5), slowMovingVehicle(6), freqStops(7);
        struct RoadWeatherMessageCommon_WiperSet wipers;  // SEQUENCE, OPTIONAL;
        struct RoadWeatherMessageCommon_BrakeSystemStatus brakeStatus;  // SEQUENCE, OPTIONAL;
        struct OPT_ENUM_ASN brakePressure;  // ENUMERATED, OPTIONAL, unavailable(0), minPressure(1), bkLvl_2(2), bkLvl_3(3), bkLvl_4(4), bkLvl_5(5), bkLvl_6(6), bkLvl_7(7), bkLvl_8(8), bkLvl_9(9), bkLvl_10(10), bkLvl_11(11), bkLvl_12(12), bkLvl_13(13), bkLvl_14(14), maxPressure(15);
        struct OPT_BYTE_ASN roadFriction;  // INTEGER, OPTIONAL, 0..50;
        struct OPT_WORD_ASN sunData;  // INTEGER, OPTIONAL, 0..1000;
        struct OPT_ENUM_ASN rainData;  // ENUMERATED, OPTIONAL, none(0), lightMist(1), heavyMist(2), lightRainOrDrizzle(3), rain(4), moderateRain(5), heavyRain(6), heavyDownpour(7);
        struct OPT_BYTE_ASN airTemp;  // INTEGER, OPTIONAL, 0..191;
        struct OPT_BYTE_ASN airPres;  // INTEGER, OPTIONAL, 0..255;
        struct RoadWeatherMessageProbeVehicleData_VehicleStatus_steering steering;  // SEQUENCE, OPTIONAL;
        struct RoadWeatherMessageProbeVehicleData_VehicleStatus_accelSets accelSets;  // SEQUENCE, OPTIONAL;
        struct RoadWeatherMessageProbeVehicleData_VehicleStatus_object object;  // SEQUENCE, OPTIONAL;
        struct RoadWeatherMessageCommon_FullPositionVector fullPos;  // SEQUENCE, OPTIONAL;
        struct OPT_BYTE_ASN throttlePos;  // INTEGER, OPTIONAL, 0..200;
        struct RoadWeatherMessageCommon_SpeedandHeadingandThrottleConfidence speedHeadC;  // SEQUENCE, OPTIONAL;
        struct OPT_ENUM_ASN speedC;  // ENUMERATED, OPTIONAL, unavailable(0), prec100ms(1), prec10ms(2), prec5ms(3), prec1ms(4), prec0_1ms(5), prec0_05ms(6), prec0_01ms(7);
        struct RoadWeatherMessageProbeVehicleData_VehicleStatus_vehicleData vehicleData;  // SEQUENCE, OPTIONAL;
        struct RoadWeatherMessageProbeVehicleData_VehicleIdent vehicleIdent;  // SEQUENCE, OPTIONAL;
        struct RoadWeatherMessageProbeVehicleData_J1939data j1939data;  // SEQUENCE, OPTIONAL;
        struct RoadWeatherMessageProbeVehicleData_VehicleStatus_weatherReport weatherReport;  // SEQUENCE, OPTIONAL;
        struct RoadWeatherMessageCommon_GNSSstatus gnssStatus;  // BITSTRING, OPTIONAL;
    };
    
    struct RoadWeatherMessageNtcipAirTemperature {
        INT isValidFlag;   // necessary if this struct is used as an optional field of a SEQUENCE
        INT temperature;  // INTEGER, -1000..1001;
        struct OPT_BYTE_ASN measurementStdDev;  // INTEGER, OPTIONAL, 1..16;
        struct OPT_INT_ASN tempSensorHeight;  // INTEGER, OPTIONAL, -1000..1001;
    };
    
    struct RoadWeatherMessageNtcipAtmosphericPressure {
        INT isValidFlag;   // necessary if this struct is used as an optional field of a SEQUENCE
        WORD pressure;  // INTEGER, 0..65535;
        struct OPT_BYTE_ASN measurementStdDev;  // INTEGER, OPTIONAL, 1..16;
    };
    
    struct RoadWeatherMessageNtcipWind {
        INT isValidFlag;   // necessary if this struct is used as an optional field of a SEQUENCE
        struct OPT_WORD_ASN avgSpeed;  // INTEGER, OPTIONAL, 0..65535;
        struct OPT_WORD_ASN avgDirection;  // INTEGER, OPTIONAL, 0..361;
        struct OPT_WORD_ASN currentSpeed;  // INTEGER, OPTIONAL, 0..65535;
        struct OPT_WORD_ASN curDirection;  // INTEGER, OPTIONAL, 0..361;
        struct OPT_WORD_ASN gustSpeed;  // INTEGER, OPTIONAL, 0..65535;
        struct OPT_WORD_ASN gustDirection;  // INTEGER, OPTIONAL, 0..361;
    };
    
    struct RoadWeatherMessageNtcipRelativeHumidity {
        INT isValidFlag;   // necessary if this struct is used as an optional field of a SEQUENCE
        BYTE relHumidity;  // INTEGER, 0..101;
        struct OPT_ENUM_ASN source;  // ENUMERATED, OPTIONAL, measured(-0), derived(1);
    };
    
    struct RoadWeatherMessageNtcipDewPoint {
        INT isValidFlag;   // necessary if this struct is used as an optional field of a SEQUENCE
        INT dewTemp;  // INTEGER, -1000..1001;
        struct OPT_ENUM_ASN source;  // ENUMERATED, OPTIONAL, measured(-0), derived(1);
        struct OPT_BYTE_ASN measurementStdDev;  // INTEGER, OPTIONAL, 1..16;
    };
    
    struct RoadWeatherMessageCommon_RoadRoughness {
        INT isValidFlag;   // necessary if this struct is used as an optional field of a SEQUENCE
        WORD meanVerticalVariation;  // INTEGER, 0..25000;
        struct OPT_WORD_ASN verticalVariationStdDev;  // INTEGER, OPTIONAL, 0..2500;
        struct OPT_WORD_ASN meanHorizontalVariation;  // INTEGER, OPTIONAL, 0..25000;
        struct OPT_WORD_ASN horizontalVariationStdDev;  // INTEGER, OPTIONAL, 0..2500;
    };
    
    struct RoadWeatherMessageNtcipPavement {
        INT isValidFlag;   // necessary if this struct is used as an optional field of a SEQUENCE
        struct OPT_INT_ASN surfaceTemp;  // INTEGER, OPTIONAL, -1000..1001;
        struct OPT_BYTE_ASN tempStdDev;  // INTEGER, OPTIONAL, 1..16;
        struct OPT_ENUM_ASN condition;  // ENUMERATED, OPTIONAL, other(1), error(2), dry(3), moist(4), chemicallyMoist(5), wet(6), chemicallyWet(7), standingWater(8), frost(9), slush(10), snow(11), ice(12), noReport(13);
        struct OPT_WORD_ASN moistureDepth;  // INTEGER, OPTIONAL, 0..65535;
        struct RoadWeatherMessageCommon_RoadRoughness roadRoughness;  // SEQUENCE, OPTIONAL;
    };
    
    struct RoadWeatherMessageNtcipVisibility {
        INT isValidFlag;   // necessary if this struct is used as an optional field of a SEQUENCE
        DWORD visibility;  // INTEGER, 0..1000001;
    };
    
    struct RoadWeatherMessageNtcipVisibilitySituation {
        INT isValidFlag;   // necessary if this struct is used as an optional field of a SEQUENCE
        INT situation;  // ENUMERATED, other(1), unknown(2), clear(3), fogNotPatchy(4), patchyFog(5), blowingSnow(6), smoke(7), seaSpray(8), vehicleSpray(9), blowingDustOrSand(10), sunGlare(11), swarmsOfInsects(12);
    };
    
    struct RoadWeatherMessageNtcipCloudSituation {
        INT isValidFlag;   // necessary if this struct is used as an optional field of a SEQUENCE
        BYTE situation;  // INTEGER, 0..8;
    };
    
    struct RoadWeatherMessageNtcipPrecipitation {
        INT isValidFlag;   // necessary if this struct is used as an optional field of a SEQUENCE
        INT precipitation;  // ENUMERATED, other(1), unknown(2), noPrecipitation(3), unidentifiedSlight(4), unidentifiedModerate(5), unidentifiedHeavy(6), snowSlight(7), snowModerate(8), snowHeavy(9), rainSlight(10), rainModerate(11), rainHeavy(12), frozenPrecipitationSlight(13), frozenPrecipitationModerate(14), frozenPrecipitationHeavy(15);
    };
    
    struct RoadWeatherMessageNtcipSolarRadiation {
        INT isValidFlag;   // necessary if this struct is used as an optional field of a SEQUENCE
        INT solarRadiation;  // INTEGER, -2048..2049;
        DWORD measurementPeriod;  // INTEGER, 0..86400;
    };
    
    struct RoadWeatherMessageNtcipEssData {
        INT isValidFlag;   // necessary if this struct is used as an optional field of a SEQUENCE
        struct RoadWeatherMessageNtcipAirTemperature airTemp;  // SEQUENCE, OPTIONAL;
        struct RoadWeatherMessageNtcipAtmosphericPressure atmosphere;  // SEQUENCE, OPTIONAL;
        struct RoadWeatherMessageNtcipWind wind;  // SEQUENCE, OPTIONAL;
        struct RoadWeatherMessageNtcipRelativeHumidity humidity;  // SEQUENCE, OPTIONAL;
        struct RoadWeatherMessageNtcipDewPoint dewpoint;  // SEQUENCE, OPTIONAL;
        struct RoadWeatherMessageNtcipPavement pavement;  // SEQUENCE, OPTIONAL;
        struct RoadWeatherMessageNtcipVisibility visibility;  // SEQUENCE, OPTIONAL;
        struct RoadWeatherMessageNtcipVisibilitySituation visSituation;  // SEQUENCE, OPTIONAL;
        struct RoadWeatherMessageNtcipCloudSituation cloudSitiation;  // SEQUENCE, OPTIONAL;
        struct RoadWeatherMessageNtcipPrecipitation precipitation;  // SEQUENCE, OPTIONAL;
        struct RoadWeatherMessageNtcipSolarRadiation solarRadiation;  // SEQUENCE, OPTIONAL;
    };
    
    struct RoadWeatherMessageSnapShot {
        INT isValidFlag;   // necessary if this struct is used as an optional field of a SEQUENCE
        struct RoadWeatherMessageCommon_FullPositionVector thePosition;  // SEQUENCE;
        struct RoadWeatherMessageCommon_VehicleSafetyExtensions safetyExt;  // SEQUENCE, OPTIONAL;
        struct RoadWeatherMessageProbeVehicleData_VehicleStatus dataSet;  // SEQUENCE, OPTIONAL;
        struct RoadWeatherMessageNtcipEssData weatherData;  // SEQUENCE, OPTIONAL;
    };
    
    struct RoadWeatherMessageNTCIPEssPavementTreatmentLocation {
        INT isValidFlag;   // necessary if this struct is used as an optional field of a SEQUENCE
        CHAR string[256];
        INT  stringLength;
    };
    
    struct RoadWeatherMessageNtcipPavementTreatment {
        INT isValidFlag;   // necessary if this struct is used as an optional field of a SEQUENCE
        LONG latitude;  // INTEGER, -90000000..90000001;
        LONG longitude;  // INTEGER, -180000000..180000001;
        struct RoadWeatherMessageNTCIPEssPavementTreatmentLocation location;  // IA5STRING;
        struct OPT_ENUM_ASN productType;  // ENUMERATED, OPTIONAL, other(1), sand(2), dirt(3), gravel(4), cinders(5), water(6), enhancedSalts(7), naCl(8), caCl(9), mgCl(10), cMA(11), kAC(12), naFormate(13), naA(14);
        struct OPT_ENUM_ASN form;  // ENUMERATED, OPTIONAL, other(1), dry(2), prewet(3), liquid(4);
        struct OPT_BYTE_ASN percentage;  // INTEGER, OPTIONAL, 0..100;
        struct OPT_BYTE_ASN amount;  // INTEGER, OPTIONAL, 0..255;
        struct OPT_BYTE_ASN width;  // INTEGER, OPTIONAL, 0..255;
    };
    
    struct RoadWeatherMessageITIS_ITIStext {
        INT isValidFlag;   // necessary if this struct is used as an optional field of a SEQUENCE
        CHAR string[501];
        INT  stringLength;
    };
    
    struct RoadWeatherMessageWDMSFleetData {
        INT isValidFlag;   // necessary if this struct is used as an optional field of a SEQUENCE
        struct RoadWeatherMessageNtcipPavementTreatment pavementTreat;  // SEQUENCE, OPTIONAL;
        struct RoadWeatherMessageITIS_ITIStext routingAdvice;  // IA5STRING, OPTIONAL;
    };
    
    struct RoadWeatherMessageVehicleReport {
        INT isValidFlag;   // necessary if this struct is used as an optional field of a SEQUENCE
        struct RoadWeatherMessageSnapShot snapShot;  // SEQUENCE;
        struct RoadWeatherMessageWDMSFleetData wdmsFleetData;  // SEQUENCE, OPTIONAL;
    };
    
    struct RoadWeatherMessageRoadWeatherUpload_vehicleReport {
        INT isValidFlag;   // necessary if this struct is used as an optional field of a SEQUENCE
        INT length;
        struct RoadWeatherMessageVehicleReport arrayValue[32];  // SEQUENCE;
    };
    
    struct RoadWeatherMessageRoadWeatherUpload {
        INT isValidFlag;   // necessary if this struct is used as an optional field of a SEQUENCE
        INT choice;
        struct RoadWeatherMessageRoadWeatherUpload_vehicleReport vehicleReport;  // SEQUENCEOF;
        struct RoadWeatherMessageSnapShot citizenReport;  // SEQUENCE;
    };
    
    struct RoadWeatherMessageCommon_FurtherInfoID {
        INT isValidFlag;   // necessary if this struct is used as an optional field of a SEQUENCE
        CHAR string[3];
        INT  stringLength;
    };
    
    struct RoadWeatherMessageAddGrpB_LatitudeDMS2 {
        INT isValidFlag;   // necessary if this struct is used as an optional field of a SEQUENCE
        INT d;  // INTEGER, -90..90;
        BYTE m;  // INTEGER, 0..59;
        WORD s;  // INTEGER, 0..5999;
    };
    
    struct RoadWeatherMessageAddGrpB_LongitudeDMS2 {
        INT isValidFlag;   // necessary if this struct is used as an optional field of a SEQUENCE
        INT d;  // INTEGER, -180..180;
        BYTE m;  // INTEGER, 0..59;
        WORD s;  // INTEGER, 0..5999;
    };
    
    struct RoadWeatherMessageAddGrpB_Position3D_addGrpB {
        INT isValidFlag;   // necessary if this struct is used as an optional field of a SEQUENCE
        struct RoadWeatherMessageAddGrpB_LatitudeDMS2 latitude;  // SEQUENCE;
        struct RoadWeatherMessageAddGrpB_LongitudeDMS2 longitude;  // SEQUENCE;
        INT elevation;  // INTEGER, -32768..32767;
    };
    
    struct RoadWeatherMessageAddGrpC_Altitude {
        INT isValidFlag;   // necessary if this struct is used as an optional field of a SEQUENCE
        LONG value;  // INTEGER, -100000..800001;
        INT confidence;  // ENUMERATED, alt_000_01(-0), alt_000_02(1), alt_000_05(2), alt_000_10(3), alt_000_20(4), alt_000_50(5), alt_001_00(6), alt_002_00(7), alt_005_00(8), alt_010_00(9), alt_020_00(10), alt_050_00(11), alt_100_00(12), alt_200_00(13), outOfRange(14), unavailable(15);
    };
    
    struct RoadWeatherMessageAddGrpC_Position3D_addGrpC {
        INT isValidFlag;   // necessary if this struct is used as an optional field of a SEQUENCE
        struct RoadWeatherMessageAddGrpC_Altitude altitude;  // SEQUENCE;
    };
    
    struct RoadWeatherMessageCommon_RegionalExtension_Reg_Position3D_table {
        struct RoadWeatherMessageAddGrpB_Position3D_addGrpB addGrpB;  // SEQUENCE;
        struct RoadWeatherMessageAddGrpC_Position3D_addGrpC addGrpC;  // SEQUENCE;
    };
    
    struct RoadWeatherMessageCommon_RegionalExtension_Reg_Position3D {
        INT isValidFlag;   // necessary if this struct is used as an optional field of a SEQUENCE
        BYTE regionId;  // INTEGER, 0..255, noRegion(0), addGrpA(1), addGrpB(2), addGrpC(3), addGrpD(4);
        struct RoadWeatherMessageCommon_RegionalExtension_Reg_Position3D_table regExtvalue;  // TABLE;
    };
    
    struct RoadWeatherMessageCommon_Position3D_regional {
        INT isValidFlag;   // necessary if this struct is used as an optional field of a SEQUENCE
        INT length;
        struct RoadWeatherMessageCommon_RegionalExtension_Reg_Position3D arrayValue[4];  // SEQUENCE;
    };
    
    struct RoadWeatherMessageCommon_Position3D {
        INT isValidFlag;   // necessary if this struct is used as an optional field of a SEQUENCE
        LONG lat;  // INTEGER, -900000000..900000001;
        LONG lon;  // INTEGER, -1799999999..1800000001;
        struct OPT_LONG_ASN elevation;  // INTEGER, OPTIONAL, -4096..61439;
        struct RoadWeatherMessageCommon_Position3D_regional regional;  // SEQUENCEOF, OPTIONAL;
    };
    
    struct RoadWeatherMessageCommon_HeadingSlice {
        INT isValidFlag;   // necessary if this struct is used as an optional field of a SEQUENCE
        CHAR string[17];
        INT  stringLength;
    };
    
    struct RoadWeatherMessageTravelerInformation_MsgCRC {
        INT isValidFlag;   // necessary if this struct is used as an optional field of a SEQUENCE
        CHAR string[3];
        INT  stringLength;
    };
    
    struct RoadWeatherMessageTravelerInformation_RoadSignID {
        INT isValidFlag;   // necessary if this struct is used as an optional field of a SEQUENCE
        struct RoadWeatherMessageCommon_Position3D position;  // SEQUENCE;
        struct RoadWeatherMessageCommon_HeadingSlice viewAngle;  // BITSTRING;
        struct OPT_ENUM_ASN mutcdCode;  // ENUMERATED, OPTIONAL, none(0), regulatory(1), warning(2), maintenance(3), motoristService(4), guide(5), rec(6);
        struct RoadWeatherMessageTravelerInformation_MsgCRC crc;  // OCTETSTRING, OPTIONAL;
    };
    
    struct RoadWeatherMessageTravelerInformation_TravelerDataFrame_msgId {
        INT isValidFlag;   // necessary if this struct is used as an optional field of a SEQUENCE
        INT choice;
        struct RoadWeatherMessageCommon_FurtherInfoID furtherInfoID;  // OCTETSTRING;
        struct RoadWeatherMessageTravelerInformation_RoadSignID roadSignID;  // SEQUENCE;
    };
    
    struct RoadWeatherMessageCommon_RoadSegmentReferenceID {
        INT isValidFlag;   // necessary if this struct is used as an optional field of a SEQUENCE
        struct OPT_WORD_ASN region;  // INTEGER, OPTIONAL, 0..65535;
        WORD id;  // INTEGER, 0..65535;
    };
    
    struct RoadWeatherMessageCommon_Node_XY_20b {
        INT isValidFlag;   // necessary if this struct is used as an optional field of a SEQUENCE
        INT x;  // INTEGER, -512..511;
        INT y;  // INTEGER, -512..511;
    };
    
    struct RoadWeatherMessageCommon_Node_XY_22b {
        INT isValidFlag;   // necessary if this struct is used as an optional field of a SEQUENCE
        INT x;  // INTEGER, -1024..1023;
        INT y;  // INTEGER, -1024..1023;
    };
    
    struct RoadWeatherMessageCommon_Node_XY_24b {
        INT isValidFlag;   // necessary if this struct is used as an optional field of a SEQUENCE
        INT x;  // INTEGER, -2048..2047;
        INT y;  // INTEGER, -2048..2047;
    };
    
    struct RoadWeatherMessageCommon_Node_XY_26b {
        INT isValidFlag;   // necessary if this struct is used as an optional field of a SEQUENCE
        INT x;  // INTEGER, -4096..4095;
        INT y;  // INTEGER, -4096..4095;
    };
    
    struct RoadWeatherMessageCommon_Node_XY_28b {
        INT isValidFlag;   // necessary if this struct is used as an optional field of a SEQUENCE
        INT x;  // INTEGER, -8192..8191;
        INT y;  // INTEGER, -8192..8191;
    };
    
    struct RoadWeatherMessageCommon_Node_XY_32b {
        INT isValidFlag;   // necessary if this struct is used as an optional field of a SEQUENCE
        INT x;  // INTEGER, -32768..32767;
        INT y;  // INTEGER, -32768..32767;
    };
    
    struct RoadWeatherMessageCommon_Node_LLmD_64b {
        INT isValidFlag;   // necessary if this struct is used as an optional field of a SEQUENCE
        LONG lon;  // INTEGER, -1799999999..1800000001;
        LONG lat;  // INTEGER, -900000000..900000001;
    };
    
    struct RoadWeatherMessageAddGrpB_Node_LLdms_48b {
        INT isValidFlag;   // necessary if this struct is used as an optional field of a SEQUENCE
        LONG lon;  // INTEGER, -64800000..64800000;
        LONG lat;  // INTEGER, -32400000..32400000;
    };
    
    struct RoadWeatherMessageAddGrpB_Node_LLdms_80b {
        INT isValidFlag;   // necessary if this struct is used as an optional field of a SEQUENCE
        struct RoadWeatherMessageAddGrpB_LongitudeDMS2 lon;  // SEQUENCE;
        struct RoadWeatherMessageAddGrpB_LatitudeDMS2 lat;  // SEQUENCE;
    };
    
    struct RoadWeatherMessageAddGrpB_NodeOffsetPointXY_addGrpB {
        INT isValidFlag;   // necessary if this struct is used as an optional field of a SEQUENCE
        INT choice;
        struct RoadWeatherMessageAddGrpB_Node_LLdms_48b posA;  // SEQUENCE;
        struct RoadWeatherMessageAddGrpB_Node_LLdms_80b posB;  // SEQUENCE;
    };
    
    struct RoadWeatherMessageCommon_RegionalExtension_Reg_NodeOffsetPointXY_table {
        struct RoadWeatherMessageAddGrpB_NodeOffsetPointXY_addGrpB addGrpB;  // CHOICE;
    };
    
    struct RoadWeatherMessageCommon_RegionalExtension_Reg_NodeOffsetPointXY {
        INT isValidFlag;   // necessary if this struct is used as an optional field of a SEQUENCE
        BYTE regionId;  // INTEGER, 0..255, noRegion(0), addGrpA(1), addGrpB(2), addGrpC(3), addGrpD(4);
        struct RoadWeatherMessageCommon_RegionalExtension_Reg_NodeOffsetPointXY_table regExtvalue;  // TABLE;
    };
    
    struct RoadWeatherMessageCommon_NodeOffsetPointXY {
        INT isValidFlag;   // necessary if this struct is used as an optional field of a SEQUENCE
        INT choice;
        struct RoadWeatherMessageCommon_Node_XY_20b node_XY1;  // SEQUENCE;
        struct RoadWeatherMessageCommon_Node_XY_22b node_XY2;  // SEQUENCE;
        struct RoadWeatherMessageCommon_Node_XY_24b node_XY3;  // SEQUENCE;
        struct RoadWeatherMessageCommon_Node_XY_26b node_XY4;  // SEQUENCE;
        struct RoadWeatherMessageCommon_Node_XY_28b node_XY5;  // SEQUENCE;
        struct RoadWeatherMessageCommon_Node_XY_32b node_XY6;  // SEQUENCE;
        struct RoadWeatherMessageCommon_Node_LLmD_64b node_LatLon;  // SEQUENCE;
        struct RoadWeatherMessageCommon_RegionalExtension_Reg_NodeOffsetPointXY regional;  // SEQUENCE;
    };
    
    struct RoadWeatherMessageCommon_NodeAttributeXYList {
        INT isValidFlag;   // necessary if this struct is used as an optional field of a SEQUENCE
        INT length;
        INT arrayValue[8];  // ENUMERATED, reserved(-0), stopLine(1), roundedCapStyleA(2), roundedCapStyleB(3), mergePoint(4), divergePoint(5), downstreamStopLine(6), downstreamStartNode(7), closedToTraffic(8), safeIsland(9), curbPresentAtStepOff(10), hydrantPresent(11);
    };
    
    struct RoadWeatherMessageCommon_SegmentAttributeXYList {
        INT isValidFlag;   // necessary if this struct is used as an optional field of a SEQUENCE
        INT length;
        INT arrayValue[8];  // ENUMERATED, reserved(-0), doNotBlock(1), whiteLine(2), mergingLaneLeft(3), mergingLaneRight(4), curbOnLeft(5), curbOnRight(6), loadingzoneOnLeft(7), loadingzoneOnRight(8), turnOutPointOnLeft(9), turnOutPointOnRight(10), adjacentParkingOnLeft(11), adjacentParkingOnRight(12), adjacentBikeLaneOnLeft(13), adjacentBikeLaneOnRight(14), sharedBikeLane(15), bikeBoxInFront(16), transitStopOnLeft(17), transitStopOnRight(18), transitStopInLane(19), sharedWithTrackedVehicle(20), safeIsland(21), lowCurbsPresent(22), rumbleStripPresent(23), audibleSignalingPresent(24), adaptiveTimingPresent(25), rfSignalRequestPresent(26), partialCurbIntrusion(27), taperToLeft(28), taperToRight(29), taperToCenterLine(30), parallelParking(31), headInParking(32), freeParking(33), timeRestrictionsOnParking(34), costToPark(35), midBlockCurbPresent(36), unEvenPavementPresent(37);
    };
    
    struct RoadWeatherMessageCommon_RegulatorySpeedLimit {
        INT isValidFlag;   // necessary if this struct is used as an optional field of a SEQUENCE
        INT type;  // ENUMERATED, unknown(-0), maxSpeedInSchoolZone(1), maxSpeedInSchoolZoneWhenChildrenArePresent(2), maxSpeedInConstructionZone(3), vehicleMinSpeed(4), vehicleMaxSpeed(5), vehicleNightMaxSpeed(6), truckMinSpeed(7), truckMaxSpeed(8), truckNightMaxSpeed(9), vehiclesWithTrailersMinSpeed(10), vehiclesWithTrailersMaxSpeed(11), vehiclesWithTrailersNightMaxSpeed(12);
        WORD speed;  // INTEGER, 0..8191;
    };
    
    struct RoadWeatherMessageCommon_SpeedLimitList {
        INT isValidFlag;   // necessary if this struct is used as an optional field of a SEQUENCE
        INT length;
        struct RoadWeatherMessageCommon_RegulatorySpeedLimit arrayValue[9];  // SEQUENCE;
    };
    
    struct RoadWeatherMessageAddGrpB_LaneDataAttribute_addGrpB {
        INT isValidFlag;   // necessary if this struct is used as an optional field of a SEQUENCE
    };
    
    struct RoadWeatherMessageCommon_RegionalExtension_Reg_LaneDataAttribute_table {
        struct RoadWeatherMessageAddGrpB_LaneDataAttribute_addGrpB addGrpB;  // SEQUENCE;
    };
    
    struct RoadWeatherMessageCommon_RegionalExtension_Reg_LaneDataAttribute {
        INT isValidFlag;   // necessary if this struct is used as an optional field of a SEQUENCE
        BYTE regionId;  // INTEGER, 0..255, noRegion(0), addGrpA(1), addGrpB(2), addGrpC(3), addGrpD(4);
        struct RoadWeatherMessageCommon_RegionalExtension_Reg_LaneDataAttribute_table regExtvalue;  // TABLE;
    };
    
    struct RoadWeatherMessageCommon_LaneDataAttribute_regional {
        INT isValidFlag;   // necessary if this struct is used as an optional field of a SEQUENCE
        INT length;
        struct RoadWeatherMessageCommon_RegionalExtension_Reg_LaneDataAttribute arrayValue[4];  // SEQUENCE;
    };
    
    struct RoadWeatherMessageCommon_LaneDataAttribute {
        INT isValidFlag;   // necessary if this struct is used as an optional field of a SEQUENCE
        INT choice;
        INT pathEndPointAngle;  // INTEGER, -150..150;
        INT laneCrownPointCenter;  // INTEGER, -128..127;
        INT laneCrownPointLeft;  // INTEGER, -128..127;
        INT laneCrownPointRight;  // INTEGER, -128..127;
        INT laneAngle;  // INTEGER, -180..180;
        struct RoadWeatherMessageCommon_SpeedLimitList speedLimits;  // SEQUENCEOF;
        struct RoadWeatherMessageCommon_LaneDataAttribute_regional regional;  // SEQUENCEOF;
    };
    
    struct RoadWeatherMessageCommon_LaneDataAttributeList {
        INT isValidFlag;   // necessary if this struct is used as an optional field of a SEQUENCE
        INT length;
        struct RoadWeatherMessageCommon_LaneDataAttribute arrayValue[8];  // CHOICE;
    };
    
    struct RoadWeatherMessageCommon_RegionalExtension_Reg_NodeAttributeSetXY_table {
    };
    
    struct RoadWeatherMessageCommon_RegionalExtension_Reg_NodeAttributeSetXY {
        INT isValidFlag;   // necessary if this struct is used as an optional field of a SEQUENCE
        BYTE regionId;  // INTEGER, 0..255, noRegion(0), addGrpA(1), addGrpB(2), addGrpC(3), addGrpD(4);
        struct RoadWeatherMessageCommon_RegionalExtension_Reg_NodeAttributeSetXY_table regExtvalue;  // TABLE;
    };
    
    struct RoadWeatherMessageCommon_NodeAttributeSetXY_regional {
        INT isValidFlag;   // necessary if this struct is used as an optional field of a SEQUENCE
        INT length;
        struct RoadWeatherMessageCommon_RegionalExtension_Reg_NodeAttributeSetXY arrayValue[4];  // SEQUENCE;
    };
    
    struct RoadWeatherMessageCommon_NodeAttributeSetXY {
        INT isValidFlag;   // necessary if this struct is used as an optional field of a SEQUENCE
        struct RoadWeatherMessageCommon_NodeAttributeXYList localNode;  // SEQUENCEOF, OPTIONAL;
        struct RoadWeatherMessageCommon_SegmentAttributeXYList disabled;  // SEQUENCEOF, OPTIONAL;
        struct RoadWeatherMessageCommon_SegmentAttributeXYList enabled;  // SEQUENCEOF, OPTIONAL;
        struct RoadWeatherMessageCommon_LaneDataAttributeList data;  // SEQUENCEOF, OPTIONAL;
        struct OPT_INT_ASN dWidth;  // INTEGER, OPTIONAL, -512..511;
        struct OPT_INT_ASN dElevation;  // INTEGER, OPTIONAL, -512..511;
        struct RoadWeatherMessageCommon_NodeAttributeSetXY_regional regional;  // SEQUENCEOF, OPTIONAL;
    };
    
    struct RoadWeatherMessageCommon_NodeXY {
        INT isValidFlag;   // necessary if this struct is used as an optional field of a SEQUENCE
        struct RoadWeatherMessageCommon_NodeOffsetPointXY delta;  // CHOICE;
        struct RoadWeatherMessageCommon_NodeAttributeSetXY attributes;  // SEQUENCE, OPTIONAL;
    };
    
    struct RoadWeatherMessageCommon_NodeSetXY {
        INT isValidFlag;   // necessary if this struct is used as an optional field of a SEQUENCE
        INT length;
        struct RoadWeatherMessageCommon_NodeXY arrayValue[63];  // SEQUENCE;
    };
    
    struct RoadWeatherMessageCommon_ComputedLane_offsetXaxis {
        INT isValidFlag;   // necessary if this struct is used as an optional field of a SEQUENCE
        INT choice;
        INT small;  // INTEGER, -2047..2047;
        INT large;  // INTEGER, -32767..32767;
    };
    
    struct RoadWeatherMessageCommon_ComputedLane_offsetYaxis {
        INT isValidFlag;   // necessary if this struct is used as an optional field of a SEQUENCE
        INT choice;
        INT small;  // INTEGER, -2047..2047;
        INT large;  // INTEGER, -32767..32767;
    };
    
    struct RoadWeatherMessageCommon_RegionalExtension_Reg_ComputedLane_table {
    };
    
    struct RoadWeatherMessageCommon_RegionalExtension_Reg_ComputedLane {
        INT isValidFlag;   // necessary if this struct is used as an optional field of a SEQUENCE
        BYTE regionId;  // INTEGER, 0..255, noRegion(0), addGrpA(1), addGrpB(2), addGrpC(3), addGrpD(4);
        struct RoadWeatherMessageCommon_RegionalExtension_Reg_ComputedLane_table regExtvalue;  // TABLE;
    };
    
    struct RoadWeatherMessageCommon_ComputedLane_regional {
        INT isValidFlag;   // necessary if this struct is used as an optional field of a SEQUENCE
        INT length;
        struct RoadWeatherMessageCommon_RegionalExtension_Reg_ComputedLane arrayValue[4];  // SEQUENCE;
    };
    
    struct RoadWeatherMessageCommon_ComputedLane {
        INT isValidFlag;   // necessary if this struct is used as an optional field of a SEQUENCE
        BYTE referenceLaneId;  // INTEGER, 0..255;
        struct RoadWeatherMessageCommon_ComputedLane_offsetXaxis offsetXaxis;  // CHOICE;
        struct RoadWeatherMessageCommon_ComputedLane_offsetYaxis offsetYaxis;  // CHOICE;
        struct OPT_WORD_ASN rotateXY;  // INTEGER, OPTIONAL, 0..28800;
        struct OPT_INT_ASN scaleXaxis;  // INTEGER, OPTIONAL, -2048..2047;
        struct OPT_INT_ASN scaleYaxis;  // INTEGER, OPTIONAL, -2048..2047;
        struct RoadWeatherMessageCommon_ComputedLane_regional regional;  // SEQUENCEOF, OPTIONAL;
    };
    
    struct RoadWeatherMessageCommon_NodeListXY {
        INT isValidFlag;   // necessary if this struct is used as an optional field of a SEQUENCE
        INT choice;
        struct RoadWeatherMessageCommon_NodeSetXY nodes;  // SEQUENCEOF;
        struct RoadWeatherMessageCommon_ComputedLane computed;  // SEQUENCE;
    };
    
    struct RoadWeatherMessageTravelerInformation_Node_LL_24B {
        INT isValidFlag;   // necessary if this struct is used as an optional field of a SEQUENCE
        INT lon;  // INTEGER, -2048..2047;
        INT lat;  // INTEGER, -2048..2047;
    };
    
    struct RoadWeatherMessageTravelerInformation_Node_LL_28B {
        INT isValidFlag;   // necessary if this struct is used as an optional field of a SEQUENCE
        INT lon;  // INTEGER, -8192..8191;
        INT lat;  // INTEGER, -8192..8191;
    };
    
    struct RoadWeatherMessageTravelerInformation_Node_LL_32B {
        INT isValidFlag;   // necessary if this struct is used as an optional field of a SEQUENCE
        INT lon;  // INTEGER, -32768..32767;
        INT lat;  // INTEGER, -32768..32767;
    };
    
    struct RoadWeatherMessageTravelerInformation_Node_LL_36B {
        INT isValidFlag;   // necessary if this struct is used as an optional field of a SEQUENCE
        LONG lon;  // INTEGER, -131072..131071;
        LONG lat;  // INTEGER, -131072..131071;
    };
    
    struct RoadWeatherMessageTravelerInformation_Node_LL_44B {
        INT isValidFlag;   // necessary if this struct is used as an optional field of a SEQUENCE
        LONG lon;  // INTEGER, -2097152..2097151;
        LONG lat;  // INTEGER, -2097152..2097151;
    };
    
    struct RoadWeatherMessageTravelerInformation_Node_LL_48B {
        INT isValidFlag;   // necessary if this struct is used as an optional field of a SEQUENCE
        LONG lon;  // INTEGER, -8388608..8388607;
        LONG lat;  // INTEGER, -8388608..8388607;
    };
    
    struct RoadWeatherMessageCommon_RegionalExtension_Reg_NodeOffsetPointLL_table {
    };
    
    struct RoadWeatherMessageCommon_RegionalExtension_Reg_NodeOffsetPointLL {
        INT isValidFlag;   // necessary if this struct is used as an optional field of a SEQUENCE
        BYTE regionId;  // INTEGER, 0..255, noRegion(0), addGrpA(1), addGrpB(2), addGrpC(3), addGrpD(4);
        struct RoadWeatherMessageCommon_RegionalExtension_Reg_NodeOffsetPointLL_table regExtvalue;  // TABLE;
    };
    
    struct RoadWeatherMessageTravelerInformation_NodeOffsetPointLL {
        INT isValidFlag;   // necessary if this struct is used as an optional field of a SEQUENCE
        INT choice;
        struct RoadWeatherMessageTravelerInformation_Node_LL_24B node_LL1;  // SEQUENCE;
        struct RoadWeatherMessageTravelerInformation_Node_LL_28B node_LL2;  // SEQUENCE;
        struct RoadWeatherMessageTravelerInformation_Node_LL_32B node_LL3;  // SEQUENCE;
        struct RoadWeatherMessageTravelerInformation_Node_LL_36B node_LL4;  // SEQUENCE;
        struct RoadWeatherMessageTravelerInformation_Node_LL_44B node_LL5;  // SEQUENCE;
        struct RoadWeatherMessageTravelerInformation_Node_LL_48B node_LL6;  // SEQUENCE;
        struct RoadWeatherMessageCommon_Node_LLmD_64b node_LatLon;  // SEQUENCE;
        struct RoadWeatherMessageCommon_RegionalExtension_Reg_NodeOffsetPointLL regional;  // SEQUENCE;
    };
    
    struct RoadWeatherMessageTravelerInformation_NodeAttributeLLList {
        INT isValidFlag;   // necessary if this struct is used as an optional field of a SEQUENCE
        INT length;
        INT arrayValue[8];  // ENUMERATED, reserved(-0), stopLine(1), roundedCapStyleA(2), roundedCapStyleB(3), mergePoint(4), divergePoint(5), downstreamStopLine(6), downstreamStartNode(7), closedToTraffic(8), safeIsland(9), curbPresentAtStepOff(10), hydrantPresent(11);
    };
    
    struct RoadWeatherMessageTravelerInformation_SegmentAttributeLLList {
        INT isValidFlag;   // necessary if this struct is used as an optional field of a SEQUENCE
        INT length;
        INT arrayValue[8];  // ENUMERATED, reserved(-0), doNotBlock(1), whiteLine(2), mergingLaneLeft(3), mergingLaneRight(4), curbOnLeft(5), curbOnRight(6), loadingzoneOnLeft(7), loadingzoneOnRight(8), turnOutPointOnLeft(9), turnOutPointOnRight(10), adjacentParkingOnLeft(11), adjacentParkingOnRight(12), adjacentBikeLaneOnLeft(13), adjacentBikeLaneOnRight(14), sharedBikeLane(15), bikeBoxInFront(16), transitStopOnLeft(17), transitStopOnRight(18), transitStopInLane(19), sharedWithTrackedVehicle(20), safeIsland(21), lowCurbsPresent(22), rumbleStripPresent(23), audibleSignalingPresent(24), adaptiveTimingPresent(25), rfSignalRequestPresent(26), partialCurbIntrusion(27), taperToLeft(28), taperToRight(29), taperToCenterLine(30), parallelParking(31), headInParking(32), freeParking(33), timeRestrictionsOnParking(34), costToPark(35), midBlockCurbPresent(36), unEvenPavementPresent(37);
    };
    
    struct RoadWeatherMessageCommon_RegionalExtension_Reg_NodeAttributeSetLL_table {
    };
    
    struct RoadWeatherMessageCommon_RegionalExtension_Reg_NodeAttributeSetLL {
        INT isValidFlag;   // necessary if this struct is used as an optional field of a SEQUENCE
        BYTE regionId;  // INTEGER, 0..255, noRegion(0), addGrpA(1), addGrpB(2), addGrpC(3), addGrpD(4);
        struct RoadWeatherMessageCommon_RegionalExtension_Reg_NodeAttributeSetLL_table regExtvalue;  // TABLE;
    };
    
    struct RoadWeatherMessageTravelerInformation_NodeAttributeSetLL_regional {
        INT isValidFlag;   // necessary if this struct is used as an optional field of a SEQUENCE
        INT length;
        struct RoadWeatherMessageCommon_RegionalExtension_Reg_NodeAttributeSetLL arrayValue[4];  // SEQUENCE;
    };
    
    struct RoadWeatherMessageTravelerInformation_NodeAttributeSetLL {
        INT isValidFlag;   // necessary if this struct is used as an optional field of a SEQUENCE
        struct RoadWeatherMessageTravelerInformation_NodeAttributeLLList localNode;  // SEQUENCEOF, OPTIONAL;
        struct RoadWeatherMessageTravelerInformation_SegmentAttributeLLList disabled;  // SEQUENCEOF, OPTIONAL;
        struct RoadWeatherMessageTravelerInformation_SegmentAttributeLLList enabled;  // SEQUENCEOF, OPTIONAL;
        struct RoadWeatherMessageCommon_LaneDataAttributeList data;  // SEQUENCEOF, OPTIONAL;
        struct OPT_INT_ASN dWidth;  // INTEGER, OPTIONAL, -512..511;
        struct OPT_INT_ASN dElevation;  // INTEGER, OPTIONAL, -512..511;
        struct RoadWeatherMessageTravelerInformation_NodeAttributeSetLL_regional regional;  // SEQUENCEOF, OPTIONAL;
    };
    
    struct RoadWeatherMessageTravelerInformation_NodeLL {
        INT isValidFlag;   // necessary if this struct is used as an optional field of a SEQUENCE
        struct RoadWeatherMessageTravelerInformation_NodeOffsetPointLL delta;  // CHOICE;
        struct RoadWeatherMessageTravelerInformation_NodeAttributeSetLL attributes;  // SEQUENCE, OPTIONAL;
    };
    
    struct RoadWeatherMessageTravelerInformation_NodeSetLL {
        INT isValidFlag;   // necessary if this struct is used as an optional field of a SEQUENCE
        INT length;
        struct RoadWeatherMessageTravelerInformation_NodeLL arrayValue[63];  // SEQUENCE;
    };
    
    struct RoadWeatherMessageTravelerInformation_NodeListLL {
        INT isValidFlag;   // necessary if this struct is used as an optional field of a SEQUENCE
        INT choice;
        struct RoadWeatherMessageTravelerInformation_NodeSetLL nodes;  // SEQUENCEOF;
    };
    
    struct RoadWeatherMessageTravelerInformation_OffsetSystem_offset {
        INT isValidFlag;   // necessary if this struct is used as an optional field of a SEQUENCE
        INT choice;
        struct RoadWeatherMessageCommon_NodeListXY xy;  // CHOICE;
        struct RoadWeatherMessageTravelerInformation_NodeListLL ll;  // CHOICE;
    };
    
    struct RoadWeatherMessageTravelerInformation_OffsetSystem {
        INT isValidFlag;   // necessary if this struct is used as an optional field of a SEQUENCE
        struct OPT_BYTE_ASN scale;  // INTEGER, OPTIONAL, 0..15;
        struct RoadWeatherMessageTravelerInformation_OffsetSystem_offset offset;  // CHOICE;
    };
    
    struct RoadWeatherMessageTravelerInformation_Circle {
        INT isValidFlag;   // necessary if this struct is used as an optional field of a SEQUENCE
        struct RoadWeatherMessageCommon_Position3D center;  // SEQUENCE;
        WORD radius;  // INTEGER, 0..4095;
        INT units;  // ENUMERATED, centimeter(0), cm2_5(1), decimeter(2), meter(3), kilometer(4), foot(5), yard(6), mile(7);
    };
    
    struct RoadWeatherMessageCommon_RegionalExtension_Reg_GeometricProjection_table {
    };
    
    struct RoadWeatherMessageCommon_RegionalExtension_Reg_GeometricProjection {
        INT isValidFlag;   // necessary if this struct is used as an optional field of a SEQUENCE
        BYTE regionId;  // INTEGER, 0..255, noRegion(0), addGrpA(1), addGrpB(2), addGrpC(3), addGrpD(4);
        struct RoadWeatherMessageCommon_RegionalExtension_Reg_GeometricProjection_table regExtvalue;  // TABLE;
    };
    
    struct RoadWeatherMessageTravelerInformation_GeometricProjection_regional {
        INT isValidFlag;   // necessary if this struct is used as an optional field of a SEQUENCE
        INT length;
        struct RoadWeatherMessageCommon_RegionalExtension_Reg_GeometricProjection arrayValue[4];  // SEQUENCE;
    };
    
    struct RoadWeatherMessageTravelerInformation_GeometricProjection {
        INT isValidFlag;   // necessary if this struct is used as an optional field of a SEQUENCE
        struct RoadWeatherMessageCommon_HeadingSlice direction;  // BITSTRING;
        struct OPT_ENUM_ASN extent;  // ENUMERATED, OPTIONAL, useInstantlyOnly(0), useFor3meters(1), useFor10meters(2), useFor50meters(3), useFor100meters(4), useFor500meters(5), useFor1000meters(6), useFor5000meters(7), useFor10000meters(8), useFor50000meters(9), useFor100000meters(10), useFor500000meters(11), useFor1000000meters(12), useFor5000000meters(13), useFor10000000meters(14), forever(15);
        struct OPT_WORD_ASN laneWidth;  // INTEGER, OPTIONAL, 0..32767;
        struct RoadWeatherMessageTravelerInformation_Circle circle;  // SEQUENCE;
        struct RoadWeatherMessageTravelerInformation_GeometricProjection_regional regional;  // SEQUENCEOF, OPTIONAL;
    };
    
    struct RoadWeatherMessageTravelerInformation_ShapePointSet {
        INT isValidFlag;   // necessary if this struct is used as an optional field of a SEQUENCE
        struct RoadWeatherMessageCommon_Position3D anchor;  // SEQUENCE, OPTIONAL;
        struct OPT_WORD_ASN laneWidth;  // INTEGER, OPTIONAL, 0..32767;
        struct OPT_ENUM_ASN directionality;  // ENUMERATED, OPTIONAL, unavailable(0), forward(1), reverse(2), both(3);
        struct RoadWeatherMessageCommon_NodeListXY nodeList;  // CHOICE;
    };
    
    struct RoadWeatherMessageTravelerInformation_RegionOffsets {
        INT isValidFlag;   // necessary if this struct is used as an optional field of a SEQUENCE
        INT xOffset;  // INTEGER, -32768..32767;
        INT yOffset;  // INTEGER, -32768..32767;
        struct OPT_INT_ASN zOffset;  // INTEGER, OPTIONAL, -32768..32767;
    };
    
    struct RoadWeatherMessageTravelerInformation_RegionList {
        INT isValidFlag;   // necessary if this struct is used as an optional field of a SEQUENCE
        INT length;
        struct RoadWeatherMessageTravelerInformation_RegionOffsets arrayValue[64];  // SEQUENCE;
    };
    
    struct RoadWeatherMessageTravelerInformation_RegionPointSet {
        INT isValidFlag;   // necessary if this struct is used as an optional field of a SEQUENCE
        struct RoadWeatherMessageCommon_Position3D anchor;  // SEQUENCE, OPTIONAL;
        struct OPT_BYTE_ASN scale;  // INTEGER, OPTIONAL, 0..15;
        struct RoadWeatherMessageTravelerInformation_RegionList nodeList;  // SEQUENCEOF;
    };
    
    struct RoadWeatherMessageTravelerInformation_ValidRegion_area {
        INT isValidFlag;   // necessary if this struct is used as an optional field of a SEQUENCE
        INT choice;
        struct RoadWeatherMessageTravelerInformation_ShapePointSet shapePointSet;  // SEQUENCE;
        struct RoadWeatherMessageTravelerInformation_Circle circle;  // SEQUENCE;
        struct RoadWeatherMessageTravelerInformation_RegionPointSet regionPointSet;  // SEQUENCE;
    };
    
    struct RoadWeatherMessageTravelerInformation_ValidRegion {
        INT isValidFlag;   // necessary if this struct is used as an optional field of a SEQUENCE
        struct RoadWeatherMessageCommon_HeadingSlice direction;  // BITSTRING;
        struct OPT_ENUM_ASN extent;  // ENUMERATED, OPTIONAL, useInstantlyOnly(0), useFor3meters(1), useFor10meters(2), useFor50meters(3), useFor100meters(4), useFor500meters(5), useFor1000meters(6), useFor5000meters(7), useFor10000meters(8), useFor50000meters(9), useFor100000meters(10), useFor500000meters(11), useFor1000000meters(12), useFor5000000meters(13), useFor10000000meters(14), forever(15);
        struct RoadWeatherMessageTravelerInformation_ValidRegion_area area;  // CHOICE;
    };
    
    struct RoadWeatherMessageTravelerInformation_GeographicalPath_description {
        INT isValidFlag;   // necessary if this struct is used as an optional field of a SEQUENCE
        INT choice;
        struct RoadWeatherMessageTravelerInformation_OffsetSystem path;  // SEQUENCE;
        struct RoadWeatherMessageTravelerInformation_GeometricProjection geometry;  // SEQUENCE;
        struct RoadWeatherMessageTravelerInformation_ValidRegion oldRegion;  // SEQUENCE;
    };
    
    struct RoadWeatherMessageCommon_RegionalExtension_Reg_GeographicalPath_table {
    };
    
    struct RoadWeatherMessageCommon_RegionalExtension_Reg_GeographicalPath {
        INT isValidFlag;   // necessary if this struct is used as an optional field of a SEQUENCE
        BYTE regionId;  // INTEGER, 0..255, noRegion(0), addGrpA(1), addGrpB(2), addGrpC(3), addGrpD(4);
        struct RoadWeatherMessageCommon_RegionalExtension_Reg_GeographicalPath_table regExtvalue;  // TABLE;
    };
    
    struct RoadWeatherMessageTravelerInformation_GeographicalPath_regional {
        INT isValidFlag;   // necessary if this struct is used as an optional field of a SEQUENCE
        INT length;
        struct RoadWeatherMessageCommon_RegionalExtension_Reg_GeographicalPath arrayValue[4];  // SEQUENCE;
    };
    
    struct RoadWeatherMessageTravelerInformation_GeographicalPath {
        INT isValidFlag;   // necessary if this struct is used as an optional field of a SEQUENCE
        struct RoadWeatherMessageCommon_DescriptiveName name;  // IA5STRING, OPTIONAL;
        struct RoadWeatherMessageCommon_RoadSegmentReferenceID id;  // SEQUENCE, OPTIONAL;
        struct RoadWeatherMessageCommon_Position3D anchor;  // SEQUENCE, OPTIONAL;
        struct OPT_WORD_ASN laneWidth;  // INTEGER, OPTIONAL, 0..32767;
        struct OPT_ENUM_ASN directionality;  // ENUMERATED, OPTIONAL, unavailable(0), forward(1), reverse(2), both(3);
        struct OPT_BOOL_ASN closedPath;  // BOOLEAN, OPTIONAL;
        struct RoadWeatherMessageCommon_HeadingSlice direction;  // BITSTRING, OPTIONAL;
        struct RoadWeatherMessageTravelerInformation_GeographicalPath_description description;  // CHOICE, OPTIONAL;
        struct RoadWeatherMessageTravelerInformation_GeographicalPath_regional regional;  // SEQUENCEOF, OPTIONAL;
    };
    
    struct RoadWeatherMessageTravelerInformation_TravelerDataFrame_regions {
        INT isValidFlag;   // necessary if this struct is used as an optional field of a SEQUENCE
        INT length;
        struct RoadWeatherMessageTravelerInformation_GeographicalPath arrayValue[16];  // SEQUENCE;
    };
    
    struct RoadWeatherMessageITIS_ITIScodesAndText__item {
        INT isValidFlag;   // necessary if this struct is used as an optional field of a SEQUENCE
        INT choice;
        WORD itis;  // INTEGER, 0..65535;
        struct RoadWeatherMessageITIS_ITIStext text;  // IA5STRING;
    };
    
    struct RoadWeatherMessageITIS_ITIScodesAndText_ {
        INT isValidFlag;   // necessary if this struct is used as an optional field of a SEQUENCE
        struct RoadWeatherMessageITIS_ITIScodesAndText__item item;  // CHOICE;
    };
    
    struct RoadWeatherMessageITIS_ITIScodesAndText {
        INT isValidFlag;   // necessary if this struct is used as an optional field of a SEQUENCE
        INT length;
        struct RoadWeatherMessageITIS_ITIScodesAndText_ arrayValue[100];  // SEQUENCE;
    };
    
    struct RoadWeatherMessageTravelerInformation_ITIStextPhrase {
        INT isValidFlag;   // necessary if this struct is used as an optional field of a SEQUENCE
        CHAR string[17];
        INT  stringLength;
    };
    
    struct RoadWeatherMessageTravelerInformation_WorkZone__item {
        INT isValidFlag;   // necessary if this struct is used as an optional field of a SEQUENCE
        INT choice;
        WORD itis;  // INTEGER, 0..65535;
        struct RoadWeatherMessageTravelerInformation_ITIStextPhrase text;  // IA5STRING;
    };
    
    struct RoadWeatherMessageTravelerInformation_WorkZone_ {
        INT isValidFlag;   // necessary if this struct is used as an optional field of a SEQUENCE
        struct RoadWeatherMessageTravelerInformation_WorkZone__item item;  // CHOICE;
    };
    
    struct RoadWeatherMessageTravelerInformation_WorkZone {
        INT isValidFlag;   // necessary if this struct is used as an optional field of a SEQUENCE
        INT length;
        struct RoadWeatherMessageTravelerInformation_WorkZone_ arrayValue[16];  // SEQUENCE;
    };
    
    struct RoadWeatherMessageTravelerInformation_GenericSignage__item {
        INT isValidFlag;   // necessary if this struct is used as an optional field of a SEQUENCE
        INT choice;
        WORD itis;  // INTEGER, 0..65535;
        struct RoadWeatherMessageTravelerInformation_ITIStextPhrase text;  // IA5STRING;
    };
    
    struct RoadWeatherMessageTravelerInformation_GenericSignage_ {
        INT isValidFlag;   // necessary if this struct is used as an optional field of a SEQUENCE
        struct RoadWeatherMessageTravelerInformation_GenericSignage__item item;  // CHOICE;
    };
    
    struct RoadWeatherMessageTravelerInformation_GenericSignage {
        INT isValidFlag;   // necessary if this struct is used as an optional field of a SEQUENCE
        INT length;
        struct RoadWeatherMessageTravelerInformation_GenericSignage_ arrayValue[16];  // SEQUENCE;
    };
    
    struct RoadWeatherMessageTravelerInformation_SpeedLimit__item {
        INT isValidFlag;   // necessary if this struct is used as an optional field of a SEQUENCE
        INT choice;
        WORD itis;  // INTEGER, 0..65535;
        struct RoadWeatherMessageTravelerInformation_ITIStextPhrase text;  // IA5STRING;
    };
    
    struct RoadWeatherMessageTravelerInformation_SpeedLimit_ {
        INT isValidFlag;   // necessary if this struct is used as an optional field of a SEQUENCE
        struct RoadWeatherMessageTravelerInformation_SpeedLimit__item item;  // CHOICE;
    };
    
    struct RoadWeatherMessageTravelerInformation_SpeedLimit {
        INT isValidFlag;   // necessary if this struct is used as an optional field of a SEQUENCE
        INT length;
        struct RoadWeatherMessageTravelerInformation_SpeedLimit_ arrayValue[16];  // SEQUENCE;
    };
    
    struct RoadWeatherMessageTravelerInformation_ExitService__item {
        INT isValidFlag;   // necessary if this struct is used as an optional field of a SEQUENCE
        INT choice;
        WORD itis;  // INTEGER, 0..65535;
        struct RoadWeatherMessageTravelerInformation_ITIStextPhrase text;  // IA5STRING;
    };
    
    struct RoadWeatherMessageTravelerInformation_ExitService_ {
        INT isValidFlag;   // necessary if this struct is used as an optional field of a SEQUENCE
        struct RoadWeatherMessageTravelerInformation_ExitService__item item;  // CHOICE;
    };
    
    struct RoadWeatherMessageTravelerInformation_ExitService {
        INT isValidFlag;   // necessary if this struct is used as an optional field of a SEQUENCE
        INT length;
        struct RoadWeatherMessageTravelerInformation_ExitService_ arrayValue[16];  // SEQUENCE;
    };
    
    struct RoadWeatherMessageTravelerInformation_TravelerDataFrame_content {
        INT isValidFlag;   // necessary if this struct is used as an optional field of a SEQUENCE
        INT choice;
        struct RoadWeatherMessageITIS_ITIScodesAndText advisory;  // SEQUENCEOF;
        struct RoadWeatherMessageTravelerInformation_WorkZone workZone;  // SEQUENCEOF;
        struct RoadWeatherMessageTravelerInformation_GenericSignage genericSign;  // SEQUENCEOF;
        struct RoadWeatherMessageTravelerInformation_SpeedLimit speedLimit;  // SEQUENCEOF;
        struct RoadWeatherMessageTravelerInformation_ExitService exitService;  // SEQUENCEOF;
    };
    
    struct RoadWeatherMessageTravelerInformation_URL_Short {
        INT isValidFlag;   // necessary if this struct is used as an optional field of a SEQUENCE
        CHAR string[16];
        INT  stringLength;
    };
    
    struct RoadWeatherMessageCommon_PortlandCement {
        INT isValidFlag;   // necessary if this struct is used as an optional field of a SEQUENCE
        INT type;  // ENUMERATED, newSharp(-0), traveled(1), trafficPolished(2);
    };
    
    struct RoadWeatherMessageCommon_AsphaltOrTar {
        INT isValidFlag;   // necessary if this struct is used as an optional field of a SEQUENCE
        INT type;  // ENUMERATED, newSharp(-0), traveled(1), trafficPolished(2), excessTar(3);
    };
    
    struct RoadWeatherMessageCommon_Gravel {
        INT isValidFlag;   // necessary if this struct is used as an optional field of a SEQUENCE
        INT type;  // ENUMERATED, packedOiled(-0), loose(1);
    };
    
    struct RoadWeatherMessageCommon_Grass {
        INT isValidFlag;   // necessary if this struct is used as an optional field of a SEQUENCE
        INT type;  // ENUMERATED, lessThan30Mph(-0);
    };
    
    struct RoadWeatherMessageCommon_Cinders {
        INT isValidFlag;   // necessary if this struct is used as an optional field of a SEQUENCE
        INT type;  // ENUMERATED, packed(-0);
    };
    
    struct RoadWeatherMessageCommon_Rock {
        INT isValidFlag;   // necessary if this struct is used as an optional field of a SEQUENCE
        INT type;  // ENUMERATED, crushed(-0);
    };
    
    struct RoadWeatherMessageCommon_Ice {
        INT isValidFlag;   // necessary if this struct is used as an optional field of a SEQUENCE
        INT type;  // ENUMERATED, smooth(-0);
    };
    
    struct RoadWeatherMessageCommon_Snow {
        INT isValidFlag;   // necessary if this struct is used as an optional field of a SEQUENCE
        INT type;  // ENUMERATED, packed(-0), loose(1);
    };
    
    struct RoadWeatherMessageCommon_DescriptionOfRoadSurface {
        INT isValidFlag;   // necessary if this struct is used as an optional field of a SEQUENCE
        INT choice;
        struct RoadWeatherMessageCommon_PortlandCement portlandCement;  // SEQUENCE;
        struct RoadWeatherMessageCommon_AsphaltOrTar asphaltOrTar;  // SEQUENCE;
        struct RoadWeatherMessageCommon_Gravel gravel;  // SEQUENCE;
        struct RoadWeatherMessageCommon_Grass grass;  // SEQUENCE;
        struct RoadWeatherMessageCommon_Cinders cinders;  // SEQUENCE;
        struct RoadWeatherMessageCommon_Rock rock;  // SEQUENCE;
        struct RoadWeatherMessageCommon_Ice ice;  // SEQUENCE;
        struct RoadWeatherMessageCommon_Snow snow;  // SEQUENCE;
    };
    
    struct RoadWeatherMessageCommon_FrictionInformation {
        INT isValidFlag;   // necessary if this struct is used as an optional field of a SEQUENCE
        struct RoadWeatherMessageCommon_DescriptionOfRoadSurface roadSurfaceDescription;  // CHOICE;
        struct OPT_ENUM_ASN dryOrWet;  // ENUMERATED, OPTIONAL, dry(-0), wet(1);
        struct RoadWeatherMessageCommon_RoadRoughness roadRoughness;  // SEQUENCE, OPTIONAL;
    };
    
    struct RoadWeatherMessageTravelerInformation_TravelerDataFrameNewPartIIIContent {
        INT isValidFlag;   // necessary if this struct is used as an optional field of a SEQUENCE
        INT choice;
        struct RoadWeatherMessageCommon_FrictionInformation frictionInfo;  // SEQUENCE;
    };
    
    struct RoadWeatherMessageTravelerInformation_TravelerDataFrame {
        INT isValidFlag;   // necessary if this struct is used as an optional field of a SEQUENCE
        BYTE doNotUse1;  // INTEGER, 0..31;
        INT frameType;  // ENUMERATED, unknown(0), advisory(1), roadSignage(2), commercialSignage(3);
        struct RoadWeatherMessageTravelerInformation_TravelerDataFrame_msgId msgId;  // CHOICE;
        struct OPT_WORD_ASN startYear;  // INTEGER, OPTIONAL, 0..4095;
        DWORD startTime;  // INTEGER, 0..527040;
        WORD durationTime;  // INTEGER, 0..32000;
        BYTE priority;  // INTEGER, 0..7;
        BYTE doNotUse2;  // INTEGER, 0..31;
        struct RoadWeatherMessageTravelerInformation_TravelerDataFrame_regions regions;  // SEQUENCEOF;
        BYTE doNotUse3;  // INTEGER, 0..31;
        BYTE doNotUse4;  // INTEGER, 0..31;
        struct RoadWeatherMessageTravelerInformation_TravelerDataFrame_content content;  // CHOICE;
        struct RoadWeatherMessageTravelerInformation_URL_Short url;  // IA5STRING, OPTIONAL;
        struct RoadWeatherMessageTravelerInformation_TravelerDataFrameNewPartIIIContent contentNew;  // CHOICE;
    };
    
    struct RoadWeatherMessageTravelerInformation_TravelerDataFrameList {
        INT isValidFlag;   // necessary if this struct is used as an optional field of a SEQUENCE
        INT length;
        struct RoadWeatherMessageTravelerInformation_TravelerDataFrame arrayValue[8];  // SEQUENCE;
    };
    
    struct RoadWeatherMessageRoadWeatherDownload {
        INT isValidFlag;   // necessary if this struct is used as an optional field of a SEQUENCE
        struct RoadWeatherMessageTravelerInformation_TravelerDataFrameList travelerData;  // SEQUENCEOF;
        struct RoadWeatherMessageWDMSFleetData wdmsFleetData;  // SEQUENCE, OPTIONAL;
    };
    
    struct RoadWeatherMessage_RoadWeatherMessage {
        INT isValidFlag;   // necessary if this struct is used as an optional field of a SEQUENCE
        INT choice;
        struct RoadWeatherMessageRoadWeatherUpload upload;  // CHOICE;
        struct RoadWeatherMessageRoadWeatherDownload download;  // SEQUENCE;
    };
    
    struct RoadWeatherMessageMESSAGE_ID_AND_TYPE {
        struct RoadWeatherMessage_RoadWeatherMessage roadWeatherMessage;  // CHOICE;
    };
    
    struct RoadWeatherMessage {
        INT isValidFlag;   // necessary if this struct is used as an optional field of a SEQUENCE
        WORD messageId;  // INTEGER, 0..32767, mapData(18), signalPhaseAndTimingMessage(19), basicSafetyMessage(20), commonSafetyRequest(21), emergencyVehicleAlert(22), intersectionCollision(23), nmeaCorrections(24), probeDataManagement(25), probeVehicleData(26), roadSideAlert(27), rtcmCorrections(28), signalRequestMessage(29), signalStatusMessage(30), travelerInformation(31), personalSafetyMessage(32), roadSafetyMessage(33), roadWeatherMessage(34), probeDataConfigMessage(35), probeDataReportMessage(36), tollAdvertisementMessage(37), tollUsageMessage(38), tollUsageAckMessage(39), cooperativeControlMessage(40), sensorDataSharingMessage(41), maneuverSharingAndCoordinatingMessage(42), roadGeometryAndAttributes(43), personalSafetyMessage2(44), trafficSignalPhaseAndTiming(45), signalControlAndPrioritizationRequest(46), signalControlAndPrioritizationStatus(47), roadUserChargingConfigMessage(48), roadUserChargingReportMessage(49), trafficLightStatusMessage(50);
        struct RoadWeatherMessageMESSAGE_ID_AND_TYPE value;  // TABLE;
    };
    
}

/*
// init function to create a simple packet handle
*/ 
LONG API_InitRoadWeatherMessagePacket()
{
  return C2xInitPacket("RoadWeatherMessage"); 
}

/*
// init function to create a simple packet handle and
// initialize the struct with valid data
*/ 
LONG API_InitRoadWeatherMessagePacket(struct RoadWeatherMessage msgStruct)
{
  long pktHandle;

  pktHandle = API_InitRoadWeatherMessagePacket();

  if (pktHandle != 0)
  {
    // create valid message and application data
    if (C2xCompletePacket(pktHandle) == 0) 
    {
      API_GetRoadWeatherMessageParams(pktHandle, msgStruct);
    }
  }
  return pktHandle;
}

/*
// init function to create a packet with security layer and
// initialize the struct with valid data
*/ 
LONG API_InitRoadWeatherMessagePacket(struct RoadWeatherMessage msgStruct, char packetTypeDesignator[], char certificateName[])
{
  long pktHandle, certHdl;

  // initialize the packet
  pktHandle = C2xInitPacket("RoadWeatherMessage", packetTypeDesignator);

  if (pktHandle != 0)
  {
    certHdl = C2xSecCertificateGetHandle(certificateName);  // get the certificate handle for the cert with name "certificateName"
    if (certHdl != 0) 
    {
      C2xSecPacketSetSignerHandle(pktHandle, certHdl); // set the certHdl to the packet
    }

    // create valid message and application data
    if (C2xCompletePacket(pktHandle) == 0) 
    {
      // copy application data to the application structure
      API_GetRoadWeatherMessageParams(pktHandle, msgStruct);
    }
  }
  return pktHandle;
}
    

int GetRoadWeatherMessageCommon_DDateTimeParams(LONG packetHandle, struct RoadWeatherMessageCommon_DDateTime value, char oldPath[])
{
  char newPath[300];
  int result;

  result = 0;

  snprintf(newPath, elcount(newPath), "%s.%s", oldPath, "year");
  value.year.isValidFlag = C2xIsTokenAvailable(packetHandle, "RoadWeatherMessage", newPath);
  if(value.year.isValidFlag==1)
  {
    value.year.value = C2xGetTokenInt(packetHandle, "RoadWeatherMessage", newPath);
    result = CheckLastError("RoadWeatherMessage", gkFuncRefGet, result);
  }
  snprintf(newPath, elcount(newPath), "%s.%s", oldPath, "month");
  value.month.isValidFlag = C2xIsTokenAvailable(packetHandle, "RoadWeatherMessage", newPath);
  if(value.month.isValidFlag==1)
  {
    value.month.value = C2xGetTokenInt(packetHandle, "RoadWeatherMessage", newPath);
    result = CheckLastError("RoadWeatherMessage", gkFuncRefGet, result);
  }
  snprintf(newPath, elcount(newPath), "%s.%s", oldPath, "day");
  value.day.isValidFlag = C2xIsTokenAvailable(packetHandle, "RoadWeatherMessage", newPath);
  if(value.day.isValidFlag==1)
  {
    value.day.value = C2xGetTokenInt(packetHandle, "RoadWeatherMessage", newPath);
    result = CheckLastError("RoadWeatherMessage", gkFuncRefGet, result);
  }
  snprintf(newPath, elcount(newPath), "%s.%s", oldPath, "hour");
  value.hour.isValidFlag = C2xIsTokenAvailable(packetHandle, "RoadWeatherMessage", newPath);
  if(value.hour.isValidFlag==1)
  {
    value.hour.value = C2xGetTokenInt(packetHandle, "RoadWeatherMessage", newPath);
    result = CheckLastError("RoadWeatherMessage", gkFuncRefGet, result);
  }
  snprintf(newPath, elcount(newPath), "%s.%s", oldPath, "minute");
  value.minute.isValidFlag = C2xIsTokenAvailable(packetHandle, "RoadWeatherMessage", newPath);
  if(value.minute.isValidFlag==1)
  {
    value.minute.value = C2xGetTokenInt(packetHandle, "RoadWeatherMessage", newPath);
    result = CheckLastError("RoadWeatherMessage", gkFuncRefGet, result);
  }
  snprintf(newPath, elcount(newPath), "%s.%s", oldPath, "second");
  value.second.isValidFlag = C2xIsTokenAvailable(packetHandle, "RoadWeatherMessage", newPath);
  if(value.second.isValidFlag==1)
  {
    value.second.value = C2xGetTokenInt(packetHandle, "RoadWeatherMessage", newPath);
    result = CheckLastError("RoadWeatherMessage", gkFuncRefGet, result);
  }
  snprintf(newPath, elcount(newPath), "%s.%s", oldPath, "offset");
  value.offset.isValidFlag = C2xIsTokenAvailable(packetHandle, "RoadWeatherMessage", newPath);
  if(value.offset.isValidFlag==1)
  {
    value.offset.value = C2xGetTokenInt(packetHandle, "RoadWeatherMessage", newPath);
    result = CheckLastError("RoadWeatherMessage", gkFuncRefGet, result);
  }
  return result;
}

int SetRoadWeatherMessageCommon_DDateTimeParams(LONG packetHandle, struct RoadWeatherMessageCommon_DDateTime value, char oldPath[])
{
  char newPath[300];
  int result;

  result = 0;

  snprintf(newPath, elcount(newPath), "%s.%s", oldPath, "year");
  if(value.year.isValidFlag==1)
  {
    C2xSetTokenInt(packetHandle, "RoadWeatherMessage", newPath, value.year.value);
    result = CheckLastError("RoadWeatherMessage", gkFuncRefGet, result);
  }
  else
  {
    if( C2xIsTokenAvailable(packetHandle, "RoadWeatherMessage", newPath) )
    {
      C2xRemoveToken(packetHandle, "RoadWeatherMessage", newPath);
    }
  }

  snprintf(newPath, elcount(newPath), "%s.%s", oldPath, "month");
  if(value.month.isValidFlag==1)
  {
    C2xSetTokenInt(packetHandle, "RoadWeatherMessage", newPath, value.month.value);
    result = CheckLastError("RoadWeatherMessage", gkFuncRefGet, result);
  }
  else
  {
    if( C2xIsTokenAvailable(packetHandle, "RoadWeatherMessage", newPath) )
    {
      C2xRemoveToken(packetHandle, "RoadWeatherMessage", newPath);
    }
  }

  snprintf(newPath, elcount(newPath), "%s.%s", oldPath, "day");
  if(value.day.isValidFlag==1)
  {
    C2xSetTokenInt(packetHandle, "RoadWeatherMessage", newPath, value.day.value);
    result = CheckLastError("RoadWeatherMessage", gkFuncRefGet, result);
  }
  else
  {
    if( C2xIsTokenAvailable(packetHandle, "RoadWeatherMessage", newPath) )
    {
      C2xRemoveToken(packetHandle, "RoadWeatherMessage", newPath);
    }
  }

  snprintf(newPath, elcount(newPath), "%s.%s", oldPath, "hour");
  if(value.hour.isValidFlag==1)
  {
    C2xSetTokenInt(packetHandle, "RoadWeatherMessage", newPath, value.hour.value);
    result = CheckLastError("RoadWeatherMessage", gkFuncRefGet, result);
  }
  else
  {
    if( C2xIsTokenAvailable(packetHandle, "RoadWeatherMessage", newPath) )
    {
      C2xRemoveToken(packetHandle, "RoadWeatherMessage", newPath);
    }
  }

  snprintf(newPath, elcount(newPath), "%s.%s", oldPath, "minute");
  if(value.minute.isValidFlag==1)
  {
    C2xSetTokenInt(packetHandle, "RoadWeatherMessage", newPath, value.minute.value);
    result = CheckLastError("RoadWeatherMessage", gkFuncRefGet, result);
  }
  else
  {
    if( C2xIsTokenAvailable(packetHandle, "RoadWeatherMessage", newPath) )
    {
      C2xRemoveToken(packetHandle, "RoadWeatherMessage", newPath);
    }
  }

  snprintf(newPath, elcount(newPath), "%s.%s", oldPath, "second");
  if(value.second.isValidFlag==1)
  {
    C2xSetTokenInt(packetHandle, "RoadWeatherMessage", newPath, value.second.value);
    result = CheckLastError("RoadWeatherMessage", gkFuncRefGet, result);
  }
  else
  {
    if( C2xIsTokenAvailable(packetHandle, "RoadWeatherMessage", newPath) )
    {
      C2xRemoveToken(packetHandle, "RoadWeatherMessage", newPath);
    }
  }

  snprintf(newPath, elcount(newPath), "%s.%s", oldPath, "offset");
  if(value.offset.isValidFlag==1)
  {
    C2xSetTokenInt(packetHandle, "RoadWeatherMessage", newPath, value.offset.value);
    result = CheckLastError("RoadWeatherMessage", gkFuncRefGet, result);
  }
  else
  {
    if( C2xIsTokenAvailable(packetHandle, "RoadWeatherMessage", newPath) )
    {
      C2xRemoveToken(packetHandle, "RoadWeatherMessage", newPath);
    }
  }

  return result;
}

int GetRoadWeatherMessageCommon_TransmissionAndSpeedParams(LONG packetHandle, struct RoadWeatherMessageCommon_TransmissionAndSpeed value, char oldPath[])
{
  char newPath[300];
  int result;

  result = 0;

  snprintf(newPath, elcount(newPath), "%s.%s", oldPath, "transmisson");
  value.transmisson = C2xGetTokenInt(packetHandle, "RoadWeatherMessage", newPath);
  result = CheckLastError("RoadWeatherMessage", gkFuncRefGet, result);

  snprintf(newPath, elcount(newPath), "%s.%s", oldPath, "speed");
  value.speed = C2xGetTokenInt(packetHandle, "RoadWeatherMessage", newPath);
  result = CheckLastError("RoadWeatherMessage", gkFuncRefGet, result);

  return result;
}

int SetRoadWeatherMessageCommon_TransmissionAndSpeedParams(LONG packetHandle, struct RoadWeatherMessageCommon_TransmissionAndSpeed value, char oldPath[])
{
  char newPath[300];
  int result;

  result = 0;

  snprintf(newPath, elcount(newPath), "%s.%s", oldPath, "transmisson");
  C2xSetTokenInt(packetHandle, "RoadWeatherMessage", newPath, value.transmisson);
  result = CheckLastError("RoadWeatherMessage", gkFuncRefGet, result);

  snprintf(newPath, elcount(newPath), "%s.%s", oldPath, "speed");
  C2xSetTokenInt(packetHandle, "RoadWeatherMessage", newPath, value.speed);
  result = CheckLastError("RoadWeatherMessage", gkFuncRefGet, result);

  return result;
}

int GetRoadWeatherMessageCommon_PositionalAccuracyParams(LONG packetHandle, struct RoadWeatherMessageCommon_PositionalAccuracy value, char oldPath[])
{
  char newPath[300];
  int result;

  result = 0;

  snprintf(newPath, elcount(newPath), "%s.%s", oldPath, "semiMajor");
  value.semiMajor = C2xGetTokenInt(packetHandle, "RoadWeatherMessage", newPath);
  result = CheckLastError("RoadWeatherMessage", gkFuncRefGet, result);

  snprintf(newPath, elcount(newPath), "%s.%s", oldPath, "semiMinor");
  value.semiMinor = C2xGetTokenInt(packetHandle, "RoadWeatherMessage", newPath);
  result = CheckLastError("RoadWeatherMessage", gkFuncRefGet, result);

  snprintf(newPath, elcount(newPath), "%s.%s", oldPath, "orientation");
  value.orientation = C2xGetTokenInt(packetHandle, "RoadWeatherMessage", newPath);
  result = CheckLastError("RoadWeatherMessage", gkFuncRefGet, result);

  return result;
}

int SetRoadWeatherMessageCommon_PositionalAccuracyParams(LONG packetHandle, struct RoadWeatherMessageCommon_PositionalAccuracy value, char oldPath[])
{
  char newPath[300];
  int result;

  result = 0;

  snprintf(newPath, elcount(newPath), "%s.%s", oldPath, "semiMajor");
  C2xSetTokenInt(packetHandle, "RoadWeatherMessage", newPath, value.semiMajor);
  result = CheckLastError("RoadWeatherMessage", gkFuncRefGet, result);

  snprintf(newPath, elcount(newPath), "%s.%s", oldPath, "semiMinor");
  C2xSetTokenInt(packetHandle, "RoadWeatherMessage", newPath, value.semiMinor);
  result = CheckLastError("RoadWeatherMessage", gkFuncRefGet, result);

  snprintf(newPath, elcount(newPath), "%s.%s", oldPath, "orientation");
  C2xSetTokenInt(packetHandle, "RoadWeatherMessage", newPath, value.orientation);
  result = CheckLastError("RoadWeatherMessage", gkFuncRefGet, result);

  return result;
}

int GetRoadWeatherMessageCommon_PositionConfidenceSetParams(LONG packetHandle, struct RoadWeatherMessageCommon_PositionConfidenceSet value, char oldPath[])
{
  char newPath[300];
  int result;

  result = 0;

  snprintf(newPath, elcount(newPath), "%s.%s", oldPath, "pos");
  value.pos = C2xGetTokenInt(packetHandle, "RoadWeatherMessage", newPath);
  result = CheckLastError("RoadWeatherMessage", gkFuncRefGet, result);

  snprintf(newPath, elcount(newPath), "%s.%s", oldPath, "elevation");
  value.elevation = C2xGetTokenInt(packetHandle, "RoadWeatherMessage", newPath);
  result = CheckLastError("RoadWeatherMessage", gkFuncRefGet, result);

  return result;
}

int SetRoadWeatherMessageCommon_PositionConfidenceSetParams(LONG packetHandle, struct RoadWeatherMessageCommon_PositionConfidenceSet value, char oldPath[])
{
  char newPath[300];
  int result;

  result = 0;

  snprintf(newPath, elcount(newPath), "%s.%s", oldPath, "pos");
  C2xSetTokenInt(packetHandle, "RoadWeatherMessage", newPath, value.pos);
  result = CheckLastError("RoadWeatherMessage", gkFuncRefGet, result);

  snprintf(newPath, elcount(newPath), "%s.%s", oldPath, "elevation");
  C2xSetTokenInt(packetHandle, "RoadWeatherMessage", newPath, value.elevation);
  result = CheckLastError("RoadWeatherMessage", gkFuncRefGet, result);

  return result;
}

int GetRoadWeatherMessageCommon_SpeedandHeadingandThrottleConfidenceParams(LONG packetHandle, struct RoadWeatherMessageCommon_SpeedandHeadingandThrottleConfidence value, char oldPath[])
{
  char newPath[300];
  int result;

  result = 0;

  snprintf(newPath, elcount(newPath), "%s.%s", oldPath, "heading");
  value.heading = C2xGetTokenInt(packetHandle, "RoadWeatherMessage", newPath);
  result = CheckLastError("RoadWeatherMessage", gkFuncRefGet, result);

  snprintf(newPath, elcount(newPath), "%s.%s", oldPath, "speed");
  value.speed = C2xGetTokenInt(packetHandle, "RoadWeatherMessage", newPath);
  result = CheckLastError("RoadWeatherMessage", gkFuncRefGet, result);

  snprintf(newPath, elcount(newPath), "%s.%s", oldPath, "throttle");
  value.throttle = C2xGetTokenInt(packetHandle, "RoadWeatherMessage", newPath);
  result = CheckLastError("RoadWeatherMessage", gkFuncRefGet, result);

  return result;
}

int SetRoadWeatherMessageCommon_SpeedandHeadingandThrottleConfidenceParams(LONG packetHandle, struct RoadWeatherMessageCommon_SpeedandHeadingandThrottleConfidence value, char oldPath[])
{
  char newPath[300];
  int result;

  result = 0;

  snprintf(newPath, elcount(newPath), "%s.%s", oldPath, "heading");
  C2xSetTokenInt(packetHandle, "RoadWeatherMessage", newPath, value.heading);
  result = CheckLastError("RoadWeatherMessage", gkFuncRefGet, result);

  snprintf(newPath, elcount(newPath), "%s.%s", oldPath, "speed");
  C2xSetTokenInt(packetHandle, "RoadWeatherMessage", newPath, value.speed);
  result = CheckLastError("RoadWeatherMessage", gkFuncRefGet, result);

  snprintf(newPath, elcount(newPath), "%s.%s", oldPath, "throttle");
  C2xSetTokenInt(packetHandle, "RoadWeatherMessage", newPath, value.throttle);
  result = CheckLastError("RoadWeatherMessage", gkFuncRefGet, result);

  return result;
}

int GetRoadWeatherMessageCommon_FullPositionVectorParams(LONG packetHandle, struct RoadWeatherMessageCommon_FullPositionVector value, char oldPath[])
{
  char newPath[300];
  int result;

  result = 0;

  snprintf(newPath, elcount(newPath), "%s.%s", oldPath, "utcTime");
  value.utcTime.isValidFlag = C2xIsTokenAvailable(packetHandle, "RoadWeatherMessage", newPath);
  if(value.utcTime.isValidFlag==1)
  {
    GetRoadWeatherMessageCommon_DDateTimeParams(packetHandle, value.utcTime, newPath);
    result = CheckLastError("RoadWeatherMessage", gkFuncRefGet, result);
  }
  snprintf(newPath, elcount(newPath), "%s.%s", oldPath, "lon");
  value.lon = C2xGetTokenInt(packetHandle, "RoadWeatherMessage", newPath);
  result = CheckLastError("RoadWeatherMessage", gkFuncRefGet, result);

  snprintf(newPath, elcount(newPath), "%s.%s", oldPath, "lat");
  value.lat = C2xGetTokenInt(packetHandle, "RoadWeatherMessage", newPath);
  result = CheckLastError("RoadWeatherMessage", gkFuncRefGet, result);

  snprintf(newPath, elcount(newPath), "%s.%s", oldPath, "elevation");
  value.elevation.isValidFlag = C2xIsTokenAvailable(packetHandle, "RoadWeatherMessage", newPath);
  if(value.elevation.isValidFlag==1)
  {
    value.elevation.value = C2xGetTokenInt(packetHandle, "RoadWeatherMessage", newPath);
    result = CheckLastError("RoadWeatherMessage", gkFuncRefGet, result);
  }
  snprintf(newPath, elcount(newPath), "%s.%s", oldPath, "heading");
  value.heading.isValidFlag = C2xIsTokenAvailable(packetHandle, "RoadWeatherMessage", newPath);
  if(value.heading.isValidFlag==1)
  {
    value.heading.value = C2xGetTokenInt(packetHandle, "RoadWeatherMessage", newPath);
    result = CheckLastError("RoadWeatherMessage", gkFuncRefGet, result);
  }
  snprintf(newPath, elcount(newPath), "%s.%s", oldPath, "speed");
  value.speed.isValidFlag = C2xIsTokenAvailable(packetHandle, "RoadWeatherMessage", newPath);
  if(value.speed.isValidFlag==1)
  {
    GetRoadWeatherMessageCommon_TransmissionAndSpeedParams(packetHandle, value.speed, newPath);
    result = CheckLastError("RoadWeatherMessage", gkFuncRefGet, result);
  }
  snprintf(newPath, elcount(newPath), "%s.%s", oldPath, "posAccuracy");
  value.posAccuracy.isValidFlag = C2xIsTokenAvailable(packetHandle, "RoadWeatherMessage", newPath);
  if(value.posAccuracy.isValidFlag==1)
  {
    GetRoadWeatherMessageCommon_PositionalAccuracyParams(packetHandle, value.posAccuracy, newPath);
    result = CheckLastError("RoadWeatherMessage", gkFuncRefGet, result);
  }
  snprintf(newPath, elcount(newPath), "%s.%s", oldPath, "timeConfidence");
  value.timeConfidence.isValidFlag = C2xIsTokenAvailable(packetHandle, "RoadWeatherMessage", newPath);
  if(value.timeConfidence.isValidFlag==1)
  {
    value.timeConfidence.value = C2xGetTokenInt(packetHandle, "RoadWeatherMessage", newPath);
    result = CheckLastError("RoadWeatherMessage", gkFuncRefGet, result);
  }
  snprintf(newPath, elcount(newPath), "%s.%s", oldPath, "posConfidence");
  value.posConfidence.isValidFlag = C2xIsTokenAvailable(packetHandle, "RoadWeatherMessage", newPath);
  if(value.posConfidence.isValidFlag==1)
  {
    GetRoadWeatherMessageCommon_PositionConfidenceSetParams(packetHandle, value.posConfidence, newPath);
    result = CheckLastError("RoadWeatherMessage", gkFuncRefGet, result);
  }
  snprintf(newPath, elcount(newPath), "%s.%s", oldPath, "speedConfidence");
  value.speedConfidence.isValidFlag = C2xIsTokenAvailable(packetHandle, "RoadWeatherMessage", newPath);
  if(value.speedConfidence.isValidFlag==1)
  {
    GetRoadWeatherMessageCommon_SpeedandHeadingandThrottleConfidenceParams(packetHandle, value.speedConfidence, newPath);
    result = CheckLastError("RoadWeatherMessage", gkFuncRefGet, result);
  }
  return result;
}

int SetRoadWeatherMessageCommon_FullPositionVectorParams(LONG packetHandle, struct RoadWeatherMessageCommon_FullPositionVector value, char oldPath[])
{
  char newPath[300];
  int result;

  result = 0;

  snprintf(newPath, elcount(newPath), "%s.%s", oldPath, "utcTime");
  if(value.utcTime.isValidFlag==1)
  {
    SetRoadWeatherMessageCommon_DDateTimeParams(packetHandle, value.utcTime, newPath);
    result = CheckLastError("RoadWeatherMessage", gkFuncRefGet, result);
  }
  else
  {
    if( C2xIsTokenAvailable(packetHandle, "RoadWeatherMessage", newPath) )
    {
      C2xRemoveToken(packetHandle, "RoadWeatherMessage", newPath);
    }
  }

  snprintf(newPath, elcount(newPath), "%s.%s", oldPath, "lon");
  C2xSetTokenInt(packetHandle, "RoadWeatherMessage", newPath, value.lon);
  result = CheckLastError("RoadWeatherMessage", gkFuncRefGet, result);

  snprintf(newPath, elcount(newPath), "%s.%s", oldPath, "lat");
  C2xSetTokenInt(packetHandle, "RoadWeatherMessage", newPath, value.lat);
  result = CheckLastError("RoadWeatherMessage", gkFuncRefGet, result);

  snprintf(newPath, elcount(newPath), "%s.%s", oldPath, "elevation");
  if(value.elevation.isValidFlag==1)
  {
    C2xSetTokenInt(packetHandle, "RoadWeatherMessage", newPath, value.elevation.value);
    result = CheckLastError("RoadWeatherMessage", gkFuncRefGet, result);
  }
  else
  {
    if( C2xIsTokenAvailable(packetHandle, "RoadWeatherMessage", newPath) )
    {
      C2xRemoveToken(packetHandle, "RoadWeatherMessage", newPath);
    }
  }

  snprintf(newPath, elcount(newPath), "%s.%s", oldPath, "heading");
  if(value.heading.isValidFlag==1)
  {
    C2xSetTokenInt(packetHandle, "RoadWeatherMessage", newPath, value.heading.value);
    result = CheckLastError("RoadWeatherMessage", gkFuncRefGet, result);
  }
  else
  {
    if( C2xIsTokenAvailable(packetHandle, "RoadWeatherMessage", newPath) )
    {
      C2xRemoveToken(packetHandle, "RoadWeatherMessage", newPath);
    }
  }

  snprintf(newPath, elcount(newPath), "%s.%s", oldPath, "speed");
  if(value.speed.isValidFlag==1)
  {
    SetRoadWeatherMessageCommon_TransmissionAndSpeedParams(packetHandle, value.speed, newPath);
    result = CheckLastError("RoadWeatherMessage", gkFuncRefGet, result);
  }
  else
  {
    if( C2xIsTokenAvailable(packetHandle, "RoadWeatherMessage", newPath) )
    {
      C2xRemoveToken(packetHandle, "RoadWeatherMessage", newPath);
    }
  }

  snprintf(newPath, elcount(newPath), "%s.%s", oldPath, "posAccuracy");
  if(value.posAccuracy.isValidFlag==1)
  {
    SetRoadWeatherMessageCommon_PositionalAccuracyParams(packetHandle, value.posAccuracy, newPath);
    result = CheckLastError("RoadWeatherMessage", gkFuncRefGet, result);
  }
  else
  {
    if( C2xIsTokenAvailable(packetHandle, "RoadWeatherMessage", newPath) )
    {
      C2xRemoveToken(packetHandle, "RoadWeatherMessage", newPath);
    }
  }

  snprintf(newPath, elcount(newPath), "%s.%s", oldPath, "timeConfidence");
  if(value.timeConfidence.isValidFlag==1)
  {
    C2xSetTokenInt(packetHandle, "RoadWeatherMessage", newPath, value.timeConfidence.value);
    result = CheckLastError("RoadWeatherMessage", gkFuncRefGet, result);
  }
  else
  {
    if( C2xIsTokenAvailable(packetHandle, "RoadWeatherMessage", newPath) )
    {
      C2xRemoveToken(packetHandle, "RoadWeatherMessage", newPath);
    }
  }

  snprintf(newPath, elcount(newPath), "%s.%s", oldPath, "posConfidence");
  if(value.posConfidence.isValidFlag==1)
  {
    SetRoadWeatherMessageCommon_PositionConfidenceSetParams(packetHandle, value.posConfidence, newPath);
    result = CheckLastError("RoadWeatherMessage", gkFuncRefGet, result);
  }
  else
  {
    if( C2xIsTokenAvailable(packetHandle, "RoadWeatherMessage", newPath) )
    {
      C2xRemoveToken(packetHandle, "RoadWeatherMessage", newPath);
    }
  }

  snprintf(newPath, elcount(newPath), "%s.%s", oldPath, "speedConfidence");
  if(value.speedConfidence.isValidFlag==1)
  {
    SetRoadWeatherMessageCommon_SpeedandHeadingandThrottleConfidenceParams(packetHandle, value.speedConfidence, newPath);
    result = CheckLastError("RoadWeatherMessage", gkFuncRefGet, result);
  }
  else
  {
    if( C2xIsTokenAvailable(packetHandle, "RoadWeatherMessage", newPath) )
    {
      C2xRemoveToken(packetHandle, "RoadWeatherMessage", newPath);
    }
  }

  return result;
}

int GetRoadWeatherMessageCommon_PathHistoryPointParams(LONG packetHandle, struct RoadWeatherMessageCommon_PathHistoryPoint value, char oldPath[])
{
  char newPath[300];
  int result;

  result = 0;

  snprintf(newPath, elcount(newPath), "%s.%s", oldPath, "latOffset");
  value.latOffset = C2xGetTokenInt(packetHandle, "RoadWeatherMessage", newPath);
  result = CheckLastError("RoadWeatherMessage", gkFuncRefGet, result);

  snprintf(newPath, elcount(newPath), "%s.%s", oldPath, "lonOffset");
  value.lonOffset = C2xGetTokenInt(packetHandle, "RoadWeatherMessage", newPath);
  result = CheckLastError("RoadWeatherMessage", gkFuncRefGet, result);

  snprintf(newPath, elcount(newPath), "%s.%s", oldPath, "elevationOffset");
  value.elevationOffset = C2xGetTokenInt(packetHandle, "RoadWeatherMessage", newPath);
  result = CheckLastError("RoadWeatherMessage", gkFuncRefGet, result);

  snprintf(newPath, elcount(newPath), "%s.%s", oldPath, "timeOffset");
  value.timeOffset = C2xGetTokenInt(packetHandle, "RoadWeatherMessage", newPath);
  result = CheckLastError("RoadWeatherMessage", gkFuncRefGet, result);

  snprintf(newPath, elcount(newPath), "%s.%s", oldPath, "speed");
  value.speed.isValidFlag = C2xIsTokenAvailable(packetHandle, "RoadWeatherMessage", newPath);
  if(value.speed.isValidFlag==1)
  {
    value.speed.value = C2xGetTokenInt(packetHandle, "RoadWeatherMessage", newPath);
    result = CheckLastError("RoadWeatherMessage", gkFuncRefGet, result);
  }
  snprintf(newPath, elcount(newPath), "%s.%s", oldPath, "posAccuracy");
  value.posAccuracy.isValidFlag = C2xIsTokenAvailable(packetHandle, "RoadWeatherMessage", newPath);
  if(value.posAccuracy.isValidFlag==1)
  {
    GetRoadWeatherMessageCommon_PositionalAccuracyParams(packetHandle, value.posAccuracy, newPath);
    result = CheckLastError("RoadWeatherMessage", gkFuncRefGet, result);
  }
  snprintf(newPath, elcount(newPath), "%s.%s", oldPath, "heading");
  value.heading.isValidFlag = C2xIsTokenAvailable(packetHandle, "RoadWeatherMessage", newPath);
  if(value.heading.isValidFlag==1)
  {
    value.heading.value = C2xGetTokenInt(packetHandle, "RoadWeatherMessage", newPath);
    result = CheckLastError("RoadWeatherMessage", gkFuncRefGet, result);
  }
  return result;
}

int SetRoadWeatherMessageCommon_PathHistoryPointParams(LONG packetHandle, struct RoadWeatherMessageCommon_PathHistoryPoint value, char oldPath[])
{
  char newPath[300];
  int result;

  result = 0;

  snprintf(newPath, elcount(newPath), "%s.%s", oldPath, "latOffset");
  C2xSetTokenInt(packetHandle, "RoadWeatherMessage", newPath, value.latOffset);
  result = CheckLastError("RoadWeatherMessage", gkFuncRefGet, result);

  snprintf(newPath, elcount(newPath), "%s.%s", oldPath, "lonOffset");
  C2xSetTokenInt(packetHandle, "RoadWeatherMessage", newPath, value.lonOffset);
  result = CheckLastError("RoadWeatherMessage", gkFuncRefGet, result);

  snprintf(newPath, elcount(newPath), "%s.%s", oldPath, "elevationOffset");
  C2xSetTokenInt(packetHandle, "RoadWeatherMessage", newPath, value.elevationOffset);
  result = CheckLastError("RoadWeatherMessage", gkFuncRefGet, result);

  snprintf(newPath, elcount(newPath), "%s.%s", oldPath, "timeOffset");
  if (value.timeOffset < 1)
  {
    C2xSetTokenInt(packetHandle, "RoadWeatherMessage", newPath, 1);
  }
  else if (value.timeOffset > 65535)
  {
    C2xSetTokenInt(packetHandle, "RoadWeatherMessage", newPath, 65535);
  }
  else
  {
    C2xSetTokenInt(packetHandle, "RoadWeatherMessage", newPath, value.timeOffset);
  }
  result = CheckLastError("RoadWeatherMessage", gkFuncRefGet, result);

  snprintf(newPath, elcount(newPath), "%s.%s", oldPath, "speed");
  if(value.speed.isValidFlag==1)
  {
    C2xSetTokenInt(packetHandle, "RoadWeatherMessage", newPath, value.speed.value);
    result = CheckLastError("RoadWeatherMessage", gkFuncRefGet, result);
  }
  else
  {
    if( C2xIsTokenAvailable(packetHandle, "RoadWeatherMessage", newPath) )
    {
      C2xRemoveToken(packetHandle, "RoadWeatherMessage", newPath);
    }
  }

  snprintf(newPath, elcount(newPath), "%s.%s", oldPath, "posAccuracy");
  if(value.posAccuracy.isValidFlag==1)
  {
    SetRoadWeatherMessageCommon_PositionalAccuracyParams(packetHandle, value.posAccuracy, newPath);
    result = CheckLastError("RoadWeatherMessage", gkFuncRefGet, result);
  }
  else
  {
    if( C2xIsTokenAvailable(packetHandle, "RoadWeatherMessage", newPath) )
    {
      C2xRemoveToken(packetHandle, "RoadWeatherMessage", newPath);
    }
  }

  snprintf(newPath, elcount(newPath), "%s.%s", oldPath, "heading");
  if(value.heading.isValidFlag==1)
  {
    C2xSetTokenInt(packetHandle, "RoadWeatherMessage", newPath, value.heading.value);
    result = CheckLastError("RoadWeatherMessage", gkFuncRefGet, result);
  }
  else
  {
    if( C2xIsTokenAvailable(packetHandle, "RoadWeatherMessage", newPath) )
    {
      C2xRemoveToken(packetHandle, "RoadWeatherMessage", newPath);
    }
  }

  return result;
}

int GetRoadWeatherMessageCommon_PathHistoryPointListParams(LONG packetHandle, struct RoadWeatherMessageCommon_PathHistoryPointList value, char oldPath[])
{
  char newPath[300]; 
  int i;
  int result;

  result = 0;

  value.length = C2xGetTokenInt(packetHandle, "RoadWeatherMessage", oldPath);
  if((result = CheckLastError("RoadWeatherMessage", gkFuncRefGet, result))==0)
  {
    for(i=0; i<value.length; i++)
    {
      snprintf(newPath, elcount(newPath), "%s[%d]", oldPath, i);
      GetRoadWeatherMessageCommon_PathHistoryPointParams(packetHandle, value.arrayValue[i], newPath);
      result = CheckLastError("RoadWeatherMessage", gkFuncRefGet, result);
    }
  }
  return result;
}

int SetRoadWeatherMessageCommon_PathHistoryPointListParams(LONG packetHandle, struct RoadWeatherMessageCommon_PathHistoryPointList value, char oldPath[])
{
  char newPath[300]; 
  int i;
  int result;

  result = 0;

  C2xRemoveToken(packetHandle, "RoadWeatherMessage", oldPath);
  for(i=0; i<value.length; i++)
  {
    snprintf(newPath, elcount(newPath), "%s[%d]", oldPath, i);
    SetRoadWeatherMessageCommon_PathHistoryPointParams(packetHandle, value.arrayValue[i], newPath);
    result = CheckLastError("RoadWeatherMessage", gkFuncRefGet, result);
  }
  return result;
}

int GetRoadWeatherMessageCommon_PathHistoryParams(LONG packetHandle, struct RoadWeatherMessageCommon_PathHistory value, char oldPath[])
{
  char newPath[300]; 
  int j; 
  int k;
  int result;

  result = 0;

  snprintf(newPath, elcount(newPath), "%s.%s", oldPath, "initialPosition");
  value.initialPosition.isValidFlag = C2xIsTokenAvailable(packetHandle, "RoadWeatherMessage", newPath);
  if(value.initialPosition.isValidFlag==1)
  {
    GetRoadWeatherMessageCommon_FullPositionVectorParams(packetHandle, value.initialPosition, newPath);
    result = CheckLastError("RoadWeatherMessage", gkFuncRefGet, result);
  }
  snprintf(newPath, elcount(newPath), "%s.%s", oldPath, "currGNSSstatus");
  value.currGNSSstatus.isValidFlag = C2xIsTokenAvailable(packetHandle, "RoadWeatherMessage", newPath);
  if(value.currGNSSstatus.isValidFlag==1)
  {
    value.currGNSSstatus.isValidFlag = 1;
    value.currGNSSstatus.stringLength = C2xGetTokenLengthBit(packetHandle, "RoadWeatherMessage", newPath);
    if ((result = CheckLastError("RoadWeatherMessage", gkFuncRefGet, result))==0)
    {
      if(value.currGNSSstatus.stringLength > 0)
      {
        for(j=0; j<value.currGNSSstatus.stringLength; j++)
        {
          if(C2xGetTokenBitOfBitString(packetHandle, "RoadWeatherMessage", newPath, j) == 0)
          {
            value.currGNSSstatus.string[j] = '0';
          }
          else if(C2xGetTokenBitOfBitString(packetHandle, "RoadWeatherMessage", newPath, j) == 1)
          {
            value.currGNSSstatus.string[j] = '1';
          }

          if(value.currGNSSstatus.stringLength == 1)
          {
            value.currGNSSstatus.string[1] = '0';
          }
          result = CheckLastError("RoadWeatherMessage", gkFuncRefGet, result);
        }
      }
      else
      {
        for(k = value.currGNSSstatus.stringLength+1; k > -1; k--)
        {
          if(value.currGNSSstatus.string[k] == '1')
          {
            value.currGNSSstatus.string[k] = '0';
          }
        }
      }
    }

  }
  snprintf(newPath, elcount(newPath), "%s.%s", oldPath, "crumbData");
  GetRoadWeatherMessageCommon_PathHistoryPointListParams(packetHandle, value.crumbData, newPath);
  result = CheckLastError("RoadWeatherMessage", gkFuncRefGet, result);

  return result;
}

int SetRoadWeatherMessageCommon_PathHistoryParams(LONG packetHandle, struct RoadWeatherMessageCommon_PathHistory value, char oldPath[])
{
  char newPath[300]; 
  int j;
  int result;

  result = 0;

  snprintf(newPath, elcount(newPath), "%s.%s", oldPath, "initialPosition");
  if(value.initialPosition.isValidFlag==1)
  {
    SetRoadWeatherMessageCommon_FullPositionVectorParams(packetHandle, value.initialPosition, newPath);
    result = CheckLastError("RoadWeatherMessage", gkFuncRefGet, result);
  }
  else
  {
    if( C2xIsTokenAvailable(packetHandle, "RoadWeatherMessage", newPath) )
    {
      C2xRemoveToken(packetHandle, "RoadWeatherMessage", newPath);
    }
  }

  snprintf(newPath, elcount(newPath), "%s.%s", oldPath, "currGNSSstatus");
  if(value.currGNSSstatus.isValidFlag==1)
  {
      for(j=0; j<value.currGNSSstatus.stringLength; j++)
      {
        if(value.currGNSSstatus.string[j] == '0')
        {
          C2xSetTokenBitOfBitString(packetHandle, "RoadWeatherMessage", newPath, j, 0);
        }
        else
        {
          C2xSetTokenBitOfBitString(packetHandle, "RoadWeatherMessage", newPath, j, 1);
        }
        result = CheckLastError("RoadWeatherMessage", gkFuncRefGet, result);
      }
  }
  else
  {
    if( C2xIsTokenAvailable(packetHandle, "RoadWeatherMessage", newPath) )
    {
      C2xRemoveToken(packetHandle, "RoadWeatherMessage", newPath);
    }
  }

  snprintf(newPath, elcount(newPath), "%s.%s", oldPath, "crumbData");
  SetRoadWeatherMessageCommon_PathHistoryPointListParams(packetHandle, value.crumbData, newPath);
  result = CheckLastError("RoadWeatherMessage", gkFuncRefGet, result);

  return result;
}

int GetRoadWeatherMessageCommon_PathPredictionParams(LONG packetHandle, struct RoadWeatherMessageCommon_PathPrediction value, char oldPath[])
{
  char newPath[300];
  int result;

  result = 0;

  snprintf(newPath, elcount(newPath), "%s.%s", oldPath, "radiusOfCurve");
  value.radiusOfCurve = C2xGetTokenInt(packetHandle, "RoadWeatherMessage", newPath);
  result = CheckLastError("RoadWeatherMessage", gkFuncRefGet, result);

  snprintf(newPath, elcount(newPath), "%s.%s", oldPath, "confidence");
  value.confidence = C2xGetTokenInt(packetHandle, "RoadWeatherMessage", newPath);
  result = CheckLastError("RoadWeatherMessage", gkFuncRefGet, result);

  return result;
}

int SetRoadWeatherMessageCommon_PathPredictionParams(LONG packetHandle, struct RoadWeatherMessageCommon_PathPrediction value, char oldPath[])
{
  char newPath[300];
  int result;

  result = 0;

  snprintf(newPath, elcount(newPath), "%s.%s", oldPath, "radiusOfCurve");
  C2xSetTokenInt(packetHandle, "RoadWeatherMessage", newPath, value.radiusOfCurve);
  result = CheckLastError("RoadWeatherMessage", gkFuncRefGet, result);

  snprintf(newPath, elcount(newPath), "%s.%s", oldPath, "confidence");
  C2xSetTokenInt(packetHandle, "RoadWeatherMessage", newPath, value.confidence);
  result = CheckLastError("RoadWeatherMessage", gkFuncRefGet, result);

  return result;
}

int GetRoadWeatherMessageCommon_VehicleSafetyExtensionsParams(LONG packetHandle, struct RoadWeatherMessageCommon_VehicleSafetyExtensions value, char oldPath[])
{
  char newPath[300]; 
  int j; 
  int k;
  int result;

  result = 0;

  snprintf(newPath, elcount(newPath), "%s.%s", oldPath, "events");
  value.events.isValidFlag = C2xIsTokenAvailable(packetHandle, "RoadWeatherMessage", newPath);
  if(value.events.isValidFlag==1)
  {
    value.events.isValidFlag = 1;
    value.events.stringLength = C2xGetTokenLengthBit(packetHandle, "RoadWeatherMessage", newPath);
    if ((result = CheckLastError("RoadWeatherMessage", gkFuncRefGet, result))==0)
    {
      if(value.events.stringLength > 0)
      {
        for(j=0; j<value.events.stringLength; j++)
        {
          if(C2xGetTokenBitOfBitString(packetHandle, "RoadWeatherMessage", newPath, j) == 0)
          {
            value.events.string[j] = '0';
          }
          else if(C2xGetTokenBitOfBitString(packetHandle, "RoadWeatherMessage", newPath, j) == 1)
          {
            value.events.string[j] = '1';
          }

          if(value.events.stringLength == 1)
          {
            value.events.string[1] = '0';
          }
          result = CheckLastError("RoadWeatherMessage", gkFuncRefGet, result);
        }
      }
      else
      {
        for(k = value.events.stringLength+1; k > -1; k--)
        {
          if(value.events.string[k] == '1')
          {
            value.events.string[k] = '0';
          }
        }
      }
    }

  }
  snprintf(newPath, elcount(newPath), "%s.%s", oldPath, "pathHistory");
  value.pathHistory.isValidFlag = C2xIsTokenAvailable(packetHandle, "RoadWeatherMessage", newPath);
  if(value.pathHistory.isValidFlag==1)
  {
    GetRoadWeatherMessageCommon_PathHistoryParams(packetHandle, value.pathHistory, newPath);
    result = CheckLastError("RoadWeatherMessage", gkFuncRefGet, result);
  }
  snprintf(newPath, elcount(newPath), "%s.%s", oldPath, "pathPrediction");
  value.pathPrediction.isValidFlag = C2xIsTokenAvailable(packetHandle, "RoadWeatherMessage", newPath);
  if(value.pathPrediction.isValidFlag==1)
  {
    GetRoadWeatherMessageCommon_PathPredictionParams(packetHandle, value.pathPrediction, newPath);
    result = CheckLastError("RoadWeatherMessage", gkFuncRefGet, result);
  }
  snprintf(newPath, elcount(newPath), "%s.%s", oldPath, "lights");
  value.lights.isValidFlag = C2xIsTokenAvailable(packetHandle, "RoadWeatherMessage", newPath);
  if(value.lights.isValidFlag==1)
  {
    value.lights.isValidFlag = 1;
    value.lights.stringLength = C2xGetTokenLengthBit(packetHandle, "RoadWeatherMessage", newPath);
    if ((result = CheckLastError("RoadWeatherMessage", gkFuncRefGet, result))==0)
    {
      if(value.lights.stringLength > 0)
      {
        for(j=0; j<value.lights.stringLength; j++)
        {
          if(C2xGetTokenBitOfBitString(packetHandle, "RoadWeatherMessage", newPath, j) == 0)
          {
            value.lights.string[j] = '0';
          }
          else if(C2xGetTokenBitOfBitString(packetHandle, "RoadWeatherMessage", newPath, j) == 1)
          {
            value.lights.string[j] = '1';
          }

          if(value.lights.stringLength == 1)
          {
            value.lights.string[1] = '0';
          }
          result = CheckLastError("RoadWeatherMessage", gkFuncRefGet, result);
        }
      }
      else
      {
        for(k = value.lights.stringLength+1; k > -1; k--)
        {
          if(value.lights.string[k] == '1')
          {
            value.lights.string[k] = '0';
          }
        }
      }
    }

  }
  return result;
}

int SetRoadWeatherMessageCommon_VehicleSafetyExtensionsParams(LONG packetHandle, struct RoadWeatherMessageCommon_VehicleSafetyExtensions value, char oldPath[])
{
  char newPath[300]; 
  int j;
  int result;

  result = 0;

  snprintf(newPath, elcount(newPath), "%s.%s", oldPath, "events");
  if(value.events.isValidFlag==1)
  {
      for(j=0; j<value.events.stringLength; j++)
      {
        if(value.events.string[j] == '0')
        {
          C2xSetTokenBitOfBitString(packetHandle, "RoadWeatherMessage", newPath, j, 0);
        }
        else
        {
          C2xSetTokenBitOfBitString(packetHandle, "RoadWeatherMessage", newPath, j, 1);
        }
        result = CheckLastError("RoadWeatherMessage", gkFuncRefGet, result);
      }
  }
  else
  {
    if( C2xIsTokenAvailable(packetHandle, "RoadWeatherMessage", newPath) )
    {
      C2xRemoveToken(packetHandle, "RoadWeatherMessage", newPath);
    }
  }

  snprintf(newPath, elcount(newPath), "%s.%s", oldPath, "pathHistory");
  if(value.pathHistory.isValidFlag==1)
  {
    SetRoadWeatherMessageCommon_PathHistoryParams(packetHandle, value.pathHistory, newPath);
    result = CheckLastError("RoadWeatherMessage", gkFuncRefGet, result);
  }
  else
  {
    if( C2xIsTokenAvailable(packetHandle, "RoadWeatherMessage", newPath) )
    {
      C2xRemoveToken(packetHandle, "RoadWeatherMessage", newPath);
    }
  }

  snprintf(newPath, elcount(newPath), "%s.%s", oldPath, "pathPrediction");
  if(value.pathPrediction.isValidFlag==1)
  {
    SetRoadWeatherMessageCommon_PathPredictionParams(packetHandle, value.pathPrediction, newPath);
    result = CheckLastError("RoadWeatherMessage", gkFuncRefGet, result);
  }
  else
  {
    if( C2xIsTokenAvailable(packetHandle, "RoadWeatherMessage", newPath) )
    {
      C2xRemoveToken(packetHandle, "RoadWeatherMessage", newPath);
    }
  }

  snprintf(newPath, elcount(newPath), "%s.%s", oldPath, "lights");
  if(value.lights.isValidFlag==1)
  {
      for(j=0; j<value.lights.stringLength; j++)
      {
        if(value.lights.string[j] == '0')
        {
          C2xSetTokenBitOfBitString(packetHandle, "RoadWeatherMessage", newPath, j, 0);
        }
        else
        {
          C2xSetTokenBitOfBitString(packetHandle, "RoadWeatherMessage", newPath, j, 1);
        }
        result = CheckLastError("RoadWeatherMessage", gkFuncRefGet, result);
      }
  }
  else
  {
    if( C2xIsTokenAvailable(packetHandle, "RoadWeatherMessage", newPath) )
    {
      C2xRemoveToken(packetHandle, "RoadWeatherMessage", newPath);
    }
  }

  return result;
}

int GetRoadWeatherMessageCommon_WiperSetParams(LONG packetHandle, struct RoadWeatherMessageCommon_WiperSet value, char oldPath[])
{
  char newPath[300];
  int result;

  result = 0;

  snprintf(newPath, elcount(newPath), "%s.%s", oldPath, "statusFront");
  value.statusFront = C2xGetTokenInt(packetHandle, "RoadWeatherMessage", newPath);
  result = CheckLastError("RoadWeatherMessage", gkFuncRefGet, result);

  snprintf(newPath, elcount(newPath), "%s.%s", oldPath, "rateFront");
  value.rateFront = C2xGetTokenInt(packetHandle, "RoadWeatherMessage", newPath);
  result = CheckLastError("RoadWeatherMessage", gkFuncRefGet, result);

  snprintf(newPath, elcount(newPath), "%s.%s", oldPath, "statusRear");
  value.statusRear.isValidFlag = C2xIsTokenAvailable(packetHandle, "RoadWeatherMessage", newPath);
  if(value.statusRear.isValidFlag==1)
  {
    value.statusRear.value = C2xGetTokenInt(packetHandle, "RoadWeatherMessage", newPath);
    result = CheckLastError("RoadWeatherMessage", gkFuncRefGet, result);
  }
  snprintf(newPath, elcount(newPath), "%s.%s", oldPath, "rateRear");
  value.rateRear.isValidFlag = C2xIsTokenAvailable(packetHandle, "RoadWeatherMessage", newPath);
  if(value.rateRear.isValidFlag==1)
  {
    value.rateRear.value = C2xGetTokenInt(packetHandle, "RoadWeatherMessage", newPath);
    result = CheckLastError("RoadWeatherMessage", gkFuncRefGet, result);
  }
  return result;
}

int SetRoadWeatherMessageCommon_WiperSetParams(LONG packetHandle, struct RoadWeatherMessageCommon_WiperSet value, char oldPath[])
{
  char newPath[300];
  int result;

  result = 0;

  snprintf(newPath, elcount(newPath), "%s.%s", oldPath, "statusFront");
  C2xSetTokenInt(packetHandle, "RoadWeatherMessage", newPath, value.statusFront);
  result = CheckLastError("RoadWeatherMessage", gkFuncRefGet, result);

  snprintf(newPath, elcount(newPath), "%s.%s", oldPath, "rateFront");
  C2xSetTokenInt(packetHandle, "RoadWeatherMessage", newPath, value.rateFront);
  result = CheckLastError("RoadWeatherMessage", gkFuncRefGet, result);

  snprintf(newPath, elcount(newPath), "%s.%s", oldPath, "statusRear");
  if(value.statusRear.isValidFlag==1)
  {
    C2xSetTokenInt(packetHandle, "RoadWeatherMessage", newPath, value.statusRear.value);
    result = CheckLastError("RoadWeatherMessage", gkFuncRefGet, result);
  }
  else
  {
    if( C2xIsTokenAvailable(packetHandle, "RoadWeatherMessage", newPath) )
    {
      C2xRemoveToken(packetHandle, "RoadWeatherMessage", newPath);
    }
  }

  snprintf(newPath, elcount(newPath), "%s.%s", oldPath, "rateRear");
  if(value.rateRear.isValidFlag==1)
  {
    C2xSetTokenInt(packetHandle, "RoadWeatherMessage", newPath, value.rateRear.value);
    result = CheckLastError("RoadWeatherMessage", gkFuncRefGet, result);
  }
  else
  {
    if( C2xIsTokenAvailable(packetHandle, "RoadWeatherMessage", newPath) )
    {
      C2xRemoveToken(packetHandle, "RoadWeatherMessage", newPath);
    }
  }

  return result;
}

int GetRoadWeatherMessageCommon_BrakeSystemStatusParams(LONG packetHandle, struct RoadWeatherMessageCommon_BrakeSystemStatus value, char oldPath[])
{
  char newPath[300]; 
  int j; 
  int k;
  int result;

  result = 0;

  snprintf(newPath, elcount(newPath), "%s.%s", oldPath, "wheelBrakes");
  value.wheelBrakes.isValidFlag = 1;
  value.wheelBrakes.stringLength = C2xGetTokenLengthBit(packetHandle, "RoadWeatherMessage", newPath);
  if ((result = CheckLastError("RoadWeatherMessage", gkFuncRefGet, result))==0)
  {
    if(value.wheelBrakes.stringLength > 0)
    {
      for(j=0; j<value.wheelBrakes.stringLength; j++)
      {
        if(C2xGetTokenBitOfBitString(packetHandle, "RoadWeatherMessage", newPath, j) == 0)
        {
          value.wheelBrakes.string[j] = '0';
        }
        else if(C2xGetTokenBitOfBitString(packetHandle, "RoadWeatherMessage", newPath, j) == 1)
        {
          value.wheelBrakes.string[j] = '1';
        }

        if(value.wheelBrakes.stringLength == 1)
        {
          value.wheelBrakes.string[1] = '0';
        }
        result = CheckLastError("RoadWeatherMessage", gkFuncRefGet, result);
      }
    }
    else
    {
      for(k = value.wheelBrakes.stringLength+1; k > -1; k--)
      {
        if(value.wheelBrakes.string[k] == '1')
        {
          value.wheelBrakes.string[k] = '0';
        }
      }
    }
  }

  snprintf(newPath, elcount(newPath), "%s.%s", oldPath, "traction");
  value.traction = C2xGetTokenInt(packetHandle, "RoadWeatherMessage", newPath);
  result = CheckLastError("RoadWeatherMessage", gkFuncRefGet, result);

  snprintf(newPath, elcount(newPath), "%s.%s", oldPath, "antiLockBrake");
  value.antiLockBrake = C2xGetTokenInt(packetHandle, "RoadWeatherMessage", newPath);
  result = CheckLastError("RoadWeatherMessage", gkFuncRefGet, result);

  snprintf(newPath, elcount(newPath), "%s.%s", oldPath, "scs");
  value.scs = C2xGetTokenInt(packetHandle, "RoadWeatherMessage", newPath);
  result = CheckLastError("RoadWeatherMessage", gkFuncRefGet, result);

  snprintf(newPath, elcount(newPath), "%s.%s", oldPath, "brakeBoost");
  value.brakeBoost = C2xGetTokenInt(packetHandle, "RoadWeatherMessage", newPath);
  result = CheckLastError("RoadWeatherMessage", gkFuncRefGet, result);

  snprintf(newPath, elcount(newPath), "%s.%s", oldPath, "auxBrakes");
  value.auxBrakes = C2xGetTokenInt(packetHandle, "RoadWeatherMessage", newPath);
  result = CheckLastError("RoadWeatherMessage", gkFuncRefGet, result);

  return result;
}

int SetRoadWeatherMessageCommon_BrakeSystemStatusParams(LONG packetHandle, struct RoadWeatherMessageCommon_BrakeSystemStatus value, char oldPath[])
{
  char newPath[300]; 
  int j;
  int result;

  result = 0;

  snprintf(newPath, elcount(newPath), "%s.%s", oldPath, "wheelBrakes");
    for(j=0; j<value.wheelBrakes.stringLength; j++)
    {
      if(value.wheelBrakes.string[j] == '0')
      {
        C2xSetTokenBitOfBitString(packetHandle, "RoadWeatherMessage", newPath, j, 0);
      }
      else
      {
        C2xSetTokenBitOfBitString(packetHandle, "RoadWeatherMessage", newPath, j, 1);
      }
      result = CheckLastError("RoadWeatherMessage", gkFuncRefGet, result);
    }

  snprintf(newPath, elcount(newPath), "%s.%s", oldPath, "traction");
  C2xSetTokenInt(packetHandle, "RoadWeatherMessage", newPath, value.traction);
  result = CheckLastError("RoadWeatherMessage", gkFuncRefGet, result);

  snprintf(newPath, elcount(newPath), "%s.%s", oldPath, "antiLockBrake");
  C2xSetTokenInt(packetHandle, "RoadWeatherMessage", newPath, value.antiLockBrake);
  result = CheckLastError("RoadWeatherMessage", gkFuncRefGet, result);

  snprintf(newPath, elcount(newPath), "%s.%s", oldPath, "scs");
  C2xSetTokenInt(packetHandle, "RoadWeatherMessage", newPath, value.scs);
  result = CheckLastError("RoadWeatherMessage", gkFuncRefGet, result);

  snprintf(newPath, elcount(newPath), "%s.%s", oldPath, "brakeBoost");
  C2xSetTokenInt(packetHandle, "RoadWeatherMessage", newPath, value.brakeBoost);
  result = CheckLastError("RoadWeatherMessage", gkFuncRefGet, result);

  snprintf(newPath, elcount(newPath), "%s.%s", oldPath, "auxBrakes");
  C2xSetTokenInt(packetHandle, "RoadWeatherMessage", newPath, value.auxBrakes);
  result = CheckLastError("RoadWeatherMessage", gkFuncRefGet, result);

  return result;
}

int GetRoadWeatherMessageProbeVehicleData_VehicleStatus_steeringParams(LONG packetHandle, struct RoadWeatherMessageProbeVehicleData_VehicleStatus_steering value, char oldPath[])
{
  char newPath[300];
  int result;

  result = 0;

  snprintf(newPath, elcount(newPath), "%s.%s", oldPath, "angle");
  value.angle = C2xGetTokenInt(packetHandle, "RoadWeatherMessage", newPath);
  result = CheckLastError("RoadWeatherMessage", gkFuncRefGet, result);

  snprintf(newPath, elcount(newPath), "%s.%s", oldPath, "confidence");
  value.confidence.isValidFlag = C2xIsTokenAvailable(packetHandle, "RoadWeatherMessage", newPath);
  if(value.confidence.isValidFlag==1)
  {
    value.confidence.value = C2xGetTokenInt(packetHandle, "RoadWeatherMessage", newPath);
    result = CheckLastError("RoadWeatherMessage", gkFuncRefGet, result);
  }
  snprintf(newPath, elcount(newPath), "%s.%s", oldPath, "rate");
  value.rate.isValidFlag = C2xIsTokenAvailable(packetHandle, "RoadWeatherMessage", newPath);
  if(value.rate.isValidFlag==1)
  {
    value.rate.value = C2xGetTokenInt(packetHandle, "RoadWeatherMessage", newPath);
    result = CheckLastError("RoadWeatherMessage", gkFuncRefGet, result);
  }
  snprintf(newPath, elcount(newPath), "%s.%s", oldPath, "wheels");
  value.wheels.isValidFlag = C2xIsTokenAvailable(packetHandle, "RoadWeatherMessage", newPath);
  if(value.wheels.isValidFlag==1)
  {
    value.wheels.value = C2xGetTokenInt(packetHandle, "RoadWeatherMessage", newPath);
    result = CheckLastError("RoadWeatherMessage", gkFuncRefGet, result);
  }
  return result;
}

int SetRoadWeatherMessageProbeVehicleData_VehicleStatus_steeringParams(LONG packetHandle, struct RoadWeatherMessageProbeVehicleData_VehicleStatus_steering value, char oldPath[])
{
  char newPath[300];
  int result;

  result = 0;

  snprintf(newPath, elcount(newPath), "%s.%s", oldPath, "angle");
  C2xSetTokenInt(packetHandle, "RoadWeatherMessage", newPath, value.angle);
  result = CheckLastError("RoadWeatherMessage", gkFuncRefGet, result);

  snprintf(newPath, elcount(newPath), "%s.%s", oldPath, "confidence");
  if(value.confidence.isValidFlag==1)
  {
    C2xSetTokenInt(packetHandle, "RoadWeatherMessage", newPath, value.confidence.value);
    result = CheckLastError("RoadWeatherMessage", gkFuncRefGet, result);
  }
  else
  {
    if( C2xIsTokenAvailable(packetHandle, "RoadWeatherMessage", newPath) )
    {
      C2xRemoveToken(packetHandle, "RoadWeatherMessage", newPath);
    }
  }

  snprintf(newPath, elcount(newPath), "%s.%s", oldPath, "rate");
  if(value.rate.isValidFlag==1)
  {
    C2xSetTokenInt(packetHandle, "RoadWeatherMessage", newPath, value.rate.value);
    result = CheckLastError("RoadWeatherMessage", gkFuncRefGet, result);
  }
  else
  {
    if( C2xIsTokenAvailable(packetHandle, "RoadWeatherMessage", newPath) )
    {
      C2xRemoveToken(packetHandle, "RoadWeatherMessage", newPath);
    }
  }

  snprintf(newPath, elcount(newPath), "%s.%s", oldPath, "wheels");
  if(value.wheels.isValidFlag==1)
  {
    C2xSetTokenInt(packetHandle, "RoadWeatherMessage", newPath, value.wheels.value);
    result = CheckLastError("RoadWeatherMessage", gkFuncRefGet, result);
  }
  else
  {
    if( C2xIsTokenAvailable(packetHandle, "RoadWeatherMessage", newPath) )
    {
      C2xRemoveToken(packetHandle, "RoadWeatherMessage", newPath);
    }
  }

  return result;
}

int GetRoadWeatherMessageCommon_AccelerationSet4WayParams(LONG packetHandle, struct RoadWeatherMessageCommon_AccelerationSet4Way value, char oldPath[])
{
  char newPath[300];
  int result;

  result = 0;

  snprintf(newPath, elcount(newPath), "%s.%s", oldPath, "lon");
  value.lon = C2xGetTokenInt(packetHandle, "RoadWeatherMessage", newPath);
  result = CheckLastError("RoadWeatherMessage", gkFuncRefGet, result);

  snprintf(newPath, elcount(newPath), "%s.%s", oldPath, "lat");
  value.lat = C2xGetTokenInt(packetHandle, "RoadWeatherMessage", newPath);
  result = CheckLastError("RoadWeatherMessage", gkFuncRefGet, result);

  snprintf(newPath, elcount(newPath), "%s.%s", oldPath, "vert");
  value.vert = C2xGetTokenInt(packetHandle, "RoadWeatherMessage", newPath);
  result = CheckLastError("RoadWeatherMessage", gkFuncRefGet, result);

  snprintf(newPath, elcount(newPath), "%s.%s", oldPath, "yaw");
  value.yaw = C2xGetTokenInt(packetHandle, "RoadWeatherMessage", newPath);
  result = CheckLastError("RoadWeatherMessage", gkFuncRefGet, result);

  return result;
}

int SetRoadWeatherMessageCommon_AccelerationSet4WayParams(LONG packetHandle, struct RoadWeatherMessageCommon_AccelerationSet4Way value, char oldPath[])
{
  char newPath[300];
  int result;

  result = 0;

  snprintf(newPath, elcount(newPath), "%s.%s", oldPath, "lon");
  C2xSetTokenInt(packetHandle, "RoadWeatherMessage", newPath, value.lon);
  result = CheckLastError("RoadWeatherMessage", gkFuncRefGet, result);

  snprintf(newPath, elcount(newPath), "%s.%s", oldPath, "lat");
  C2xSetTokenInt(packetHandle, "RoadWeatherMessage", newPath, value.lat);
  result = CheckLastError("RoadWeatherMessage", gkFuncRefGet, result);

  snprintf(newPath, elcount(newPath), "%s.%s", oldPath, "vert");
  C2xSetTokenInt(packetHandle, "RoadWeatherMessage", newPath, value.vert);
  result = CheckLastError("RoadWeatherMessage", gkFuncRefGet, result);

  snprintf(newPath, elcount(newPath), "%s.%s", oldPath, "yaw");
  C2xSetTokenInt(packetHandle, "RoadWeatherMessage", newPath, value.yaw);
  result = CheckLastError("RoadWeatherMessage", gkFuncRefGet, result);

  return result;
}

int GetRoadWeatherMessageProbeVehicleData_AccelSteerYawRateConfidenceParams(LONG packetHandle, struct RoadWeatherMessageProbeVehicleData_AccelSteerYawRateConfidence value, char oldPath[])
{
  char newPath[300];
  int result;

  result = 0;

  snprintf(newPath, elcount(newPath), "%s.%s", oldPath, "yawRate");
  value.yawRate = C2xGetTokenInt(packetHandle, "RoadWeatherMessage", newPath);
  result = CheckLastError("RoadWeatherMessage", gkFuncRefGet, result);

  snprintf(newPath, elcount(newPath), "%s.%s", oldPath, "acceleration");
  value.acceleration = C2xGetTokenInt(packetHandle, "RoadWeatherMessage", newPath);
  result = CheckLastError("RoadWeatherMessage", gkFuncRefGet, result);

  snprintf(newPath, elcount(newPath), "%s.%s", oldPath, "steeringWheelAngle");
  value.steeringWheelAngle = C2xGetTokenInt(packetHandle, "RoadWeatherMessage", newPath);
  result = CheckLastError("RoadWeatherMessage", gkFuncRefGet, result);

  return result;
}

int SetRoadWeatherMessageProbeVehicleData_AccelSteerYawRateConfidenceParams(LONG packetHandle, struct RoadWeatherMessageProbeVehicleData_AccelSteerYawRateConfidence value, char oldPath[])
{
  char newPath[300];
  int result;

  result = 0;

  snprintf(newPath, elcount(newPath), "%s.%s", oldPath, "yawRate");
  C2xSetTokenInt(packetHandle, "RoadWeatherMessage", newPath, value.yawRate);
  result = CheckLastError("RoadWeatherMessage", gkFuncRefGet, result);

  snprintf(newPath, elcount(newPath), "%s.%s", oldPath, "acceleration");
  C2xSetTokenInt(packetHandle, "RoadWeatherMessage", newPath, value.acceleration);
  result = CheckLastError("RoadWeatherMessage", gkFuncRefGet, result);

  snprintf(newPath, elcount(newPath), "%s.%s", oldPath, "steeringWheelAngle");
  C2xSetTokenInt(packetHandle, "RoadWeatherMessage", newPath, value.steeringWheelAngle);
  result = CheckLastError("RoadWeatherMessage", gkFuncRefGet, result);

  return result;
}

int GetRoadWeatherMessageProbeVehicleData_ConfidenceSetParams(LONG packetHandle, struct RoadWeatherMessageProbeVehicleData_ConfidenceSet value, char oldPath[])
{
  char newPath[300];
  int result;

  result = 0;

  snprintf(newPath, elcount(newPath), "%s.%s", oldPath, "accelConfidence");
  value.accelConfidence.isValidFlag = C2xIsTokenAvailable(packetHandle, "RoadWeatherMessage", newPath);
  if(value.accelConfidence.isValidFlag==1)
  {
    GetRoadWeatherMessageProbeVehicleData_AccelSteerYawRateConfidenceParams(packetHandle, value.accelConfidence, newPath);
    result = CheckLastError("RoadWeatherMessage", gkFuncRefGet, result);
  }
  snprintf(newPath, elcount(newPath), "%s.%s", oldPath, "speedConfidence");
  value.speedConfidence.isValidFlag = C2xIsTokenAvailable(packetHandle, "RoadWeatherMessage", newPath);
  if(value.speedConfidence.isValidFlag==1)
  {
    GetRoadWeatherMessageCommon_SpeedandHeadingandThrottleConfidenceParams(packetHandle, value.speedConfidence, newPath);
    result = CheckLastError("RoadWeatherMessage", gkFuncRefGet, result);
  }
  snprintf(newPath, elcount(newPath), "%s.%s", oldPath, "timeConfidence");
  value.timeConfidence.isValidFlag = C2xIsTokenAvailable(packetHandle, "RoadWeatherMessage", newPath);
  if(value.timeConfidence.isValidFlag==1)
  {
    value.timeConfidence.value = C2xGetTokenInt(packetHandle, "RoadWeatherMessage", newPath);
    result = CheckLastError("RoadWeatherMessage", gkFuncRefGet, result);
  }
  snprintf(newPath, elcount(newPath), "%s.%s", oldPath, "posConfidence");
  value.posConfidence.isValidFlag = C2xIsTokenAvailable(packetHandle, "RoadWeatherMessage", newPath);
  if(value.posConfidence.isValidFlag==1)
  {
    GetRoadWeatherMessageCommon_PositionConfidenceSetParams(packetHandle, value.posConfidence, newPath);
    result = CheckLastError("RoadWeatherMessage", gkFuncRefGet, result);
  }
  snprintf(newPath, elcount(newPath), "%s.%s", oldPath, "steerConfidence");
  value.steerConfidence.isValidFlag = C2xIsTokenAvailable(packetHandle, "RoadWeatherMessage", newPath);
  if(value.steerConfidence.isValidFlag==1)
  {
    value.steerConfidence.value = C2xGetTokenInt(packetHandle, "RoadWeatherMessage", newPath);
    result = CheckLastError("RoadWeatherMessage", gkFuncRefGet, result);
  }
  snprintf(newPath, elcount(newPath), "%s.%s", oldPath, "headingConfidence");
  value.headingConfidence.isValidFlag = C2xIsTokenAvailable(packetHandle, "RoadWeatherMessage", newPath);
  if(value.headingConfidence.isValidFlag==1)
  {
    value.headingConfidence.value = C2xGetTokenInt(packetHandle, "RoadWeatherMessage", newPath);
    result = CheckLastError("RoadWeatherMessage", gkFuncRefGet, result);
  }
  snprintf(newPath, elcount(newPath), "%s.%s", oldPath, "throttleConfidence");
  value.throttleConfidence.isValidFlag = C2xIsTokenAvailable(packetHandle, "RoadWeatherMessage", newPath);
  if(value.throttleConfidence.isValidFlag==1)
  {
    value.throttleConfidence.value = C2xGetTokenInt(packetHandle, "RoadWeatherMessage", newPath);
    result = CheckLastError("RoadWeatherMessage", gkFuncRefGet, result);
  }
  return result;
}

int SetRoadWeatherMessageProbeVehicleData_ConfidenceSetParams(LONG packetHandle, struct RoadWeatherMessageProbeVehicleData_ConfidenceSet value, char oldPath[])
{
  char newPath[300];
  int result;

  result = 0;

  snprintf(newPath, elcount(newPath), "%s.%s", oldPath, "accelConfidence");
  if(value.accelConfidence.isValidFlag==1)
  {
    SetRoadWeatherMessageProbeVehicleData_AccelSteerYawRateConfidenceParams(packetHandle, value.accelConfidence, newPath);
    result = CheckLastError("RoadWeatherMessage", gkFuncRefGet, result);
  }
  else
  {
    if( C2xIsTokenAvailable(packetHandle, "RoadWeatherMessage", newPath) )
    {
      C2xRemoveToken(packetHandle, "RoadWeatherMessage", newPath);
    }
  }

  snprintf(newPath, elcount(newPath), "%s.%s", oldPath, "speedConfidence");
  if(value.speedConfidence.isValidFlag==1)
  {
    SetRoadWeatherMessageCommon_SpeedandHeadingandThrottleConfidenceParams(packetHandle, value.speedConfidence, newPath);
    result = CheckLastError("RoadWeatherMessage", gkFuncRefGet, result);
  }
  else
  {
    if( C2xIsTokenAvailable(packetHandle, "RoadWeatherMessage", newPath) )
    {
      C2xRemoveToken(packetHandle, "RoadWeatherMessage", newPath);
    }
  }

  snprintf(newPath, elcount(newPath), "%s.%s", oldPath, "timeConfidence");
  if(value.timeConfidence.isValidFlag==1)
  {
    C2xSetTokenInt(packetHandle, "RoadWeatherMessage", newPath, value.timeConfidence.value);
    result = CheckLastError("RoadWeatherMessage", gkFuncRefGet, result);
  }
  else
  {
    if( C2xIsTokenAvailable(packetHandle, "RoadWeatherMessage", newPath) )
    {
      C2xRemoveToken(packetHandle, "RoadWeatherMessage", newPath);
    }
  }

  snprintf(newPath, elcount(newPath), "%s.%s", oldPath, "posConfidence");
  if(value.posConfidence.isValidFlag==1)
  {
    SetRoadWeatherMessageCommon_PositionConfidenceSetParams(packetHandle, value.posConfidence, newPath);
    result = CheckLastError("RoadWeatherMessage", gkFuncRefGet, result);
  }
  else
  {
    if( C2xIsTokenAvailable(packetHandle, "RoadWeatherMessage", newPath) )
    {
      C2xRemoveToken(packetHandle, "RoadWeatherMessage", newPath);
    }
  }

  snprintf(newPath, elcount(newPath), "%s.%s", oldPath, "steerConfidence");
  if(value.steerConfidence.isValidFlag==1)
  {
    C2xSetTokenInt(packetHandle, "RoadWeatherMessage", newPath, value.steerConfidence.value);
    result = CheckLastError("RoadWeatherMessage", gkFuncRefGet, result);
  }
  else
  {
    if( C2xIsTokenAvailable(packetHandle, "RoadWeatherMessage", newPath) )
    {
      C2xRemoveToken(packetHandle, "RoadWeatherMessage", newPath);
    }
  }

  snprintf(newPath, elcount(newPath), "%s.%s", oldPath, "headingConfidence");
  if(value.headingConfidence.isValidFlag==1)
  {
    C2xSetTokenInt(packetHandle, "RoadWeatherMessage", newPath, value.headingConfidence.value);
    result = CheckLastError("RoadWeatherMessage", gkFuncRefGet, result);
  }
  else
  {
    if( C2xIsTokenAvailable(packetHandle, "RoadWeatherMessage", newPath) )
    {
      C2xRemoveToken(packetHandle, "RoadWeatherMessage", newPath);
    }
  }

  snprintf(newPath, elcount(newPath), "%s.%s", oldPath, "throttleConfidence");
  if(value.throttleConfidence.isValidFlag==1)
  {
    C2xSetTokenInt(packetHandle, "RoadWeatherMessage", newPath, value.throttleConfidence.value);
    result = CheckLastError("RoadWeatherMessage", gkFuncRefGet, result);
  }
  else
  {
    if( C2xIsTokenAvailable(packetHandle, "RoadWeatherMessage", newPath) )
    {
      C2xRemoveToken(packetHandle, "RoadWeatherMessage", newPath);
    }
  }

  return result;
}

int GetRoadWeatherMessageProbeVehicleData_VehicleStatus_accelSetsParams(LONG packetHandle, struct RoadWeatherMessageProbeVehicleData_VehicleStatus_accelSets value, char oldPath[])
{
  char newPath[300]; 
  int j; 
  int k;
  int result;

  result = 0;

  snprintf(newPath, elcount(newPath), "%s.%s", oldPath, "accel4way");
  value.accel4way.isValidFlag = C2xIsTokenAvailable(packetHandle, "RoadWeatherMessage", newPath);
  if(value.accel4way.isValidFlag==1)
  {
    GetRoadWeatherMessageCommon_AccelerationSet4WayParams(packetHandle, value.accel4way, newPath);
    result = CheckLastError("RoadWeatherMessage", gkFuncRefGet, result);
  }
  snprintf(newPath, elcount(newPath), "%s.%s", oldPath, "vertAccelThres");
  value.vertAccelThres.isValidFlag = C2xIsTokenAvailable(packetHandle, "RoadWeatherMessage", newPath);
  if(value.vertAccelThres.isValidFlag==1)
  {
    value.vertAccelThres.isValidFlag = 1;
    value.vertAccelThres.stringLength = C2xGetTokenLengthBit(packetHandle, "RoadWeatherMessage", newPath);
    if ((result = CheckLastError("RoadWeatherMessage", gkFuncRefGet, result))==0)
    {
      if(value.vertAccelThres.stringLength > 0)
      {
        for(j=0; j<value.vertAccelThres.stringLength; j++)
        {
          if(C2xGetTokenBitOfBitString(packetHandle, "RoadWeatherMessage", newPath, j) == 0)
          {
            value.vertAccelThres.string[j] = '0';
          }
          else if(C2xGetTokenBitOfBitString(packetHandle, "RoadWeatherMessage", newPath, j) == 1)
          {
            value.vertAccelThres.string[j] = '1';
          }

          if(value.vertAccelThres.stringLength == 1)
          {
            value.vertAccelThres.string[1] = '0';
          }
          result = CheckLastError("RoadWeatherMessage", gkFuncRefGet, result);
        }
      }
      else
      {
        for(k = value.vertAccelThres.stringLength+1; k > -1; k--)
        {
          if(value.vertAccelThres.string[k] == '1')
          {
            value.vertAccelThres.string[k] = '0';
          }
        }
      }
    }

  }
  snprintf(newPath, elcount(newPath), "%s.%s", oldPath, "yawRateCon");
  value.yawRateCon.isValidFlag = C2xIsTokenAvailable(packetHandle, "RoadWeatherMessage", newPath);
  if(value.yawRateCon.isValidFlag==1)
  {
    value.yawRateCon.value = C2xGetTokenInt(packetHandle, "RoadWeatherMessage", newPath);
    result = CheckLastError("RoadWeatherMessage", gkFuncRefGet, result);
  }
  snprintf(newPath, elcount(newPath), "%s.%s", oldPath, "hozAccelCon");
  value.hozAccelCon.isValidFlag = C2xIsTokenAvailable(packetHandle, "RoadWeatherMessage", newPath);
  if(value.hozAccelCon.isValidFlag==1)
  {
    value.hozAccelCon.value = C2xGetTokenInt(packetHandle, "RoadWeatherMessage", newPath);
    result = CheckLastError("RoadWeatherMessage", gkFuncRefGet, result);
  }
  snprintf(newPath, elcount(newPath), "%s.%s", oldPath, "confidenceSet");
  value.confidenceSet.isValidFlag = C2xIsTokenAvailable(packetHandle, "RoadWeatherMessage", newPath);
  if(value.confidenceSet.isValidFlag==1)
  {
    GetRoadWeatherMessageProbeVehicleData_ConfidenceSetParams(packetHandle, value.confidenceSet, newPath);
    result = CheckLastError("RoadWeatherMessage", gkFuncRefGet, result);
  }
  return result;
}

int SetRoadWeatherMessageProbeVehicleData_VehicleStatus_accelSetsParams(LONG packetHandle, struct RoadWeatherMessageProbeVehicleData_VehicleStatus_accelSets value, char oldPath[])
{
  char newPath[300]; 
  int j;
  int result;

  result = 0;

  snprintf(newPath, elcount(newPath), "%s.%s", oldPath, "accel4way");
  if(value.accel4way.isValidFlag==1)
  {
    SetRoadWeatherMessageCommon_AccelerationSet4WayParams(packetHandle, value.accel4way, newPath);
    result = CheckLastError("RoadWeatherMessage", gkFuncRefGet, result);
  }
  else
  {
    if( C2xIsTokenAvailable(packetHandle, "RoadWeatherMessage", newPath) )
    {
      C2xRemoveToken(packetHandle, "RoadWeatherMessage", newPath);
    }
  }

  snprintf(newPath, elcount(newPath), "%s.%s", oldPath, "vertAccelThres");
  if(value.vertAccelThres.isValidFlag==1)
  {
      for(j=0; j<value.vertAccelThres.stringLength; j++)
      {
        if(value.vertAccelThres.string[j] == '0')
        {
          C2xSetTokenBitOfBitString(packetHandle, "RoadWeatherMessage", newPath, j, 0);
        }
        else
        {
          C2xSetTokenBitOfBitString(packetHandle, "RoadWeatherMessage", newPath, j, 1);
        }
        result = CheckLastError("RoadWeatherMessage", gkFuncRefGet, result);
      }
  }
  else
  {
    if( C2xIsTokenAvailable(packetHandle, "RoadWeatherMessage", newPath) )
    {
      C2xRemoveToken(packetHandle, "RoadWeatherMessage", newPath);
    }
  }

  snprintf(newPath, elcount(newPath), "%s.%s", oldPath, "yawRateCon");
  if(value.yawRateCon.isValidFlag==1)
  {
    C2xSetTokenInt(packetHandle, "RoadWeatherMessage", newPath, value.yawRateCon.value);
    result = CheckLastError("RoadWeatherMessage", gkFuncRefGet, result);
  }
  else
  {
    if( C2xIsTokenAvailable(packetHandle, "RoadWeatherMessage", newPath) )
    {
      C2xRemoveToken(packetHandle, "RoadWeatherMessage", newPath);
    }
  }

  snprintf(newPath, elcount(newPath), "%s.%s", oldPath, "hozAccelCon");
  if(value.hozAccelCon.isValidFlag==1)
  {
    C2xSetTokenInt(packetHandle, "RoadWeatherMessage", newPath, value.hozAccelCon.value);
    result = CheckLastError("RoadWeatherMessage", gkFuncRefGet, result);
  }
  else
  {
    if( C2xIsTokenAvailable(packetHandle, "RoadWeatherMessage", newPath) )
    {
      C2xRemoveToken(packetHandle, "RoadWeatherMessage", newPath);
    }
  }

  snprintf(newPath, elcount(newPath), "%s.%s", oldPath, "confidenceSet");
  if(value.confidenceSet.isValidFlag==1)
  {
    SetRoadWeatherMessageProbeVehicleData_ConfidenceSetParams(packetHandle, value.confidenceSet, newPath);
    result = CheckLastError("RoadWeatherMessage", gkFuncRefGet, result);
  }
  else
  {
    if( C2xIsTokenAvailable(packetHandle, "RoadWeatherMessage", newPath) )
    {
      C2xRemoveToken(packetHandle, "RoadWeatherMessage", newPath);
    }
  }

  return result;
}

int GetRoadWeatherMessageProbeVehicleData_VehicleStatus_objectParams(LONG packetHandle, struct RoadWeatherMessageProbeVehicleData_VehicleStatus_object value, char oldPath[])
{
  char newPath[300];
  int result;

  result = 0;

  snprintf(newPath, elcount(newPath), "%s.%s", oldPath, "obDist");
  value.obDist = C2xGetTokenInt(packetHandle, "RoadWeatherMessage", newPath);
  result = CheckLastError("RoadWeatherMessage", gkFuncRefGet, result);

  snprintf(newPath, elcount(newPath), "%s.%s", oldPath, "obDirect");
  value.obDirect = C2xGetTokenInt(packetHandle, "RoadWeatherMessage", newPath);
  result = CheckLastError("RoadWeatherMessage", gkFuncRefGet, result);

  snprintf(newPath, elcount(newPath), "%s.%s", oldPath, "dateTime");
  GetRoadWeatherMessageCommon_DDateTimeParams(packetHandle, value.dateTime, newPath);
  result = CheckLastError("RoadWeatherMessage", gkFuncRefGet, result);

  return result;
}

int SetRoadWeatherMessageProbeVehicleData_VehicleStatus_objectParams(LONG packetHandle, struct RoadWeatherMessageProbeVehicleData_VehicleStatus_object value, char oldPath[])
{
  char newPath[300];
  int result;

  result = 0;

  snprintf(newPath, elcount(newPath), "%s.%s", oldPath, "obDist");
  C2xSetTokenInt(packetHandle, "RoadWeatherMessage", newPath, value.obDist);
  result = CheckLastError("RoadWeatherMessage", gkFuncRefGet, result);

  snprintf(newPath, elcount(newPath), "%s.%s", oldPath, "obDirect");
  C2xSetTokenInt(packetHandle, "RoadWeatherMessage", newPath, value.obDirect);
  result = CheckLastError("RoadWeatherMessage", gkFuncRefGet, result);

  snprintf(newPath, elcount(newPath), "%s.%s", oldPath, "dateTime");
  SetRoadWeatherMessageCommon_DDateTimeParams(packetHandle, value.dateTime, newPath);
  result = CheckLastError("RoadWeatherMessage", gkFuncRefGet, result);

  return result;
}

int GetRoadWeatherMessageCommon_BumperHeightsParams(LONG packetHandle, struct RoadWeatherMessageCommon_BumperHeights value, char oldPath[])
{
  char newPath[300];
  int result;

  result = 0;

  snprintf(newPath, elcount(newPath), "%s.%s", oldPath, "front");
  value.front = C2xGetTokenInt(packetHandle, "RoadWeatherMessage", newPath);
  result = CheckLastError("RoadWeatherMessage", gkFuncRefGet, result);

  snprintf(newPath, elcount(newPath), "%s.%s", oldPath, "rear");
  value.rear = C2xGetTokenInt(packetHandle, "RoadWeatherMessage", newPath);
  result = CheckLastError("RoadWeatherMessage", gkFuncRefGet, result);

  return result;
}

int SetRoadWeatherMessageCommon_BumperHeightsParams(LONG packetHandle, struct RoadWeatherMessageCommon_BumperHeights value, char oldPath[])
{
  char newPath[300];
  int result;

  result = 0;

  snprintf(newPath, elcount(newPath), "%s.%s", oldPath, "front");
  C2xSetTokenInt(packetHandle, "RoadWeatherMessage", newPath, value.front);
  result = CheckLastError("RoadWeatherMessage", gkFuncRefGet, result);

  snprintf(newPath, elcount(newPath), "%s.%s", oldPath, "rear");
  C2xSetTokenInt(packetHandle, "RoadWeatherMessage", newPath, value.rear);
  result = CheckLastError("RoadWeatherMessage", gkFuncRefGet, result);

  return result;
}

int GetRoadWeatherMessageProbeVehicleData_VehicleStatus_vehicleDataParams(LONG packetHandle, struct RoadWeatherMessageProbeVehicleData_VehicleStatus_vehicleData value, char oldPath[])
{
  char newPath[300];
  int result;

  result = 0;

  snprintf(newPath, elcount(newPath), "%s.%s", oldPath, "height");
  value.height = C2xGetTokenInt(packetHandle, "RoadWeatherMessage", newPath);
  result = CheckLastError("RoadWeatherMessage", gkFuncRefGet, result);

  snprintf(newPath, elcount(newPath), "%s.%s", oldPath, "bumpers");
  GetRoadWeatherMessageCommon_BumperHeightsParams(packetHandle, value.bumpers, newPath);
  result = CheckLastError("RoadWeatherMessage", gkFuncRefGet, result);

  snprintf(newPath, elcount(newPath), "%s.%s", oldPath, "mass");
  value.mass = C2xGetTokenInt(packetHandle, "RoadWeatherMessage", newPath);
  result = CheckLastError("RoadWeatherMessage", gkFuncRefGet, result);

  snprintf(newPath, elcount(newPath), "%s.%s", oldPath, "trailerWeight");
  value.trailerWeight = C2xGetTokenInt(packetHandle, "RoadWeatherMessage", newPath);
  result = CheckLastError("RoadWeatherMessage", gkFuncRefGet, result);

  snprintf(newPath, elcount(newPath), "%s.%s", oldPath, "type");
  value.type = C2xGetTokenInt(packetHandle, "RoadWeatherMessage", newPath);
  result = CheckLastError("RoadWeatherMessage", gkFuncRefGet, result);

  return result;
}

int SetRoadWeatherMessageProbeVehicleData_VehicleStatus_vehicleDataParams(LONG packetHandle, struct RoadWeatherMessageProbeVehicleData_VehicleStatus_vehicleData value, char oldPath[])
{
  char newPath[300];
  int result;

  result = 0;

  snprintf(newPath, elcount(newPath), "%s.%s", oldPath, "height");
  C2xSetTokenInt(packetHandle, "RoadWeatherMessage", newPath, value.height);
  result = CheckLastError("RoadWeatherMessage", gkFuncRefGet, result);

  snprintf(newPath, elcount(newPath), "%s.%s", oldPath, "bumpers");
  SetRoadWeatherMessageCommon_BumperHeightsParams(packetHandle, value.bumpers, newPath);
  result = CheckLastError("RoadWeatherMessage", gkFuncRefGet, result);

  snprintf(newPath, elcount(newPath), "%s.%s", oldPath, "mass");
  C2xSetTokenInt(packetHandle, "RoadWeatherMessage", newPath, value.mass);
  result = CheckLastError("RoadWeatherMessage", gkFuncRefGet, result);

  snprintf(newPath, elcount(newPath), "%s.%s", oldPath, "trailerWeight");
  C2xSetTokenInt(packetHandle, "RoadWeatherMessage", newPath, value.trailerWeight);
  result = CheckLastError("RoadWeatherMessage", gkFuncRefGet, result);

  snprintf(newPath, elcount(newPath), "%s.%s", oldPath, "type");
  C2xSetTokenInt(packetHandle, "RoadWeatherMessage", newPath, value.type);
  result = CheckLastError("RoadWeatherMessage", gkFuncRefGet, result);

  return result;
}

int GetRoadWeatherMessageCommon_VehicleIDParams(LONG packetHandle, struct RoadWeatherMessageCommon_VehicleID value, char oldPath[])
{
  char newPath[300];
  char buffer[300];
  int result;

  result = 0;

  value.choice = C2xGetTokenInt(packetHandle, "RoadWeatherMessage", oldPath);

  switch(value.choice)
  {
    case 0:
    {
      snprintf(newPath, elcount(newPath), "%s.%s", oldPath, "entityID");
      value.entityID.stringLength = C2xGetTokenData(packetHandle, "RoadWeatherMessage", newPath, elcount(value.entityID.string), value.entityID.string);
      result = CheckLastError("RoadWeatherMessage", gkFuncRefGet, result);
    }
    break;
    case 1:
    {
      snprintf(newPath, elcount(newPath), "%s.%s", oldPath, "stationID");
      value.stationID = C2xGetTokenInt64(packetHandle, "RoadWeatherMessage", newPath);
      result = CheckLastError("RoadWeatherMessage", gkFuncRefGet, result);
    }
    break;
  }
  return result;
}

int SetRoadWeatherMessageCommon_VehicleIDParams(LONG packetHandle, struct RoadWeatherMessageCommon_VehicleID value, char oldPath[])
{
  char newPath[300];
  char buffer[300];
  int result;

  result = 0;

  switch(value.choice)
  {
    case 0:
    {
      snprintf(newPath, elcount(newPath), "%s.%s", oldPath, "entityID");
      C2xSetTokenData(packetHandle, "RoadWeatherMessage", newPath, value.entityID.stringLength, value.entityID.string);
      result = CheckLastError("RoadWeatherMessage", gkFuncRefGet, result);
    }
    break;
    case 1:
    {
      snprintf(newPath, elcount(newPath), "%s.%s", oldPath, "stationID");
      C2xSetTokenInt64(packetHandle, "RoadWeatherMessage", newPath, value.stationID);
      result = CheckLastError("RoadWeatherMessage", gkFuncRefGet, result);
    }
    break;
  }
  return result;
}

int GetRoadWeatherMessageProbeVehicleData_VehicleIdent_vehicleClassParams(LONG packetHandle, struct RoadWeatherMessageProbeVehicleData_VehicleIdent_vehicleClass value, char oldPath[])
{
  char newPath[300];
  int result;

  result = 0;

  value.choice = C2xGetTokenInt(packetHandle, "RoadWeatherMessage", oldPath);

  switch(value.choice)
  {
    case 0:
    {
      snprintf(newPath, elcount(newPath), "%s.%s", oldPath, "vGroup");
      value.vGroup = C2xGetTokenInt(packetHandle, "RoadWeatherMessage", newPath);
      result = CheckLastError("RoadWeatherMessage", gkFuncRefGet, result);
    }
    break;
    case 1:
    {
      snprintf(newPath, elcount(newPath), "%s.%s", oldPath, "rGroup");
      value.rGroup = C2xGetTokenInt(packetHandle, "RoadWeatherMessage", newPath);
      result = CheckLastError("RoadWeatherMessage", gkFuncRefGet, result);
    }
    break;
    case 2:
    {
      snprintf(newPath, elcount(newPath), "%s.%s", oldPath, "rEquip");
      value.rEquip = C2xGetTokenInt(packetHandle, "RoadWeatherMessage", newPath);
      result = CheckLastError("RoadWeatherMessage", gkFuncRefGet, result);
    }
    break;
  }
  return result;
}

int SetRoadWeatherMessageProbeVehicleData_VehicleIdent_vehicleClassParams(LONG packetHandle, struct RoadWeatherMessageProbeVehicleData_VehicleIdent_vehicleClass value, char oldPath[])
{
  char newPath[300];
  int result;

  result = 0;

  switch(value.choice)
  {
    case 0:
    {
      snprintf(newPath, elcount(newPath), "%s.%s", oldPath, "vGroup");
      C2xSetTokenInt(packetHandle, "RoadWeatherMessage", newPath, value.vGroup);
      result = CheckLastError("RoadWeatherMessage", gkFuncRefGet, result);
    }
    break;
    case 1:
    {
      snprintf(newPath, elcount(newPath), "%s.%s", oldPath, "rGroup");
      C2xSetTokenInt(packetHandle, "RoadWeatherMessage", newPath, value.rGroup);
      result = CheckLastError("RoadWeatherMessage", gkFuncRefGet, result);
    }
    break;
    case 2:
    {
      snprintf(newPath, elcount(newPath), "%s.%s", oldPath, "rEquip");
      C2xSetTokenInt(packetHandle, "RoadWeatherMessage", newPath, value.rEquip);
      result = CheckLastError("RoadWeatherMessage", gkFuncRefGet, result);
    }
    break;
  }
  return result;
}

int GetRoadWeatherMessageProbeVehicleData_VehicleIdentParams(LONG packetHandle, struct RoadWeatherMessageProbeVehicleData_VehicleIdent value, char oldPath[])
{
  char newPath[300];
  int result;

  result = 0;

  snprintf(newPath, elcount(newPath), "%s.%s", oldPath, "name");
  value.name.isValidFlag = C2xIsTokenAvailable(packetHandle, "RoadWeatherMessage", newPath);
  if(value.name.isValidFlag==1)
  {
    value.name.stringLength = C2xGetTokenData(packetHandle, "RoadWeatherMessage", newPath, elcount(value.name.string), value.name.string);
    result = CheckLastError("RoadWeatherMessage", gkFuncRefGet, result);
  }
  snprintf(newPath, elcount(newPath), "%s.%s", oldPath, "vin");
  value.vin.isValidFlag = C2xIsTokenAvailable(packetHandle, "RoadWeatherMessage", newPath);
  if(value.vin.isValidFlag==1)
  {
    value.vin.isValidFlag = 1;
    value.vin.stringLength = C2xGetTokenData(packetHandle, "RoadWeatherMessage", newPath, elcount(value.vin.string), value.vin.string);
  }
  snprintf(newPath, elcount(newPath), "%s.%s", oldPath, "ownerCode");
  value.ownerCode.isValidFlag = C2xIsTokenAvailable(packetHandle, "RoadWeatherMessage", newPath);
  if(value.ownerCode.isValidFlag==1)
  {
    value.ownerCode.stringLength = C2xGetTokenData(packetHandle, "RoadWeatherMessage", newPath, elcount(value.ownerCode.string), value.ownerCode.string);
    result = CheckLastError("RoadWeatherMessage", gkFuncRefGet, result);
  }
  snprintf(newPath, elcount(newPath), "%s.%s", oldPath, "id");
  value.id.isValidFlag = C2xIsTokenAvailable(packetHandle, "RoadWeatherMessage", newPath);
  if(value.id.isValidFlag==1)
  {
    GetRoadWeatherMessageCommon_VehicleIDParams(packetHandle, value.id, newPath);
    result = CheckLastError("RoadWeatherMessage", gkFuncRefGet, result);
  }
  snprintf(newPath, elcount(newPath), "%s.%s", oldPath, "vehicleType");
  value.vehicleType.isValidFlag = C2xIsTokenAvailable(packetHandle, "RoadWeatherMessage", newPath);
  if(value.vehicleType.isValidFlag==1)
  {
    value.vehicleType.value = C2xGetTokenInt(packetHandle, "RoadWeatherMessage", newPath);
    result = CheckLastError("RoadWeatherMessage", gkFuncRefGet, result);
  }
  snprintf(newPath, elcount(newPath), "%s.%s", oldPath, "vehicleClass");
  value.vehicleClass.isValidFlag = C2xIsTokenAvailable(packetHandle, "RoadWeatherMessage", newPath);
  if(value.vehicleClass.isValidFlag==1)
  {
    GetRoadWeatherMessageProbeVehicleData_VehicleIdent_vehicleClassParams(packetHandle, value.vehicleClass, newPath);
    result = CheckLastError("RoadWeatherMessage", gkFuncRefGet, result);
  }
  return result;
}

int SetRoadWeatherMessageProbeVehicleData_VehicleIdentParams(LONG packetHandle, struct RoadWeatherMessageProbeVehicleData_VehicleIdent value, char oldPath[])
{
  char newPath[300];
  int result;

  result = 0;

  snprintf(newPath, elcount(newPath), "%s.%s", oldPath, "name");
  if(value.name.isValidFlag==1)
  {
    C2xSetTokenData(packetHandle, "RoadWeatherMessage", newPath, value.name.stringLength, value.name.string);
    result = CheckLastError("RoadWeatherMessage", gkFuncRefGet, result);
  }
  else
  {
    if( C2xIsTokenAvailable(packetHandle, "RoadWeatherMessage", newPath) )
    {
      C2xRemoveToken(packetHandle, "RoadWeatherMessage", newPath);
    }
  }

  snprintf(newPath, elcount(newPath), "%s.%s", oldPath, "vin");
  if(value.vin.isValidFlag==1)
  {
    C2xSetTokenData(packetHandle, "RoadWeatherMessage", newPath, value.vin.stringLength, value.vin.string);
  }
  else
  {
    if( C2xIsTokenAvailable(packetHandle, "RoadWeatherMessage", newPath) )
    {
      C2xRemoveToken(packetHandle, "RoadWeatherMessage", newPath);
    }
  }

  snprintf(newPath, elcount(newPath), "%s.%s", oldPath, "ownerCode");
  if(value.ownerCode.isValidFlag==1)
  {
    C2xSetTokenData(packetHandle, "RoadWeatherMessage", newPath, value.ownerCode.stringLength, value.ownerCode.string);
    result = CheckLastError("RoadWeatherMessage", gkFuncRefGet, result);
  }
  else
  {
    if( C2xIsTokenAvailable(packetHandle, "RoadWeatherMessage", newPath) )
    {
      C2xRemoveToken(packetHandle, "RoadWeatherMessage", newPath);
    }
  }

  snprintf(newPath, elcount(newPath), "%s.%s", oldPath, "id");
  if(value.id.isValidFlag==1)
  {
    SetRoadWeatherMessageCommon_VehicleIDParams(packetHandle, value.id, newPath);
    result = CheckLastError("RoadWeatherMessage", gkFuncRefGet, result);
  }
  else
  {
    if( C2xIsTokenAvailable(packetHandle, "RoadWeatherMessage", newPath) )
    {
      C2xRemoveToken(packetHandle, "RoadWeatherMessage", newPath);
    }
  }

  snprintf(newPath, elcount(newPath), "%s.%s", oldPath, "vehicleType");
  if(value.vehicleType.isValidFlag==1)
  {
    C2xSetTokenInt(packetHandle, "RoadWeatherMessage", newPath, value.vehicleType.value);
    result = CheckLastError("RoadWeatherMessage", gkFuncRefGet, result);
  }
  else
  {
    if( C2xIsTokenAvailable(packetHandle, "RoadWeatherMessage", newPath) )
    {
      C2xRemoveToken(packetHandle, "RoadWeatherMessage", newPath);
    }
  }

  snprintf(newPath, elcount(newPath), "%s.%s", oldPath, "vehicleClass");
  if(value.vehicleClass.isValidFlag==1)
  {
    SetRoadWeatherMessageProbeVehicleData_VehicleIdent_vehicleClassParams(packetHandle, value.vehicleClass, newPath);
    result = CheckLastError("RoadWeatherMessage", gkFuncRefGet, result);
  }
  else
  {
    if( C2xIsTokenAvailable(packetHandle, "RoadWeatherMessage", newPath) )
    {
      C2xRemoveToken(packetHandle, "RoadWeatherMessage", newPath);
    }
  }

  return result;
}

int GetRoadWeatherMessageProbeVehicleData_TireDataParams(LONG packetHandle, struct RoadWeatherMessageProbeVehicleData_TireData value, char oldPath[])
{
  char newPath[300];
  int result;

  result = 0;

  snprintf(newPath, elcount(newPath), "%s.%s", oldPath, "location");
  value.location.isValidFlag = C2xIsTokenAvailable(packetHandle, "RoadWeatherMessage", newPath);
  if(value.location.isValidFlag==1)
  {
    value.location.value = C2xGetTokenInt(packetHandle, "RoadWeatherMessage", newPath);
    result = CheckLastError("RoadWeatherMessage", gkFuncRefGet, result);
  }
  snprintf(newPath, elcount(newPath), "%s.%s", oldPath, "pressure");
  value.pressure.isValidFlag = C2xIsTokenAvailable(packetHandle, "RoadWeatherMessage", newPath);
  if(value.pressure.isValidFlag==1)
  {
    value.pressure.value = C2xGetTokenInt(packetHandle, "RoadWeatherMessage", newPath);
    result = CheckLastError("RoadWeatherMessage", gkFuncRefGet, result);
  }
  snprintf(newPath, elcount(newPath), "%s.%s", oldPath, "temp");
  value.temp.isValidFlag = C2xIsTokenAvailable(packetHandle, "RoadWeatherMessage", newPath);
  if(value.temp.isValidFlag==1)
  {
    value.temp.value = C2xGetTokenInt(packetHandle, "RoadWeatherMessage", newPath);
    result = CheckLastError("RoadWeatherMessage", gkFuncRefGet, result);
  }
  snprintf(newPath, elcount(newPath), "%s.%s", oldPath, "wheelSensorStatus");
  value.wheelSensorStatus.isValidFlag = C2xIsTokenAvailable(packetHandle, "RoadWeatherMessage", newPath);
  if(value.wheelSensorStatus.isValidFlag==1)
  {
    value.wheelSensorStatus.value = C2xGetTokenInt(packetHandle, "RoadWeatherMessage", newPath);
    result = CheckLastError("RoadWeatherMessage", gkFuncRefGet, result);
  }
  snprintf(newPath, elcount(newPath), "%s.%s", oldPath, "wheelEndElectFault");
  value.wheelEndElectFault.isValidFlag = C2xIsTokenAvailable(packetHandle, "RoadWeatherMessage", newPath);
  if(value.wheelEndElectFault.isValidFlag==1)
  {
    value.wheelEndElectFault.value = C2xGetTokenInt(packetHandle, "RoadWeatherMessage", newPath);
    result = CheckLastError("RoadWeatherMessage", gkFuncRefGet, result);
  }
  snprintf(newPath, elcount(newPath), "%s.%s", oldPath, "leakageRate");
  value.leakageRate.isValidFlag = C2xIsTokenAvailable(packetHandle, "RoadWeatherMessage", newPath);
  if(value.leakageRate.isValidFlag==1)
  {
    value.leakageRate.value = C2xGetTokenInt(packetHandle, "RoadWeatherMessage", newPath);
    result = CheckLastError("RoadWeatherMessage", gkFuncRefGet, result);
  }
  snprintf(newPath, elcount(newPath), "%s.%s", oldPath, "detection");
  value.detection.isValidFlag = C2xIsTokenAvailable(packetHandle, "RoadWeatherMessage", newPath);
  if(value.detection.isValidFlag==1)
  {
    value.detection.value = C2xGetTokenInt(packetHandle, "RoadWeatherMessage", newPath);
    result = CheckLastError("RoadWeatherMessage", gkFuncRefGet, result);
  }
  return result;
}

int SetRoadWeatherMessageProbeVehicleData_TireDataParams(LONG packetHandle, struct RoadWeatherMessageProbeVehicleData_TireData value, char oldPath[])
{
  char newPath[300];
  int result;

  result = 0;

  snprintf(newPath, elcount(newPath), "%s.%s", oldPath, "location");
  if(value.location.isValidFlag==1)
  {
    C2xSetTokenInt(packetHandle, "RoadWeatherMessage", newPath, value.location.value);
    result = CheckLastError("RoadWeatherMessage", gkFuncRefGet, result);
  }
  else
  {
    if( C2xIsTokenAvailable(packetHandle, "RoadWeatherMessage", newPath) )
    {
      C2xRemoveToken(packetHandle, "RoadWeatherMessage", newPath);
    }
  }

  snprintf(newPath, elcount(newPath), "%s.%s", oldPath, "pressure");
  if(value.pressure.isValidFlag==1)
  {
    C2xSetTokenInt(packetHandle, "RoadWeatherMessage", newPath, value.pressure.value);
    result = CheckLastError("RoadWeatherMessage", gkFuncRefGet, result);
  }
  else
  {
    if( C2xIsTokenAvailable(packetHandle, "RoadWeatherMessage", newPath) )
    {
      C2xRemoveToken(packetHandle, "RoadWeatherMessage", newPath);
    }
  }

  snprintf(newPath, elcount(newPath), "%s.%s", oldPath, "temp");
  if(value.temp.isValidFlag==1)
  {
    C2xSetTokenInt(packetHandle, "RoadWeatherMessage", newPath, value.temp.value);
    result = CheckLastError("RoadWeatherMessage", gkFuncRefGet, result);
  }
  else
  {
    if( C2xIsTokenAvailable(packetHandle, "RoadWeatherMessage", newPath) )
    {
      C2xRemoveToken(packetHandle, "RoadWeatherMessage", newPath);
    }
  }

  snprintf(newPath, elcount(newPath), "%s.%s", oldPath, "wheelSensorStatus");
  if(value.wheelSensorStatus.isValidFlag==1)
  {
    C2xSetTokenInt(packetHandle, "RoadWeatherMessage", newPath, value.wheelSensorStatus.value);
    result = CheckLastError("RoadWeatherMessage", gkFuncRefGet, result);
  }
  else
  {
    if( C2xIsTokenAvailable(packetHandle, "RoadWeatherMessage", newPath) )
    {
      C2xRemoveToken(packetHandle, "RoadWeatherMessage", newPath);
    }
  }

  snprintf(newPath, elcount(newPath), "%s.%s", oldPath, "wheelEndElectFault");
  if(value.wheelEndElectFault.isValidFlag==1)
  {
    C2xSetTokenInt(packetHandle, "RoadWeatherMessage", newPath, value.wheelEndElectFault.value);
    result = CheckLastError("RoadWeatherMessage", gkFuncRefGet, result);
  }
  else
  {
    if( C2xIsTokenAvailable(packetHandle, "RoadWeatherMessage", newPath) )
    {
      C2xRemoveToken(packetHandle, "RoadWeatherMessage", newPath);
    }
  }

  snprintf(newPath, elcount(newPath), "%s.%s", oldPath, "leakageRate");
  if(value.leakageRate.isValidFlag==1)
  {
    C2xSetTokenInt(packetHandle, "RoadWeatherMessage", newPath, value.leakageRate.value);
    result = CheckLastError("RoadWeatherMessage", gkFuncRefGet, result);
  }
  else
  {
    if( C2xIsTokenAvailable(packetHandle, "RoadWeatherMessage", newPath) )
    {
      C2xRemoveToken(packetHandle, "RoadWeatherMessage", newPath);
    }
  }

  snprintf(newPath, elcount(newPath), "%s.%s", oldPath, "detection");
  if(value.detection.isValidFlag==1)
  {
    C2xSetTokenInt(packetHandle, "RoadWeatherMessage", newPath, value.detection.value);
    result = CheckLastError("RoadWeatherMessage", gkFuncRefGet, result);
  }
  else
  {
    if( C2xIsTokenAvailable(packetHandle, "RoadWeatherMessage", newPath) )
    {
      C2xRemoveToken(packetHandle, "RoadWeatherMessage", newPath);
    }
  }

  return result;
}

int GetRoadWeatherMessageProbeVehicleData_TireDataListParams(LONG packetHandle, struct RoadWeatherMessageProbeVehicleData_TireDataList value, char oldPath[])
{
  char newPath[300]; 
  int i;
  int result;

  result = 0;

  value.length = C2xGetTokenInt(packetHandle, "RoadWeatherMessage", oldPath);
  if((result = CheckLastError("RoadWeatherMessage", gkFuncRefGet, result))==0)
  {
    for(i=0; i<value.length; i++)
    {
      snprintf(newPath, elcount(newPath), "%s[%d]", oldPath, i);
      GetRoadWeatherMessageProbeVehicleData_TireDataParams(packetHandle, value.arrayValue[i], newPath);
      result = CheckLastError("RoadWeatherMessage", gkFuncRefGet, result);
    }
  }
  return result;
}

int SetRoadWeatherMessageProbeVehicleData_TireDataListParams(LONG packetHandle, struct RoadWeatherMessageProbeVehicleData_TireDataList value, char oldPath[])
{
  char newPath[300]; 
  int i;
  int result;

  result = 0;

  C2xRemoveToken(packetHandle, "RoadWeatherMessage", oldPath);
  for(i=0; i<value.length; i++)
  {
    snprintf(newPath, elcount(newPath), "%s[%d]", oldPath, i);
    SetRoadWeatherMessageProbeVehicleData_TireDataParams(packetHandle, value.arrayValue[i], newPath);
    result = CheckLastError("RoadWeatherMessage", gkFuncRefGet, result);
  }
  return result;
}

int GetRoadWeatherMessageProbeVehicleData_AxleWeightSetParams(LONG packetHandle, struct RoadWeatherMessageProbeVehicleData_AxleWeightSet value, char oldPath[])
{
  char newPath[300];
  int result;

  result = 0;

  snprintf(newPath, elcount(newPath), "%s.%s", oldPath, "location");
  value.location.isValidFlag = C2xIsTokenAvailable(packetHandle, "RoadWeatherMessage", newPath);
  if(value.location.isValidFlag==1)
  {
    value.location.value = C2xGetTokenInt(packetHandle, "RoadWeatherMessage", newPath);
    result = CheckLastError("RoadWeatherMessage", gkFuncRefGet, result);
  }
  snprintf(newPath, elcount(newPath), "%s.%s", oldPath, "weight");
  value.weight.isValidFlag = C2xIsTokenAvailable(packetHandle, "RoadWeatherMessage", newPath);
  if(value.weight.isValidFlag==1)
  {
    value.weight.value = C2xGetTokenInt(packetHandle, "RoadWeatherMessage", newPath);
    result = CheckLastError("RoadWeatherMessage", gkFuncRefGet, result);
  }
  return result;
}

int SetRoadWeatherMessageProbeVehicleData_AxleWeightSetParams(LONG packetHandle, struct RoadWeatherMessageProbeVehicleData_AxleWeightSet value, char oldPath[])
{
  char newPath[300];
  int result;

  result = 0;

  snprintf(newPath, elcount(newPath), "%s.%s", oldPath, "location");
  if(value.location.isValidFlag==1)
  {
    C2xSetTokenInt(packetHandle, "RoadWeatherMessage", newPath, value.location.value);
    result = CheckLastError("RoadWeatherMessage", gkFuncRefGet, result);
  }
  else
  {
    if( C2xIsTokenAvailable(packetHandle, "RoadWeatherMessage", newPath) )
    {
      C2xRemoveToken(packetHandle, "RoadWeatherMessage", newPath);
    }
  }

  snprintf(newPath, elcount(newPath), "%s.%s", oldPath, "weight");
  if(value.weight.isValidFlag==1)
  {
    C2xSetTokenInt(packetHandle, "RoadWeatherMessage", newPath, value.weight.value);
    result = CheckLastError("RoadWeatherMessage", gkFuncRefGet, result);
  }
  else
  {
    if( C2xIsTokenAvailable(packetHandle, "RoadWeatherMessage", newPath) )
    {
      C2xRemoveToken(packetHandle, "RoadWeatherMessage", newPath);
    }
  }

  return result;
}

int GetRoadWeatherMessageProbeVehicleData_AxleWeightListParams(LONG packetHandle, struct RoadWeatherMessageProbeVehicleData_AxleWeightList value, char oldPath[])
{
  char newPath[300]; 
  int i;
  int result;

  result = 0;

  value.length = C2xGetTokenInt(packetHandle, "RoadWeatherMessage", oldPath);
  if((result = CheckLastError("RoadWeatherMessage", gkFuncRefGet, result))==0)
  {
    for(i=0; i<value.length; i++)
    {
      snprintf(newPath, elcount(newPath), "%s[%d]", oldPath, i);
      GetRoadWeatherMessageProbeVehicleData_AxleWeightSetParams(packetHandle, value.arrayValue[i], newPath);
      result = CheckLastError("RoadWeatherMessage", gkFuncRefGet, result);
    }
  }
  return result;
}

int SetRoadWeatherMessageProbeVehicleData_AxleWeightListParams(LONG packetHandle, struct RoadWeatherMessageProbeVehicleData_AxleWeightList value, char oldPath[])
{
  char newPath[300]; 
  int i;
  int result;

  result = 0;

  C2xRemoveToken(packetHandle, "RoadWeatherMessage", oldPath);
  for(i=0; i<value.length; i++)
  {
    snprintf(newPath, elcount(newPath), "%s[%d]", oldPath, i);
    SetRoadWeatherMessageProbeVehicleData_AxleWeightSetParams(packetHandle, value.arrayValue[i], newPath);
    result = CheckLastError("RoadWeatherMessage", gkFuncRefGet, result);
  }
  return result;
}

int GetRoadWeatherMessageProbeVehicleData_J1939dataParams(LONG packetHandle, struct RoadWeatherMessageProbeVehicleData_J1939data value, char oldPath[])
{
  char newPath[300];
  int result;

  result = 0;

  snprintf(newPath, elcount(newPath), "%s.%s", oldPath, "tires");
  value.tires.isValidFlag = C2xIsTokenAvailable(packetHandle, "RoadWeatherMessage", newPath);
  if(value.tires.isValidFlag==1)
  {
    GetRoadWeatherMessageProbeVehicleData_TireDataListParams(packetHandle, value.tires, newPath);
    result = CheckLastError("RoadWeatherMessage", gkFuncRefGet, result);
  }
  snprintf(newPath, elcount(newPath), "%s.%s", oldPath, "axles");
  value.axles.isValidFlag = C2xIsTokenAvailable(packetHandle, "RoadWeatherMessage", newPath);
  if(value.axles.isValidFlag==1)
  {
    GetRoadWeatherMessageProbeVehicleData_AxleWeightListParams(packetHandle, value.axles, newPath);
    result = CheckLastError("RoadWeatherMessage", gkFuncRefGet, result);
  }
  snprintf(newPath, elcount(newPath), "%s.%s", oldPath, "trailerWeight");
  value.trailerWeight.isValidFlag = C2xIsTokenAvailable(packetHandle, "RoadWeatherMessage", newPath);
  if(value.trailerWeight.isValidFlag==1)
  {
    value.trailerWeight.value = C2xGetTokenInt(packetHandle, "RoadWeatherMessage", newPath);
    result = CheckLastError("RoadWeatherMessage", gkFuncRefGet, result);
  }
  snprintf(newPath, elcount(newPath), "%s.%s", oldPath, "cargoWeight");
  value.cargoWeight.isValidFlag = C2xIsTokenAvailable(packetHandle, "RoadWeatherMessage", newPath);
  if(value.cargoWeight.isValidFlag==1)
  {
    value.cargoWeight.value = C2xGetTokenInt(packetHandle, "RoadWeatherMessage", newPath);
    result = CheckLastError("RoadWeatherMessage", gkFuncRefGet, result);
  }
  snprintf(newPath, elcount(newPath), "%s.%s", oldPath, "steeringAxleTemperature");
  value.steeringAxleTemperature.isValidFlag = C2xIsTokenAvailable(packetHandle, "RoadWeatherMessage", newPath);
  if(value.steeringAxleTemperature.isValidFlag==1)
  {
    value.steeringAxleTemperature.value = C2xGetTokenInt(packetHandle, "RoadWeatherMessage", newPath);
    result = CheckLastError("RoadWeatherMessage", gkFuncRefGet, result);
  }
  snprintf(newPath, elcount(newPath), "%s.%s", oldPath, "driveAxleLocation");
  value.driveAxleLocation.isValidFlag = C2xIsTokenAvailable(packetHandle, "RoadWeatherMessage", newPath);
  if(value.driveAxleLocation.isValidFlag==1)
  {
    value.driveAxleLocation.value = C2xGetTokenInt(packetHandle, "RoadWeatherMessage", newPath);
    result = CheckLastError("RoadWeatherMessage", gkFuncRefGet, result);
  }
  snprintf(newPath, elcount(newPath), "%s.%s", oldPath, "driveAxleLiftAirPressure");
  value.driveAxleLiftAirPressure.isValidFlag = C2xIsTokenAvailable(packetHandle, "RoadWeatherMessage", newPath);
  if(value.driveAxleLiftAirPressure.isValidFlag==1)
  {
    value.driveAxleLiftAirPressure.value = C2xGetTokenInt(packetHandle, "RoadWeatherMessage", newPath);
    result = CheckLastError("RoadWeatherMessage", gkFuncRefGet, result);
  }
  snprintf(newPath, elcount(newPath), "%s.%s", oldPath, "driveAxleTemperature");
  value.driveAxleTemperature.isValidFlag = C2xIsTokenAvailable(packetHandle, "RoadWeatherMessage", newPath);
  if(value.driveAxleTemperature.isValidFlag==1)
  {
    value.driveAxleTemperature.value = C2xGetTokenInt(packetHandle, "RoadWeatherMessage", newPath);
    result = CheckLastError("RoadWeatherMessage", gkFuncRefGet, result);
  }
  snprintf(newPath, elcount(newPath), "%s.%s", oldPath, "driveAxleLubePressure");
  value.driveAxleLubePressure.isValidFlag = C2xIsTokenAvailable(packetHandle, "RoadWeatherMessage", newPath);
  if(value.driveAxleLubePressure.isValidFlag==1)
  {
    value.driveAxleLubePressure.value = C2xGetTokenInt(packetHandle, "RoadWeatherMessage", newPath);
    result = CheckLastError("RoadWeatherMessage", gkFuncRefGet, result);
  }
  snprintf(newPath, elcount(newPath), "%s.%s", oldPath, "steeringAxleLubePressure");
  value.steeringAxleLubePressure.isValidFlag = C2xIsTokenAvailable(packetHandle, "RoadWeatherMessage", newPath);
  if(value.steeringAxleLubePressure.isValidFlag==1)
  {
    value.steeringAxleLubePressure.value = C2xGetTokenInt(packetHandle, "RoadWeatherMessage", newPath);
    result = CheckLastError("RoadWeatherMessage", gkFuncRefGet, result);
  }
  return result;
}

int SetRoadWeatherMessageProbeVehicleData_J1939dataParams(LONG packetHandle, struct RoadWeatherMessageProbeVehicleData_J1939data value, char oldPath[])
{
  char newPath[300];
  int result;

  result = 0;

  snprintf(newPath, elcount(newPath), "%s.%s", oldPath, "tires");
  if(value.tires.isValidFlag==1)
  {
    SetRoadWeatherMessageProbeVehicleData_TireDataListParams(packetHandle, value.tires, newPath);
    result = CheckLastError("RoadWeatherMessage", gkFuncRefGet, result);
  }
  else
  {
    if( C2xIsTokenAvailable(packetHandle, "RoadWeatherMessage", newPath) )
    {
      C2xRemoveToken(packetHandle, "RoadWeatherMessage", newPath);
    }
  }

  snprintf(newPath, elcount(newPath), "%s.%s", oldPath, "axles");
  if(value.axles.isValidFlag==1)
  {
    SetRoadWeatherMessageProbeVehicleData_AxleWeightListParams(packetHandle, value.axles, newPath);
    result = CheckLastError("RoadWeatherMessage", gkFuncRefGet, result);
  }
  else
  {
    if( C2xIsTokenAvailable(packetHandle, "RoadWeatherMessage", newPath) )
    {
      C2xRemoveToken(packetHandle, "RoadWeatherMessage", newPath);
    }
  }

  snprintf(newPath, elcount(newPath), "%s.%s", oldPath, "trailerWeight");
  if(value.trailerWeight.isValidFlag==1)
  {
    C2xSetTokenInt(packetHandle, "RoadWeatherMessage", newPath, value.trailerWeight.value);
    result = CheckLastError("RoadWeatherMessage", gkFuncRefGet, result);
  }
  else
  {
    if( C2xIsTokenAvailable(packetHandle, "RoadWeatherMessage", newPath) )
    {
      C2xRemoveToken(packetHandle, "RoadWeatherMessage", newPath);
    }
  }

  snprintf(newPath, elcount(newPath), "%s.%s", oldPath, "cargoWeight");
  if(value.cargoWeight.isValidFlag==1)
  {
    C2xSetTokenInt(packetHandle, "RoadWeatherMessage", newPath, value.cargoWeight.value);
    result = CheckLastError("RoadWeatherMessage", gkFuncRefGet, result);
  }
  else
  {
    if( C2xIsTokenAvailable(packetHandle, "RoadWeatherMessage", newPath) )
    {
      C2xRemoveToken(packetHandle, "RoadWeatherMessage", newPath);
    }
  }

  snprintf(newPath, elcount(newPath), "%s.%s", oldPath, "steeringAxleTemperature");
  if(value.steeringAxleTemperature.isValidFlag==1)
  {
    C2xSetTokenInt(packetHandle, "RoadWeatherMessage", newPath, value.steeringAxleTemperature.value);
    result = CheckLastError("RoadWeatherMessage", gkFuncRefGet, result);
  }
  else
  {
    if( C2xIsTokenAvailable(packetHandle, "RoadWeatherMessage", newPath) )
    {
      C2xRemoveToken(packetHandle, "RoadWeatherMessage", newPath);
    }
  }

  snprintf(newPath, elcount(newPath), "%s.%s", oldPath, "driveAxleLocation");
  if(value.driveAxleLocation.isValidFlag==1)
  {
    C2xSetTokenInt(packetHandle, "RoadWeatherMessage", newPath, value.driveAxleLocation.value);
    result = CheckLastError("RoadWeatherMessage", gkFuncRefGet, result);
  }
  else
  {
    if( C2xIsTokenAvailable(packetHandle, "RoadWeatherMessage", newPath) )
    {
      C2xRemoveToken(packetHandle, "RoadWeatherMessage", newPath);
    }
  }

  snprintf(newPath, elcount(newPath), "%s.%s", oldPath, "driveAxleLiftAirPressure");
  if(value.driveAxleLiftAirPressure.isValidFlag==1)
  {
    C2xSetTokenInt(packetHandle, "RoadWeatherMessage", newPath, value.driveAxleLiftAirPressure.value);
    result = CheckLastError("RoadWeatherMessage", gkFuncRefGet, result);
  }
  else
  {
    if( C2xIsTokenAvailable(packetHandle, "RoadWeatherMessage", newPath) )
    {
      C2xRemoveToken(packetHandle, "RoadWeatherMessage", newPath);
    }
  }

  snprintf(newPath, elcount(newPath), "%s.%s", oldPath, "driveAxleTemperature");
  if(value.driveAxleTemperature.isValidFlag==1)
  {
    C2xSetTokenInt(packetHandle, "RoadWeatherMessage", newPath, value.driveAxleTemperature.value);
    result = CheckLastError("RoadWeatherMessage", gkFuncRefGet, result);
  }
  else
  {
    if( C2xIsTokenAvailable(packetHandle, "RoadWeatherMessage", newPath) )
    {
      C2xRemoveToken(packetHandle, "RoadWeatherMessage", newPath);
    }
  }

  snprintf(newPath, elcount(newPath), "%s.%s", oldPath, "driveAxleLubePressure");
  if(value.driveAxleLubePressure.isValidFlag==1)
  {
    C2xSetTokenInt(packetHandle, "RoadWeatherMessage", newPath, value.driveAxleLubePressure.value);
    result = CheckLastError("RoadWeatherMessage", gkFuncRefGet, result);
  }
  else
  {
    if( C2xIsTokenAvailable(packetHandle, "RoadWeatherMessage", newPath) )
    {
      C2xRemoveToken(packetHandle, "RoadWeatherMessage", newPath);
    }
  }

  snprintf(newPath, elcount(newPath), "%s.%s", oldPath, "steeringAxleLubePressure");
  if(value.steeringAxleLubePressure.isValidFlag==1)
  {
    C2xSetTokenInt(packetHandle, "RoadWeatherMessage", newPath, value.steeringAxleLubePressure.value);
    result = CheckLastError("RoadWeatherMessage", gkFuncRefGet, result);
  }
  else
  {
    if( C2xIsTokenAvailable(packetHandle, "RoadWeatherMessage", newPath) )
    {
      C2xRemoveToken(packetHandle, "RoadWeatherMessage", newPath);
    }
  }

  return result;
}

int GetRoadWeatherMessageProbeVehicleData_VehicleStatus_weatherReportParams(LONG packetHandle, struct RoadWeatherMessageProbeVehicleData_VehicleStatus_weatherReport value, char oldPath[])
{
  char newPath[300];
  int result;

  result = 0;

  snprintf(newPath, elcount(newPath), "%s.%s", oldPath, "isRaining");
  value.isRaining = C2xGetTokenInt(packetHandle, "RoadWeatherMessage", newPath);
  result = CheckLastError("RoadWeatherMessage", gkFuncRefGet, result);

  snprintf(newPath, elcount(newPath), "%s.%s", oldPath, "rainRate");
  value.rainRate.isValidFlag = C2xIsTokenAvailable(packetHandle, "RoadWeatherMessage", newPath);
  if(value.rainRate.isValidFlag==1)
  {
    value.rainRate.value = C2xGetTokenInt(packetHandle, "RoadWeatherMessage", newPath);
    result = CheckLastError("RoadWeatherMessage", gkFuncRefGet, result);
  }
  snprintf(newPath, elcount(newPath), "%s.%s", oldPath, "precipSituation");
  value.precipSituation.isValidFlag = C2xIsTokenAvailable(packetHandle, "RoadWeatherMessage", newPath);
  if(value.precipSituation.isValidFlag==1)
  {
    value.precipSituation.value = C2xGetTokenInt(packetHandle, "RoadWeatherMessage", newPath);
    result = CheckLastError("RoadWeatherMessage", gkFuncRefGet, result);
  }
  snprintf(newPath, elcount(newPath), "%s.%s", oldPath, "solarRadiation");
  value.solarRadiation.isValidFlag = C2xIsTokenAvailable(packetHandle, "RoadWeatherMessage", newPath);
  if(value.solarRadiation.isValidFlag==1)
  {
    value.solarRadiation.value = C2xGetTokenInt(packetHandle, "RoadWeatherMessage", newPath);
    result = CheckLastError("RoadWeatherMessage", gkFuncRefGet, result);
  }
  snprintf(newPath, elcount(newPath), "%s.%s", oldPath, "friction");
  value.friction.isValidFlag = C2xIsTokenAvailable(packetHandle, "RoadWeatherMessage", newPath);
  if(value.friction.isValidFlag==1)
  {
    value.friction.value = C2xGetTokenInt(packetHandle, "RoadWeatherMessage", newPath);
    result = CheckLastError("RoadWeatherMessage", gkFuncRefGet, result);
  }
  return result;
}

int SetRoadWeatherMessageProbeVehicleData_VehicleStatus_weatherReportParams(LONG packetHandle, struct RoadWeatherMessageProbeVehicleData_VehicleStatus_weatherReport value, char oldPath[])
{
  char newPath[300];
  int result;

  result = 0;

  snprintf(newPath, elcount(newPath), "%s.%s", oldPath, "isRaining");
  if (value.isRaining < 1)
  {
    C2xSetTokenInt(packetHandle, "RoadWeatherMessage", newPath, 1);
  }
  else if (value.isRaining > 3)
  {
    C2xSetTokenInt(packetHandle, "RoadWeatherMessage", newPath, 3);
  }
  else
  {
    C2xSetTokenInt(packetHandle, "RoadWeatherMessage", newPath, value.isRaining);
  }
  result = CheckLastError("RoadWeatherMessage", gkFuncRefGet, result);

  snprintf(newPath, elcount(newPath), "%s.%s", oldPath, "rainRate");
  if(value.rainRate.isValidFlag==1)
  {
    C2xSetTokenInt(packetHandle, "RoadWeatherMessage", newPath, value.rainRate.value);
    result = CheckLastError("RoadWeatherMessage", gkFuncRefGet, result);
  }
  else
  {
    if( C2xIsTokenAvailable(packetHandle, "RoadWeatherMessage", newPath) )
    {
      C2xRemoveToken(packetHandle, "RoadWeatherMessage", newPath);
    }
  }

  snprintf(newPath, elcount(newPath), "%s.%s", oldPath, "precipSituation");
  if(value.precipSituation.isValidFlag==1)
  {
    if (value.precipSituation.value < 1)
    {
        C2xSetTokenInt(packetHandle, "RoadWeatherMessage", newPath, 1);
    }
    else if (value.precipSituation.value > 15)
    {
        C2xSetTokenInt(packetHandle, "RoadWeatherMessage", newPath, 15);
    }
    else
    {
        C2xSetTokenInt(packetHandle, "RoadWeatherMessage", newPath, value.precipSituation.value);
    }
    result = CheckLastError("RoadWeatherMessage", gkFuncRefGet, result);
  }
  else
  {
    if( C2xIsTokenAvailable(packetHandle, "RoadWeatherMessage", newPath) )
    {
      C2xRemoveToken(packetHandle, "RoadWeatherMessage", newPath);
    }
  }

  snprintf(newPath, elcount(newPath), "%s.%s", oldPath, "solarRadiation");
  if(value.solarRadiation.isValidFlag==1)
  {
    C2xSetTokenInt(packetHandle, "RoadWeatherMessage", newPath, value.solarRadiation.value);
    result = CheckLastError("RoadWeatherMessage", gkFuncRefGet, result);
  }
  else
  {
    if( C2xIsTokenAvailable(packetHandle, "RoadWeatherMessage", newPath) )
    {
      C2xRemoveToken(packetHandle, "RoadWeatherMessage", newPath);
    }
  }

  snprintf(newPath, elcount(newPath), "%s.%s", oldPath, "friction");
  if(value.friction.isValidFlag==1)
  {
    C2xSetTokenInt(packetHandle, "RoadWeatherMessage", newPath, value.friction.value);
    result = CheckLastError("RoadWeatherMessage", gkFuncRefGet, result);
  }
  else
  {
    if( C2xIsTokenAvailable(packetHandle, "RoadWeatherMessage", newPath) )
    {
      C2xRemoveToken(packetHandle, "RoadWeatherMessage", newPath);
    }
  }

  return result;
}

int GetRoadWeatherMessageProbeVehicleData_VehicleStatusParams(LONG packetHandle, struct RoadWeatherMessageProbeVehicleData_VehicleStatus value, char oldPath[])
{
  char newPath[300]; 
  int j; 
  int k;
  int result;

  result = 0;

  snprintf(newPath, elcount(newPath), "%s.%s", oldPath, "lights");
  value.lights.isValidFlag = C2xIsTokenAvailable(packetHandle, "RoadWeatherMessage", newPath);
  if(value.lights.isValidFlag==1)
  {
    value.lights.isValidFlag = 1;
    value.lights.stringLength = C2xGetTokenLengthBit(packetHandle, "RoadWeatherMessage", newPath);
    if ((result = CheckLastError("RoadWeatherMessage", gkFuncRefGet, result))==0)
    {
      if(value.lights.stringLength > 0)
      {
        for(j=0; j<value.lights.stringLength; j++)
        {
          if(C2xGetTokenBitOfBitString(packetHandle, "RoadWeatherMessage", newPath, j) == 0)
          {
            value.lights.string[j] = '0';
          }
          else if(C2xGetTokenBitOfBitString(packetHandle, "RoadWeatherMessage", newPath, j) == 1)
          {
            value.lights.string[j] = '1';
          }

          if(value.lights.stringLength == 1)
          {
            value.lights.string[1] = '0';
          }
          result = CheckLastError("RoadWeatherMessage", gkFuncRefGet, result);
        }
      }
      else
      {
        for(k = value.lights.stringLength+1; k > -1; k--)
        {
          if(value.lights.string[k] == '1')
          {
            value.lights.string[k] = '0';
          }
        }
      }
    }

  }
  snprintf(newPath, elcount(newPath), "%s.%s", oldPath, "lightBar");
  value.lightBar.isValidFlag = C2xIsTokenAvailable(packetHandle, "RoadWeatherMessage", newPath);
  if(value.lightBar.isValidFlag==1)
  {
    value.lightBar.value = C2xGetTokenInt(packetHandle, "RoadWeatherMessage", newPath);
    result = CheckLastError("RoadWeatherMessage", gkFuncRefGet, result);
  }
  snprintf(newPath, elcount(newPath), "%s.%s", oldPath, "wipers");
  value.wipers.isValidFlag = C2xIsTokenAvailable(packetHandle, "RoadWeatherMessage", newPath);
  if(value.wipers.isValidFlag==1)
  {
    GetRoadWeatherMessageCommon_WiperSetParams(packetHandle, value.wipers, newPath);
    result = CheckLastError("RoadWeatherMessage", gkFuncRefGet, result);
  }
  snprintf(newPath, elcount(newPath), "%s.%s", oldPath, "brakeStatus");
  value.brakeStatus.isValidFlag = C2xIsTokenAvailable(packetHandle, "RoadWeatherMessage", newPath);
  if(value.brakeStatus.isValidFlag==1)
  {
    GetRoadWeatherMessageCommon_BrakeSystemStatusParams(packetHandle, value.brakeStatus, newPath);
    result = CheckLastError("RoadWeatherMessage", gkFuncRefGet, result);
  }
  snprintf(newPath, elcount(newPath), "%s.%s", oldPath, "brakePressure");
  value.brakePressure.isValidFlag = C2xIsTokenAvailable(packetHandle, "RoadWeatherMessage", newPath);
  if(value.brakePressure.isValidFlag==1)
  {
    value.brakePressure.value = C2xGetTokenInt(packetHandle, "RoadWeatherMessage", newPath);
    result = CheckLastError("RoadWeatherMessage", gkFuncRefGet, result);
  }
  snprintf(newPath, elcount(newPath), "%s.%s", oldPath, "roadFriction");
  value.roadFriction.isValidFlag = C2xIsTokenAvailable(packetHandle, "RoadWeatherMessage", newPath);
  if(value.roadFriction.isValidFlag==1)
  {
    value.roadFriction.value = C2xGetTokenInt(packetHandle, "RoadWeatherMessage", newPath);
    result = CheckLastError("RoadWeatherMessage", gkFuncRefGet, result);
  }
  snprintf(newPath, elcount(newPath), "%s.%s", oldPath, "sunData");
  value.sunData.isValidFlag = C2xIsTokenAvailable(packetHandle, "RoadWeatherMessage", newPath);
  if(value.sunData.isValidFlag==1)
  {
    value.sunData.value = C2xGetTokenInt(packetHandle, "RoadWeatherMessage", newPath);
    result = CheckLastError("RoadWeatherMessage", gkFuncRefGet, result);
  }
  snprintf(newPath, elcount(newPath), "%s.%s", oldPath, "rainData");
  value.rainData.isValidFlag = C2xIsTokenAvailable(packetHandle, "RoadWeatherMessage", newPath);
  if(value.rainData.isValidFlag==1)
  {
    value.rainData.value = C2xGetTokenInt(packetHandle, "RoadWeatherMessage", newPath);
    result = CheckLastError("RoadWeatherMessage", gkFuncRefGet, result);
  }
  snprintf(newPath, elcount(newPath), "%s.%s", oldPath, "airTemp");
  value.airTemp.isValidFlag = C2xIsTokenAvailable(packetHandle, "RoadWeatherMessage", newPath);
  if(value.airTemp.isValidFlag==1)
  {
    value.airTemp.value = C2xGetTokenInt(packetHandle, "RoadWeatherMessage", newPath);
    result = CheckLastError("RoadWeatherMessage", gkFuncRefGet, result);
  }
  snprintf(newPath, elcount(newPath), "%s.%s", oldPath, "airPres");
  value.airPres.isValidFlag = C2xIsTokenAvailable(packetHandle, "RoadWeatherMessage", newPath);
  if(value.airPres.isValidFlag==1)
  {
    value.airPres.value = C2xGetTokenInt(packetHandle, "RoadWeatherMessage", newPath);
    result = CheckLastError("RoadWeatherMessage", gkFuncRefGet, result);
  }
  snprintf(newPath, elcount(newPath), "%s.%s", oldPath, "steering");
  value.steering.isValidFlag = C2xIsTokenAvailable(packetHandle, "RoadWeatherMessage", newPath);
  if(value.steering.isValidFlag==1)
  {
    GetRoadWeatherMessageProbeVehicleData_VehicleStatus_steeringParams(packetHandle, value.steering, newPath);
    result = CheckLastError("RoadWeatherMessage", gkFuncRefGet, result);
  }
  snprintf(newPath, elcount(newPath), "%s.%s", oldPath, "accelSets");
  value.accelSets.isValidFlag = C2xIsTokenAvailable(packetHandle, "RoadWeatherMessage", newPath);
  if(value.accelSets.isValidFlag==1)
  {
    GetRoadWeatherMessageProbeVehicleData_VehicleStatus_accelSetsParams(packetHandle, value.accelSets, newPath);
    result = CheckLastError("RoadWeatherMessage", gkFuncRefGet, result);
  }
  snprintf(newPath, elcount(newPath), "%s.%s", oldPath, "object");
  value.object.isValidFlag = C2xIsTokenAvailable(packetHandle, "RoadWeatherMessage", newPath);
  if(value.object.isValidFlag==1)
  {
    GetRoadWeatherMessageProbeVehicleData_VehicleStatus_objectParams(packetHandle, value.object, newPath);
    result = CheckLastError("RoadWeatherMessage", gkFuncRefGet, result);
  }
  snprintf(newPath, elcount(newPath), "%s.%s", oldPath, "fullPos");
  value.fullPos.isValidFlag = C2xIsTokenAvailable(packetHandle, "RoadWeatherMessage", newPath);
  if(value.fullPos.isValidFlag==1)
  {
    GetRoadWeatherMessageCommon_FullPositionVectorParams(packetHandle, value.fullPos, newPath);
    result = CheckLastError("RoadWeatherMessage", gkFuncRefGet, result);
  }
  snprintf(newPath, elcount(newPath), "%s.%s", oldPath, "throttlePos");
  value.throttlePos.isValidFlag = C2xIsTokenAvailable(packetHandle, "RoadWeatherMessage", newPath);
  if(value.throttlePos.isValidFlag==1)
  {
    value.throttlePos.value = C2xGetTokenInt(packetHandle, "RoadWeatherMessage", newPath);
    result = CheckLastError("RoadWeatherMessage", gkFuncRefGet, result);
  }
  snprintf(newPath, elcount(newPath), "%s.%s", oldPath, "speedHeadC");
  value.speedHeadC.isValidFlag = C2xIsTokenAvailable(packetHandle, "RoadWeatherMessage", newPath);
  if(value.speedHeadC.isValidFlag==1)
  {
    GetRoadWeatherMessageCommon_SpeedandHeadingandThrottleConfidenceParams(packetHandle, value.speedHeadC, newPath);
    result = CheckLastError("RoadWeatherMessage", gkFuncRefGet, result);
  }
  snprintf(newPath, elcount(newPath), "%s.%s", oldPath, "speedC");
  value.speedC.isValidFlag = C2xIsTokenAvailable(packetHandle, "RoadWeatherMessage", newPath);
  if(value.speedC.isValidFlag==1)
  {
    value.speedC.value = C2xGetTokenInt(packetHandle, "RoadWeatherMessage", newPath);
    result = CheckLastError("RoadWeatherMessage", gkFuncRefGet, result);
  }
  snprintf(newPath, elcount(newPath), "%s.%s", oldPath, "vehicleData");
  value.vehicleData.isValidFlag = C2xIsTokenAvailable(packetHandle, "RoadWeatherMessage", newPath);
  if(value.vehicleData.isValidFlag==1)
  {
    GetRoadWeatherMessageProbeVehicleData_VehicleStatus_vehicleDataParams(packetHandle, value.vehicleData, newPath);
    result = CheckLastError("RoadWeatherMessage", gkFuncRefGet, result);
  }
  snprintf(newPath, elcount(newPath), "%s.%s", oldPath, "vehicleIdent");
  value.vehicleIdent.isValidFlag = C2xIsTokenAvailable(packetHandle, "RoadWeatherMessage", newPath);
  if(value.vehicleIdent.isValidFlag==1)
  {
    GetRoadWeatherMessageProbeVehicleData_VehicleIdentParams(packetHandle, value.vehicleIdent, newPath);
    result = CheckLastError("RoadWeatherMessage", gkFuncRefGet, result);
  }
  snprintf(newPath, elcount(newPath), "%s.%s", oldPath, "j1939data");
  value.j1939data.isValidFlag = C2xIsTokenAvailable(packetHandle, "RoadWeatherMessage", newPath);
  if(value.j1939data.isValidFlag==1)
  {
    GetRoadWeatherMessageProbeVehicleData_J1939dataParams(packetHandle, value.j1939data, newPath);
    result = CheckLastError("RoadWeatherMessage", gkFuncRefGet, result);
  }
  snprintf(newPath, elcount(newPath), "%s.%s", oldPath, "weatherReport");
  value.weatherReport.isValidFlag = C2xIsTokenAvailable(packetHandle, "RoadWeatherMessage", newPath);
  if(value.weatherReport.isValidFlag==1)
  {
    GetRoadWeatherMessageProbeVehicleData_VehicleStatus_weatherReportParams(packetHandle, value.weatherReport, newPath);
    result = CheckLastError("RoadWeatherMessage", gkFuncRefGet, result);
  }
  snprintf(newPath, elcount(newPath), "%s.%s", oldPath, "gnssStatus");
  value.gnssStatus.isValidFlag = C2xIsTokenAvailable(packetHandle, "RoadWeatherMessage", newPath);
  if(value.gnssStatus.isValidFlag==1)
  {
    value.gnssStatus.isValidFlag = 1;
    value.gnssStatus.stringLength = C2xGetTokenLengthBit(packetHandle, "RoadWeatherMessage", newPath);
    if ((result = CheckLastError("RoadWeatherMessage", gkFuncRefGet, result))==0)
    {
      if(value.gnssStatus.stringLength > 0)
      {
        for(j=0; j<value.gnssStatus.stringLength; j++)
        {
          if(C2xGetTokenBitOfBitString(packetHandle, "RoadWeatherMessage", newPath, j) == 0)
          {
            value.gnssStatus.string[j] = '0';
          }
          else if(C2xGetTokenBitOfBitString(packetHandle, "RoadWeatherMessage", newPath, j) == 1)
          {
            value.gnssStatus.string[j] = '1';
          }

          if(value.gnssStatus.stringLength == 1)
          {
            value.gnssStatus.string[1] = '0';
          }
          result = CheckLastError("RoadWeatherMessage", gkFuncRefGet, result);
        }
      }
      else
      {
        for(k = value.gnssStatus.stringLength+1; k > -1; k--)
        {
          if(value.gnssStatus.string[k] == '1')
          {
            value.gnssStatus.string[k] = '0';
          }
        }
      }
    }

  }
  return result;
}

int SetRoadWeatherMessageProbeVehicleData_VehicleStatusParams(LONG packetHandle, struct RoadWeatherMessageProbeVehicleData_VehicleStatus value, char oldPath[])
{
  char newPath[300]; 
  int j;
  int result;

  result = 0;

  snprintf(newPath, elcount(newPath), "%s.%s", oldPath, "lights");
  if(value.lights.isValidFlag==1)
  {
      for(j=0; j<value.lights.stringLength; j++)
      {
        if(value.lights.string[j] == '0')
        {
          C2xSetTokenBitOfBitString(packetHandle, "RoadWeatherMessage", newPath, j, 0);
        }
        else
        {
          C2xSetTokenBitOfBitString(packetHandle, "RoadWeatherMessage", newPath, j, 1);
        }
        result = CheckLastError("RoadWeatherMessage", gkFuncRefGet, result);
      }
  }
  else
  {
    if( C2xIsTokenAvailable(packetHandle, "RoadWeatherMessage", newPath) )
    {
      C2xRemoveToken(packetHandle, "RoadWeatherMessage", newPath);
    }
  }

  snprintf(newPath, elcount(newPath), "%s.%s", oldPath, "lightBar");
  if(value.lightBar.isValidFlag==1)
  {
    C2xSetTokenInt(packetHandle, "RoadWeatherMessage", newPath, value.lightBar.value);
    result = CheckLastError("RoadWeatherMessage", gkFuncRefGet, result);
  }
  else
  {
    if( C2xIsTokenAvailable(packetHandle, "RoadWeatherMessage", newPath) )
    {
      C2xRemoveToken(packetHandle, "RoadWeatherMessage", newPath);
    }
  }

  snprintf(newPath, elcount(newPath), "%s.%s", oldPath, "wipers");
  if(value.wipers.isValidFlag==1)
  {
    SetRoadWeatherMessageCommon_WiperSetParams(packetHandle, value.wipers, newPath);
    result = CheckLastError("RoadWeatherMessage", gkFuncRefGet, result);
  }
  else
  {
    if( C2xIsTokenAvailable(packetHandle, "RoadWeatherMessage", newPath) )
    {
      C2xRemoveToken(packetHandle, "RoadWeatherMessage", newPath);
    }
  }

  snprintf(newPath, elcount(newPath), "%s.%s", oldPath, "brakeStatus");
  if(value.brakeStatus.isValidFlag==1)
  {
    SetRoadWeatherMessageCommon_BrakeSystemStatusParams(packetHandle, value.brakeStatus, newPath);
    result = CheckLastError("RoadWeatherMessage", gkFuncRefGet, result);
  }
  else
  {
    if( C2xIsTokenAvailable(packetHandle, "RoadWeatherMessage", newPath) )
    {
      C2xRemoveToken(packetHandle, "RoadWeatherMessage", newPath);
    }
  }

  snprintf(newPath, elcount(newPath), "%s.%s", oldPath, "brakePressure");
  if(value.brakePressure.isValidFlag==1)
  {
    C2xSetTokenInt(packetHandle, "RoadWeatherMessage", newPath, value.brakePressure.value);
    result = CheckLastError("RoadWeatherMessage", gkFuncRefGet, result);
  }
  else
  {
    if( C2xIsTokenAvailable(packetHandle, "RoadWeatherMessage", newPath) )
    {
      C2xRemoveToken(packetHandle, "RoadWeatherMessage", newPath);
    }
  }

  snprintf(newPath, elcount(newPath), "%s.%s", oldPath, "roadFriction");
  if(value.roadFriction.isValidFlag==1)
  {
    C2xSetTokenInt(packetHandle, "RoadWeatherMessage", newPath, value.roadFriction.value);
    result = CheckLastError("RoadWeatherMessage", gkFuncRefGet, result);
  }
  else
  {
    if( C2xIsTokenAvailable(packetHandle, "RoadWeatherMessage", newPath) )
    {
      C2xRemoveToken(packetHandle, "RoadWeatherMessage", newPath);
    }
  }

  snprintf(newPath, elcount(newPath), "%s.%s", oldPath, "sunData");
  if(value.sunData.isValidFlag==1)
  {
    C2xSetTokenInt(packetHandle, "RoadWeatherMessage", newPath, value.sunData.value);
    result = CheckLastError("RoadWeatherMessage", gkFuncRefGet, result);
  }
  else
  {
    if( C2xIsTokenAvailable(packetHandle, "RoadWeatherMessage", newPath) )
    {
      C2xRemoveToken(packetHandle, "RoadWeatherMessage", newPath);
    }
  }

  snprintf(newPath, elcount(newPath), "%s.%s", oldPath, "rainData");
  if(value.rainData.isValidFlag==1)
  {
    C2xSetTokenInt(packetHandle, "RoadWeatherMessage", newPath, value.rainData.value);
    result = CheckLastError("RoadWeatherMessage", gkFuncRefGet, result);
  }
  else
  {
    if( C2xIsTokenAvailable(packetHandle, "RoadWeatherMessage", newPath) )
    {
      C2xRemoveToken(packetHandle, "RoadWeatherMessage", newPath);
    }
  }

  snprintf(newPath, elcount(newPath), "%s.%s", oldPath, "airTemp");
  if(value.airTemp.isValidFlag==1)
  {
    C2xSetTokenInt(packetHandle, "RoadWeatherMessage", newPath, value.airTemp.value);
    result = CheckLastError("RoadWeatherMessage", gkFuncRefGet, result);
  }
  else
  {
    if( C2xIsTokenAvailable(packetHandle, "RoadWeatherMessage", newPath) )
    {
      C2xRemoveToken(packetHandle, "RoadWeatherMessage", newPath);
    }
  }

  snprintf(newPath, elcount(newPath), "%s.%s", oldPath, "airPres");
  if(value.airPres.isValidFlag==1)
  {
    C2xSetTokenInt(packetHandle, "RoadWeatherMessage", newPath, value.airPres.value);
    result = CheckLastError("RoadWeatherMessage", gkFuncRefGet, result);
  }
  else
  {
    if( C2xIsTokenAvailable(packetHandle, "RoadWeatherMessage", newPath) )
    {
      C2xRemoveToken(packetHandle, "RoadWeatherMessage", newPath);
    }
  }

  snprintf(newPath, elcount(newPath), "%s.%s", oldPath, "steering");
  if(value.steering.isValidFlag==1)
  {
    SetRoadWeatherMessageProbeVehicleData_VehicleStatus_steeringParams(packetHandle, value.steering, newPath);
    result = CheckLastError("RoadWeatherMessage", gkFuncRefGet, result);
  }
  else
  {
    if( C2xIsTokenAvailable(packetHandle, "RoadWeatherMessage", newPath) )
    {
      C2xRemoveToken(packetHandle, "RoadWeatherMessage", newPath);
    }
  }

  snprintf(newPath, elcount(newPath), "%s.%s", oldPath, "accelSets");
  if(value.accelSets.isValidFlag==1)
  {
    SetRoadWeatherMessageProbeVehicleData_VehicleStatus_accelSetsParams(packetHandle, value.accelSets, newPath);
    result = CheckLastError("RoadWeatherMessage", gkFuncRefGet, result);
  }
  else
  {
    if( C2xIsTokenAvailable(packetHandle, "RoadWeatherMessage", newPath) )
    {
      C2xRemoveToken(packetHandle, "RoadWeatherMessage", newPath);
    }
  }

  snprintf(newPath, elcount(newPath), "%s.%s", oldPath, "object");
  if(value.object.isValidFlag==1)
  {
    SetRoadWeatherMessageProbeVehicleData_VehicleStatus_objectParams(packetHandle, value.object, newPath);
    result = CheckLastError("RoadWeatherMessage", gkFuncRefGet, result);
  }
  else
  {
    if( C2xIsTokenAvailable(packetHandle, "RoadWeatherMessage", newPath) )
    {
      C2xRemoveToken(packetHandle, "RoadWeatherMessage", newPath);
    }
  }

  snprintf(newPath, elcount(newPath), "%s.%s", oldPath, "fullPos");
  if(value.fullPos.isValidFlag==1)
  {
    SetRoadWeatherMessageCommon_FullPositionVectorParams(packetHandle, value.fullPos, newPath);
    result = CheckLastError("RoadWeatherMessage", gkFuncRefGet, result);
  }
  else
  {
    if( C2xIsTokenAvailable(packetHandle, "RoadWeatherMessage", newPath) )
    {
      C2xRemoveToken(packetHandle, "RoadWeatherMessage", newPath);
    }
  }

  snprintf(newPath, elcount(newPath), "%s.%s", oldPath, "throttlePos");
  if(value.throttlePos.isValidFlag==1)
  {
    C2xSetTokenInt(packetHandle, "RoadWeatherMessage", newPath, value.throttlePos.value);
    result = CheckLastError("RoadWeatherMessage", gkFuncRefGet, result);
  }
  else
  {
    if( C2xIsTokenAvailable(packetHandle, "RoadWeatherMessage", newPath) )
    {
      C2xRemoveToken(packetHandle, "RoadWeatherMessage", newPath);
    }
  }

  snprintf(newPath, elcount(newPath), "%s.%s", oldPath, "speedHeadC");
  if(value.speedHeadC.isValidFlag==1)
  {
    SetRoadWeatherMessageCommon_SpeedandHeadingandThrottleConfidenceParams(packetHandle, value.speedHeadC, newPath);
    result = CheckLastError("RoadWeatherMessage", gkFuncRefGet, result);
  }
  else
  {
    if( C2xIsTokenAvailable(packetHandle, "RoadWeatherMessage", newPath) )
    {
      C2xRemoveToken(packetHandle, "RoadWeatherMessage", newPath);
    }
  }

  snprintf(newPath, elcount(newPath), "%s.%s", oldPath, "speedC");
  if(value.speedC.isValidFlag==1)
  {
    C2xSetTokenInt(packetHandle, "RoadWeatherMessage", newPath, value.speedC.value);
    result = CheckLastError("RoadWeatherMessage", gkFuncRefGet, result);
  }
  else
  {
    if( C2xIsTokenAvailable(packetHandle, "RoadWeatherMessage", newPath) )
    {
      C2xRemoveToken(packetHandle, "RoadWeatherMessage", newPath);
    }
  }

  snprintf(newPath, elcount(newPath), "%s.%s", oldPath, "vehicleData");
  if(value.vehicleData.isValidFlag==1)
  {
    SetRoadWeatherMessageProbeVehicleData_VehicleStatus_vehicleDataParams(packetHandle, value.vehicleData, newPath);
    result = CheckLastError("RoadWeatherMessage", gkFuncRefGet, result);
  }
  else
  {
    if( C2xIsTokenAvailable(packetHandle, "RoadWeatherMessage", newPath) )
    {
      C2xRemoveToken(packetHandle, "RoadWeatherMessage", newPath);
    }
  }

  snprintf(newPath, elcount(newPath), "%s.%s", oldPath, "vehicleIdent");
  if(value.vehicleIdent.isValidFlag==1)
  {
    SetRoadWeatherMessageProbeVehicleData_VehicleIdentParams(packetHandle, value.vehicleIdent, newPath);
    result = CheckLastError("RoadWeatherMessage", gkFuncRefGet, result);
  }
  else
  {
    if( C2xIsTokenAvailable(packetHandle, "RoadWeatherMessage", newPath) )
    {
      C2xRemoveToken(packetHandle, "RoadWeatherMessage", newPath);
    }
  }

  snprintf(newPath, elcount(newPath), "%s.%s", oldPath, "j1939data");
  if(value.j1939data.isValidFlag==1)
  {
    SetRoadWeatherMessageProbeVehicleData_J1939dataParams(packetHandle, value.j1939data, newPath);
    result = CheckLastError("RoadWeatherMessage", gkFuncRefGet, result);
  }
  else
  {
    if( C2xIsTokenAvailable(packetHandle, "RoadWeatherMessage", newPath) )
    {
      C2xRemoveToken(packetHandle, "RoadWeatherMessage", newPath);
    }
  }

  snprintf(newPath, elcount(newPath), "%s.%s", oldPath, "weatherReport");
  if(value.weatherReport.isValidFlag==1)
  {
    SetRoadWeatherMessageProbeVehicleData_VehicleStatus_weatherReportParams(packetHandle, value.weatherReport, newPath);
    result = CheckLastError("RoadWeatherMessage", gkFuncRefGet, result);
  }
  else
  {
    if( C2xIsTokenAvailable(packetHandle, "RoadWeatherMessage", newPath) )
    {
      C2xRemoveToken(packetHandle, "RoadWeatherMessage", newPath);
    }
  }

  snprintf(newPath, elcount(newPath), "%s.%s", oldPath, "gnssStatus");
  if(value.gnssStatus.isValidFlag==1)
  {
      for(j=0; j<value.gnssStatus.stringLength; j++)
      {
        if(value.gnssStatus.string[j] == '0')
        {
          C2xSetTokenBitOfBitString(packetHandle, "RoadWeatherMessage", newPath, j, 0);
        }
        else
        {
          C2xSetTokenBitOfBitString(packetHandle, "RoadWeatherMessage", newPath, j, 1);
        }
        result = CheckLastError("RoadWeatherMessage", gkFuncRefGet, result);
      }
  }
  else
  {
    if( C2xIsTokenAvailable(packetHandle, "RoadWeatherMessage", newPath) )
    {
      C2xRemoveToken(packetHandle, "RoadWeatherMessage", newPath);
    }
  }

  return result;
}

int GetRoadWeatherMessageNtcipAirTemperatureParams(LONG packetHandle, struct RoadWeatherMessageNtcipAirTemperature value, char oldPath[])
{
  char newPath[300];
  int result;

  result = 0;

  snprintf(newPath, elcount(newPath), "%s.%s", oldPath, "temperature");
  value.temperature = C2xGetTokenInt(packetHandle, "RoadWeatherMessage", newPath);
  result = CheckLastError("RoadWeatherMessage", gkFuncRefGet, result);

  snprintf(newPath, elcount(newPath), "%s.%s", oldPath, "measurementStdDev");
  value.measurementStdDev.isValidFlag = C2xIsTokenAvailable(packetHandle, "RoadWeatherMessage", newPath);
  if(value.measurementStdDev.isValidFlag==1)
  {
    value.measurementStdDev.value = C2xGetTokenInt(packetHandle, "RoadWeatherMessage", newPath);
    result = CheckLastError("RoadWeatherMessage", gkFuncRefGet, result);
  }
  snprintf(newPath, elcount(newPath), "%s.%s", oldPath, "tempSensorHeight");
  value.tempSensorHeight.isValidFlag = C2xIsTokenAvailable(packetHandle, "RoadWeatherMessage", newPath);
  if(value.tempSensorHeight.isValidFlag==1)
  {
    value.tempSensorHeight.value = C2xGetTokenInt(packetHandle, "RoadWeatherMessage", newPath);
    result = CheckLastError("RoadWeatherMessage", gkFuncRefGet, result);
  }
  return result;
}

int SetRoadWeatherMessageNtcipAirTemperatureParams(LONG packetHandle, struct RoadWeatherMessageNtcipAirTemperature value, char oldPath[])
{
  char newPath[300];
  int result;

  result = 0;

  snprintf(newPath, elcount(newPath), "%s.%s", oldPath, "temperature");
  C2xSetTokenInt(packetHandle, "RoadWeatherMessage", newPath, value.temperature);
  result = CheckLastError("RoadWeatherMessage", gkFuncRefGet, result);

  snprintf(newPath, elcount(newPath), "%s.%s", oldPath, "measurementStdDev");
  if(value.measurementStdDev.isValidFlag==1)
  {
    if (value.measurementStdDev.value < 1)
    {
        C2xSetTokenInt(packetHandle, "RoadWeatherMessage", newPath, 1);
    }
    else if (value.measurementStdDev.value > 16)
    {
        C2xSetTokenInt(packetHandle, "RoadWeatherMessage", newPath, 16);
    }
    else
    {
        C2xSetTokenInt(packetHandle, "RoadWeatherMessage", newPath, value.measurementStdDev.value);
    }
    result = CheckLastError("RoadWeatherMessage", gkFuncRefGet, result);
  }
  else
  {
    if( C2xIsTokenAvailable(packetHandle, "RoadWeatherMessage", newPath) )
    {
      C2xRemoveToken(packetHandle, "RoadWeatherMessage", newPath);
    }
  }

  snprintf(newPath, elcount(newPath), "%s.%s", oldPath, "tempSensorHeight");
  if(value.tempSensorHeight.isValidFlag==1)
  {
    C2xSetTokenInt(packetHandle, "RoadWeatherMessage", newPath, value.tempSensorHeight.value);
    result = CheckLastError("RoadWeatherMessage", gkFuncRefGet, result);
  }
  else
  {
    if( C2xIsTokenAvailable(packetHandle, "RoadWeatherMessage", newPath) )
    {
      C2xRemoveToken(packetHandle, "RoadWeatherMessage", newPath);
    }
  }

  return result;
}

int GetRoadWeatherMessageNtcipAtmosphericPressureParams(LONG packetHandle, struct RoadWeatherMessageNtcipAtmosphericPressure value, char oldPath[])
{
  char newPath[300];
  int result;

  result = 0;

  snprintf(newPath, elcount(newPath), "%s.%s", oldPath, "pressure");
  value.pressure = C2xGetTokenInt(packetHandle, "RoadWeatherMessage", newPath);
  result = CheckLastError("RoadWeatherMessage", gkFuncRefGet, result);

  snprintf(newPath, elcount(newPath), "%s.%s", oldPath, "measurementStdDev");
  value.measurementStdDev.isValidFlag = C2xIsTokenAvailable(packetHandle, "RoadWeatherMessage", newPath);
  if(value.measurementStdDev.isValidFlag==1)
  {
    value.measurementStdDev.value = C2xGetTokenInt(packetHandle, "RoadWeatherMessage", newPath);
    result = CheckLastError("RoadWeatherMessage", gkFuncRefGet, result);
  }
  return result;
}

int SetRoadWeatherMessageNtcipAtmosphericPressureParams(LONG packetHandle, struct RoadWeatherMessageNtcipAtmosphericPressure value, char oldPath[])
{
  char newPath[300];
  int result;

  result = 0;

  snprintf(newPath, elcount(newPath), "%s.%s", oldPath, "pressure");
  C2xSetTokenInt(packetHandle, "RoadWeatherMessage", newPath, value.pressure);
  result = CheckLastError("RoadWeatherMessage", gkFuncRefGet, result);

  snprintf(newPath, elcount(newPath), "%s.%s", oldPath, "measurementStdDev");
  if(value.measurementStdDev.isValidFlag==1)
  {
    if (value.measurementStdDev.value < 1)
    {
        C2xSetTokenInt(packetHandle, "RoadWeatherMessage", newPath, 1);
    }
    else if (value.measurementStdDev.value > 16)
    {
        C2xSetTokenInt(packetHandle, "RoadWeatherMessage", newPath, 16);
    }
    else
    {
        C2xSetTokenInt(packetHandle, "RoadWeatherMessage", newPath, value.measurementStdDev.value);
    }
    result = CheckLastError("RoadWeatherMessage", gkFuncRefGet, result);
  }
  else
  {
    if( C2xIsTokenAvailable(packetHandle, "RoadWeatherMessage", newPath) )
    {
      C2xRemoveToken(packetHandle, "RoadWeatherMessage", newPath);
    }
  }

  return result;
}

int GetRoadWeatherMessageNtcipWindParams(LONG packetHandle, struct RoadWeatherMessageNtcipWind value, char oldPath[])
{
  char newPath[300];
  int result;

  result = 0;

  snprintf(newPath, elcount(newPath), "%s.%s", oldPath, "avgSpeed");
  value.avgSpeed.isValidFlag = C2xIsTokenAvailable(packetHandle, "RoadWeatherMessage", newPath);
  if(value.avgSpeed.isValidFlag==1)
  {
    value.avgSpeed.value = C2xGetTokenInt(packetHandle, "RoadWeatherMessage", newPath);
    result = CheckLastError("RoadWeatherMessage", gkFuncRefGet, result);
  }
  snprintf(newPath, elcount(newPath), "%s.%s", oldPath, "avgDirection");
  value.avgDirection.isValidFlag = C2xIsTokenAvailable(packetHandle, "RoadWeatherMessage", newPath);
  if(value.avgDirection.isValidFlag==1)
  {
    value.avgDirection.value = C2xGetTokenInt(packetHandle, "RoadWeatherMessage", newPath);
    result = CheckLastError("RoadWeatherMessage", gkFuncRefGet, result);
  }
  snprintf(newPath, elcount(newPath), "%s.%s", oldPath, "currentSpeed");
  value.currentSpeed.isValidFlag = C2xIsTokenAvailable(packetHandle, "RoadWeatherMessage", newPath);
  if(value.currentSpeed.isValidFlag==1)
  {
    value.currentSpeed.value = C2xGetTokenInt(packetHandle, "RoadWeatherMessage", newPath);
    result = CheckLastError("RoadWeatherMessage", gkFuncRefGet, result);
  }
  snprintf(newPath, elcount(newPath), "%s.%s", oldPath, "curDirection");
  value.curDirection.isValidFlag = C2xIsTokenAvailable(packetHandle, "RoadWeatherMessage", newPath);
  if(value.curDirection.isValidFlag==1)
  {
    value.curDirection.value = C2xGetTokenInt(packetHandle, "RoadWeatherMessage", newPath);
    result = CheckLastError("RoadWeatherMessage", gkFuncRefGet, result);
  }
  snprintf(newPath, elcount(newPath), "%s.%s", oldPath, "gustSpeed");
  value.gustSpeed.isValidFlag = C2xIsTokenAvailable(packetHandle, "RoadWeatherMessage", newPath);
  if(value.gustSpeed.isValidFlag==1)
  {
    value.gustSpeed.value = C2xGetTokenInt(packetHandle, "RoadWeatherMessage", newPath);
    result = CheckLastError("RoadWeatherMessage", gkFuncRefGet, result);
  }
  snprintf(newPath, elcount(newPath), "%s.%s", oldPath, "gustDirection");
  value.gustDirection.isValidFlag = C2xIsTokenAvailable(packetHandle, "RoadWeatherMessage", newPath);
  if(value.gustDirection.isValidFlag==1)
  {
    value.gustDirection.value = C2xGetTokenInt(packetHandle, "RoadWeatherMessage", newPath);
    result = CheckLastError("RoadWeatherMessage", gkFuncRefGet, result);
  }
  return result;
}

int SetRoadWeatherMessageNtcipWindParams(LONG packetHandle, struct RoadWeatherMessageNtcipWind value, char oldPath[])
{
  char newPath[300];
  int result;

  result = 0;

  snprintf(newPath, elcount(newPath), "%s.%s", oldPath, "avgSpeed");
  if(value.avgSpeed.isValidFlag==1)
  {
    C2xSetTokenInt(packetHandle, "RoadWeatherMessage", newPath, value.avgSpeed.value);
    result = CheckLastError("RoadWeatherMessage", gkFuncRefGet, result);
  }
  else
  {
    if( C2xIsTokenAvailable(packetHandle, "RoadWeatherMessage", newPath) )
    {
      C2xRemoveToken(packetHandle, "RoadWeatherMessage", newPath);
    }
  }

  snprintf(newPath, elcount(newPath), "%s.%s", oldPath, "avgDirection");
  if(value.avgDirection.isValidFlag==1)
  {
    C2xSetTokenInt(packetHandle, "RoadWeatherMessage", newPath, value.avgDirection.value);
    result = CheckLastError("RoadWeatherMessage", gkFuncRefGet, result);
  }
  else
  {
    if( C2xIsTokenAvailable(packetHandle, "RoadWeatherMessage", newPath) )
    {
      C2xRemoveToken(packetHandle, "RoadWeatherMessage", newPath);
    }
  }

  snprintf(newPath, elcount(newPath), "%s.%s", oldPath, "currentSpeed");
  if(value.currentSpeed.isValidFlag==1)
  {
    C2xSetTokenInt(packetHandle, "RoadWeatherMessage", newPath, value.currentSpeed.value);
    result = CheckLastError("RoadWeatherMessage", gkFuncRefGet, result);
  }
  else
  {
    if( C2xIsTokenAvailable(packetHandle, "RoadWeatherMessage", newPath) )
    {
      C2xRemoveToken(packetHandle, "RoadWeatherMessage", newPath);
    }
  }

  snprintf(newPath, elcount(newPath), "%s.%s", oldPath, "curDirection");
  if(value.curDirection.isValidFlag==1)
  {
    C2xSetTokenInt(packetHandle, "RoadWeatherMessage", newPath, value.curDirection.value);
    result = CheckLastError("RoadWeatherMessage", gkFuncRefGet, result);
  }
  else
  {
    if( C2xIsTokenAvailable(packetHandle, "RoadWeatherMessage", newPath) )
    {
      C2xRemoveToken(packetHandle, "RoadWeatherMessage", newPath);
    }
  }

  snprintf(newPath, elcount(newPath), "%s.%s", oldPath, "gustSpeed");
  if(value.gustSpeed.isValidFlag==1)
  {
    C2xSetTokenInt(packetHandle, "RoadWeatherMessage", newPath, value.gustSpeed.value);
    result = CheckLastError("RoadWeatherMessage", gkFuncRefGet, result);
  }
  else
  {
    if( C2xIsTokenAvailable(packetHandle, "RoadWeatherMessage", newPath) )
    {
      C2xRemoveToken(packetHandle, "RoadWeatherMessage", newPath);
    }
  }

  snprintf(newPath, elcount(newPath), "%s.%s", oldPath, "gustDirection");
  if(value.gustDirection.isValidFlag==1)
  {
    C2xSetTokenInt(packetHandle, "RoadWeatherMessage", newPath, value.gustDirection.value);
    result = CheckLastError("RoadWeatherMessage", gkFuncRefGet, result);
  }
  else
  {
    if( C2xIsTokenAvailable(packetHandle, "RoadWeatherMessage", newPath) )
    {
      C2xRemoveToken(packetHandle, "RoadWeatherMessage", newPath);
    }
  }

  return result;
}

int GetRoadWeatherMessageNtcipRelativeHumidityParams(LONG packetHandle, struct RoadWeatherMessageNtcipRelativeHumidity value, char oldPath[])
{
  char newPath[300];
  int result;

  result = 0;

  snprintf(newPath, elcount(newPath), "%s.%s", oldPath, "relHumidity");
  value.relHumidity = C2xGetTokenInt(packetHandle, "RoadWeatherMessage", newPath);
  result = CheckLastError("RoadWeatherMessage", gkFuncRefGet, result);

  snprintf(newPath, elcount(newPath), "%s.%s", oldPath, "source");
  value.source.isValidFlag = C2xIsTokenAvailable(packetHandle, "RoadWeatherMessage", newPath);
  if(value.source.isValidFlag==1)
  {
    value.source.value = C2xGetTokenInt(packetHandle, "RoadWeatherMessage", newPath);
    result = CheckLastError("RoadWeatherMessage", gkFuncRefGet, result);
  }
  return result;
}

int SetRoadWeatherMessageNtcipRelativeHumidityParams(LONG packetHandle, struct RoadWeatherMessageNtcipRelativeHumidity value, char oldPath[])
{
  char newPath[300];
  int result;

  result = 0;

  snprintf(newPath, elcount(newPath), "%s.%s", oldPath, "relHumidity");
  C2xSetTokenInt(packetHandle, "RoadWeatherMessage", newPath, value.relHumidity);
  result = CheckLastError("RoadWeatherMessage", gkFuncRefGet, result);

  snprintf(newPath, elcount(newPath), "%s.%s", oldPath, "source");
  if(value.source.isValidFlag==1)
  {
    C2xSetTokenInt(packetHandle, "RoadWeatherMessage", newPath, value.source.value);
    result = CheckLastError("RoadWeatherMessage", gkFuncRefGet, result);
  }
  else
  {
    if( C2xIsTokenAvailable(packetHandle, "RoadWeatherMessage", newPath) )
    {
      C2xRemoveToken(packetHandle, "RoadWeatherMessage", newPath);
    }
  }

  return result;
}

int GetRoadWeatherMessageNtcipDewPointParams(LONG packetHandle, struct RoadWeatherMessageNtcipDewPoint value, char oldPath[])
{
  char newPath[300];
  int result;

  result = 0;

  snprintf(newPath, elcount(newPath), "%s.%s", oldPath, "dewTemp");
  value.dewTemp = C2xGetTokenInt(packetHandle, "RoadWeatherMessage", newPath);
  result = CheckLastError("RoadWeatherMessage", gkFuncRefGet, result);

  snprintf(newPath, elcount(newPath), "%s.%s", oldPath, "source");
  value.source.isValidFlag = C2xIsTokenAvailable(packetHandle, "RoadWeatherMessage", newPath);
  if(value.source.isValidFlag==1)
  {
    value.source.value = C2xGetTokenInt(packetHandle, "RoadWeatherMessage", newPath);
    result = CheckLastError("RoadWeatherMessage", gkFuncRefGet, result);
  }
  snprintf(newPath, elcount(newPath), "%s.%s", oldPath, "measurementStdDev");
  value.measurementStdDev.isValidFlag = C2xIsTokenAvailable(packetHandle, "RoadWeatherMessage", newPath);
  if(value.measurementStdDev.isValidFlag==1)
  {
    value.measurementStdDev.value = C2xGetTokenInt(packetHandle, "RoadWeatherMessage", newPath);
    result = CheckLastError("RoadWeatherMessage", gkFuncRefGet, result);
  }
  return result;
}

int SetRoadWeatherMessageNtcipDewPointParams(LONG packetHandle, struct RoadWeatherMessageNtcipDewPoint value, char oldPath[])
{
  char newPath[300];
  int result;

  result = 0;

  snprintf(newPath, elcount(newPath), "%s.%s", oldPath, "dewTemp");
  C2xSetTokenInt(packetHandle, "RoadWeatherMessage", newPath, value.dewTemp);
  result = CheckLastError("RoadWeatherMessage", gkFuncRefGet, result);

  snprintf(newPath, elcount(newPath), "%s.%s", oldPath, "source");
  if(value.source.isValidFlag==1)
  {
    C2xSetTokenInt(packetHandle, "RoadWeatherMessage", newPath, value.source.value);
    result = CheckLastError("RoadWeatherMessage", gkFuncRefGet, result);
  }
  else
  {
    if( C2xIsTokenAvailable(packetHandle, "RoadWeatherMessage", newPath) )
    {
      C2xRemoveToken(packetHandle, "RoadWeatherMessage", newPath);
    }
  }

  snprintf(newPath, elcount(newPath), "%s.%s", oldPath, "measurementStdDev");
  if(value.measurementStdDev.isValidFlag==1)
  {
    if (value.measurementStdDev.value < 1)
    {
        C2xSetTokenInt(packetHandle, "RoadWeatherMessage", newPath, 1);
    }
    else if (value.measurementStdDev.value > 16)
    {
        C2xSetTokenInt(packetHandle, "RoadWeatherMessage", newPath, 16);
    }
    else
    {
        C2xSetTokenInt(packetHandle, "RoadWeatherMessage", newPath, value.measurementStdDev.value);
    }
    result = CheckLastError("RoadWeatherMessage", gkFuncRefGet, result);
  }
  else
  {
    if( C2xIsTokenAvailable(packetHandle, "RoadWeatherMessage", newPath) )
    {
      C2xRemoveToken(packetHandle, "RoadWeatherMessage", newPath);
    }
  }

  return result;
}

int GetRoadWeatherMessageCommon_RoadRoughnessParams(LONG packetHandle, struct RoadWeatherMessageCommon_RoadRoughness value, char oldPath[])
{
  char newPath[300];
  int result;

  result = 0;

  snprintf(newPath, elcount(newPath), "%s.%s", oldPath, "meanVerticalVariation");
  value.meanVerticalVariation = C2xGetTokenInt(packetHandle, "RoadWeatherMessage", newPath);
  result = CheckLastError("RoadWeatherMessage", gkFuncRefGet, result);

  snprintf(newPath, elcount(newPath), "%s.%s", oldPath, "verticalVariationStdDev");
  value.verticalVariationStdDev.isValidFlag = C2xIsTokenAvailable(packetHandle, "RoadWeatherMessage", newPath);
  if(value.verticalVariationStdDev.isValidFlag==1)
  {
    value.verticalVariationStdDev.value = C2xGetTokenInt(packetHandle, "RoadWeatherMessage", newPath);
    result = CheckLastError("RoadWeatherMessage", gkFuncRefGet, result);
  }
  snprintf(newPath, elcount(newPath), "%s.%s", oldPath, "meanHorizontalVariation");
  value.meanHorizontalVariation.isValidFlag = C2xIsTokenAvailable(packetHandle, "RoadWeatherMessage", newPath);
  if(value.meanHorizontalVariation.isValidFlag==1)
  {
    value.meanHorizontalVariation.value = C2xGetTokenInt(packetHandle, "RoadWeatherMessage", newPath);
    result = CheckLastError("RoadWeatherMessage", gkFuncRefGet, result);
  }
  snprintf(newPath, elcount(newPath), "%s.%s", oldPath, "horizontalVariationStdDev");
  value.horizontalVariationStdDev.isValidFlag = C2xIsTokenAvailable(packetHandle, "RoadWeatherMessage", newPath);
  if(value.horizontalVariationStdDev.isValidFlag==1)
  {
    value.horizontalVariationStdDev.value = C2xGetTokenInt(packetHandle, "RoadWeatherMessage", newPath);
    result = CheckLastError("RoadWeatherMessage", gkFuncRefGet, result);
  }
  return result;
}

int SetRoadWeatherMessageCommon_RoadRoughnessParams(LONG packetHandle, struct RoadWeatherMessageCommon_RoadRoughness value, char oldPath[])
{
  char newPath[300];
  int result;

  result = 0;

  snprintf(newPath, elcount(newPath), "%s.%s", oldPath, "meanVerticalVariation");
  C2xSetTokenInt(packetHandle, "RoadWeatherMessage", newPath, value.meanVerticalVariation);
  result = CheckLastError("RoadWeatherMessage", gkFuncRefGet, result);

  snprintf(newPath, elcount(newPath), "%s.%s", oldPath, "verticalVariationStdDev");
  if(value.verticalVariationStdDev.isValidFlag==1)
  {
    C2xSetTokenInt(packetHandle, "RoadWeatherMessage", newPath, value.verticalVariationStdDev.value);
    result = CheckLastError("RoadWeatherMessage", gkFuncRefGet, result);
  }
  else
  {
    if( C2xIsTokenAvailable(packetHandle, "RoadWeatherMessage", newPath) )
    {
      C2xRemoveToken(packetHandle, "RoadWeatherMessage", newPath);
    }
  }

  snprintf(newPath, elcount(newPath), "%s.%s", oldPath, "meanHorizontalVariation");
  if(value.meanHorizontalVariation.isValidFlag==1)
  {
    C2xSetTokenInt(packetHandle, "RoadWeatherMessage", newPath, value.meanHorizontalVariation.value);
    result = CheckLastError("RoadWeatherMessage", gkFuncRefGet, result);
  }
  else
  {
    if( C2xIsTokenAvailable(packetHandle, "RoadWeatherMessage", newPath) )
    {
      C2xRemoveToken(packetHandle, "RoadWeatherMessage", newPath);
    }
  }

  snprintf(newPath, elcount(newPath), "%s.%s", oldPath, "horizontalVariationStdDev");
  if(value.horizontalVariationStdDev.isValidFlag==1)
  {
    C2xSetTokenInt(packetHandle, "RoadWeatherMessage", newPath, value.horizontalVariationStdDev.value);
    result = CheckLastError("RoadWeatherMessage", gkFuncRefGet, result);
  }
  else
  {
    if( C2xIsTokenAvailable(packetHandle, "RoadWeatherMessage", newPath) )
    {
      C2xRemoveToken(packetHandle, "RoadWeatherMessage", newPath);
    }
  }

  return result;
}

int GetRoadWeatherMessageNtcipPavementParams(LONG packetHandle, struct RoadWeatherMessageNtcipPavement value, char oldPath[])
{
  char newPath[300];
  int result;

  result = 0;

  snprintf(newPath, elcount(newPath), "%s.%s", oldPath, "surfaceTemp");
  value.surfaceTemp.isValidFlag = C2xIsTokenAvailable(packetHandle, "RoadWeatherMessage", newPath);
  if(value.surfaceTemp.isValidFlag==1)
  {
    value.surfaceTemp.value = C2xGetTokenInt(packetHandle, "RoadWeatherMessage", newPath);
    result = CheckLastError("RoadWeatherMessage", gkFuncRefGet, result);
  }
  snprintf(newPath, elcount(newPath), "%s.%s", oldPath, "tempStdDev");
  value.tempStdDev.isValidFlag = C2xIsTokenAvailable(packetHandle, "RoadWeatherMessage", newPath);
  if(value.tempStdDev.isValidFlag==1)
  {
    value.tempStdDev.value = C2xGetTokenInt(packetHandle, "RoadWeatherMessage", newPath);
    result = CheckLastError("RoadWeatherMessage", gkFuncRefGet, result);
  }
  snprintf(newPath, elcount(newPath), "%s.%s", oldPath, "condition");
  value.condition.isValidFlag = C2xIsTokenAvailable(packetHandle, "RoadWeatherMessage", newPath);
  if(value.condition.isValidFlag==1)
  {
    value.condition.value = C2xGetTokenInt(packetHandle, "RoadWeatherMessage", newPath);
    result = CheckLastError("RoadWeatherMessage", gkFuncRefGet, result);
  }
  snprintf(newPath, elcount(newPath), "%s.%s", oldPath, "moistureDepth");
  value.moistureDepth.isValidFlag = C2xIsTokenAvailable(packetHandle, "RoadWeatherMessage", newPath);
  if(value.moistureDepth.isValidFlag==1)
  {
    value.moistureDepth.value = C2xGetTokenInt(packetHandle, "RoadWeatherMessage", newPath);
    result = CheckLastError("RoadWeatherMessage", gkFuncRefGet, result);
  }
  snprintf(newPath, elcount(newPath), "%s.%s", oldPath, "roadRoughness");
  value.roadRoughness.isValidFlag = C2xIsTokenAvailable(packetHandle, "RoadWeatherMessage", newPath);
  if(value.roadRoughness.isValidFlag==1)
  {
    GetRoadWeatherMessageCommon_RoadRoughnessParams(packetHandle, value.roadRoughness, newPath);
    result = CheckLastError("RoadWeatherMessage", gkFuncRefGet, result);
  }
  return result;
}

int SetRoadWeatherMessageNtcipPavementParams(LONG packetHandle, struct RoadWeatherMessageNtcipPavement value, char oldPath[])
{
  char newPath[300];
  int result;

  result = 0;

  snprintf(newPath, elcount(newPath), "%s.%s", oldPath, "surfaceTemp");
  if(value.surfaceTemp.isValidFlag==1)
  {
    C2xSetTokenInt(packetHandle, "RoadWeatherMessage", newPath, value.surfaceTemp.value);
    result = CheckLastError("RoadWeatherMessage", gkFuncRefGet, result);
  }
  else
  {
    if( C2xIsTokenAvailable(packetHandle, "RoadWeatherMessage", newPath) )
    {
      C2xRemoveToken(packetHandle, "RoadWeatherMessage", newPath);
    }
  }

  snprintf(newPath, elcount(newPath), "%s.%s", oldPath, "tempStdDev");
  if(value.tempStdDev.isValidFlag==1)
  {
    if (value.tempStdDev.value < 1)
    {
        C2xSetTokenInt(packetHandle, "RoadWeatherMessage", newPath, 1);
    }
    else if (value.tempStdDev.value > 16)
    {
        C2xSetTokenInt(packetHandle, "RoadWeatherMessage", newPath, 16);
    }
    else
    {
        C2xSetTokenInt(packetHandle, "RoadWeatherMessage", newPath, value.tempStdDev.value);
    }
    result = CheckLastError("RoadWeatherMessage", gkFuncRefGet, result);
  }
  else
  {
    if( C2xIsTokenAvailable(packetHandle, "RoadWeatherMessage", newPath) )
    {
      C2xRemoveToken(packetHandle, "RoadWeatherMessage", newPath);
    }
  }

  snprintf(newPath, elcount(newPath), "%s.%s", oldPath, "condition");
  if(value.condition.isValidFlag==1)
  {
    if (value.condition.value < 1)
    {
        C2xSetTokenInt(packetHandle, "RoadWeatherMessage", newPath, 1);
    }
    else if (value.condition.value > 13)
    {
        C2xSetTokenInt(packetHandle, "RoadWeatherMessage", newPath, 13);
    }
    else
    {
        C2xSetTokenInt(packetHandle, "RoadWeatherMessage", newPath, value.condition.value);
    }
    result = CheckLastError("RoadWeatherMessage", gkFuncRefGet, result);
  }
  else
  {
    if( C2xIsTokenAvailable(packetHandle, "RoadWeatherMessage", newPath) )
    {
      C2xRemoveToken(packetHandle, "RoadWeatherMessage", newPath);
    }
  }

  snprintf(newPath, elcount(newPath), "%s.%s", oldPath, "moistureDepth");
  if(value.moistureDepth.isValidFlag==1)
  {
    C2xSetTokenInt(packetHandle, "RoadWeatherMessage", newPath, value.moistureDepth.value);
    result = CheckLastError("RoadWeatherMessage", gkFuncRefGet, result);
  }
  else
  {
    if( C2xIsTokenAvailable(packetHandle, "RoadWeatherMessage", newPath) )
    {
      C2xRemoveToken(packetHandle, "RoadWeatherMessage", newPath);
    }
  }

  snprintf(newPath, elcount(newPath), "%s.%s", oldPath, "roadRoughness");
  if(value.roadRoughness.isValidFlag==1)
  {
    SetRoadWeatherMessageCommon_RoadRoughnessParams(packetHandle, value.roadRoughness, newPath);
    result = CheckLastError("RoadWeatherMessage", gkFuncRefGet, result);
  }
  else
  {
    if( C2xIsTokenAvailable(packetHandle, "RoadWeatherMessage", newPath) )
    {
      C2xRemoveToken(packetHandle, "RoadWeatherMessage", newPath);
    }
  }

  return result;
}

int GetRoadWeatherMessageNtcipVisibilityParams(LONG packetHandle, struct RoadWeatherMessageNtcipVisibility value, char oldPath[])
{
  char newPath[300];
  int result;

  result = 0;

  snprintf(newPath, elcount(newPath), "%s.%s", oldPath, "visibility");
  value.visibility = C2xGetTokenInt(packetHandle, "RoadWeatherMessage", newPath);
  result = CheckLastError("RoadWeatherMessage", gkFuncRefGet, result);

  return result;
}

int SetRoadWeatherMessageNtcipVisibilityParams(LONG packetHandle, struct RoadWeatherMessageNtcipVisibility value, char oldPath[])
{
  char newPath[300];
  int result;

  result = 0;

  snprintf(newPath, elcount(newPath), "%s.%s", oldPath, "visibility");
  C2xSetTokenInt(packetHandle, "RoadWeatherMessage", newPath, value.visibility);
  result = CheckLastError("RoadWeatherMessage", gkFuncRefGet, result);

  return result;
}

int GetRoadWeatherMessageNtcipVisibilitySituationParams(LONG packetHandle, struct RoadWeatherMessageNtcipVisibilitySituation value, char oldPath[])
{
  char newPath[300];
  int result;

  result = 0;

  snprintf(newPath, elcount(newPath), "%s.%s", oldPath, "situation");
  value.situation = C2xGetTokenInt(packetHandle, "RoadWeatherMessage", newPath);
  result = CheckLastError("RoadWeatherMessage", gkFuncRefGet, result);

  return result;
}

int SetRoadWeatherMessageNtcipVisibilitySituationParams(LONG packetHandle, struct RoadWeatherMessageNtcipVisibilitySituation value, char oldPath[])
{
  char newPath[300];
  int result;

  result = 0;

  snprintf(newPath, elcount(newPath), "%s.%s", oldPath, "situation");
  if (value.situation < 1)
  {
    C2xSetTokenInt(packetHandle, "RoadWeatherMessage", newPath, 1);
  }
  else if (value.situation > 12)
  {
    C2xSetTokenInt(packetHandle, "RoadWeatherMessage", newPath, 12);
  }
  else
  {
    C2xSetTokenInt(packetHandle, "RoadWeatherMessage", newPath, value.situation);
  }
  result = CheckLastError("RoadWeatherMessage", gkFuncRefGet, result);

  return result;
}

int GetRoadWeatherMessageNtcipCloudSituationParams(LONG packetHandle, struct RoadWeatherMessageNtcipCloudSituation value, char oldPath[])
{
  char newPath[300];
  int result;

  result = 0;

  snprintf(newPath, elcount(newPath), "%s.%s", oldPath, "situation");
  value.situation = C2xGetTokenInt(packetHandle, "RoadWeatherMessage", newPath);
  result = CheckLastError("RoadWeatherMessage", gkFuncRefGet, result);

  return result;
}

int SetRoadWeatherMessageNtcipCloudSituationParams(LONG packetHandle, struct RoadWeatherMessageNtcipCloudSituation value, char oldPath[])
{
  char newPath[300];
  int result;

  result = 0;

  snprintf(newPath, elcount(newPath), "%s.%s", oldPath, "situation");
  C2xSetTokenInt(packetHandle, "RoadWeatherMessage", newPath, value.situation);
  result = CheckLastError("RoadWeatherMessage", gkFuncRefGet, result);

  return result;
}

int GetRoadWeatherMessageNtcipPrecipitationParams(LONG packetHandle, struct RoadWeatherMessageNtcipPrecipitation value, char oldPath[])
{
  char newPath[300];
  int result;

  result = 0;

  snprintf(newPath, elcount(newPath), "%s.%s", oldPath, "precipitation");
  value.precipitation = C2xGetTokenInt(packetHandle, "RoadWeatherMessage", newPath);
  result = CheckLastError("RoadWeatherMessage", gkFuncRefGet, result);

  return result;
}

int SetRoadWeatherMessageNtcipPrecipitationParams(LONG packetHandle, struct RoadWeatherMessageNtcipPrecipitation value, char oldPath[])
{
  char newPath[300];
  int result;

  result = 0;

  snprintf(newPath, elcount(newPath), "%s.%s", oldPath, "precipitation");
  if (value.precipitation < 1)
  {
    C2xSetTokenInt(packetHandle, "RoadWeatherMessage", newPath, 1);
  }
  else if (value.precipitation > 15)
  {
    C2xSetTokenInt(packetHandle, "RoadWeatherMessage", newPath, 15);
  }
  else
  {
    C2xSetTokenInt(packetHandle, "RoadWeatherMessage", newPath, value.precipitation);
  }
  result = CheckLastError("RoadWeatherMessage", gkFuncRefGet, result);

  return result;
}

int GetRoadWeatherMessageNtcipSolarRadiationParams(LONG packetHandle, struct RoadWeatherMessageNtcipSolarRadiation value, char oldPath[])
{
  char newPath[300];
  int result;

  result = 0;

  snprintf(newPath, elcount(newPath), "%s.%s", oldPath, "solarRadiation");
  value.solarRadiation = C2xGetTokenInt(packetHandle, "RoadWeatherMessage", newPath);
  result = CheckLastError("RoadWeatherMessage", gkFuncRefGet, result);

  snprintf(newPath, elcount(newPath), "%s.%s", oldPath, "measurementPeriod");
  value.measurementPeriod = C2xGetTokenInt(packetHandle, "RoadWeatherMessage", newPath);
  result = CheckLastError("RoadWeatherMessage", gkFuncRefGet, result);

  return result;
}

int SetRoadWeatherMessageNtcipSolarRadiationParams(LONG packetHandle, struct RoadWeatherMessageNtcipSolarRadiation value, char oldPath[])
{
  char newPath[300];
  int result;

  result = 0;

  snprintf(newPath, elcount(newPath), "%s.%s", oldPath, "solarRadiation");
  C2xSetTokenInt(packetHandle, "RoadWeatherMessage", newPath, value.solarRadiation);
  result = CheckLastError("RoadWeatherMessage", gkFuncRefGet, result);

  snprintf(newPath, elcount(newPath), "%s.%s", oldPath, "measurementPeriod");
  C2xSetTokenInt(packetHandle, "RoadWeatherMessage", newPath, value.measurementPeriod);
  result = CheckLastError("RoadWeatherMessage", gkFuncRefGet, result);

  return result;
}

int GetRoadWeatherMessageNtcipEssDataParams(LONG packetHandle, struct RoadWeatherMessageNtcipEssData value, char oldPath[])
{
  char newPath[300];
  int result;

  result = 0;

  snprintf(newPath, elcount(newPath), "%s.%s", oldPath, "airTemp");
  value.airTemp.isValidFlag = C2xIsTokenAvailable(packetHandle, "RoadWeatherMessage", newPath);
  if(value.airTemp.isValidFlag==1)
  {
    GetRoadWeatherMessageNtcipAirTemperatureParams(packetHandle, value.airTemp, newPath);
    result = CheckLastError("RoadWeatherMessage", gkFuncRefGet, result);
  }
  snprintf(newPath, elcount(newPath), "%s.%s", oldPath, "atmosphere");
  value.atmosphere.isValidFlag = C2xIsTokenAvailable(packetHandle, "RoadWeatherMessage", newPath);
  if(value.atmosphere.isValidFlag==1)
  {
    GetRoadWeatherMessageNtcipAtmosphericPressureParams(packetHandle, value.atmosphere, newPath);
    result = CheckLastError("RoadWeatherMessage", gkFuncRefGet, result);
  }
  snprintf(newPath, elcount(newPath), "%s.%s", oldPath, "wind");
  value.wind.isValidFlag = C2xIsTokenAvailable(packetHandle, "RoadWeatherMessage", newPath);
  if(value.wind.isValidFlag==1)
  {
    GetRoadWeatherMessageNtcipWindParams(packetHandle, value.wind, newPath);
    result = CheckLastError("RoadWeatherMessage", gkFuncRefGet, result);
  }
  snprintf(newPath, elcount(newPath), "%s.%s", oldPath, "humidity");
  value.humidity.isValidFlag = C2xIsTokenAvailable(packetHandle, "RoadWeatherMessage", newPath);
  if(value.humidity.isValidFlag==1)
  {
    GetRoadWeatherMessageNtcipRelativeHumidityParams(packetHandle, value.humidity, newPath);
    result = CheckLastError("RoadWeatherMessage", gkFuncRefGet, result);
  }
  snprintf(newPath, elcount(newPath), "%s.%s", oldPath, "dewpoint");
  value.dewpoint.isValidFlag = C2xIsTokenAvailable(packetHandle, "RoadWeatherMessage", newPath);
  if(value.dewpoint.isValidFlag==1)
  {
    GetRoadWeatherMessageNtcipDewPointParams(packetHandle, value.dewpoint, newPath);
    result = CheckLastError("RoadWeatherMessage", gkFuncRefGet, result);
  }
  snprintf(newPath, elcount(newPath), "%s.%s", oldPath, "pavement");
  value.pavement.isValidFlag = C2xIsTokenAvailable(packetHandle, "RoadWeatherMessage", newPath);
  if(value.pavement.isValidFlag==1)
  {
    GetRoadWeatherMessageNtcipPavementParams(packetHandle, value.pavement, newPath);
    result = CheckLastError("RoadWeatherMessage", gkFuncRefGet, result);
  }
  snprintf(newPath, elcount(newPath), "%s.%s", oldPath, "visibility");
  value.visibility.isValidFlag = C2xIsTokenAvailable(packetHandle, "RoadWeatherMessage", newPath);
  if(value.visibility.isValidFlag==1)
  {
    GetRoadWeatherMessageNtcipVisibilityParams(packetHandle, value.visibility, newPath);
    result = CheckLastError("RoadWeatherMessage", gkFuncRefGet, result);
  }
  snprintf(newPath, elcount(newPath), "%s.%s", oldPath, "visSituation");
  value.visSituation.isValidFlag = C2xIsTokenAvailable(packetHandle, "RoadWeatherMessage", newPath);
  if(value.visSituation.isValidFlag==1)
  {
    GetRoadWeatherMessageNtcipVisibilitySituationParams(packetHandle, value.visSituation, newPath);
    result = CheckLastError("RoadWeatherMessage", gkFuncRefGet, result);
  }
  snprintf(newPath, elcount(newPath), "%s.%s", oldPath, "cloudSitiation");
  value.cloudSitiation.isValidFlag = C2xIsTokenAvailable(packetHandle, "RoadWeatherMessage", newPath);
  if(value.cloudSitiation.isValidFlag==1)
  {
    GetRoadWeatherMessageNtcipCloudSituationParams(packetHandle, value.cloudSitiation, newPath);
    result = CheckLastError("RoadWeatherMessage", gkFuncRefGet, result);
  }
  snprintf(newPath, elcount(newPath), "%s.%s", oldPath, "precipitation");
  value.precipitation.isValidFlag = C2xIsTokenAvailable(packetHandle, "RoadWeatherMessage", newPath);
  if(value.precipitation.isValidFlag==1)
  {
    GetRoadWeatherMessageNtcipPrecipitationParams(packetHandle, value.precipitation, newPath);
    result = CheckLastError("RoadWeatherMessage", gkFuncRefGet, result);
  }
  snprintf(newPath, elcount(newPath), "%s.%s", oldPath, "solarRadiation");
  value.solarRadiation.isValidFlag = C2xIsTokenAvailable(packetHandle, "RoadWeatherMessage", newPath);
  if(value.solarRadiation.isValidFlag==1)
  {
    GetRoadWeatherMessageNtcipSolarRadiationParams(packetHandle, value.solarRadiation, newPath);
    result = CheckLastError("RoadWeatherMessage", gkFuncRefGet, result);
  }
  return result;
}

int SetRoadWeatherMessageNtcipEssDataParams(LONG packetHandle, struct RoadWeatherMessageNtcipEssData value, char oldPath[])
{
  char newPath[300];
  int result;

  result = 0;

  snprintf(newPath, elcount(newPath), "%s.%s", oldPath, "airTemp");
  if(value.airTemp.isValidFlag==1)
  {
    SetRoadWeatherMessageNtcipAirTemperatureParams(packetHandle, value.airTemp, newPath);
    result = CheckLastError("RoadWeatherMessage", gkFuncRefGet, result);
  }
  else
  {
    if( C2xIsTokenAvailable(packetHandle, "RoadWeatherMessage", newPath) )
    {
      C2xRemoveToken(packetHandle, "RoadWeatherMessage", newPath);
    }
  }

  snprintf(newPath, elcount(newPath), "%s.%s", oldPath, "atmosphere");
  if(value.atmosphere.isValidFlag==1)
  {
    SetRoadWeatherMessageNtcipAtmosphericPressureParams(packetHandle, value.atmosphere, newPath);
    result = CheckLastError("RoadWeatherMessage", gkFuncRefGet, result);
  }
  else
  {
    if( C2xIsTokenAvailable(packetHandle, "RoadWeatherMessage", newPath) )
    {
      C2xRemoveToken(packetHandle, "RoadWeatherMessage", newPath);
    }
  }

  snprintf(newPath, elcount(newPath), "%s.%s", oldPath, "wind");
  if(value.wind.isValidFlag==1)
  {
    SetRoadWeatherMessageNtcipWindParams(packetHandle, value.wind, newPath);
    result = CheckLastError("RoadWeatherMessage", gkFuncRefGet, result);
  }
  else
  {
    if( C2xIsTokenAvailable(packetHandle, "RoadWeatherMessage", newPath) )
    {
      C2xRemoveToken(packetHandle, "RoadWeatherMessage", newPath);
    }
  }

  snprintf(newPath, elcount(newPath), "%s.%s", oldPath, "humidity");
  if(value.humidity.isValidFlag==1)
  {
    SetRoadWeatherMessageNtcipRelativeHumidityParams(packetHandle, value.humidity, newPath);
    result = CheckLastError("RoadWeatherMessage", gkFuncRefGet, result);
  }
  else
  {
    if( C2xIsTokenAvailable(packetHandle, "RoadWeatherMessage", newPath) )
    {
      C2xRemoveToken(packetHandle, "RoadWeatherMessage", newPath);
    }
  }

  snprintf(newPath, elcount(newPath), "%s.%s", oldPath, "dewpoint");
  if(value.dewpoint.isValidFlag==1)
  {
    SetRoadWeatherMessageNtcipDewPointParams(packetHandle, value.dewpoint, newPath);
    result = CheckLastError("RoadWeatherMessage", gkFuncRefGet, result);
  }
  else
  {
    if( C2xIsTokenAvailable(packetHandle, "RoadWeatherMessage", newPath) )
    {
      C2xRemoveToken(packetHandle, "RoadWeatherMessage", newPath);
    }
  }

  snprintf(newPath, elcount(newPath), "%s.%s", oldPath, "pavement");
  if(value.pavement.isValidFlag==1)
  {
    SetRoadWeatherMessageNtcipPavementParams(packetHandle, value.pavement, newPath);
    result = CheckLastError("RoadWeatherMessage", gkFuncRefGet, result);
  }
  else
  {
    if( C2xIsTokenAvailable(packetHandle, "RoadWeatherMessage", newPath) )
    {
      C2xRemoveToken(packetHandle, "RoadWeatherMessage", newPath);
    }
  }

  snprintf(newPath, elcount(newPath), "%s.%s", oldPath, "visibility");
  if(value.visibility.isValidFlag==1)
  {
    SetRoadWeatherMessageNtcipVisibilityParams(packetHandle, value.visibility, newPath);
    result = CheckLastError("RoadWeatherMessage", gkFuncRefGet, result);
  }
  else
  {
    if( C2xIsTokenAvailable(packetHandle, "RoadWeatherMessage", newPath) )
    {
      C2xRemoveToken(packetHandle, "RoadWeatherMessage", newPath);
    }
  }

  snprintf(newPath, elcount(newPath), "%s.%s", oldPath, "visSituation");
  if(value.visSituation.isValidFlag==1)
  {
    SetRoadWeatherMessageNtcipVisibilitySituationParams(packetHandle, value.visSituation, newPath);
    result = CheckLastError("RoadWeatherMessage", gkFuncRefGet, result);
  }
  else
  {
    if( C2xIsTokenAvailable(packetHandle, "RoadWeatherMessage", newPath) )
    {
      C2xRemoveToken(packetHandle, "RoadWeatherMessage", newPath);
    }
  }

  snprintf(newPath, elcount(newPath), "%s.%s", oldPath, "cloudSitiation");
  if(value.cloudSitiation.isValidFlag==1)
  {
    SetRoadWeatherMessageNtcipCloudSituationParams(packetHandle, value.cloudSitiation, newPath);
    result = CheckLastError("RoadWeatherMessage", gkFuncRefGet, result);
  }
  else
  {
    if( C2xIsTokenAvailable(packetHandle, "RoadWeatherMessage", newPath) )
    {
      C2xRemoveToken(packetHandle, "RoadWeatherMessage", newPath);
    }
  }

  snprintf(newPath, elcount(newPath), "%s.%s", oldPath, "precipitation");
  if(value.precipitation.isValidFlag==1)
  {
    SetRoadWeatherMessageNtcipPrecipitationParams(packetHandle, value.precipitation, newPath);
    result = CheckLastError("RoadWeatherMessage", gkFuncRefGet, result);
  }
  else
  {
    if( C2xIsTokenAvailable(packetHandle, "RoadWeatherMessage", newPath) )
    {
      C2xRemoveToken(packetHandle, "RoadWeatherMessage", newPath);
    }
  }

  snprintf(newPath, elcount(newPath), "%s.%s", oldPath, "solarRadiation");
  if(value.solarRadiation.isValidFlag==1)
  {
    SetRoadWeatherMessageNtcipSolarRadiationParams(packetHandle, value.solarRadiation, newPath);
    result = CheckLastError("RoadWeatherMessage", gkFuncRefGet, result);
  }
  else
  {
    if( C2xIsTokenAvailable(packetHandle, "RoadWeatherMessage", newPath) )
    {
      C2xRemoveToken(packetHandle, "RoadWeatherMessage", newPath);
    }
  }

  return result;
}

int GetRoadWeatherMessageSnapShotParams(LONG packetHandle, struct RoadWeatherMessageSnapShot value, char oldPath[])
{
  char newPath[300];
  int result;

  result = 0;

  snprintf(newPath, elcount(newPath), "%s.%s", oldPath, "thePosition");
  GetRoadWeatherMessageCommon_FullPositionVectorParams(packetHandle, value.thePosition, newPath);
  result = CheckLastError("RoadWeatherMessage", gkFuncRefGet, result);

  snprintf(newPath, elcount(newPath), "%s.%s", oldPath, "safetyExt");
  value.safetyExt.isValidFlag = C2xIsTokenAvailable(packetHandle, "RoadWeatherMessage", newPath);
  if(value.safetyExt.isValidFlag==1)
  {
    GetRoadWeatherMessageCommon_VehicleSafetyExtensionsParams(packetHandle, value.safetyExt, newPath);
    result = CheckLastError("RoadWeatherMessage", gkFuncRefGet, result);
  }
  snprintf(newPath, elcount(newPath), "%s.%s", oldPath, "dataSet");
  value.dataSet.isValidFlag = C2xIsTokenAvailable(packetHandle, "RoadWeatherMessage", newPath);
  if(value.dataSet.isValidFlag==1)
  {
    GetRoadWeatherMessageProbeVehicleData_VehicleStatusParams(packetHandle, value.dataSet, newPath);
    result = CheckLastError("RoadWeatherMessage", gkFuncRefGet, result);
  }
  snprintf(newPath, elcount(newPath), "%s.%s", oldPath, "weatherData");
  value.weatherData.isValidFlag = C2xIsTokenAvailable(packetHandle, "RoadWeatherMessage", newPath);
  if(value.weatherData.isValidFlag==1)
  {
    GetRoadWeatherMessageNtcipEssDataParams(packetHandle, value.weatherData, newPath);
    result = CheckLastError("RoadWeatherMessage", gkFuncRefGet, result);
  }
  return result;
}

int SetRoadWeatherMessageSnapShotParams(LONG packetHandle, struct RoadWeatherMessageSnapShot value, char oldPath[])
{
  char newPath[300];
  int result;

  result = 0;

  snprintf(newPath, elcount(newPath), "%s.%s", oldPath, "thePosition");
  SetRoadWeatherMessageCommon_FullPositionVectorParams(packetHandle, value.thePosition, newPath);
  result = CheckLastError("RoadWeatherMessage", gkFuncRefGet, result);

  snprintf(newPath, elcount(newPath), "%s.%s", oldPath, "safetyExt");
  if(value.safetyExt.isValidFlag==1)
  {
    SetRoadWeatherMessageCommon_VehicleSafetyExtensionsParams(packetHandle, value.safetyExt, newPath);
    result = CheckLastError("RoadWeatherMessage", gkFuncRefGet, result);
  }
  else
  {
    if( C2xIsTokenAvailable(packetHandle, "RoadWeatherMessage", newPath) )
    {
      C2xRemoveToken(packetHandle, "RoadWeatherMessage", newPath);
    }
  }

  snprintf(newPath, elcount(newPath), "%s.%s", oldPath, "dataSet");
  if(value.dataSet.isValidFlag==1)
  {
    SetRoadWeatherMessageProbeVehicleData_VehicleStatusParams(packetHandle, value.dataSet, newPath);
    result = CheckLastError("RoadWeatherMessage", gkFuncRefGet, result);
  }
  else
  {
    if( C2xIsTokenAvailable(packetHandle, "RoadWeatherMessage", newPath) )
    {
      C2xRemoveToken(packetHandle, "RoadWeatherMessage", newPath);
    }
  }

  snprintf(newPath, elcount(newPath), "%s.%s", oldPath, "weatherData");
  if(value.weatherData.isValidFlag==1)
  {
    SetRoadWeatherMessageNtcipEssDataParams(packetHandle, value.weatherData, newPath);
    result = CheckLastError("RoadWeatherMessage", gkFuncRefGet, result);
  }
  else
  {
    if( C2xIsTokenAvailable(packetHandle, "RoadWeatherMessage", newPath) )
    {
      C2xRemoveToken(packetHandle, "RoadWeatherMessage", newPath);
    }
  }

  return result;
}

int GetRoadWeatherMessageNtcipPavementTreatmentParams(LONG packetHandle, struct RoadWeatherMessageNtcipPavementTreatment value, char oldPath[])
{
  char newPath[300];
  int result;

  result = 0;

  snprintf(newPath, elcount(newPath), "%s.%s", oldPath, "latitude");
  value.latitude = C2xGetTokenInt(packetHandle, "RoadWeatherMessage", newPath);
  result = CheckLastError("RoadWeatherMessage", gkFuncRefGet, result);

  snprintf(newPath, elcount(newPath), "%s.%s", oldPath, "longitude");
  value.longitude = C2xGetTokenInt(packetHandle, "RoadWeatherMessage", newPath);
  result = CheckLastError("RoadWeatherMessage", gkFuncRefGet, result);

  snprintf(newPath, elcount(newPath), "%s.%s", oldPath, "location");
  value.location.stringLength = C2xGetTokenData(packetHandle, "RoadWeatherMessage", newPath, elcount(value.location.string), value.location.string);
  result = CheckLastError("RoadWeatherMessage", gkFuncRefGet, result);
  snprintf(newPath, elcount(newPath), "%s.%s", oldPath, "productType");
  value.productType.isValidFlag = C2xIsTokenAvailable(packetHandle, "RoadWeatherMessage", newPath);
  if(value.productType.isValidFlag==1)
  {
    value.productType.value = C2xGetTokenInt(packetHandle, "RoadWeatherMessage", newPath);
    result = CheckLastError("RoadWeatherMessage", gkFuncRefGet, result);
  }
  snprintf(newPath, elcount(newPath), "%s.%s", oldPath, "form");
  value.form.isValidFlag = C2xIsTokenAvailable(packetHandle, "RoadWeatherMessage", newPath);
  if(value.form.isValidFlag==1)
  {
    value.form.value = C2xGetTokenInt(packetHandle, "RoadWeatherMessage", newPath);
    result = CheckLastError("RoadWeatherMessage", gkFuncRefGet, result);
  }
  snprintf(newPath, elcount(newPath), "%s.%s", oldPath, "percentage");
  value.percentage.isValidFlag = C2xIsTokenAvailable(packetHandle, "RoadWeatherMessage", newPath);
  if(value.percentage.isValidFlag==1)
  {
    value.percentage.value = C2xGetTokenInt(packetHandle, "RoadWeatherMessage", newPath);
    result = CheckLastError("RoadWeatherMessage", gkFuncRefGet, result);
  }
  snprintf(newPath, elcount(newPath), "%s.%s", oldPath, "amount");
  value.amount.isValidFlag = C2xIsTokenAvailable(packetHandle, "RoadWeatherMessage", newPath);
  if(value.amount.isValidFlag==1)
  {
    value.amount.value = C2xGetTokenInt(packetHandle, "RoadWeatherMessage", newPath);
    result = CheckLastError("RoadWeatherMessage", gkFuncRefGet, result);
  }
  snprintf(newPath, elcount(newPath), "%s.%s", oldPath, "width");
  value.width.isValidFlag = C2xIsTokenAvailable(packetHandle, "RoadWeatherMessage", newPath);
  if(value.width.isValidFlag==1)
  {
    value.width.value = C2xGetTokenInt(packetHandle, "RoadWeatherMessage", newPath);
    result = CheckLastError("RoadWeatherMessage", gkFuncRefGet, result);
  }
  return result;
}

int SetRoadWeatherMessageNtcipPavementTreatmentParams(LONG packetHandle, struct RoadWeatherMessageNtcipPavementTreatment value, char oldPath[])
{
  char newPath[300];
  int result;

  result = 0;

  snprintf(newPath, elcount(newPath), "%s.%s", oldPath, "latitude");
  C2xSetTokenInt(packetHandle, "RoadWeatherMessage", newPath, value.latitude);
  result = CheckLastError("RoadWeatherMessage", gkFuncRefGet, result);

  snprintf(newPath, elcount(newPath), "%s.%s", oldPath, "longitude");
  C2xSetTokenInt(packetHandle, "RoadWeatherMessage", newPath, value.longitude);
  result = CheckLastError("RoadWeatherMessage", gkFuncRefGet, result);

  snprintf(newPath, elcount(newPath), "%s.%s", oldPath, "location");
  C2xSetTokenData(packetHandle, "RoadWeatherMessage", newPath, value.location.stringLength, value.location.string);
  result = CheckLastError("RoadWeatherMessage", gkFuncRefGet, result);

  snprintf(newPath, elcount(newPath), "%s.%s", oldPath, "productType");
  if(value.productType.isValidFlag==1)
  {
    if (value.productType.value < 1)
    {
        C2xSetTokenInt(packetHandle, "RoadWeatherMessage", newPath, 1);
    }
    else if (value.productType.value > 14)
    {
        C2xSetTokenInt(packetHandle, "RoadWeatherMessage", newPath, 14);
    }
    else
    {
        C2xSetTokenInt(packetHandle, "RoadWeatherMessage", newPath, value.productType.value);
    }
    result = CheckLastError("RoadWeatherMessage", gkFuncRefGet, result);
  }
  else
  {
    if( C2xIsTokenAvailable(packetHandle, "RoadWeatherMessage", newPath) )
    {
      C2xRemoveToken(packetHandle, "RoadWeatherMessage", newPath);
    }
  }

  snprintf(newPath, elcount(newPath), "%s.%s", oldPath, "form");
  if(value.form.isValidFlag==1)
  {
    if (value.form.value < 1)
    {
        C2xSetTokenInt(packetHandle, "RoadWeatherMessage", newPath, 1);
    }
    else if (value.form.value > 4)
    {
        C2xSetTokenInt(packetHandle, "RoadWeatherMessage", newPath, 4);
    }
    else
    {
        C2xSetTokenInt(packetHandle, "RoadWeatherMessage", newPath, value.form.value);
    }
    result = CheckLastError("RoadWeatherMessage", gkFuncRefGet, result);
  }
  else
  {
    if( C2xIsTokenAvailable(packetHandle, "RoadWeatherMessage", newPath) )
    {
      C2xRemoveToken(packetHandle, "RoadWeatherMessage", newPath);
    }
  }

  snprintf(newPath, elcount(newPath), "%s.%s", oldPath, "percentage");
  if(value.percentage.isValidFlag==1)
  {
    C2xSetTokenInt(packetHandle, "RoadWeatherMessage", newPath, value.percentage.value);
    result = CheckLastError("RoadWeatherMessage", gkFuncRefGet, result);
  }
  else
  {
    if( C2xIsTokenAvailable(packetHandle, "RoadWeatherMessage", newPath) )
    {
      C2xRemoveToken(packetHandle, "RoadWeatherMessage", newPath);
    }
  }

  snprintf(newPath, elcount(newPath), "%s.%s", oldPath, "amount");
  if(value.amount.isValidFlag==1)
  {
    C2xSetTokenInt(packetHandle, "RoadWeatherMessage", newPath, value.amount.value);
    result = CheckLastError("RoadWeatherMessage", gkFuncRefGet, result);
  }
  else
  {
    if( C2xIsTokenAvailable(packetHandle, "RoadWeatherMessage", newPath) )
    {
      C2xRemoveToken(packetHandle, "RoadWeatherMessage", newPath);
    }
  }

  snprintf(newPath, elcount(newPath), "%s.%s", oldPath, "width");
  if(value.width.isValidFlag==1)
  {
    C2xSetTokenInt(packetHandle, "RoadWeatherMessage", newPath, value.width.value);
    result = CheckLastError("RoadWeatherMessage", gkFuncRefGet, result);
  }
  else
  {
    if( C2xIsTokenAvailable(packetHandle, "RoadWeatherMessage", newPath) )
    {
      C2xRemoveToken(packetHandle, "RoadWeatherMessage", newPath);
    }
  }

  return result;
}

int GetRoadWeatherMessageWDMSFleetDataParams(LONG packetHandle, struct RoadWeatherMessageWDMSFleetData value, char oldPath[])
{
  char newPath[300];
  int result;

  result = 0;

  snprintf(newPath, elcount(newPath), "%s.%s", oldPath, "pavementTreat");
  value.pavementTreat.isValidFlag = C2xIsTokenAvailable(packetHandle, "RoadWeatherMessage", newPath);
  if(value.pavementTreat.isValidFlag==1)
  {
    GetRoadWeatherMessageNtcipPavementTreatmentParams(packetHandle, value.pavementTreat, newPath);
    result = CheckLastError("RoadWeatherMessage", gkFuncRefGet, result);
  }
  snprintf(newPath, elcount(newPath), "%s.%s", oldPath, "routingAdvice");
  value.routingAdvice.isValidFlag = C2xIsTokenAvailable(packetHandle, "RoadWeatherMessage", newPath);
  if(value.routingAdvice.isValidFlag==1)
  {
    value.routingAdvice.stringLength = C2xGetTokenData(packetHandle, "RoadWeatherMessage", newPath, elcount(value.routingAdvice.string), value.routingAdvice.string);
    result = CheckLastError("RoadWeatherMessage", gkFuncRefGet, result);
  }
  return result;
}

int SetRoadWeatherMessageWDMSFleetDataParams(LONG packetHandle, struct RoadWeatherMessageWDMSFleetData value, char oldPath[])
{
  char newPath[300];
  int result;

  result = 0;

  snprintf(newPath, elcount(newPath), "%s.%s", oldPath, "pavementTreat");
  if(value.pavementTreat.isValidFlag==1)
  {
    SetRoadWeatherMessageNtcipPavementTreatmentParams(packetHandle, value.pavementTreat, newPath);
    result = CheckLastError("RoadWeatherMessage", gkFuncRefGet, result);
  }
  else
  {
    if( C2xIsTokenAvailable(packetHandle, "RoadWeatherMessage", newPath) )
    {
      C2xRemoveToken(packetHandle, "RoadWeatherMessage", newPath);
    }
  }

  snprintf(newPath, elcount(newPath), "%s.%s", oldPath, "routingAdvice");
  if(value.routingAdvice.isValidFlag==1)
  {
    C2xSetTokenData(packetHandle, "RoadWeatherMessage", newPath, value.routingAdvice.stringLength, value.routingAdvice.string);
    result = CheckLastError("RoadWeatherMessage", gkFuncRefGet, result);
  }
  else
  {
    if( C2xIsTokenAvailable(packetHandle, "RoadWeatherMessage", newPath) )
    {
      C2xRemoveToken(packetHandle, "RoadWeatherMessage", newPath);
    }
  }

  return result;
}

int GetRoadWeatherMessageVehicleReportParams(LONG packetHandle, struct RoadWeatherMessageVehicleReport value, char oldPath[])
{
  char newPath[300];
  int result;

  result = 0;

  snprintf(newPath, elcount(newPath), "%s.%s", oldPath, "snapShot");
  GetRoadWeatherMessageSnapShotParams(packetHandle, value.snapShot, newPath);
  result = CheckLastError("RoadWeatherMessage", gkFuncRefGet, result);

  snprintf(newPath, elcount(newPath), "%s.%s", oldPath, "wdmsFleetData");
  value.wdmsFleetData.isValidFlag = C2xIsTokenAvailable(packetHandle, "RoadWeatherMessage", newPath);
  if(value.wdmsFleetData.isValidFlag==1)
  {
    GetRoadWeatherMessageWDMSFleetDataParams(packetHandle, value.wdmsFleetData, newPath);
    result = CheckLastError("RoadWeatherMessage", gkFuncRefGet, result);
  }
  return result;
}

int SetRoadWeatherMessageVehicleReportParams(LONG packetHandle, struct RoadWeatherMessageVehicleReport value, char oldPath[])
{
  char newPath[300];
  int result;

  result = 0;

  snprintf(newPath, elcount(newPath), "%s.%s", oldPath, "snapShot");
  SetRoadWeatherMessageSnapShotParams(packetHandle, value.snapShot, newPath);
  result = CheckLastError("RoadWeatherMessage", gkFuncRefGet, result);

  snprintf(newPath, elcount(newPath), "%s.%s", oldPath, "wdmsFleetData");
  if(value.wdmsFleetData.isValidFlag==1)
  {
    SetRoadWeatherMessageWDMSFleetDataParams(packetHandle, value.wdmsFleetData, newPath);
    result = CheckLastError("RoadWeatherMessage", gkFuncRefGet, result);
  }
  else
  {
    if( C2xIsTokenAvailable(packetHandle, "RoadWeatherMessage", newPath) )
    {
      C2xRemoveToken(packetHandle, "RoadWeatherMessage", newPath);
    }
  }

  return result;
}

int GetRoadWeatherMessageRoadWeatherUpload_vehicleReportParams(LONG packetHandle, struct RoadWeatherMessageRoadWeatherUpload_vehicleReport value, char oldPath[])
{
  char newPath[300]; 
  int i;
  int result;

  result = 0;

  value.length = C2xGetTokenInt(packetHandle, "RoadWeatherMessage", oldPath);
  if((result = CheckLastError("RoadWeatherMessage", gkFuncRefGet, result))==0)
  {
    for(i=0; i<value.length; i++)
    {
      snprintf(newPath, elcount(newPath), "%s[%d]", oldPath, i);
      GetRoadWeatherMessageVehicleReportParams(packetHandle, value.arrayValue[i], newPath);
      result = CheckLastError("RoadWeatherMessage", gkFuncRefGet, result);
    }
  }
  return result;
}

int SetRoadWeatherMessageRoadWeatherUpload_vehicleReportParams(LONG packetHandle, struct RoadWeatherMessageRoadWeatherUpload_vehicleReport value, char oldPath[])
{
  char newPath[300]; 
  int i;
  int result;

  result = 0;

  C2xRemoveToken(packetHandle, "RoadWeatherMessage", oldPath);
  for(i=0; i<value.length; i++)
  {
    snprintf(newPath, elcount(newPath), "%s[%d]", oldPath, i);
    SetRoadWeatherMessageVehicleReportParams(packetHandle, value.arrayValue[i], newPath);
    result = CheckLastError("RoadWeatherMessage", gkFuncRefGet, result);
  }
  return result;
}

int GetRoadWeatherMessageRoadWeatherUploadParams(LONG packetHandle, struct RoadWeatherMessageRoadWeatherUpload value, char oldPath[])
{
  char newPath[300];
  int result;

  result = 0;

  value.choice = C2xGetTokenInt(packetHandle, "RoadWeatherMessage", oldPath);

  switch(value.choice)
  {
    case 0:
    {
      snprintf(newPath, elcount(newPath), "%s.%s", oldPath, "vehicleReport");
      GetRoadWeatherMessageRoadWeatherUpload_vehicleReportParams(packetHandle, value.vehicleReport, newPath);
      result = CheckLastError("RoadWeatherMessage", gkFuncRefGet, result);
    }
    break;
    case 1:
    {
      snprintf(newPath, elcount(newPath), "%s.%s", oldPath, "citizenReport");
      GetRoadWeatherMessageSnapShotParams(packetHandle, value.citizenReport, newPath);
      result = CheckLastError("RoadWeatherMessage", gkFuncRefGet, result);
    }
    break;
  }
  return result;
}

int SetRoadWeatherMessageRoadWeatherUploadParams(LONG packetHandle, struct RoadWeatherMessageRoadWeatherUpload value, char oldPath[])
{
  char newPath[300];
  int result;

  result = 0;

  switch(value.choice)
  {
    case 0:
    {
      snprintf(newPath, elcount(newPath), "%s.%s", oldPath, "vehicleReport");
      SetRoadWeatherMessageRoadWeatherUpload_vehicleReportParams(packetHandle, value.vehicleReport, newPath);
      result = CheckLastError("RoadWeatherMessage", gkFuncRefGet, result);
    }
    break;
    case 1:
    {
      snprintf(newPath, elcount(newPath), "%s.%s", oldPath, "citizenReport");
      SetRoadWeatherMessageSnapShotParams(packetHandle, value.citizenReport, newPath);
      result = CheckLastError("RoadWeatherMessage", gkFuncRefGet, result);
    }
    break;
  }
  return result;
}

int GetRoadWeatherMessageAddGrpB_LatitudeDMS2Params(LONG packetHandle, struct RoadWeatherMessageAddGrpB_LatitudeDMS2 value, char oldPath[])
{
  char newPath[300];
  int result;

  result = 0;

  snprintf(newPath, elcount(newPath), "%s.%s", oldPath, "d");
  value.d = C2xGetTokenInt(packetHandle, "RoadWeatherMessage", newPath);
  result = CheckLastError("RoadWeatherMessage", gkFuncRefGet, result);

  snprintf(newPath, elcount(newPath), "%s.%s", oldPath, "m");
  value.m = C2xGetTokenInt(packetHandle, "RoadWeatherMessage", newPath);
  result = CheckLastError("RoadWeatherMessage", gkFuncRefGet, result);

  snprintf(newPath, elcount(newPath), "%s.%s", oldPath, "s");
  value.s = C2xGetTokenInt(packetHandle, "RoadWeatherMessage", newPath);
  result = CheckLastError("RoadWeatherMessage", gkFuncRefGet, result);

  return result;
}

int SetRoadWeatherMessageAddGrpB_LatitudeDMS2Params(LONG packetHandle, struct RoadWeatherMessageAddGrpB_LatitudeDMS2 value, char oldPath[])
{
  char newPath[300];
  int result;

  result = 0;

  snprintf(newPath, elcount(newPath), "%s.%s", oldPath, "d");
  C2xSetTokenInt(packetHandle, "RoadWeatherMessage", newPath, value.d);
  result = CheckLastError("RoadWeatherMessage", gkFuncRefGet, result);

  snprintf(newPath, elcount(newPath), "%s.%s", oldPath, "m");
  C2xSetTokenInt(packetHandle, "RoadWeatherMessage", newPath, value.m);
  result = CheckLastError("RoadWeatherMessage", gkFuncRefGet, result);

  snprintf(newPath, elcount(newPath), "%s.%s", oldPath, "s");
  C2xSetTokenInt(packetHandle, "RoadWeatherMessage", newPath, value.s);
  result = CheckLastError("RoadWeatherMessage", gkFuncRefGet, result);

  return result;
}

int GetRoadWeatherMessageAddGrpB_LongitudeDMS2Params(LONG packetHandle, struct RoadWeatherMessageAddGrpB_LongitudeDMS2 value, char oldPath[])
{
  char newPath[300];
  int result;

  result = 0;

  snprintf(newPath, elcount(newPath), "%s.%s", oldPath, "d");
  value.d = C2xGetTokenInt(packetHandle, "RoadWeatherMessage", newPath);
  result = CheckLastError("RoadWeatherMessage", gkFuncRefGet, result);

  snprintf(newPath, elcount(newPath), "%s.%s", oldPath, "m");
  value.m = C2xGetTokenInt(packetHandle, "RoadWeatherMessage", newPath);
  result = CheckLastError("RoadWeatherMessage", gkFuncRefGet, result);

  snprintf(newPath, elcount(newPath), "%s.%s", oldPath, "s");
  value.s = C2xGetTokenInt(packetHandle, "RoadWeatherMessage", newPath);
  result = CheckLastError("RoadWeatherMessage", gkFuncRefGet, result);

  return result;
}

int SetRoadWeatherMessageAddGrpB_LongitudeDMS2Params(LONG packetHandle, struct RoadWeatherMessageAddGrpB_LongitudeDMS2 value, char oldPath[])
{
  char newPath[300];
  int result;

  result = 0;

  snprintf(newPath, elcount(newPath), "%s.%s", oldPath, "d");
  C2xSetTokenInt(packetHandle, "RoadWeatherMessage", newPath, value.d);
  result = CheckLastError("RoadWeatherMessage", gkFuncRefGet, result);

  snprintf(newPath, elcount(newPath), "%s.%s", oldPath, "m");
  C2xSetTokenInt(packetHandle, "RoadWeatherMessage", newPath, value.m);
  result = CheckLastError("RoadWeatherMessage", gkFuncRefGet, result);

  snprintf(newPath, elcount(newPath), "%s.%s", oldPath, "s");
  C2xSetTokenInt(packetHandle, "RoadWeatherMessage", newPath, value.s);
  result = CheckLastError("RoadWeatherMessage", gkFuncRefGet, result);

  return result;
}

int GetRoadWeatherMessageAddGrpB_Position3D_addGrpBParams(LONG packetHandle, struct RoadWeatherMessageAddGrpB_Position3D_addGrpB value, char oldPath[])
{
  char newPath[300];
  int result;

  result = 0;

  snprintf(newPath, elcount(newPath), "%s.%s", oldPath, "latitude");
  GetRoadWeatherMessageAddGrpB_LatitudeDMS2Params(packetHandle, value.latitude, newPath);
  result = CheckLastError("RoadWeatherMessage", gkFuncRefGet, result);

  snprintf(newPath, elcount(newPath), "%s.%s", oldPath, "longitude");
  GetRoadWeatherMessageAddGrpB_LongitudeDMS2Params(packetHandle, value.longitude, newPath);
  result = CheckLastError("RoadWeatherMessage", gkFuncRefGet, result);

  snprintf(newPath, elcount(newPath), "%s.%s", oldPath, "elevation");
  value.elevation = C2xGetTokenInt(packetHandle, "RoadWeatherMessage", newPath);
  result = CheckLastError("RoadWeatherMessage", gkFuncRefGet, result);

  return result;
}

int SetRoadWeatherMessageAddGrpB_Position3D_addGrpBParams(LONG packetHandle, struct RoadWeatherMessageAddGrpB_Position3D_addGrpB value, char oldPath[])
{
  char newPath[300];
  int result;

  result = 0;

  snprintf(newPath, elcount(newPath), "%s.%s", oldPath, "latitude");
  SetRoadWeatherMessageAddGrpB_LatitudeDMS2Params(packetHandle, value.latitude, newPath);
  result = CheckLastError("RoadWeatherMessage", gkFuncRefGet, result);

  snprintf(newPath, elcount(newPath), "%s.%s", oldPath, "longitude");
  SetRoadWeatherMessageAddGrpB_LongitudeDMS2Params(packetHandle, value.longitude, newPath);
  result = CheckLastError("RoadWeatherMessage", gkFuncRefGet, result);

  snprintf(newPath, elcount(newPath), "%s.%s", oldPath, "elevation");
  C2xSetTokenInt(packetHandle, "RoadWeatherMessage", newPath, value.elevation);
  result = CheckLastError("RoadWeatherMessage", gkFuncRefGet, result);

  return result;
}

int GetRoadWeatherMessageAddGrpC_AltitudeParams(LONG packetHandle, struct RoadWeatherMessageAddGrpC_Altitude value, char oldPath[])
{
  char newPath[300];
  int result;

  result = 0;

  snprintf(newPath, elcount(newPath), "%s.%s", oldPath, "value");
  value.value = C2xGetTokenInt(packetHandle, "RoadWeatherMessage", newPath);
  result = CheckLastError("RoadWeatherMessage", gkFuncRefGet, result);

  snprintf(newPath, elcount(newPath), "%s.%s", oldPath, "confidence");
  value.confidence = C2xGetTokenInt(packetHandle, "RoadWeatherMessage", newPath);
  result = CheckLastError("RoadWeatherMessage", gkFuncRefGet, result);

  return result;
}

int SetRoadWeatherMessageAddGrpC_AltitudeParams(LONG packetHandle, struct RoadWeatherMessageAddGrpC_Altitude value, char oldPath[])
{
  char newPath[300];
  int result;

  result = 0;

  snprintf(newPath, elcount(newPath), "%s.%s", oldPath, "value");
  C2xSetTokenInt(packetHandle, "RoadWeatherMessage", newPath, value.value);
  result = CheckLastError("RoadWeatherMessage", gkFuncRefGet, result);

  snprintf(newPath, elcount(newPath), "%s.%s", oldPath, "confidence");
  C2xSetTokenInt(packetHandle, "RoadWeatherMessage", newPath, value.confidence);
  result = CheckLastError("RoadWeatherMessage", gkFuncRefGet, result);

  return result;
}

int GetRoadWeatherMessageAddGrpC_Position3D_addGrpCParams(LONG packetHandle, struct RoadWeatherMessageAddGrpC_Position3D_addGrpC value, char oldPath[])
{
  char newPath[300];
  int result;

  result = 0;

  snprintf(newPath, elcount(newPath), "%s.%s", oldPath, "altitude");
  GetRoadWeatherMessageAddGrpC_AltitudeParams(packetHandle, value.altitude, newPath);
  result = CheckLastError("RoadWeatherMessage", gkFuncRefGet, result);

  return result;
}

int SetRoadWeatherMessageAddGrpC_Position3D_addGrpCParams(LONG packetHandle, struct RoadWeatherMessageAddGrpC_Position3D_addGrpC value, char oldPath[])
{
  char newPath[300];
  int result;

  result = 0;

  snprintf(newPath, elcount(newPath), "%s.%s", oldPath, "altitude");
  SetRoadWeatherMessageAddGrpC_AltitudeParams(packetHandle, value.altitude, newPath);
  result = CheckLastError("RoadWeatherMessage", gkFuncRefGet, result);

  return result;
}

int GetRoadWeatherMessageCommon_RegionalExtension_Reg_Position3D_tableParams(LONG packetHandle, WORD tableKey, struct RoadWeatherMessageCommon_RegionalExtension_Reg_Position3D_table value, char oldPath[])
{
  char newPath[300];
  int result;

  result = 0;

  switch(tableKey)
  {
    case 2:
    {
      snprintf(newPath, elcount(newPath), "%s.%s", oldPath, "addGrpB");
      GetRoadWeatherMessageAddGrpB_Position3D_addGrpBParams(packetHandle, value.addGrpB, newPath);
      result = CheckLastError("RoadWeatherMessage", gkFuncRefGet, result);
    }
    break;
    case 3:
    {
      snprintf(newPath, elcount(newPath), "%s.%s", oldPath, "addGrpC");
      GetRoadWeatherMessageAddGrpC_Position3D_addGrpCParams(packetHandle, value.addGrpC, newPath);
      result = CheckLastError("RoadWeatherMessage", gkFuncRefGet, result);
    }
    break;
  }
  return result;
}

int SetRoadWeatherMessageCommon_RegionalExtension_Reg_Position3D_tableParams(LONG packetHandle, WORD tableKey, struct RoadWeatherMessageCommon_RegionalExtension_Reg_Position3D_table value, char oldPath[])
{
  char newPath[300];
  int result;

  result = 0;

  switch(tableKey)
  {
    case 2:
    {
      snprintf(newPath, elcount(newPath), "%s.%s", oldPath, "addGrpB");
      SetRoadWeatherMessageAddGrpB_Position3D_addGrpBParams(packetHandle, value.addGrpB, newPath);
      result = CheckLastError("RoadWeatherMessage", gkFuncRefGet, result);
    }
    break;
    case 3:
    {
      snprintf(newPath, elcount(newPath), "%s.%s", oldPath, "addGrpC");
      SetRoadWeatherMessageAddGrpC_Position3D_addGrpCParams(packetHandle, value.addGrpC, newPath);
      result = CheckLastError("RoadWeatherMessage", gkFuncRefGet, result);
    }
    break;
  }
  return result;
}

int GetRoadWeatherMessageCommon_RegionalExtension_Reg_Position3DParams(LONG packetHandle, struct RoadWeatherMessageCommon_RegionalExtension_Reg_Position3D value, char oldPath[])
{
  char newPath[300];
  int result;

  result = 0;

  snprintf(newPath, elcount(newPath), "%s.%s", oldPath, "regionId");
  value.regionId = C2xGetTokenInt(packetHandle, "RoadWeatherMessage", newPath);
  result = CheckLastError("RoadWeatherMessage", gkFuncRefGet, result);

  snprintf(newPath, elcount(newPath), "%s.%s", oldPath, "regExtvalue");
  GetRoadWeatherMessageCommon_RegionalExtension_Reg_Position3D_tableParams(packetHandle, value.regionId, value.regExtvalue, newPath);
  result = CheckLastError("RoadWeatherMessage", gkFuncRefGet, result);

  return result;
}

int SetRoadWeatherMessageCommon_RegionalExtension_Reg_Position3DParams(LONG packetHandle, struct RoadWeatherMessageCommon_RegionalExtension_Reg_Position3D value, char oldPath[])
{
  char newPath[300];
  int result;

  result = 0;


  snprintf(newPath, elcount(newPath), "%s.%s", oldPath, "regExtvalue");
  SetRoadWeatherMessageCommon_RegionalExtension_Reg_Position3D_tableParams(packetHandle, value.regionId, value.regExtvalue, newPath);
  result = CheckLastError("RoadWeatherMessage", gkFuncRefGet, result);

  return result;
}

int GetRoadWeatherMessageCommon_Position3D_regionalParams(LONG packetHandle, struct RoadWeatherMessageCommon_Position3D_regional value, char oldPath[])
{
  char newPath[300]; 
  int i;
  int result;

  result = 0;

  value.length = C2xGetTokenInt(packetHandle, "RoadWeatherMessage", oldPath);
  if((result = CheckLastError("RoadWeatherMessage", gkFuncRefGet, result))==0)
  {
    for(i=0; i<value.length; i++)
    {
      snprintf(newPath, elcount(newPath), "%s[%d]", oldPath, i);
      GetRoadWeatherMessageCommon_RegionalExtension_Reg_Position3DParams(packetHandle, value.arrayValue[i], newPath);
      result = CheckLastError("RoadWeatherMessage", gkFuncRefGet, result);
    }
  }
  return result;
}

int SetRoadWeatherMessageCommon_Position3D_regionalParams(LONG packetHandle, struct RoadWeatherMessageCommon_Position3D_regional value, char oldPath[])
{
  char newPath[300]; 
  int i;
  int result;

  result = 0;

  C2xRemoveToken(packetHandle, "RoadWeatherMessage", oldPath);
  for(i=0; i<value.length; i++)
  {
    snprintf(newPath, elcount(newPath), "%s[%d]", oldPath, i);
    SetRoadWeatherMessageCommon_RegionalExtension_Reg_Position3DParams(packetHandle, value.arrayValue[i], newPath);
    result = CheckLastError("RoadWeatherMessage", gkFuncRefGet, result);
  }
  return result;
}

int GetRoadWeatherMessageCommon_Position3DParams(LONG packetHandle, struct RoadWeatherMessageCommon_Position3D value, char oldPath[])
{
  char newPath[300];
  int result;

  result = 0;

  snprintf(newPath, elcount(newPath), "%s.%s", oldPath, "lat");
  value.lat = C2xGetTokenInt(packetHandle, "RoadWeatherMessage", newPath);
  result = CheckLastError("RoadWeatherMessage", gkFuncRefGet, result);

  snprintf(newPath, elcount(newPath), "%s.%s", oldPath, "lon");
  value.lon = C2xGetTokenInt(packetHandle, "RoadWeatherMessage", newPath);
  result = CheckLastError("RoadWeatherMessage", gkFuncRefGet, result);

  snprintf(newPath, elcount(newPath), "%s.%s", oldPath, "elevation");
  value.elevation.isValidFlag = C2xIsTokenAvailable(packetHandle, "RoadWeatherMessage", newPath);
  if(value.elevation.isValidFlag==1)
  {
    value.elevation.value = C2xGetTokenInt(packetHandle, "RoadWeatherMessage", newPath);
    result = CheckLastError("RoadWeatherMessage", gkFuncRefGet, result);
  }
  snprintf(newPath, elcount(newPath), "%s.%s", oldPath, "regional");
  value.regional.isValidFlag = C2xIsTokenAvailable(packetHandle, "RoadWeatherMessage", newPath);
  if(value.regional.isValidFlag==1)
  {
    GetRoadWeatherMessageCommon_Position3D_regionalParams(packetHandle, value.regional, newPath);
    result = CheckLastError("RoadWeatherMessage", gkFuncRefGet, result);
  }
  return result;
}

int SetRoadWeatherMessageCommon_Position3DParams(LONG packetHandle, struct RoadWeatherMessageCommon_Position3D value, char oldPath[])
{
  char newPath[300];
  int result;

  result = 0;

  snprintf(newPath, elcount(newPath), "%s.%s", oldPath, "lat");
  C2xSetTokenInt(packetHandle, "RoadWeatherMessage", newPath, value.lat);
  result = CheckLastError("RoadWeatherMessage", gkFuncRefGet, result);

  snprintf(newPath, elcount(newPath), "%s.%s", oldPath, "lon");
  C2xSetTokenInt(packetHandle, "RoadWeatherMessage", newPath, value.lon);
  result = CheckLastError("RoadWeatherMessage", gkFuncRefGet, result);

  snprintf(newPath, elcount(newPath), "%s.%s", oldPath, "elevation");
  if(value.elevation.isValidFlag==1)
  {
    C2xSetTokenInt(packetHandle, "RoadWeatherMessage", newPath, value.elevation.value);
    result = CheckLastError("RoadWeatherMessage", gkFuncRefGet, result);
  }
  else
  {
    if( C2xIsTokenAvailable(packetHandle, "RoadWeatherMessage", newPath) )
    {
      C2xRemoveToken(packetHandle, "RoadWeatherMessage", newPath);
    }
  }

  snprintf(newPath, elcount(newPath), "%s.%s", oldPath, "regional");
  if(value.regional.isValidFlag==1)
  {
    SetRoadWeatherMessageCommon_Position3D_regionalParams(packetHandle, value.regional, newPath);
    result = CheckLastError("RoadWeatherMessage", gkFuncRefGet, result);
  }
  else
  {
    if( C2xIsTokenAvailable(packetHandle, "RoadWeatherMessage", newPath) )
    {
      C2xRemoveToken(packetHandle, "RoadWeatherMessage", newPath);
    }
  }

  return result;
}

int GetRoadWeatherMessageTravelerInformation_RoadSignIDParams(LONG packetHandle, struct RoadWeatherMessageTravelerInformation_RoadSignID value, char oldPath[])
{
  char newPath[300]; 
  int j; 
  int k;
  int result;

  result = 0;

  snprintf(newPath, elcount(newPath), "%s.%s", oldPath, "position");
  GetRoadWeatherMessageCommon_Position3DParams(packetHandle, value.position, newPath);
  result = CheckLastError("RoadWeatherMessage", gkFuncRefGet, result);

  snprintf(newPath, elcount(newPath), "%s.%s", oldPath, "viewAngle");
  value.viewAngle.isValidFlag = 1;
  value.viewAngle.stringLength = C2xGetTokenLengthBit(packetHandle, "RoadWeatherMessage", newPath);
  if ((result = CheckLastError("RoadWeatherMessage", gkFuncRefGet, result))==0)
  {
    if(value.viewAngle.stringLength > 0)
    {
      for(j=0; j<value.viewAngle.stringLength; j++)
      {
        if(C2xGetTokenBitOfBitString(packetHandle, "RoadWeatherMessage", newPath, j) == 0)
        {
          value.viewAngle.string[j] = '0';
        }
        else if(C2xGetTokenBitOfBitString(packetHandle, "RoadWeatherMessage", newPath, j) == 1)
        {
          value.viewAngle.string[j] = '1';
        }

        if(value.viewAngle.stringLength == 1)
        {
          value.viewAngle.string[1] = '0';
        }
        result = CheckLastError("RoadWeatherMessage", gkFuncRefGet, result);
      }
    }
    else
    {
      for(k = value.viewAngle.stringLength+1; k > -1; k--)
      {
        if(value.viewAngle.string[k] == '1')
        {
          value.viewAngle.string[k] = '0';
        }
      }
    }
  }

  snprintf(newPath, elcount(newPath), "%s.%s", oldPath, "mutcdCode");
  value.mutcdCode.isValidFlag = C2xIsTokenAvailable(packetHandle, "RoadWeatherMessage", newPath);
  if(value.mutcdCode.isValidFlag==1)
  {
    value.mutcdCode.value = C2xGetTokenInt(packetHandle, "RoadWeatherMessage", newPath);
    result = CheckLastError("RoadWeatherMessage", gkFuncRefGet, result);
  }
  snprintf(newPath, elcount(newPath), "%s.%s", oldPath, "crc");
  value.crc.isValidFlag = C2xIsTokenAvailable(packetHandle, "RoadWeatherMessage", newPath);
  if(value.crc.isValidFlag==1)
  {
    value.crc.isValidFlag = 1;
    value.crc.stringLength = C2xGetTokenData(packetHandle, "RoadWeatherMessage", newPath, elcount(value.crc.string), value.crc.string);
  }
  return result;
}

int SetRoadWeatherMessageTravelerInformation_RoadSignIDParams(LONG packetHandle, struct RoadWeatherMessageTravelerInformation_RoadSignID value, char oldPath[])
{
  char newPath[300]; 
  int j;
  int result;

  result = 0;

  snprintf(newPath, elcount(newPath), "%s.%s", oldPath, "position");
  SetRoadWeatherMessageCommon_Position3DParams(packetHandle, value.position, newPath);
  result = CheckLastError("RoadWeatherMessage", gkFuncRefGet, result);

  snprintf(newPath, elcount(newPath), "%s.%s", oldPath, "viewAngle");
    for(j=0; j<value.viewAngle.stringLength; j++)
    {
      if(value.viewAngle.string[j] == '0')
      {
        C2xSetTokenBitOfBitString(packetHandle, "RoadWeatherMessage", newPath, j, 0);
      }
      else
      {
        C2xSetTokenBitOfBitString(packetHandle, "RoadWeatherMessage", newPath, j, 1);
      }
      result = CheckLastError("RoadWeatherMessage", gkFuncRefGet, result);
    }

  snprintf(newPath, elcount(newPath), "%s.%s", oldPath, "mutcdCode");
  if(value.mutcdCode.isValidFlag==1)
  {
    C2xSetTokenInt(packetHandle, "RoadWeatherMessage", newPath, value.mutcdCode.value);
    result = CheckLastError("RoadWeatherMessage", gkFuncRefGet, result);
  }
  else
  {
    if( C2xIsTokenAvailable(packetHandle, "RoadWeatherMessage", newPath) )
    {
      C2xRemoveToken(packetHandle, "RoadWeatherMessage", newPath);
    }
  }

  snprintf(newPath, elcount(newPath), "%s.%s", oldPath, "crc");
  if(value.crc.isValidFlag==1)
  {
    C2xSetTokenData(packetHandle, "RoadWeatherMessage", newPath, value.crc.stringLength, value.crc.string);
  }
  else
  {
    if( C2xIsTokenAvailable(packetHandle, "RoadWeatherMessage", newPath) )
    {
      C2xRemoveToken(packetHandle, "RoadWeatherMessage", newPath);
    }
  }

  return result;
}

int GetRoadWeatherMessageTravelerInformation_TravelerDataFrame_msgIdParams(LONG packetHandle, struct RoadWeatherMessageTravelerInformation_TravelerDataFrame_msgId value, char oldPath[])
{
  char newPath[300];
  char buffer[300];
  int result;

  result = 0;

  value.choice = C2xGetTokenInt(packetHandle, "RoadWeatherMessage", oldPath);

  switch(value.choice)
  {
    case 0:
    {
      snprintf(newPath, elcount(newPath), "%s.%s", oldPath, "furtherInfoID");
      value.furtherInfoID.stringLength = C2xGetTokenData(packetHandle, "RoadWeatherMessage", newPath, elcount(value.furtherInfoID.string), value.furtherInfoID.string);
      result = CheckLastError("RoadWeatherMessage", gkFuncRefGet, result);
    }
    break;
    case 1:
    {
      snprintf(newPath, elcount(newPath), "%s.%s", oldPath, "roadSignID");
      GetRoadWeatherMessageTravelerInformation_RoadSignIDParams(packetHandle, value.roadSignID, newPath);
      result = CheckLastError("RoadWeatherMessage", gkFuncRefGet, result);
    }
    break;
  }
  return result;
}

int SetRoadWeatherMessageTravelerInformation_TravelerDataFrame_msgIdParams(LONG packetHandle, struct RoadWeatherMessageTravelerInformation_TravelerDataFrame_msgId value, char oldPath[])
{
  char newPath[300];
  char buffer[300];
  int result;

  result = 0;

  switch(value.choice)
  {
    case 0:
    {
      snprintf(newPath, elcount(newPath), "%s.%s", oldPath, "furtherInfoID");
      C2xSetTokenData(packetHandle, "RoadWeatherMessage", newPath, value.furtherInfoID.stringLength, value.furtherInfoID.string);
      result = CheckLastError("RoadWeatherMessage", gkFuncRefGet, result);
    }
    break;
    case 1:
    {
      snprintf(newPath, elcount(newPath), "%s.%s", oldPath, "roadSignID");
      SetRoadWeatherMessageTravelerInformation_RoadSignIDParams(packetHandle, value.roadSignID, newPath);
      result = CheckLastError("RoadWeatherMessage", gkFuncRefGet, result);
    }
    break;
  }
  return result;
}

int GetRoadWeatherMessageCommon_RoadSegmentReferenceIDParams(LONG packetHandle, struct RoadWeatherMessageCommon_RoadSegmentReferenceID value, char oldPath[])
{
  char newPath[300];
  int result;

  result = 0;

  snprintf(newPath, elcount(newPath), "%s.%s", oldPath, "region");
  value.region.isValidFlag = C2xIsTokenAvailable(packetHandle, "RoadWeatherMessage", newPath);
  if(value.region.isValidFlag==1)
  {
    value.region.value = C2xGetTokenInt(packetHandle, "RoadWeatherMessage", newPath);
    result = CheckLastError("RoadWeatherMessage", gkFuncRefGet, result);
  }
  snprintf(newPath, elcount(newPath), "%s.%s", oldPath, "id");
  value.id = C2xGetTokenInt(packetHandle, "RoadWeatherMessage", newPath);
  result = CheckLastError("RoadWeatherMessage", gkFuncRefGet, result);

  return result;
}

int SetRoadWeatherMessageCommon_RoadSegmentReferenceIDParams(LONG packetHandle, struct RoadWeatherMessageCommon_RoadSegmentReferenceID value, char oldPath[])
{
  char newPath[300];
  int result;

  result = 0;

  snprintf(newPath, elcount(newPath), "%s.%s", oldPath, "region");
  if(value.region.isValidFlag==1)
  {
    C2xSetTokenInt(packetHandle, "RoadWeatherMessage", newPath, value.region.value);
    result = CheckLastError("RoadWeatherMessage", gkFuncRefGet, result);
  }
  else
  {
    if( C2xIsTokenAvailable(packetHandle, "RoadWeatherMessage", newPath) )
    {
      C2xRemoveToken(packetHandle, "RoadWeatherMessage", newPath);
    }
  }

  snprintf(newPath, elcount(newPath), "%s.%s", oldPath, "id");
  C2xSetTokenInt(packetHandle, "RoadWeatherMessage", newPath, value.id);
  result = CheckLastError("RoadWeatherMessage", gkFuncRefGet, result);

  return result;
}

int GetRoadWeatherMessageCommon_Node_XY_20bParams(LONG packetHandle, struct RoadWeatherMessageCommon_Node_XY_20b value, char oldPath[])
{
  char newPath[300];
  int result;

  result = 0;

  snprintf(newPath, elcount(newPath), "%s.%s", oldPath, "x");
  value.x = C2xGetTokenInt(packetHandle, "RoadWeatherMessage", newPath);
  result = CheckLastError("RoadWeatherMessage", gkFuncRefGet, result);

  snprintf(newPath, elcount(newPath), "%s.%s", oldPath, "y");
  value.y = C2xGetTokenInt(packetHandle, "RoadWeatherMessage", newPath);
  result = CheckLastError("RoadWeatherMessage", gkFuncRefGet, result);

  return result;
}

int SetRoadWeatherMessageCommon_Node_XY_20bParams(LONG packetHandle, struct RoadWeatherMessageCommon_Node_XY_20b value, char oldPath[])
{
  char newPath[300];
  int result;

  result = 0;

  snprintf(newPath, elcount(newPath), "%s.%s", oldPath, "x");
  C2xSetTokenInt(packetHandle, "RoadWeatherMessage", newPath, value.x);
  result = CheckLastError("RoadWeatherMessage", gkFuncRefGet, result);

  snprintf(newPath, elcount(newPath), "%s.%s", oldPath, "y");
  C2xSetTokenInt(packetHandle, "RoadWeatherMessage", newPath, value.y);
  result = CheckLastError("RoadWeatherMessage", gkFuncRefGet, result);

  return result;
}

int GetRoadWeatherMessageCommon_Node_XY_22bParams(LONG packetHandle, struct RoadWeatherMessageCommon_Node_XY_22b value, char oldPath[])
{
  char newPath[300];
  int result;

  result = 0;

  snprintf(newPath, elcount(newPath), "%s.%s", oldPath, "x");
  value.x = C2xGetTokenInt(packetHandle, "RoadWeatherMessage", newPath);
  result = CheckLastError("RoadWeatherMessage", gkFuncRefGet, result);

  snprintf(newPath, elcount(newPath), "%s.%s", oldPath, "y");
  value.y = C2xGetTokenInt(packetHandle, "RoadWeatherMessage", newPath);
  result = CheckLastError("RoadWeatherMessage", gkFuncRefGet, result);

  return result;
}

int SetRoadWeatherMessageCommon_Node_XY_22bParams(LONG packetHandle, struct RoadWeatherMessageCommon_Node_XY_22b value, char oldPath[])
{
  char newPath[300];
  int result;

  result = 0;

  snprintf(newPath, elcount(newPath), "%s.%s", oldPath, "x");
  C2xSetTokenInt(packetHandle, "RoadWeatherMessage", newPath, value.x);
  result = CheckLastError("RoadWeatherMessage", gkFuncRefGet, result);

  snprintf(newPath, elcount(newPath), "%s.%s", oldPath, "y");
  C2xSetTokenInt(packetHandle, "RoadWeatherMessage", newPath, value.y);
  result = CheckLastError("RoadWeatherMessage", gkFuncRefGet, result);

  return result;
}

int GetRoadWeatherMessageCommon_Node_XY_24bParams(LONG packetHandle, struct RoadWeatherMessageCommon_Node_XY_24b value, char oldPath[])
{
  char newPath[300];
  int result;

  result = 0;

  snprintf(newPath, elcount(newPath), "%s.%s", oldPath, "x");
  value.x = C2xGetTokenInt(packetHandle, "RoadWeatherMessage", newPath);
  result = CheckLastError("RoadWeatherMessage", gkFuncRefGet, result);

  snprintf(newPath, elcount(newPath), "%s.%s", oldPath, "y");
  value.y = C2xGetTokenInt(packetHandle, "RoadWeatherMessage", newPath);
  result = CheckLastError("RoadWeatherMessage", gkFuncRefGet, result);

  return result;
}

int SetRoadWeatherMessageCommon_Node_XY_24bParams(LONG packetHandle, struct RoadWeatherMessageCommon_Node_XY_24b value, char oldPath[])
{
  char newPath[300];
  int result;

  result = 0;

  snprintf(newPath, elcount(newPath), "%s.%s", oldPath, "x");
  C2xSetTokenInt(packetHandle, "RoadWeatherMessage", newPath, value.x);
  result = CheckLastError("RoadWeatherMessage", gkFuncRefGet, result);

  snprintf(newPath, elcount(newPath), "%s.%s", oldPath, "y");
  C2xSetTokenInt(packetHandle, "RoadWeatherMessage", newPath, value.y);
  result = CheckLastError("RoadWeatherMessage", gkFuncRefGet, result);

  return result;
}

int GetRoadWeatherMessageCommon_Node_XY_26bParams(LONG packetHandle, struct RoadWeatherMessageCommon_Node_XY_26b value, char oldPath[])
{
  char newPath[300];
  int result;

  result = 0;

  snprintf(newPath, elcount(newPath), "%s.%s", oldPath, "x");
  value.x = C2xGetTokenInt(packetHandle, "RoadWeatherMessage", newPath);
  result = CheckLastError("RoadWeatherMessage", gkFuncRefGet, result);

  snprintf(newPath, elcount(newPath), "%s.%s", oldPath, "y");
  value.y = C2xGetTokenInt(packetHandle, "RoadWeatherMessage", newPath);
  result = CheckLastError("RoadWeatherMessage", gkFuncRefGet, result);

  return result;
}

int SetRoadWeatherMessageCommon_Node_XY_26bParams(LONG packetHandle, struct RoadWeatherMessageCommon_Node_XY_26b value, char oldPath[])
{
  char newPath[300];
  int result;

  result = 0;

  snprintf(newPath, elcount(newPath), "%s.%s", oldPath, "x");
  C2xSetTokenInt(packetHandle, "RoadWeatherMessage", newPath, value.x);
  result = CheckLastError("RoadWeatherMessage", gkFuncRefGet, result);

  snprintf(newPath, elcount(newPath), "%s.%s", oldPath, "y");
  C2xSetTokenInt(packetHandle, "RoadWeatherMessage", newPath, value.y);
  result = CheckLastError("RoadWeatherMessage", gkFuncRefGet, result);

  return result;
}

int GetRoadWeatherMessageCommon_Node_XY_28bParams(LONG packetHandle, struct RoadWeatherMessageCommon_Node_XY_28b value, char oldPath[])
{
  char newPath[300];
  int result;

  result = 0;

  snprintf(newPath, elcount(newPath), "%s.%s", oldPath, "x");
  value.x = C2xGetTokenInt(packetHandle, "RoadWeatherMessage", newPath);
  result = CheckLastError("RoadWeatherMessage", gkFuncRefGet, result);

  snprintf(newPath, elcount(newPath), "%s.%s", oldPath, "y");
  value.y = C2xGetTokenInt(packetHandle, "RoadWeatherMessage", newPath);
  result = CheckLastError("RoadWeatherMessage", gkFuncRefGet, result);

  return result;
}

int SetRoadWeatherMessageCommon_Node_XY_28bParams(LONG packetHandle, struct RoadWeatherMessageCommon_Node_XY_28b value, char oldPath[])
{
  char newPath[300];
  int result;

  result = 0;

  snprintf(newPath, elcount(newPath), "%s.%s", oldPath, "x");
  C2xSetTokenInt(packetHandle, "RoadWeatherMessage", newPath, value.x);
  result = CheckLastError("RoadWeatherMessage", gkFuncRefGet, result);

  snprintf(newPath, elcount(newPath), "%s.%s", oldPath, "y");
  C2xSetTokenInt(packetHandle, "RoadWeatherMessage", newPath, value.y);
  result = CheckLastError("RoadWeatherMessage", gkFuncRefGet, result);

  return result;
}

int GetRoadWeatherMessageCommon_Node_XY_32bParams(LONG packetHandle, struct RoadWeatherMessageCommon_Node_XY_32b value, char oldPath[])
{
  char newPath[300];
  int result;

  result = 0;

  snprintf(newPath, elcount(newPath), "%s.%s", oldPath, "x");
  value.x = C2xGetTokenInt(packetHandle, "RoadWeatherMessage", newPath);
  result = CheckLastError("RoadWeatherMessage", gkFuncRefGet, result);

  snprintf(newPath, elcount(newPath), "%s.%s", oldPath, "y");
  value.y = C2xGetTokenInt(packetHandle, "RoadWeatherMessage", newPath);
  result = CheckLastError("RoadWeatherMessage", gkFuncRefGet, result);

  return result;
}

int SetRoadWeatherMessageCommon_Node_XY_32bParams(LONG packetHandle, struct RoadWeatherMessageCommon_Node_XY_32b value, char oldPath[])
{
  char newPath[300];
  int result;

  result = 0;

  snprintf(newPath, elcount(newPath), "%s.%s", oldPath, "x");
  C2xSetTokenInt(packetHandle, "RoadWeatherMessage", newPath, value.x);
  result = CheckLastError("RoadWeatherMessage", gkFuncRefGet, result);

  snprintf(newPath, elcount(newPath), "%s.%s", oldPath, "y");
  C2xSetTokenInt(packetHandle, "RoadWeatherMessage", newPath, value.y);
  result = CheckLastError("RoadWeatherMessage", gkFuncRefGet, result);

  return result;
}

int GetRoadWeatherMessageCommon_Node_LLmD_64bParams(LONG packetHandle, struct RoadWeatherMessageCommon_Node_LLmD_64b value, char oldPath[])
{
  char newPath[300];
  int result;

  result = 0;

  snprintf(newPath, elcount(newPath), "%s.%s", oldPath, "lon");
  value.lon = C2xGetTokenInt(packetHandle, "RoadWeatherMessage", newPath);
  result = CheckLastError("RoadWeatherMessage", gkFuncRefGet, result);

  snprintf(newPath, elcount(newPath), "%s.%s", oldPath, "lat");
  value.lat = C2xGetTokenInt(packetHandle, "RoadWeatherMessage", newPath);
  result = CheckLastError("RoadWeatherMessage", gkFuncRefGet, result);

  return result;
}

int SetRoadWeatherMessageCommon_Node_LLmD_64bParams(LONG packetHandle, struct RoadWeatherMessageCommon_Node_LLmD_64b value, char oldPath[])
{
  char newPath[300];
  int result;

  result = 0;

  snprintf(newPath, elcount(newPath), "%s.%s", oldPath, "lon");
  C2xSetTokenInt(packetHandle, "RoadWeatherMessage", newPath, value.lon);
  result = CheckLastError("RoadWeatherMessage", gkFuncRefGet, result);

  snprintf(newPath, elcount(newPath), "%s.%s", oldPath, "lat");
  C2xSetTokenInt(packetHandle, "RoadWeatherMessage", newPath, value.lat);
  result = CheckLastError("RoadWeatherMessage", gkFuncRefGet, result);

  return result;
}

int GetRoadWeatherMessageAddGrpB_Node_LLdms_48bParams(LONG packetHandle, struct RoadWeatherMessageAddGrpB_Node_LLdms_48b value, char oldPath[])
{
  char newPath[300];
  int result;

  result = 0;

  snprintf(newPath, elcount(newPath), "%s.%s", oldPath, "lon");
  value.lon = C2xGetTokenInt(packetHandle, "RoadWeatherMessage", newPath);
  result = CheckLastError("RoadWeatherMessage", gkFuncRefGet, result);

  snprintf(newPath, elcount(newPath), "%s.%s", oldPath, "lat");
  value.lat = C2xGetTokenInt(packetHandle, "RoadWeatherMessage", newPath);
  result = CheckLastError("RoadWeatherMessage", gkFuncRefGet, result);

  return result;
}

int SetRoadWeatherMessageAddGrpB_Node_LLdms_48bParams(LONG packetHandle, struct RoadWeatherMessageAddGrpB_Node_LLdms_48b value, char oldPath[])
{
  char newPath[300];
  int result;

  result = 0;

  snprintf(newPath, elcount(newPath), "%s.%s", oldPath, "lon");
  C2xSetTokenInt(packetHandle, "RoadWeatherMessage", newPath, value.lon);
  result = CheckLastError("RoadWeatherMessage", gkFuncRefGet, result);

  snprintf(newPath, elcount(newPath), "%s.%s", oldPath, "lat");
  C2xSetTokenInt(packetHandle, "RoadWeatherMessage", newPath, value.lat);
  result = CheckLastError("RoadWeatherMessage", gkFuncRefGet, result);

  return result;
}

int GetRoadWeatherMessageAddGrpB_Node_LLdms_80bParams(LONG packetHandle, struct RoadWeatherMessageAddGrpB_Node_LLdms_80b value, char oldPath[])
{
  char newPath[300];
  int result;

  result = 0;

  snprintf(newPath, elcount(newPath), "%s.%s", oldPath, "lon");
  GetRoadWeatherMessageAddGrpB_LongitudeDMS2Params(packetHandle, value.lon, newPath);
  result = CheckLastError("RoadWeatherMessage", gkFuncRefGet, result);

  snprintf(newPath, elcount(newPath), "%s.%s", oldPath, "lat");
  GetRoadWeatherMessageAddGrpB_LatitudeDMS2Params(packetHandle, value.lat, newPath);
  result = CheckLastError("RoadWeatherMessage", gkFuncRefGet, result);

  return result;
}

int SetRoadWeatherMessageAddGrpB_Node_LLdms_80bParams(LONG packetHandle, struct RoadWeatherMessageAddGrpB_Node_LLdms_80b value, char oldPath[])
{
  char newPath[300];
  int result;

  result = 0;

  snprintf(newPath, elcount(newPath), "%s.%s", oldPath, "lon");
  SetRoadWeatherMessageAddGrpB_LongitudeDMS2Params(packetHandle, value.lon, newPath);
  result = CheckLastError("RoadWeatherMessage", gkFuncRefGet, result);

  snprintf(newPath, elcount(newPath), "%s.%s", oldPath, "lat");
  SetRoadWeatherMessageAddGrpB_LatitudeDMS2Params(packetHandle, value.lat, newPath);
  result = CheckLastError("RoadWeatherMessage", gkFuncRefGet, result);

  return result;
}

int GetRoadWeatherMessageAddGrpB_NodeOffsetPointXY_addGrpBParams(LONG packetHandle, struct RoadWeatherMessageAddGrpB_NodeOffsetPointXY_addGrpB value, char oldPath[])
{
  char newPath[300];
  int result;

  result = 0;

  value.choice = C2xGetTokenInt(packetHandle, "RoadWeatherMessage", oldPath);

  switch(value.choice)
  {
    case 0:
    {
      snprintf(newPath, elcount(newPath), "%s.%s", oldPath, "posA");
      GetRoadWeatherMessageAddGrpB_Node_LLdms_48bParams(packetHandle, value.posA, newPath);
      result = CheckLastError("RoadWeatherMessage", gkFuncRefGet, result);
    }
    break;
    case 1:
    {
      snprintf(newPath, elcount(newPath), "%s.%s", oldPath, "posB");
      GetRoadWeatherMessageAddGrpB_Node_LLdms_80bParams(packetHandle, value.posB, newPath);
      result = CheckLastError("RoadWeatherMessage", gkFuncRefGet, result);
    }
    break;
  }
  return result;
}

int SetRoadWeatherMessageAddGrpB_NodeOffsetPointXY_addGrpBParams(LONG packetHandle, struct RoadWeatherMessageAddGrpB_NodeOffsetPointXY_addGrpB value, char oldPath[])
{
  char newPath[300];
  int result;

  result = 0;

  switch(value.choice)
  {
    case 0:
    {
      snprintf(newPath, elcount(newPath), "%s.%s", oldPath, "posA");
      SetRoadWeatherMessageAddGrpB_Node_LLdms_48bParams(packetHandle, value.posA, newPath);
      result = CheckLastError("RoadWeatherMessage", gkFuncRefGet, result);
    }
    break;
    case 1:
    {
      snprintf(newPath, elcount(newPath), "%s.%s", oldPath, "posB");
      SetRoadWeatherMessageAddGrpB_Node_LLdms_80bParams(packetHandle, value.posB, newPath);
      result = CheckLastError("RoadWeatherMessage", gkFuncRefGet, result);
    }
    break;
  }
  return result;
}

int GetRoadWeatherMessageCommon_RegionalExtension_Reg_NodeOffsetPointXY_tableParams(LONG packetHandle, WORD tableKey, struct RoadWeatherMessageCommon_RegionalExtension_Reg_NodeOffsetPointXY_table value, char oldPath[])
{
  char newPath[300];
  int result;

  result = 0;

  switch(tableKey)
  {
    case 2:
    {
      snprintf(newPath, elcount(newPath), "%s.%s", oldPath, "addGrpB");
      GetRoadWeatherMessageAddGrpB_NodeOffsetPointXY_addGrpBParams(packetHandle, value.addGrpB, newPath);
      result = CheckLastError("RoadWeatherMessage", gkFuncRefGet, result);
    }
    break;
  }
  return result;
}

int SetRoadWeatherMessageCommon_RegionalExtension_Reg_NodeOffsetPointXY_tableParams(LONG packetHandle, WORD tableKey, struct RoadWeatherMessageCommon_RegionalExtension_Reg_NodeOffsetPointXY_table value, char oldPath[])
{
  char newPath[300];
  int result;

  result = 0;

  switch(tableKey)
  {
    case 2:
    {
      snprintf(newPath, elcount(newPath), "%s.%s", oldPath, "addGrpB");
      SetRoadWeatherMessageAddGrpB_NodeOffsetPointXY_addGrpBParams(packetHandle, value.addGrpB, newPath);
      result = CheckLastError("RoadWeatherMessage", gkFuncRefGet, result);
    }
    break;
  }
  return result;
}

int GetRoadWeatherMessageCommon_RegionalExtension_Reg_NodeOffsetPointXYParams(LONG packetHandle, struct RoadWeatherMessageCommon_RegionalExtension_Reg_NodeOffsetPointXY value, char oldPath[])
{
  char newPath[300];
  int result;

  result = 0;

  snprintf(newPath, elcount(newPath), "%s.%s", oldPath, "regionId");
  value.regionId = C2xGetTokenInt(packetHandle, "RoadWeatherMessage", newPath);
  result = CheckLastError("RoadWeatherMessage", gkFuncRefGet, result);

  snprintf(newPath, elcount(newPath), "%s.%s", oldPath, "regExtvalue");
  GetRoadWeatherMessageCommon_RegionalExtension_Reg_NodeOffsetPointXY_tableParams(packetHandle, value.regionId, value.regExtvalue, newPath);
  result = CheckLastError("RoadWeatherMessage", gkFuncRefGet, result);

  return result;
}

int SetRoadWeatherMessageCommon_RegionalExtension_Reg_NodeOffsetPointXYParams(LONG packetHandle, struct RoadWeatherMessageCommon_RegionalExtension_Reg_NodeOffsetPointXY value, char oldPath[])
{
  char newPath[300];
  int result;

  result = 0;


  snprintf(newPath, elcount(newPath), "%s.%s", oldPath, "regExtvalue");
  SetRoadWeatherMessageCommon_RegionalExtension_Reg_NodeOffsetPointXY_tableParams(packetHandle, value.regionId, value.regExtvalue, newPath);
  result = CheckLastError("RoadWeatherMessage", gkFuncRefGet, result);

  return result;
}

int GetRoadWeatherMessageCommon_NodeOffsetPointXYParams(LONG packetHandle, struct RoadWeatherMessageCommon_NodeOffsetPointXY value, char oldPath[])
{
  char newPath[300];
  int result;

  result = 0;

  value.choice = C2xGetTokenInt(packetHandle, "RoadWeatherMessage", oldPath);

  switch(value.choice)
  {
    case 0:
    {
      snprintf(newPath, elcount(newPath), "%s.%s", oldPath, "node_XY1");
      GetRoadWeatherMessageCommon_Node_XY_20bParams(packetHandle, value.node_XY1, newPath);
      result = CheckLastError("RoadWeatherMessage", gkFuncRefGet, result);
    }
    break;
    case 1:
    {
      snprintf(newPath, elcount(newPath), "%s.%s", oldPath, "node_XY2");
      GetRoadWeatherMessageCommon_Node_XY_22bParams(packetHandle, value.node_XY2, newPath);
      result = CheckLastError("RoadWeatherMessage", gkFuncRefGet, result);
    }
    break;
    case 2:
    {
      snprintf(newPath, elcount(newPath), "%s.%s", oldPath, "node_XY3");
      GetRoadWeatherMessageCommon_Node_XY_24bParams(packetHandle, value.node_XY3, newPath);
      result = CheckLastError("RoadWeatherMessage", gkFuncRefGet, result);
    }
    break;
    case 3:
    {
      snprintf(newPath, elcount(newPath), "%s.%s", oldPath, "node_XY4");
      GetRoadWeatherMessageCommon_Node_XY_26bParams(packetHandle, value.node_XY4, newPath);
      result = CheckLastError("RoadWeatherMessage", gkFuncRefGet, result);
    }
    break;
    case 4:
    {
      snprintf(newPath, elcount(newPath), "%s.%s", oldPath, "node_XY5");
      GetRoadWeatherMessageCommon_Node_XY_28bParams(packetHandle, value.node_XY5, newPath);
      result = CheckLastError("RoadWeatherMessage", gkFuncRefGet, result);
    }
    break;
    case 5:
    {
      snprintf(newPath, elcount(newPath), "%s.%s", oldPath, "node_XY6");
      GetRoadWeatherMessageCommon_Node_XY_32bParams(packetHandle, value.node_XY6, newPath);
      result = CheckLastError("RoadWeatherMessage", gkFuncRefGet, result);
    }
    break;
    case 6:
    {
      snprintf(newPath, elcount(newPath), "%s.%s", oldPath, "node_LatLon");
      GetRoadWeatherMessageCommon_Node_LLmD_64bParams(packetHandle, value.node_LatLon, newPath);
      result = CheckLastError("RoadWeatherMessage", gkFuncRefGet, result);
    }
    break;
    case 7:
    {
      snprintf(newPath, elcount(newPath), "%s.%s", oldPath, "regional");
      GetRoadWeatherMessageCommon_RegionalExtension_Reg_NodeOffsetPointXYParams(packetHandle, value.regional, newPath);
      result = CheckLastError("RoadWeatherMessage", gkFuncRefGet, result);
    }
    break;
  }
  return result;
}

int SetRoadWeatherMessageCommon_NodeOffsetPointXYParams(LONG packetHandle, struct RoadWeatherMessageCommon_NodeOffsetPointXY value, char oldPath[])
{
  char newPath[300];
  int result;

  result = 0;

  switch(value.choice)
  {
    case 0:
    {
      snprintf(newPath, elcount(newPath), "%s.%s", oldPath, "node_XY1");
      SetRoadWeatherMessageCommon_Node_XY_20bParams(packetHandle, value.node_XY1, newPath);
      result = CheckLastError("RoadWeatherMessage", gkFuncRefGet, result);
    }
    break;
    case 1:
    {
      snprintf(newPath, elcount(newPath), "%s.%s", oldPath, "node_XY2");
      SetRoadWeatherMessageCommon_Node_XY_22bParams(packetHandle, value.node_XY2, newPath);
      result = CheckLastError("RoadWeatherMessage", gkFuncRefGet, result);
    }
    break;
    case 2:
    {
      snprintf(newPath, elcount(newPath), "%s.%s", oldPath, "node_XY3");
      SetRoadWeatherMessageCommon_Node_XY_24bParams(packetHandle, value.node_XY3, newPath);
      result = CheckLastError("RoadWeatherMessage", gkFuncRefGet, result);
    }
    break;
    case 3:
    {
      snprintf(newPath, elcount(newPath), "%s.%s", oldPath, "node_XY4");
      SetRoadWeatherMessageCommon_Node_XY_26bParams(packetHandle, value.node_XY4, newPath);
      result = CheckLastError("RoadWeatherMessage", gkFuncRefGet, result);
    }
    break;
    case 4:
    {
      snprintf(newPath, elcount(newPath), "%s.%s", oldPath, "node_XY5");
      SetRoadWeatherMessageCommon_Node_XY_28bParams(packetHandle, value.node_XY5, newPath);
      result = CheckLastError("RoadWeatherMessage", gkFuncRefGet, result);
    }
    break;
    case 5:
    {
      snprintf(newPath, elcount(newPath), "%s.%s", oldPath, "node_XY6");
      SetRoadWeatherMessageCommon_Node_XY_32bParams(packetHandle, value.node_XY6, newPath);
      result = CheckLastError("RoadWeatherMessage", gkFuncRefGet, result);
    }
    break;
    case 6:
    {
      snprintf(newPath, elcount(newPath), "%s.%s", oldPath, "node_LatLon");
      SetRoadWeatherMessageCommon_Node_LLmD_64bParams(packetHandle, value.node_LatLon, newPath);
      result = CheckLastError("RoadWeatherMessage", gkFuncRefGet, result);
    }
    break;
    case 7:
    {
      snprintf(newPath, elcount(newPath), "%s.%s", oldPath, "regional");
      SetRoadWeatherMessageCommon_RegionalExtension_Reg_NodeOffsetPointXYParams(packetHandle, value.regional, newPath);
      result = CheckLastError("RoadWeatherMessage", gkFuncRefGet, result);
    }
    break;
  }
  return result;
}

int GetRoadWeatherMessageCommon_NodeAttributeXYListParams(LONG packetHandle, struct RoadWeatherMessageCommon_NodeAttributeXYList value, char oldPath[])
{
  char newPath[300]; 
  int i;
  int result;

  result = 0;

  value.length = C2xGetTokenInt(packetHandle, "RoadWeatherMessage", oldPath);
  if((result = CheckLastError("RoadWeatherMessage", gkFuncRefGet, result))==0)
  {
    for(i=0; i<value.length; i++)
    {
      snprintf(newPath, elcount(newPath), "%s[%d]", oldPath, i);
      value.arrayValue[i] = C2xGetTokenInt64(packetHandle, "RoadWeatherMessage", newPath);
      result = CheckLastError("RoadWeatherMessage", gkFuncRefGet, result);
    }
  }
  return result;
}

int SetRoadWeatherMessageCommon_NodeAttributeXYListParams(LONG packetHandle, struct RoadWeatherMessageCommon_NodeAttributeXYList value, char oldPath[])
{
  char newPath[300]; 
  int i;
  int result;

  result = 0;

  C2xRemoveToken(packetHandle, "RoadWeatherMessage", oldPath);
  for(i=0; i<value.length; i++)
  {
    snprintf(newPath, elcount(newPath), "%s[%d]", oldPath, i);
    C2xSetTokenInt64(packetHandle, "RoadWeatherMessage", newPath, value.arrayValue[i]);
    result = CheckLastError("RoadWeatherMessage", gkFuncRefGet, result);
  }
  return result;
}

int GetRoadWeatherMessageCommon_SegmentAttributeXYListParams(LONG packetHandle, struct RoadWeatherMessageCommon_SegmentAttributeXYList value, char oldPath[])
{
  char newPath[300]; 
  int i;
  int result;

  result = 0;

  value.length = C2xGetTokenInt(packetHandle, "RoadWeatherMessage", oldPath);
  if((result = CheckLastError("RoadWeatherMessage", gkFuncRefGet, result))==0)
  {
    for(i=0; i<value.length; i++)
    {
      snprintf(newPath, elcount(newPath), "%s[%d]", oldPath, i);
      value.arrayValue[i] = C2xGetTokenInt64(packetHandle, "RoadWeatherMessage", newPath);
      result = CheckLastError("RoadWeatherMessage", gkFuncRefGet, result);
    }
  }
  return result;
}

int SetRoadWeatherMessageCommon_SegmentAttributeXYListParams(LONG packetHandle, struct RoadWeatherMessageCommon_SegmentAttributeXYList value, char oldPath[])
{
  char newPath[300]; 
  int i;
  int result;

  result = 0;

  C2xRemoveToken(packetHandle, "RoadWeatherMessage", oldPath);
  for(i=0; i<value.length; i++)
  {
    snprintf(newPath, elcount(newPath), "%s[%d]", oldPath, i);
    C2xSetTokenInt64(packetHandle, "RoadWeatherMessage", newPath, value.arrayValue[i]);
    result = CheckLastError("RoadWeatherMessage", gkFuncRefGet, result);
  }
  return result;
}

int GetRoadWeatherMessageCommon_RegulatorySpeedLimitParams(LONG packetHandle, struct RoadWeatherMessageCommon_RegulatorySpeedLimit value, char oldPath[])
{
  char newPath[300];
  int result;

  result = 0;

  snprintf(newPath, elcount(newPath), "%s.%s", oldPath, "type");
  value.type = C2xGetTokenInt(packetHandle, "RoadWeatherMessage", newPath);
  result = CheckLastError("RoadWeatherMessage", gkFuncRefGet, result);

  snprintf(newPath, elcount(newPath), "%s.%s", oldPath, "speed");
  value.speed = C2xGetTokenInt(packetHandle, "RoadWeatherMessage", newPath);
  result = CheckLastError("RoadWeatherMessage", gkFuncRefGet, result);

  return result;
}

int SetRoadWeatherMessageCommon_RegulatorySpeedLimitParams(LONG packetHandle, struct RoadWeatherMessageCommon_RegulatorySpeedLimit value, char oldPath[])
{
  char newPath[300];
  int result;

  result = 0;

  snprintf(newPath, elcount(newPath), "%s.%s", oldPath, "type");
  C2xSetTokenInt(packetHandle, "RoadWeatherMessage", newPath, value.type);
  result = CheckLastError("RoadWeatherMessage", gkFuncRefGet, result);

  snprintf(newPath, elcount(newPath), "%s.%s", oldPath, "speed");
  C2xSetTokenInt(packetHandle, "RoadWeatherMessage", newPath, value.speed);
  result = CheckLastError("RoadWeatherMessage", gkFuncRefGet, result);

  return result;
}

int GetRoadWeatherMessageCommon_SpeedLimitListParams(LONG packetHandle, struct RoadWeatherMessageCommon_SpeedLimitList value, char oldPath[])
{
  char newPath[300]; 
  int i;
  int result;

  result = 0;

  value.length = C2xGetTokenInt(packetHandle, "RoadWeatherMessage", oldPath);
  if((result = CheckLastError("RoadWeatherMessage", gkFuncRefGet, result))==0)
  {
    for(i=0; i<value.length; i++)
    {
      snprintf(newPath, elcount(newPath), "%s[%d]", oldPath, i);
      GetRoadWeatherMessageCommon_RegulatorySpeedLimitParams(packetHandle, value.arrayValue[i], newPath);
      result = CheckLastError("RoadWeatherMessage", gkFuncRefGet, result);
    }
  }
  return result;
}

int SetRoadWeatherMessageCommon_SpeedLimitListParams(LONG packetHandle, struct RoadWeatherMessageCommon_SpeedLimitList value, char oldPath[])
{
  char newPath[300]; 
  int i;
  int result;

  result = 0;

  C2xRemoveToken(packetHandle, "RoadWeatherMessage", oldPath);
  for(i=0; i<value.length; i++)
  {
    snprintf(newPath, elcount(newPath), "%s[%d]", oldPath, i);
    SetRoadWeatherMessageCommon_RegulatorySpeedLimitParams(packetHandle, value.arrayValue[i], newPath);
    result = CheckLastError("RoadWeatherMessage", gkFuncRefGet, result);
  }
  return result;
}

int GetRoadWeatherMessageCommon_RegionalExtension_Reg_LaneDataAttributeParams(LONG packetHandle, struct RoadWeatherMessageCommon_RegionalExtension_Reg_LaneDataAttribute value, char oldPath[])
{
  char newPath[300];
  int result;

  result = 0;

  snprintf(newPath, elcount(newPath), "%s.%s", oldPath, "regionId");
  value.regionId = C2xGetTokenInt(packetHandle, "RoadWeatherMessage", newPath);
  result = CheckLastError("RoadWeatherMessage", gkFuncRefGet, result);

  return result;
}

int SetRoadWeatherMessageCommon_RegionalExtension_Reg_LaneDataAttributeParams(LONG packetHandle, struct RoadWeatherMessageCommon_RegionalExtension_Reg_LaneDataAttribute value, char oldPath[])
{
  char newPath[300];
  int result;

  result = 0;


  return result;
}

int GetRoadWeatherMessageCommon_LaneDataAttribute_regionalParams(LONG packetHandle, struct RoadWeatherMessageCommon_LaneDataAttribute_regional value, char oldPath[])
{
  char newPath[300]; 
  int i;
  int result;

  result = 0;

  value.length = C2xGetTokenInt(packetHandle, "RoadWeatherMessage", oldPath);
  if((result = CheckLastError("RoadWeatherMessage", gkFuncRefGet, result))==0)
  {
    for(i=0; i<value.length; i++)
    {
      snprintf(newPath, elcount(newPath), "%s[%d]", oldPath, i);
      GetRoadWeatherMessageCommon_RegionalExtension_Reg_LaneDataAttributeParams(packetHandle, value.arrayValue[i], newPath);
      result = CheckLastError("RoadWeatherMessage", gkFuncRefGet, result);
    }
  }
  return result;
}

int SetRoadWeatherMessageCommon_LaneDataAttribute_regionalParams(LONG packetHandle, struct RoadWeatherMessageCommon_LaneDataAttribute_regional value, char oldPath[])
{
  char newPath[300]; 
  int i;
  int result;

  result = 0;

  C2xRemoveToken(packetHandle, "RoadWeatherMessage", oldPath);
  for(i=0; i<value.length; i++)
  {
    snprintf(newPath, elcount(newPath), "%s[%d]", oldPath, i);
    SetRoadWeatherMessageCommon_RegionalExtension_Reg_LaneDataAttributeParams(packetHandle, value.arrayValue[i], newPath);
    result = CheckLastError("RoadWeatherMessage", gkFuncRefGet, result);
  }
  return result;
}

int GetRoadWeatherMessageCommon_LaneDataAttributeParams(LONG packetHandle, struct RoadWeatherMessageCommon_LaneDataAttribute value, char oldPath[])
{
  char newPath[300];
  int result;

  result = 0;

  value.choice = C2xGetTokenInt(packetHandle, "RoadWeatherMessage", oldPath);

  switch(value.choice)
  {
    case 0:
    {
      snprintf(newPath, elcount(newPath), "%s.%s", oldPath, "pathEndPointAngle");
      value.pathEndPointAngle = C2xGetTokenInt(packetHandle, "RoadWeatherMessage", newPath);
      result = CheckLastError("RoadWeatherMessage", gkFuncRefGet, result);
    }
    break;
    case 1:
    {
      snprintf(newPath, elcount(newPath), "%s.%s", oldPath, "laneCrownPointCenter");
      value.laneCrownPointCenter = C2xGetTokenInt(packetHandle, "RoadWeatherMessage", newPath);
      result = CheckLastError("RoadWeatherMessage", gkFuncRefGet, result);
    }
    break;
    case 2:
    {
      snprintf(newPath, elcount(newPath), "%s.%s", oldPath, "laneCrownPointLeft");
      value.laneCrownPointLeft = C2xGetTokenInt(packetHandle, "RoadWeatherMessage", newPath);
      result = CheckLastError("RoadWeatherMessage", gkFuncRefGet, result);
    }
    break;
    case 3:
    {
      snprintf(newPath, elcount(newPath), "%s.%s", oldPath, "laneCrownPointRight");
      value.laneCrownPointRight = C2xGetTokenInt(packetHandle, "RoadWeatherMessage", newPath);
      result = CheckLastError("RoadWeatherMessage", gkFuncRefGet, result);
    }
    break;
    case 4:
    {
      snprintf(newPath, elcount(newPath), "%s.%s", oldPath, "laneAngle");
      value.laneAngle = C2xGetTokenInt(packetHandle, "RoadWeatherMessage", newPath);
      result = CheckLastError("RoadWeatherMessage", gkFuncRefGet, result);
    }
    break;
    case 5:
    {
      snprintf(newPath, elcount(newPath), "%s.%s", oldPath, "speedLimits");
      GetRoadWeatherMessageCommon_SpeedLimitListParams(packetHandle, value.speedLimits, newPath);
      result = CheckLastError("RoadWeatherMessage", gkFuncRefGet, result);
    }
    break;
    case 6:
    {
      snprintf(newPath, elcount(newPath), "%s.%s", oldPath, "regional");
      GetRoadWeatherMessageCommon_LaneDataAttribute_regionalParams(packetHandle, value.regional, newPath);
      result = CheckLastError("RoadWeatherMessage", gkFuncRefGet, result);
    }
    break;
  }
  return result;
}

int SetRoadWeatherMessageCommon_LaneDataAttributeParams(LONG packetHandle, struct RoadWeatherMessageCommon_LaneDataAttribute value, char oldPath[])
{
  char newPath[300];
  int result;

  result = 0;

  switch(value.choice)
  {
    case 0:
    {
      snprintf(newPath, elcount(newPath), "%s.%s", oldPath, "pathEndPointAngle");
      C2xSetTokenInt(packetHandle, "RoadWeatherMessage", newPath, value.pathEndPointAngle);
      result = CheckLastError("RoadWeatherMessage", gkFuncRefGet, result);
    }
    break;
    case 1:
    {
      snprintf(newPath, elcount(newPath), "%s.%s", oldPath, "laneCrownPointCenter");
      C2xSetTokenInt(packetHandle, "RoadWeatherMessage", newPath, value.laneCrownPointCenter);
      result = CheckLastError("RoadWeatherMessage", gkFuncRefGet, result);
    }
    break;
    case 2:
    {
      snprintf(newPath, elcount(newPath), "%s.%s", oldPath, "laneCrownPointLeft");
      C2xSetTokenInt(packetHandle, "RoadWeatherMessage", newPath, value.laneCrownPointLeft);
      result = CheckLastError("RoadWeatherMessage", gkFuncRefGet, result);
    }
    break;
    case 3:
    {
      snprintf(newPath, elcount(newPath), "%s.%s", oldPath, "laneCrownPointRight");
      C2xSetTokenInt(packetHandle, "RoadWeatherMessage", newPath, value.laneCrownPointRight);
      result = CheckLastError("RoadWeatherMessage", gkFuncRefGet, result);
    }
    break;
    case 4:
    {
      snprintf(newPath, elcount(newPath), "%s.%s", oldPath, "laneAngle");
      C2xSetTokenInt(packetHandle, "RoadWeatherMessage", newPath, value.laneAngle);
      result = CheckLastError("RoadWeatherMessage", gkFuncRefGet, result);
    }
    break;
    case 5:
    {
      snprintf(newPath, elcount(newPath), "%s.%s", oldPath, "speedLimits");
      SetRoadWeatherMessageCommon_SpeedLimitListParams(packetHandle, value.speedLimits, newPath);
      result = CheckLastError("RoadWeatherMessage", gkFuncRefGet, result);
    }
    break;
    case 6:
    {
      snprintf(newPath, elcount(newPath), "%s.%s", oldPath, "regional");
      SetRoadWeatherMessageCommon_LaneDataAttribute_regionalParams(packetHandle, value.regional, newPath);
      result = CheckLastError("RoadWeatherMessage", gkFuncRefGet, result);
    }
    break;
  }
  return result;
}

int GetRoadWeatherMessageCommon_LaneDataAttributeListParams(LONG packetHandle, struct RoadWeatherMessageCommon_LaneDataAttributeList value, char oldPath[])
{
  char newPath[300]; 
  int i;
  int result;

  result = 0;

  value.length = C2xGetTokenInt(packetHandle, "RoadWeatherMessage", oldPath);
  if((result = CheckLastError("RoadWeatherMessage", gkFuncRefGet, result))==0)
  {
    for(i=0; i<value.length; i++)
    {
      snprintf(newPath, elcount(newPath), "%s[%d]", oldPath, i);
      GetRoadWeatherMessageCommon_LaneDataAttributeParams(packetHandle, value.arrayValue[i], newPath);
      result = CheckLastError("RoadWeatherMessage", gkFuncRefGet, result);
    }
  }
  return result;
}

int SetRoadWeatherMessageCommon_LaneDataAttributeListParams(LONG packetHandle, struct RoadWeatherMessageCommon_LaneDataAttributeList value, char oldPath[])
{
  char newPath[300]; 
  int i;
  int result;

  result = 0;

  C2xRemoveToken(packetHandle, "RoadWeatherMessage", oldPath);
  for(i=0; i<value.length; i++)
  {
    snprintf(newPath, elcount(newPath), "%s[%d]", oldPath, i);
    SetRoadWeatherMessageCommon_LaneDataAttributeParams(packetHandle, value.arrayValue[i], newPath);
    result = CheckLastError("RoadWeatherMessage", gkFuncRefGet, result);
  }
  return result;
}

int GetRoadWeatherMessageCommon_RegionalExtension_Reg_NodeAttributeSetXYParams(LONG packetHandle, struct RoadWeatherMessageCommon_RegionalExtension_Reg_NodeAttributeSetXY value, char oldPath[])
{
  char newPath[300];
  int result;

  result = 0;

  snprintf(newPath, elcount(newPath), "%s.%s", oldPath, "regionId");
  value.regionId = C2xGetTokenInt(packetHandle, "RoadWeatherMessage", newPath);
  result = CheckLastError("RoadWeatherMessage", gkFuncRefGet, result);

  return result;
}

int SetRoadWeatherMessageCommon_RegionalExtension_Reg_NodeAttributeSetXYParams(LONG packetHandle, struct RoadWeatherMessageCommon_RegionalExtension_Reg_NodeAttributeSetXY value, char oldPath[])
{
  char newPath[300];
  int result;

  result = 0;


  return result;
}

int GetRoadWeatherMessageCommon_NodeAttributeSetXY_regionalParams(LONG packetHandle, struct RoadWeatherMessageCommon_NodeAttributeSetXY_regional value, char oldPath[])
{
  char newPath[300]; 
  int i;
  int result;

  result = 0;

  value.length = C2xGetTokenInt(packetHandle, "RoadWeatherMessage", oldPath);
  if((result = CheckLastError("RoadWeatherMessage", gkFuncRefGet, result))==0)
  {
    for(i=0; i<value.length; i++)
    {
      snprintf(newPath, elcount(newPath), "%s[%d]", oldPath, i);
      GetRoadWeatherMessageCommon_RegionalExtension_Reg_NodeAttributeSetXYParams(packetHandle, value.arrayValue[i], newPath);
      result = CheckLastError("RoadWeatherMessage", gkFuncRefGet, result);
    }
  }
  return result;
}

int SetRoadWeatherMessageCommon_NodeAttributeSetXY_regionalParams(LONG packetHandle, struct RoadWeatherMessageCommon_NodeAttributeSetXY_regional value, char oldPath[])
{
  char newPath[300]; 
  int i;
  int result;

  result = 0;

  C2xRemoveToken(packetHandle, "RoadWeatherMessage", oldPath);
  for(i=0; i<value.length; i++)
  {
    snprintf(newPath, elcount(newPath), "%s[%d]", oldPath, i);
    SetRoadWeatherMessageCommon_RegionalExtension_Reg_NodeAttributeSetXYParams(packetHandle, value.arrayValue[i], newPath);
    result = CheckLastError("RoadWeatherMessage", gkFuncRefGet, result);
  }
  return result;
}

int GetRoadWeatherMessageCommon_NodeAttributeSetXYParams(LONG packetHandle, struct RoadWeatherMessageCommon_NodeAttributeSetXY value, char oldPath[])
{
  char newPath[300];
  int result;

  result = 0;

  snprintf(newPath, elcount(newPath), "%s.%s", oldPath, "localNode");
  value.localNode.isValidFlag = C2xIsTokenAvailable(packetHandle, "RoadWeatherMessage", newPath);
  if(value.localNode.isValidFlag==1)
  {
    GetRoadWeatherMessageCommon_NodeAttributeXYListParams(packetHandle, value.localNode, newPath);
    result = CheckLastError("RoadWeatherMessage", gkFuncRefGet, result);
  }
  snprintf(newPath, elcount(newPath), "%s.%s", oldPath, "disabled");
  value.disabled.isValidFlag = C2xIsTokenAvailable(packetHandle, "RoadWeatherMessage", newPath);
  if(value.disabled.isValidFlag==1)
  {
    GetRoadWeatherMessageCommon_SegmentAttributeXYListParams(packetHandle, value.disabled, newPath);
    result = CheckLastError("RoadWeatherMessage", gkFuncRefGet, result);
  }
  snprintf(newPath, elcount(newPath), "%s.%s", oldPath, "enabled");
  value.enabled.isValidFlag = C2xIsTokenAvailable(packetHandle, "RoadWeatherMessage", newPath);
  if(value.enabled.isValidFlag==1)
  {
    GetRoadWeatherMessageCommon_SegmentAttributeXYListParams(packetHandle, value.enabled, newPath);
    result = CheckLastError("RoadWeatherMessage", gkFuncRefGet, result);
  }
  snprintf(newPath, elcount(newPath), "%s.%s", oldPath, "data");
  value.data.isValidFlag = C2xIsTokenAvailable(packetHandle, "RoadWeatherMessage", newPath);
  if(value.data.isValidFlag==1)
  {
    GetRoadWeatherMessageCommon_LaneDataAttributeListParams(packetHandle, value.data, newPath);
    result = CheckLastError("RoadWeatherMessage", gkFuncRefGet, result);
  }
  snprintf(newPath, elcount(newPath), "%s.%s", oldPath, "dWidth");
  value.dWidth.isValidFlag = C2xIsTokenAvailable(packetHandle, "RoadWeatherMessage", newPath);
  if(value.dWidth.isValidFlag==1)
  {
    value.dWidth.value = C2xGetTokenInt(packetHandle, "RoadWeatherMessage", newPath);
    result = CheckLastError("RoadWeatherMessage", gkFuncRefGet, result);
  }
  snprintf(newPath, elcount(newPath), "%s.%s", oldPath, "dElevation");
  value.dElevation.isValidFlag = C2xIsTokenAvailable(packetHandle, "RoadWeatherMessage", newPath);
  if(value.dElevation.isValidFlag==1)
  {
    value.dElevation.value = C2xGetTokenInt(packetHandle, "RoadWeatherMessage", newPath);
    result = CheckLastError("RoadWeatherMessage", gkFuncRefGet, result);
  }
  snprintf(newPath, elcount(newPath), "%s.%s", oldPath, "regional");
  value.regional.isValidFlag = C2xIsTokenAvailable(packetHandle, "RoadWeatherMessage", newPath);
  if(value.regional.isValidFlag==1)
  {
    GetRoadWeatherMessageCommon_NodeAttributeSetXY_regionalParams(packetHandle, value.regional, newPath);
    result = CheckLastError("RoadWeatherMessage", gkFuncRefGet, result);
  }
  return result;
}

int SetRoadWeatherMessageCommon_NodeAttributeSetXYParams(LONG packetHandle, struct RoadWeatherMessageCommon_NodeAttributeSetXY value, char oldPath[])
{
  char newPath[300];
  int result;

  result = 0;

  snprintf(newPath, elcount(newPath), "%s.%s", oldPath, "localNode");
  if(value.localNode.isValidFlag==1)
  {
    SetRoadWeatherMessageCommon_NodeAttributeXYListParams(packetHandle, value.localNode, newPath);
    result = CheckLastError("RoadWeatherMessage", gkFuncRefGet, result);
  }
  else
  {
    if( C2xIsTokenAvailable(packetHandle, "RoadWeatherMessage", newPath) )
    {
      C2xRemoveToken(packetHandle, "RoadWeatherMessage", newPath);
    }
  }

  snprintf(newPath, elcount(newPath), "%s.%s", oldPath, "disabled");
  if(value.disabled.isValidFlag==1)
  {
    SetRoadWeatherMessageCommon_SegmentAttributeXYListParams(packetHandle, value.disabled, newPath);
    result = CheckLastError("RoadWeatherMessage", gkFuncRefGet, result);
  }
  else
  {
    if( C2xIsTokenAvailable(packetHandle, "RoadWeatherMessage", newPath) )
    {
      C2xRemoveToken(packetHandle, "RoadWeatherMessage", newPath);
    }
  }

  snprintf(newPath, elcount(newPath), "%s.%s", oldPath, "enabled");
  if(value.enabled.isValidFlag==1)
  {
    SetRoadWeatherMessageCommon_SegmentAttributeXYListParams(packetHandle, value.enabled, newPath);
    result = CheckLastError("RoadWeatherMessage", gkFuncRefGet, result);
  }
  else
  {
    if( C2xIsTokenAvailable(packetHandle, "RoadWeatherMessage", newPath) )
    {
      C2xRemoveToken(packetHandle, "RoadWeatherMessage", newPath);
    }
  }

  snprintf(newPath, elcount(newPath), "%s.%s", oldPath, "data");
  if(value.data.isValidFlag==1)
  {
    SetRoadWeatherMessageCommon_LaneDataAttributeListParams(packetHandle, value.data, newPath);
    result = CheckLastError("RoadWeatherMessage", gkFuncRefGet, result);
  }
  else
  {
    if( C2xIsTokenAvailable(packetHandle, "RoadWeatherMessage", newPath) )
    {
      C2xRemoveToken(packetHandle, "RoadWeatherMessage", newPath);
    }
  }

  snprintf(newPath, elcount(newPath), "%s.%s", oldPath, "dWidth");
  if(value.dWidth.isValidFlag==1)
  {
    C2xSetTokenInt(packetHandle, "RoadWeatherMessage", newPath, value.dWidth.value);
    result = CheckLastError("RoadWeatherMessage", gkFuncRefGet, result);
  }
  else
  {
    if( C2xIsTokenAvailable(packetHandle, "RoadWeatherMessage", newPath) )
    {
      C2xRemoveToken(packetHandle, "RoadWeatherMessage", newPath);
    }
  }

  snprintf(newPath, elcount(newPath), "%s.%s", oldPath, "dElevation");
  if(value.dElevation.isValidFlag==1)
  {
    C2xSetTokenInt(packetHandle, "RoadWeatherMessage", newPath, value.dElevation.value);
    result = CheckLastError("RoadWeatherMessage", gkFuncRefGet, result);
  }
  else
  {
    if( C2xIsTokenAvailable(packetHandle, "RoadWeatherMessage", newPath) )
    {
      C2xRemoveToken(packetHandle, "RoadWeatherMessage", newPath);
    }
  }

  snprintf(newPath, elcount(newPath), "%s.%s", oldPath, "regional");
  if(value.regional.isValidFlag==1)
  {
    SetRoadWeatherMessageCommon_NodeAttributeSetXY_regionalParams(packetHandle, value.regional, newPath);
    result = CheckLastError("RoadWeatherMessage", gkFuncRefGet, result);
  }
  else
  {
    if( C2xIsTokenAvailable(packetHandle, "RoadWeatherMessage", newPath) )
    {
      C2xRemoveToken(packetHandle, "RoadWeatherMessage", newPath);
    }
  }

  return result;
}

int GetRoadWeatherMessageCommon_NodeXYParams(LONG packetHandle, struct RoadWeatherMessageCommon_NodeXY value, char oldPath[])
{
  char newPath[300];
  int result;

  result = 0;

  snprintf(newPath, elcount(newPath), "%s.%s", oldPath, "delta");
  GetRoadWeatherMessageCommon_NodeOffsetPointXYParams(packetHandle, value.delta, newPath);
  result = CheckLastError("RoadWeatherMessage", gkFuncRefGet, result);

  snprintf(newPath, elcount(newPath), "%s.%s", oldPath, "attributes");
  value.attributes.isValidFlag = C2xIsTokenAvailable(packetHandle, "RoadWeatherMessage", newPath);
  if(value.attributes.isValidFlag==1)
  {
    GetRoadWeatherMessageCommon_NodeAttributeSetXYParams(packetHandle, value.attributes, newPath);
    result = CheckLastError("RoadWeatherMessage", gkFuncRefGet, result);
  }
  return result;
}

int SetRoadWeatherMessageCommon_NodeXYParams(LONG packetHandle, struct RoadWeatherMessageCommon_NodeXY value, char oldPath[])
{
  char newPath[300];
  int result;

  result = 0;

  snprintf(newPath, elcount(newPath), "%s.%s", oldPath, "delta");
  SetRoadWeatherMessageCommon_NodeOffsetPointXYParams(packetHandle, value.delta, newPath);
  result = CheckLastError("RoadWeatherMessage", gkFuncRefGet, result);

  snprintf(newPath, elcount(newPath), "%s.%s", oldPath, "attributes");
  if(value.attributes.isValidFlag==1)
  {
    SetRoadWeatherMessageCommon_NodeAttributeSetXYParams(packetHandle, value.attributes, newPath);
    result = CheckLastError("RoadWeatherMessage", gkFuncRefGet, result);
  }
  else
  {
    if( C2xIsTokenAvailable(packetHandle, "RoadWeatherMessage", newPath) )
    {
      C2xRemoveToken(packetHandle, "RoadWeatherMessage", newPath);
    }
  }

  return result;
}

int GetRoadWeatherMessageCommon_NodeSetXYParams(LONG packetHandle, struct RoadWeatherMessageCommon_NodeSetXY value, char oldPath[])
{
  char newPath[300]; 
  int i;
  int result;

  result = 0;

  value.length = C2xGetTokenInt(packetHandle, "RoadWeatherMessage", oldPath);
  if((result = CheckLastError("RoadWeatherMessage", gkFuncRefGet, result))==0)
  {
    for(i=0; i<value.length; i++)
    {
      snprintf(newPath, elcount(newPath), "%s[%d]", oldPath, i);
      GetRoadWeatherMessageCommon_NodeXYParams(packetHandle, value.arrayValue[i], newPath);
      result = CheckLastError("RoadWeatherMessage", gkFuncRefGet, result);
    }
  }
  return result;
}

int SetRoadWeatherMessageCommon_NodeSetXYParams(LONG packetHandle, struct RoadWeatherMessageCommon_NodeSetXY value, char oldPath[])
{
  char newPath[300]; 
  int i;
  int result;

  result = 0;

  C2xRemoveToken(packetHandle, "RoadWeatherMessage", oldPath);
  for(i=0; i<value.length; i++)
  {
    snprintf(newPath, elcount(newPath), "%s[%d]", oldPath, i);
    SetRoadWeatherMessageCommon_NodeXYParams(packetHandle, value.arrayValue[i], newPath);
    result = CheckLastError("RoadWeatherMessage", gkFuncRefGet, result);
  }
  return result;
}

int GetRoadWeatherMessageCommon_ComputedLane_offsetXaxisParams(LONG packetHandle, struct RoadWeatherMessageCommon_ComputedLane_offsetXaxis value, char oldPath[])
{
  char newPath[300];
  int result;

  result = 0;

  value.choice = C2xGetTokenInt(packetHandle, "RoadWeatherMessage", oldPath);

  switch(value.choice)
  {
    case 0:
    {
      snprintf(newPath, elcount(newPath), "%s.%s", oldPath, "small");
      value.small = C2xGetTokenInt(packetHandle, "RoadWeatherMessage", newPath);
      result = CheckLastError("RoadWeatherMessage", gkFuncRefGet, result);
    }
    break;
    case 1:
    {
      snprintf(newPath, elcount(newPath), "%s.%s", oldPath, "large");
      value.large = C2xGetTokenInt(packetHandle, "RoadWeatherMessage", newPath);
      result = CheckLastError("RoadWeatherMessage", gkFuncRefGet, result);
    }
    break;
  }
  return result;
}

int SetRoadWeatherMessageCommon_ComputedLane_offsetXaxisParams(LONG packetHandle, struct RoadWeatherMessageCommon_ComputedLane_offsetXaxis value, char oldPath[])
{
  char newPath[300];
  int result;

  result = 0;

  switch(value.choice)
  {
    case 0:
    {
      snprintf(newPath, elcount(newPath), "%s.%s", oldPath, "small");
      C2xSetTokenInt(packetHandle, "RoadWeatherMessage", newPath, value.small);
      result = CheckLastError("RoadWeatherMessage", gkFuncRefGet, result);
    }
    break;
    case 1:
    {
      snprintf(newPath, elcount(newPath), "%s.%s", oldPath, "large");
      C2xSetTokenInt(packetHandle, "RoadWeatherMessage", newPath, value.large);
      result = CheckLastError("RoadWeatherMessage", gkFuncRefGet, result);
    }
    break;
  }
  return result;
}

int GetRoadWeatherMessageCommon_ComputedLane_offsetYaxisParams(LONG packetHandle, struct RoadWeatherMessageCommon_ComputedLane_offsetYaxis value, char oldPath[])
{
  char newPath[300];
  int result;

  result = 0;

  value.choice = C2xGetTokenInt(packetHandle, "RoadWeatherMessage", oldPath);

  switch(value.choice)
  {
    case 0:
    {
      snprintf(newPath, elcount(newPath), "%s.%s", oldPath, "small");
      value.small = C2xGetTokenInt(packetHandle, "RoadWeatherMessage", newPath);
      result = CheckLastError("RoadWeatherMessage", gkFuncRefGet, result);
    }
    break;
    case 1:
    {
      snprintf(newPath, elcount(newPath), "%s.%s", oldPath, "large");
      value.large = C2xGetTokenInt(packetHandle, "RoadWeatherMessage", newPath);
      result = CheckLastError("RoadWeatherMessage", gkFuncRefGet, result);
    }
    break;
  }
  return result;
}

int SetRoadWeatherMessageCommon_ComputedLane_offsetYaxisParams(LONG packetHandle, struct RoadWeatherMessageCommon_ComputedLane_offsetYaxis value, char oldPath[])
{
  char newPath[300];
  int result;

  result = 0;

  switch(value.choice)
  {
    case 0:
    {
      snprintf(newPath, elcount(newPath), "%s.%s", oldPath, "small");
      C2xSetTokenInt(packetHandle, "RoadWeatherMessage", newPath, value.small);
      result = CheckLastError("RoadWeatherMessage", gkFuncRefGet, result);
    }
    break;
    case 1:
    {
      snprintf(newPath, elcount(newPath), "%s.%s", oldPath, "large");
      C2xSetTokenInt(packetHandle, "RoadWeatherMessage", newPath, value.large);
      result = CheckLastError("RoadWeatherMessage", gkFuncRefGet, result);
    }
    break;
  }
  return result;
}

int GetRoadWeatherMessageCommon_RegionalExtension_Reg_ComputedLaneParams(LONG packetHandle, struct RoadWeatherMessageCommon_RegionalExtension_Reg_ComputedLane value, char oldPath[])
{
  char newPath[300];
  int result;

  result = 0;

  snprintf(newPath, elcount(newPath), "%s.%s", oldPath, "regionId");
  value.regionId = C2xGetTokenInt(packetHandle, "RoadWeatherMessage", newPath);
  result = CheckLastError("RoadWeatherMessage", gkFuncRefGet, result);

  return result;
}

int SetRoadWeatherMessageCommon_RegionalExtension_Reg_ComputedLaneParams(LONG packetHandle, struct RoadWeatherMessageCommon_RegionalExtension_Reg_ComputedLane value, char oldPath[])
{
  char newPath[300];
  int result;

  result = 0;


  return result;
}

int GetRoadWeatherMessageCommon_ComputedLane_regionalParams(LONG packetHandle, struct RoadWeatherMessageCommon_ComputedLane_regional value, char oldPath[])
{
  char newPath[300]; 
  int i;
  int result;

  result = 0;

  value.length = C2xGetTokenInt(packetHandle, "RoadWeatherMessage", oldPath);
  if((result = CheckLastError("RoadWeatherMessage", gkFuncRefGet, result))==0)
  {
    for(i=0; i<value.length; i++)
    {
      snprintf(newPath, elcount(newPath), "%s[%d]", oldPath, i);
      GetRoadWeatherMessageCommon_RegionalExtension_Reg_ComputedLaneParams(packetHandle, value.arrayValue[i], newPath);
      result = CheckLastError("RoadWeatherMessage", gkFuncRefGet, result);
    }
  }
  return result;
}

int SetRoadWeatherMessageCommon_ComputedLane_regionalParams(LONG packetHandle, struct RoadWeatherMessageCommon_ComputedLane_regional value, char oldPath[])
{
  char newPath[300]; 
  int i;
  int result;

  result = 0;

  C2xRemoveToken(packetHandle, "RoadWeatherMessage", oldPath);
  for(i=0; i<value.length; i++)
  {
    snprintf(newPath, elcount(newPath), "%s[%d]", oldPath, i);
    SetRoadWeatherMessageCommon_RegionalExtension_Reg_ComputedLaneParams(packetHandle, value.arrayValue[i], newPath);
    result = CheckLastError("RoadWeatherMessage", gkFuncRefGet, result);
  }
  return result;
}

int GetRoadWeatherMessageCommon_ComputedLaneParams(LONG packetHandle, struct RoadWeatherMessageCommon_ComputedLane value, char oldPath[])
{
  char newPath[300];
  int result;

  result = 0;

  snprintf(newPath, elcount(newPath), "%s.%s", oldPath, "referenceLaneId");
  value.referenceLaneId = C2xGetTokenInt(packetHandle, "RoadWeatherMessage", newPath);
  result = CheckLastError("RoadWeatherMessage", gkFuncRefGet, result);

  snprintf(newPath, elcount(newPath), "%s.%s", oldPath, "offsetXaxis");
  GetRoadWeatherMessageCommon_ComputedLane_offsetXaxisParams(packetHandle, value.offsetXaxis, newPath);
  result = CheckLastError("RoadWeatherMessage", gkFuncRefGet, result);

  snprintf(newPath, elcount(newPath), "%s.%s", oldPath, "offsetYaxis");
  GetRoadWeatherMessageCommon_ComputedLane_offsetYaxisParams(packetHandle, value.offsetYaxis, newPath);
  result = CheckLastError("RoadWeatherMessage", gkFuncRefGet, result);

  snprintf(newPath, elcount(newPath), "%s.%s", oldPath, "rotateXY");
  value.rotateXY.isValidFlag = C2xIsTokenAvailable(packetHandle, "RoadWeatherMessage", newPath);
  if(value.rotateXY.isValidFlag==1)
  {
    value.rotateXY.value = C2xGetTokenInt(packetHandle, "RoadWeatherMessage", newPath);
    result = CheckLastError("RoadWeatherMessage", gkFuncRefGet, result);
  }
  snprintf(newPath, elcount(newPath), "%s.%s", oldPath, "scaleXaxis");
  value.scaleXaxis.isValidFlag = C2xIsTokenAvailable(packetHandle, "RoadWeatherMessage", newPath);
  if(value.scaleXaxis.isValidFlag==1)
  {
    value.scaleXaxis.value = C2xGetTokenInt(packetHandle, "RoadWeatherMessage", newPath);
    result = CheckLastError("RoadWeatherMessage", gkFuncRefGet, result);
  }
  snprintf(newPath, elcount(newPath), "%s.%s", oldPath, "scaleYaxis");
  value.scaleYaxis.isValidFlag = C2xIsTokenAvailable(packetHandle, "RoadWeatherMessage", newPath);
  if(value.scaleYaxis.isValidFlag==1)
  {
    value.scaleYaxis.value = C2xGetTokenInt(packetHandle, "RoadWeatherMessage", newPath);
    result = CheckLastError("RoadWeatherMessage", gkFuncRefGet, result);
  }
  snprintf(newPath, elcount(newPath), "%s.%s", oldPath, "regional");
  value.regional.isValidFlag = C2xIsTokenAvailable(packetHandle, "RoadWeatherMessage", newPath);
  if(value.regional.isValidFlag==1)
  {
    GetRoadWeatherMessageCommon_ComputedLane_regionalParams(packetHandle, value.regional, newPath);
    result = CheckLastError("RoadWeatherMessage", gkFuncRefGet, result);
  }
  return result;
}

int SetRoadWeatherMessageCommon_ComputedLaneParams(LONG packetHandle, struct RoadWeatherMessageCommon_ComputedLane value, char oldPath[])
{
  char newPath[300];
  int result;

  result = 0;

  snprintf(newPath, elcount(newPath), "%s.%s", oldPath, "referenceLaneId");
  C2xSetTokenInt(packetHandle, "RoadWeatherMessage", newPath, value.referenceLaneId);
  result = CheckLastError("RoadWeatherMessage", gkFuncRefGet, result);

  snprintf(newPath, elcount(newPath), "%s.%s", oldPath, "offsetXaxis");
  SetRoadWeatherMessageCommon_ComputedLane_offsetXaxisParams(packetHandle, value.offsetXaxis, newPath);
  result = CheckLastError("RoadWeatherMessage", gkFuncRefGet, result);

  snprintf(newPath, elcount(newPath), "%s.%s", oldPath, "offsetYaxis");
  SetRoadWeatherMessageCommon_ComputedLane_offsetYaxisParams(packetHandle, value.offsetYaxis, newPath);
  result = CheckLastError("RoadWeatherMessage", gkFuncRefGet, result);

  snprintf(newPath, elcount(newPath), "%s.%s", oldPath, "rotateXY");
  if(value.rotateXY.isValidFlag==1)
  {
    C2xSetTokenInt(packetHandle, "RoadWeatherMessage", newPath, value.rotateXY.value);
    result = CheckLastError("RoadWeatherMessage", gkFuncRefGet, result);
  }
  else
  {
    if( C2xIsTokenAvailable(packetHandle, "RoadWeatherMessage", newPath) )
    {
      C2xRemoveToken(packetHandle, "RoadWeatherMessage", newPath);
    }
  }

  snprintf(newPath, elcount(newPath), "%s.%s", oldPath, "scaleXaxis");
  if(value.scaleXaxis.isValidFlag==1)
  {
    C2xSetTokenInt(packetHandle, "RoadWeatherMessage", newPath, value.scaleXaxis.value);
    result = CheckLastError("RoadWeatherMessage", gkFuncRefGet, result);
  }
  else
  {
    if( C2xIsTokenAvailable(packetHandle, "RoadWeatherMessage", newPath) )
    {
      C2xRemoveToken(packetHandle, "RoadWeatherMessage", newPath);
    }
  }

  snprintf(newPath, elcount(newPath), "%s.%s", oldPath, "scaleYaxis");
  if(value.scaleYaxis.isValidFlag==1)
  {
    C2xSetTokenInt(packetHandle, "RoadWeatherMessage", newPath, value.scaleYaxis.value);
    result = CheckLastError("RoadWeatherMessage", gkFuncRefGet, result);
  }
  else
  {
    if( C2xIsTokenAvailable(packetHandle, "RoadWeatherMessage", newPath) )
    {
      C2xRemoveToken(packetHandle, "RoadWeatherMessage", newPath);
    }
  }

  snprintf(newPath, elcount(newPath), "%s.%s", oldPath, "regional");
  if(value.regional.isValidFlag==1)
  {
    SetRoadWeatherMessageCommon_ComputedLane_regionalParams(packetHandle, value.regional, newPath);
    result = CheckLastError("RoadWeatherMessage", gkFuncRefGet, result);
  }
  else
  {
    if( C2xIsTokenAvailable(packetHandle, "RoadWeatherMessage", newPath) )
    {
      C2xRemoveToken(packetHandle, "RoadWeatherMessage", newPath);
    }
  }

  return result;
}

int GetRoadWeatherMessageCommon_NodeListXYParams(LONG packetHandle, struct RoadWeatherMessageCommon_NodeListXY value, char oldPath[])
{
  char newPath[300];
  int result;

  result = 0;

  value.choice = C2xGetTokenInt(packetHandle, "RoadWeatherMessage", oldPath);

  switch(value.choice)
  {
    case 0:
    {
      snprintf(newPath, elcount(newPath), "%s.%s", oldPath, "nodes");
      GetRoadWeatherMessageCommon_NodeSetXYParams(packetHandle, value.nodes, newPath);
      result = CheckLastError("RoadWeatherMessage", gkFuncRefGet, result);
    }
    break;
    case 1:
    {
      snprintf(newPath, elcount(newPath), "%s.%s", oldPath, "computed");
      GetRoadWeatherMessageCommon_ComputedLaneParams(packetHandle, value.computed, newPath);
      result = CheckLastError("RoadWeatherMessage", gkFuncRefGet, result);
    }
    break;
  }
  return result;
}

int SetRoadWeatherMessageCommon_NodeListXYParams(LONG packetHandle, struct RoadWeatherMessageCommon_NodeListXY value, char oldPath[])
{
  char newPath[300];
  int result;

  result = 0;

  switch(value.choice)
  {
    case 0:
    {
      snprintf(newPath, elcount(newPath), "%s.%s", oldPath, "nodes");
      SetRoadWeatherMessageCommon_NodeSetXYParams(packetHandle, value.nodes, newPath);
      result = CheckLastError("RoadWeatherMessage", gkFuncRefGet, result);
    }
    break;
    case 1:
    {
      snprintf(newPath, elcount(newPath), "%s.%s", oldPath, "computed");
      SetRoadWeatherMessageCommon_ComputedLaneParams(packetHandle, value.computed, newPath);
      result = CheckLastError("RoadWeatherMessage", gkFuncRefGet, result);
    }
    break;
  }
  return result;
}

int GetRoadWeatherMessageTravelerInformation_Node_LL_24BParams(LONG packetHandle, struct RoadWeatherMessageTravelerInformation_Node_LL_24B value, char oldPath[])
{
  char newPath[300];
  int result;

  result = 0;

  snprintf(newPath, elcount(newPath), "%s.%s", oldPath, "lon");
  value.lon = C2xGetTokenInt(packetHandle, "RoadWeatherMessage", newPath);
  result = CheckLastError("RoadWeatherMessage", gkFuncRefGet, result);

  snprintf(newPath, elcount(newPath), "%s.%s", oldPath, "lat");
  value.lat = C2xGetTokenInt(packetHandle, "RoadWeatherMessage", newPath);
  result = CheckLastError("RoadWeatherMessage", gkFuncRefGet, result);

  return result;
}

int SetRoadWeatherMessageTravelerInformation_Node_LL_24BParams(LONG packetHandle, struct RoadWeatherMessageTravelerInformation_Node_LL_24B value, char oldPath[])
{
  char newPath[300];
  int result;

  result = 0;

  snprintf(newPath, elcount(newPath), "%s.%s", oldPath, "lon");
  C2xSetTokenInt(packetHandle, "RoadWeatherMessage", newPath, value.lon);
  result = CheckLastError("RoadWeatherMessage", gkFuncRefGet, result);

  snprintf(newPath, elcount(newPath), "%s.%s", oldPath, "lat");
  C2xSetTokenInt(packetHandle, "RoadWeatherMessage", newPath, value.lat);
  result = CheckLastError("RoadWeatherMessage", gkFuncRefGet, result);

  return result;
}

int GetRoadWeatherMessageTravelerInformation_Node_LL_28BParams(LONG packetHandle, struct RoadWeatherMessageTravelerInformation_Node_LL_28B value, char oldPath[])
{
  char newPath[300];
  int result;

  result = 0;

  snprintf(newPath, elcount(newPath), "%s.%s", oldPath, "lon");
  value.lon = C2xGetTokenInt(packetHandle, "RoadWeatherMessage", newPath);
  result = CheckLastError("RoadWeatherMessage", gkFuncRefGet, result);

  snprintf(newPath, elcount(newPath), "%s.%s", oldPath, "lat");
  value.lat = C2xGetTokenInt(packetHandle, "RoadWeatherMessage", newPath);
  result = CheckLastError("RoadWeatherMessage", gkFuncRefGet, result);

  return result;
}

int SetRoadWeatherMessageTravelerInformation_Node_LL_28BParams(LONG packetHandle, struct RoadWeatherMessageTravelerInformation_Node_LL_28B value, char oldPath[])
{
  char newPath[300];
  int result;

  result = 0;

  snprintf(newPath, elcount(newPath), "%s.%s", oldPath, "lon");
  C2xSetTokenInt(packetHandle, "RoadWeatherMessage", newPath, value.lon);
  result = CheckLastError("RoadWeatherMessage", gkFuncRefGet, result);

  snprintf(newPath, elcount(newPath), "%s.%s", oldPath, "lat");
  C2xSetTokenInt(packetHandle, "RoadWeatherMessage", newPath, value.lat);
  result = CheckLastError("RoadWeatherMessage", gkFuncRefGet, result);

  return result;
}

int GetRoadWeatherMessageTravelerInformation_Node_LL_32BParams(LONG packetHandle, struct RoadWeatherMessageTravelerInformation_Node_LL_32B value, char oldPath[])
{
  char newPath[300];
  int result;

  result = 0;

  snprintf(newPath, elcount(newPath), "%s.%s", oldPath, "lon");
  value.lon = C2xGetTokenInt(packetHandle, "RoadWeatherMessage", newPath);
  result = CheckLastError("RoadWeatherMessage", gkFuncRefGet, result);

  snprintf(newPath, elcount(newPath), "%s.%s", oldPath, "lat");
  value.lat = C2xGetTokenInt(packetHandle, "RoadWeatherMessage", newPath);
  result = CheckLastError("RoadWeatherMessage", gkFuncRefGet, result);

  return result;
}

int SetRoadWeatherMessageTravelerInformation_Node_LL_32BParams(LONG packetHandle, struct RoadWeatherMessageTravelerInformation_Node_LL_32B value, char oldPath[])
{
  char newPath[300];
  int result;

  result = 0;

  snprintf(newPath, elcount(newPath), "%s.%s", oldPath, "lon");
  C2xSetTokenInt(packetHandle, "RoadWeatherMessage", newPath, value.lon);
  result = CheckLastError("RoadWeatherMessage", gkFuncRefGet, result);

  snprintf(newPath, elcount(newPath), "%s.%s", oldPath, "lat");
  C2xSetTokenInt(packetHandle, "RoadWeatherMessage", newPath, value.lat);
  result = CheckLastError("RoadWeatherMessage", gkFuncRefGet, result);

  return result;
}

int GetRoadWeatherMessageTravelerInformation_Node_LL_36BParams(LONG packetHandle, struct RoadWeatherMessageTravelerInformation_Node_LL_36B value, char oldPath[])
{
  char newPath[300];
  int result;

  result = 0;

  snprintf(newPath, elcount(newPath), "%s.%s", oldPath, "lon");
  value.lon = C2xGetTokenInt(packetHandle, "RoadWeatherMessage", newPath);
  result = CheckLastError("RoadWeatherMessage", gkFuncRefGet, result);

  snprintf(newPath, elcount(newPath), "%s.%s", oldPath, "lat");
  value.lat = C2xGetTokenInt(packetHandle, "RoadWeatherMessage", newPath);
  result = CheckLastError("RoadWeatherMessage", gkFuncRefGet, result);

  return result;
}

int SetRoadWeatherMessageTravelerInformation_Node_LL_36BParams(LONG packetHandle, struct RoadWeatherMessageTravelerInformation_Node_LL_36B value, char oldPath[])
{
  char newPath[300];
  int result;

  result = 0;

  snprintf(newPath, elcount(newPath), "%s.%s", oldPath, "lon");
  C2xSetTokenInt(packetHandle, "RoadWeatherMessage", newPath, value.lon);
  result = CheckLastError("RoadWeatherMessage", gkFuncRefGet, result);

  snprintf(newPath, elcount(newPath), "%s.%s", oldPath, "lat");
  C2xSetTokenInt(packetHandle, "RoadWeatherMessage", newPath, value.lat);
  result = CheckLastError("RoadWeatherMessage", gkFuncRefGet, result);

  return result;
}

int GetRoadWeatherMessageTravelerInformation_Node_LL_44BParams(LONG packetHandle, struct RoadWeatherMessageTravelerInformation_Node_LL_44B value, char oldPath[])
{
  char newPath[300];
  int result;

  result = 0;

  snprintf(newPath, elcount(newPath), "%s.%s", oldPath, "lon");
  value.lon = C2xGetTokenInt(packetHandle, "RoadWeatherMessage", newPath);
  result = CheckLastError("RoadWeatherMessage", gkFuncRefGet, result);

  snprintf(newPath, elcount(newPath), "%s.%s", oldPath, "lat");
  value.lat = C2xGetTokenInt(packetHandle, "RoadWeatherMessage", newPath);
  result = CheckLastError("RoadWeatherMessage", gkFuncRefGet, result);

  return result;
}

int SetRoadWeatherMessageTravelerInformation_Node_LL_44BParams(LONG packetHandle, struct RoadWeatherMessageTravelerInformation_Node_LL_44B value, char oldPath[])
{
  char newPath[300];
  int result;

  result = 0;

  snprintf(newPath, elcount(newPath), "%s.%s", oldPath, "lon");
  C2xSetTokenInt(packetHandle, "RoadWeatherMessage", newPath, value.lon);
  result = CheckLastError("RoadWeatherMessage", gkFuncRefGet, result);

  snprintf(newPath, elcount(newPath), "%s.%s", oldPath, "lat");
  C2xSetTokenInt(packetHandle, "RoadWeatherMessage", newPath, value.lat);
  result = CheckLastError("RoadWeatherMessage", gkFuncRefGet, result);

  return result;
}

int GetRoadWeatherMessageTravelerInformation_Node_LL_48BParams(LONG packetHandle, struct RoadWeatherMessageTravelerInformation_Node_LL_48B value, char oldPath[])
{
  char newPath[300];
  int result;

  result = 0;

  snprintf(newPath, elcount(newPath), "%s.%s", oldPath, "lon");
  value.lon = C2xGetTokenInt(packetHandle, "RoadWeatherMessage", newPath);
  result = CheckLastError("RoadWeatherMessage", gkFuncRefGet, result);

  snprintf(newPath, elcount(newPath), "%s.%s", oldPath, "lat");
  value.lat = C2xGetTokenInt(packetHandle, "RoadWeatherMessage", newPath);
  result = CheckLastError("RoadWeatherMessage", gkFuncRefGet, result);

  return result;
}

int SetRoadWeatherMessageTravelerInformation_Node_LL_48BParams(LONG packetHandle, struct RoadWeatherMessageTravelerInformation_Node_LL_48B value, char oldPath[])
{
  char newPath[300];
  int result;

  result = 0;

  snprintf(newPath, elcount(newPath), "%s.%s", oldPath, "lon");
  C2xSetTokenInt(packetHandle, "RoadWeatherMessage", newPath, value.lon);
  result = CheckLastError("RoadWeatherMessage", gkFuncRefGet, result);

  snprintf(newPath, elcount(newPath), "%s.%s", oldPath, "lat");
  C2xSetTokenInt(packetHandle, "RoadWeatherMessage", newPath, value.lat);
  result = CheckLastError("RoadWeatherMessage", gkFuncRefGet, result);

  return result;
}

int GetRoadWeatherMessageCommon_RegionalExtension_Reg_NodeOffsetPointLLParams(LONG packetHandle, struct RoadWeatherMessageCommon_RegionalExtension_Reg_NodeOffsetPointLL value, char oldPath[])
{
  char newPath[300];
  int result;

  result = 0;

  snprintf(newPath, elcount(newPath), "%s.%s", oldPath, "regionId");
  value.regionId = C2xGetTokenInt(packetHandle, "RoadWeatherMessage", newPath);
  result = CheckLastError("RoadWeatherMessage", gkFuncRefGet, result);

  return result;
}

int SetRoadWeatherMessageCommon_RegionalExtension_Reg_NodeOffsetPointLLParams(LONG packetHandle, struct RoadWeatherMessageCommon_RegionalExtension_Reg_NodeOffsetPointLL value, char oldPath[])
{
  char newPath[300];
  int result;

  result = 0;


  return result;
}

int GetRoadWeatherMessageTravelerInformation_NodeOffsetPointLLParams(LONG packetHandle, struct RoadWeatherMessageTravelerInformation_NodeOffsetPointLL value, char oldPath[])
{
  char newPath[300];
  int result;

  result = 0;

  value.choice = C2xGetTokenInt(packetHandle, "RoadWeatherMessage", oldPath);

  switch(value.choice)
  {
    case 0:
    {
      snprintf(newPath, elcount(newPath), "%s.%s", oldPath, "node_LL1");
      GetRoadWeatherMessageTravelerInformation_Node_LL_24BParams(packetHandle, value.node_LL1, newPath);
      result = CheckLastError("RoadWeatherMessage", gkFuncRefGet, result);
    }
    break;
    case 1:
    {
      snprintf(newPath, elcount(newPath), "%s.%s", oldPath, "node_LL2");
      GetRoadWeatherMessageTravelerInformation_Node_LL_28BParams(packetHandle, value.node_LL2, newPath);
      result = CheckLastError("RoadWeatherMessage", gkFuncRefGet, result);
    }
    break;
    case 2:
    {
      snprintf(newPath, elcount(newPath), "%s.%s", oldPath, "node_LL3");
      GetRoadWeatherMessageTravelerInformation_Node_LL_32BParams(packetHandle, value.node_LL3, newPath);
      result = CheckLastError("RoadWeatherMessage", gkFuncRefGet, result);
    }
    break;
    case 3:
    {
      snprintf(newPath, elcount(newPath), "%s.%s", oldPath, "node_LL4");
      GetRoadWeatherMessageTravelerInformation_Node_LL_36BParams(packetHandle, value.node_LL4, newPath);
      result = CheckLastError("RoadWeatherMessage", gkFuncRefGet, result);
    }
    break;
    case 4:
    {
      snprintf(newPath, elcount(newPath), "%s.%s", oldPath, "node_LL5");
      GetRoadWeatherMessageTravelerInformation_Node_LL_44BParams(packetHandle, value.node_LL5, newPath);
      result = CheckLastError("RoadWeatherMessage", gkFuncRefGet, result);
    }
    break;
    case 5:
    {
      snprintf(newPath, elcount(newPath), "%s.%s", oldPath, "node_LL6");
      GetRoadWeatherMessageTravelerInformation_Node_LL_48BParams(packetHandle, value.node_LL6, newPath);
      result = CheckLastError("RoadWeatherMessage", gkFuncRefGet, result);
    }
    break;
    case 6:
    {
      snprintf(newPath, elcount(newPath), "%s.%s", oldPath, "node_LatLon");
      GetRoadWeatherMessageCommon_Node_LLmD_64bParams(packetHandle, value.node_LatLon, newPath);
      result = CheckLastError("RoadWeatherMessage", gkFuncRefGet, result);
    }
    break;
    case 7:
    {
      snprintf(newPath, elcount(newPath), "%s.%s", oldPath, "regional");
      GetRoadWeatherMessageCommon_RegionalExtension_Reg_NodeOffsetPointLLParams(packetHandle, value.regional, newPath);
      result = CheckLastError("RoadWeatherMessage", gkFuncRefGet, result);
    }
    break;
  }
  return result;
}

int SetRoadWeatherMessageTravelerInformation_NodeOffsetPointLLParams(LONG packetHandle, struct RoadWeatherMessageTravelerInformation_NodeOffsetPointLL value, char oldPath[])
{
  char newPath[300];
  int result;

  result = 0;

  switch(value.choice)
  {
    case 0:
    {
      snprintf(newPath, elcount(newPath), "%s.%s", oldPath, "node_LL1");
      SetRoadWeatherMessageTravelerInformation_Node_LL_24BParams(packetHandle, value.node_LL1, newPath);
      result = CheckLastError("RoadWeatherMessage", gkFuncRefGet, result);
    }
    break;
    case 1:
    {
      snprintf(newPath, elcount(newPath), "%s.%s", oldPath, "node_LL2");
      SetRoadWeatherMessageTravelerInformation_Node_LL_28BParams(packetHandle, value.node_LL2, newPath);
      result = CheckLastError("RoadWeatherMessage", gkFuncRefGet, result);
    }
    break;
    case 2:
    {
      snprintf(newPath, elcount(newPath), "%s.%s", oldPath, "node_LL3");
      SetRoadWeatherMessageTravelerInformation_Node_LL_32BParams(packetHandle, value.node_LL3, newPath);
      result = CheckLastError("RoadWeatherMessage", gkFuncRefGet, result);
    }
    break;
    case 3:
    {
      snprintf(newPath, elcount(newPath), "%s.%s", oldPath, "node_LL4");
      SetRoadWeatherMessageTravelerInformation_Node_LL_36BParams(packetHandle, value.node_LL4, newPath);
      result = CheckLastError("RoadWeatherMessage", gkFuncRefGet, result);
    }
    break;
    case 4:
    {
      snprintf(newPath, elcount(newPath), "%s.%s", oldPath, "node_LL5");
      SetRoadWeatherMessageTravelerInformation_Node_LL_44BParams(packetHandle, value.node_LL5, newPath);
      result = CheckLastError("RoadWeatherMessage", gkFuncRefGet, result);
    }
    break;
    case 5:
    {
      snprintf(newPath, elcount(newPath), "%s.%s", oldPath, "node_LL6");
      SetRoadWeatherMessageTravelerInformation_Node_LL_48BParams(packetHandle, value.node_LL6, newPath);
      result = CheckLastError("RoadWeatherMessage", gkFuncRefGet, result);
    }
    break;
    case 6:
    {
      snprintf(newPath, elcount(newPath), "%s.%s", oldPath, "node_LatLon");
      SetRoadWeatherMessageCommon_Node_LLmD_64bParams(packetHandle, value.node_LatLon, newPath);
      result = CheckLastError("RoadWeatherMessage", gkFuncRefGet, result);
    }
    break;
    case 7:
    {
      snprintf(newPath, elcount(newPath), "%s.%s", oldPath, "regional");
      SetRoadWeatherMessageCommon_RegionalExtension_Reg_NodeOffsetPointLLParams(packetHandle, value.regional, newPath);
      result = CheckLastError("RoadWeatherMessage", gkFuncRefGet, result);
    }
    break;
  }
  return result;
}

int GetRoadWeatherMessageTravelerInformation_NodeAttributeLLListParams(LONG packetHandle, struct RoadWeatherMessageTravelerInformation_NodeAttributeLLList value, char oldPath[])
{
  char newPath[300]; 
  int i;
  int result;

  result = 0;

  value.length = C2xGetTokenInt(packetHandle, "RoadWeatherMessage", oldPath);
  if((result = CheckLastError("RoadWeatherMessage", gkFuncRefGet, result))==0)
  {
    for(i=0; i<value.length; i++)
    {
      snprintf(newPath, elcount(newPath), "%s[%d]", oldPath, i);
      value.arrayValue[i] = C2xGetTokenInt64(packetHandle, "RoadWeatherMessage", newPath);
      result = CheckLastError("RoadWeatherMessage", gkFuncRefGet, result);
    }
  }
  return result;
}

int SetRoadWeatherMessageTravelerInformation_NodeAttributeLLListParams(LONG packetHandle, struct RoadWeatherMessageTravelerInformation_NodeAttributeLLList value, char oldPath[])
{
  char newPath[300]; 
  int i;
  int result;

  result = 0;

  C2xRemoveToken(packetHandle, "RoadWeatherMessage", oldPath);
  for(i=0; i<value.length; i++)
  {
    snprintf(newPath, elcount(newPath), "%s[%d]", oldPath, i);
    C2xSetTokenInt64(packetHandle, "RoadWeatherMessage", newPath, value.arrayValue[i]);
    result = CheckLastError("RoadWeatherMessage", gkFuncRefGet, result);
  }
  return result;
}

int GetRoadWeatherMessageTravelerInformation_SegmentAttributeLLListParams(LONG packetHandle, struct RoadWeatherMessageTravelerInformation_SegmentAttributeLLList value, char oldPath[])
{
  char newPath[300]; 
  int i;
  int result;

  result = 0;

  value.length = C2xGetTokenInt(packetHandle, "RoadWeatherMessage", oldPath);
  if((result = CheckLastError("RoadWeatherMessage", gkFuncRefGet, result))==0)
  {
    for(i=0; i<value.length; i++)
    {
      snprintf(newPath, elcount(newPath), "%s[%d]", oldPath, i);
      value.arrayValue[i] = C2xGetTokenInt64(packetHandle, "RoadWeatherMessage", newPath);
      result = CheckLastError("RoadWeatherMessage", gkFuncRefGet, result);
    }
  }
  return result;
}

int SetRoadWeatherMessageTravelerInformation_SegmentAttributeLLListParams(LONG packetHandle, struct RoadWeatherMessageTravelerInformation_SegmentAttributeLLList value, char oldPath[])
{
  char newPath[300]; 
  int i;
  int result;

  result = 0;

  C2xRemoveToken(packetHandle, "RoadWeatherMessage", oldPath);
  for(i=0; i<value.length; i++)
  {
    snprintf(newPath, elcount(newPath), "%s[%d]", oldPath, i);
    C2xSetTokenInt64(packetHandle, "RoadWeatherMessage", newPath, value.arrayValue[i]);
    result = CheckLastError("RoadWeatherMessage", gkFuncRefGet, result);
  }
  return result;
}

int GetRoadWeatherMessageCommon_RegionalExtension_Reg_NodeAttributeSetLLParams(LONG packetHandle, struct RoadWeatherMessageCommon_RegionalExtension_Reg_NodeAttributeSetLL value, char oldPath[])
{
  char newPath[300];
  int result;

  result = 0;

  snprintf(newPath, elcount(newPath), "%s.%s", oldPath, "regionId");
  value.regionId = C2xGetTokenInt(packetHandle, "RoadWeatherMessage", newPath);
  result = CheckLastError("RoadWeatherMessage", gkFuncRefGet, result);

  return result;
}

int SetRoadWeatherMessageCommon_RegionalExtension_Reg_NodeAttributeSetLLParams(LONG packetHandle, struct RoadWeatherMessageCommon_RegionalExtension_Reg_NodeAttributeSetLL value, char oldPath[])
{
  char newPath[300];
  int result;

  result = 0;


  return result;
}

int GetRoadWeatherMessageTravelerInformation_NodeAttributeSetLL_regionalParams(LONG packetHandle, struct RoadWeatherMessageTravelerInformation_NodeAttributeSetLL_regional value, char oldPath[])
{
  char newPath[300]; 
  int i;
  int result;

  result = 0;

  value.length = C2xGetTokenInt(packetHandle, "RoadWeatherMessage", oldPath);
  if((result = CheckLastError("RoadWeatherMessage", gkFuncRefGet, result))==0)
  {
    for(i=0; i<value.length; i++)
    {
      snprintf(newPath, elcount(newPath), "%s[%d]", oldPath, i);
      GetRoadWeatherMessageCommon_RegionalExtension_Reg_NodeAttributeSetLLParams(packetHandle, value.arrayValue[i], newPath);
      result = CheckLastError("RoadWeatherMessage", gkFuncRefGet, result);
    }
  }
  return result;
}

int SetRoadWeatherMessageTravelerInformation_NodeAttributeSetLL_regionalParams(LONG packetHandle, struct RoadWeatherMessageTravelerInformation_NodeAttributeSetLL_regional value, char oldPath[])
{
  char newPath[300]; 
  int i;
  int result;

  result = 0;

  C2xRemoveToken(packetHandle, "RoadWeatherMessage", oldPath);
  for(i=0; i<value.length; i++)
  {
    snprintf(newPath, elcount(newPath), "%s[%d]", oldPath, i);
    SetRoadWeatherMessageCommon_RegionalExtension_Reg_NodeAttributeSetLLParams(packetHandle, value.arrayValue[i], newPath);
    result = CheckLastError("RoadWeatherMessage", gkFuncRefGet, result);
  }
  return result;
}

int GetRoadWeatherMessageTravelerInformation_NodeAttributeSetLLParams(LONG packetHandle, struct RoadWeatherMessageTravelerInformation_NodeAttributeSetLL value, char oldPath[])
{
  char newPath[300];
  int result;

  result = 0;

  snprintf(newPath, elcount(newPath), "%s.%s", oldPath, "localNode");
  value.localNode.isValidFlag = C2xIsTokenAvailable(packetHandle, "RoadWeatherMessage", newPath);
  if(value.localNode.isValidFlag==1)
  {
    GetRoadWeatherMessageTravelerInformation_NodeAttributeLLListParams(packetHandle, value.localNode, newPath);
    result = CheckLastError("RoadWeatherMessage", gkFuncRefGet, result);
  }
  snprintf(newPath, elcount(newPath), "%s.%s", oldPath, "disabled");
  value.disabled.isValidFlag = C2xIsTokenAvailable(packetHandle, "RoadWeatherMessage", newPath);
  if(value.disabled.isValidFlag==1)
  {
    GetRoadWeatherMessageTravelerInformation_SegmentAttributeLLListParams(packetHandle, value.disabled, newPath);
    result = CheckLastError("RoadWeatherMessage", gkFuncRefGet, result);
  }
  snprintf(newPath, elcount(newPath), "%s.%s", oldPath, "enabled");
  value.enabled.isValidFlag = C2xIsTokenAvailable(packetHandle, "RoadWeatherMessage", newPath);
  if(value.enabled.isValidFlag==1)
  {
    GetRoadWeatherMessageTravelerInformation_SegmentAttributeLLListParams(packetHandle, value.enabled, newPath);
    result = CheckLastError("RoadWeatherMessage", gkFuncRefGet, result);
  }
  snprintf(newPath, elcount(newPath), "%s.%s", oldPath, "data");
  value.data.isValidFlag = C2xIsTokenAvailable(packetHandle, "RoadWeatherMessage", newPath);
  if(value.data.isValidFlag==1)
  {
    GetRoadWeatherMessageCommon_LaneDataAttributeListParams(packetHandle, value.data, newPath);
    result = CheckLastError("RoadWeatherMessage", gkFuncRefGet, result);
  }
  snprintf(newPath, elcount(newPath), "%s.%s", oldPath, "dWidth");
  value.dWidth.isValidFlag = C2xIsTokenAvailable(packetHandle, "RoadWeatherMessage", newPath);
  if(value.dWidth.isValidFlag==1)
  {
    value.dWidth.value = C2xGetTokenInt(packetHandle, "RoadWeatherMessage", newPath);
    result = CheckLastError("RoadWeatherMessage", gkFuncRefGet, result);
  }
  snprintf(newPath, elcount(newPath), "%s.%s", oldPath, "dElevation");
  value.dElevation.isValidFlag = C2xIsTokenAvailable(packetHandle, "RoadWeatherMessage", newPath);
  if(value.dElevation.isValidFlag==1)
  {
    value.dElevation.value = C2xGetTokenInt(packetHandle, "RoadWeatherMessage", newPath);
    result = CheckLastError("RoadWeatherMessage", gkFuncRefGet, result);
  }
  snprintf(newPath, elcount(newPath), "%s.%s", oldPath, "regional");
  value.regional.isValidFlag = C2xIsTokenAvailable(packetHandle, "RoadWeatherMessage", newPath);
  if(value.regional.isValidFlag==1)
  {
    GetRoadWeatherMessageTravelerInformation_NodeAttributeSetLL_regionalParams(packetHandle, value.regional, newPath);
    result = CheckLastError("RoadWeatherMessage", gkFuncRefGet, result);
  }
  return result;
}

int SetRoadWeatherMessageTravelerInformation_NodeAttributeSetLLParams(LONG packetHandle, struct RoadWeatherMessageTravelerInformation_NodeAttributeSetLL value, char oldPath[])
{
  char newPath[300];
  int result;

  result = 0;

  snprintf(newPath, elcount(newPath), "%s.%s", oldPath, "localNode");
  if(value.localNode.isValidFlag==1)
  {
    SetRoadWeatherMessageTravelerInformation_NodeAttributeLLListParams(packetHandle, value.localNode, newPath);
    result = CheckLastError("RoadWeatherMessage", gkFuncRefGet, result);
  }
  else
  {
    if( C2xIsTokenAvailable(packetHandle, "RoadWeatherMessage", newPath) )
    {
      C2xRemoveToken(packetHandle, "RoadWeatherMessage", newPath);
    }
  }

  snprintf(newPath, elcount(newPath), "%s.%s", oldPath, "disabled");
  if(value.disabled.isValidFlag==1)
  {
    SetRoadWeatherMessageTravelerInformation_SegmentAttributeLLListParams(packetHandle, value.disabled, newPath);
    result = CheckLastError("RoadWeatherMessage", gkFuncRefGet, result);
  }
  else
  {
    if( C2xIsTokenAvailable(packetHandle, "RoadWeatherMessage", newPath) )
    {
      C2xRemoveToken(packetHandle, "RoadWeatherMessage", newPath);
    }
  }

  snprintf(newPath, elcount(newPath), "%s.%s", oldPath, "enabled");
  if(value.enabled.isValidFlag==1)
  {
    SetRoadWeatherMessageTravelerInformation_SegmentAttributeLLListParams(packetHandle, value.enabled, newPath);
    result = CheckLastError("RoadWeatherMessage", gkFuncRefGet, result);
  }
  else
  {
    if( C2xIsTokenAvailable(packetHandle, "RoadWeatherMessage", newPath) )
    {
      C2xRemoveToken(packetHandle, "RoadWeatherMessage", newPath);
    }
  }

  snprintf(newPath, elcount(newPath), "%s.%s", oldPath, "data");
  if(value.data.isValidFlag==1)
  {
    SetRoadWeatherMessageCommon_LaneDataAttributeListParams(packetHandle, value.data, newPath);
    result = CheckLastError("RoadWeatherMessage", gkFuncRefGet, result);
  }
  else
  {
    if( C2xIsTokenAvailable(packetHandle, "RoadWeatherMessage", newPath) )
    {
      C2xRemoveToken(packetHandle, "RoadWeatherMessage", newPath);
    }
  }

  snprintf(newPath, elcount(newPath), "%s.%s", oldPath, "dWidth");
  if(value.dWidth.isValidFlag==1)
  {
    C2xSetTokenInt(packetHandle, "RoadWeatherMessage", newPath, value.dWidth.value);
    result = CheckLastError("RoadWeatherMessage", gkFuncRefGet, result);
  }
  else
  {
    if( C2xIsTokenAvailable(packetHandle, "RoadWeatherMessage", newPath) )
    {
      C2xRemoveToken(packetHandle, "RoadWeatherMessage", newPath);
    }
  }

  snprintf(newPath, elcount(newPath), "%s.%s", oldPath, "dElevation");
  if(value.dElevation.isValidFlag==1)
  {
    C2xSetTokenInt(packetHandle, "RoadWeatherMessage", newPath, value.dElevation.value);
    result = CheckLastError("RoadWeatherMessage", gkFuncRefGet, result);
  }
  else
  {
    if( C2xIsTokenAvailable(packetHandle, "RoadWeatherMessage", newPath) )
    {
      C2xRemoveToken(packetHandle, "RoadWeatherMessage", newPath);
    }
  }

  snprintf(newPath, elcount(newPath), "%s.%s", oldPath, "regional");
  if(value.regional.isValidFlag==1)
  {
    SetRoadWeatherMessageTravelerInformation_NodeAttributeSetLL_regionalParams(packetHandle, value.regional, newPath);
    result = CheckLastError("RoadWeatherMessage", gkFuncRefGet, result);
  }
  else
  {
    if( C2xIsTokenAvailable(packetHandle, "RoadWeatherMessage", newPath) )
    {
      C2xRemoveToken(packetHandle, "RoadWeatherMessage", newPath);
    }
  }

  return result;
}

int GetRoadWeatherMessageTravelerInformation_NodeLLParams(LONG packetHandle, struct RoadWeatherMessageTravelerInformation_NodeLL value, char oldPath[])
{
  char newPath[300];
  int result;

  result = 0;

  snprintf(newPath, elcount(newPath), "%s.%s", oldPath, "delta");
  GetRoadWeatherMessageTravelerInformation_NodeOffsetPointLLParams(packetHandle, value.delta, newPath);
  result = CheckLastError("RoadWeatherMessage", gkFuncRefGet, result);

  snprintf(newPath, elcount(newPath), "%s.%s", oldPath, "attributes");
  value.attributes.isValidFlag = C2xIsTokenAvailable(packetHandle, "RoadWeatherMessage", newPath);
  if(value.attributes.isValidFlag==1)
  {
    GetRoadWeatherMessageTravelerInformation_NodeAttributeSetLLParams(packetHandle, value.attributes, newPath);
    result = CheckLastError("RoadWeatherMessage", gkFuncRefGet, result);
  }
  return result;
}

int SetRoadWeatherMessageTravelerInformation_NodeLLParams(LONG packetHandle, struct RoadWeatherMessageTravelerInformation_NodeLL value, char oldPath[])
{
  char newPath[300];
  int result;

  result = 0;

  snprintf(newPath, elcount(newPath), "%s.%s", oldPath, "delta");
  SetRoadWeatherMessageTravelerInformation_NodeOffsetPointLLParams(packetHandle, value.delta, newPath);
  result = CheckLastError("RoadWeatherMessage", gkFuncRefGet, result);

  snprintf(newPath, elcount(newPath), "%s.%s", oldPath, "attributes");
  if(value.attributes.isValidFlag==1)
  {
    SetRoadWeatherMessageTravelerInformation_NodeAttributeSetLLParams(packetHandle, value.attributes, newPath);
    result = CheckLastError("RoadWeatherMessage", gkFuncRefGet, result);
  }
  else
  {
    if( C2xIsTokenAvailable(packetHandle, "RoadWeatherMessage", newPath) )
    {
      C2xRemoveToken(packetHandle, "RoadWeatherMessage", newPath);
    }
  }

  return result;
}

int GetRoadWeatherMessageTravelerInformation_NodeSetLLParams(LONG packetHandle, struct RoadWeatherMessageTravelerInformation_NodeSetLL value, char oldPath[])
{
  char newPath[300]; 
  int i;
  int result;

  result = 0;

  value.length = C2xGetTokenInt(packetHandle, "RoadWeatherMessage", oldPath);
  if((result = CheckLastError("RoadWeatherMessage", gkFuncRefGet, result))==0)
  {
    for(i=0; i<value.length; i++)
    {
      snprintf(newPath, elcount(newPath), "%s[%d]", oldPath, i);
      GetRoadWeatherMessageTravelerInformation_NodeLLParams(packetHandle, value.arrayValue[i], newPath);
      result = CheckLastError("RoadWeatherMessage", gkFuncRefGet, result);
    }
  }
  return result;
}

int SetRoadWeatherMessageTravelerInformation_NodeSetLLParams(LONG packetHandle, struct RoadWeatherMessageTravelerInformation_NodeSetLL value, char oldPath[])
{
  char newPath[300]; 
  int i;
  int result;

  result = 0;

  C2xRemoveToken(packetHandle, "RoadWeatherMessage", oldPath);
  for(i=0; i<value.length; i++)
  {
    snprintf(newPath, elcount(newPath), "%s[%d]", oldPath, i);
    SetRoadWeatherMessageTravelerInformation_NodeLLParams(packetHandle, value.arrayValue[i], newPath);
    result = CheckLastError("RoadWeatherMessage", gkFuncRefGet, result);
  }
  return result;
}

int GetRoadWeatherMessageTravelerInformation_NodeListLLParams(LONG packetHandle, struct RoadWeatherMessageTravelerInformation_NodeListLL value, char oldPath[])
{
  char newPath[300];
  int result;

  result = 0;

  value.choice = C2xGetTokenInt(packetHandle, "RoadWeatherMessage", oldPath);

  switch(value.choice)
  {
    case 0:
    {
      snprintf(newPath, elcount(newPath), "%s.%s", oldPath, "nodes");
      GetRoadWeatherMessageTravelerInformation_NodeSetLLParams(packetHandle, value.nodes, newPath);
      result = CheckLastError("RoadWeatherMessage", gkFuncRefGet, result);
    }
    break;
  }
  return result;
}

int SetRoadWeatherMessageTravelerInformation_NodeListLLParams(LONG packetHandle, struct RoadWeatherMessageTravelerInformation_NodeListLL value, char oldPath[])
{
  char newPath[300];
  int result;

  result = 0;

  switch(value.choice)
  {
    case 0:
    {
      snprintf(newPath, elcount(newPath), "%s.%s", oldPath, "nodes");
      SetRoadWeatherMessageTravelerInformation_NodeSetLLParams(packetHandle, value.nodes, newPath);
      result = CheckLastError("RoadWeatherMessage", gkFuncRefGet, result);
    }
    break;
  }
  return result;
}

int GetRoadWeatherMessageTravelerInformation_OffsetSystem_offsetParams(LONG packetHandle, struct RoadWeatherMessageTravelerInformation_OffsetSystem_offset value, char oldPath[])
{
  char newPath[300];
  int result;

  result = 0;

  value.choice = C2xGetTokenInt(packetHandle, "RoadWeatherMessage", oldPath);

  switch(value.choice)
  {
    case 0:
    {
      snprintf(newPath, elcount(newPath), "%s.%s", oldPath, "xy");
      GetRoadWeatherMessageCommon_NodeListXYParams(packetHandle, value.xy, newPath);
      result = CheckLastError("RoadWeatherMessage", gkFuncRefGet, result);
    }
    break;
    case 1:
    {
      snprintf(newPath, elcount(newPath), "%s.%s", oldPath, "ll");
      GetRoadWeatherMessageTravelerInformation_NodeListLLParams(packetHandle, value.ll, newPath);
      result = CheckLastError("RoadWeatherMessage", gkFuncRefGet, result);
    }
    break;
  }
  return result;
}

int SetRoadWeatherMessageTravelerInformation_OffsetSystem_offsetParams(LONG packetHandle, struct RoadWeatherMessageTravelerInformation_OffsetSystem_offset value, char oldPath[])
{
  char newPath[300];
  int result;

  result = 0;

  switch(value.choice)
  {
    case 0:
    {
      snprintf(newPath, elcount(newPath), "%s.%s", oldPath, "xy");
      SetRoadWeatherMessageCommon_NodeListXYParams(packetHandle, value.xy, newPath);
      result = CheckLastError("RoadWeatherMessage", gkFuncRefGet, result);
    }
    break;
    case 1:
    {
      snprintf(newPath, elcount(newPath), "%s.%s", oldPath, "ll");
      SetRoadWeatherMessageTravelerInformation_NodeListLLParams(packetHandle, value.ll, newPath);
      result = CheckLastError("RoadWeatherMessage", gkFuncRefGet, result);
    }
    break;
  }
  return result;
}

int GetRoadWeatherMessageTravelerInformation_OffsetSystemParams(LONG packetHandle, struct RoadWeatherMessageTravelerInformation_OffsetSystem value, char oldPath[])
{
  char newPath[300];
  int result;

  result = 0;

  snprintf(newPath, elcount(newPath), "%s.%s", oldPath, "scale");
  value.scale.isValidFlag = C2xIsTokenAvailable(packetHandle, "RoadWeatherMessage", newPath);
  if(value.scale.isValidFlag==1)
  {
    value.scale.value = C2xGetTokenInt(packetHandle, "RoadWeatherMessage", newPath);
    result = CheckLastError("RoadWeatherMessage", gkFuncRefGet, result);
  }
  snprintf(newPath, elcount(newPath), "%s.%s", oldPath, "offset");
  GetRoadWeatherMessageTravelerInformation_OffsetSystem_offsetParams(packetHandle, value.offset, newPath);
  result = CheckLastError("RoadWeatherMessage", gkFuncRefGet, result);

  return result;
}

int SetRoadWeatherMessageTravelerInformation_OffsetSystemParams(LONG packetHandle, struct RoadWeatherMessageTravelerInformation_OffsetSystem value, char oldPath[])
{
  char newPath[300];
  int result;

  result = 0;

  snprintf(newPath, elcount(newPath), "%s.%s", oldPath, "scale");
  if(value.scale.isValidFlag==1)
  {
    C2xSetTokenInt(packetHandle, "RoadWeatherMessage", newPath, value.scale.value);
    result = CheckLastError("RoadWeatherMessage", gkFuncRefGet, result);
  }
  else
  {
    if( C2xIsTokenAvailable(packetHandle, "RoadWeatherMessage", newPath) )
    {
      C2xRemoveToken(packetHandle, "RoadWeatherMessage", newPath);
    }
  }

  snprintf(newPath, elcount(newPath), "%s.%s", oldPath, "offset");
  SetRoadWeatherMessageTravelerInformation_OffsetSystem_offsetParams(packetHandle, value.offset, newPath);
  result = CheckLastError("RoadWeatherMessage", gkFuncRefGet, result);

  return result;
}

int GetRoadWeatherMessageTravelerInformation_CircleParams(LONG packetHandle, struct RoadWeatherMessageTravelerInformation_Circle value, char oldPath[])
{
  char newPath[300];
  int result;

  result = 0;

  snprintf(newPath, elcount(newPath), "%s.%s", oldPath, "center");
  GetRoadWeatherMessageCommon_Position3DParams(packetHandle, value.center, newPath);
  result = CheckLastError("RoadWeatherMessage", gkFuncRefGet, result);

  snprintf(newPath, elcount(newPath), "%s.%s", oldPath, "radius");
  value.radius = C2xGetTokenInt(packetHandle, "RoadWeatherMessage", newPath);
  result = CheckLastError("RoadWeatherMessage", gkFuncRefGet, result);

  snprintf(newPath, elcount(newPath), "%s.%s", oldPath, "units");
  value.units = C2xGetTokenInt(packetHandle, "RoadWeatherMessage", newPath);
  result = CheckLastError("RoadWeatherMessage", gkFuncRefGet, result);

  return result;
}

int SetRoadWeatherMessageTravelerInformation_CircleParams(LONG packetHandle, struct RoadWeatherMessageTravelerInformation_Circle value, char oldPath[])
{
  char newPath[300];
  int result;

  result = 0;

  snprintf(newPath, elcount(newPath), "%s.%s", oldPath, "center");
  SetRoadWeatherMessageCommon_Position3DParams(packetHandle, value.center, newPath);
  result = CheckLastError("RoadWeatherMessage", gkFuncRefGet, result);

  snprintf(newPath, elcount(newPath), "%s.%s", oldPath, "radius");
  C2xSetTokenInt(packetHandle, "RoadWeatherMessage", newPath, value.radius);
  result = CheckLastError("RoadWeatherMessage", gkFuncRefGet, result);

  snprintf(newPath, elcount(newPath), "%s.%s", oldPath, "units");
  C2xSetTokenInt(packetHandle, "RoadWeatherMessage", newPath, value.units);
  result = CheckLastError("RoadWeatherMessage", gkFuncRefGet, result);

  return result;
}

int GetRoadWeatherMessageCommon_RegionalExtension_Reg_GeometricProjectionParams(LONG packetHandle, struct RoadWeatherMessageCommon_RegionalExtension_Reg_GeometricProjection value, char oldPath[])
{
  char newPath[300];
  int result;

  result = 0;

  snprintf(newPath, elcount(newPath), "%s.%s", oldPath, "regionId");
  value.regionId = C2xGetTokenInt(packetHandle, "RoadWeatherMessage", newPath);
  result = CheckLastError("RoadWeatherMessage", gkFuncRefGet, result);

  return result;
}

int SetRoadWeatherMessageCommon_RegionalExtension_Reg_GeometricProjectionParams(LONG packetHandle, struct RoadWeatherMessageCommon_RegionalExtension_Reg_GeometricProjection value, char oldPath[])
{
  char newPath[300];
  int result;

  result = 0;


  return result;
}

int GetRoadWeatherMessageTravelerInformation_GeometricProjection_regionalParams(LONG packetHandle, struct RoadWeatherMessageTravelerInformation_GeometricProjection_regional value, char oldPath[])
{
  char newPath[300]; 
  int i;
  int result;

  result = 0;

  value.length = C2xGetTokenInt(packetHandle, "RoadWeatherMessage", oldPath);
  if((result = CheckLastError("RoadWeatherMessage", gkFuncRefGet, result))==0)
  {
    for(i=0; i<value.length; i++)
    {
      snprintf(newPath, elcount(newPath), "%s[%d]", oldPath, i);
      GetRoadWeatherMessageCommon_RegionalExtension_Reg_GeometricProjectionParams(packetHandle, value.arrayValue[i], newPath);
      result = CheckLastError("RoadWeatherMessage", gkFuncRefGet, result);
    }
  }
  return result;
}

int SetRoadWeatherMessageTravelerInformation_GeometricProjection_regionalParams(LONG packetHandle, struct RoadWeatherMessageTravelerInformation_GeometricProjection_regional value, char oldPath[])
{
  char newPath[300]; 
  int i;
  int result;

  result = 0;

  C2xRemoveToken(packetHandle, "RoadWeatherMessage", oldPath);
  for(i=0; i<value.length; i++)
  {
    snprintf(newPath, elcount(newPath), "%s[%d]", oldPath, i);
    SetRoadWeatherMessageCommon_RegionalExtension_Reg_GeometricProjectionParams(packetHandle, value.arrayValue[i], newPath);
    result = CheckLastError("RoadWeatherMessage", gkFuncRefGet, result);
  }
  return result;
}

int GetRoadWeatherMessageTravelerInformation_GeometricProjectionParams(LONG packetHandle, struct RoadWeatherMessageTravelerInformation_GeometricProjection value, char oldPath[])
{
  char newPath[300]; 
  int j; 
  int k;
  int result;

  result = 0;

  snprintf(newPath, elcount(newPath), "%s.%s", oldPath, "direction");
  value.direction.isValidFlag = 1;
  value.direction.stringLength = C2xGetTokenLengthBit(packetHandle, "RoadWeatherMessage", newPath);
  if ((result = CheckLastError("RoadWeatherMessage", gkFuncRefGet, result))==0)
  {
    if(value.direction.stringLength > 0)
    {
      for(j=0; j<value.direction.stringLength; j++)
      {
        if(C2xGetTokenBitOfBitString(packetHandle, "RoadWeatherMessage", newPath, j) == 0)
        {
          value.direction.string[j] = '0';
        }
        else if(C2xGetTokenBitOfBitString(packetHandle, "RoadWeatherMessage", newPath, j) == 1)
        {
          value.direction.string[j] = '1';
        }

        if(value.direction.stringLength == 1)
        {
          value.direction.string[1] = '0';
        }
        result = CheckLastError("RoadWeatherMessage", gkFuncRefGet, result);
      }
    }
    else
    {
      for(k = value.direction.stringLength+1; k > -1; k--)
      {
        if(value.direction.string[k] == '1')
        {
          value.direction.string[k] = '0';
        }
      }
    }
  }

  snprintf(newPath, elcount(newPath), "%s.%s", oldPath, "extent");
  value.extent.isValidFlag = C2xIsTokenAvailable(packetHandle, "RoadWeatherMessage", newPath);
  if(value.extent.isValidFlag==1)
  {
    value.extent.value = C2xGetTokenInt(packetHandle, "RoadWeatherMessage", newPath);
    result = CheckLastError("RoadWeatherMessage", gkFuncRefGet, result);
  }
  snprintf(newPath, elcount(newPath), "%s.%s", oldPath, "laneWidth");
  value.laneWidth.isValidFlag = C2xIsTokenAvailable(packetHandle, "RoadWeatherMessage", newPath);
  if(value.laneWidth.isValidFlag==1)
  {
    value.laneWidth.value = C2xGetTokenInt(packetHandle, "RoadWeatherMessage", newPath);
    result = CheckLastError("RoadWeatherMessage", gkFuncRefGet, result);
  }
  snprintf(newPath, elcount(newPath), "%s.%s", oldPath, "circle");
  GetRoadWeatherMessageTravelerInformation_CircleParams(packetHandle, value.circle, newPath);
  result = CheckLastError("RoadWeatherMessage", gkFuncRefGet, result);

  snprintf(newPath, elcount(newPath), "%s.%s", oldPath, "regional");
  value.regional.isValidFlag = C2xIsTokenAvailable(packetHandle, "RoadWeatherMessage", newPath);
  if(value.regional.isValidFlag==1)
  {
    GetRoadWeatherMessageTravelerInformation_GeometricProjection_regionalParams(packetHandle, value.regional, newPath);
    result = CheckLastError("RoadWeatherMessage", gkFuncRefGet, result);
  }
  return result;
}

int SetRoadWeatherMessageTravelerInformation_GeometricProjectionParams(LONG packetHandle, struct RoadWeatherMessageTravelerInformation_GeometricProjection value, char oldPath[])
{
  char newPath[300]; 
  int j;
  int result;

  result = 0;

  snprintf(newPath, elcount(newPath), "%s.%s", oldPath, "direction");
    for(j=0; j<value.direction.stringLength; j++)
    {
      if(value.direction.string[j] == '0')
      {
        C2xSetTokenBitOfBitString(packetHandle, "RoadWeatherMessage", newPath, j, 0);
      }
      else
      {
        C2xSetTokenBitOfBitString(packetHandle, "RoadWeatherMessage", newPath, j, 1);
      }
      result = CheckLastError("RoadWeatherMessage", gkFuncRefGet, result);
    }

  snprintf(newPath, elcount(newPath), "%s.%s", oldPath, "extent");
  if(value.extent.isValidFlag==1)
  {
    C2xSetTokenInt(packetHandle, "RoadWeatherMessage", newPath, value.extent.value);
    result = CheckLastError("RoadWeatherMessage", gkFuncRefGet, result);
  }
  else
  {
    if( C2xIsTokenAvailable(packetHandle, "RoadWeatherMessage", newPath) )
    {
      C2xRemoveToken(packetHandle, "RoadWeatherMessage", newPath);
    }
  }

  snprintf(newPath, elcount(newPath), "%s.%s", oldPath, "laneWidth");
  if(value.laneWidth.isValidFlag==1)
  {
    C2xSetTokenInt(packetHandle, "RoadWeatherMessage", newPath, value.laneWidth.value);
    result = CheckLastError("RoadWeatherMessage", gkFuncRefGet, result);
  }
  else
  {
    if( C2xIsTokenAvailable(packetHandle, "RoadWeatherMessage", newPath) )
    {
      C2xRemoveToken(packetHandle, "RoadWeatherMessage", newPath);
    }
  }

  snprintf(newPath, elcount(newPath), "%s.%s", oldPath, "circle");
  SetRoadWeatherMessageTravelerInformation_CircleParams(packetHandle, value.circle, newPath);
  result = CheckLastError("RoadWeatherMessage", gkFuncRefGet, result);

  snprintf(newPath, elcount(newPath), "%s.%s", oldPath, "regional");
  if(value.regional.isValidFlag==1)
  {
    SetRoadWeatherMessageTravelerInformation_GeometricProjection_regionalParams(packetHandle, value.regional, newPath);
    result = CheckLastError("RoadWeatherMessage", gkFuncRefGet, result);
  }
  else
  {
    if( C2xIsTokenAvailable(packetHandle, "RoadWeatherMessage", newPath) )
    {
      C2xRemoveToken(packetHandle, "RoadWeatherMessage", newPath);
    }
  }

  return result;
}

int GetRoadWeatherMessageTravelerInformation_ShapePointSetParams(LONG packetHandle, struct RoadWeatherMessageTravelerInformation_ShapePointSet value, char oldPath[])
{
  char newPath[300];
  int result;

  result = 0;

  snprintf(newPath, elcount(newPath), "%s.%s", oldPath, "anchor");
  value.anchor.isValidFlag = C2xIsTokenAvailable(packetHandle, "RoadWeatherMessage", newPath);
  if(value.anchor.isValidFlag==1)
  {
    GetRoadWeatherMessageCommon_Position3DParams(packetHandle, value.anchor, newPath);
    result = CheckLastError("RoadWeatherMessage", gkFuncRefGet, result);
  }
  snprintf(newPath, elcount(newPath), "%s.%s", oldPath, "laneWidth");
  value.laneWidth.isValidFlag = C2xIsTokenAvailable(packetHandle, "RoadWeatherMessage", newPath);
  if(value.laneWidth.isValidFlag==1)
  {
    value.laneWidth.value = C2xGetTokenInt(packetHandle, "RoadWeatherMessage", newPath);
    result = CheckLastError("RoadWeatherMessage", gkFuncRefGet, result);
  }
  snprintf(newPath, elcount(newPath), "%s.%s", oldPath, "directionality");
  value.directionality.isValidFlag = C2xIsTokenAvailable(packetHandle, "RoadWeatherMessage", newPath);
  if(value.directionality.isValidFlag==1)
  {
    value.directionality.value = C2xGetTokenInt(packetHandle, "RoadWeatherMessage", newPath);
    result = CheckLastError("RoadWeatherMessage", gkFuncRefGet, result);
  }
  snprintf(newPath, elcount(newPath), "%s.%s", oldPath, "nodeList");
  GetRoadWeatherMessageCommon_NodeListXYParams(packetHandle, value.nodeList, newPath);
  result = CheckLastError("RoadWeatherMessage", gkFuncRefGet, result);

  return result;
}

int SetRoadWeatherMessageTravelerInformation_ShapePointSetParams(LONG packetHandle, struct RoadWeatherMessageTravelerInformation_ShapePointSet value, char oldPath[])
{
  char newPath[300];
  int result;

  result = 0;

  snprintf(newPath, elcount(newPath), "%s.%s", oldPath, "anchor");
  if(value.anchor.isValidFlag==1)
  {
    SetRoadWeatherMessageCommon_Position3DParams(packetHandle, value.anchor, newPath);
    result = CheckLastError("RoadWeatherMessage", gkFuncRefGet, result);
  }
  else
  {
    if( C2xIsTokenAvailable(packetHandle, "RoadWeatherMessage", newPath) )
    {
      C2xRemoveToken(packetHandle, "RoadWeatherMessage", newPath);
    }
  }

  snprintf(newPath, elcount(newPath), "%s.%s", oldPath, "laneWidth");
  if(value.laneWidth.isValidFlag==1)
  {
    C2xSetTokenInt(packetHandle, "RoadWeatherMessage", newPath, value.laneWidth.value);
    result = CheckLastError("RoadWeatherMessage", gkFuncRefGet, result);
  }
  else
  {
    if( C2xIsTokenAvailable(packetHandle, "RoadWeatherMessage", newPath) )
    {
      C2xRemoveToken(packetHandle, "RoadWeatherMessage", newPath);
    }
  }

  snprintf(newPath, elcount(newPath), "%s.%s", oldPath, "directionality");
  if(value.directionality.isValidFlag==1)
  {
    C2xSetTokenInt(packetHandle, "RoadWeatherMessage", newPath, value.directionality.value);
    result = CheckLastError("RoadWeatherMessage", gkFuncRefGet, result);
  }
  else
  {
    if( C2xIsTokenAvailable(packetHandle, "RoadWeatherMessage", newPath) )
    {
      C2xRemoveToken(packetHandle, "RoadWeatherMessage", newPath);
    }
  }

  snprintf(newPath, elcount(newPath), "%s.%s", oldPath, "nodeList");
  SetRoadWeatherMessageCommon_NodeListXYParams(packetHandle, value.nodeList, newPath);
  result = CheckLastError("RoadWeatherMessage", gkFuncRefGet, result);

  return result;
}

int GetRoadWeatherMessageTravelerInformation_RegionOffsetsParams(LONG packetHandle, struct RoadWeatherMessageTravelerInformation_RegionOffsets value, char oldPath[])
{
  char newPath[300];
  int result;

  result = 0;

  snprintf(newPath, elcount(newPath), "%s.%s", oldPath, "xOffset");
  value.xOffset = C2xGetTokenInt(packetHandle, "RoadWeatherMessage", newPath);
  result = CheckLastError("RoadWeatherMessage", gkFuncRefGet, result);

  snprintf(newPath, elcount(newPath), "%s.%s", oldPath, "yOffset");
  value.yOffset = C2xGetTokenInt(packetHandle, "RoadWeatherMessage", newPath);
  result = CheckLastError("RoadWeatherMessage", gkFuncRefGet, result);

  snprintf(newPath, elcount(newPath), "%s.%s", oldPath, "zOffset");
  value.zOffset.isValidFlag = C2xIsTokenAvailable(packetHandle, "RoadWeatherMessage", newPath);
  if(value.zOffset.isValidFlag==1)
  {
    value.zOffset.value = C2xGetTokenInt(packetHandle, "RoadWeatherMessage", newPath);
    result = CheckLastError("RoadWeatherMessage", gkFuncRefGet, result);
  }
  return result;
}

int SetRoadWeatherMessageTravelerInformation_RegionOffsetsParams(LONG packetHandle, struct RoadWeatherMessageTravelerInformation_RegionOffsets value, char oldPath[])
{
  char newPath[300];
  int result;

  result = 0;

  snprintf(newPath, elcount(newPath), "%s.%s", oldPath, "xOffset");
  C2xSetTokenInt(packetHandle, "RoadWeatherMessage", newPath, value.xOffset);
  result = CheckLastError("RoadWeatherMessage", gkFuncRefGet, result);

  snprintf(newPath, elcount(newPath), "%s.%s", oldPath, "yOffset");
  C2xSetTokenInt(packetHandle, "RoadWeatherMessage", newPath, value.yOffset);
  result = CheckLastError("RoadWeatherMessage", gkFuncRefGet, result);

  snprintf(newPath, elcount(newPath), "%s.%s", oldPath, "zOffset");
  if(value.zOffset.isValidFlag==1)
  {
    C2xSetTokenInt(packetHandle, "RoadWeatherMessage", newPath, value.zOffset.value);
    result = CheckLastError("RoadWeatherMessage", gkFuncRefGet, result);
  }
  else
  {
    if( C2xIsTokenAvailable(packetHandle, "RoadWeatherMessage", newPath) )
    {
      C2xRemoveToken(packetHandle, "RoadWeatherMessage", newPath);
    }
  }

  return result;
}

int GetRoadWeatherMessageTravelerInformation_RegionListParams(LONG packetHandle, struct RoadWeatherMessageTravelerInformation_RegionList value, char oldPath[])
{
  char newPath[300]; 
  int i;
  int result;

  result = 0;

  value.length = C2xGetTokenInt(packetHandle, "RoadWeatherMessage", oldPath);
  if((result = CheckLastError("RoadWeatherMessage", gkFuncRefGet, result))==0)
  {
    for(i=0; i<value.length; i++)
    {
      snprintf(newPath, elcount(newPath), "%s[%d]", oldPath, i);
      GetRoadWeatherMessageTravelerInformation_RegionOffsetsParams(packetHandle, value.arrayValue[i], newPath);
      result = CheckLastError("RoadWeatherMessage", gkFuncRefGet, result);
    }
  }
  return result;
}

int SetRoadWeatherMessageTravelerInformation_RegionListParams(LONG packetHandle, struct RoadWeatherMessageTravelerInformation_RegionList value, char oldPath[])
{
  char newPath[300]; 
  int i;
  int result;

  result = 0;

  C2xRemoveToken(packetHandle, "RoadWeatherMessage", oldPath);
  for(i=0; i<value.length; i++)
  {
    snprintf(newPath, elcount(newPath), "%s[%d]", oldPath, i);
    SetRoadWeatherMessageTravelerInformation_RegionOffsetsParams(packetHandle, value.arrayValue[i], newPath);
    result = CheckLastError("RoadWeatherMessage", gkFuncRefGet, result);
  }
  return result;
}

int GetRoadWeatherMessageTravelerInformation_RegionPointSetParams(LONG packetHandle, struct RoadWeatherMessageTravelerInformation_RegionPointSet value, char oldPath[])
{
  char newPath[300];
  int result;

  result = 0;

  snprintf(newPath, elcount(newPath), "%s.%s", oldPath, "anchor");
  value.anchor.isValidFlag = C2xIsTokenAvailable(packetHandle, "RoadWeatherMessage", newPath);
  if(value.anchor.isValidFlag==1)
  {
    GetRoadWeatherMessageCommon_Position3DParams(packetHandle, value.anchor, newPath);
    result = CheckLastError("RoadWeatherMessage", gkFuncRefGet, result);
  }
  snprintf(newPath, elcount(newPath), "%s.%s", oldPath, "scale");
  value.scale.isValidFlag = C2xIsTokenAvailable(packetHandle, "RoadWeatherMessage", newPath);
  if(value.scale.isValidFlag==1)
  {
    value.scale.value = C2xGetTokenInt(packetHandle, "RoadWeatherMessage", newPath);
    result = CheckLastError("RoadWeatherMessage", gkFuncRefGet, result);
  }
  snprintf(newPath, elcount(newPath), "%s.%s", oldPath, "nodeList");
  GetRoadWeatherMessageTravelerInformation_RegionListParams(packetHandle, value.nodeList, newPath);
  result = CheckLastError("RoadWeatherMessage", gkFuncRefGet, result);

  return result;
}

int SetRoadWeatherMessageTravelerInformation_RegionPointSetParams(LONG packetHandle, struct RoadWeatherMessageTravelerInformation_RegionPointSet value, char oldPath[])
{
  char newPath[300];
  int result;

  result = 0;

  snprintf(newPath, elcount(newPath), "%s.%s", oldPath, "anchor");
  if(value.anchor.isValidFlag==1)
  {
    SetRoadWeatherMessageCommon_Position3DParams(packetHandle, value.anchor, newPath);
    result = CheckLastError("RoadWeatherMessage", gkFuncRefGet, result);
  }
  else
  {
    if( C2xIsTokenAvailable(packetHandle, "RoadWeatherMessage", newPath) )
    {
      C2xRemoveToken(packetHandle, "RoadWeatherMessage", newPath);
    }
  }

  snprintf(newPath, elcount(newPath), "%s.%s", oldPath, "scale");
  if(value.scale.isValidFlag==1)
  {
    C2xSetTokenInt(packetHandle, "RoadWeatherMessage", newPath, value.scale.value);
    result = CheckLastError("RoadWeatherMessage", gkFuncRefGet, result);
  }
  else
  {
    if( C2xIsTokenAvailable(packetHandle, "RoadWeatherMessage", newPath) )
    {
      C2xRemoveToken(packetHandle, "RoadWeatherMessage", newPath);
    }
  }

  snprintf(newPath, elcount(newPath), "%s.%s", oldPath, "nodeList");
  SetRoadWeatherMessageTravelerInformation_RegionListParams(packetHandle, value.nodeList, newPath);
  result = CheckLastError("RoadWeatherMessage", gkFuncRefGet, result);

  return result;
}

int GetRoadWeatherMessageTravelerInformation_ValidRegion_areaParams(LONG packetHandle, struct RoadWeatherMessageTravelerInformation_ValidRegion_area value, char oldPath[])
{
  char newPath[300];
  int result;

  result = 0;

  value.choice = C2xGetTokenInt(packetHandle, "RoadWeatherMessage", oldPath);

  switch(value.choice)
  {
    case 0:
    {
      snprintf(newPath, elcount(newPath), "%s.%s", oldPath, "shapePointSet");
      GetRoadWeatherMessageTravelerInformation_ShapePointSetParams(packetHandle, value.shapePointSet, newPath);
      result = CheckLastError("RoadWeatherMessage", gkFuncRefGet, result);
    }
    break;
    case 1:
    {
      snprintf(newPath, elcount(newPath), "%s.%s", oldPath, "circle");
      GetRoadWeatherMessageTravelerInformation_CircleParams(packetHandle, value.circle, newPath);
      result = CheckLastError("RoadWeatherMessage", gkFuncRefGet, result);
    }
    break;
    case 2:
    {
      snprintf(newPath, elcount(newPath), "%s.%s", oldPath, "regionPointSet");
      GetRoadWeatherMessageTravelerInformation_RegionPointSetParams(packetHandle, value.regionPointSet, newPath);
      result = CheckLastError("RoadWeatherMessage", gkFuncRefGet, result);
    }
    break;
  }
  return result;
}

int SetRoadWeatherMessageTravelerInformation_ValidRegion_areaParams(LONG packetHandle, struct RoadWeatherMessageTravelerInformation_ValidRegion_area value, char oldPath[])
{
  char newPath[300];
  int result;

  result = 0;

  switch(value.choice)
  {
    case 0:
    {
      snprintf(newPath, elcount(newPath), "%s.%s", oldPath, "shapePointSet");
      SetRoadWeatherMessageTravelerInformation_ShapePointSetParams(packetHandle, value.shapePointSet, newPath);
      result = CheckLastError("RoadWeatherMessage", gkFuncRefGet, result);
    }
    break;
    case 1:
    {
      snprintf(newPath, elcount(newPath), "%s.%s", oldPath, "circle");
      SetRoadWeatherMessageTravelerInformation_CircleParams(packetHandle, value.circle, newPath);
      result = CheckLastError("RoadWeatherMessage", gkFuncRefGet, result);
    }
    break;
    case 2:
    {
      snprintf(newPath, elcount(newPath), "%s.%s", oldPath, "regionPointSet");
      SetRoadWeatherMessageTravelerInformation_RegionPointSetParams(packetHandle, value.regionPointSet, newPath);
      result = CheckLastError("RoadWeatherMessage", gkFuncRefGet, result);
    }
    break;
  }
  return result;
}

int GetRoadWeatherMessageTravelerInformation_ValidRegionParams(LONG packetHandle, struct RoadWeatherMessageTravelerInformation_ValidRegion value, char oldPath[])
{
  char newPath[300]; 
  int j; 
  int k;
  int result;

  result = 0;

  snprintf(newPath, elcount(newPath), "%s.%s", oldPath, "direction");
  value.direction.isValidFlag = 1;
  value.direction.stringLength = C2xGetTokenLengthBit(packetHandle, "RoadWeatherMessage", newPath);
  if ((result = CheckLastError("RoadWeatherMessage", gkFuncRefGet, result))==0)
  {
    if(value.direction.stringLength > 0)
    {
      for(j=0; j<value.direction.stringLength; j++)
      {
        if(C2xGetTokenBitOfBitString(packetHandle, "RoadWeatherMessage", newPath, j) == 0)
        {
          value.direction.string[j] = '0';
        }
        else if(C2xGetTokenBitOfBitString(packetHandle, "RoadWeatherMessage", newPath, j) == 1)
        {
          value.direction.string[j] = '1';
        }

        if(value.direction.stringLength == 1)
        {
          value.direction.string[1] = '0';
        }
        result = CheckLastError("RoadWeatherMessage", gkFuncRefGet, result);
      }
    }
    else
    {
      for(k = value.direction.stringLength+1; k > -1; k--)
      {
        if(value.direction.string[k] == '1')
        {
          value.direction.string[k] = '0';
        }
      }
    }
  }

  snprintf(newPath, elcount(newPath), "%s.%s", oldPath, "extent");
  value.extent.isValidFlag = C2xIsTokenAvailable(packetHandle, "RoadWeatherMessage", newPath);
  if(value.extent.isValidFlag==1)
  {
    value.extent.value = C2xGetTokenInt(packetHandle, "RoadWeatherMessage", newPath);
    result = CheckLastError("RoadWeatherMessage", gkFuncRefGet, result);
  }
  snprintf(newPath, elcount(newPath), "%s.%s", oldPath, "area");
  GetRoadWeatherMessageTravelerInformation_ValidRegion_areaParams(packetHandle, value.area, newPath);
  result = CheckLastError("RoadWeatherMessage", gkFuncRefGet, result);

  return result;
}

int SetRoadWeatherMessageTravelerInformation_ValidRegionParams(LONG packetHandle, struct RoadWeatherMessageTravelerInformation_ValidRegion value, char oldPath[])
{
  char newPath[300]; 
  int j;
  int result;

  result = 0;

  snprintf(newPath, elcount(newPath), "%s.%s", oldPath, "direction");
    for(j=0; j<value.direction.stringLength; j++)
    {
      if(value.direction.string[j] == '0')
      {
        C2xSetTokenBitOfBitString(packetHandle, "RoadWeatherMessage", newPath, j, 0);
      }
      else
      {
        C2xSetTokenBitOfBitString(packetHandle, "RoadWeatherMessage", newPath, j, 1);
      }
      result = CheckLastError("RoadWeatherMessage", gkFuncRefGet, result);
    }

  snprintf(newPath, elcount(newPath), "%s.%s", oldPath, "extent");
  if(value.extent.isValidFlag==1)
  {
    C2xSetTokenInt(packetHandle, "RoadWeatherMessage", newPath, value.extent.value);
    result = CheckLastError("RoadWeatherMessage", gkFuncRefGet, result);
  }
  else
  {
    if( C2xIsTokenAvailable(packetHandle, "RoadWeatherMessage", newPath) )
    {
      C2xRemoveToken(packetHandle, "RoadWeatherMessage", newPath);
    }
  }

  snprintf(newPath, elcount(newPath), "%s.%s", oldPath, "area");
  SetRoadWeatherMessageTravelerInformation_ValidRegion_areaParams(packetHandle, value.area, newPath);
  result = CheckLastError("RoadWeatherMessage", gkFuncRefGet, result);

  return result;
}

int GetRoadWeatherMessageTravelerInformation_GeographicalPath_descriptionParams(LONG packetHandle, struct RoadWeatherMessageTravelerInformation_GeographicalPath_description value, char oldPath[])
{
  char newPath[300];
  int result;

  result = 0;

  value.choice = C2xGetTokenInt(packetHandle, "RoadWeatherMessage", oldPath);

  switch(value.choice)
  {
    case 0:
    {
      snprintf(newPath, elcount(newPath), "%s.%s", oldPath, "path");
      GetRoadWeatherMessageTravelerInformation_OffsetSystemParams(packetHandle, value.path, newPath);
      result = CheckLastError("RoadWeatherMessage", gkFuncRefGet, result);
    }
    break;
    case 1:
    {
      snprintf(newPath, elcount(newPath), "%s.%s", oldPath, "geometry");
      GetRoadWeatherMessageTravelerInformation_GeometricProjectionParams(packetHandle, value.geometry, newPath);
      result = CheckLastError("RoadWeatherMessage", gkFuncRefGet, result);
    }
    break;
    case 2:
    {
      snprintf(newPath, elcount(newPath), "%s.%s", oldPath, "oldRegion");
      GetRoadWeatherMessageTravelerInformation_ValidRegionParams(packetHandle, value.oldRegion, newPath);
      result = CheckLastError("RoadWeatherMessage", gkFuncRefGet, result);
    }
    break;
  }
  return result;
}

int SetRoadWeatherMessageTravelerInformation_GeographicalPath_descriptionParams(LONG packetHandle, struct RoadWeatherMessageTravelerInformation_GeographicalPath_description value, char oldPath[])
{
  char newPath[300];
  int result;

  result = 0;

  switch(value.choice)
  {
    case 0:
    {
      snprintf(newPath, elcount(newPath), "%s.%s", oldPath, "path");
      SetRoadWeatherMessageTravelerInformation_OffsetSystemParams(packetHandle, value.path, newPath);
      result = CheckLastError("RoadWeatherMessage", gkFuncRefGet, result);
    }
    break;
    case 1:
    {
      snprintf(newPath, elcount(newPath), "%s.%s", oldPath, "geometry");
      SetRoadWeatherMessageTravelerInformation_GeometricProjectionParams(packetHandle, value.geometry, newPath);
      result = CheckLastError("RoadWeatherMessage", gkFuncRefGet, result);
    }
    break;
    case 2:
    {
      snprintf(newPath, elcount(newPath), "%s.%s", oldPath, "oldRegion");
      SetRoadWeatherMessageTravelerInformation_ValidRegionParams(packetHandle, value.oldRegion, newPath);
      result = CheckLastError("RoadWeatherMessage", gkFuncRefGet, result);
    }
    break;
  }
  return result;
}

int GetRoadWeatherMessageCommon_RegionalExtension_Reg_GeographicalPathParams(LONG packetHandle, struct RoadWeatherMessageCommon_RegionalExtension_Reg_GeographicalPath value, char oldPath[])
{
  char newPath[300];
  int result;

  result = 0;

  snprintf(newPath, elcount(newPath), "%s.%s", oldPath, "regionId");
  value.regionId = C2xGetTokenInt(packetHandle, "RoadWeatherMessage", newPath);
  result = CheckLastError("RoadWeatherMessage", gkFuncRefGet, result);

  return result;
}

int SetRoadWeatherMessageCommon_RegionalExtension_Reg_GeographicalPathParams(LONG packetHandle, struct RoadWeatherMessageCommon_RegionalExtension_Reg_GeographicalPath value, char oldPath[])
{
  char newPath[300];
  int result;

  result = 0;


  return result;
}

int GetRoadWeatherMessageTravelerInformation_GeographicalPath_regionalParams(LONG packetHandle, struct RoadWeatherMessageTravelerInformation_GeographicalPath_regional value, char oldPath[])
{
  char newPath[300]; 
  int i;
  int result;

  result = 0;

  value.length = C2xGetTokenInt(packetHandle, "RoadWeatherMessage", oldPath);
  if((result = CheckLastError("RoadWeatherMessage", gkFuncRefGet, result))==0)
  {
    for(i=0; i<value.length; i++)
    {
      snprintf(newPath, elcount(newPath), "%s[%d]", oldPath, i);
      GetRoadWeatherMessageCommon_RegionalExtension_Reg_GeographicalPathParams(packetHandle, value.arrayValue[i], newPath);
      result = CheckLastError("RoadWeatherMessage", gkFuncRefGet, result);
    }
  }
  return result;
}

int SetRoadWeatherMessageTravelerInformation_GeographicalPath_regionalParams(LONG packetHandle, struct RoadWeatherMessageTravelerInformation_GeographicalPath_regional value, char oldPath[])
{
  char newPath[300]; 
  int i;
  int result;

  result = 0;

  C2xRemoveToken(packetHandle, "RoadWeatherMessage", oldPath);
  for(i=0; i<value.length; i++)
  {
    snprintf(newPath, elcount(newPath), "%s[%d]", oldPath, i);
    SetRoadWeatherMessageCommon_RegionalExtension_Reg_GeographicalPathParams(packetHandle, value.arrayValue[i], newPath);
    result = CheckLastError("RoadWeatherMessage", gkFuncRefGet, result);
  }
  return result;
}

int GetRoadWeatherMessageTravelerInformation_GeographicalPathParams(LONG packetHandle, struct RoadWeatherMessageTravelerInformation_GeographicalPath value, char oldPath[])
{
  char newPath[300]; 
  int j; 
  int k;
  int result;

  result = 0;

  snprintf(newPath, elcount(newPath), "%s.%s", oldPath, "name");
  value.name.isValidFlag = C2xIsTokenAvailable(packetHandle, "RoadWeatherMessage", newPath);
  if(value.name.isValidFlag==1)
  {
    value.name.stringLength = C2xGetTokenData(packetHandle, "RoadWeatherMessage", newPath, elcount(value.name.string), value.name.string);
    result = CheckLastError("RoadWeatherMessage", gkFuncRefGet, result);
  }
  snprintf(newPath, elcount(newPath), "%s.%s", oldPath, "id");
  value.id.isValidFlag = C2xIsTokenAvailable(packetHandle, "RoadWeatherMessage", newPath);
  if(value.id.isValidFlag==1)
  {
    GetRoadWeatherMessageCommon_RoadSegmentReferenceIDParams(packetHandle, value.id, newPath);
    result = CheckLastError("RoadWeatherMessage", gkFuncRefGet, result);
  }
  snprintf(newPath, elcount(newPath), "%s.%s", oldPath, "anchor");
  value.anchor.isValidFlag = C2xIsTokenAvailable(packetHandle, "RoadWeatherMessage", newPath);
  if(value.anchor.isValidFlag==1)
  {
    GetRoadWeatherMessageCommon_Position3DParams(packetHandle, value.anchor, newPath);
    result = CheckLastError("RoadWeatherMessage", gkFuncRefGet, result);
  }
  snprintf(newPath, elcount(newPath), "%s.%s", oldPath, "laneWidth");
  value.laneWidth.isValidFlag = C2xIsTokenAvailable(packetHandle, "RoadWeatherMessage", newPath);
  if(value.laneWidth.isValidFlag==1)
  {
    value.laneWidth.value = C2xGetTokenInt(packetHandle, "RoadWeatherMessage", newPath);
    result = CheckLastError("RoadWeatherMessage", gkFuncRefGet, result);
  }
  snprintf(newPath, elcount(newPath), "%s.%s", oldPath, "directionality");
  value.directionality.isValidFlag = C2xIsTokenAvailable(packetHandle, "RoadWeatherMessage", newPath);
  if(value.directionality.isValidFlag==1)
  {
    value.directionality.value = C2xGetTokenInt(packetHandle, "RoadWeatherMessage", newPath);
    result = CheckLastError("RoadWeatherMessage", gkFuncRefGet, result);
  }
  snprintf(newPath, elcount(newPath), "%s.%s", oldPath, "closedPath");
  value.closedPath.isValidFlag = C2xIsTokenAvailable(packetHandle, "RoadWeatherMessage", newPath);
  if(value.closedPath.isValidFlag==1)
  {
    value.closedPath.value = C2xGetTokenInt64(packetHandle, "RoadWeatherMessage", newPath);
    result = CheckLastError("RoadWeatherMessage", gkFuncRefGet, result);
  }
  snprintf(newPath, elcount(newPath), "%s.%s", oldPath, "direction");
  value.direction.isValidFlag = C2xIsTokenAvailable(packetHandle, "RoadWeatherMessage", newPath);
  if(value.direction.isValidFlag==1)
  {
    value.direction.isValidFlag = 1;
    value.direction.stringLength = C2xGetTokenLengthBit(packetHandle, "RoadWeatherMessage", newPath);
    if ((result = CheckLastError("RoadWeatherMessage", gkFuncRefGet, result))==0)
    {
      if(value.direction.stringLength > 0)
      {
        for(j=0; j<value.direction.stringLength; j++)
        {
          if(C2xGetTokenBitOfBitString(packetHandle, "RoadWeatherMessage", newPath, j) == 0)
          {
            value.direction.string[j] = '0';
          }
          else if(C2xGetTokenBitOfBitString(packetHandle, "RoadWeatherMessage", newPath, j) == 1)
          {
            value.direction.string[j] = '1';
          }

          if(value.direction.stringLength == 1)
          {
            value.direction.string[1] = '0';
          }
          result = CheckLastError("RoadWeatherMessage", gkFuncRefGet, result);
        }
      }
      else
      {
        for(k = value.direction.stringLength+1; k > -1; k--)
        {
          if(value.direction.string[k] == '1')
          {
            value.direction.string[k] = '0';
          }
        }
      }
    }

  }
  snprintf(newPath, elcount(newPath), "%s.%s", oldPath, "description");
  value.description.isValidFlag = C2xIsTokenAvailable(packetHandle, "RoadWeatherMessage", newPath);
  if(value.description.isValidFlag==1)
  {
    GetRoadWeatherMessageTravelerInformation_GeographicalPath_descriptionParams(packetHandle, value.description, newPath);
    result = CheckLastError("RoadWeatherMessage", gkFuncRefGet, result);
  }
  snprintf(newPath, elcount(newPath), "%s.%s", oldPath, "regional");
  value.regional.isValidFlag = C2xIsTokenAvailable(packetHandle, "RoadWeatherMessage", newPath);
  if(value.regional.isValidFlag==1)
  {
    GetRoadWeatherMessageTravelerInformation_GeographicalPath_regionalParams(packetHandle, value.regional, newPath);
    result = CheckLastError("RoadWeatherMessage", gkFuncRefGet, result);
  }
  return result;
}

int SetRoadWeatherMessageTravelerInformation_GeographicalPathParams(LONG packetHandle, struct RoadWeatherMessageTravelerInformation_GeographicalPath value, char oldPath[])
{
  char newPath[300]; 
  int j;
  int result;

  result = 0;

  snprintf(newPath, elcount(newPath), "%s.%s", oldPath, "name");
  if(value.name.isValidFlag==1)
  {
    C2xSetTokenData(packetHandle, "RoadWeatherMessage", newPath, value.name.stringLength, value.name.string);
    result = CheckLastError("RoadWeatherMessage", gkFuncRefGet, result);
  }
  else
  {
    if( C2xIsTokenAvailable(packetHandle, "RoadWeatherMessage", newPath) )
    {
      C2xRemoveToken(packetHandle, "RoadWeatherMessage", newPath);
    }
  }

  snprintf(newPath, elcount(newPath), "%s.%s", oldPath, "id");
  if(value.id.isValidFlag==1)
  {
    SetRoadWeatherMessageCommon_RoadSegmentReferenceIDParams(packetHandle, value.id, newPath);
    result = CheckLastError("RoadWeatherMessage", gkFuncRefGet, result);
  }
  else
  {
    if( C2xIsTokenAvailable(packetHandle, "RoadWeatherMessage", newPath) )
    {
      C2xRemoveToken(packetHandle, "RoadWeatherMessage", newPath);
    }
  }

  snprintf(newPath, elcount(newPath), "%s.%s", oldPath, "anchor");
  if(value.anchor.isValidFlag==1)
  {
    SetRoadWeatherMessageCommon_Position3DParams(packetHandle, value.anchor, newPath);
    result = CheckLastError("RoadWeatherMessage", gkFuncRefGet, result);
  }
  else
  {
    if( C2xIsTokenAvailable(packetHandle, "RoadWeatherMessage", newPath) )
    {
      C2xRemoveToken(packetHandle, "RoadWeatherMessage", newPath);
    }
  }

  snprintf(newPath, elcount(newPath), "%s.%s", oldPath, "laneWidth");
  if(value.laneWidth.isValidFlag==1)
  {
    C2xSetTokenInt(packetHandle, "RoadWeatherMessage", newPath, value.laneWidth.value);
    result = CheckLastError("RoadWeatherMessage", gkFuncRefGet, result);
  }
  else
  {
    if( C2xIsTokenAvailable(packetHandle, "RoadWeatherMessage", newPath) )
    {
      C2xRemoveToken(packetHandle, "RoadWeatherMessage", newPath);
    }
  }

  snprintf(newPath, elcount(newPath), "%s.%s", oldPath, "directionality");
  if(value.directionality.isValidFlag==1)
  {
    C2xSetTokenInt(packetHandle, "RoadWeatherMessage", newPath, value.directionality.value);
    result = CheckLastError("RoadWeatherMessage", gkFuncRefGet, result);
  }
  else
  {
    if( C2xIsTokenAvailable(packetHandle, "RoadWeatherMessage", newPath) )
    {
      C2xRemoveToken(packetHandle, "RoadWeatherMessage", newPath);
    }
  }

  snprintf(newPath, elcount(newPath), "%s.%s", oldPath, "closedPath");
  if(value.closedPath.isValidFlag==1)
  {
    C2xSetTokenInt64(packetHandle, "RoadWeatherMessage", newPath, value.closedPath.value);
    result = CheckLastError("RoadWeatherMessage", gkFuncRefGet, result);
  }
  else
  {
    if( C2xIsTokenAvailable(packetHandle, "RoadWeatherMessage", newPath) )
    {
      C2xRemoveToken(packetHandle, "RoadWeatherMessage", newPath);
    }
  }

  snprintf(newPath, elcount(newPath), "%s.%s", oldPath, "direction");
  if(value.direction.isValidFlag==1)
  {
      for(j=0; j<value.direction.stringLength; j++)
      {
        if(value.direction.string[j] == '0')
        {
          C2xSetTokenBitOfBitString(packetHandle, "RoadWeatherMessage", newPath, j, 0);
        }
        else
        {
          C2xSetTokenBitOfBitString(packetHandle, "RoadWeatherMessage", newPath, j, 1);
        }
        result = CheckLastError("RoadWeatherMessage", gkFuncRefGet, result);
      }
  }
  else
  {
    if( C2xIsTokenAvailable(packetHandle, "RoadWeatherMessage", newPath) )
    {
      C2xRemoveToken(packetHandle, "RoadWeatherMessage", newPath);
    }
  }

  snprintf(newPath, elcount(newPath), "%s.%s", oldPath, "description");
  if(value.description.isValidFlag==1)
  {
    SetRoadWeatherMessageTravelerInformation_GeographicalPath_descriptionParams(packetHandle, value.description, newPath);
    result = CheckLastError("RoadWeatherMessage", gkFuncRefGet, result);
  }
  else
  {
    if( C2xIsTokenAvailable(packetHandle, "RoadWeatherMessage", newPath) )
    {
      C2xRemoveToken(packetHandle, "RoadWeatherMessage", newPath);
    }
  }

  snprintf(newPath, elcount(newPath), "%s.%s", oldPath, "regional");
  if(value.regional.isValidFlag==1)
  {
    SetRoadWeatherMessageTravelerInformation_GeographicalPath_regionalParams(packetHandle, value.regional, newPath);
    result = CheckLastError("RoadWeatherMessage", gkFuncRefGet, result);
  }
  else
  {
    if( C2xIsTokenAvailable(packetHandle, "RoadWeatherMessage", newPath) )
    {
      C2xRemoveToken(packetHandle, "RoadWeatherMessage", newPath);
    }
  }

  return result;
}

int GetRoadWeatherMessageTravelerInformation_TravelerDataFrame_regionsParams(LONG packetHandle, struct RoadWeatherMessageTravelerInformation_TravelerDataFrame_regions value, char oldPath[])
{
  char newPath[300]; 
  int i;
  int result;

  result = 0;

  value.length = C2xGetTokenInt(packetHandle, "RoadWeatherMessage", oldPath);
  if((result = CheckLastError("RoadWeatherMessage", gkFuncRefGet, result))==0)
  {
    for(i=0; i<value.length; i++)
    {
      snprintf(newPath, elcount(newPath), "%s[%d]", oldPath, i);
      GetRoadWeatherMessageTravelerInformation_GeographicalPathParams(packetHandle, value.arrayValue[i], newPath);
      result = CheckLastError("RoadWeatherMessage", gkFuncRefGet, result);
    }
  }
  return result;
}

int SetRoadWeatherMessageTravelerInformation_TravelerDataFrame_regionsParams(LONG packetHandle, struct RoadWeatherMessageTravelerInformation_TravelerDataFrame_regions value, char oldPath[])
{
  char newPath[300]; 
  int i;
  int result;

  result = 0;

  C2xRemoveToken(packetHandle, "RoadWeatherMessage", oldPath);
  for(i=0; i<value.length; i++)
  {
    snprintf(newPath, elcount(newPath), "%s[%d]", oldPath, i);
    SetRoadWeatherMessageTravelerInformation_GeographicalPathParams(packetHandle, value.arrayValue[i], newPath);
    result = CheckLastError("RoadWeatherMessage", gkFuncRefGet, result);
  }
  return result;
}

int GetRoadWeatherMessageITIS_ITIScodesAndText__itemParams(LONG packetHandle, struct RoadWeatherMessageITIS_ITIScodesAndText__item value, char oldPath[])
{
  char newPath[300];
  int result;

  result = 0;

  value.choice = C2xGetTokenInt(packetHandle, "RoadWeatherMessage", oldPath);

  switch(value.choice)
  {
    case 0:
    {
      snprintf(newPath, elcount(newPath), "%s.%s", oldPath, "itis");
      value.itis = C2xGetTokenInt(packetHandle, "RoadWeatherMessage", newPath);
      result = CheckLastError("RoadWeatherMessage", gkFuncRefGet, result);
    }
    break;
    case 1:
    {
      snprintf(newPath, elcount(newPath), "%s.%s", oldPath, "text");
      value.text.stringLength = C2xGetTokenData(packetHandle, "RoadWeatherMessage", newPath, elcount(value.text.string), value.text.string);
      result = CheckLastError("RoadWeatherMessage", gkFuncRefGet, result);
    }
    break;
  }
  return result;
}

int SetRoadWeatherMessageITIS_ITIScodesAndText__itemParams(LONG packetHandle, struct RoadWeatherMessageITIS_ITIScodesAndText__item value, char oldPath[])
{
  char newPath[300];
  int result;

  result = 0;

  switch(value.choice)
  {
    case 0:
    {
      snprintf(newPath, elcount(newPath), "%s.%s", oldPath, "itis");
      C2xSetTokenInt(packetHandle, "RoadWeatherMessage", newPath, value.itis);
      result = CheckLastError("RoadWeatherMessage", gkFuncRefGet, result);
    }
    break;
    case 1:
    {
      snprintf(newPath, elcount(newPath), "%s.%s", oldPath, "text");
      C2xSetTokenData(packetHandle, "RoadWeatherMessage", newPath, value.text.stringLength, value.text.string);
      result = CheckLastError("RoadWeatherMessage", gkFuncRefGet, result);
    }
    break;
  }
  return result;
}

int GetRoadWeatherMessageITIS_ITIScodesAndText_Params(LONG packetHandle, struct RoadWeatherMessageITIS_ITIScodesAndText_ value, char oldPath[])
{
  char newPath[300];
  int result;

  result = 0;

  snprintf(newPath, elcount(newPath), "%s.%s", oldPath, "item");
  GetRoadWeatherMessageITIS_ITIScodesAndText__itemParams(packetHandle, value.item, newPath);
  result = CheckLastError("RoadWeatherMessage", gkFuncRefGet, result);

  return result;
}

int SetRoadWeatherMessageITIS_ITIScodesAndText_Params(LONG packetHandle, struct RoadWeatherMessageITIS_ITIScodesAndText_ value, char oldPath[])
{
  char newPath[300];
  int result;

  result = 0;

  snprintf(newPath, elcount(newPath), "%s.%s", oldPath, "item");
  SetRoadWeatherMessageITIS_ITIScodesAndText__itemParams(packetHandle, value.item, newPath);
  result = CheckLastError("RoadWeatherMessage", gkFuncRefGet, result);

  return result;
}

int GetRoadWeatherMessageITIS_ITIScodesAndTextParams(LONG packetHandle, struct RoadWeatherMessageITIS_ITIScodesAndText value, char oldPath[])
{
  char newPath[300]; 
  int i;
  int result;

  result = 0;

  value.length = C2xGetTokenInt(packetHandle, "RoadWeatherMessage", oldPath);
  if((result = CheckLastError("RoadWeatherMessage", gkFuncRefGet, result))==0)
  {
    for(i=0; i<value.length; i++)
    {
      snprintf(newPath, elcount(newPath), "%s[%d]", oldPath, i);
      GetRoadWeatherMessageITIS_ITIScodesAndText_Params(packetHandle, value.arrayValue[i], newPath);
      result = CheckLastError("RoadWeatherMessage", gkFuncRefGet, result);
    }
  }
  return result;
}

int SetRoadWeatherMessageITIS_ITIScodesAndTextParams(LONG packetHandle, struct RoadWeatherMessageITIS_ITIScodesAndText value, char oldPath[])
{
  char newPath[300]; 
  int i;
  int result;

  result = 0;

  C2xRemoveToken(packetHandle, "RoadWeatherMessage", oldPath);
  for(i=0; i<value.length; i++)
  {
    snprintf(newPath, elcount(newPath), "%s[%d]", oldPath, i);
    SetRoadWeatherMessageITIS_ITIScodesAndText_Params(packetHandle, value.arrayValue[i], newPath);
    result = CheckLastError("RoadWeatherMessage", gkFuncRefGet, result);
  }
  return result;
}

int GetRoadWeatherMessageTravelerInformation_WorkZone__itemParams(LONG packetHandle, struct RoadWeatherMessageTravelerInformation_WorkZone__item value, char oldPath[])
{
  char newPath[300];
  int result;

  result = 0;

  value.choice = C2xGetTokenInt(packetHandle, "RoadWeatherMessage", oldPath);

  switch(value.choice)
  {
    case 0:
    {
      snprintf(newPath, elcount(newPath), "%s.%s", oldPath, "itis");
      value.itis = C2xGetTokenInt(packetHandle, "RoadWeatherMessage", newPath);
      result = CheckLastError("RoadWeatherMessage", gkFuncRefGet, result);
    }
    break;
    case 1:
    {
      snprintf(newPath, elcount(newPath), "%s.%s", oldPath, "text");
      value.text.stringLength = C2xGetTokenData(packetHandle, "RoadWeatherMessage", newPath, elcount(value.text.string), value.text.string);
      result = CheckLastError("RoadWeatherMessage", gkFuncRefGet, result);
    }
    break;
  }
  return result;
}

int SetRoadWeatherMessageTravelerInformation_WorkZone__itemParams(LONG packetHandle, struct RoadWeatherMessageTravelerInformation_WorkZone__item value, char oldPath[])
{
  char newPath[300];
  int result;

  result = 0;

  switch(value.choice)
  {
    case 0:
    {
      snprintf(newPath, elcount(newPath), "%s.%s", oldPath, "itis");
      C2xSetTokenInt(packetHandle, "RoadWeatherMessage", newPath, value.itis);
      result = CheckLastError("RoadWeatherMessage", gkFuncRefGet, result);
    }
    break;
    case 1:
    {
      snprintf(newPath, elcount(newPath), "%s.%s", oldPath, "text");
      C2xSetTokenData(packetHandle, "RoadWeatherMessage", newPath, value.text.stringLength, value.text.string);
      result = CheckLastError("RoadWeatherMessage", gkFuncRefGet, result);
    }
    break;
  }
  return result;
}

int GetRoadWeatherMessageTravelerInformation_WorkZone_Params(LONG packetHandle, struct RoadWeatherMessageTravelerInformation_WorkZone_ value, char oldPath[])
{
  char newPath[300];
  int result;

  result = 0;

  snprintf(newPath, elcount(newPath), "%s.%s", oldPath, "item");
  GetRoadWeatherMessageTravelerInformation_WorkZone__itemParams(packetHandle, value.item, newPath);
  result = CheckLastError("RoadWeatherMessage", gkFuncRefGet, result);

  return result;
}

int SetRoadWeatherMessageTravelerInformation_WorkZone_Params(LONG packetHandle, struct RoadWeatherMessageTravelerInformation_WorkZone_ value, char oldPath[])
{
  char newPath[300];
  int result;

  result = 0;

  snprintf(newPath, elcount(newPath), "%s.%s", oldPath, "item");
  SetRoadWeatherMessageTravelerInformation_WorkZone__itemParams(packetHandle, value.item, newPath);
  result = CheckLastError("RoadWeatherMessage", gkFuncRefGet, result);

  return result;
}

int GetRoadWeatherMessageTravelerInformation_WorkZoneParams(LONG packetHandle, struct RoadWeatherMessageTravelerInformation_WorkZone value, char oldPath[])
{
  char newPath[300]; 
  int i;
  int result;

  result = 0;

  value.length = C2xGetTokenInt(packetHandle, "RoadWeatherMessage", oldPath);
  if((result = CheckLastError("RoadWeatherMessage", gkFuncRefGet, result))==0)
  {
    for(i=0; i<value.length; i++)
    {
      snprintf(newPath, elcount(newPath), "%s[%d]", oldPath, i);
      GetRoadWeatherMessageTravelerInformation_WorkZone_Params(packetHandle, value.arrayValue[i], newPath);
      result = CheckLastError("RoadWeatherMessage", gkFuncRefGet, result);
    }
  }
  return result;
}

int SetRoadWeatherMessageTravelerInformation_WorkZoneParams(LONG packetHandle, struct RoadWeatherMessageTravelerInformation_WorkZone value, char oldPath[])
{
  char newPath[300]; 
  int i;
  int result;

  result = 0;

  C2xRemoveToken(packetHandle, "RoadWeatherMessage", oldPath);
  for(i=0; i<value.length; i++)
  {
    snprintf(newPath, elcount(newPath), "%s[%d]", oldPath, i);
    SetRoadWeatherMessageTravelerInformation_WorkZone_Params(packetHandle, value.arrayValue[i], newPath);
    result = CheckLastError("RoadWeatherMessage", gkFuncRefGet, result);
  }
  return result;
}

int GetRoadWeatherMessageTravelerInformation_GenericSignage__itemParams(LONG packetHandle, struct RoadWeatherMessageTravelerInformation_GenericSignage__item value, char oldPath[])
{
  char newPath[300];
  int result;

  result = 0;

  value.choice = C2xGetTokenInt(packetHandle, "RoadWeatherMessage", oldPath);

  switch(value.choice)
  {
    case 0:
    {
      snprintf(newPath, elcount(newPath), "%s.%s", oldPath, "itis");
      value.itis = C2xGetTokenInt(packetHandle, "RoadWeatherMessage", newPath);
      result = CheckLastError("RoadWeatherMessage", gkFuncRefGet, result);
    }
    break;
    case 1:
    {
      snprintf(newPath, elcount(newPath), "%s.%s", oldPath, "text");
      value.text.stringLength = C2xGetTokenData(packetHandle, "RoadWeatherMessage", newPath, elcount(value.text.string), value.text.string);
      result = CheckLastError("RoadWeatherMessage", gkFuncRefGet, result);
    }
    break;
  }
  return result;
}

int SetRoadWeatherMessageTravelerInformation_GenericSignage__itemParams(LONG packetHandle, struct RoadWeatherMessageTravelerInformation_GenericSignage__item value, char oldPath[])
{
  char newPath[300];
  int result;

  result = 0;

  switch(value.choice)
  {
    case 0:
    {
      snprintf(newPath, elcount(newPath), "%s.%s", oldPath, "itis");
      C2xSetTokenInt(packetHandle, "RoadWeatherMessage", newPath, value.itis);
      result = CheckLastError("RoadWeatherMessage", gkFuncRefGet, result);
    }
    break;
    case 1:
    {
      snprintf(newPath, elcount(newPath), "%s.%s", oldPath, "text");
      C2xSetTokenData(packetHandle, "RoadWeatherMessage", newPath, value.text.stringLength, value.text.string);
      result = CheckLastError("RoadWeatherMessage", gkFuncRefGet, result);
    }
    break;
  }
  return result;
}

int GetRoadWeatherMessageTravelerInformation_GenericSignage_Params(LONG packetHandle, struct RoadWeatherMessageTravelerInformation_GenericSignage_ value, char oldPath[])
{
  char newPath[300];
  int result;

  result = 0;

  snprintf(newPath, elcount(newPath), "%s.%s", oldPath, "item");
  GetRoadWeatherMessageTravelerInformation_GenericSignage__itemParams(packetHandle, value.item, newPath);
  result = CheckLastError("RoadWeatherMessage", gkFuncRefGet, result);

  return result;
}

int SetRoadWeatherMessageTravelerInformation_GenericSignage_Params(LONG packetHandle, struct RoadWeatherMessageTravelerInformation_GenericSignage_ value, char oldPath[])
{
  char newPath[300];
  int result;

  result = 0;

  snprintf(newPath, elcount(newPath), "%s.%s", oldPath, "item");
  SetRoadWeatherMessageTravelerInformation_GenericSignage__itemParams(packetHandle, value.item, newPath);
  result = CheckLastError("RoadWeatherMessage", gkFuncRefGet, result);

  return result;
}

int GetRoadWeatherMessageTravelerInformation_GenericSignageParams(LONG packetHandle, struct RoadWeatherMessageTravelerInformation_GenericSignage value, char oldPath[])
{
  char newPath[300]; 
  int i;
  int result;

  result = 0;

  value.length = C2xGetTokenInt(packetHandle, "RoadWeatherMessage", oldPath);
  if((result = CheckLastError("RoadWeatherMessage", gkFuncRefGet, result))==0)
  {
    for(i=0; i<value.length; i++)
    {
      snprintf(newPath, elcount(newPath), "%s[%d]", oldPath, i);
      GetRoadWeatherMessageTravelerInformation_GenericSignage_Params(packetHandle, value.arrayValue[i], newPath);
      result = CheckLastError("RoadWeatherMessage", gkFuncRefGet, result);
    }
  }
  return result;
}

int SetRoadWeatherMessageTravelerInformation_GenericSignageParams(LONG packetHandle, struct RoadWeatherMessageTravelerInformation_GenericSignage value, char oldPath[])
{
  char newPath[300]; 
  int i;
  int result;

  result = 0;

  C2xRemoveToken(packetHandle, "RoadWeatherMessage", oldPath);
  for(i=0; i<value.length; i++)
  {
    snprintf(newPath, elcount(newPath), "%s[%d]", oldPath, i);
    SetRoadWeatherMessageTravelerInformation_GenericSignage_Params(packetHandle, value.arrayValue[i], newPath);
    result = CheckLastError("RoadWeatherMessage", gkFuncRefGet, result);
  }
  return result;
}

int GetRoadWeatherMessageTravelerInformation_SpeedLimit__itemParams(LONG packetHandle, struct RoadWeatherMessageTravelerInformation_SpeedLimit__item value, char oldPath[])
{
  char newPath[300];
  int result;

  result = 0;

  value.choice = C2xGetTokenInt(packetHandle, "RoadWeatherMessage", oldPath);

  switch(value.choice)
  {
    case 0:
    {
      snprintf(newPath, elcount(newPath), "%s.%s", oldPath, "itis");
      value.itis = C2xGetTokenInt(packetHandle, "RoadWeatherMessage", newPath);
      result = CheckLastError("RoadWeatherMessage", gkFuncRefGet, result);
    }
    break;
    case 1:
    {
      snprintf(newPath, elcount(newPath), "%s.%s", oldPath, "text");
      value.text.stringLength = C2xGetTokenData(packetHandle, "RoadWeatherMessage", newPath, elcount(value.text.string), value.text.string);
      result = CheckLastError("RoadWeatherMessage", gkFuncRefGet, result);
    }
    break;
  }
  return result;
}

int SetRoadWeatherMessageTravelerInformation_SpeedLimit__itemParams(LONG packetHandle, struct RoadWeatherMessageTravelerInformation_SpeedLimit__item value, char oldPath[])
{
  char newPath[300];
  int result;

  result = 0;

  switch(value.choice)
  {
    case 0:
    {
      snprintf(newPath, elcount(newPath), "%s.%s", oldPath, "itis");
      C2xSetTokenInt(packetHandle, "RoadWeatherMessage", newPath, value.itis);
      result = CheckLastError("RoadWeatherMessage", gkFuncRefGet, result);
    }
    break;
    case 1:
    {
      snprintf(newPath, elcount(newPath), "%s.%s", oldPath, "text");
      C2xSetTokenData(packetHandle, "RoadWeatherMessage", newPath, value.text.stringLength, value.text.string);
      result = CheckLastError("RoadWeatherMessage", gkFuncRefGet, result);
    }
    break;
  }
  return result;
}

int GetRoadWeatherMessageTravelerInformation_SpeedLimit_Params(LONG packetHandle, struct RoadWeatherMessageTravelerInformation_SpeedLimit_ value, char oldPath[])
{
  char newPath[300];
  int result;

  result = 0;

  snprintf(newPath, elcount(newPath), "%s.%s", oldPath, "item");
  GetRoadWeatherMessageTravelerInformation_SpeedLimit__itemParams(packetHandle, value.item, newPath);
  result = CheckLastError("RoadWeatherMessage", gkFuncRefGet, result);

  return result;
}

int SetRoadWeatherMessageTravelerInformation_SpeedLimit_Params(LONG packetHandle, struct RoadWeatherMessageTravelerInformation_SpeedLimit_ value, char oldPath[])
{
  char newPath[300];
  int result;

  result = 0;

  snprintf(newPath, elcount(newPath), "%s.%s", oldPath, "item");
  SetRoadWeatherMessageTravelerInformation_SpeedLimit__itemParams(packetHandle, value.item, newPath);
  result = CheckLastError("RoadWeatherMessage", gkFuncRefGet, result);

  return result;
}

int GetRoadWeatherMessageTravelerInformation_SpeedLimitParams(LONG packetHandle, struct RoadWeatherMessageTravelerInformation_SpeedLimit value, char oldPath[])
{
  char newPath[300]; 
  int i;
  int result;

  result = 0;

  value.length = C2xGetTokenInt(packetHandle, "RoadWeatherMessage", oldPath);
  if((result = CheckLastError("RoadWeatherMessage", gkFuncRefGet, result))==0)
  {
    for(i=0; i<value.length; i++)
    {
      snprintf(newPath, elcount(newPath), "%s[%d]", oldPath, i);
      GetRoadWeatherMessageTravelerInformation_SpeedLimit_Params(packetHandle, value.arrayValue[i], newPath);
      result = CheckLastError("RoadWeatherMessage", gkFuncRefGet, result);
    }
  }
  return result;
}

int SetRoadWeatherMessageTravelerInformation_SpeedLimitParams(LONG packetHandle, struct RoadWeatherMessageTravelerInformation_SpeedLimit value, char oldPath[])
{
  char newPath[300]; 
  int i;
  int result;

  result = 0;

  C2xRemoveToken(packetHandle, "RoadWeatherMessage", oldPath);
  for(i=0; i<value.length; i++)
  {
    snprintf(newPath, elcount(newPath), "%s[%d]", oldPath, i);
    SetRoadWeatherMessageTravelerInformation_SpeedLimit_Params(packetHandle, value.arrayValue[i], newPath);
    result = CheckLastError("RoadWeatherMessage", gkFuncRefGet, result);
  }
  return result;
}

int GetRoadWeatherMessageTravelerInformation_ExitService__itemParams(LONG packetHandle, struct RoadWeatherMessageTravelerInformation_ExitService__item value, char oldPath[])
{
  char newPath[300];
  int result;

  result = 0;

  value.choice = C2xGetTokenInt(packetHandle, "RoadWeatherMessage", oldPath);

  switch(value.choice)
  {
    case 0:
    {
      snprintf(newPath, elcount(newPath), "%s.%s", oldPath, "itis");
      value.itis = C2xGetTokenInt(packetHandle, "RoadWeatherMessage", newPath);
      result = CheckLastError("RoadWeatherMessage", gkFuncRefGet, result);
    }
    break;
    case 1:
    {
      snprintf(newPath, elcount(newPath), "%s.%s", oldPath, "text");
      value.text.stringLength = C2xGetTokenData(packetHandle, "RoadWeatherMessage", newPath, elcount(value.text.string), value.text.string);
      result = CheckLastError("RoadWeatherMessage", gkFuncRefGet, result);
    }
    break;
  }
  return result;
}

int SetRoadWeatherMessageTravelerInformation_ExitService__itemParams(LONG packetHandle, struct RoadWeatherMessageTravelerInformation_ExitService__item value, char oldPath[])
{
  char newPath[300];
  int result;

  result = 0;

  switch(value.choice)
  {
    case 0:
    {
      snprintf(newPath, elcount(newPath), "%s.%s", oldPath, "itis");
      C2xSetTokenInt(packetHandle, "RoadWeatherMessage", newPath, value.itis);
      result = CheckLastError("RoadWeatherMessage", gkFuncRefGet, result);
    }
    break;
    case 1:
    {
      snprintf(newPath, elcount(newPath), "%s.%s", oldPath, "text");
      C2xSetTokenData(packetHandle, "RoadWeatherMessage", newPath, value.text.stringLength, value.text.string);
      result = CheckLastError("RoadWeatherMessage", gkFuncRefGet, result);
    }
    break;
  }
  return result;
}

int GetRoadWeatherMessageTravelerInformation_ExitService_Params(LONG packetHandle, struct RoadWeatherMessageTravelerInformation_ExitService_ value, char oldPath[])
{
  char newPath[300];
  int result;

  result = 0;

  snprintf(newPath, elcount(newPath), "%s.%s", oldPath, "item");
  GetRoadWeatherMessageTravelerInformation_ExitService__itemParams(packetHandle, value.item, newPath);
  result = CheckLastError("RoadWeatherMessage", gkFuncRefGet, result);

  return result;
}

int SetRoadWeatherMessageTravelerInformation_ExitService_Params(LONG packetHandle, struct RoadWeatherMessageTravelerInformation_ExitService_ value, char oldPath[])
{
  char newPath[300];
  int result;

  result = 0;

  snprintf(newPath, elcount(newPath), "%s.%s", oldPath, "item");
  SetRoadWeatherMessageTravelerInformation_ExitService__itemParams(packetHandle, value.item, newPath);
  result = CheckLastError("RoadWeatherMessage", gkFuncRefGet, result);

  return result;
}

int GetRoadWeatherMessageTravelerInformation_ExitServiceParams(LONG packetHandle, struct RoadWeatherMessageTravelerInformation_ExitService value, char oldPath[])
{
  char newPath[300]; 
  int i;
  int result;

  result = 0;

  value.length = C2xGetTokenInt(packetHandle, "RoadWeatherMessage", oldPath);
  if((result = CheckLastError("RoadWeatherMessage", gkFuncRefGet, result))==0)
  {
    for(i=0; i<value.length; i++)
    {
      snprintf(newPath, elcount(newPath), "%s[%d]", oldPath, i);
      GetRoadWeatherMessageTravelerInformation_ExitService_Params(packetHandle, value.arrayValue[i], newPath);
      result = CheckLastError("RoadWeatherMessage", gkFuncRefGet, result);
    }
  }
  return result;
}

int SetRoadWeatherMessageTravelerInformation_ExitServiceParams(LONG packetHandle, struct RoadWeatherMessageTravelerInformation_ExitService value, char oldPath[])
{
  char newPath[300]; 
  int i;
  int result;

  result = 0;

  C2xRemoveToken(packetHandle, "RoadWeatherMessage", oldPath);
  for(i=0; i<value.length; i++)
  {
    snprintf(newPath, elcount(newPath), "%s[%d]", oldPath, i);
    SetRoadWeatherMessageTravelerInformation_ExitService_Params(packetHandle, value.arrayValue[i], newPath);
    result = CheckLastError("RoadWeatherMessage", gkFuncRefGet, result);
  }
  return result;
}

int GetRoadWeatherMessageTravelerInformation_TravelerDataFrame_contentParams(LONG packetHandle, struct RoadWeatherMessageTravelerInformation_TravelerDataFrame_content value, char oldPath[])
{
  char newPath[300];
  int result;

  result = 0;

  value.choice = C2xGetTokenInt(packetHandle, "RoadWeatherMessage", oldPath);

  switch(value.choice)
  {
    case 0:
    {
      snprintf(newPath, elcount(newPath), "%s.%s", oldPath, "advisory");
      GetRoadWeatherMessageITIS_ITIScodesAndTextParams(packetHandle, value.advisory, newPath);
      result = CheckLastError("RoadWeatherMessage", gkFuncRefGet, result);
    }
    break;
    case 1:
    {
      snprintf(newPath, elcount(newPath), "%s.%s", oldPath, "workZone");
      GetRoadWeatherMessageTravelerInformation_WorkZoneParams(packetHandle, value.workZone, newPath);
      result = CheckLastError("RoadWeatherMessage", gkFuncRefGet, result);
    }
    break;
    case 2:
    {
      snprintf(newPath, elcount(newPath), "%s.%s", oldPath, "genericSign");
      GetRoadWeatherMessageTravelerInformation_GenericSignageParams(packetHandle, value.genericSign, newPath);
      result = CheckLastError("RoadWeatherMessage", gkFuncRefGet, result);
    }
    break;
    case 3:
    {
      snprintf(newPath, elcount(newPath), "%s.%s", oldPath, "speedLimit");
      GetRoadWeatherMessageTravelerInformation_SpeedLimitParams(packetHandle, value.speedLimit, newPath);
      result = CheckLastError("RoadWeatherMessage", gkFuncRefGet, result);
    }
    break;
    case 4:
    {
      snprintf(newPath, elcount(newPath), "%s.%s", oldPath, "exitService");
      GetRoadWeatherMessageTravelerInformation_ExitServiceParams(packetHandle, value.exitService, newPath);
      result = CheckLastError("RoadWeatherMessage", gkFuncRefGet, result);
    }
    break;
  }
  return result;
}

int SetRoadWeatherMessageTravelerInformation_TravelerDataFrame_contentParams(LONG packetHandle, struct RoadWeatherMessageTravelerInformation_TravelerDataFrame_content value, char oldPath[])
{
  char newPath[300];
  int result;

  result = 0;

  switch(value.choice)
  {
    case 0:
    {
      snprintf(newPath, elcount(newPath), "%s.%s", oldPath, "advisory");
      SetRoadWeatherMessageITIS_ITIScodesAndTextParams(packetHandle, value.advisory, newPath);
      result = CheckLastError("RoadWeatherMessage", gkFuncRefGet, result);
    }
    break;
    case 1:
    {
      snprintf(newPath, elcount(newPath), "%s.%s", oldPath, "workZone");
      SetRoadWeatherMessageTravelerInformation_WorkZoneParams(packetHandle, value.workZone, newPath);
      result = CheckLastError("RoadWeatherMessage", gkFuncRefGet, result);
    }
    break;
    case 2:
    {
      snprintf(newPath, elcount(newPath), "%s.%s", oldPath, "genericSign");
      SetRoadWeatherMessageTravelerInformation_GenericSignageParams(packetHandle, value.genericSign, newPath);
      result = CheckLastError("RoadWeatherMessage", gkFuncRefGet, result);
    }
    break;
    case 3:
    {
      snprintf(newPath, elcount(newPath), "%s.%s", oldPath, "speedLimit");
      SetRoadWeatherMessageTravelerInformation_SpeedLimitParams(packetHandle, value.speedLimit, newPath);
      result = CheckLastError("RoadWeatherMessage", gkFuncRefGet, result);
    }
    break;
    case 4:
    {
      snprintf(newPath, elcount(newPath), "%s.%s", oldPath, "exitService");
      SetRoadWeatherMessageTravelerInformation_ExitServiceParams(packetHandle, value.exitService, newPath);
      result = CheckLastError("RoadWeatherMessage", gkFuncRefGet, result);
    }
    break;
  }
  return result;
}

int GetRoadWeatherMessageCommon_PortlandCementParams(LONG packetHandle, struct RoadWeatherMessageCommon_PortlandCement value, char oldPath[])
{
  char newPath[300];
  int result;

  result = 0;

  snprintf(newPath, elcount(newPath), "%s.%s", oldPath, "type");
  value.type = C2xGetTokenInt(packetHandle, "RoadWeatherMessage", newPath);
  result = CheckLastError("RoadWeatherMessage", gkFuncRefGet, result);

  return result;
}

int SetRoadWeatherMessageCommon_PortlandCementParams(LONG packetHandle, struct RoadWeatherMessageCommon_PortlandCement value, char oldPath[])
{
  char newPath[300];
  int result;

  result = 0;

  snprintf(newPath, elcount(newPath), "%s.%s", oldPath, "type");
  C2xSetTokenInt(packetHandle, "RoadWeatherMessage", newPath, value.type);
  result = CheckLastError("RoadWeatherMessage", gkFuncRefGet, result);

  return result;
}

int GetRoadWeatherMessageCommon_AsphaltOrTarParams(LONG packetHandle, struct RoadWeatherMessageCommon_AsphaltOrTar value, char oldPath[])
{
  char newPath[300];
  int result;

  result = 0;

  snprintf(newPath, elcount(newPath), "%s.%s", oldPath, "type");
  value.type = C2xGetTokenInt(packetHandle, "RoadWeatherMessage", newPath);
  result = CheckLastError("RoadWeatherMessage", gkFuncRefGet, result);

  return result;
}

int SetRoadWeatherMessageCommon_AsphaltOrTarParams(LONG packetHandle, struct RoadWeatherMessageCommon_AsphaltOrTar value, char oldPath[])
{
  char newPath[300];
  int result;

  result = 0;

  snprintf(newPath, elcount(newPath), "%s.%s", oldPath, "type");
  C2xSetTokenInt(packetHandle, "RoadWeatherMessage", newPath, value.type);
  result = CheckLastError("RoadWeatherMessage", gkFuncRefGet, result);

  return result;
}

int GetRoadWeatherMessageCommon_GravelParams(LONG packetHandle, struct RoadWeatherMessageCommon_Gravel value, char oldPath[])
{
  char newPath[300];
  int result;

  result = 0;

  snprintf(newPath, elcount(newPath), "%s.%s", oldPath, "type");
  value.type = C2xGetTokenInt(packetHandle, "RoadWeatherMessage", newPath);
  result = CheckLastError("RoadWeatherMessage", gkFuncRefGet, result);

  return result;
}

int SetRoadWeatherMessageCommon_GravelParams(LONG packetHandle, struct RoadWeatherMessageCommon_Gravel value, char oldPath[])
{
  char newPath[300];
  int result;

  result = 0;

  snprintf(newPath, elcount(newPath), "%s.%s", oldPath, "type");
  C2xSetTokenInt(packetHandle, "RoadWeatherMessage", newPath, value.type);
  result = CheckLastError("RoadWeatherMessage", gkFuncRefGet, result);

  return result;
}

int GetRoadWeatherMessageCommon_GrassParams(LONG packetHandle, struct RoadWeatherMessageCommon_Grass value, char oldPath[])
{
  char newPath[300];
  int result;

  result = 0;

  snprintf(newPath, elcount(newPath), "%s.%s", oldPath, "type");
  value.type = C2xGetTokenInt(packetHandle, "RoadWeatherMessage", newPath);
  result = CheckLastError("RoadWeatherMessage", gkFuncRefGet, result);

  return result;
}

int SetRoadWeatherMessageCommon_GrassParams(LONG packetHandle, struct RoadWeatherMessageCommon_Grass value, char oldPath[])
{
  char newPath[300];
  int result;

  result = 0;

  snprintf(newPath, elcount(newPath), "%s.%s", oldPath, "type");
  C2xSetTokenInt(packetHandle, "RoadWeatherMessage", newPath, value.type);
  result = CheckLastError("RoadWeatherMessage", gkFuncRefGet, result);

  return result;
}

int GetRoadWeatherMessageCommon_CindersParams(LONG packetHandle, struct RoadWeatherMessageCommon_Cinders value, char oldPath[])
{
  char newPath[300];
  int result;

  result = 0;

  snprintf(newPath, elcount(newPath), "%s.%s", oldPath, "type");
  value.type = C2xGetTokenInt(packetHandle, "RoadWeatherMessage", newPath);
  result = CheckLastError("RoadWeatherMessage", gkFuncRefGet, result);

  return result;
}

int SetRoadWeatherMessageCommon_CindersParams(LONG packetHandle, struct RoadWeatherMessageCommon_Cinders value, char oldPath[])
{
  char newPath[300];
  int result;

  result = 0;

  snprintf(newPath, elcount(newPath), "%s.%s", oldPath, "type");
  C2xSetTokenInt(packetHandle, "RoadWeatherMessage", newPath, value.type);
  result = CheckLastError("RoadWeatherMessage", gkFuncRefGet, result);

  return result;
}

int GetRoadWeatherMessageCommon_RockParams(LONG packetHandle, struct RoadWeatherMessageCommon_Rock value, char oldPath[])
{
  char newPath[300];
  int result;

  result = 0;

  snprintf(newPath, elcount(newPath), "%s.%s", oldPath, "type");
  value.type = C2xGetTokenInt(packetHandle, "RoadWeatherMessage", newPath);
  result = CheckLastError("RoadWeatherMessage", gkFuncRefGet, result);

  return result;
}

int SetRoadWeatherMessageCommon_RockParams(LONG packetHandle, struct RoadWeatherMessageCommon_Rock value, char oldPath[])
{
  char newPath[300];
  int result;

  result = 0;

  snprintf(newPath, elcount(newPath), "%s.%s", oldPath, "type");
  C2xSetTokenInt(packetHandle, "RoadWeatherMessage", newPath, value.type);
  result = CheckLastError("RoadWeatherMessage", gkFuncRefGet, result);

  return result;
}

int GetRoadWeatherMessageCommon_IceParams(LONG packetHandle, struct RoadWeatherMessageCommon_Ice value, char oldPath[])
{
  char newPath[300];
  int result;

  result = 0;

  snprintf(newPath, elcount(newPath), "%s.%s", oldPath, "type");
  value.type = C2xGetTokenInt(packetHandle, "RoadWeatherMessage", newPath);
  result = CheckLastError("RoadWeatherMessage", gkFuncRefGet, result);

  return result;
}

int SetRoadWeatherMessageCommon_IceParams(LONG packetHandle, struct RoadWeatherMessageCommon_Ice value, char oldPath[])
{
  char newPath[300];
  int result;

  result = 0;

  snprintf(newPath, elcount(newPath), "%s.%s", oldPath, "type");
  C2xSetTokenInt(packetHandle, "RoadWeatherMessage", newPath, value.type);
  result = CheckLastError("RoadWeatherMessage", gkFuncRefGet, result);

  return result;
}

int GetRoadWeatherMessageCommon_SnowParams(LONG packetHandle, struct RoadWeatherMessageCommon_Snow value, char oldPath[])
{
  char newPath[300];
  int result;

  result = 0;

  snprintf(newPath, elcount(newPath), "%s.%s", oldPath, "type");
  value.type = C2xGetTokenInt(packetHandle, "RoadWeatherMessage", newPath);
  result = CheckLastError("RoadWeatherMessage", gkFuncRefGet, result);

  return result;
}

int SetRoadWeatherMessageCommon_SnowParams(LONG packetHandle, struct RoadWeatherMessageCommon_Snow value, char oldPath[])
{
  char newPath[300];
  int result;

  result = 0;

  snprintf(newPath, elcount(newPath), "%s.%s", oldPath, "type");
  C2xSetTokenInt(packetHandle, "RoadWeatherMessage", newPath, value.type);
  result = CheckLastError("RoadWeatherMessage", gkFuncRefGet, result);

  return result;
}

int GetRoadWeatherMessageCommon_DescriptionOfRoadSurfaceParams(LONG packetHandle, struct RoadWeatherMessageCommon_DescriptionOfRoadSurface value, char oldPath[])
{
  char newPath[300];
  int result;

  result = 0;

  value.choice = C2xGetTokenInt(packetHandle, "RoadWeatherMessage", oldPath);

  switch(value.choice)
  {
    case 0:
    {
      snprintf(newPath, elcount(newPath), "%s.%s", oldPath, "portlandCement");
      GetRoadWeatherMessageCommon_PortlandCementParams(packetHandle, value.portlandCement, newPath);
      result = CheckLastError("RoadWeatherMessage", gkFuncRefGet, result);
    }
    break;
    case 1:
    {
      snprintf(newPath, elcount(newPath), "%s.%s", oldPath, "asphaltOrTar");
      GetRoadWeatherMessageCommon_AsphaltOrTarParams(packetHandle, value.asphaltOrTar, newPath);
      result = CheckLastError("RoadWeatherMessage", gkFuncRefGet, result);
    }
    break;
    case 2:
    {
      snprintf(newPath, elcount(newPath), "%s.%s", oldPath, "gravel");
      GetRoadWeatherMessageCommon_GravelParams(packetHandle, value.gravel, newPath);
      result = CheckLastError("RoadWeatherMessage", gkFuncRefGet, result);
    }
    break;
    case 3:
    {
      snprintf(newPath, elcount(newPath), "%s.%s", oldPath, "grass");
      GetRoadWeatherMessageCommon_GrassParams(packetHandle, value.grass, newPath);
      result = CheckLastError("RoadWeatherMessage", gkFuncRefGet, result);
    }
    break;
    case 4:
    {
      snprintf(newPath, elcount(newPath), "%s.%s", oldPath, "cinders");
      GetRoadWeatherMessageCommon_CindersParams(packetHandle, value.cinders, newPath);
      result = CheckLastError("RoadWeatherMessage", gkFuncRefGet, result);
    }
    break;
    case 5:
    {
      snprintf(newPath, elcount(newPath), "%s.%s", oldPath, "rock");
      GetRoadWeatherMessageCommon_RockParams(packetHandle, value.rock, newPath);
      result = CheckLastError("RoadWeatherMessage", gkFuncRefGet, result);
    }
    break;
    case 6:
    {
      snprintf(newPath, elcount(newPath), "%s.%s", oldPath, "ice");
      GetRoadWeatherMessageCommon_IceParams(packetHandle, value.ice, newPath);
      result = CheckLastError("RoadWeatherMessage", gkFuncRefGet, result);
    }
    break;
    case 7:
    {
      snprintf(newPath, elcount(newPath), "%s.%s", oldPath, "snow");
      GetRoadWeatherMessageCommon_SnowParams(packetHandle, value.snow, newPath);
      result = CheckLastError("RoadWeatherMessage", gkFuncRefGet, result);
    }
    break;
  }
  return result;
}

int SetRoadWeatherMessageCommon_DescriptionOfRoadSurfaceParams(LONG packetHandle, struct RoadWeatherMessageCommon_DescriptionOfRoadSurface value, char oldPath[])
{
  char newPath[300];
  int result;

  result = 0;

  switch(value.choice)
  {
    case 0:
    {
      snprintf(newPath, elcount(newPath), "%s.%s", oldPath, "portlandCement");
      SetRoadWeatherMessageCommon_PortlandCementParams(packetHandle, value.portlandCement, newPath);
      result = CheckLastError("RoadWeatherMessage", gkFuncRefGet, result);
    }
    break;
    case 1:
    {
      snprintf(newPath, elcount(newPath), "%s.%s", oldPath, "asphaltOrTar");
      SetRoadWeatherMessageCommon_AsphaltOrTarParams(packetHandle, value.asphaltOrTar, newPath);
      result = CheckLastError("RoadWeatherMessage", gkFuncRefGet, result);
    }
    break;
    case 2:
    {
      snprintf(newPath, elcount(newPath), "%s.%s", oldPath, "gravel");
      SetRoadWeatherMessageCommon_GravelParams(packetHandle, value.gravel, newPath);
      result = CheckLastError("RoadWeatherMessage", gkFuncRefGet, result);
    }
    break;
    case 3:
    {
      snprintf(newPath, elcount(newPath), "%s.%s", oldPath, "grass");
      SetRoadWeatherMessageCommon_GrassParams(packetHandle, value.grass, newPath);
      result = CheckLastError("RoadWeatherMessage", gkFuncRefGet, result);
    }
    break;
    case 4:
    {
      snprintf(newPath, elcount(newPath), "%s.%s", oldPath, "cinders");
      SetRoadWeatherMessageCommon_CindersParams(packetHandle, value.cinders, newPath);
      result = CheckLastError("RoadWeatherMessage", gkFuncRefGet, result);
    }
    break;
    case 5:
    {
      snprintf(newPath, elcount(newPath), "%s.%s", oldPath, "rock");
      SetRoadWeatherMessageCommon_RockParams(packetHandle, value.rock, newPath);
      result = CheckLastError("RoadWeatherMessage", gkFuncRefGet, result);
    }
    break;
    case 6:
    {
      snprintf(newPath, elcount(newPath), "%s.%s", oldPath, "ice");
      SetRoadWeatherMessageCommon_IceParams(packetHandle, value.ice, newPath);
      result = CheckLastError("RoadWeatherMessage", gkFuncRefGet, result);
    }
    break;
    case 7:
    {
      snprintf(newPath, elcount(newPath), "%s.%s", oldPath, "snow");
      SetRoadWeatherMessageCommon_SnowParams(packetHandle, value.snow, newPath);
      result = CheckLastError("RoadWeatherMessage", gkFuncRefGet, result);
    }
    break;
  }
  return result;
}

int GetRoadWeatherMessageCommon_FrictionInformationParams(LONG packetHandle, struct RoadWeatherMessageCommon_FrictionInformation value, char oldPath[])
{
  char newPath[300];
  int result;

  result = 0;

  snprintf(newPath, elcount(newPath), "%s.%s", oldPath, "roadSurfaceDescription");
  GetRoadWeatherMessageCommon_DescriptionOfRoadSurfaceParams(packetHandle, value.roadSurfaceDescription, newPath);
  result = CheckLastError("RoadWeatherMessage", gkFuncRefGet, result);

  snprintf(newPath, elcount(newPath), "%s.%s", oldPath, "dryOrWet");
  value.dryOrWet.isValidFlag = C2xIsTokenAvailable(packetHandle, "RoadWeatherMessage", newPath);
  if(value.dryOrWet.isValidFlag==1)
  {
    value.dryOrWet.value = C2xGetTokenInt(packetHandle, "RoadWeatherMessage", newPath);
    result = CheckLastError("RoadWeatherMessage", gkFuncRefGet, result);
  }
  snprintf(newPath, elcount(newPath), "%s.%s", oldPath, "roadRoughness");
  value.roadRoughness.isValidFlag = C2xIsTokenAvailable(packetHandle, "RoadWeatherMessage", newPath);
  if(value.roadRoughness.isValidFlag==1)
  {
    GetRoadWeatherMessageCommon_RoadRoughnessParams(packetHandle, value.roadRoughness, newPath);
    result = CheckLastError("RoadWeatherMessage", gkFuncRefGet, result);
  }
  return result;
}

int SetRoadWeatherMessageCommon_FrictionInformationParams(LONG packetHandle, struct RoadWeatherMessageCommon_FrictionInformation value, char oldPath[])
{
  char newPath[300];
  int result;

  result = 0;

  snprintf(newPath, elcount(newPath), "%s.%s", oldPath, "roadSurfaceDescription");
  SetRoadWeatherMessageCommon_DescriptionOfRoadSurfaceParams(packetHandle, value.roadSurfaceDescription, newPath);
  result = CheckLastError("RoadWeatherMessage", gkFuncRefGet, result);

  snprintf(newPath, elcount(newPath), "%s.%s", oldPath, "dryOrWet");
  if(value.dryOrWet.isValidFlag==1)
  {
    C2xSetTokenInt(packetHandle, "RoadWeatherMessage", newPath, value.dryOrWet.value);
    result = CheckLastError("RoadWeatherMessage", gkFuncRefGet, result);
  }
  else
  {
    if( C2xIsTokenAvailable(packetHandle, "RoadWeatherMessage", newPath) )
    {
      C2xRemoveToken(packetHandle, "RoadWeatherMessage", newPath);
    }
  }

  snprintf(newPath, elcount(newPath), "%s.%s", oldPath, "roadRoughness");
  if(value.roadRoughness.isValidFlag==1)
  {
    SetRoadWeatherMessageCommon_RoadRoughnessParams(packetHandle, value.roadRoughness, newPath);
    result = CheckLastError("RoadWeatherMessage", gkFuncRefGet, result);
  }
  else
  {
    if( C2xIsTokenAvailable(packetHandle, "RoadWeatherMessage", newPath) )
    {
      C2xRemoveToken(packetHandle, "RoadWeatherMessage", newPath);
    }
  }

  return result;
}

int GetRoadWeatherMessageTravelerInformation_TravelerDataFrameNewPartIIIContentParams(LONG packetHandle, struct RoadWeatherMessageTravelerInformation_TravelerDataFrameNewPartIIIContent value, char oldPath[])
{
  char newPath[300];
  int result;

  result = 0;

  value.choice = C2xGetTokenInt(packetHandle, "RoadWeatherMessage", oldPath);

  switch(value.choice)
  {
    case 0:
    {
      snprintf(newPath, elcount(newPath), "%s.%s", oldPath, "frictionInfo");
      GetRoadWeatherMessageCommon_FrictionInformationParams(packetHandle, value.frictionInfo, newPath);
      result = CheckLastError("RoadWeatherMessage", gkFuncRefGet, result);
    }
    break;
  }
  return result;
}

int SetRoadWeatherMessageTravelerInformation_TravelerDataFrameNewPartIIIContentParams(LONG packetHandle, struct RoadWeatherMessageTravelerInformation_TravelerDataFrameNewPartIIIContent value, char oldPath[])
{
  char newPath[300];
  int result;

  result = 0;

  switch(value.choice)
  {
    case 0:
    {
      snprintf(newPath, elcount(newPath), "%s.%s", oldPath, "frictionInfo");
      SetRoadWeatherMessageCommon_FrictionInformationParams(packetHandle, value.frictionInfo, newPath);
      result = CheckLastError("RoadWeatherMessage", gkFuncRefGet, result);
    }
    break;
  }
  return result;
}

int GetRoadWeatherMessageTravelerInformation_TravelerDataFrameParams(LONG packetHandle, struct RoadWeatherMessageTravelerInformation_TravelerDataFrame value, char oldPath[])
{
  char newPath[300];
  int result;

  result = 0;

  snprintf(newPath, elcount(newPath), "%s.%s", oldPath, "doNotUse1");
  value.doNotUse1 = C2xGetTokenInt(packetHandle, "RoadWeatherMessage", newPath);
  result = CheckLastError("RoadWeatherMessage", gkFuncRefGet, result);

  snprintf(newPath, elcount(newPath), "%s.%s", oldPath, "frameType");
  value.frameType = C2xGetTokenInt(packetHandle, "RoadWeatherMessage", newPath);
  result = CheckLastError("RoadWeatherMessage", gkFuncRefGet, result);

  snprintf(newPath, elcount(newPath), "%s.%s", oldPath, "msgId");
  GetRoadWeatherMessageTravelerInformation_TravelerDataFrame_msgIdParams(packetHandle, value.msgId, newPath);
  result = CheckLastError("RoadWeatherMessage", gkFuncRefGet, result);

  snprintf(newPath, elcount(newPath), "%s.%s", oldPath, "startYear");
  value.startYear.isValidFlag = C2xIsTokenAvailable(packetHandle, "RoadWeatherMessage", newPath);
  if(value.startYear.isValidFlag==1)
  {
    value.startYear.value = C2xGetTokenInt(packetHandle, "RoadWeatherMessage", newPath);
    result = CheckLastError("RoadWeatherMessage", gkFuncRefGet, result);
  }
  snprintf(newPath, elcount(newPath), "%s.%s", oldPath, "startTime");
  value.startTime = C2xGetTokenInt(packetHandle, "RoadWeatherMessage", newPath);
  result = CheckLastError("RoadWeatherMessage", gkFuncRefGet, result);

  snprintf(newPath, elcount(newPath), "%s.%s", oldPath, "durationTime");
  value.durationTime = C2xGetTokenInt(packetHandle, "RoadWeatherMessage", newPath);
  result = CheckLastError("RoadWeatherMessage", gkFuncRefGet, result);

  snprintf(newPath, elcount(newPath), "%s.%s", oldPath, "priority");
  value.priority = C2xGetTokenInt(packetHandle, "RoadWeatherMessage", newPath);
  result = CheckLastError("RoadWeatherMessage", gkFuncRefGet, result);

  snprintf(newPath, elcount(newPath), "%s.%s", oldPath, "doNotUse2");
  value.doNotUse2 = C2xGetTokenInt(packetHandle, "RoadWeatherMessage", newPath);
  result = CheckLastError("RoadWeatherMessage", gkFuncRefGet, result);

  snprintf(newPath, elcount(newPath), "%s.%s", oldPath, "regions");
  GetRoadWeatherMessageTravelerInformation_TravelerDataFrame_regionsParams(packetHandle, value.regions, newPath);
  result = CheckLastError("RoadWeatherMessage", gkFuncRefGet, result);

  snprintf(newPath, elcount(newPath), "%s.%s", oldPath, "doNotUse3");
  value.doNotUse3 = C2xGetTokenInt(packetHandle, "RoadWeatherMessage", newPath);
  result = CheckLastError("RoadWeatherMessage", gkFuncRefGet, result);

  snprintf(newPath, elcount(newPath), "%s.%s", oldPath, "doNotUse4");
  value.doNotUse4 = C2xGetTokenInt(packetHandle, "RoadWeatherMessage", newPath);
  result = CheckLastError("RoadWeatherMessage", gkFuncRefGet, result);

  snprintf(newPath, elcount(newPath), "%s.%s", oldPath, "content");
  GetRoadWeatherMessageTravelerInformation_TravelerDataFrame_contentParams(packetHandle, value.content, newPath);
  result = CheckLastError("RoadWeatherMessage", gkFuncRefGet, result);

  snprintf(newPath, elcount(newPath), "%s.%s", oldPath, "url");
  value.url.isValidFlag = C2xIsTokenAvailable(packetHandle, "RoadWeatherMessage", newPath);
  if(value.url.isValidFlag==1)
  {
    value.url.stringLength = C2xGetTokenData(packetHandle, "RoadWeatherMessage", newPath, elcount(value.url.string), value.url.string);
    result = CheckLastError("RoadWeatherMessage", gkFuncRefGet, result);
  }
  snprintf(newPath, elcount(newPath), "%s.%s", oldPath, "contentNew");
  GetRoadWeatherMessageTravelerInformation_TravelerDataFrameNewPartIIIContentParams(packetHandle, value.contentNew, newPath);
  result = CheckLastError("RoadWeatherMessage", gkFuncRefGet, result);

  return result;
}

int SetRoadWeatherMessageTravelerInformation_TravelerDataFrameParams(LONG packetHandle, struct RoadWeatherMessageTravelerInformation_TravelerDataFrame value, char oldPath[])
{
  char newPath[300];
  int result;

  result = 0;

  snprintf(newPath, elcount(newPath), "%s.%s", oldPath, "doNotUse1");
  C2xSetTokenInt(packetHandle, "RoadWeatherMessage", newPath, value.doNotUse1);
  result = CheckLastError("RoadWeatherMessage", gkFuncRefGet, result);

  snprintf(newPath, elcount(newPath), "%s.%s", oldPath, "frameType");
  C2xSetTokenInt(packetHandle, "RoadWeatherMessage", newPath, value.frameType);
  result = CheckLastError("RoadWeatherMessage", gkFuncRefGet, result);

  snprintf(newPath, elcount(newPath), "%s.%s", oldPath, "msgId");
  SetRoadWeatherMessageTravelerInformation_TravelerDataFrame_msgIdParams(packetHandle, value.msgId, newPath);
  result = CheckLastError("RoadWeatherMessage", gkFuncRefGet, result);

  snprintf(newPath, elcount(newPath), "%s.%s", oldPath, "startYear");
  if(value.startYear.isValidFlag==1)
  {
    C2xSetTokenInt(packetHandle, "RoadWeatherMessage", newPath, value.startYear.value);
    result = CheckLastError("RoadWeatherMessage", gkFuncRefGet, result);
  }
  else
  {
    if( C2xIsTokenAvailable(packetHandle, "RoadWeatherMessage", newPath) )
    {
      C2xRemoveToken(packetHandle, "RoadWeatherMessage", newPath);
    }
  }

  snprintf(newPath, elcount(newPath), "%s.%s", oldPath, "startTime");
  C2xSetTokenInt(packetHandle, "RoadWeatherMessage", newPath, value.startTime);
  result = CheckLastError("RoadWeatherMessage", gkFuncRefGet, result);

  snprintf(newPath, elcount(newPath), "%s.%s", oldPath, "durationTime");
  C2xSetTokenInt(packetHandle, "RoadWeatherMessage", newPath, value.durationTime);
  result = CheckLastError("RoadWeatherMessage", gkFuncRefGet, result);

  snprintf(newPath, elcount(newPath), "%s.%s", oldPath, "priority");
  C2xSetTokenInt(packetHandle, "RoadWeatherMessage", newPath, value.priority);
  result = CheckLastError("RoadWeatherMessage", gkFuncRefGet, result);

  snprintf(newPath, elcount(newPath), "%s.%s", oldPath, "doNotUse2");
  C2xSetTokenInt(packetHandle, "RoadWeatherMessage", newPath, value.doNotUse2);
  result = CheckLastError("RoadWeatherMessage", gkFuncRefGet, result);

  snprintf(newPath, elcount(newPath), "%s.%s", oldPath, "regions");
  SetRoadWeatherMessageTravelerInformation_TravelerDataFrame_regionsParams(packetHandle, value.regions, newPath);
  result = CheckLastError("RoadWeatherMessage", gkFuncRefGet, result);

  snprintf(newPath, elcount(newPath), "%s.%s", oldPath, "doNotUse3");
  C2xSetTokenInt(packetHandle, "RoadWeatherMessage", newPath, value.doNotUse3);
  result = CheckLastError("RoadWeatherMessage", gkFuncRefGet, result);

  snprintf(newPath, elcount(newPath), "%s.%s", oldPath, "doNotUse4");
  C2xSetTokenInt(packetHandle, "RoadWeatherMessage", newPath, value.doNotUse4);
  result = CheckLastError("RoadWeatherMessage", gkFuncRefGet, result);

  snprintf(newPath, elcount(newPath), "%s.%s", oldPath, "content");
  SetRoadWeatherMessageTravelerInformation_TravelerDataFrame_contentParams(packetHandle, value.content, newPath);
  result = CheckLastError("RoadWeatherMessage", gkFuncRefGet, result);

  snprintf(newPath, elcount(newPath), "%s.%s", oldPath, "url");
  if(value.url.isValidFlag==1)
  {
    C2xSetTokenData(packetHandle, "RoadWeatherMessage", newPath, value.url.stringLength, value.url.string);
    result = CheckLastError("RoadWeatherMessage", gkFuncRefGet, result);
  }
  else
  {
    if( C2xIsTokenAvailable(packetHandle, "RoadWeatherMessage", newPath) )
    {
      C2xRemoveToken(packetHandle, "RoadWeatherMessage", newPath);
    }
  }

  snprintf(newPath, elcount(newPath), "%s.%s", oldPath, "contentNew");
  SetRoadWeatherMessageTravelerInformation_TravelerDataFrameNewPartIIIContentParams(packetHandle, value.contentNew, newPath);
  result = CheckLastError("RoadWeatherMessage", gkFuncRefGet, result);

  return result;
}

int GetRoadWeatherMessageTravelerInformation_TravelerDataFrameListParams(LONG packetHandle, struct RoadWeatherMessageTravelerInformation_TravelerDataFrameList value, char oldPath[])
{
  char newPath[300]; 
  int i;
  int result;

  result = 0;

  value.length = C2xGetTokenInt(packetHandle, "RoadWeatherMessage", oldPath);
  if((result = CheckLastError("RoadWeatherMessage", gkFuncRefGet, result))==0)
  {
    for(i=0; i<value.length; i++)
    {
      snprintf(newPath, elcount(newPath), "%s[%d]", oldPath, i);
      GetRoadWeatherMessageTravelerInformation_TravelerDataFrameParams(packetHandle, value.arrayValue[i], newPath);
      result = CheckLastError("RoadWeatherMessage", gkFuncRefGet, result);
    }
  }
  return result;
}

int SetRoadWeatherMessageTravelerInformation_TravelerDataFrameListParams(LONG packetHandle, struct RoadWeatherMessageTravelerInformation_TravelerDataFrameList value, char oldPath[])
{
  char newPath[300]; 
  int i;
  int result;

  result = 0;

  C2xRemoveToken(packetHandle, "RoadWeatherMessage", oldPath);
  for(i=0; i<value.length; i++)
  {
    snprintf(newPath, elcount(newPath), "%s[%d]", oldPath, i);
    SetRoadWeatherMessageTravelerInformation_TravelerDataFrameParams(packetHandle, value.arrayValue[i], newPath);
    result = CheckLastError("RoadWeatherMessage", gkFuncRefGet, result);
  }
  return result;
}

int GetRoadWeatherMessageRoadWeatherDownloadParams(LONG packetHandle, struct RoadWeatherMessageRoadWeatherDownload value, char oldPath[])
{
  char newPath[300];
  int result;

  result = 0;

  snprintf(newPath, elcount(newPath), "%s.%s", oldPath, "travelerData");
  GetRoadWeatherMessageTravelerInformation_TravelerDataFrameListParams(packetHandle, value.travelerData, newPath);
  result = CheckLastError("RoadWeatherMessage", gkFuncRefGet, result);

  snprintf(newPath, elcount(newPath), "%s.%s", oldPath, "wdmsFleetData");
  value.wdmsFleetData.isValidFlag = C2xIsTokenAvailable(packetHandle, "RoadWeatherMessage", newPath);
  if(value.wdmsFleetData.isValidFlag==1)
  {
    GetRoadWeatherMessageWDMSFleetDataParams(packetHandle, value.wdmsFleetData, newPath);
    result = CheckLastError("RoadWeatherMessage", gkFuncRefGet, result);
  }
  return result;
}

int SetRoadWeatherMessageRoadWeatherDownloadParams(LONG packetHandle, struct RoadWeatherMessageRoadWeatherDownload value, char oldPath[])
{
  char newPath[300];
  int result;

  result = 0;

  snprintf(newPath, elcount(newPath), "%s.%s", oldPath, "travelerData");
  SetRoadWeatherMessageTravelerInformation_TravelerDataFrameListParams(packetHandle, value.travelerData, newPath);
  result = CheckLastError("RoadWeatherMessage", gkFuncRefGet, result);

  snprintf(newPath, elcount(newPath), "%s.%s", oldPath, "wdmsFleetData");
  if(value.wdmsFleetData.isValidFlag==1)
  {
    SetRoadWeatherMessageWDMSFleetDataParams(packetHandle, value.wdmsFleetData, newPath);
    result = CheckLastError("RoadWeatherMessage", gkFuncRefGet, result);
  }
  else
  {
    if( C2xIsTokenAvailable(packetHandle, "RoadWeatherMessage", newPath) )
    {
      C2xRemoveToken(packetHandle, "RoadWeatherMessage", newPath);
    }
  }

  return result;
}

int GetRoadWeatherMessage_RoadWeatherMessageParams(LONG packetHandle, struct RoadWeatherMessage_RoadWeatherMessage value, char oldPath[])
{
  char newPath[300];
  int result;

  result = 0;

  value.choice = C2xGetTokenInt(packetHandle, "RoadWeatherMessage", oldPath);

  switch(value.choice)
  {
    case 0:
    {
      snprintf(newPath, elcount(newPath), "%s.%s", oldPath, "upload");
      GetRoadWeatherMessageRoadWeatherUploadParams(packetHandle, value.upload, newPath);
      result = CheckLastError("RoadWeatherMessage", gkFuncRefGet, result);
    }
    break;
    case 1:
    {
      snprintf(newPath, elcount(newPath), "%s.%s", oldPath, "download");
      GetRoadWeatherMessageRoadWeatherDownloadParams(packetHandle, value.download, newPath);
      result = CheckLastError("RoadWeatherMessage", gkFuncRefGet, result);
    }
    break;
  }
  return result;
}

int SetRoadWeatherMessage_RoadWeatherMessageParams(LONG packetHandle, struct RoadWeatherMessage_RoadWeatherMessage value, char oldPath[])
{
  char newPath[300];
  int result;

  result = 0;

  switch(value.choice)
  {
    case 0:
    {
      snprintf(newPath, elcount(newPath), "%s.%s", oldPath, "upload");
      SetRoadWeatherMessageRoadWeatherUploadParams(packetHandle, value.upload, newPath);
      result = CheckLastError("RoadWeatherMessage", gkFuncRefGet, result);
    }
    break;
    case 1:
    {
      snprintf(newPath, elcount(newPath), "%s.%s", oldPath, "download");
      SetRoadWeatherMessageRoadWeatherDownloadParams(packetHandle, value.download, newPath);
      result = CheckLastError("RoadWeatherMessage", gkFuncRefGet, result);
    }
    break;
  }
  return result;
}

int GetRoadWeatherMessageMESSAGE_ID_AND_TYPEParams(LONG packetHandle, WORD tableKey, struct RoadWeatherMessageMESSAGE_ID_AND_TYPE value, char oldPath[])
{
  char newPath[300];
  int result;

  result = 0;

  switch(tableKey)
  {
    case 34:
    {
      snprintf(newPath, elcount(newPath), "%s.%s", oldPath, "roadWeatherMessage");
      GetRoadWeatherMessage_RoadWeatherMessageParams(packetHandle, value.roadWeatherMessage, newPath);
      result = CheckLastError("RoadWeatherMessage", gkFuncRefGet, result);
    }
    break;
  }
  return result;
}

int SetRoadWeatherMessageMESSAGE_ID_AND_TYPEParams(LONG packetHandle, WORD tableKey, struct RoadWeatherMessageMESSAGE_ID_AND_TYPE value, char oldPath[])
{
  char newPath[300];
  int result;

  result = 0;

  switch(tableKey)
  {
    case 34:
    {
      snprintf(newPath, elcount(newPath), "%s.%s", oldPath, "roadWeatherMessage");
      SetRoadWeatherMessage_RoadWeatherMessageParams(packetHandle, value.roadWeatherMessage, newPath);
      result = CheckLastError("RoadWeatherMessage", gkFuncRefGet, result);
    }
    break;
  }
  return result;
}

int API_GetRoadWeatherMessageParams(LONG packetHandle, struct RoadWeatherMessage value)
{
  int result;
  result = 0;

  value.messageId = C2xGetTokenInt(packetHandle, "RoadWeatherMessage", "messageId");
  result = CheckLastError("RoadWeatherMessage", gkFuncRefGet, result);

  GetRoadWeatherMessageMESSAGE_ID_AND_TYPEParams(packetHandle, value.messageId, value.value, "value");
  result = CheckLastError("RoadWeatherMessage", gkFuncRefGet, result);

  return result;
}

int API_SetRoadWeatherMessageParams(LONG packetHandle, struct RoadWeatherMessage value)
{
  int result;
  result = 0;

  value.messageId = 34;

  SetRoadWeatherMessageMESSAGE_ID_AND_TYPEParams(packetHandle, value.messageId, value.value, "value");
  result = CheckLastError("RoadWeatherMessage", gkFuncRefGet, result);

  return result;
}

