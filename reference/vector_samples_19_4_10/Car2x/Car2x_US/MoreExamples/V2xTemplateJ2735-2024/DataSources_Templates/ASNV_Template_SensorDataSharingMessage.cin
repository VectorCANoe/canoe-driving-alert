/*@!Encoding:1252*/
/*
//  (c) Vector Informatik GmbH. All rights reserved.
//
//  This file contains definitions of structs and methods that may be used
//  to set and get the values of an ASN.1 defined packet's payload.
//
//  //This example demonstrates how to set a packet's payload:
//  LONG packetHandle;
//  struct SensorDataSharingMessage payload;
//  //you need to set the values of the variable "payload" yourself
//  packetHandle = API_InitSensorDataSharingMessagePacket();
//  if (packetHandle!=0) {
//    if (API_SetSensorDataSharingMessageParams(packetHandle, payload)==0) {
//      if (C2xCompletePacket(packetHandle)==0) {
//        C2xOutputPacket(packetHandle);
//      }
//    }
//  }
//                                                                             */
includes
{
  #include "ASNV_Template_BaseDatatypes.cin"  // If warning "Duplicate #include, ignoring this include" appears, please remove the ASNV_Template_BaseDatatypes.cin include from your other *.cin files in the project.
}
variables
{
    struct SensorDataSharingMessageCommon_TemporaryID {
        INT isValidFlag;   // necessary if this struct is used as an optional field of a SEQUENCE
        CHAR string[5];
        INT  stringLength;
    };
    
    struct SensorDataSharingMessageCommon_DDateTime {
        INT isValidFlag;   // necessary if this struct is used as an optional field of a SEQUENCE
        struct OPT_WORD_ASN year;  // INTEGER, OPTIONAL, 0..4095;
        struct OPT_BYTE_ASN month;  // INTEGER, OPTIONAL, 0..12;
        struct OPT_BYTE_ASN day;  // INTEGER, OPTIONAL, 0..31;
        struct OPT_BYTE_ASN hour;  // INTEGER, OPTIONAL, 0..31;
        struct OPT_BYTE_ASN minute;  // INTEGER, OPTIONAL, 0..60;
        struct OPT_WORD_ASN second;  // INTEGER, OPTIONAL, 0..65535;
        struct OPT_INT_ASN offset;  // INTEGER, OPTIONAL, -840..840;
    };
    
    struct SensorDataSharingMessageAddGrpB_LatitudeDMS2 {
        INT isValidFlag;   // necessary if this struct is used as an optional field of a SEQUENCE
        INT d;  // INTEGER, -90..90;
        BYTE m;  // INTEGER, 0..59;
        WORD s;  // INTEGER, 0..5999;
    };
    
    struct SensorDataSharingMessageAddGrpB_LongitudeDMS2 {
        INT isValidFlag;   // necessary if this struct is used as an optional field of a SEQUENCE
        INT d;  // INTEGER, -180..180;
        BYTE m;  // INTEGER, 0..59;
        WORD s;  // INTEGER, 0..5999;
    };
    
    struct SensorDataSharingMessageAddGrpB_Position3D_addGrpB {
        INT isValidFlag;   // necessary if this struct is used as an optional field of a SEQUENCE
        struct SensorDataSharingMessageAddGrpB_LatitudeDMS2 latitude;  // SEQUENCE;
        struct SensorDataSharingMessageAddGrpB_LongitudeDMS2 longitude;  // SEQUENCE;
        INT elevation;  // INTEGER, -32768..32767;
    };
    
    struct SensorDataSharingMessageAddGrpC_Altitude {
        INT isValidFlag;   // necessary if this struct is used as an optional field of a SEQUENCE
        LONG value;  // INTEGER, -100000..800001;
        INT confidence;  // ENUMERATED, alt_000_01(-0), alt_000_02(1), alt_000_05(2), alt_000_10(3), alt_000_20(4), alt_000_50(5), alt_001_00(6), alt_002_00(7), alt_005_00(8), alt_010_00(9), alt_020_00(10), alt_050_00(11), alt_100_00(12), alt_200_00(13), outOfRange(14), unavailable(15);
    };
    
    struct SensorDataSharingMessageAddGrpC_Position3D_addGrpC {
        INT isValidFlag;   // necessary if this struct is used as an optional field of a SEQUENCE
        struct SensorDataSharingMessageAddGrpC_Altitude altitude;  // SEQUENCE;
    };
    
    struct SensorDataSharingMessageCommon_RegionalExtension_Reg_Position3D_table {
        struct SensorDataSharingMessageAddGrpB_Position3D_addGrpB addGrpB;  // SEQUENCE;
        struct SensorDataSharingMessageAddGrpC_Position3D_addGrpC addGrpC;  // SEQUENCE;
    };
    
    struct SensorDataSharingMessageCommon_RegionalExtension_Reg_Position3D {
        INT isValidFlag;   // necessary if this struct is used as an optional field of a SEQUENCE
        BYTE regionId;  // INTEGER, 0..255, noRegion(0), addGrpA(1), addGrpB(2), addGrpC(3), addGrpD(4);
        struct SensorDataSharingMessageCommon_RegionalExtension_Reg_Position3D_table regExtvalue;  // TABLE;
    };
    
    struct SensorDataSharingMessageCommon_Position3D_regional {
        INT isValidFlag;   // necessary if this struct is used as an optional field of a SEQUENCE
        INT length;
        struct SensorDataSharingMessageCommon_RegionalExtension_Reg_Position3D arrayValue[4];  // SEQUENCE;
    };
    
    struct SensorDataSharingMessageCommon_Position3D {
        INT isValidFlag;   // necessary if this struct is used as an optional field of a SEQUENCE
        LONG lat;  // INTEGER, -900000000..900000001;
        LONG lon;  // INTEGER, -1799999999..1800000001;
        struct OPT_LONG_ASN elevation;  // INTEGER, OPTIONAL, -4096..61439;
        struct SensorDataSharingMessageCommon_Position3D_regional regional;  // SEQUENCEOF, OPTIONAL;
    };
    
    struct SensorDataSharingMessageCommon_PositionalAccuracy {
        INT isValidFlag;   // necessary if this struct is used as an optional field of a SEQUENCE
        BYTE semiMajor;  // INTEGER, 0..255;
        BYTE semiMinor;  // INTEGER, 0..255;
        WORD orientation;  // INTEGER, 0..65535;
    };
    
    struct SensorDataSharingMessagePositionOffsetXYZ {
        INT isValidFlag;   // necessary if this struct is used as an optional field of a SEQUENCE
        INT offsetX;  // INTEGER, -32767..32767;
        INT offsetY;  // INTEGER, -32767..32767;
        struct OPT_INT_ASN offsetZ;  // INTEGER, OPTIONAL, -32767..32767;
    };
    
    struct SensorDataSharingMessageCommon_PositionConfidenceSet {
        INT isValidFlag;   // necessary if this struct is used as an optional field of a SEQUENCE
        INT pos;  // ENUMERATED, unavailable(0), a500m(1), a200m(2), a100m(3), a50m(4), a20m(5), a10m(6), a5m(7), a2m(8), a1m(9), a50cm(10), a20cm(11), a10cm(12), a5cm(13), a2cm(14), a1cm(15);
        INT elevation;  // ENUMERATED, unavailable(0), elev_500_00(1), elev_200_00(2), elev_100_00(3), elev_050_00(4), elev_020_00(5), elev_010_00(6), elev_005_00(7), elev_002_00(8), elev_001_00(9), elev_000_50(10), elev_000_20(11), elev_000_10(12), elev_000_05(13), elev_000_02(14), elev_000_01(15);
    };
    
    struct SensorDataSharingMessageCommon_AccelerationSet4Way {
        INT isValidFlag;   // necessary if this struct is used as an optional field of a SEQUENCE
        INT lon;  // INTEGER, -2000..2001;
        INT lat;  // INTEGER, -2000..2001;
        INT vert;  // INTEGER, -127..127;
        INT yaw;  // INTEGER, -32767..32767;
    };
    
    struct SensorDataSharingMessageDetectedObjectCommonData {
        INT isValidFlag;   // necessary if this struct is used as an optional field of a SEQUENCE
        INT objType;  // ENUMERATED, unknown(0), vehicle(1), vru(2), animal(3);
        BYTE objTypeCfd;  // INTEGER, 0..101;
        WORD objectID;  // INTEGER, 0..65535;
        INT measurementTime;  // INTEGER, -1500..1500;
        INT timeConfidence;  // ENUMERATED, unavailable(0), time_100_000(1), time_050_000(2), time_020_000(3), time_010_000(4), time_002_000(5), time_001_000(6), time_000_500(7), time_000_200(8), time_000_100(9), time_000_050(10), time_000_020(11), time_000_010(12), time_000_005(13), time_000_002(14), time_000_001(15), time_000_000_5(16), time_000_000_2(17), time_000_000_1(18), time_000_000_05(19), time_000_000_02(20), time_000_000_01(21), time_000_000_005(22), time_000_000_002(23), time_000_000_001(24), time_000_000_000_5(25), time_000_000_000_2(26), time_000_000_000_1(27), time_000_000_000_05(28), time_000_000_000_02(29), time_000_000_000_01(30), time_000_000_000_005(31), time_000_000_000_002(32), time_000_000_000_001(33), time_000_000_000_000_5(34), time_000_000_000_000_2(35), time_000_000_000_000_1(36), time_000_000_000_000_05(37), time_000_000_000_000_02(38), time_000_000_000_000_01(39);
        struct SensorDataSharingMessagePositionOffsetXYZ pos;  // SEQUENCE;
        struct SensorDataSharingMessageCommon_PositionConfidenceSet posConfidence;  // SEQUENCE;
        WORD speed;  // INTEGER, 0..8191;
        INT speedConfidence;  // ENUMERATED, unavailable(0), prec100ms(1), prec10ms(2), prec5ms(3), prec1ms(4), prec0_1ms(5), prec0_05ms(6), prec0_01ms(7);
        struct OPT_WORD_ASN speedZ;  // INTEGER, OPTIONAL, 0..8191;
        struct OPT_ENUM_ASN speedConfidenceZ;  // ENUMERATED, OPTIONAL, unavailable(0), prec100ms(1), prec10ms(2), prec5ms(3), prec1ms(4), prec0_1ms(5), prec0_05ms(6), prec0_01ms(7);
        WORD heading;  // INTEGER, 0..28800;
        INT headingConf;  // ENUMERATED, unavailable(0), prec10deg(1), prec05deg(2), prec01deg(3), prec0_1deg(4), prec0_05deg(5), prec0_01deg(6), prec0_0125deg(7);
        struct SensorDataSharingMessageCommon_AccelerationSet4Way accel4way;  // SEQUENCE, OPTIONAL;
        struct OPT_ENUM_ASN accCfdX;  // ENUMERATED, OPTIONAL, unavailable(0), accl_100_00(1), accl_010_00(2), accl_005_00(3), accl_001_00(4), accl_000_10(5), accl_000_05(6), accl_000_01(7);
        struct OPT_ENUM_ASN accCfdY;  // ENUMERATED, OPTIONAL, unavailable(0), accl_100_00(1), accl_010_00(2), accl_005_00(3), accl_001_00(4), accl_000_10(5), accl_000_05(6), accl_000_01(7);
        struct OPT_ENUM_ASN accCfdZ;  // ENUMERATED, OPTIONAL, unavailable(0), accl_100_00(1), accl_010_00(2), accl_005_00(3), accl_001_00(4), accl_000_10(5), accl_000_05(6), accl_000_01(7);
        struct OPT_ENUM_ASN accCfdYaw;  // ENUMERATED, OPTIONAL, unavailable(0), degSec_100_00(1), degSec_010_00(2), degSec_005_00(3), degSec_001_00(4), degSec_000_10(5), degSec_000_05(6), degSec_000_01(7);
    };
    
    struct SensorDataSharingMessageCommon_ExteriorLights {
        INT isValidFlag;   // necessary if this struct is used as an optional field of a SEQUENCE
        CHAR string[10];
        INT  stringLength;
    };
    
    struct SensorDataSharingMessageAttitude {
        INT isValidFlag;   // necessary if this struct is used as an optional field of a SEQUENCE
        INT pitch;  // INTEGER, -7200..7200;
        INT roll;  // INTEGER, -14400..14400;
        INT yaw;  // INTEGER, -14400..14400;
    };
    
    struct SensorDataSharingMessageAttitudeConfidence {
        INT isValidFlag;   // necessary if this struct is used as an optional field of a SEQUENCE
        INT pitchConfidence;  // ENUMERATED, unavailable(0), prec10deg(1), prec05deg(2), prec01deg(3), prec0_1deg(4), prec0_05deg(5), prec0_01deg(6), prec0_0125deg(7);
        INT rollConfidence;  // ENUMERATED, unavailable(0), prec10deg(1), prec05deg(2), prec01deg(3), prec0_1deg(4), prec0_05deg(5), prec0_01deg(6), prec0_0125deg(7);
        INT yawConfidence;  // ENUMERATED, unavailable(0), prec10deg(1), prec05deg(2), prec01deg(3), prec0_1deg(4), prec0_05deg(5), prec0_01deg(6), prec0_0125deg(7);
    };
    
    struct SensorDataSharingMessageAngularVelocity {
        INT isValidFlag;   // necessary if this struct is used as an optional field of a SEQUENCE
        INT pitchRate;  // INTEGER, -32767..32767;
        INT rollRate;  // INTEGER, -32767..32767;
    };
    
    struct SensorDataSharingMessageAngularVelocityConfidence {
        INT isValidFlag;   // necessary if this struct is used as an optional field of a SEQUENCE
        struct OPT_ENUM_ASN pitchRateConfidence;  // ENUMERATED, OPTIONAL, unavailable(0), degSec_100_00(1), degSec_010_00(2), degSec_005_00(3), degSec_001_00(4), degSec_000_10(5), degSec_000_05(6), degSec_000_01(7);
        struct OPT_ENUM_ASN rollRateConfidence;  // ENUMERATED, OPTIONAL, unavailable(0), degSec_100_00(1), degSec_010_00(2), degSec_005_00(3), degSec_001_00(4), degSec_000_10(5), degSec_000_05(6), degSec_000_01(7);
    };
    
    struct SensorDataSharingMessageCommon_VehicleSize {
        INT isValidFlag;   // necessary if this struct is used as an optional field of a SEQUENCE
        WORD width;  // INTEGER, 0..1023;
        WORD length;  // INTEGER, 0..4095;
    };
    
    struct SensorDataSharingMessageVehicleSizeConfidence {
        INT isValidFlag;   // necessary if this struct is used as an optional field of a SEQUENCE
        INT vehicleWidthConfidence;  // ENUMERATED, unavailable(0), size_100_00(1), size_050_00(2), size_020_00(3), size_010_00(4), size_005_00(5), size_002_00(6), size_001_00(7), size_000_50(8), size_000_20(9), size_000_10(10), size_000_05(11), size_000_02(12), size_000_01(13);
        INT vehicleLengthConfidence;  // ENUMERATED, unavailable(0), size_100_00(1), size_050_00(2), size_020_00(3), size_010_00(4), size_005_00(5), size_002_00(6), size_001_00(7), size_000_50(8), size_000_20(9), size_000_10(10), size_000_05(11), size_000_02(12), size_000_01(13);
        struct OPT_ENUM_ASN vehicleHeightConfidence;  // ENUMERATED, OPTIONAL, unavailable(0), size_100_00(1), size_050_00(2), size_020_00(3), size_010_00(4), size_005_00(5), size_002_00(6), size_001_00(7), size_000_50(8), size_000_20(9), size_000_10(10), size_000_05(11), size_000_02(12), size_000_01(13);
    };
    
    struct SensorDataSharingMessageDetectedVehicleData {
        INT isValidFlag;   // necessary if this struct is used as an optional field of a SEQUENCE
        struct SensorDataSharingMessageCommon_ExteriorLights lights;  // BITSTRING, OPTIONAL;
        struct SensorDataSharingMessageAttitude vehAttitude;  // SEQUENCE, OPTIONAL;
        struct SensorDataSharingMessageAttitudeConfidence vehAttitudeConfidence;  // SEQUENCE, OPTIONAL;
        struct SensorDataSharingMessageAngularVelocity vehAngVel;  // SEQUENCE, OPTIONAL;
        struct SensorDataSharingMessageAngularVelocityConfidence vehAngVelConfidence;  // SEQUENCE, OPTIONAL;
        struct SensorDataSharingMessageCommon_VehicleSize size;  // SEQUENCE, OPTIONAL;
        struct OPT_BYTE_ASN height;  // INTEGER, OPTIONAL, 0..127;
        struct SensorDataSharingMessageVehicleSizeConfidence vehicleSizeConfidence;  // SEQUENCE, OPTIONAL;
        struct OPT_BYTE_ASN vehicleClass;  // INTEGER, OPTIONAL, 0..255, unknownVehicleClass(0), specialVehicleClass(1), passenger_Vehicle_TypeUnknown(10), passenger_Vehicle_TypeOther(11), lightTruck_Vehicle_TypeUnknown(20), lightTruck_Vehicle_TypeOther(21), truck_Vehicle_TypeUnknown(25), truck_Vehicle_TypeOther(26), truck_axleCnt2(27), truck_axleCnt3(28), truck_axleCnt4(29), truck_axleCnt4Trailer(30), truck_axleCnt5Trailer(31), truck_axleCnt6Trailer(32), truck_axleCnt5MultiTrailer(33), truck_axleCnt6MultiTrailer(34), truck_axleCnt7MultiTrailer(35), motorcycle_TypeUnknown(40), motorcycle_TypeOther(41), motorcycle_Cruiser_Standard(42), motorcycle_SportUnclad(43), motorcycle_SportTouring(44), motorcycle_SuperSport(45), motorcycle_Touring(46), motorcycle_Trike(47), motorcycle_wPassengers(48), transit_TypeUnknown(50), transit_TypeOther(51), transit_BRT(52), transit_ExpressBus(53), transit_LocalBus(54), transit_SchoolBus(55), transit_FixedGuideway(56), transit_Paratransit(57), transit_Paratransit_Ambulance(58), emergency_TypeUnknown(60), emergency_TypeOther(61), emergency_Fire_Light_Vehicle(62), emergency_Fire_Heavy_Vehicle(63), emergency_Fire_Paramedic_Vehicle(64), emergency_Fire_Ambulance_Vehicle(65), emergency_Police_Light_Vehicle(66), emergency_Police_Heavy_Vehicle(67), emergency_Other_Responder(68), emergency_Other_Ambulance(69), otherTraveler_TypeUnknown(80), otherTraveler_TypeOther(81), otherTraveler_Pedestrian(82), otherTraveler_Visually_Disabled(83), otherTraveler_Physically_Disabled(84), otherTraveler_Bicycle(85), otherTraveler_Vulnerable_Roadworker(86), infrastructure_TypeUnknown(90), infrastructure_Fixed(91), infrastructure_Movable(92), equipped_CargoTrailer(93);
        struct OPT_BYTE_ASN classConf;  // INTEGER, OPTIONAL, 0..101;
    };
    
    struct SensorDataSharingMessagePersonalSafetyMessage_PropelledInformation {
        INT isValidFlag;   // necessary if this struct is used as an optional field of a SEQUENCE
        INT choice;
        INT human;  // ENUMERATED, unavailable(0), otherTypes(1), onFoot(2), skateboard(3), pushOrKickScooter(4), wheelchair(5);
        INT animal;  // ENUMERATED, unavailable(0), otherTypes(1), animalMounted(2), animalDrawnCarriage(3);
        INT motor;  // ENUMERATED, unavailable(0), otherTypes(1), wheelChair(2), bicycle(3), scooter(4), selfBalancingDevice(5);
    };
    
    struct SensorDataSharingMessageDetectedVRUData {
        INT isValidFlag;   // necessary if this struct is used as an optional field of a SEQUENCE
        struct OPT_ENUM_ASN basicType;  // ENUMERATED, OPTIONAL, unavailable(0), aPEDESTRIAN(1), aPEDALCYCLIST(2), aPUBLICSAFETYWORKER(3), anANIMAL(4);
        struct SensorDataSharingMessagePersonalSafetyMessage_PropelledInformation propulsion;  // CHOICE, OPTIONAL;
        struct OPT_ENUM_ASN attachment;  // ENUMERATED, OPTIONAL, unavailable(0), stroller(1), bicycleTrailer(2), cart(3), wheelchair(4), otherWalkAssistAttachments(5), pet(6);
        struct OPT_BYTE_ASN radius;  // INTEGER, OPTIONAL, 0..200;
    };
    
    struct SensorDataSharingMessageObstacleSize {
        INT isValidFlag;   // necessary if this struct is used as an optional field of a SEQUENCE
        WORD width;  // INTEGER, 0..1023;
        WORD length;  // INTEGER, 0..1023;
        struct OPT_WORD_ASN height;  // INTEGER, OPTIONAL, 0..1023;
    };
    
    struct SensorDataSharingMessageObstacleSizeConfidence {
        INT isValidFlag;   // necessary if this struct is used as an optional field of a SEQUENCE
        INT widthConfidence;  // ENUMERATED, unavailable(0), size_100_00(1), size_050_00(2), size_020_00(3), size_010_00(4), size_005_00(5), size_002_00(6), size_001_00(7), size_000_50(8), size_000_20(9), size_000_10(10), size_000_05(11), size_000_02(12), size_000_01(13);
        INT lengthConfidence;  // ENUMERATED, unavailable(0), size_100_00(1), size_050_00(2), size_020_00(3), size_010_00(4), size_005_00(5), size_002_00(6), size_001_00(7), size_000_50(8), size_000_20(9), size_000_10(10), size_000_05(11), size_000_02(12), size_000_01(13);
        struct OPT_ENUM_ASN heightConfidence;  // ENUMERATED, OPTIONAL, unavailable(0), size_100_00(1), size_050_00(2), size_020_00(3), size_010_00(4), size_005_00(5), size_002_00(6), size_001_00(7), size_000_50(8), size_000_20(9), size_000_10(10), size_000_05(11), size_000_02(12), size_000_01(13);
    };
    
    struct SensorDataSharingMessageDetectedObstacleData {
        INT isValidFlag;   // necessary if this struct is used as an optional field of a SEQUENCE
        struct SensorDataSharingMessageObstacleSize obstSize;  // SEQUENCE;
        struct SensorDataSharingMessageObstacleSizeConfidence obstSizeConfidence;  // SEQUENCE;
    };
    
    struct SensorDataSharingMessageDetectedObjectOptionalData {
        INT isValidFlag;   // necessary if this struct is used as an optional field of a SEQUENCE
        INT choice;
        struct SensorDataSharingMessageDetectedVehicleData detVeh;  // SEQUENCE;
        struct SensorDataSharingMessageDetectedVRUData detVRU;  // SEQUENCE;
        struct SensorDataSharingMessageDetectedObstacleData detObst;  // SEQUENCE;
    };
    
    struct SensorDataSharingMessageDetectedObjectData {
        INT isValidFlag;   // necessary if this struct is used as an optional field of a SEQUENCE
        struct SensorDataSharingMessageDetectedObjectCommonData detObjCommon;  // SEQUENCE;
        struct SensorDataSharingMessageDetectedObjectOptionalData detObjOptData;  // CHOICE, OPTIONAL;
    };
    
    struct SensorDataSharingMessageDetectedObjectList {
        INT isValidFlag;   // necessary if this struct is used as an optional field of a SEQUENCE
        INT length;
        struct SensorDataSharingMessageDetectedObjectData arrayValue[256];  // SEQUENCE;
    };
    
    struct SensorDataSharingMessage_SensorDataSharingMessage {
        INT isValidFlag;   // necessary if this struct is used as an optional field of a SEQUENCE
        BYTE msgCnt;  // INTEGER, 0..127;
        struct SensorDataSharingMessageCommon_TemporaryID sourceID;  // OCTETSTRING;
        INT equipmentType;  // ENUMERATED, unknown(0), rsu(1), obu(2), vru(3);
        struct SensorDataSharingMessageCommon_DDateTime sDSMTimeStamp;  // SEQUENCE;
        struct SensorDataSharingMessageCommon_Position3D refPos;  // SEQUENCE;
        struct SensorDataSharingMessageCommon_PositionalAccuracy refPosXYConf;  // SEQUENCE;
        struct OPT_ENUM_ASN refPosElConf;  // ENUMERATED, OPTIONAL, unavailable(0), elev_500_00(1), elev_200_00(2), elev_100_00(3), elev_050_00(4), elev_020_00(5), elev_010_00(6), elev_005_00(7), elev_002_00(8), elev_001_00(9), elev_000_50(10), elev_000_20(11), elev_000_10(12), elev_000_05(13), elev_000_02(14), elev_000_01(15);
        struct SensorDataSharingMessageDetectedObjectList objects;  // SEQUENCEOF;
    };
    
    struct SensorDataSharingMessageMESSAGE_ID_AND_TYPE {
        struct SensorDataSharingMessage_SensorDataSharingMessage sensorDataSharingMessage;  // SEQUENCE;
    };
    
    struct SensorDataSharingMessage {
        INT isValidFlag;   // necessary if this struct is used as an optional field of a SEQUENCE
        WORD messageId;  // INTEGER, 0..32767, mapData(18), signalPhaseAndTimingMessage(19), basicSafetyMessage(20), commonSafetyRequest(21), emergencyVehicleAlert(22), intersectionCollision(23), nmeaCorrections(24), probeDataManagement(25), probeVehicleData(26), roadSideAlert(27), rtcmCorrections(28), signalRequestMessage(29), signalStatusMessage(30), travelerInformation(31), personalSafetyMessage(32), roadSafetyMessage(33), roadWeatherMessage(34), probeDataConfigMessage(35), probeDataReportMessage(36), tollAdvertisementMessage(37), tollUsageMessage(38), tollUsageAckMessage(39), cooperativeControlMessage(40), sensorDataSharingMessage(41), maneuverSharingAndCoordinatingMessage(42), roadGeometryAndAttributes(43), personalSafetyMessage2(44), trafficSignalPhaseAndTiming(45), signalControlAndPrioritizationRequest(46), signalControlAndPrioritizationStatus(47), roadUserChargingConfigMessage(48), roadUserChargingReportMessage(49), trafficLightStatusMessage(50);
        struct SensorDataSharingMessageMESSAGE_ID_AND_TYPE value;  // TABLE;
    };
    
}

/*
// init function to create a simple packet handle
*/ 
LONG API_InitSensorDataSharingMessagePacket()
{
  return C2xInitPacket("SensorDataSharingMessage"); 
}

/*
// init function to create a simple packet handle and
// initialize the struct with valid data
*/ 
LONG API_InitSensorDataSharingMessagePacket(struct SensorDataSharingMessage msgStruct)
{
  long pktHandle;

  pktHandle = API_InitSensorDataSharingMessagePacket();

  if (pktHandle != 0)
  {
    // create valid message and application data
    if (C2xCompletePacket(pktHandle) == 0) 
    {
      API_GetSensorDataSharingMessageParams(pktHandle, msgStruct);
    }
  }
  return pktHandle;
}

/*
// init function to create a packet with security layer and
// initialize the struct with valid data
*/ 
LONG API_InitSensorDataSharingMessagePacket(struct SensorDataSharingMessage msgStruct, char packetTypeDesignator[], char certificateName[])
{
  long pktHandle, certHdl;

  // initialize the packet
  pktHandle = C2xInitPacket("SensorDataSharingMessage", packetTypeDesignator);

  if (pktHandle != 0)
  {
    certHdl = C2xSecCertificateGetHandle(certificateName);  // get the certificate handle for the cert with name "certificateName"
    if (certHdl != 0) 
    {
      C2xSecPacketSetSignerHandle(pktHandle, certHdl); // set the certHdl to the packet
    }

    // create valid message and application data
    if (C2xCompletePacket(pktHandle) == 0) 
    {
      // copy application data to the application structure
      API_GetSensorDataSharingMessageParams(pktHandle, msgStruct);
    }
  }
  return pktHandle;
}
    

int GetSensorDataSharingMessageCommon_DDateTimeParams(LONG packetHandle, struct SensorDataSharingMessageCommon_DDateTime value, char oldPath[])
{
  char newPath[300];
  int result;

  result = 0;

  snprintf(newPath, elcount(newPath), "%s.%s", oldPath, "year");
  value.year.isValidFlag = C2xIsTokenAvailable(packetHandle, "SensorDataSharingMessage", newPath);
  if(value.year.isValidFlag==1)
  {
    value.year.value = C2xGetTokenInt(packetHandle, "SensorDataSharingMessage", newPath);
    result = CheckLastError("SensorDataSharingMessage", gkFuncRefGet, result);
  }
  snprintf(newPath, elcount(newPath), "%s.%s", oldPath, "month");
  value.month.isValidFlag = C2xIsTokenAvailable(packetHandle, "SensorDataSharingMessage", newPath);
  if(value.month.isValidFlag==1)
  {
    value.month.value = C2xGetTokenInt(packetHandle, "SensorDataSharingMessage", newPath);
    result = CheckLastError("SensorDataSharingMessage", gkFuncRefGet, result);
  }
  snprintf(newPath, elcount(newPath), "%s.%s", oldPath, "day");
  value.day.isValidFlag = C2xIsTokenAvailable(packetHandle, "SensorDataSharingMessage", newPath);
  if(value.day.isValidFlag==1)
  {
    value.day.value = C2xGetTokenInt(packetHandle, "SensorDataSharingMessage", newPath);
    result = CheckLastError("SensorDataSharingMessage", gkFuncRefGet, result);
  }
  snprintf(newPath, elcount(newPath), "%s.%s", oldPath, "hour");
  value.hour.isValidFlag = C2xIsTokenAvailable(packetHandle, "SensorDataSharingMessage", newPath);
  if(value.hour.isValidFlag==1)
  {
    value.hour.value = C2xGetTokenInt(packetHandle, "SensorDataSharingMessage", newPath);
    result = CheckLastError("SensorDataSharingMessage", gkFuncRefGet, result);
  }
  snprintf(newPath, elcount(newPath), "%s.%s", oldPath, "minute");
  value.minute.isValidFlag = C2xIsTokenAvailable(packetHandle, "SensorDataSharingMessage", newPath);
  if(value.minute.isValidFlag==1)
  {
    value.minute.value = C2xGetTokenInt(packetHandle, "SensorDataSharingMessage", newPath);
    result = CheckLastError("SensorDataSharingMessage", gkFuncRefGet, result);
  }
  snprintf(newPath, elcount(newPath), "%s.%s", oldPath, "second");
  value.second.isValidFlag = C2xIsTokenAvailable(packetHandle, "SensorDataSharingMessage", newPath);
  if(value.second.isValidFlag==1)
  {
    value.second.value = C2xGetTokenInt(packetHandle, "SensorDataSharingMessage", newPath);
    result = CheckLastError("SensorDataSharingMessage", gkFuncRefGet, result);
  }
  snprintf(newPath, elcount(newPath), "%s.%s", oldPath, "offset");
  value.offset.isValidFlag = C2xIsTokenAvailable(packetHandle, "SensorDataSharingMessage", newPath);
  if(value.offset.isValidFlag==1)
  {
    value.offset.value = C2xGetTokenInt(packetHandle, "SensorDataSharingMessage", newPath);
    result = CheckLastError("SensorDataSharingMessage", gkFuncRefGet, result);
  }
  return result;
}

int SetSensorDataSharingMessageCommon_DDateTimeParams(LONG packetHandle, struct SensorDataSharingMessageCommon_DDateTime value, char oldPath[])
{
  char newPath[300];
  int result;

  result = 0;

  snprintf(newPath, elcount(newPath), "%s.%s", oldPath, "year");
  if(value.year.isValidFlag==1)
  {
    C2xSetTokenInt(packetHandle, "SensorDataSharingMessage", newPath, value.year.value);
    result = CheckLastError("SensorDataSharingMessage", gkFuncRefGet, result);
  }
  else
  {
    if( C2xIsTokenAvailable(packetHandle, "SensorDataSharingMessage", newPath) )
    {
      C2xRemoveToken(packetHandle, "SensorDataSharingMessage", newPath);
    }
  }

  snprintf(newPath, elcount(newPath), "%s.%s", oldPath, "month");
  if(value.month.isValidFlag==1)
  {
    C2xSetTokenInt(packetHandle, "SensorDataSharingMessage", newPath, value.month.value);
    result = CheckLastError("SensorDataSharingMessage", gkFuncRefGet, result);
  }
  else
  {
    if( C2xIsTokenAvailable(packetHandle, "SensorDataSharingMessage", newPath) )
    {
      C2xRemoveToken(packetHandle, "SensorDataSharingMessage", newPath);
    }
  }

  snprintf(newPath, elcount(newPath), "%s.%s", oldPath, "day");
  if(value.day.isValidFlag==1)
  {
    C2xSetTokenInt(packetHandle, "SensorDataSharingMessage", newPath, value.day.value);
    result = CheckLastError("SensorDataSharingMessage", gkFuncRefGet, result);
  }
  else
  {
    if( C2xIsTokenAvailable(packetHandle, "SensorDataSharingMessage", newPath) )
    {
      C2xRemoveToken(packetHandle, "SensorDataSharingMessage", newPath);
    }
  }

  snprintf(newPath, elcount(newPath), "%s.%s", oldPath, "hour");
  if(value.hour.isValidFlag==1)
  {
    C2xSetTokenInt(packetHandle, "SensorDataSharingMessage", newPath, value.hour.value);
    result = CheckLastError("SensorDataSharingMessage", gkFuncRefGet, result);
  }
  else
  {
    if( C2xIsTokenAvailable(packetHandle, "SensorDataSharingMessage", newPath) )
    {
      C2xRemoveToken(packetHandle, "SensorDataSharingMessage", newPath);
    }
  }

  snprintf(newPath, elcount(newPath), "%s.%s", oldPath, "minute");
  if(value.minute.isValidFlag==1)
  {
    C2xSetTokenInt(packetHandle, "SensorDataSharingMessage", newPath, value.minute.value);
    result = CheckLastError("SensorDataSharingMessage", gkFuncRefGet, result);
  }
  else
  {
    if( C2xIsTokenAvailable(packetHandle, "SensorDataSharingMessage", newPath) )
    {
      C2xRemoveToken(packetHandle, "SensorDataSharingMessage", newPath);
    }
  }

  snprintf(newPath, elcount(newPath), "%s.%s", oldPath, "second");
  if(value.second.isValidFlag==1)
  {
    C2xSetTokenInt(packetHandle, "SensorDataSharingMessage", newPath, value.second.value);
    result = CheckLastError("SensorDataSharingMessage", gkFuncRefGet, result);
  }
  else
  {
    if( C2xIsTokenAvailable(packetHandle, "SensorDataSharingMessage", newPath) )
    {
      C2xRemoveToken(packetHandle, "SensorDataSharingMessage", newPath);
    }
  }

  snprintf(newPath, elcount(newPath), "%s.%s", oldPath, "offset");
  if(value.offset.isValidFlag==1)
  {
    C2xSetTokenInt(packetHandle, "SensorDataSharingMessage", newPath, value.offset.value);
    result = CheckLastError("SensorDataSharingMessage", gkFuncRefGet, result);
  }
  else
  {
    if( C2xIsTokenAvailable(packetHandle, "SensorDataSharingMessage", newPath) )
    {
      C2xRemoveToken(packetHandle, "SensorDataSharingMessage", newPath);
    }
  }

  return result;
}

int GetSensorDataSharingMessageAddGrpB_LatitudeDMS2Params(LONG packetHandle, struct SensorDataSharingMessageAddGrpB_LatitudeDMS2 value, char oldPath[])
{
  char newPath[300];
  int result;

  result = 0;

  snprintf(newPath, elcount(newPath), "%s.%s", oldPath, "d");
  value.d = C2xGetTokenInt(packetHandle, "SensorDataSharingMessage", newPath);
  result = CheckLastError("SensorDataSharingMessage", gkFuncRefGet, result);

  snprintf(newPath, elcount(newPath), "%s.%s", oldPath, "m");
  value.m = C2xGetTokenInt(packetHandle, "SensorDataSharingMessage", newPath);
  result = CheckLastError("SensorDataSharingMessage", gkFuncRefGet, result);

  snprintf(newPath, elcount(newPath), "%s.%s", oldPath, "s");
  value.s = C2xGetTokenInt(packetHandle, "SensorDataSharingMessage", newPath);
  result = CheckLastError("SensorDataSharingMessage", gkFuncRefGet, result);

  return result;
}

int SetSensorDataSharingMessageAddGrpB_LatitudeDMS2Params(LONG packetHandle, struct SensorDataSharingMessageAddGrpB_LatitudeDMS2 value, char oldPath[])
{
  char newPath[300];
  int result;

  result = 0;

  snprintf(newPath, elcount(newPath), "%s.%s", oldPath, "d");
  C2xSetTokenInt(packetHandle, "SensorDataSharingMessage", newPath, value.d);
  result = CheckLastError("SensorDataSharingMessage", gkFuncRefGet, result);

  snprintf(newPath, elcount(newPath), "%s.%s", oldPath, "m");
  C2xSetTokenInt(packetHandle, "SensorDataSharingMessage", newPath, value.m);
  result = CheckLastError("SensorDataSharingMessage", gkFuncRefGet, result);

  snprintf(newPath, elcount(newPath), "%s.%s", oldPath, "s");
  C2xSetTokenInt(packetHandle, "SensorDataSharingMessage", newPath, value.s);
  result = CheckLastError("SensorDataSharingMessage", gkFuncRefGet, result);

  return result;
}

int GetSensorDataSharingMessageAddGrpB_LongitudeDMS2Params(LONG packetHandle, struct SensorDataSharingMessageAddGrpB_LongitudeDMS2 value, char oldPath[])
{
  char newPath[300];
  int result;

  result = 0;

  snprintf(newPath, elcount(newPath), "%s.%s", oldPath, "d");
  value.d = C2xGetTokenInt(packetHandle, "SensorDataSharingMessage", newPath);
  result = CheckLastError("SensorDataSharingMessage", gkFuncRefGet, result);

  snprintf(newPath, elcount(newPath), "%s.%s", oldPath, "m");
  value.m = C2xGetTokenInt(packetHandle, "SensorDataSharingMessage", newPath);
  result = CheckLastError("SensorDataSharingMessage", gkFuncRefGet, result);

  snprintf(newPath, elcount(newPath), "%s.%s", oldPath, "s");
  value.s = C2xGetTokenInt(packetHandle, "SensorDataSharingMessage", newPath);
  result = CheckLastError("SensorDataSharingMessage", gkFuncRefGet, result);

  return result;
}

int SetSensorDataSharingMessageAddGrpB_LongitudeDMS2Params(LONG packetHandle, struct SensorDataSharingMessageAddGrpB_LongitudeDMS2 value, char oldPath[])
{
  char newPath[300];
  int result;

  result = 0;

  snprintf(newPath, elcount(newPath), "%s.%s", oldPath, "d");
  C2xSetTokenInt(packetHandle, "SensorDataSharingMessage", newPath, value.d);
  result = CheckLastError("SensorDataSharingMessage", gkFuncRefGet, result);

  snprintf(newPath, elcount(newPath), "%s.%s", oldPath, "m");
  C2xSetTokenInt(packetHandle, "SensorDataSharingMessage", newPath, value.m);
  result = CheckLastError("SensorDataSharingMessage", gkFuncRefGet, result);

  snprintf(newPath, elcount(newPath), "%s.%s", oldPath, "s");
  C2xSetTokenInt(packetHandle, "SensorDataSharingMessage", newPath, value.s);
  result = CheckLastError("SensorDataSharingMessage", gkFuncRefGet, result);

  return result;
}

int GetSensorDataSharingMessageAddGrpB_Position3D_addGrpBParams(LONG packetHandle, struct SensorDataSharingMessageAddGrpB_Position3D_addGrpB value, char oldPath[])
{
  char newPath[300];
  int result;

  result = 0;

  snprintf(newPath, elcount(newPath), "%s.%s", oldPath, "latitude");
  GetSensorDataSharingMessageAddGrpB_LatitudeDMS2Params(packetHandle, value.latitude, newPath);
  result = CheckLastError("SensorDataSharingMessage", gkFuncRefGet, result);

  snprintf(newPath, elcount(newPath), "%s.%s", oldPath, "longitude");
  GetSensorDataSharingMessageAddGrpB_LongitudeDMS2Params(packetHandle, value.longitude, newPath);
  result = CheckLastError("SensorDataSharingMessage", gkFuncRefGet, result);

  snprintf(newPath, elcount(newPath), "%s.%s", oldPath, "elevation");
  value.elevation = C2xGetTokenInt(packetHandle, "SensorDataSharingMessage", newPath);
  result = CheckLastError("SensorDataSharingMessage", gkFuncRefGet, result);

  return result;
}

int SetSensorDataSharingMessageAddGrpB_Position3D_addGrpBParams(LONG packetHandle, struct SensorDataSharingMessageAddGrpB_Position3D_addGrpB value, char oldPath[])
{
  char newPath[300];
  int result;

  result = 0;

  snprintf(newPath, elcount(newPath), "%s.%s", oldPath, "latitude");
  SetSensorDataSharingMessageAddGrpB_LatitudeDMS2Params(packetHandle, value.latitude, newPath);
  result = CheckLastError("SensorDataSharingMessage", gkFuncRefGet, result);

  snprintf(newPath, elcount(newPath), "%s.%s", oldPath, "longitude");
  SetSensorDataSharingMessageAddGrpB_LongitudeDMS2Params(packetHandle, value.longitude, newPath);
  result = CheckLastError("SensorDataSharingMessage", gkFuncRefGet, result);

  snprintf(newPath, elcount(newPath), "%s.%s", oldPath, "elevation");
  C2xSetTokenInt(packetHandle, "SensorDataSharingMessage", newPath, value.elevation);
  result = CheckLastError("SensorDataSharingMessage", gkFuncRefGet, result);

  return result;
}

int GetSensorDataSharingMessageAddGrpC_AltitudeParams(LONG packetHandle, struct SensorDataSharingMessageAddGrpC_Altitude value, char oldPath[])
{
  char newPath[300];
  int result;

  result = 0;

  snprintf(newPath, elcount(newPath), "%s.%s", oldPath, "value");
  value.value = C2xGetTokenInt(packetHandle, "SensorDataSharingMessage", newPath);
  result = CheckLastError("SensorDataSharingMessage", gkFuncRefGet, result);

  snprintf(newPath, elcount(newPath), "%s.%s", oldPath, "confidence");
  value.confidence = C2xGetTokenInt(packetHandle, "SensorDataSharingMessage", newPath);
  result = CheckLastError("SensorDataSharingMessage", gkFuncRefGet, result);

  return result;
}

int SetSensorDataSharingMessageAddGrpC_AltitudeParams(LONG packetHandle, struct SensorDataSharingMessageAddGrpC_Altitude value, char oldPath[])
{
  char newPath[300];
  int result;

  result = 0;

  snprintf(newPath, elcount(newPath), "%s.%s", oldPath, "value");
  C2xSetTokenInt(packetHandle, "SensorDataSharingMessage", newPath, value.value);
  result = CheckLastError("SensorDataSharingMessage", gkFuncRefGet, result);

  snprintf(newPath, elcount(newPath), "%s.%s", oldPath, "confidence");
  C2xSetTokenInt(packetHandle, "SensorDataSharingMessage", newPath, value.confidence);
  result = CheckLastError("SensorDataSharingMessage", gkFuncRefGet, result);

  return result;
}

int GetSensorDataSharingMessageAddGrpC_Position3D_addGrpCParams(LONG packetHandle, struct SensorDataSharingMessageAddGrpC_Position3D_addGrpC value, char oldPath[])
{
  char newPath[300];
  int result;

  result = 0;

  snprintf(newPath, elcount(newPath), "%s.%s", oldPath, "altitude");
  GetSensorDataSharingMessageAddGrpC_AltitudeParams(packetHandle, value.altitude, newPath);
  result = CheckLastError("SensorDataSharingMessage", gkFuncRefGet, result);

  return result;
}

int SetSensorDataSharingMessageAddGrpC_Position3D_addGrpCParams(LONG packetHandle, struct SensorDataSharingMessageAddGrpC_Position3D_addGrpC value, char oldPath[])
{
  char newPath[300];
  int result;

  result = 0;

  snprintf(newPath, elcount(newPath), "%s.%s", oldPath, "altitude");
  SetSensorDataSharingMessageAddGrpC_AltitudeParams(packetHandle, value.altitude, newPath);
  result = CheckLastError("SensorDataSharingMessage", gkFuncRefGet, result);

  return result;
}

int GetSensorDataSharingMessageCommon_RegionalExtension_Reg_Position3D_tableParams(LONG packetHandle, WORD tableKey, struct SensorDataSharingMessageCommon_RegionalExtension_Reg_Position3D_table value, char oldPath[])
{
  char newPath[300];
  int result;

  result = 0;

  switch(tableKey)
  {
    case 2:
    {
      snprintf(newPath, elcount(newPath), "%s.%s", oldPath, "addGrpB");
      GetSensorDataSharingMessageAddGrpB_Position3D_addGrpBParams(packetHandle, value.addGrpB, newPath);
      result = CheckLastError("SensorDataSharingMessage", gkFuncRefGet, result);
    }
    break;
    case 3:
    {
      snprintf(newPath, elcount(newPath), "%s.%s", oldPath, "addGrpC");
      GetSensorDataSharingMessageAddGrpC_Position3D_addGrpCParams(packetHandle, value.addGrpC, newPath);
      result = CheckLastError("SensorDataSharingMessage", gkFuncRefGet, result);
    }
    break;
  }
  return result;
}

int SetSensorDataSharingMessageCommon_RegionalExtension_Reg_Position3D_tableParams(LONG packetHandle, WORD tableKey, struct SensorDataSharingMessageCommon_RegionalExtension_Reg_Position3D_table value, char oldPath[])
{
  char newPath[300];
  int result;

  result = 0;

  switch(tableKey)
  {
    case 2:
    {
      snprintf(newPath, elcount(newPath), "%s.%s", oldPath, "addGrpB");
      SetSensorDataSharingMessageAddGrpB_Position3D_addGrpBParams(packetHandle, value.addGrpB, newPath);
      result = CheckLastError("SensorDataSharingMessage", gkFuncRefGet, result);
    }
    break;
    case 3:
    {
      snprintf(newPath, elcount(newPath), "%s.%s", oldPath, "addGrpC");
      SetSensorDataSharingMessageAddGrpC_Position3D_addGrpCParams(packetHandle, value.addGrpC, newPath);
      result = CheckLastError("SensorDataSharingMessage", gkFuncRefGet, result);
    }
    break;
  }
  return result;
}

int GetSensorDataSharingMessageCommon_RegionalExtension_Reg_Position3DParams(LONG packetHandle, struct SensorDataSharingMessageCommon_RegionalExtension_Reg_Position3D value, char oldPath[])
{
  char newPath[300];
  int result;

  result = 0;

  snprintf(newPath, elcount(newPath), "%s.%s", oldPath, "regionId");
  value.regionId = C2xGetTokenInt(packetHandle, "SensorDataSharingMessage", newPath);
  result = CheckLastError("SensorDataSharingMessage", gkFuncRefGet, result);

  snprintf(newPath, elcount(newPath), "%s.%s", oldPath, "regExtvalue");
  GetSensorDataSharingMessageCommon_RegionalExtension_Reg_Position3D_tableParams(packetHandle, value.regionId, value.regExtvalue, newPath);
  result = CheckLastError("SensorDataSharingMessage", gkFuncRefGet, result);

  return result;
}

int SetSensorDataSharingMessageCommon_RegionalExtension_Reg_Position3DParams(LONG packetHandle, struct SensorDataSharingMessageCommon_RegionalExtension_Reg_Position3D value, char oldPath[])
{
  char newPath[300];
  int result;

  result = 0;


  snprintf(newPath, elcount(newPath), "%s.%s", oldPath, "regExtvalue");
  SetSensorDataSharingMessageCommon_RegionalExtension_Reg_Position3D_tableParams(packetHandle, value.regionId, value.regExtvalue, newPath);
  result = CheckLastError("SensorDataSharingMessage", gkFuncRefGet, result);

  return result;
}

int GetSensorDataSharingMessageCommon_Position3D_regionalParams(LONG packetHandle, struct SensorDataSharingMessageCommon_Position3D_regional value, char oldPath[])
{
  char newPath[300]; 
  int i;
  int result;

  result = 0;

  value.length = C2xGetTokenInt(packetHandle, "SensorDataSharingMessage", oldPath);
  if((result = CheckLastError("SensorDataSharingMessage", gkFuncRefGet, result))==0)
  {
    for(i=0; i<value.length; i++)
    {
      snprintf(newPath, elcount(newPath), "%s[%d]", oldPath, i);
      GetSensorDataSharingMessageCommon_RegionalExtension_Reg_Position3DParams(packetHandle, value.arrayValue[i], newPath);
      result = CheckLastError("SensorDataSharingMessage", gkFuncRefGet, result);
    }
  }
  return result;
}

int SetSensorDataSharingMessageCommon_Position3D_regionalParams(LONG packetHandle, struct SensorDataSharingMessageCommon_Position3D_regional value, char oldPath[])
{
  char newPath[300]; 
  int i;
  int result;

  result = 0;

  C2xRemoveToken(packetHandle, "SensorDataSharingMessage", oldPath);
  for(i=0; i<value.length; i++)
  {
    snprintf(newPath, elcount(newPath), "%s[%d]", oldPath, i);
    SetSensorDataSharingMessageCommon_RegionalExtension_Reg_Position3DParams(packetHandle, value.arrayValue[i], newPath);
    result = CheckLastError("SensorDataSharingMessage", gkFuncRefGet, result);
  }
  return result;
}

int GetSensorDataSharingMessageCommon_Position3DParams(LONG packetHandle, struct SensorDataSharingMessageCommon_Position3D value, char oldPath[])
{
  char newPath[300];
  int result;

  result = 0;

  snprintf(newPath, elcount(newPath), "%s.%s", oldPath, "lat");
  value.lat = C2xGetTokenInt(packetHandle, "SensorDataSharingMessage", newPath);
  result = CheckLastError("SensorDataSharingMessage", gkFuncRefGet, result);

  snprintf(newPath, elcount(newPath), "%s.%s", oldPath, "lon");
  value.lon = C2xGetTokenInt(packetHandle, "SensorDataSharingMessage", newPath);
  result = CheckLastError("SensorDataSharingMessage", gkFuncRefGet, result);

  snprintf(newPath, elcount(newPath), "%s.%s", oldPath, "elevation");
  value.elevation.isValidFlag = C2xIsTokenAvailable(packetHandle, "SensorDataSharingMessage", newPath);
  if(value.elevation.isValidFlag==1)
  {
    value.elevation.value = C2xGetTokenInt(packetHandle, "SensorDataSharingMessage", newPath);
    result = CheckLastError("SensorDataSharingMessage", gkFuncRefGet, result);
  }
  snprintf(newPath, elcount(newPath), "%s.%s", oldPath, "regional");
  value.regional.isValidFlag = C2xIsTokenAvailable(packetHandle, "SensorDataSharingMessage", newPath);
  if(value.regional.isValidFlag==1)
  {
    GetSensorDataSharingMessageCommon_Position3D_regionalParams(packetHandle, value.regional, newPath);
    result = CheckLastError("SensorDataSharingMessage", gkFuncRefGet, result);
  }
  return result;
}

int SetSensorDataSharingMessageCommon_Position3DParams(LONG packetHandle, struct SensorDataSharingMessageCommon_Position3D value, char oldPath[])
{
  char newPath[300];
  int result;

  result = 0;

  snprintf(newPath, elcount(newPath), "%s.%s", oldPath, "lat");
  C2xSetTokenInt(packetHandle, "SensorDataSharingMessage", newPath, value.lat);
  result = CheckLastError("SensorDataSharingMessage", gkFuncRefGet, result);

  snprintf(newPath, elcount(newPath), "%s.%s", oldPath, "lon");
  C2xSetTokenInt(packetHandle, "SensorDataSharingMessage", newPath, value.lon);
  result = CheckLastError("SensorDataSharingMessage", gkFuncRefGet, result);

  snprintf(newPath, elcount(newPath), "%s.%s", oldPath, "elevation");
  if(value.elevation.isValidFlag==1)
  {
    C2xSetTokenInt(packetHandle, "SensorDataSharingMessage", newPath, value.elevation.value);
    result = CheckLastError("SensorDataSharingMessage", gkFuncRefGet, result);
  }
  else
  {
    if( C2xIsTokenAvailable(packetHandle, "SensorDataSharingMessage", newPath) )
    {
      C2xRemoveToken(packetHandle, "SensorDataSharingMessage", newPath);
    }
  }

  snprintf(newPath, elcount(newPath), "%s.%s", oldPath, "regional");
  if(value.regional.isValidFlag==1)
  {
    SetSensorDataSharingMessageCommon_Position3D_regionalParams(packetHandle, value.regional, newPath);
    result = CheckLastError("SensorDataSharingMessage", gkFuncRefGet, result);
  }
  else
  {
    if( C2xIsTokenAvailable(packetHandle, "SensorDataSharingMessage", newPath) )
    {
      C2xRemoveToken(packetHandle, "SensorDataSharingMessage", newPath);
    }
  }

  return result;
}

int GetSensorDataSharingMessageCommon_PositionalAccuracyParams(LONG packetHandle, struct SensorDataSharingMessageCommon_PositionalAccuracy value, char oldPath[])
{
  char newPath[300];
  int result;

  result = 0;

  snprintf(newPath, elcount(newPath), "%s.%s", oldPath, "semiMajor");
  value.semiMajor = C2xGetTokenInt(packetHandle, "SensorDataSharingMessage", newPath);
  result = CheckLastError("SensorDataSharingMessage", gkFuncRefGet, result);

  snprintf(newPath, elcount(newPath), "%s.%s", oldPath, "semiMinor");
  value.semiMinor = C2xGetTokenInt(packetHandle, "SensorDataSharingMessage", newPath);
  result = CheckLastError("SensorDataSharingMessage", gkFuncRefGet, result);

  snprintf(newPath, elcount(newPath), "%s.%s", oldPath, "orientation");
  value.orientation = C2xGetTokenInt(packetHandle, "SensorDataSharingMessage", newPath);
  result = CheckLastError("SensorDataSharingMessage", gkFuncRefGet, result);

  return result;
}

int SetSensorDataSharingMessageCommon_PositionalAccuracyParams(LONG packetHandle, struct SensorDataSharingMessageCommon_PositionalAccuracy value, char oldPath[])
{
  char newPath[300];
  int result;

  result = 0;

  snprintf(newPath, elcount(newPath), "%s.%s", oldPath, "semiMajor");
  C2xSetTokenInt(packetHandle, "SensorDataSharingMessage", newPath, value.semiMajor);
  result = CheckLastError("SensorDataSharingMessage", gkFuncRefGet, result);

  snprintf(newPath, elcount(newPath), "%s.%s", oldPath, "semiMinor");
  C2xSetTokenInt(packetHandle, "SensorDataSharingMessage", newPath, value.semiMinor);
  result = CheckLastError("SensorDataSharingMessage", gkFuncRefGet, result);

  snprintf(newPath, elcount(newPath), "%s.%s", oldPath, "orientation");
  C2xSetTokenInt(packetHandle, "SensorDataSharingMessage", newPath, value.orientation);
  result = CheckLastError("SensorDataSharingMessage", gkFuncRefGet, result);

  return result;
}

int GetSensorDataSharingMessagePositionOffsetXYZParams(LONG packetHandle, struct SensorDataSharingMessagePositionOffsetXYZ value, char oldPath[])
{
  char newPath[300];
  int result;

  result = 0;

  snprintf(newPath, elcount(newPath), "%s.%s", oldPath, "offsetX");
  value.offsetX = C2xGetTokenInt(packetHandle, "SensorDataSharingMessage", newPath);
  result = CheckLastError("SensorDataSharingMessage", gkFuncRefGet, result);

  snprintf(newPath, elcount(newPath), "%s.%s", oldPath, "offsetY");
  value.offsetY = C2xGetTokenInt(packetHandle, "SensorDataSharingMessage", newPath);
  result = CheckLastError("SensorDataSharingMessage", gkFuncRefGet, result);

  snprintf(newPath, elcount(newPath), "%s.%s", oldPath, "offsetZ");
  value.offsetZ.isValidFlag = C2xIsTokenAvailable(packetHandle, "SensorDataSharingMessage", newPath);
  if(value.offsetZ.isValidFlag==1)
  {
    value.offsetZ.value = C2xGetTokenInt(packetHandle, "SensorDataSharingMessage", newPath);
    result = CheckLastError("SensorDataSharingMessage", gkFuncRefGet, result);
  }
  return result;
}

int SetSensorDataSharingMessagePositionOffsetXYZParams(LONG packetHandle, struct SensorDataSharingMessagePositionOffsetXYZ value, char oldPath[])
{
  char newPath[300];
  int result;

  result = 0;

  snprintf(newPath, elcount(newPath), "%s.%s", oldPath, "offsetX");
  C2xSetTokenInt(packetHandle, "SensorDataSharingMessage", newPath, value.offsetX);
  result = CheckLastError("SensorDataSharingMessage", gkFuncRefGet, result);

  snprintf(newPath, elcount(newPath), "%s.%s", oldPath, "offsetY");
  C2xSetTokenInt(packetHandle, "SensorDataSharingMessage", newPath, value.offsetY);
  result = CheckLastError("SensorDataSharingMessage", gkFuncRefGet, result);

  snprintf(newPath, elcount(newPath), "%s.%s", oldPath, "offsetZ");
  if(value.offsetZ.isValidFlag==1)
  {
    C2xSetTokenInt(packetHandle, "SensorDataSharingMessage", newPath, value.offsetZ.value);
    result = CheckLastError("SensorDataSharingMessage", gkFuncRefGet, result);
  }
  else
  {
    if( C2xIsTokenAvailable(packetHandle, "SensorDataSharingMessage", newPath) )
    {
      C2xRemoveToken(packetHandle, "SensorDataSharingMessage", newPath);
    }
  }

  return result;
}

int GetSensorDataSharingMessageCommon_PositionConfidenceSetParams(LONG packetHandle, struct SensorDataSharingMessageCommon_PositionConfidenceSet value, char oldPath[])
{
  char newPath[300];
  int result;

  result = 0;

  snprintf(newPath, elcount(newPath), "%s.%s", oldPath, "pos");
  value.pos = C2xGetTokenInt(packetHandle, "SensorDataSharingMessage", newPath);
  result = CheckLastError("SensorDataSharingMessage", gkFuncRefGet, result);

  snprintf(newPath, elcount(newPath), "%s.%s", oldPath, "elevation");
  value.elevation = C2xGetTokenInt(packetHandle, "SensorDataSharingMessage", newPath);
  result = CheckLastError("SensorDataSharingMessage", gkFuncRefGet, result);

  return result;
}

int SetSensorDataSharingMessageCommon_PositionConfidenceSetParams(LONG packetHandle, struct SensorDataSharingMessageCommon_PositionConfidenceSet value, char oldPath[])
{
  char newPath[300];
  int result;

  result = 0;

  snprintf(newPath, elcount(newPath), "%s.%s", oldPath, "pos");
  C2xSetTokenInt(packetHandle, "SensorDataSharingMessage", newPath, value.pos);
  result = CheckLastError("SensorDataSharingMessage", gkFuncRefGet, result);

  snprintf(newPath, elcount(newPath), "%s.%s", oldPath, "elevation");
  C2xSetTokenInt(packetHandle, "SensorDataSharingMessage", newPath, value.elevation);
  result = CheckLastError("SensorDataSharingMessage", gkFuncRefGet, result);

  return result;
}

int GetSensorDataSharingMessageCommon_AccelerationSet4WayParams(LONG packetHandle, struct SensorDataSharingMessageCommon_AccelerationSet4Way value, char oldPath[])
{
  char newPath[300];
  int result;

  result = 0;

  snprintf(newPath, elcount(newPath), "%s.%s", oldPath, "lon");
  value.lon = C2xGetTokenInt(packetHandle, "SensorDataSharingMessage", newPath);
  result = CheckLastError("SensorDataSharingMessage", gkFuncRefGet, result);

  snprintf(newPath, elcount(newPath), "%s.%s", oldPath, "lat");
  value.lat = C2xGetTokenInt(packetHandle, "SensorDataSharingMessage", newPath);
  result = CheckLastError("SensorDataSharingMessage", gkFuncRefGet, result);

  snprintf(newPath, elcount(newPath), "%s.%s", oldPath, "vert");
  value.vert = C2xGetTokenInt(packetHandle, "SensorDataSharingMessage", newPath);
  result = CheckLastError("SensorDataSharingMessage", gkFuncRefGet, result);

  snprintf(newPath, elcount(newPath), "%s.%s", oldPath, "yaw");
  value.yaw = C2xGetTokenInt(packetHandle, "SensorDataSharingMessage", newPath);
  result = CheckLastError("SensorDataSharingMessage", gkFuncRefGet, result);

  return result;
}

int SetSensorDataSharingMessageCommon_AccelerationSet4WayParams(LONG packetHandle, struct SensorDataSharingMessageCommon_AccelerationSet4Way value, char oldPath[])
{
  char newPath[300];
  int result;

  result = 0;

  snprintf(newPath, elcount(newPath), "%s.%s", oldPath, "lon");
  C2xSetTokenInt(packetHandle, "SensorDataSharingMessage", newPath, value.lon);
  result = CheckLastError("SensorDataSharingMessage", gkFuncRefGet, result);

  snprintf(newPath, elcount(newPath), "%s.%s", oldPath, "lat");
  C2xSetTokenInt(packetHandle, "SensorDataSharingMessage", newPath, value.lat);
  result = CheckLastError("SensorDataSharingMessage", gkFuncRefGet, result);

  snprintf(newPath, elcount(newPath), "%s.%s", oldPath, "vert");
  C2xSetTokenInt(packetHandle, "SensorDataSharingMessage", newPath, value.vert);
  result = CheckLastError("SensorDataSharingMessage", gkFuncRefGet, result);

  snprintf(newPath, elcount(newPath), "%s.%s", oldPath, "yaw");
  C2xSetTokenInt(packetHandle, "SensorDataSharingMessage", newPath, value.yaw);
  result = CheckLastError("SensorDataSharingMessage", gkFuncRefGet, result);

  return result;
}

int GetSensorDataSharingMessageDetectedObjectCommonDataParams(LONG packetHandle, struct SensorDataSharingMessageDetectedObjectCommonData value, char oldPath[])
{
  char newPath[300];
  int result;

  result = 0;

  snprintf(newPath, elcount(newPath), "%s.%s", oldPath, "objType");
  value.objType = C2xGetTokenInt(packetHandle, "SensorDataSharingMessage", newPath);
  result = CheckLastError("SensorDataSharingMessage", gkFuncRefGet, result);

  snprintf(newPath, elcount(newPath), "%s.%s", oldPath, "objTypeCfd");
  value.objTypeCfd = C2xGetTokenInt(packetHandle, "SensorDataSharingMessage", newPath);
  result = CheckLastError("SensorDataSharingMessage", gkFuncRefGet, result);

  snprintf(newPath, elcount(newPath), "%s.%s", oldPath, "objectID");
  value.objectID = C2xGetTokenInt(packetHandle, "SensorDataSharingMessage", newPath);
  result = CheckLastError("SensorDataSharingMessage", gkFuncRefGet, result);

  snprintf(newPath, elcount(newPath), "%s.%s", oldPath, "measurementTime");
  value.measurementTime = C2xGetTokenInt(packetHandle, "SensorDataSharingMessage", newPath);
  result = CheckLastError("SensorDataSharingMessage", gkFuncRefGet, result);

  snprintf(newPath, elcount(newPath), "%s.%s", oldPath, "timeConfidence");
  value.timeConfidence = C2xGetTokenInt(packetHandle, "SensorDataSharingMessage", newPath);
  result = CheckLastError("SensorDataSharingMessage", gkFuncRefGet, result);

  snprintf(newPath, elcount(newPath), "%s.%s", oldPath, "pos");
  GetSensorDataSharingMessagePositionOffsetXYZParams(packetHandle, value.pos, newPath);
  result = CheckLastError("SensorDataSharingMessage", gkFuncRefGet, result);

  snprintf(newPath, elcount(newPath), "%s.%s", oldPath, "posConfidence");
  GetSensorDataSharingMessageCommon_PositionConfidenceSetParams(packetHandle, value.posConfidence, newPath);
  result = CheckLastError("SensorDataSharingMessage", gkFuncRefGet, result);

  snprintf(newPath, elcount(newPath), "%s.%s", oldPath, "speed");
  value.speed = C2xGetTokenInt(packetHandle, "SensorDataSharingMessage", newPath);
  result = CheckLastError("SensorDataSharingMessage", gkFuncRefGet, result);

  snprintf(newPath, elcount(newPath), "%s.%s", oldPath, "speedConfidence");
  value.speedConfidence = C2xGetTokenInt(packetHandle, "SensorDataSharingMessage", newPath);
  result = CheckLastError("SensorDataSharingMessage", gkFuncRefGet, result);

  snprintf(newPath, elcount(newPath), "%s.%s", oldPath, "speedZ");
  value.speedZ.isValidFlag = C2xIsTokenAvailable(packetHandle, "SensorDataSharingMessage", newPath);
  if(value.speedZ.isValidFlag==1)
  {
    value.speedZ.value = C2xGetTokenInt(packetHandle, "SensorDataSharingMessage", newPath);
    result = CheckLastError("SensorDataSharingMessage", gkFuncRefGet, result);
  }
  snprintf(newPath, elcount(newPath), "%s.%s", oldPath, "speedConfidenceZ");
  value.speedConfidenceZ.isValidFlag = C2xIsTokenAvailable(packetHandle, "SensorDataSharingMessage", newPath);
  if(value.speedConfidenceZ.isValidFlag==1)
  {
    value.speedConfidenceZ.value = C2xGetTokenInt(packetHandle, "SensorDataSharingMessage", newPath);
    result = CheckLastError("SensorDataSharingMessage", gkFuncRefGet, result);
  }
  snprintf(newPath, elcount(newPath), "%s.%s", oldPath, "heading");
  value.heading = C2xGetTokenInt(packetHandle, "SensorDataSharingMessage", newPath);
  result = CheckLastError("SensorDataSharingMessage", gkFuncRefGet, result);

  snprintf(newPath, elcount(newPath), "%s.%s", oldPath, "headingConf");
  value.headingConf = C2xGetTokenInt(packetHandle, "SensorDataSharingMessage", newPath);
  result = CheckLastError("SensorDataSharingMessage", gkFuncRefGet, result);

  snprintf(newPath, elcount(newPath), "%s.%s", oldPath, "accel4way");
  value.accel4way.isValidFlag = C2xIsTokenAvailable(packetHandle, "SensorDataSharingMessage", newPath);
  if(value.accel4way.isValidFlag==1)
  {
    GetSensorDataSharingMessageCommon_AccelerationSet4WayParams(packetHandle, value.accel4way, newPath);
    result = CheckLastError("SensorDataSharingMessage", gkFuncRefGet, result);
  }
  snprintf(newPath, elcount(newPath), "%s.%s", oldPath, "accCfdX");
  value.accCfdX.isValidFlag = C2xIsTokenAvailable(packetHandle, "SensorDataSharingMessage", newPath);
  if(value.accCfdX.isValidFlag==1)
  {
    value.accCfdX.value = C2xGetTokenInt(packetHandle, "SensorDataSharingMessage", newPath);
    result = CheckLastError("SensorDataSharingMessage", gkFuncRefGet, result);
  }
  snprintf(newPath, elcount(newPath), "%s.%s", oldPath, "accCfdY");
  value.accCfdY.isValidFlag = C2xIsTokenAvailable(packetHandle, "SensorDataSharingMessage", newPath);
  if(value.accCfdY.isValidFlag==1)
  {
    value.accCfdY.value = C2xGetTokenInt(packetHandle, "SensorDataSharingMessage", newPath);
    result = CheckLastError("SensorDataSharingMessage", gkFuncRefGet, result);
  }
  snprintf(newPath, elcount(newPath), "%s.%s", oldPath, "accCfdZ");
  value.accCfdZ.isValidFlag = C2xIsTokenAvailable(packetHandle, "SensorDataSharingMessage", newPath);
  if(value.accCfdZ.isValidFlag==1)
  {
    value.accCfdZ.value = C2xGetTokenInt(packetHandle, "SensorDataSharingMessage", newPath);
    result = CheckLastError("SensorDataSharingMessage", gkFuncRefGet, result);
  }
  snprintf(newPath, elcount(newPath), "%s.%s", oldPath, "accCfdYaw");
  value.accCfdYaw.isValidFlag = C2xIsTokenAvailable(packetHandle, "SensorDataSharingMessage", newPath);
  if(value.accCfdYaw.isValidFlag==1)
  {
    value.accCfdYaw.value = C2xGetTokenInt(packetHandle, "SensorDataSharingMessage", newPath);
    result = CheckLastError("SensorDataSharingMessage", gkFuncRefGet, result);
  }
  return result;
}

int SetSensorDataSharingMessageDetectedObjectCommonDataParams(LONG packetHandle, struct SensorDataSharingMessageDetectedObjectCommonData value, char oldPath[])
{
  char newPath[300];
  int result;

  result = 0;

  snprintf(newPath, elcount(newPath), "%s.%s", oldPath, "objType");
  C2xSetTokenInt(packetHandle, "SensorDataSharingMessage", newPath, value.objType);
  result = CheckLastError("SensorDataSharingMessage", gkFuncRefGet, result);

  snprintf(newPath, elcount(newPath), "%s.%s", oldPath, "objTypeCfd");
  C2xSetTokenInt(packetHandle, "SensorDataSharingMessage", newPath, value.objTypeCfd);
  result = CheckLastError("SensorDataSharingMessage", gkFuncRefGet, result);

  snprintf(newPath, elcount(newPath), "%s.%s", oldPath, "objectID");
  C2xSetTokenInt(packetHandle, "SensorDataSharingMessage", newPath, value.objectID);
  result = CheckLastError("SensorDataSharingMessage", gkFuncRefGet, result);

  snprintf(newPath, elcount(newPath), "%s.%s", oldPath, "measurementTime");
  C2xSetTokenInt(packetHandle, "SensorDataSharingMessage", newPath, value.measurementTime);
  result = CheckLastError("SensorDataSharingMessage", gkFuncRefGet, result);

  snprintf(newPath, elcount(newPath), "%s.%s", oldPath, "timeConfidence");
  C2xSetTokenInt(packetHandle, "SensorDataSharingMessage", newPath, value.timeConfidence);
  result = CheckLastError("SensorDataSharingMessage", gkFuncRefGet, result);

  snprintf(newPath, elcount(newPath), "%s.%s", oldPath, "pos");
  SetSensorDataSharingMessagePositionOffsetXYZParams(packetHandle, value.pos, newPath);
  result = CheckLastError("SensorDataSharingMessage", gkFuncRefGet, result);

  snprintf(newPath, elcount(newPath), "%s.%s", oldPath, "posConfidence");
  SetSensorDataSharingMessageCommon_PositionConfidenceSetParams(packetHandle, value.posConfidence, newPath);
  result = CheckLastError("SensorDataSharingMessage", gkFuncRefGet, result);

  snprintf(newPath, elcount(newPath), "%s.%s", oldPath, "speed");
  C2xSetTokenInt(packetHandle, "SensorDataSharingMessage", newPath, value.speed);
  result = CheckLastError("SensorDataSharingMessage", gkFuncRefGet, result);

  snprintf(newPath, elcount(newPath), "%s.%s", oldPath, "speedConfidence");
  C2xSetTokenInt(packetHandle, "SensorDataSharingMessage", newPath, value.speedConfidence);
  result = CheckLastError("SensorDataSharingMessage", gkFuncRefGet, result);

  snprintf(newPath, elcount(newPath), "%s.%s", oldPath, "speedZ");
  if(value.speedZ.isValidFlag==1)
  {
    C2xSetTokenInt(packetHandle, "SensorDataSharingMessage", newPath, value.speedZ.value);
    result = CheckLastError("SensorDataSharingMessage", gkFuncRefGet, result);
  }
  else
  {
    if( C2xIsTokenAvailable(packetHandle, "SensorDataSharingMessage", newPath) )
    {
      C2xRemoveToken(packetHandle, "SensorDataSharingMessage", newPath);
    }
  }

  snprintf(newPath, elcount(newPath), "%s.%s", oldPath, "speedConfidenceZ");
  if(value.speedConfidenceZ.isValidFlag==1)
  {
    C2xSetTokenInt(packetHandle, "SensorDataSharingMessage", newPath, value.speedConfidenceZ.value);
    result = CheckLastError("SensorDataSharingMessage", gkFuncRefGet, result);
  }
  else
  {
    if( C2xIsTokenAvailable(packetHandle, "SensorDataSharingMessage", newPath) )
    {
      C2xRemoveToken(packetHandle, "SensorDataSharingMessage", newPath);
    }
  }

  snprintf(newPath, elcount(newPath), "%s.%s", oldPath, "heading");
  C2xSetTokenInt(packetHandle, "SensorDataSharingMessage", newPath, value.heading);
  result = CheckLastError("SensorDataSharingMessage", gkFuncRefGet, result);

  snprintf(newPath, elcount(newPath), "%s.%s", oldPath, "headingConf");
  C2xSetTokenInt(packetHandle, "SensorDataSharingMessage", newPath, value.headingConf);
  result = CheckLastError("SensorDataSharingMessage", gkFuncRefGet, result);

  snprintf(newPath, elcount(newPath), "%s.%s", oldPath, "accel4way");
  if(value.accel4way.isValidFlag==1)
  {
    SetSensorDataSharingMessageCommon_AccelerationSet4WayParams(packetHandle, value.accel4way, newPath);
    result = CheckLastError("SensorDataSharingMessage", gkFuncRefGet, result);
  }
  else
  {
    if( C2xIsTokenAvailable(packetHandle, "SensorDataSharingMessage", newPath) )
    {
      C2xRemoveToken(packetHandle, "SensorDataSharingMessage", newPath);
    }
  }

  snprintf(newPath, elcount(newPath), "%s.%s", oldPath, "accCfdX");
  if(value.accCfdX.isValidFlag==1)
  {
    C2xSetTokenInt(packetHandle, "SensorDataSharingMessage", newPath, value.accCfdX.value);
    result = CheckLastError("SensorDataSharingMessage", gkFuncRefGet, result);
  }
  else
  {
    if( C2xIsTokenAvailable(packetHandle, "SensorDataSharingMessage", newPath) )
    {
      C2xRemoveToken(packetHandle, "SensorDataSharingMessage", newPath);
    }
  }

  snprintf(newPath, elcount(newPath), "%s.%s", oldPath, "accCfdY");
  if(value.accCfdY.isValidFlag==1)
  {
    C2xSetTokenInt(packetHandle, "SensorDataSharingMessage", newPath, value.accCfdY.value);
    result = CheckLastError("SensorDataSharingMessage", gkFuncRefGet, result);
  }
  else
  {
    if( C2xIsTokenAvailable(packetHandle, "SensorDataSharingMessage", newPath) )
    {
      C2xRemoveToken(packetHandle, "SensorDataSharingMessage", newPath);
    }
  }

  snprintf(newPath, elcount(newPath), "%s.%s", oldPath, "accCfdZ");
  if(value.accCfdZ.isValidFlag==1)
  {
    C2xSetTokenInt(packetHandle, "SensorDataSharingMessage", newPath, value.accCfdZ.value);
    result = CheckLastError("SensorDataSharingMessage", gkFuncRefGet, result);
  }
  else
  {
    if( C2xIsTokenAvailable(packetHandle, "SensorDataSharingMessage", newPath) )
    {
      C2xRemoveToken(packetHandle, "SensorDataSharingMessage", newPath);
    }
  }

  snprintf(newPath, elcount(newPath), "%s.%s", oldPath, "accCfdYaw");
  if(value.accCfdYaw.isValidFlag==1)
  {
    C2xSetTokenInt(packetHandle, "SensorDataSharingMessage", newPath, value.accCfdYaw.value);
    result = CheckLastError("SensorDataSharingMessage", gkFuncRefGet, result);
  }
  else
  {
    if( C2xIsTokenAvailable(packetHandle, "SensorDataSharingMessage", newPath) )
    {
      C2xRemoveToken(packetHandle, "SensorDataSharingMessage", newPath);
    }
  }

  return result;
}

int GetSensorDataSharingMessageAttitudeParams(LONG packetHandle, struct SensorDataSharingMessageAttitude value, char oldPath[])
{
  char newPath[300];
  int result;

  result = 0;

  snprintf(newPath, elcount(newPath), "%s.%s", oldPath, "pitch");
  value.pitch = C2xGetTokenInt(packetHandle, "SensorDataSharingMessage", newPath);
  result = CheckLastError("SensorDataSharingMessage", gkFuncRefGet, result);

  snprintf(newPath, elcount(newPath), "%s.%s", oldPath, "roll");
  value.roll = C2xGetTokenInt(packetHandle, "SensorDataSharingMessage", newPath);
  result = CheckLastError("SensorDataSharingMessage", gkFuncRefGet, result);

  snprintf(newPath, elcount(newPath), "%s.%s", oldPath, "yaw");
  value.yaw = C2xGetTokenInt(packetHandle, "SensorDataSharingMessage", newPath);
  result = CheckLastError("SensorDataSharingMessage", gkFuncRefGet, result);

  return result;
}

int SetSensorDataSharingMessageAttitudeParams(LONG packetHandle, struct SensorDataSharingMessageAttitude value, char oldPath[])
{
  char newPath[300];
  int result;

  result = 0;

  snprintf(newPath, elcount(newPath), "%s.%s", oldPath, "pitch");
  C2xSetTokenInt(packetHandle, "SensorDataSharingMessage", newPath, value.pitch);
  result = CheckLastError("SensorDataSharingMessage", gkFuncRefGet, result);

  snprintf(newPath, elcount(newPath), "%s.%s", oldPath, "roll");
  C2xSetTokenInt(packetHandle, "SensorDataSharingMessage", newPath, value.roll);
  result = CheckLastError("SensorDataSharingMessage", gkFuncRefGet, result);

  snprintf(newPath, elcount(newPath), "%s.%s", oldPath, "yaw");
  C2xSetTokenInt(packetHandle, "SensorDataSharingMessage", newPath, value.yaw);
  result = CheckLastError("SensorDataSharingMessage", gkFuncRefGet, result);

  return result;
}

int GetSensorDataSharingMessageAttitudeConfidenceParams(LONG packetHandle, struct SensorDataSharingMessageAttitudeConfidence value, char oldPath[])
{
  char newPath[300];
  int result;

  result = 0;

  snprintf(newPath, elcount(newPath), "%s.%s", oldPath, "pitchConfidence");
  value.pitchConfidence = C2xGetTokenInt(packetHandle, "SensorDataSharingMessage", newPath);
  result = CheckLastError("SensorDataSharingMessage", gkFuncRefGet, result);

  snprintf(newPath, elcount(newPath), "%s.%s", oldPath, "rollConfidence");
  value.rollConfidence = C2xGetTokenInt(packetHandle, "SensorDataSharingMessage", newPath);
  result = CheckLastError("SensorDataSharingMessage", gkFuncRefGet, result);

  snprintf(newPath, elcount(newPath), "%s.%s", oldPath, "yawConfidence");
  value.yawConfidence = C2xGetTokenInt(packetHandle, "SensorDataSharingMessage", newPath);
  result = CheckLastError("SensorDataSharingMessage", gkFuncRefGet, result);

  return result;
}

int SetSensorDataSharingMessageAttitudeConfidenceParams(LONG packetHandle, struct SensorDataSharingMessageAttitudeConfidence value, char oldPath[])
{
  char newPath[300];
  int result;

  result = 0;

  snprintf(newPath, elcount(newPath), "%s.%s", oldPath, "pitchConfidence");
  C2xSetTokenInt(packetHandle, "SensorDataSharingMessage", newPath, value.pitchConfidence);
  result = CheckLastError("SensorDataSharingMessage", gkFuncRefGet, result);

  snprintf(newPath, elcount(newPath), "%s.%s", oldPath, "rollConfidence");
  C2xSetTokenInt(packetHandle, "SensorDataSharingMessage", newPath, value.rollConfidence);
  result = CheckLastError("SensorDataSharingMessage", gkFuncRefGet, result);

  snprintf(newPath, elcount(newPath), "%s.%s", oldPath, "yawConfidence");
  C2xSetTokenInt(packetHandle, "SensorDataSharingMessage", newPath, value.yawConfidence);
  result = CheckLastError("SensorDataSharingMessage", gkFuncRefGet, result);

  return result;
}

int GetSensorDataSharingMessageAngularVelocityParams(LONG packetHandle, struct SensorDataSharingMessageAngularVelocity value, char oldPath[])
{
  char newPath[300];
  int result;

  result = 0;

  snprintf(newPath, elcount(newPath), "%s.%s", oldPath, "pitchRate");
  value.pitchRate = C2xGetTokenInt(packetHandle, "SensorDataSharingMessage", newPath);
  result = CheckLastError("SensorDataSharingMessage", gkFuncRefGet, result);

  snprintf(newPath, elcount(newPath), "%s.%s", oldPath, "rollRate");
  value.rollRate = C2xGetTokenInt(packetHandle, "SensorDataSharingMessage", newPath);
  result = CheckLastError("SensorDataSharingMessage", gkFuncRefGet, result);

  return result;
}

int SetSensorDataSharingMessageAngularVelocityParams(LONG packetHandle, struct SensorDataSharingMessageAngularVelocity value, char oldPath[])
{
  char newPath[300];
  int result;

  result = 0;

  snprintf(newPath, elcount(newPath), "%s.%s", oldPath, "pitchRate");
  C2xSetTokenInt(packetHandle, "SensorDataSharingMessage", newPath, value.pitchRate);
  result = CheckLastError("SensorDataSharingMessage", gkFuncRefGet, result);

  snprintf(newPath, elcount(newPath), "%s.%s", oldPath, "rollRate");
  C2xSetTokenInt(packetHandle, "SensorDataSharingMessage", newPath, value.rollRate);
  result = CheckLastError("SensorDataSharingMessage", gkFuncRefGet, result);

  return result;
}

int GetSensorDataSharingMessageAngularVelocityConfidenceParams(LONG packetHandle, struct SensorDataSharingMessageAngularVelocityConfidence value, char oldPath[])
{
  char newPath[300];
  int result;

  result = 0;

  snprintf(newPath, elcount(newPath), "%s.%s", oldPath, "pitchRateConfidence");
  value.pitchRateConfidence.isValidFlag = C2xIsTokenAvailable(packetHandle, "SensorDataSharingMessage", newPath);
  if(value.pitchRateConfidence.isValidFlag==1)
  {
    value.pitchRateConfidence.value = C2xGetTokenInt(packetHandle, "SensorDataSharingMessage", newPath);
    result = CheckLastError("SensorDataSharingMessage", gkFuncRefGet, result);
  }
  snprintf(newPath, elcount(newPath), "%s.%s", oldPath, "rollRateConfidence");
  value.rollRateConfidence.isValidFlag = C2xIsTokenAvailable(packetHandle, "SensorDataSharingMessage", newPath);
  if(value.rollRateConfidence.isValidFlag==1)
  {
    value.rollRateConfidence.value = C2xGetTokenInt(packetHandle, "SensorDataSharingMessage", newPath);
    result = CheckLastError("SensorDataSharingMessage", gkFuncRefGet, result);
  }
  return result;
}

int SetSensorDataSharingMessageAngularVelocityConfidenceParams(LONG packetHandle, struct SensorDataSharingMessageAngularVelocityConfidence value, char oldPath[])
{
  char newPath[300];
  int result;

  result = 0;

  snprintf(newPath, elcount(newPath), "%s.%s", oldPath, "pitchRateConfidence");
  if(value.pitchRateConfidence.isValidFlag==1)
  {
    C2xSetTokenInt(packetHandle, "SensorDataSharingMessage", newPath, value.pitchRateConfidence.value);
    result = CheckLastError("SensorDataSharingMessage", gkFuncRefGet, result);
  }
  else
  {
    if( C2xIsTokenAvailable(packetHandle, "SensorDataSharingMessage", newPath) )
    {
      C2xRemoveToken(packetHandle, "SensorDataSharingMessage", newPath);
    }
  }

  snprintf(newPath, elcount(newPath), "%s.%s", oldPath, "rollRateConfidence");
  if(value.rollRateConfidence.isValidFlag==1)
  {
    C2xSetTokenInt(packetHandle, "SensorDataSharingMessage", newPath, value.rollRateConfidence.value);
    result = CheckLastError("SensorDataSharingMessage", gkFuncRefGet, result);
  }
  else
  {
    if( C2xIsTokenAvailable(packetHandle, "SensorDataSharingMessage", newPath) )
    {
      C2xRemoveToken(packetHandle, "SensorDataSharingMessage", newPath);
    }
  }

  return result;
}

int GetSensorDataSharingMessageCommon_VehicleSizeParams(LONG packetHandle, struct SensorDataSharingMessageCommon_VehicleSize value, char oldPath[])
{
  char newPath[300];
  int result;

  result = 0;

  snprintf(newPath, elcount(newPath), "%s.%s", oldPath, "width");
  value.width = C2xGetTokenInt(packetHandle, "SensorDataSharingMessage", newPath);
  result = CheckLastError("SensorDataSharingMessage", gkFuncRefGet, result);

  snprintf(newPath, elcount(newPath), "%s.%s", oldPath, "length");
  value.length = C2xGetTokenInt(packetHandle, "SensorDataSharingMessage", newPath);
  result = CheckLastError("SensorDataSharingMessage", gkFuncRefGet, result);

  return result;
}

int SetSensorDataSharingMessageCommon_VehicleSizeParams(LONG packetHandle, struct SensorDataSharingMessageCommon_VehicleSize value, char oldPath[])
{
  char newPath[300];
  int result;

  result = 0;

  snprintf(newPath, elcount(newPath), "%s.%s", oldPath, "width");
  C2xSetTokenInt(packetHandle, "SensorDataSharingMessage", newPath, value.width);
  result = CheckLastError("SensorDataSharingMessage", gkFuncRefGet, result);

  snprintf(newPath, elcount(newPath), "%s.%s", oldPath, "length");
  C2xSetTokenInt(packetHandle, "SensorDataSharingMessage", newPath, value.length);
  result = CheckLastError("SensorDataSharingMessage", gkFuncRefGet, result);

  return result;
}

int GetSensorDataSharingMessageVehicleSizeConfidenceParams(LONG packetHandle, struct SensorDataSharingMessageVehicleSizeConfidence value, char oldPath[])
{
  char newPath[300];
  int result;

  result = 0;

  snprintf(newPath, elcount(newPath), "%s.%s", oldPath, "vehicleWidthConfidence");
  value.vehicleWidthConfidence = C2xGetTokenInt(packetHandle, "SensorDataSharingMessage", newPath);
  result = CheckLastError("SensorDataSharingMessage", gkFuncRefGet, result);

  snprintf(newPath, elcount(newPath), "%s.%s", oldPath, "vehicleLengthConfidence");
  value.vehicleLengthConfidence = C2xGetTokenInt(packetHandle, "SensorDataSharingMessage", newPath);
  result = CheckLastError("SensorDataSharingMessage", gkFuncRefGet, result);

  snprintf(newPath, elcount(newPath), "%s.%s", oldPath, "vehicleHeightConfidence");
  value.vehicleHeightConfidence.isValidFlag = C2xIsTokenAvailable(packetHandle, "SensorDataSharingMessage", newPath);
  if(value.vehicleHeightConfidence.isValidFlag==1)
  {
    value.vehicleHeightConfidence.value = C2xGetTokenInt(packetHandle, "SensorDataSharingMessage", newPath);
    result = CheckLastError("SensorDataSharingMessage", gkFuncRefGet, result);
  }
  return result;
}

int SetSensorDataSharingMessageVehicleSizeConfidenceParams(LONG packetHandle, struct SensorDataSharingMessageVehicleSizeConfidence value, char oldPath[])
{
  char newPath[300];
  int result;

  result = 0;

  snprintf(newPath, elcount(newPath), "%s.%s", oldPath, "vehicleWidthConfidence");
  C2xSetTokenInt(packetHandle, "SensorDataSharingMessage", newPath, value.vehicleWidthConfidence);
  result = CheckLastError("SensorDataSharingMessage", gkFuncRefGet, result);

  snprintf(newPath, elcount(newPath), "%s.%s", oldPath, "vehicleLengthConfidence");
  C2xSetTokenInt(packetHandle, "SensorDataSharingMessage", newPath, value.vehicleLengthConfidence);
  result = CheckLastError("SensorDataSharingMessage", gkFuncRefGet, result);

  snprintf(newPath, elcount(newPath), "%s.%s", oldPath, "vehicleHeightConfidence");
  if(value.vehicleHeightConfidence.isValidFlag==1)
  {
    C2xSetTokenInt(packetHandle, "SensorDataSharingMessage", newPath, value.vehicleHeightConfidence.value);
    result = CheckLastError("SensorDataSharingMessage", gkFuncRefGet, result);
  }
  else
  {
    if( C2xIsTokenAvailable(packetHandle, "SensorDataSharingMessage", newPath) )
    {
      C2xRemoveToken(packetHandle, "SensorDataSharingMessage", newPath);
    }
  }

  return result;
}

int GetSensorDataSharingMessageDetectedVehicleDataParams(LONG packetHandle, struct SensorDataSharingMessageDetectedVehicleData value, char oldPath[])
{
  char newPath[300]; 
  int j; 
  int k;
  int result;

  result = 0;

  snprintf(newPath, elcount(newPath), "%s.%s", oldPath, "lights");
  value.lights.isValidFlag = C2xIsTokenAvailable(packetHandle, "SensorDataSharingMessage", newPath);
  if(value.lights.isValidFlag==1)
  {
    value.lights.isValidFlag = 1;
    value.lights.stringLength = C2xGetTokenLengthBit(packetHandle, "SensorDataSharingMessage", newPath);
    if ((result = CheckLastError("SensorDataSharingMessage", gkFuncRefGet, result))==0)
    {
      if(value.lights.stringLength > 0)
      {
        for(j=0; j<value.lights.stringLength; j++)
        {
          if(C2xGetTokenBitOfBitString(packetHandle, "SensorDataSharingMessage", newPath, j) == 0)
          {
            value.lights.string[j] = '0';
          }
          else if(C2xGetTokenBitOfBitString(packetHandle, "SensorDataSharingMessage", newPath, j) == 1)
          {
            value.lights.string[j] = '1';
          }

          if(value.lights.stringLength == 1)
          {
            value.lights.string[1] = '0';
          }
          result = CheckLastError("SensorDataSharingMessage", gkFuncRefGet, result);
        }
      }
      else
      {
        for(k = value.lights.stringLength+1; k > -1; k--)
        {
          if(value.lights.string[k] == '1')
          {
            value.lights.string[k] = '0';
          }
        }
      }
    }

  }
  snprintf(newPath, elcount(newPath), "%s.%s", oldPath, "vehAttitude");
  value.vehAttitude.isValidFlag = C2xIsTokenAvailable(packetHandle, "SensorDataSharingMessage", newPath);
  if(value.vehAttitude.isValidFlag==1)
  {
    GetSensorDataSharingMessageAttitudeParams(packetHandle, value.vehAttitude, newPath);
    result = CheckLastError("SensorDataSharingMessage", gkFuncRefGet, result);
  }
  snprintf(newPath, elcount(newPath), "%s.%s", oldPath, "vehAttitudeConfidence");
  value.vehAttitudeConfidence.isValidFlag = C2xIsTokenAvailable(packetHandle, "SensorDataSharingMessage", newPath);
  if(value.vehAttitudeConfidence.isValidFlag==1)
  {
    GetSensorDataSharingMessageAttitudeConfidenceParams(packetHandle, value.vehAttitudeConfidence, newPath);
    result = CheckLastError("SensorDataSharingMessage", gkFuncRefGet, result);
  }
  snprintf(newPath, elcount(newPath), "%s.%s", oldPath, "vehAngVel");
  value.vehAngVel.isValidFlag = C2xIsTokenAvailable(packetHandle, "SensorDataSharingMessage", newPath);
  if(value.vehAngVel.isValidFlag==1)
  {
    GetSensorDataSharingMessageAngularVelocityParams(packetHandle, value.vehAngVel, newPath);
    result = CheckLastError("SensorDataSharingMessage", gkFuncRefGet, result);
  }
  snprintf(newPath, elcount(newPath), "%s.%s", oldPath, "vehAngVelConfidence");
  value.vehAngVelConfidence.isValidFlag = C2xIsTokenAvailable(packetHandle, "SensorDataSharingMessage", newPath);
  if(value.vehAngVelConfidence.isValidFlag==1)
  {
    GetSensorDataSharingMessageAngularVelocityConfidenceParams(packetHandle, value.vehAngVelConfidence, newPath);
    result = CheckLastError("SensorDataSharingMessage", gkFuncRefGet, result);
  }
  snprintf(newPath, elcount(newPath), "%s.%s", oldPath, "size");
  value.size.isValidFlag = C2xIsTokenAvailable(packetHandle, "SensorDataSharingMessage", newPath);
  if(value.size.isValidFlag==1)
  {
    GetSensorDataSharingMessageCommon_VehicleSizeParams(packetHandle, value.size, newPath);
    result = CheckLastError("SensorDataSharingMessage", gkFuncRefGet, result);
  }
  snprintf(newPath, elcount(newPath), "%s.%s", oldPath, "height");
  value.height.isValidFlag = C2xIsTokenAvailable(packetHandle, "SensorDataSharingMessage", newPath);
  if(value.height.isValidFlag==1)
  {
    value.height.value = C2xGetTokenInt(packetHandle, "SensorDataSharingMessage", newPath);
    result = CheckLastError("SensorDataSharingMessage", gkFuncRefGet, result);
  }
  snprintf(newPath, elcount(newPath), "%s.%s", oldPath, "vehicleSizeConfidence");
  value.vehicleSizeConfidence.isValidFlag = C2xIsTokenAvailable(packetHandle, "SensorDataSharingMessage", newPath);
  if(value.vehicleSizeConfidence.isValidFlag==1)
  {
    GetSensorDataSharingMessageVehicleSizeConfidenceParams(packetHandle, value.vehicleSizeConfidence, newPath);
    result = CheckLastError("SensorDataSharingMessage", gkFuncRefGet, result);
  }
  snprintf(newPath, elcount(newPath), "%s.%s", oldPath, "vehicleClass");
  value.vehicleClass.isValidFlag = C2xIsTokenAvailable(packetHandle, "SensorDataSharingMessage", newPath);
  if(value.vehicleClass.isValidFlag==1)
  {
    value.vehicleClass.value = C2xGetTokenInt(packetHandle, "SensorDataSharingMessage", newPath);
    result = CheckLastError("SensorDataSharingMessage", gkFuncRefGet, result);
  }
  snprintf(newPath, elcount(newPath), "%s.%s", oldPath, "classConf");
  value.classConf.isValidFlag = C2xIsTokenAvailable(packetHandle, "SensorDataSharingMessage", newPath);
  if(value.classConf.isValidFlag==1)
  {
    value.classConf.value = C2xGetTokenInt(packetHandle, "SensorDataSharingMessage", newPath);
    result = CheckLastError("SensorDataSharingMessage", gkFuncRefGet, result);
  }
  return result;
}

int SetSensorDataSharingMessageDetectedVehicleDataParams(LONG packetHandle, struct SensorDataSharingMessageDetectedVehicleData value, char oldPath[])
{
  char newPath[300]; 
  int j;
  int result;

  result = 0;

  snprintf(newPath, elcount(newPath), "%s.%s", oldPath, "lights");
  if(value.lights.isValidFlag==1)
  {
      for(j=0; j<value.lights.stringLength; j++)
      {
        if(value.lights.string[j] == '0')
        {
          C2xSetTokenBitOfBitString(packetHandle, "SensorDataSharingMessage", newPath, j, 0);
        }
        else
        {
          C2xSetTokenBitOfBitString(packetHandle, "SensorDataSharingMessage", newPath, j, 1);
        }
        result = CheckLastError("SensorDataSharingMessage", gkFuncRefGet, result);
      }
  }
  else
  {
    if( C2xIsTokenAvailable(packetHandle, "SensorDataSharingMessage", newPath) )
    {
      C2xRemoveToken(packetHandle, "SensorDataSharingMessage", newPath);
    }
  }

  snprintf(newPath, elcount(newPath), "%s.%s", oldPath, "vehAttitude");
  if(value.vehAttitude.isValidFlag==1)
  {
    SetSensorDataSharingMessageAttitudeParams(packetHandle, value.vehAttitude, newPath);
    result = CheckLastError("SensorDataSharingMessage", gkFuncRefGet, result);
  }
  else
  {
    if( C2xIsTokenAvailable(packetHandle, "SensorDataSharingMessage", newPath) )
    {
      C2xRemoveToken(packetHandle, "SensorDataSharingMessage", newPath);
    }
  }

  snprintf(newPath, elcount(newPath), "%s.%s", oldPath, "vehAttitudeConfidence");
  if(value.vehAttitudeConfidence.isValidFlag==1)
  {
    SetSensorDataSharingMessageAttitudeConfidenceParams(packetHandle, value.vehAttitudeConfidence, newPath);
    result = CheckLastError("SensorDataSharingMessage", gkFuncRefGet, result);
  }
  else
  {
    if( C2xIsTokenAvailable(packetHandle, "SensorDataSharingMessage", newPath) )
    {
      C2xRemoveToken(packetHandle, "SensorDataSharingMessage", newPath);
    }
  }

  snprintf(newPath, elcount(newPath), "%s.%s", oldPath, "vehAngVel");
  if(value.vehAngVel.isValidFlag==1)
  {
    SetSensorDataSharingMessageAngularVelocityParams(packetHandle, value.vehAngVel, newPath);
    result = CheckLastError("SensorDataSharingMessage", gkFuncRefGet, result);
  }
  else
  {
    if( C2xIsTokenAvailable(packetHandle, "SensorDataSharingMessage", newPath) )
    {
      C2xRemoveToken(packetHandle, "SensorDataSharingMessage", newPath);
    }
  }

  snprintf(newPath, elcount(newPath), "%s.%s", oldPath, "vehAngVelConfidence");
  if(value.vehAngVelConfidence.isValidFlag==1)
  {
    SetSensorDataSharingMessageAngularVelocityConfidenceParams(packetHandle, value.vehAngVelConfidence, newPath);
    result = CheckLastError("SensorDataSharingMessage", gkFuncRefGet, result);
  }
  else
  {
    if( C2xIsTokenAvailable(packetHandle, "SensorDataSharingMessage", newPath) )
    {
      C2xRemoveToken(packetHandle, "SensorDataSharingMessage", newPath);
    }
  }

  snprintf(newPath, elcount(newPath), "%s.%s", oldPath, "size");
  if(value.size.isValidFlag==1)
  {
    SetSensorDataSharingMessageCommon_VehicleSizeParams(packetHandle, value.size, newPath);
    result = CheckLastError("SensorDataSharingMessage", gkFuncRefGet, result);
  }
  else
  {
    if( C2xIsTokenAvailable(packetHandle, "SensorDataSharingMessage", newPath) )
    {
      C2xRemoveToken(packetHandle, "SensorDataSharingMessage", newPath);
    }
  }

  snprintf(newPath, elcount(newPath), "%s.%s", oldPath, "height");
  if(value.height.isValidFlag==1)
  {
    C2xSetTokenInt(packetHandle, "SensorDataSharingMessage", newPath, value.height.value);
    result = CheckLastError("SensorDataSharingMessage", gkFuncRefGet, result);
  }
  else
  {
    if( C2xIsTokenAvailable(packetHandle, "SensorDataSharingMessage", newPath) )
    {
      C2xRemoveToken(packetHandle, "SensorDataSharingMessage", newPath);
    }
  }

  snprintf(newPath, elcount(newPath), "%s.%s", oldPath, "vehicleSizeConfidence");
  if(value.vehicleSizeConfidence.isValidFlag==1)
  {
    SetSensorDataSharingMessageVehicleSizeConfidenceParams(packetHandle, value.vehicleSizeConfidence, newPath);
    result = CheckLastError("SensorDataSharingMessage", gkFuncRefGet, result);
  }
  else
  {
    if( C2xIsTokenAvailable(packetHandle, "SensorDataSharingMessage", newPath) )
    {
      C2xRemoveToken(packetHandle, "SensorDataSharingMessage", newPath);
    }
  }

  snprintf(newPath, elcount(newPath), "%s.%s", oldPath, "vehicleClass");
  if(value.vehicleClass.isValidFlag==1)
  {
    C2xSetTokenInt(packetHandle, "SensorDataSharingMessage", newPath, value.vehicleClass.value);
    result = CheckLastError("SensorDataSharingMessage", gkFuncRefGet, result);
  }
  else
  {
    if( C2xIsTokenAvailable(packetHandle, "SensorDataSharingMessage", newPath) )
    {
      C2xRemoveToken(packetHandle, "SensorDataSharingMessage", newPath);
    }
  }

  snprintf(newPath, elcount(newPath), "%s.%s", oldPath, "classConf");
  if(value.classConf.isValidFlag==1)
  {
    C2xSetTokenInt(packetHandle, "SensorDataSharingMessage", newPath, value.classConf.value);
    result = CheckLastError("SensorDataSharingMessage", gkFuncRefGet, result);
  }
  else
  {
    if( C2xIsTokenAvailable(packetHandle, "SensorDataSharingMessage", newPath) )
    {
      C2xRemoveToken(packetHandle, "SensorDataSharingMessage", newPath);
    }
  }

  return result;
}

int GetSensorDataSharingMessagePersonalSafetyMessage_PropelledInformationParams(LONG packetHandle, struct SensorDataSharingMessagePersonalSafetyMessage_PropelledInformation value, char oldPath[])
{
  char newPath[300];
  int result;

  result = 0;

  value.choice = C2xGetTokenInt(packetHandle, "SensorDataSharingMessage", oldPath);

  switch(value.choice)
  {
    case 0:
    {
      snprintf(newPath, elcount(newPath), "%s.%s", oldPath, "human");
      value.human = C2xGetTokenInt(packetHandle, "SensorDataSharingMessage", newPath);
      result = CheckLastError("SensorDataSharingMessage", gkFuncRefGet, result);
    }
    break;
    case 1:
    {
      snprintf(newPath, elcount(newPath), "%s.%s", oldPath, "animal");
      value.animal = C2xGetTokenInt(packetHandle, "SensorDataSharingMessage", newPath);
      result = CheckLastError("SensorDataSharingMessage", gkFuncRefGet, result);
    }
    break;
    case 2:
    {
      snprintf(newPath, elcount(newPath), "%s.%s", oldPath, "motor");
      value.motor = C2xGetTokenInt(packetHandle, "SensorDataSharingMessage", newPath);
      result = CheckLastError("SensorDataSharingMessage", gkFuncRefGet, result);
    }
    break;
  }
  return result;
}

int SetSensorDataSharingMessagePersonalSafetyMessage_PropelledInformationParams(LONG packetHandle, struct SensorDataSharingMessagePersonalSafetyMessage_PropelledInformation value, char oldPath[])
{
  char newPath[300];
  int result;

  result = 0;

  switch(value.choice)
  {
    case 0:
    {
      snprintf(newPath, elcount(newPath), "%s.%s", oldPath, "human");
      C2xSetTokenInt(packetHandle, "SensorDataSharingMessage", newPath, value.human);
      result = CheckLastError("SensorDataSharingMessage", gkFuncRefGet, result);
    }
    break;
    case 1:
    {
      snprintf(newPath, elcount(newPath), "%s.%s", oldPath, "animal");
      C2xSetTokenInt(packetHandle, "SensorDataSharingMessage", newPath, value.animal);
      result = CheckLastError("SensorDataSharingMessage", gkFuncRefGet, result);
    }
    break;
    case 2:
    {
      snprintf(newPath, elcount(newPath), "%s.%s", oldPath, "motor");
      C2xSetTokenInt(packetHandle, "SensorDataSharingMessage", newPath, value.motor);
      result = CheckLastError("SensorDataSharingMessage", gkFuncRefGet, result);
    }
    break;
  }
  return result;
}

int GetSensorDataSharingMessageDetectedVRUDataParams(LONG packetHandle, struct SensorDataSharingMessageDetectedVRUData value, char oldPath[])
{
  char newPath[300];
  int result;

  result = 0;

  snprintf(newPath, elcount(newPath), "%s.%s", oldPath, "basicType");
  value.basicType.isValidFlag = C2xIsTokenAvailable(packetHandle, "SensorDataSharingMessage", newPath);
  if(value.basicType.isValidFlag==1)
  {
    value.basicType.value = C2xGetTokenInt(packetHandle, "SensorDataSharingMessage", newPath);
    result = CheckLastError("SensorDataSharingMessage", gkFuncRefGet, result);
  }
  snprintf(newPath, elcount(newPath), "%s.%s", oldPath, "propulsion");
  value.propulsion.isValidFlag = C2xIsTokenAvailable(packetHandle, "SensorDataSharingMessage", newPath);
  if(value.propulsion.isValidFlag==1)
  {
    GetSensorDataSharingMessagePersonalSafetyMessage_PropelledInformationParams(packetHandle, value.propulsion, newPath);
    result = CheckLastError("SensorDataSharingMessage", gkFuncRefGet, result);
  }
  snprintf(newPath, elcount(newPath), "%s.%s", oldPath, "attachment");
  value.attachment.isValidFlag = C2xIsTokenAvailable(packetHandle, "SensorDataSharingMessage", newPath);
  if(value.attachment.isValidFlag==1)
  {
    value.attachment.value = C2xGetTokenInt(packetHandle, "SensorDataSharingMessage", newPath);
    result = CheckLastError("SensorDataSharingMessage", gkFuncRefGet, result);
  }
  snprintf(newPath, elcount(newPath), "%s.%s", oldPath, "radius");
  value.radius.isValidFlag = C2xIsTokenAvailable(packetHandle, "SensorDataSharingMessage", newPath);
  if(value.radius.isValidFlag==1)
  {
    value.radius.value = C2xGetTokenInt(packetHandle, "SensorDataSharingMessage", newPath);
    result = CheckLastError("SensorDataSharingMessage", gkFuncRefGet, result);
  }
  return result;
}

int SetSensorDataSharingMessageDetectedVRUDataParams(LONG packetHandle, struct SensorDataSharingMessageDetectedVRUData value, char oldPath[])
{
  char newPath[300];
  int result;

  result = 0;

  snprintf(newPath, elcount(newPath), "%s.%s", oldPath, "basicType");
  if(value.basicType.isValidFlag==1)
  {
    C2xSetTokenInt(packetHandle, "SensorDataSharingMessage", newPath, value.basicType.value);
    result = CheckLastError("SensorDataSharingMessage", gkFuncRefGet, result);
  }
  else
  {
    if( C2xIsTokenAvailable(packetHandle, "SensorDataSharingMessage", newPath) )
    {
      C2xRemoveToken(packetHandle, "SensorDataSharingMessage", newPath);
    }
  }

  snprintf(newPath, elcount(newPath), "%s.%s", oldPath, "propulsion");
  if(value.propulsion.isValidFlag==1)
  {
    SetSensorDataSharingMessagePersonalSafetyMessage_PropelledInformationParams(packetHandle, value.propulsion, newPath);
    result = CheckLastError("SensorDataSharingMessage", gkFuncRefGet, result);
  }
  else
  {
    if( C2xIsTokenAvailable(packetHandle, "SensorDataSharingMessage", newPath) )
    {
      C2xRemoveToken(packetHandle, "SensorDataSharingMessage", newPath);
    }
  }

  snprintf(newPath, elcount(newPath), "%s.%s", oldPath, "attachment");
  if(value.attachment.isValidFlag==1)
  {
    C2xSetTokenInt(packetHandle, "SensorDataSharingMessage", newPath, value.attachment.value);
    result = CheckLastError("SensorDataSharingMessage", gkFuncRefGet, result);
  }
  else
  {
    if( C2xIsTokenAvailable(packetHandle, "SensorDataSharingMessage", newPath) )
    {
      C2xRemoveToken(packetHandle, "SensorDataSharingMessage", newPath);
    }
  }

  snprintf(newPath, elcount(newPath), "%s.%s", oldPath, "radius");
  if(value.radius.isValidFlag==1)
  {
    C2xSetTokenInt(packetHandle, "SensorDataSharingMessage", newPath, value.radius.value);
    result = CheckLastError("SensorDataSharingMessage", gkFuncRefGet, result);
  }
  else
  {
    if( C2xIsTokenAvailable(packetHandle, "SensorDataSharingMessage", newPath) )
    {
      C2xRemoveToken(packetHandle, "SensorDataSharingMessage", newPath);
    }
  }

  return result;
}

int GetSensorDataSharingMessageObstacleSizeParams(LONG packetHandle, struct SensorDataSharingMessageObstacleSize value, char oldPath[])
{
  char newPath[300];
  int result;

  result = 0;

  snprintf(newPath, elcount(newPath), "%s.%s", oldPath, "width");
  value.width = C2xGetTokenInt(packetHandle, "SensorDataSharingMessage", newPath);
  result = CheckLastError("SensorDataSharingMessage", gkFuncRefGet, result);

  snprintf(newPath, elcount(newPath), "%s.%s", oldPath, "length");
  value.length = C2xGetTokenInt(packetHandle, "SensorDataSharingMessage", newPath);
  result = CheckLastError("SensorDataSharingMessage", gkFuncRefGet, result);

  snprintf(newPath, elcount(newPath), "%s.%s", oldPath, "height");
  value.height.isValidFlag = C2xIsTokenAvailable(packetHandle, "SensorDataSharingMessage", newPath);
  if(value.height.isValidFlag==1)
  {
    value.height.value = C2xGetTokenInt(packetHandle, "SensorDataSharingMessage", newPath);
    result = CheckLastError("SensorDataSharingMessage", gkFuncRefGet, result);
  }
  return result;
}

int SetSensorDataSharingMessageObstacleSizeParams(LONG packetHandle, struct SensorDataSharingMessageObstacleSize value, char oldPath[])
{
  char newPath[300];
  int result;

  result = 0;

  snprintf(newPath, elcount(newPath), "%s.%s", oldPath, "width");
  C2xSetTokenInt(packetHandle, "SensorDataSharingMessage", newPath, value.width);
  result = CheckLastError("SensorDataSharingMessage", gkFuncRefGet, result);

  snprintf(newPath, elcount(newPath), "%s.%s", oldPath, "length");
  C2xSetTokenInt(packetHandle, "SensorDataSharingMessage", newPath, value.length);
  result = CheckLastError("SensorDataSharingMessage", gkFuncRefGet, result);

  snprintf(newPath, elcount(newPath), "%s.%s", oldPath, "height");
  if(value.height.isValidFlag==1)
  {
    C2xSetTokenInt(packetHandle, "SensorDataSharingMessage", newPath, value.height.value);
    result = CheckLastError("SensorDataSharingMessage", gkFuncRefGet, result);
  }
  else
  {
    if( C2xIsTokenAvailable(packetHandle, "SensorDataSharingMessage", newPath) )
    {
      C2xRemoveToken(packetHandle, "SensorDataSharingMessage", newPath);
    }
  }

  return result;
}

int GetSensorDataSharingMessageObstacleSizeConfidenceParams(LONG packetHandle, struct SensorDataSharingMessageObstacleSizeConfidence value, char oldPath[])
{
  char newPath[300];
  int result;

  result = 0;

  snprintf(newPath, elcount(newPath), "%s.%s", oldPath, "widthConfidence");
  value.widthConfidence = C2xGetTokenInt(packetHandle, "SensorDataSharingMessage", newPath);
  result = CheckLastError("SensorDataSharingMessage", gkFuncRefGet, result);

  snprintf(newPath, elcount(newPath), "%s.%s", oldPath, "lengthConfidence");
  value.lengthConfidence = C2xGetTokenInt(packetHandle, "SensorDataSharingMessage", newPath);
  result = CheckLastError("SensorDataSharingMessage", gkFuncRefGet, result);

  snprintf(newPath, elcount(newPath), "%s.%s", oldPath, "heightConfidence");
  value.heightConfidence.isValidFlag = C2xIsTokenAvailable(packetHandle, "SensorDataSharingMessage", newPath);
  if(value.heightConfidence.isValidFlag==1)
  {
    value.heightConfidence.value = C2xGetTokenInt(packetHandle, "SensorDataSharingMessage", newPath);
    result = CheckLastError("SensorDataSharingMessage", gkFuncRefGet, result);
  }
  return result;
}

int SetSensorDataSharingMessageObstacleSizeConfidenceParams(LONG packetHandle, struct SensorDataSharingMessageObstacleSizeConfidence value, char oldPath[])
{
  char newPath[300];
  int result;

  result = 0;

  snprintf(newPath, elcount(newPath), "%s.%s", oldPath, "widthConfidence");
  C2xSetTokenInt(packetHandle, "SensorDataSharingMessage", newPath, value.widthConfidence);
  result = CheckLastError("SensorDataSharingMessage", gkFuncRefGet, result);

  snprintf(newPath, elcount(newPath), "%s.%s", oldPath, "lengthConfidence");
  C2xSetTokenInt(packetHandle, "SensorDataSharingMessage", newPath, value.lengthConfidence);
  result = CheckLastError("SensorDataSharingMessage", gkFuncRefGet, result);

  snprintf(newPath, elcount(newPath), "%s.%s", oldPath, "heightConfidence");
  if(value.heightConfidence.isValidFlag==1)
  {
    C2xSetTokenInt(packetHandle, "SensorDataSharingMessage", newPath, value.heightConfidence.value);
    result = CheckLastError("SensorDataSharingMessage", gkFuncRefGet, result);
  }
  else
  {
    if( C2xIsTokenAvailable(packetHandle, "SensorDataSharingMessage", newPath) )
    {
      C2xRemoveToken(packetHandle, "SensorDataSharingMessage", newPath);
    }
  }

  return result;
}

int GetSensorDataSharingMessageDetectedObstacleDataParams(LONG packetHandle, struct SensorDataSharingMessageDetectedObstacleData value, char oldPath[])
{
  char newPath[300];
  int result;

  result = 0;

  snprintf(newPath, elcount(newPath), "%s.%s", oldPath, "obstSize");
  GetSensorDataSharingMessageObstacleSizeParams(packetHandle, value.obstSize, newPath);
  result = CheckLastError("SensorDataSharingMessage", gkFuncRefGet, result);

  snprintf(newPath, elcount(newPath), "%s.%s", oldPath, "obstSizeConfidence");
  GetSensorDataSharingMessageObstacleSizeConfidenceParams(packetHandle, value.obstSizeConfidence, newPath);
  result = CheckLastError("SensorDataSharingMessage", gkFuncRefGet, result);

  return result;
}

int SetSensorDataSharingMessageDetectedObstacleDataParams(LONG packetHandle, struct SensorDataSharingMessageDetectedObstacleData value, char oldPath[])
{
  char newPath[300];
  int result;

  result = 0;

  snprintf(newPath, elcount(newPath), "%s.%s", oldPath, "obstSize");
  SetSensorDataSharingMessageObstacleSizeParams(packetHandle, value.obstSize, newPath);
  result = CheckLastError("SensorDataSharingMessage", gkFuncRefGet, result);

  snprintf(newPath, elcount(newPath), "%s.%s", oldPath, "obstSizeConfidence");
  SetSensorDataSharingMessageObstacleSizeConfidenceParams(packetHandle, value.obstSizeConfidence, newPath);
  result = CheckLastError("SensorDataSharingMessage", gkFuncRefGet, result);

  return result;
}

int GetSensorDataSharingMessageDetectedObjectOptionalDataParams(LONG packetHandle, struct SensorDataSharingMessageDetectedObjectOptionalData value, char oldPath[])
{
  char newPath[300];
  int result;

  result = 0;

  value.choice = C2xGetTokenInt(packetHandle, "SensorDataSharingMessage", oldPath);

  switch(value.choice)
  {
    case 0:
    {
      snprintf(newPath, elcount(newPath), "%s.%s", oldPath, "detVeh");
      GetSensorDataSharingMessageDetectedVehicleDataParams(packetHandle, value.detVeh, newPath);
      result = CheckLastError("SensorDataSharingMessage", gkFuncRefGet, result);
    }
    break;
    case 1:
    {
      snprintf(newPath, elcount(newPath), "%s.%s", oldPath, "detVRU");
      GetSensorDataSharingMessageDetectedVRUDataParams(packetHandle, value.detVRU, newPath);
      result = CheckLastError("SensorDataSharingMessage", gkFuncRefGet, result);
    }
    break;
    case 2:
    {
      snprintf(newPath, elcount(newPath), "%s.%s", oldPath, "detObst");
      GetSensorDataSharingMessageDetectedObstacleDataParams(packetHandle, value.detObst, newPath);
      result = CheckLastError("SensorDataSharingMessage", gkFuncRefGet, result);
    }
    break;
  }
  return result;
}

int SetSensorDataSharingMessageDetectedObjectOptionalDataParams(LONG packetHandle, struct SensorDataSharingMessageDetectedObjectOptionalData value, char oldPath[])
{
  char newPath[300];
  int result;

  result = 0;

  switch(value.choice)
  {
    case 0:
    {
      snprintf(newPath, elcount(newPath), "%s.%s", oldPath, "detVeh");
      SetSensorDataSharingMessageDetectedVehicleDataParams(packetHandle, value.detVeh, newPath);
      result = CheckLastError("SensorDataSharingMessage", gkFuncRefGet, result);
    }
    break;
    case 1:
    {
      snprintf(newPath, elcount(newPath), "%s.%s", oldPath, "detVRU");
      SetSensorDataSharingMessageDetectedVRUDataParams(packetHandle, value.detVRU, newPath);
      result = CheckLastError("SensorDataSharingMessage", gkFuncRefGet, result);
    }
    break;
    case 2:
    {
      snprintf(newPath, elcount(newPath), "%s.%s", oldPath, "detObst");
      SetSensorDataSharingMessageDetectedObstacleDataParams(packetHandle, value.detObst, newPath);
      result = CheckLastError("SensorDataSharingMessage", gkFuncRefGet, result);
    }
    break;
  }
  return result;
}

int GetSensorDataSharingMessageDetectedObjectDataParams(LONG packetHandle, struct SensorDataSharingMessageDetectedObjectData value, char oldPath[])
{
  char newPath[300];
  int result;

  result = 0;

  snprintf(newPath, elcount(newPath), "%s.%s", oldPath, "detObjCommon");
  GetSensorDataSharingMessageDetectedObjectCommonDataParams(packetHandle, value.detObjCommon, newPath);
  result = CheckLastError("SensorDataSharingMessage", gkFuncRefGet, result);

  snprintf(newPath, elcount(newPath), "%s.%s", oldPath, "detObjOptData");
  value.detObjOptData.isValidFlag = C2xIsTokenAvailable(packetHandle, "SensorDataSharingMessage", newPath);
  if(value.detObjOptData.isValidFlag==1)
  {
    GetSensorDataSharingMessageDetectedObjectOptionalDataParams(packetHandle, value.detObjOptData, newPath);
    result = CheckLastError("SensorDataSharingMessage", gkFuncRefGet, result);
  }
  return result;
}

int SetSensorDataSharingMessageDetectedObjectDataParams(LONG packetHandle, struct SensorDataSharingMessageDetectedObjectData value, char oldPath[])
{
  char newPath[300];
  int result;

  result = 0;

  snprintf(newPath, elcount(newPath), "%s.%s", oldPath, "detObjCommon");
  SetSensorDataSharingMessageDetectedObjectCommonDataParams(packetHandle, value.detObjCommon, newPath);
  result = CheckLastError("SensorDataSharingMessage", gkFuncRefGet, result);

  snprintf(newPath, elcount(newPath), "%s.%s", oldPath, "detObjOptData");
  if(value.detObjOptData.isValidFlag==1)
  {
    SetSensorDataSharingMessageDetectedObjectOptionalDataParams(packetHandle, value.detObjOptData, newPath);
    result = CheckLastError("SensorDataSharingMessage", gkFuncRefGet, result);
  }
  else
  {
    if( C2xIsTokenAvailable(packetHandle, "SensorDataSharingMessage", newPath) )
    {
      C2xRemoveToken(packetHandle, "SensorDataSharingMessage", newPath);
    }
  }

  return result;
}

int GetSensorDataSharingMessageDetectedObjectListParams(LONG packetHandle, struct SensorDataSharingMessageDetectedObjectList value, char oldPath[])
{
  char newPath[300]; 
  int i;
  int result;

  result = 0;

  value.length = C2xGetTokenInt(packetHandle, "SensorDataSharingMessage", oldPath);
  if((result = CheckLastError("SensorDataSharingMessage", gkFuncRefGet, result))==0)
  {
    for(i=0; i<value.length; i++)
    {
      snprintf(newPath, elcount(newPath), "%s[%d]", oldPath, i);
      GetSensorDataSharingMessageDetectedObjectDataParams(packetHandle, value.arrayValue[i], newPath);
      result = CheckLastError("SensorDataSharingMessage", gkFuncRefGet, result);
    }
  }
  return result;
}

int SetSensorDataSharingMessageDetectedObjectListParams(LONG packetHandle, struct SensorDataSharingMessageDetectedObjectList value, char oldPath[])
{
  char newPath[300]; 
  int i;
  int result;

  result = 0;

  C2xRemoveToken(packetHandle, "SensorDataSharingMessage", oldPath);
  for(i=0; i<value.length; i++)
  {
    snprintf(newPath, elcount(newPath), "%s[%d]", oldPath, i);
    SetSensorDataSharingMessageDetectedObjectDataParams(packetHandle, value.arrayValue[i], newPath);
    result = CheckLastError("SensorDataSharingMessage", gkFuncRefGet, result);
  }
  return result;
}

int GetSensorDataSharingMessage_SensorDataSharingMessageParams(LONG packetHandle, struct SensorDataSharingMessage_SensorDataSharingMessage value, char oldPath[])
{
  char newPath[300];
  int result;

  result = 0;

  snprintf(newPath, elcount(newPath), "%s.%s", oldPath, "msgCnt");
  value.msgCnt = C2xGetTokenInt(packetHandle, "SensorDataSharingMessage", newPath);
  result = CheckLastError("SensorDataSharingMessage", gkFuncRefGet, result);

  snprintf(newPath, elcount(newPath), "%s.%s", oldPath, "sourceID");
  value.sourceID.stringLength = C2xGetTokenData(packetHandle, "SensorDataSharingMessage", newPath, elcount(value.sourceID.string), value.sourceID.string);
  snprintf(newPath, elcount(newPath), "%s.%s", oldPath, "equipmentType");
  value.equipmentType = C2xGetTokenInt(packetHandle, "SensorDataSharingMessage", newPath);
  result = CheckLastError("SensorDataSharingMessage", gkFuncRefGet, result);

  snprintf(newPath, elcount(newPath), "%s.%s", oldPath, "sDSMTimeStamp");
  GetSensorDataSharingMessageCommon_DDateTimeParams(packetHandle, value.sDSMTimeStamp, newPath);
  result = CheckLastError("SensorDataSharingMessage", gkFuncRefGet, result);

  snprintf(newPath, elcount(newPath), "%s.%s", oldPath, "refPos");
  GetSensorDataSharingMessageCommon_Position3DParams(packetHandle, value.refPos, newPath);
  result = CheckLastError("SensorDataSharingMessage", gkFuncRefGet, result);

  snprintf(newPath, elcount(newPath), "%s.%s", oldPath, "refPosXYConf");
  GetSensorDataSharingMessageCommon_PositionalAccuracyParams(packetHandle, value.refPosXYConf, newPath);
  result = CheckLastError("SensorDataSharingMessage", gkFuncRefGet, result);

  snprintf(newPath, elcount(newPath), "%s.%s", oldPath, "refPosElConf");
  value.refPosElConf.isValidFlag = C2xIsTokenAvailable(packetHandle, "SensorDataSharingMessage", newPath);
  if(value.refPosElConf.isValidFlag==1)
  {
    value.refPosElConf.value = C2xGetTokenInt(packetHandle, "SensorDataSharingMessage", newPath);
    result = CheckLastError("SensorDataSharingMessage", gkFuncRefGet, result);
  }
  snprintf(newPath, elcount(newPath), "%s.%s", oldPath, "objects");
  GetSensorDataSharingMessageDetectedObjectListParams(packetHandle, value.objects, newPath);
  result = CheckLastError("SensorDataSharingMessage", gkFuncRefGet, result);

  return result;
}

int SetSensorDataSharingMessage_SensorDataSharingMessageParams(LONG packetHandle, struct SensorDataSharingMessage_SensorDataSharingMessage value, char oldPath[])
{
  char newPath[300];
  int result;

  result = 0;

  snprintf(newPath, elcount(newPath), "%s.%s", oldPath, "msgCnt");
  C2xSetTokenInt(packetHandle, "SensorDataSharingMessage", newPath, value.msgCnt);
  result = CheckLastError("SensorDataSharingMessage", gkFuncRefGet, result);

  snprintf(newPath, elcount(newPath), "%s.%s", oldPath, "sourceID");
  C2xSetTokenData(packetHandle, "SensorDataSharingMessage", newPath, value.sourceID.stringLength, value.sourceID.string);

  snprintf(newPath, elcount(newPath), "%s.%s", oldPath, "equipmentType");
  C2xSetTokenInt(packetHandle, "SensorDataSharingMessage", newPath, value.equipmentType);
  result = CheckLastError("SensorDataSharingMessage", gkFuncRefGet, result);

  snprintf(newPath, elcount(newPath), "%s.%s", oldPath, "sDSMTimeStamp");
  SetSensorDataSharingMessageCommon_DDateTimeParams(packetHandle, value.sDSMTimeStamp, newPath);
  result = CheckLastError("SensorDataSharingMessage", gkFuncRefGet, result);

  snprintf(newPath, elcount(newPath), "%s.%s", oldPath, "refPos");
  SetSensorDataSharingMessageCommon_Position3DParams(packetHandle, value.refPos, newPath);
  result = CheckLastError("SensorDataSharingMessage", gkFuncRefGet, result);

  snprintf(newPath, elcount(newPath), "%s.%s", oldPath, "refPosXYConf");
  SetSensorDataSharingMessageCommon_PositionalAccuracyParams(packetHandle, value.refPosXYConf, newPath);
  result = CheckLastError("SensorDataSharingMessage", gkFuncRefGet, result);

  snprintf(newPath, elcount(newPath), "%s.%s", oldPath, "refPosElConf");
  if(value.refPosElConf.isValidFlag==1)
  {
    C2xSetTokenInt(packetHandle, "SensorDataSharingMessage", newPath, value.refPosElConf.value);
    result = CheckLastError("SensorDataSharingMessage", gkFuncRefGet, result);
  }
  else
  {
    if( C2xIsTokenAvailable(packetHandle, "SensorDataSharingMessage", newPath) )
    {
      C2xRemoveToken(packetHandle, "SensorDataSharingMessage", newPath);
    }
  }

  snprintf(newPath, elcount(newPath), "%s.%s", oldPath, "objects");
  SetSensorDataSharingMessageDetectedObjectListParams(packetHandle, value.objects, newPath);
  result = CheckLastError("SensorDataSharingMessage", gkFuncRefGet, result);

  return result;
}

int GetSensorDataSharingMessageMESSAGE_ID_AND_TYPEParams(LONG packetHandle, WORD tableKey, struct SensorDataSharingMessageMESSAGE_ID_AND_TYPE value, char oldPath[])
{
  char newPath[300];
  int result;

  result = 0;

  switch(tableKey)
  {
    case 41:
    {
      snprintf(newPath, elcount(newPath), "%s.%s", oldPath, "sensorDataSharingMessage");
      GetSensorDataSharingMessage_SensorDataSharingMessageParams(packetHandle, value.sensorDataSharingMessage, newPath);
      result = CheckLastError("SensorDataSharingMessage", gkFuncRefGet, result);
    }
    break;
  }
  return result;
}

int SetSensorDataSharingMessageMESSAGE_ID_AND_TYPEParams(LONG packetHandle, WORD tableKey, struct SensorDataSharingMessageMESSAGE_ID_AND_TYPE value, char oldPath[])
{
  char newPath[300];
  int result;

  result = 0;

  switch(tableKey)
  {
    case 41:
    {
      snprintf(newPath, elcount(newPath), "%s.%s", oldPath, "sensorDataSharingMessage");
      SetSensorDataSharingMessage_SensorDataSharingMessageParams(packetHandle, value.sensorDataSharingMessage, newPath);
      result = CheckLastError("SensorDataSharingMessage", gkFuncRefGet, result);
    }
    break;
  }
  return result;
}

int API_GetSensorDataSharingMessageParams(LONG packetHandle, struct SensorDataSharingMessage value)
{
  int result;
  result = 0;

  value.messageId = C2xGetTokenInt(packetHandle, "SensorDataSharingMessage", "messageId");
  result = CheckLastError("SensorDataSharingMessage", gkFuncRefGet, result);

  GetSensorDataSharingMessageMESSAGE_ID_AND_TYPEParams(packetHandle, value.messageId, value.value, "value");
  result = CheckLastError("SensorDataSharingMessage", gkFuncRefGet, result);

  return result;
}

int API_SetSensorDataSharingMessageParams(LONG packetHandle, struct SensorDataSharingMessage value)
{
  int result;
  result = 0;

  value.messageId = 41;

  SetSensorDataSharingMessageMESSAGE_ID_AND_TYPEParams(packetHandle, value.messageId, value.value, "value");
  result = CheckLastError("SensorDataSharingMessage", gkFuncRefGet, result);

  return result;
}

