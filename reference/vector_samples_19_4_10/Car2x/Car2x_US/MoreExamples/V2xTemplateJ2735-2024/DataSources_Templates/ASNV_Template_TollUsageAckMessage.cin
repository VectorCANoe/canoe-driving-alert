/*@!Encoding:1252*/
/*
//  (c) Vector Informatik GmbH. All rights reserved.
//
//  This file contains definitions of structs and methods that may be used
//  to set and get the values of an ASN.1 defined packet's payload.
//
//  //This example demonstrates how to set a packet's payload:
//  LONG packetHandle;
//  struct TollUsageAckMessage payload;
//  //you need to set the values of the variable "payload" yourself
//  packetHandle = API_InitTollUsageAckMessagePacket();
//  if (packetHandle!=0) {
//    if (API_SetTollUsageAckMessageParams(packetHandle, payload)==0) {
//      if (C2xCompletePacket(packetHandle)==0) {
//        C2xOutputPacket(packetHandle);
//      }
//    }
//  }
//                                                                             */
includes
{
  #include "ASNV_Template_BaseDatatypes.cin"  // If warning "Duplicate #include, ignoring this include" appears, please remove the ASNV_Template_BaseDatatypes.cin include from your other *.cin files in the project.
}
variables
{
    struct TollUsageAckMessageTumAckHash_signedTumHash {
        INT isValidFlag;   // necessary if this struct is used as an optional field of a SEQUENCE
        CHAR string[33];
        INT  stringLength;
    };
    
    struct TollUsageAckMessageCommon_TemporaryID {
        INT isValidFlag;   // necessary if this struct is used as an optional field of a SEQUENCE
        CHAR string[5];
        INT  stringLength;
    };
    
    struct TollUsageAckMessageTumAckHash {
        INT isValidFlag;   // necessary if this struct is used as an optional field of a SEQUENCE
        struct TollUsageAckMessageTumAckHash_signedTumHash signedTumHash;  // OCTETSTRING, OPTIONAL;
        struct TollUsageAckMessageCommon_TemporaryID tempId;  // OCTETSTRING;
        BYTE tumSequenceNum;  // INTEGER, 0..127;
    };
    
    struct TollUsageAckMessageTumAck {
        INT isValidFlag;   // necessary if this struct is used as an optional field of a SEQUENCE
        INT length;
        struct TollUsageAckMessageTumAckHash arrayValue[32];  // SEQUENCE;
    };
    
    struct TollUsageAckMessage_TollUsageAckMessage {
        INT isValidFlag;   // necessary if this struct is used as an optional field of a SEQUENCE
        struct TollUsageAckMessageTumAck tumAck;  // SEQUENCEOF;
        WORD ackMaxAge;  // INTEGER, 100..10000;
    };
    
    struct TollUsageAckMessageMESSAGE_ID_AND_TYPE {
        struct TollUsageAckMessage_TollUsageAckMessage tollUsageAckMessage;  // SEQUENCE;
    };
    
    struct TollUsageAckMessage {
        INT isValidFlag;   // necessary if this struct is used as an optional field of a SEQUENCE
        WORD messageId;  // INTEGER, 0..32767, mapData(18), signalPhaseAndTimingMessage(19), basicSafetyMessage(20), commonSafetyRequest(21), emergencyVehicleAlert(22), intersectionCollision(23), nmeaCorrections(24), probeDataManagement(25), probeVehicleData(26), roadSideAlert(27), rtcmCorrections(28), signalRequestMessage(29), signalStatusMessage(30), travelerInformation(31), personalSafetyMessage(32), roadSafetyMessage(33), roadWeatherMessage(34), probeDataConfigMessage(35), probeDataReportMessage(36), tollAdvertisementMessage(37), tollUsageMessage(38), tollUsageAckMessage(39), cooperativeControlMessage(40), sensorDataSharingMessage(41), maneuverSharingAndCoordinatingMessage(42), roadGeometryAndAttributes(43), personalSafetyMessage2(44), trafficSignalPhaseAndTiming(45), signalControlAndPrioritizationRequest(46), signalControlAndPrioritizationStatus(47), roadUserChargingConfigMessage(48), roadUserChargingReportMessage(49), trafficLightStatusMessage(50);
        struct TollUsageAckMessageMESSAGE_ID_AND_TYPE value;  // TABLE;
    };
    
}

/*
// init function to create a simple packet handle
*/ 
LONG API_InitTollUsageAckMessagePacket()
{
  return C2xInitPacket("TollUsageAckMessage"); 
}

/*
// init function to create a simple packet handle and
// initialize the struct with valid data
*/ 
LONG API_InitTollUsageAckMessagePacket(struct TollUsageAckMessage msgStruct)
{
  long pktHandle;

  pktHandle = API_InitTollUsageAckMessagePacket();

  if (pktHandle != 0)
  {
    // create valid message and application data
    if (C2xCompletePacket(pktHandle) == 0) 
    {
      API_GetTollUsageAckMessageParams(pktHandle, msgStruct);
    }
  }
  return pktHandle;
}

/*
// init function to create a packet with security layer and
// initialize the struct with valid data
*/ 
LONG API_InitTollUsageAckMessagePacket(struct TollUsageAckMessage msgStruct, char packetTypeDesignator[], char certificateName[])
{
  long pktHandle, certHdl;

  // initialize the packet
  pktHandle = C2xInitPacket("TollUsageAckMessage", packetTypeDesignator);

  if (pktHandle != 0)
  {
    certHdl = C2xSecCertificateGetHandle(certificateName);  // get the certificate handle for the cert with name "certificateName"
    if (certHdl != 0) 
    {
      C2xSecPacketSetSignerHandle(pktHandle, certHdl); // set the certHdl to the packet
    }

    // create valid message and application data
    if (C2xCompletePacket(pktHandle) == 0) 
    {
      // copy application data to the application structure
      API_GetTollUsageAckMessageParams(pktHandle, msgStruct);
    }
  }
  return pktHandle;
}
    

int GetTollUsageAckMessageTumAckHashParams(LONG packetHandle, struct TollUsageAckMessageTumAckHash value, char oldPath[])
{
  char newPath[300];
  char buffer[300];
  int result;

  result = 0;

  snprintf(newPath, elcount(newPath), "%s.%s", oldPath, "signedTumHash");
  value.signedTumHash.isValidFlag = C2xIsTokenAvailable(packetHandle, "TollUsageAckMessage", newPath);
  if(value.signedTumHash.isValidFlag==1)
  {
    value.signedTumHash.isValidFlag = 1;
    value.signedTumHash.stringLength = C2xGetTokenData(packetHandle, "TollUsageAckMessage", newPath, elcount(value.signedTumHash.string), value.signedTumHash.string);
  }
  snprintf(newPath, elcount(newPath), "%s.%s", oldPath, "tempId");
  value.tempId.stringLength = C2xGetTokenData(packetHandle, "TollUsageAckMessage", newPath, elcount(value.tempId.string), value.tempId.string);
  snprintf(newPath, elcount(newPath), "%s.%s", oldPath, "tumSequenceNum");
  value.tumSequenceNum = C2xGetTokenInt(packetHandle, "TollUsageAckMessage", newPath);
  result = CheckLastError("TollUsageAckMessage", gkFuncRefGet, result);

  return result;
}

int SetTollUsageAckMessageTumAckHashParams(LONG packetHandle, struct TollUsageAckMessageTumAckHash value, char oldPath[])
{
  char newPath[300];
  char buffer[300];
  int result;

  result = 0;

  snprintf(newPath, elcount(newPath), "%s.%s", oldPath, "signedTumHash");
  if(value.signedTumHash.isValidFlag==1)
  {
    C2xSetTokenData(packetHandle, "TollUsageAckMessage", newPath, value.signedTumHash.stringLength, value.signedTumHash.string);
  }
  else
  {
    if( C2xIsTokenAvailable(packetHandle, "TollUsageAckMessage", newPath) )
    {
      C2xRemoveToken(packetHandle, "TollUsageAckMessage", newPath);
    }
  }

  snprintf(newPath, elcount(newPath), "%s.%s", oldPath, "tempId");
  C2xSetTokenData(packetHandle, "TollUsageAckMessage", newPath, value.tempId.stringLength, value.tempId.string);

  snprintf(newPath, elcount(newPath), "%s.%s", oldPath, "tumSequenceNum");
  C2xSetTokenInt(packetHandle, "TollUsageAckMessage", newPath, value.tumSequenceNum);
  result = CheckLastError("TollUsageAckMessage", gkFuncRefGet, result);

  return result;
}

int GetTollUsageAckMessageTumAckParams(LONG packetHandle, struct TollUsageAckMessageTumAck value, char oldPath[])
{
  char newPath[300]; 
  int i;
  int result;

  result = 0;

  value.length = C2xGetTokenInt(packetHandle, "TollUsageAckMessage", oldPath);
  if((result = CheckLastError("TollUsageAckMessage", gkFuncRefGet, result))==0)
  {
    for(i=0; i<value.length; i++)
    {
      snprintf(newPath, elcount(newPath), "%s[%d]", oldPath, i);
      GetTollUsageAckMessageTumAckHashParams(packetHandle, value.arrayValue[i], newPath);
      result = CheckLastError("TollUsageAckMessage", gkFuncRefGet, result);
    }
  }
  return result;
}

int SetTollUsageAckMessageTumAckParams(LONG packetHandle, struct TollUsageAckMessageTumAck value, char oldPath[])
{
  char newPath[300]; 
  int i;
  int result;

  result = 0;

  C2xRemoveToken(packetHandle, "TollUsageAckMessage", oldPath);
  for(i=0; i<value.length; i++)
  {
    snprintf(newPath, elcount(newPath), "%s[%d]", oldPath, i);
    SetTollUsageAckMessageTumAckHashParams(packetHandle, value.arrayValue[i], newPath);
    result = CheckLastError("TollUsageAckMessage", gkFuncRefGet, result);
  }
  return result;
}

int GetTollUsageAckMessage_TollUsageAckMessageParams(LONG packetHandle, struct TollUsageAckMessage_TollUsageAckMessage value, char oldPath[])
{
  char newPath[300];
  int result;

  result = 0;

  snprintf(newPath, elcount(newPath), "%s.%s", oldPath, "tumAck");
  GetTollUsageAckMessageTumAckParams(packetHandle, value.tumAck, newPath);
  result = CheckLastError("TollUsageAckMessage", gkFuncRefGet, result);

  snprintf(newPath, elcount(newPath), "%s.%s", oldPath, "ackMaxAge");
  value.ackMaxAge = C2xGetTokenInt(packetHandle, "TollUsageAckMessage", newPath);
  result = CheckLastError("TollUsageAckMessage", gkFuncRefGet, result);

  return result;
}

int SetTollUsageAckMessage_TollUsageAckMessageParams(LONG packetHandle, struct TollUsageAckMessage_TollUsageAckMessage value, char oldPath[])
{
  char newPath[300];
  int result;

  result = 0;

  snprintf(newPath, elcount(newPath), "%s.%s", oldPath, "tumAck");
  SetTollUsageAckMessageTumAckParams(packetHandle, value.tumAck, newPath);
  result = CheckLastError("TollUsageAckMessage", gkFuncRefGet, result);

  snprintf(newPath, elcount(newPath), "%s.%s", oldPath, "ackMaxAge");
  if (value.ackMaxAge < 100)
  {
    C2xSetTokenInt(packetHandle, "TollUsageAckMessage", newPath, 100);
  }
  else if (value.ackMaxAge > 10000)
  {
    C2xSetTokenInt(packetHandle, "TollUsageAckMessage", newPath, 10000);
  }
  else
  {
    C2xSetTokenInt(packetHandle, "TollUsageAckMessage", newPath, value.ackMaxAge);
  }
  result = CheckLastError("TollUsageAckMessage", gkFuncRefGet, result);

  return result;
}

int GetTollUsageAckMessageMESSAGE_ID_AND_TYPEParams(LONG packetHandle, WORD tableKey, struct TollUsageAckMessageMESSAGE_ID_AND_TYPE value, char oldPath[])
{
  char newPath[300];
  int result;

  result = 0;

  switch(tableKey)
  {
    case 39:
    {
      snprintf(newPath, elcount(newPath), "%s.%s", oldPath, "tollUsageAckMessage");
      GetTollUsageAckMessage_TollUsageAckMessageParams(packetHandle, value.tollUsageAckMessage, newPath);
      result = CheckLastError("TollUsageAckMessage", gkFuncRefGet, result);
    }
    break;
  }
  return result;
}

int SetTollUsageAckMessageMESSAGE_ID_AND_TYPEParams(LONG packetHandle, WORD tableKey, struct TollUsageAckMessageMESSAGE_ID_AND_TYPE value, char oldPath[])
{
  char newPath[300];
  int result;

  result = 0;

  switch(tableKey)
  {
    case 39:
    {
      snprintf(newPath, elcount(newPath), "%s.%s", oldPath, "tollUsageAckMessage");
      SetTollUsageAckMessage_TollUsageAckMessageParams(packetHandle, value.tollUsageAckMessage, newPath);
      result = CheckLastError("TollUsageAckMessage", gkFuncRefGet, result);
    }
    break;
  }
  return result;
}

int API_GetTollUsageAckMessageParams(LONG packetHandle, struct TollUsageAckMessage value)
{
  int result;
  result = 0;

  value.messageId = C2xGetTokenInt(packetHandle, "TollUsageAckMessage", "messageId");
  result = CheckLastError("TollUsageAckMessage", gkFuncRefGet, result);

  GetTollUsageAckMessageMESSAGE_ID_AND_TYPEParams(packetHandle, value.messageId, value.value, "value");
  result = CheckLastError("TollUsageAckMessage", gkFuncRefGet, result);

  return result;
}

int API_SetTollUsageAckMessageParams(LONG packetHandle, struct TollUsageAckMessage value)
{
  int result;
  result = 0;

  value.messageId = 39;

  SetTollUsageAckMessageMESSAGE_ID_AND_TYPEParams(packetHandle, value.messageId, value.value, "value");
  result = CheckLastError("TollUsageAckMessage", gkFuncRefGet, result);

  return result;
}

