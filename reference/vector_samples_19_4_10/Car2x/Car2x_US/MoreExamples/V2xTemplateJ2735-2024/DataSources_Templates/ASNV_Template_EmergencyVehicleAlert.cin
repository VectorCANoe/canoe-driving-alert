/*@!Encoding:1252*/
/*
//  (c) Vector Informatik GmbH. All rights reserved.
//
//  This file contains definitions of structs and methods that may be used
//  to set and get the values of an ASN.1 defined packet's payload.
//
//  //This example demonstrates how to set a packet's payload:
//  LONG packetHandle;
//  struct EmergencyVehicleAlert payload;
//  //you need to set the values of the variable "payload" yourself
//  packetHandle = API_InitEmergencyVehicleAlertPacket();
//  if (packetHandle!=0) {
//    if (API_SetEmergencyVehicleAlertParams(packetHandle, payload)==0) {
//      if (C2xCompletePacket(packetHandle)==0) {
//        C2xOutputPacket(packetHandle);
//      }
//    }
//  }
//                                                                             */
includes
{
  #include "ASNV_Template_BaseDatatypes.cin"  // If warning "Duplicate #include, ignoring this include" appears, please remove the ASNV_Template_BaseDatatypes.cin include from your other *.cin files in the project.
}
variables
{
    struct EmergencyVehicleAlertCommon_TemporaryID {
        INT isValidFlag;   // necessary if this struct is used as an optional field of a SEQUENCE
        CHAR string[5];
        INT  stringLength;
    };
    
    struct EmergencyVehicleAlertRoadSideAlert_RoadSideAlert_description {
        INT isValidFlag;   // necessary if this struct is used as an optional field of a SEQUENCE
        INT length;
        WORD arrayValue[8];  // INTEGER, 0..65535;
    };
    
    struct EmergencyVehicleAlertCommon_Priority {
        INT isValidFlag;   // necessary if this struct is used as an optional field of a SEQUENCE
        CHAR string[2];
        INT  stringLength;
    };
    
    struct EmergencyVehicleAlertCommon_HeadingSlice {
        INT isValidFlag;   // necessary if this struct is used as an optional field of a SEQUENCE
        CHAR string[17];
        INT  stringLength;
    };
    
    struct EmergencyVehicleAlertCommon_DDateTime {
        INT isValidFlag;   // necessary if this struct is used as an optional field of a SEQUENCE
        struct OPT_WORD_ASN year;  // INTEGER, OPTIONAL, 0..4095;
        struct OPT_BYTE_ASN month;  // INTEGER, OPTIONAL, 0..12;
        struct OPT_BYTE_ASN day;  // INTEGER, OPTIONAL, 0..31;
        struct OPT_BYTE_ASN hour;  // INTEGER, OPTIONAL, 0..31;
        struct OPT_BYTE_ASN minute;  // INTEGER, OPTIONAL, 0..60;
        struct OPT_WORD_ASN second;  // INTEGER, OPTIONAL, 0..65535;
        struct OPT_INT_ASN offset;  // INTEGER, OPTIONAL, -840..840;
    };
    
    struct EmergencyVehicleAlertCommon_TransmissionAndSpeed {
        INT isValidFlag;   // necessary if this struct is used as an optional field of a SEQUENCE
        INT transmisson;  // ENUMERATED, neutral(0), park(1), forwardGears(2), reverseGears(3), reserved1(4), reserved2(5), reserved3(6), unavailable(7);
        WORD speed;  // INTEGER, 0..8191;
    };
    
    struct EmergencyVehicleAlertCommon_PositionalAccuracy {
        INT isValidFlag;   // necessary if this struct is used as an optional field of a SEQUENCE
        BYTE semiMajor;  // INTEGER, 0..255;
        BYTE semiMinor;  // INTEGER, 0..255;
        WORD orientation;  // INTEGER, 0..65535;
    };
    
    struct EmergencyVehicleAlertCommon_PositionConfidenceSet {
        INT isValidFlag;   // necessary if this struct is used as an optional field of a SEQUENCE
        INT pos;  // ENUMERATED, unavailable(0), a500m(1), a200m(2), a100m(3), a50m(4), a20m(5), a10m(6), a5m(7), a2m(8), a1m(9), a50cm(10), a20cm(11), a10cm(12), a5cm(13), a2cm(14), a1cm(15);
        INT elevation;  // ENUMERATED, unavailable(0), elev_500_00(1), elev_200_00(2), elev_100_00(3), elev_050_00(4), elev_020_00(5), elev_010_00(6), elev_005_00(7), elev_002_00(8), elev_001_00(9), elev_000_50(10), elev_000_20(11), elev_000_10(12), elev_000_05(13), elev_000_02(14), elev_000_01(15);
    };
    
    struct EmergencyVehicleAlertCommon_SpeedandHeadingandThrottleConfidence {
        INT isValidFlag;   // necessary if this struct is used as an optional field of a SEQUENCE
        INT heading;  // ENUMERATED, unavailable(0), prec10deg(1), prec05deg(2), prec01deg(3), prec0_1deg(4), prec0_05deg(5), prec0_01deg(6), prec0_0125deg(7);
        INT speed;  // ENUMERATED, unavailable(0), prec100ms(1), prec10ms(2), prec5ms(3), prec1ms(4), prec0_1ms(5), prec0_05ms(6), prec0_01ms(7);
        INT throttle;  // ENUMERATED, unavailable(0), prec10percent(1), prec1percent(2), prec0_5percent(3);
    };
    
    struct EmergencyVehicleAlertCommon_FullPositionVector {
        INT isValidFlag;   // necessary if this struct is used as an optional field of a SEQUENCE
        struct EmergencyVehicleAlertCommon_DDateTime utcTime;  // SEQUENCE, OPTIONAL;
        LONG lon;  // INTEGER, -1799999999..1800000001;
        LONG lat;  // INTEGER, -900000000..900000001;
        struct OPT_LONG_ASN elevation;  // INTEGER, OPTIONAL, -4096..61439;
        struct OPT_WORD_ASN heading;  // INTEGER, OPTIONAL, 0..28800;
        struct EmergencyVehicleAlertCommon_TransmissionAndSpeed speed;  // SEQUENCE, OPTIONAL;
        struct EmergencyVehicleAlertCommon_PositionalAccuracy posAccuracy;  // SEQUENCE, OPTIONAL;
        struct OPT_ENUM_ASN timeConfidence;  // ENUMERATED, OPTIONAL, unavailable(0), time_100_000(1), time_050_000(2), time_020_000(3), time_010_000(4), time_002_000(5), time_001_000(6), time_000_500(7), time_000_200(8), time_000_100(9), time_000_050(10), time_000_020(11), time_000_010(12), time_000_005(13), time_000_002(14), time_000_001(15), time_000_000_5(16), time_000_000_2(17), time_000_000_1(18), time_000_000_05(19), time_000_000_02(20), time_000_000_01(21), time_000_000_005(22), time_000_000_002(23), time_000_000_001(24), time_000_000_000_5(25), time_000_000_000_2(26), time_000_000_000_1(27), time_000_000_000_05(28), time_000_000_000_02(29), time_000_000_000_01(30), time_000_000_000_005(31), time_000_000_000_002(32), time_000_000_000_001(33), time_000_000_000_000_5(34), time_000_000_000_000_2(35), time_000_000_000_000_1(36), time_000_000_000_000_05(37), time_000_000_000_000_02(38), time_000_000_000_000_01(39);
        struct EmergencyVehicleAlertCommon_PositionConfidenceSet posConfidence;  // SEQUENCE, OPTIONAL;
        struct EmergencyVehicleAlertCommon_SpeedandHeadingandThrottleConfidence speedConfidence;  // SEQUENCE, OPTIONAL;
    };
    
    struct EmergencyVehicleAlertCommon_FurtherInfoID {
        INT isValidFlag;   // necessary if this struct is used as an optional field of a SEQUENCE
        CHAR string[3];
        INT  stringLength;
    };
    
    struct EmergencyVehicleAlertCommon_RegionalExtension_Reg_RoadSideAlert_table {
    };
    
    struct EmergencyVehicleAlertCommon_RegionalExtension_Reg_RoadSideAlert {
        INT isValidFlag;   // necessary if this struct is used as an optional field of a SEQUENCE
        BYTE regionId;  // INTEGER, 0..255, noRegion(0), addGrpA(1), addGrpB(2), addGrpC(3), addGrpD(4);
        struct EmergencyVehicleAlertCommon_RegionalExtension_Reg_RoadSideAlert_table regExtvalue;  // TABLE;
    };
    
    struct EmergencyVehicleAlertRoadSideAlert_RoadSideAlert_regional {
        INT isValidFlag;   // necessary if this struct is used as an optional field of a SEQUENCE
        INT length;
        struct EmergencyVehicleAlertCommon_RegionalExtension_Reg_RoadSideAlert arrayValue[4];  // SEQUENCE;
    };
    
    struct EmergencyVehicleAlertRoadSideAlert_RoadSideAlert {
        INT isValidFlag;   // necessary if this struct is used as an optional field of a SEQUENCE
        BYTE msgCnt;  // INTEGER, 0..127;
        struct OPT_DWORD_ASN timeStamp;  // INTEGER, OPTIONAL, 0..527040;
        WORD typeEvent;  // INTEGER, 0..65535;
        struct EmergencyVehicleAlertRoadSideAlert_RoadSideAlert_description description;  // SEQUENCEOF, OPTIONAL;
        struct EmergencyVehicleAlertCommon_Priority priority;  // OCTETSTRING, OPTIONAL;
        struct EmergencyVehicleAlertCommon_HeadingSlice heading;  // BITSTRING, OPTIONAL;
        struct OPT_ENUM_ASN extent;  // ENUMERATED, OPTIONAL, useInstantlyOnly(0), useFor3meters(1), useFor10meters(2), useFor50meters(3), useFor100meters(4), useFor500meters(5), useFor1000meters(6), useFor5000meters(7), useFor10000meters(8), useFor50000meters(9), useFor100000meters(10), useFor500000meters(11), useFor1000000meters(12), useFor5000000meters(13), useFor10000000meters(14), forever(15);
        struct EmergencyVehicleAlertCommon_FullPositionVector position;  // SEQUENCE, OPTIONAL;
        struct EmergencyVehicleAlertCommon_FurtherInfoID furtherInfoID;  // OCTETSTRING, OPTIONAL;
        struct EmergencyVehicleAlertRoadSideAlert_RoadSideAlert_regional regional;  // SEQUENCEOF, OPTIONAL;
    };
    
    struct EmergencyVehicleAlertCommon_PrivilegedEventFlags {
        INT isValidFlag;   // necessary if this struct is used as an optional field of a SEQUENCE
        CHAR string[17];
        INT  stringLength;
    };
    
    struct EmergencyVehicleAlertCommon_PrivilegedEvents {
        INT isValidFlag;   // necessary if this struct is used as an optional field of a SEQUENCE
        BYTE doNotUse;  // INTEGER, 0..31;
        struct EmergencyVehicleAlertCommon_PrivilegedEventFlags event;  // BITSTRING;
    };
    
    struct EmergencyVehicleAlertCommon_EmergencyDetails {
        INT isValidFlag;   // necessary if this struct is used as an optional field of a SEQUENCE
        BYTE doNotUse;  // INTEGER, 0..31;
        INT sirenUse;  // ENUMERATED, unavailable(0), notInUse(1), inUse(2), reserved(3);
        INT lightsUse;  // ENUMERATED, unavailable(0), notInUse(1), inUse(2), yellowCautionLights(3), schooldBusLights(4), arrowSignsActive(5), slowMovingVehicle(6), freqStops(7);
        INT multi;  // ENUMERATED, unavailable(0), singleVehicle(1), multiVehicle(2), reserved(3);
        struct EmergencyVehicleAlertCommon_PrivilegedEvents events;  // SEQUENCE, OPTIONAL;
        struct OPT_ENUM_ASN responseType;  // ENUMERATED, OPTIONAL, notInUseOrNotEquipped(0), emergency(1), nonEmergency(2), pursuit(3), stationary(4), slowMoving(5), stopAndGoMovement(6);
    };
    
    struct EmergencyVehicleAlertCommon_RegionalExtension_Reg_EmergencyVehicleAlert_table {
    };
    
    struct EmergencyVehicleAlertCommon_RegionalExtension_Reg_EmergencyVehicleAlert {
        INT isValidFlag;   // necessary if this struct is used as an optional field of a SEQUENCE
        BYTE regionId;  // INTEGER, 0..255, noRegion(0), addGrpA(1), addGrpB(2), addGrpC(3), addGrpD(4);
        struct EmergencyVehicleAlertCommon_RegionalExtension_Reg_EmergencyVehicleAlert_table regExtvalue;  // TABLE;
    };
    
    struct EmergencyVehicleAlertEmergencyVehicleAlert_regional {
        INT isValidFlag;   // necessary if this struct is used as an optional field of a SEQUENCE
        INT length;
        struct EmergencyVehicleAlertCommon_RegionalExtension_Reg_EmergencyVehicleAlert arrayValue[4];  // SEQUENCE;
    };
    
    struct EmergencyVehicleAlert_EmergencyVehicleAlert {
        INT isValidFlag;   // necessary if this struct is used as an optional field of a SEQUENCE
        struct OPT_DWORD_ASN timeStamp;  // INTEGER, OPTIONAL, 0..527040;
        struct EmergencyVehicleAlertCommon_TemporaryID id;  // OCTETSTRING, OPTIONAL;
        struct EmergencyVehicleAlertRoadSideAlert_RoadSideAlert rsaMsg;  // SEQUENCE;
        struct OPT_ENUM_ASN responseType;  // ENUMERATED, OPTIONAL, notInUseOrNotEquipped(0), emergency(1), nonEmergency(2), pursuit(3), stationary(4), slowMoving(5), stopAndGoMovement(6);
        struct EmergencyVehicleAlertCommon_EmergencyDetails details;  // SEQUENCE, OPTIONAL;
        struct OPT_BYTE_ASN mass;  // INTEGER, OPTIONAL, 0..255;
        struct OPT_ENUM_ASN basicType;  // ENUMERATED, OPTIONAL, none(0), unknown(1), special(2), moto(3), car(4), carOther(5), bus(6), axleCnt2(7), axleCnt3(8), axleCnt4(9), axleCnt4Trailer(10), axleCnt5Trailer(11), axleCnt6Trailer(12), axleCnt5MultiTrailer(13), axleCnt6MultiTrailer(14), axleCnt7MultiTrailer(15);
        struct OPT_ENUM_ASN vehicleType;  // ENUMERATED, OPTIONAL, all_vehicles(9217), bicycles(9218), motorcycles(9219), cars(9220), light_vehicles(9221), cars_and_light_vehicles(9222), cars_with_trailers(9223), cars_with_recreational_trailers(9224), vehicles_with_trailers(9225), heavy_vehicles(9226), trucks(9227), buses(9228), articulated_buses(9229), school_buses(9230), vehicles_with_semi_trailers(9231), vehicles_with_double_trailers(9232), high_profile_vehicles(9233), wide_vehicles(9234), long_vehicles(9235), hazardous_loads(9236), exceptional_loads(9237), abnormal_loads(9238), convoys(9239), maintenance_vehicles(9240), delivery_vehicles(9241), vehicles_with_even_numbered_license_plates(9242), vehicles_with_odd_numbered_license_plates(9243), vehicles_with_parking_permits(9244), vehicles_with_catalytic_converters(9245), vehicles_without_catalytic_converters(9246), gas_powered_vehicles(9247), diesel_powered_vehicles(9248), lPG_vehicles(9249), military_convoys(9250), military_vehicles(9251);
        struct OPT_ENUM_ASN responseEquip;  // ENUMERATED, OPTIONAL, ground_fire_suppression(9985), heavy_ground_equipment(9986), aircraft(9988), marine_equipment(9989), support_equipment(9990), medical_rescue_unit(9991), other(9993), ground_fire_suppression_other(9994), engine(9995), truck_or_aerial(9996), quint(9997), tanker_pumper_combination(9998), brush_truck(10000), aircraft_rescue_firefighting(10001), heavy_ground_equipment_other(10004), dozer_or_plow(10005), tractor(10006), tanker_or_tender(10008), aircraft_other(10024), aircraft_fixed_wing_tanker(10025), helitanker(10026), helicopter(10027), marine_equipment_other(10034), fire_boat_with_pump(10035), boat_no_pump(10036), support_apparatus_other(10044), breathing_apparatus_support(10045), light_and_air_unit(10046), medical_rescue_unit_other(10054), rescue_unit(10055), urban_search_rescue_unit(10056), high_angle_rescue(10057), crash_fire_rescue(10058), bLS_unit(10059), aLS_unit(10060), mobile_command_post(10075), chief_officer_car(10076), hAZMAT_unit(10077), type_i_hand_crew(10078), type_ii_hand_crew(10079), privately_owned_vehicle(10083), other_apparatus_resource(10084), ambulance(10085), bomb_squad_van(10086), combine_harvester(10087), construction_vehicle(10088), farm_tractor(10089), grass_cutting_machines(10090), hAZMAT_containment_tow(10091), heavy_tow(10092), light_tow(10094), flatbed_tow(10114), hedge_cutting_machines(10093), mobile_crane(10095), refuse_collection_vehicle(10096), resurfacing_vehicle(10097), road_sweeper(10098), roadside_litter_collection_crews(10099), salvage_vehicle(10100), sand_truck(10101), snowplow(10102), steam_roller(10103), swat_team_van(10104), track_laying_vehicle(10105), unknown_vehicle(10106), white_lining_vehicle(10107), dump_truck(10108), supervisor_vehicle(10109), snow_blower(10110), rotary_snow_blower(10111), road_grader(10112), steam_truck(10113);
        struct OPT_ENUM_ASN responderType;  // ENUMERATED, OPTIONAL, emergency_vehicle_units(9729), federal_law_enforcement_units(9730), state_police_units(9731), county_police_units(9732), local_police_units(9733), ambulance_units(9734), rescue_units(9735), fire_units(9736), hAZMAT_units(9737), light_tow_unit(9738), heavy_tow_unit(9739), freeway_service_patrols(9740), transportation_response_units(9741), private_contractor_response_units(9742);
        struct EmergencyVehicleAlertEmergencyVehicleAlert_regional regional;  // SEQUENCEOF, OPTIONAL;
    };
    
    struct EmergencyVehicleAlertMESSAGE_ID_AND_TYPE {
        struct EmergencyVehicleAlert_EmergencyVehicleAlert emergencyVehicleAlert;  // SEQUENCE;
    };
    
    struct EmergencyVehicleAlert {
        INT isValidFlag;   // necessary if this struct is used as an optional field of a SEQUENCE
        WORD messageId;  // INTEGER, 0..32767, mapData(18), signalPhaseAndTimingMessage(19), basicSafetyMessage(20), commonSafetyRequest(21), emergencyVehicleAlert(22), intersectionCollision(23), nmeaCorrections(24), probeDataManagement(25), probeVehicleData(26), roadSideAlert(27), rtcmCorrections(28), signalRequestMessage(29), signalStatusMessage(30), travelerInformation(31), personalSafetyMessage(32), roadSafetyMessage(33), roadWeatherMessage(34), probeDataConfigMessage(35), probeDataReportMessage(36), tollAdvertisementMessage(37), tollUsageMessage(38), tollUsageAckMessage(39), cooperativeControlMessage(40), sensorDataSharingMessage(41), maneuverSharingAndCoordinatingMessage(42), roadGeometryAndAttributes(43), personalSafetyMessage2(44), trafficSignalPhaseAndTiming(45), signalControlAndPrioritizationRequest(46), signalControlAndPrioritizationStatus(47), roadUserChargingConfigMessage(48), roadUserChargingReportMessage(49), trafficLightStatusMessage(50);
        struct EmergencyVehicleAlertMESSAGE_ID_AND_TYPE value;  // TABLE;
    };
    
}

/*
// init function to create a simple packet handle
*/ 
LONG API_InitEmergencyVehicleAlertPacket()
{
  return C2xInitPacket("EmergencyVehicleAlert"); 
}

/*
// init function to create a simple packet handle and
// initialize the struct with valid data
*/ 
LONG API_InitEmergencyVehicleAlertPacket(struct EmergencyVehicleAlert msgStruct)
{
  long pktHandle;

  pktHandle = API_InitEmergencyVehicleAlertPacket();

  if (pktHandle != 0)
  {
    // create valid message and application data
    if (C2xCompletePacket(pktHandle) == 0) 
    {
      API_GetEmergencyVehicleAlertParams(pktHandle, msgStruct);
    }
  }
  return pktHandle;
}

/*
// init function to create a packet with security layer and
// initialize the struct with valid data
*/ 
LONG API_InitEmergencyVehicleAlertPacket(struct EmergencyVehicleAlert msgStruct, char packetTypeDesignator[], char certificateName[])
{
  long pktHandle, certHdl;

  // initialize the packet
  pktHandle = C2xInitPacket("EmergencyVehicleAlert", packetTypeDesignator);

  if (pktHandle != 0)
  {
    certHdl = C2xSecCertificateGetHandle(certificateName);  // get the certificate handle for the cert with name "certificateName"
    if (certHdl != 0) 
    {
      C2xSecPacketSetSignerHandle(pktHandle, certHdl); // set the certHdl to the packet
    }

    // create valid message and application data
    if (C2xCompletePacket(pktHandle) == 0) 
    {
      // copy application data to the application structure
      API_GetEmergencyVehicleAlertParams(pktHandle, msgStruct);
    }
  }
  return pktHandle;
}
    

int GetEmergencyVehicleAlertRoadSideAlert_RoadSideAlert_descriptionParams(LONG packetHandle, struct EmergencyVehicleAlertRoadSideAlert_RoadSideAlert_description value, char oldPath[])
{
  char newPath[300]; 
  int i;
  int result;

  result = 0;

  value.length = C2xGetTokenInt(packetHandle, "EmergencyVehicleAlert", oldPath);
  if((result = CheckLastError("EmergencyVehicleAlert", gkFuncRefGet, result))==0)
  {
    for(i=0; i<value.length; i++)
    {
      snprintf(newPath, elcount(newPath), "%s[%d]", oldPath, i);
      value.arrayValue[i] = C2xGetTokenInt64(packetHandle, "EmergencyVehicleAlert", newPath);
      result = CheckLastError("EmergencyVehicleAlert", gkFuncRefGet, result);
    }
  }
  return result;
}

int SetEmergencyVehicleAlertRoadSideAlert_RoadSideAlert_descriptionParams(LONG packetHandle, struct EmergencyVehicleAlertRoadSideAlert_RoadSideAlert_description value, char oldPath[])
{
  char newPath[300]; 
  int i;
  int result;

  result = 0;

  C2xRemoveToken(packetHandle, "EmergencyVehicleAlert", oldPath);
  for(i=0; i<value.length; i++)
  {
    snprintf(newPath, elcount(newPath), "%s[%d]", oldPath, i);
    C2xSetTokenInt64(packetHandle, "EmergencyVehicleAlert", newPath, value.arrayValue[i]);
    result = CheckLastError("EmergencyVehicleAlert", gkFuncRefGet, result);
  }
  return result;
}

int GetEmergencyVehicleAlertCommon_DDateTimeParams(LONG packetHandle, struct EmergencyVehicleAlertCommon_DDateTime value, char oldPath[])
{
  char newPath[300];
  int result;

  result = 0;

  snprintf(newPath, elcount(newPath), "%s.%s", oldPath, "year");
  value.year.isValidFlag = C2xIsTokenAvailable(packetHandle, "EmergencyVehicleAlert", newPath);
  if(value.year.isValidFlag==1)
  {
    value.year.value = C2xGetTokenInt(packetHandle, "EmergencyVehicleAlert", newPath);
    result = CheckLastError("EmergencyVehicleAlert", gkFuncRefGet, result);
  }
  snprintf(newPath, elcount(newPath), "%s.%s", oldPath, "month");
  value.month.isValidFlag = C2xIsTokenAvailable(packetHandle, "EmergencyVehicleAlert", newPath);
  if(value.month.isValidFlag==1)
  {
    value.month.value = C2xGetTokenInt(packetHandle, "EmergencyVehicleAlert", newPath);
    result = CheckLastError("EmergencyVehicleAlert", gkFuncRefGet, result);
  }
  snprintf(newPath, elcount(newPath), "%s.%s", oldPath, "day");
  value.day.isValidFlag = C2xIsTokenAvailable(packetHandle, "EmergencyVehicleAlert", newPath);
  if(value.day.isValidFlag==1)
  {
    value.day.value = C2xGetTokenInt(packetHandle, "EmergencyVehicleAlert", newPath);
    result = CheckLastError("EmergencyVehicleAlert", gkFuncRefGet, result);
  }
  snprintf(newPath, elcount(newPath), "%s.%s", oldPath, "hour");
  value.hour.isValidFlag = C2xIsTokenAvailable(packetHandle, "EmergencyVehicleAlert", newPath);
  if(value.hour.isValidFlag==1)
  {
    value.hour.value = C2xGetTokenInt(packetHandle, "EmergencyVehicleAlert", newPath);
    result = CheckLastError("EmergencyVehicleAlert", gkFuncRefGet, result);
  }
  snprintf(newPath, elcount(newPath), "%s.%s", oldPath, "minute");
  value.minute.isValidFlag = C2xIsTokenAvailable(packetHandle, "EmergencyVehicleAlert", newPath);
  if(value.minute.isValidFlag==1)
  {
    value.minute.value = C2xGetTokenInt(packetHandle, "EmergencyVehicleAlert", newPath);
    result = CheckLastError("EmergencyVehicleAlert", gkFuncRefGet, result);
  }
  snprintf(newPath, elcount(newPath), "%s.%s", oldPath, "second");
  value.second.isValidFlag = C2xIsTokenAvailable(packetHandle, "EmergencyVehicleAlert", newPath);
  if(value.second.isValidFlag==1)
  {
    value.second.value = C2xGetTokenInt(packetHandle, "EmergencyVehicleAlert", newPath);
    result = CheckLastError("EmergencyVehicleAlert", gkFuncRefGet, result);
  }
  snprintf(newPath, elcount(newPath), "%s.%s", oldPath, "offset");
  value.offset.isValidFlag = C2xIsTokenAvailable(packetHandle, "EmergencyVehicleAlert", newPath);
  if(value.offset.isValidFlag==1)
  {
    value.offset.value = C2xGetTokenInt(packetHandle, "EmergencyVehicleAlert", newPath);
    result = CheckLastError("EmergencyVehicleAlert", gkFuncRefGet, result);
  }
  return result;
}

int SetEmergencyVehicleAlertCommon_DDateTimeParams(LONG packetHandle, struct EmergencyVehicleAlertCommon_DDateTime value, char oldPath[])
{
  char newPath[300];
  int result;

  result = 0;

  snprintf(newPath, elcount(newPath), "%s.%s", oldPath, "year");
  if(value.year.isValidFlag==1)
  {
    C2xSetTokenInt(packetHandle, "EmergencyVehicleAlert", newPath, value.year.value);
    result = CheckLastError("EmergencyVehicleAlert", gkFuncRefGet, result);
  }
  else
  {
    if( C2xIsTokenAvailable(packetHandle, "EmergencyVehicleAlert", newPath) )
    {
      C2xRemoveToken(packetHandle, "EmergencyVehicleAlert", newPath);
    }
  }

  snprintf(newPath, elcount(newPath), "%s.%s", oldPath, "month");
  if(value.month.isValidFlag==1)
  {
    C2xSetTokenInt(packetHandle, "EmergencyVehicleAlert", newPath, value.month.value);
    result = CheckLastError("EmergencyVehicleAlert", gkFuncRefGet, result);
  }
  else
  {
    if( C2xIsTokenAvailable(packetHandle, "EmergencyVehicleAlert", newPath) )
    {
      C2xRemoveToken(packetHandle, "EmergencyVehicleAlert", newPath);
    }
  }

  snprintf(newPath, elcount(newPath), "%s.%s", oldPath, "day");
  if(value.day.isValidFlag==1)
  {
    C2xSetTokenInt(packetHandle, "EmergencyVehicleAlert", newPath, value.day.value);
    result = CheckLastError("EmergencyVehicleAlert", gkFuncRefGet, result);
  }
  else
  {
    if( C2xIsTokenAvailable(packetHandle, "EmergencyVehicleAlert", newPath) )
    {
      C2xRemoveToken(packetHandle, "EmergencyVehicleAlert", newPath);
    }
  }

  snprintf(newPath, elcount(newPath), "%s.%s", oldPath, "hour");
  if(value.hour.isValidFlag==1)
  {
    C2xSetTokenInt(packetHandle, "EmergencyVehicleAlert", newPath, value.hour.value);
    result = CheckLastError("EmergencyVehicleAlert", gkFuncRefGet, result);
  }
  else
  {
    if( C2xIsTokenAvailable(packetHandle, "EmergencyVehicleAlert", newPath) )
    {
      C2xRemoveToken(packetHandle, "EmergencyVehicleAlert", newPath);
    }
  }

  snprintf(newPath, elcount(newPath), "%s.%s", oldPath, "minute");
  if(value.minute.isValidFlag==1)
  {
    C2xSetTokenInt(packetHandle, "EmergencyVehicleAlert", newPath, value.minute.value);
    result = CheckLastError("EmergencyVehicleAlert", gkFuncRefGet, result);
  }
  else
  {
    if( C2xIsTokenAvailable(packetHandle, "EmergencyVehicleAlert", newPath) )
    {
      C2xRemoveToken(packetHandle, "EmergencyVehicleAlert", newPath);
    }
  }

  snprintf(newPath, elcount(newPath), "%s.%s", oldPath, "second");
  if(value.second.isValidFlag==1)
  {
    C2xSetTokenInt(packetHandle, "EmergencyVehicleAlert", newPath, value.second.value);
    result = CheckLastError("EmergencyVehicleAlert", gkFuncRefGet, result);
  }
  else
  {
    if( C2xIsTokenAvailable(packetHandle, "EmergencyVehicleAlert", newPath) )
    {
      C2xRemoveToken(packetHandle, "EmergencyVehicleAlert", newPath);
    }
  }

  snprintf(newPath, elcount(newPath), "%s.%s", oldPath, "offset");
  if(value.offset.isValidFlag==1)
  {
    C2xSetTokenInt(packetHandle, "EmergencyVehicleAlert", newPath, value.offset.value);
    result = CheckLastError("EmergencyVehicleAlert", gkFuncRefGet, result);
  }
  else
  {
    if( C2xIsTokenAvailable(packetHandle, "EmergencyVehicleAlert", newPath) )
    {
      C2xRemoveToken(packetHandle, "EmergencyVehicleAlert", newPath);
    }
  }

  return result;
}

int GetEmergencyVehicleAlertCommon_TransmissionAndSpeedParams(LONG packetHandle, struct EmergencyVehicleAlertCommon_TransmissionAndSpeed value, char oldPath[])
{
  char newPath[300];
  int result;

  result = 0;

  snprintf(newPath, elcount(newPath), "%s.%s", oldPath, "transmisson");
  value.transmisson = C2xGetTokenInt(packetHandle, "EmergencyVehicleAlert", newPath);
  result = CheckLastError("EmergencyVehicleAlert", gkFuncRefGet, result);

  snprintf(newPath, elcount(newPath), "%s.%s", oldPath, "speed");
  value.speed = C2xGetTokenInt(packetHandle, "EmergencyVehicleAlert", newPath);
  result = CheckLastError("EmergencyVehicleAlert", gkFuncRefGet, result);

  return result;
}

int SetEmergencyVehicleAlertCommon_TransmissionAndSpeedParams(LONG packetHandle, struct EmergencyVehicleAlertCommon_TransmissionAndSpeed value, char oldPath[])
{
  char newPath[300];
  int result;

  result = 0;

  snprintf(newPath, elcount(newPath), "%s.%s", oldPath, "transmisson");
  C2xSetTokenInt(packetHandle, "EmergencyVehicleAlert", newPath, value.transmisson);
  result = CheckLastError("EmergencyVehicleAlert", gkFuncRefGet, result);

  snprintf(newPath, elcount(newPath), "%s.%s", oldPath, "speed");
  C2xSetTokenInt(packetHandle, "EmergencyVehicleAlert", newPath, value.speed);
  result = CheckLastError("EmergencyVehicleAlert", gkFuncRefGet, result);

  return result;
}

int GetEmergencyVehicleAlertCommon_PositionalAccuracyParams(LONG packetHandle, struct EmergencyVehicleAlertCommon_PositionalAccuracy value, char oldPath[])
{
  char newPath[300];
  int result;

  result = 0;

  snprintf(newPath, elcount(newPath), "%s.%s", oldPath, "semiMajor");
  value.semiMajor = C2xGetTokenInt(packetHandle, "EmergencyVehicleAlert", newPath);
  result = CheckLastError("EmergencyVehicleAlert", gkFuncRefGet, result);

  snprintf(newPath, elcount(newPath), "%s.%s", oldPath, "semiMinor");
  value.semiMinor = C2xGetTokenInt(packetHandle, "EmergencyVehicleAlert", newPath);
  result = CheckLastError("EmergencyVehicleAlert", gkFuncRefGet, result);

  snprintf(newPath, elcount(newPath), "%s.%s", oldPath, "orientation");
  value.orientation = C2xGetTokenInt(packetHandle, "EmergencyVehicleAlert", newPath);
  result = CheckLastError("EmergencyVehicleAlert", gkFuncRefGet, result);

  return result;
}

int SetEmergencyVehicleAlertCommon_PositionalAccuracyParams(LONG packetHandle, struct EmergencyVehicleAlertCommon_PositionalAccuracy value, char oldPath[])
{
  char newPath[300];
  int result;

  result = 0;

  snprintf(newPath, elcount(newPath), "%s.%s", oldPath, "semiMajor");
  C2xSetTokenInt(packetHandle, "EmergencyVehicleAlert", newPath, value.semiMajor);
  result = CheckLastError("EmergencyVehicleAlert", gkFuncRefGet, result);

  snprintf(newPath, elcount(newPath), "%s.%s", oldPath, "semiMinor");
  C2xSetTokenInt(packetHandle, "EmergencyVehicleAlert", newPath, value.semiMinor);
  result = CheckLastError("EmergencyVehicleAlert", gkFuncRefGet, result);

  snprintf(newPath, elcount(newPath), "%s.%s", oldPath, "orientation");
  C2xSetTokenInt(packetHandle, "EmergencyVehicleAlert", newPath, value.orientation);
  result = CheckLastError("EmergencyVehicleAlert", gkFuncRefGet, result);

  return result;
}

int GetEmergencyVehicleAlertCommon_PositionConfidenceSetParams(LONG packetHandle, struct EmergencyVehicleAlertCommon_PositionConfidenceSet value, char oldPath[])
{
  char newPath[300];
  int result;

  result = 0;

  snprintf(newPath, elcount(newPath), "%s.%s", oldPath, "pos");
  value.pos = C2xGetTokenInt(packetHandle, "EmergencyVehicleAlert", newPath);
  result = CheckLastError("EmergencyVehicleAlert", gkFuncRefGet, result);

  snprintf(newPath, elcount(newPath), "%s.%s", oldPath, "elevation");
  value.elevation = C2xGetTokenInt(packetHandle, "EmergencyVehicleAlert", newPath);
  result = CheckLastError("EmergencyVehicleAlert", gkFuncRefGet, result);

  return result;
}

int SetEmergencyVehicleAlertCommon_PositionConfidenceSetParams(LONG packetHandle, struct EmergencyVehicleAlertCommon_PositionConfidenceSet value, char oldPath[])
{
  char newPath[300];
  int result;

  result = 0;

  snprintf(newPath, elcount(newPath), "%s.%s", oldPath, "pos");
  C2xSetTokenInt(packetHandle, "EmergencyVehicleAlert", newPath, value.pos);
  result = CheckLastError("EmergencyVehicleAlert", gkFuncRefGet, result);

  snprintf(newPath, elcount(newPath), "%s.%s", oldPath, "elevation");
  C2xSetTokenInt(packetHandle, "EmergencyVehicleAlert", newPath, value.elevation);
  result = CheckLastError("EmergencyVehicleAlert", gkFuncRefGet, result);

  return result;
}

int GetEmergencyVehicleAlertCommon_SpeedandHeadingandThrottleConfidenceParams(LONG packetHandle, struct EmergencyVehicleAlertCommon_SpeedandHeadingandThrottleConfidence value, char oldPath[])
{
  char newPath[300];
  int result;

  result = 0;

  snprintf(newPath, elcount(newPath), "%s.%s", oldPath, "heading");
  value.heading = C2xGetTokenInt(packetHandle, "EmergencyVehicleAlert", newPath);
  result = CheckLastError("EmergencyVehicleAlert", gkFuncRefGet, result);

  snprintf(newPath, elcount(newPath), "%s.%s", oldPath, "speed");
  value.speed = C2xGetTokenInt(packetHandle, "EmergencyVehicleAlert", newPath);
  result = CheckLastError("EmergencyVehicleAlert", gkFuncRefGet, result);

  snprintf(newPath, elcount(newPath), "%s.%s", oldPath, "throttle");
  value.throttle = C2xGetTokenInt(packetHandle, "EmergencyVehicleAlert", newPath);
  result = CheckLastError("EmergencyVehicleAlert", gkFuncRefGet, result);

  return result;
}

int SetEmergencyVehicleAlertCommon_SpeedandHeadingandThrottleConfidenceParams(LONG packetHandle, struct EmergencyVehicleAlertCommon_SpeedandHeadingandThrottleConfidence value, char oldPath[])
{
  char newPath[300];
  int result;

  result = 0;

  snprintf(newPath, elcount(newPath), "%s.%s", oldPath, "heading");
  C2xSetTokenInt(packetHandle, "EmergencyVehicleAlert", newPath, value.heading);
  result = CheckLastError("EmergencyVehicleAlert", gkFuncRefGet, result);

  snprintf(newPath, elcount(newPath), "%s.%s", oldPath, "speed");
  C2xSetTokenInt(packetHandle, "EmergencyVehicleAlert", newPath, value.speed);
  result = CheckLastError("EmergencyVehicleAlert", gkFuncRefGet, result);

  snprintf(newPath, elcount(newPath), "%s.%s", oldPath, "throttle");
  C2xSetTokenInt(packetHandle, "EmergencyVehicleAlert", newPath, value.throttle);
  result = CheckLastError("EmergencyVehicleAlert", gkFuncRefGet, result);

  return result;
}

int GetEmergencyVehicleAlertCommon_FullPositionVectorParams(LONG packetHandle, struct EmergencyVehicleAlertCommon_FullPositionVector value, char oldPath[])
{
  char newPath[300];
  int result;

  result = 0;

  snprintf(newPath, elcount(newPath), "%s.%s", oldPath, "utcTime");
  value.utcTime.isValidFlag = C2xIsTokenAvailable(packetHandle, "EmergencyVehicleAlert", newPath);
  if(value.utcTime.isValidFlag==1)
  {
    GetEmergencyVehicleAlertCommon_DDateTimeParams(packetHandle, value.utcTime, newPath);
    result = CheckLastError("EmergencyVehicleAlert", gkFuncRefGet, result);
  }
  snprintf(newPath, elcount(newPath), "%s.%s", oldPath, "lon");
  value.lon = C2xGetTokenInt(packetHandle, "EmergencyVehicleAlert", newPath);
  result = CheckLastError("EmergencyVehicleAlert", gkFuncRefGet, result);

  snprintf(newPath, elcount(newPath), "%s.%s", oldPath, "lat");
  value.lat = C2xGetTokenInt(packetHandle, "EmergencyVehicleAlert", newPath);
  result = CheckLastError("EmergencyVehicleAlert", gkFuncRefGet, result);

  snprintf(newPath, elcount(newPath), "%s.%s", oldPath, "elevation");
  value.elevation.isValidFlag = C2xIsTokenAvailable(packetHandle, "EmergencyVehicleAlert", newPath);
  if(value.elevation.isValidFlag==1)
  {
    value.elevation.value = C2xGetTokenInt(packetHandle, "EmergencyVehicleAlert", newPath);
    result = CheckLastError("EmergencyVehicleAlert", gkFuncRefGet, result);
  }
  snprintf(newPath, elcount(newPath), "%s.%s", oldPath, "heading");
  value.heading.isValidFlag = C2xIsTokenAvailable(packetHandle, "EmergencyVehicleAlert", newPath);
  if(value.heading.isValidFlag==1)
  {
    value.heading.value = C2xGetTokenInt(packetHandle, "EmergencyVehicleAlert", newPath);
    result = CheckLastError("EmergencyVehicleAlert", gkFuncRefGet, result);
  }
  snprintf(newPath, elcount(newPath), "%s.%s", oldPath, "speed");
  value.speed.isValidFlag = C2xIsTokenAvailable(packetHandle, "EmergencyVehicleAlert", newPath);
  if(value.speed.isValidFlag==1)
  {
    GetEmergencyVehicleAlertCommon_TransmissionAndSpeedParams(packetHandle, value.speed, newPath);
    result = CheckLastError("EmergencyVehicleAlert", gkFuncRefGet, result);
  }
  snprintf(newPath, elcount(newPath), "%s.%s", oldPath, "posAccuracy");
  value.posAccuracy.isValidFlag = C2xIsTokenAvailable(packetHandle, "EmergencyVehicleAlert", newPath);
  if(value.posAccuracy.isValidFlag==1)
  {
    GetEmergencyVehicleAlertCommon_PositionalAccuracyParams(packetHandle, value.posAccuracy, newPath);
    result = CheckLastError("EmergencyVehicleAlert", gkFuncRefGet, result);
  }
  snprintf(newPath, elcount(newPath), "%s.%s", oldPath, "timeConfidence");
  value.timeConfidence.isValidFlag = C2xIsTokenAvailable(packetHandle, "EmergencyVehicleAlert", newPath);
  if(value.timeConfidence.isValidFlag==1)
  {
    value.timeConfidence.value = C2xGetTokenInt(packetHandle, "EmergencyVehicleAlert", newPath);
    result = CheckLastError("EmergencyVehicleAlert", gkFuncRefGet, result);
  }
  snprintf(newPath, elcount(newPath), "%s.%s", oldPath, "posConfidence");
  value.posConfidence.isValidFlag = C2xIsTokenAvailable(packetHandle, "EmergencyVehicleAlert", newPath);
  if(value.posConfidence.isValidFlag==1)
  {
    GetEmergencyVehicleAlertCommon_PositionConfidenceSetParams(packetHandle, value.posConfidence, newPath);
    result = CheckLastError("EmergencyVehicleAlert", gkFuncRefGet, result);
  }
  snprintf(newPath, elcount(newPath), "%s.%s", oldPath, "speedConfidence");
  value.speedConfidence.isValidFlag = C2xIsTokenAvailable(packetHandle, "EmergencyVehicleAlert", newPath);
  if(value.speedConfidence.isValidFlag==1)
  {
    GetEmergencyVehicleAlertCommon_SpeedandHeadingandThrottleConfidenceParams(packetHandle, value.speedConfidence, newPath);
    result = CheckLastError("EmergencyVehicleAlert", gkFuncRefGet, result);
  }
  return result;
}

int SetEmergencyVehicleAlertCommon_FullPositionVectorParams(LONG packetHandle, struct EmergencyVehicleAlertCommon_FullPositionVector value, char oldPath[])
{
  char newPath[300];
  int result;

  result = 0;

  snprintf(newPath, elcount(newPath), "%s.%s", oldPath, "utcTime");
  if(value.utcTime.isValidFlag==1)
  {
    SetEmergencyVehicleAlertCommon_DDateTimeParams(packetHandle, value.utcTime, newPath);
    result = CheckLastError("EmergencyVehicleAlert", gkFuncRefGet, result);
  }
  else
  {
    if( C2xIsTokenAvailable(packetHandle, "EmergencyVehicleAlert", newPath) )
    {
      C2xRemoveToken(packetHandle, "EmergencyVehicleAlert", newPath);
    }
  }

  snprintf(newPath, elcount(newPath), "%s.%s", oldPath, "lon");
  C2xSetTokenInt(packetHandle, "EmergencyVehicleAlert", newPath, value.lon);
  result = CheckLastError("EmergencyVehicleAlert", gkFuncRefGet, result);

  snprintf(newPath, elcount(newPath), "%s.%s", oldPath, "lat");
  C2xSetTokenInt(packetHandle, "EmergencyVehicleAlert", newPath, value.lat);
  result = CheckLastError("EmergencyVehicleAlert", gkFuncRefGet, result);

  snprintf(newPath, elcount(newPath), "%s.%s", oldPath, "elevation");
  if(value.elevation.isValidFlag==1)
  {
    C2xSetTokenInt(packetHandle, "EmergencyVehicleAlert", newPath, value.elevation.value);
    result = CheckLastError("EmergencyVehicleAlert", gkFuncRefGet, result);
  }
  else
  {
    if( C2xIsTokenAvailable(packetHandle, "EmergencyVehicleAlert", newPath) )
    {
      C2xRemoveToken(packetHandle, "EmergencyVehicleAlert", newPath);
    }
  }

  snprintf(newPath, elcount(newPath), "%s.%s", oldPath, "heading");
  if(value.heading.isValidFlag==1)
  {
    C2xSetTokenInt(packetHandle, "EmergencyVehicleAlert", newPath, value.heading.value);
    result = CheckLastError("EmergencyVehicleAlert", gkFuncRefGet, result);
  }
  else
  {
    if( C2xIsTokenAvailable(packetHandle, "EmergencyVehicleAlert", newPath) )
    {
      C2xRemoveToken(packetHandle, "EmergencyVehicleAlert", newPath);
    }
  }

  snprintf(newPath, elcount(newPath), "%s.%s", oldPath, "speed");
  if(value.speed.isValidFlag==1)
  {
    SetEmergencyVehicleAlertCommon_TransmissionAndSpeedParams(packetHandle, value.speed, newPath);
    result = CheckLastError("EmergencyVehicleAlert", gkFuncRefGet, result);
  }
  else
  {
    if( C2xIsTokenAvailable(packetHandle, "EmergencyVehicleAlert", newPath) )
    {
      C2xRemoveToken(packetHandle, "EmergencyVehicleAlert", newPath);
    }
  }

  snprintf(newPath, elcount(newPath), "%s.%s", oldPath, "posAccuracy");
  if(value.posAccuracy.isValidFlag==1)
  {
    SetEmergencyVehicleAlertCommon_PositionalAccuracyParams(packetHandle, value.posAccuracy, newPath);
    result = CheckLastError("EmergencyVehicleAlert", gkFuncRefGet, result);
  }
  else
  {
    if( C2xIsTokenAvailable(packetHandle, "EmergencyVehicleAlert", newPath) )
    {
      C2xRemoveToken(packetHandle, "EmergencyVehicleAlert", newPath);
    }
  }

  snprintf(newPath, elcount(newPath), "%s.%s", oldPath, "timeConfidence");
  if(value.timeConfidence.isValidFlag==1)
  {
    C2xSetTokenInt(packetHandle, "EmergencyVehicleAlert", newPath, value.timeConfidence.value);
    result = CheckLastError("EmergencyVehicleAlert", gkFuncRefGet, result);
  }
  else
  {
    if( C2xIsTokenAvailable(packetHandle, "EmergencyVehicleAlert", newPath) )
    {
      C2xRemoveToken(packetHandle, "EmergencyVehicleAlert", newPath);
    }
  }

  snprintf(newPath, elcount(newPath), "%s.%s", oldPath, "posConfidence");
  if(value.posConfidence.isValidFlag==1)
  {
    SetEmergencyVehicleAlertCommon_PositionConfidenceSetParams(packetHandle, value.posConfidence, newPath);
    result = CheckLastError("EmergencyVehicleAlert", gkFuncRefGet, result);
  }
  else
  {
    if( C2xIsTokenAvailable(packetHandle, "EmergencyVehicleAlert", newPath) )
    {
      C2xRemoveToken(packetHandle, "EmergencyVehicleAlert", newPath);
    }
  }

  snprintf(newPath, elcount(newPath), "%s.%s", oldPath, "speedConfidence");
  if(value.speedConfidence.isValidFlag==1)
  {
    SetEmergencyVehicleAlertCommon_SpeedandHeadingandThrottleConfidenceParams(packetHandle, value.speedConfidence, newPath);
    result = CheckLastError("EmergencyVehicleAlert", gkFuncRefGet, result);
  }
  else
  {
    if( C2xIsTokenAvailable(packetHandle, "EmergencyVehicleAlert", newPath) )
    {
      C2xRemoveToken(packetHandle, "EmergencyVehicleAlert", newPath);
    }
  }

  return result;
}

int GetEmergencyVehicleAlertCommon_RegionalExtension_Reg_RoadSideAlertParams(LONG packetHandle, struct EmergencyVehicleAlertCommon_RegionalExtension_Reg_RoadSideAlert value, char oldPath[])
{
  char newPath[300];
  int result;

  result = 0;

  snprintf(newPath, elcount(newPath), "%s.%s", oldPath, "regionId");
  value.regionId = C2xGetTokenInt(packetHandle, "EmergencyVehicleAlert", newPath);
  result = CheckLastError("EmergencyVehicleAlert", gkFuncRefGet, result);

  return result;
}

int SetEmergencyVehicleAlertCommon_RegionalExtension_Reg_RoadSideAlertParams(LONG packetHandle, struct EmergencyVehicleAlertCommon_RegionalExtension_Reg_RoadSideAlert value, char oldPath[])
{
  char newPath[300];
  int result;

  result = 0;


  return result;
}

int GetEmergencyVehicleAlertRoadSideAlert_RoadSideAlert_regionalParams(LONG packetHandle, struct EmergencyVehicleAlertRoadSideAlert_RoadSideAlert_regional value, char oldPath[])
{
  char newPath[300]; 
  int i;
  int result;

  result = 0;

  value.length = C2xGetTokenInt(packetHandle, "EmergencyVehicleAlert", oldPath);
  if((result = CheckLastError("EmergencyVehicleAlert", gkFuncRefGet, result))==0)
  {
    for(i=0; i<value.length; i++)
    {
      snprintf(newPath, elcount(newPath), "%s[%d]", oldPath, i);
      GetEmergencyVehicleAlertCommon_RegionalExtension_Reg_RoadSideAlertParams(packetHandle, value.arrayValue[i], newPath);
      result = CheckLastError("EmergencyVehicleAlert", gkFuncRefGet, result);
    }
  }
  return result;
}

int SetEmergencyVehicleAlertRoadSideAlert_RoadSideAlert_regionalParams(LONG packetHandle, struct EmergencyVehicleAlertRoadSideAlert_RoadSideAlert_regional value, char oldPath[])
{
  char newPath[300]; 
  int i;
  int result;

  result = 0;

  C2xRemoveToken(packetHandle, "EmergencyVehicleAlert", oldPath);
  for(i=0; i<value.length; i++)
  {
    snprintf(newPath, elcount(newPath), "%s[%d]", oldPath, i);
    SetEmergencyVehicleAlertCommon_RegionalExtension_Reg_RoadSideAlertParams(packetHandle, value.arrayValue[i], newPath);
    result = CheckLastError("EmergencyVehicleAlert", gkFuncRefGet, result);
  }
  return result;
}

int GetEmergencyVehicleAlertRoadSideAlert_RoadSideAlertParams(LONG packetHandle, struct EmergencyVehicleAlertRoadSideAlert_RoadSideAlert value, char oldPath[])
{
  char newPath[300]; 
  int j; 
  int k;
  int result;

  result = 0;

  snprintf(newPath, elcount(newPath), "%s.%s", oldPath, "msgCnt");
  value.msgCnt = C2xGetTokenInt(packetHandle, "EmergencyVehicleAlert", newPath);
  result = CheckLastError("EmergencyVehicleAlert", gkFuncRefGet, result);

  snprintf(newPath, elcount(newPath), "%s.%s", oldPath, "timeStamp");
  value.timeStamp.isValidFlag = C2xIsTokenAvailable(packetHandle, "EmergencyVehicleAlert", newPath);
  if(value.timeStamp.isValidFlag==1)
  {
    value.timeStamp.value = C2xGetTokenInt(packetHandle, "EmergencyVehicleAlert", newPath);
    result = CheckLastError("EmergencyVehicleAlert", gkFuncRefGet, result);
  }
  snprintf(newPath, elcount(newPath), "%s.%s", oldPath, "typeEvent");
  value.typeEvent = C2xGetTokenInt(packetHandle, "EmergencyVehicleAlert", newPath);
  result = CheckLastError("EmergencyVehicleAlert", gkFuncRefGet, result);

  snprintf(newPath, elcount(newPath), "%s.%s", oldPath, "description");
  value.description.isValidFlag = C2xIsTokenAvailable(packetHandle, "EmergencyVehicleAlert", newPath);
  if(value.description.isValidFlag==1)
  {
    GetEmergencyVehicleAlertRoadSideAlert_RoadSideAlert_descriptionParams(packetHandle, value.description, newPath);
    result = CheckLastError("EmergencyVehicleAlert", gkFuncRefGet, result);
  }
  snprintf(newPath, elcount(newPath), "%s.%s", oldPath, "priority");
  value.priority.isValidFlag = C2xIsTokenAvailable(packetHandle, "EmergencyVehicleAlert", newPath);
  if(value.priority.isValidFlag==1)
  {
    value.priority.isValidFlag = 1;
    value.priority.stringLength = C2xGetTokenData(packetHandle, "EmergencyVehicleAlert", newPath, elcount(value.priority.string), value.priority.string);
  }
  snprintf(newPath, elcount(newPath), "%s.%s", oldPath, "heading");
  value.heading.isValidFlag = C2xIsTokenAvailable(packetHandle, "EmergencyVehicleAlert", newPath);
  if(value.heading.isValidFlag==1)
  {
    value.heading.isValidFlag = 1;
    value.heading.stringLength = C2xGetTokenLengthBit(packetHandle, "EmergencyVehicleAlert", newPath);
    if ((result = CheckLastError("EmergencyVehicleAlert", gkFuncRefGet, result))==0)
    {
      if(value.heading.stringLength > 0)
      {
        for(j=0; j<value.heading.stringLength; j++)
        {
          if(C2xGetTokenBitOfBitString(packetHandle, "EmergencyVehicleAlert", newPath, j) == 0)
          {
            value.heading.string[j] = '0';
          }
          else if(C2xGetTokenBitOfBitString(packetHandle, "EmergencyVehicleAlert", newPath, j) == 1)
          {
            value.heading.string[j] = '1';
          }

          if(value.heading.stringLength == 1)
          {
            value.heading.string[1] = '0';
          }
          result = CheckLastError("EmergencyVehicleAlert", gkFuncRefGet, result);
        }
      }
      else
      {
        for(k = value.heading.stringLength+1; k > -1; k--)
        {
          if(value.heading.string[k] == '1')
          {
            value.heading.string[k] = '0';
          }
        }
      }
    }

  }
  snprintf(newPath, elcount(newPath), "%s.%s", oldPath, "extent");
  value.extent.isValidFlag = C2xIsTokenAvailable(packetHandle, "EmergencyVehicleAlert", newPath);
  if(value.extent.isValidFlag==1)
  {
    value.extent.value = C2xGetTokenInt(packetHandle, "EmergencyVehicleAlert", newPath);
    result = CheckLastError("EmergencyVehicleAlert", gkFuncRefGet, result);
  }
  snprintf(newPath, elcount(newPath), "%s.%s", oldPath, "position");
  value.position.isValidFlag = C2xIsTokenAvailable(packetHandle, "EmergencyVehicleAlert", newPath);
  if(value.position.isValidFlag==1)
  {
    GetEmergencyVehicleAlertCommon_FullPositionVectorParams(packetHandle, value.position, newPath);
    result = CheckLastError("EmergencyVehicleAlert", gkFuncRefGet, result);
  }
  snprintf(newPath, elcount(newPath), "%s.%s", oldPath, "furtherInfoID");
  value.furtherInfoID.isValidFlag = C2xIsTokenAvailable(packetHandle, "EmergencyVehicleAlert", newPath);
  if(value.furtherInfoID.isValidFlag==1)
  {
    value.furtherInfoID.isValidFlag = 1;
    value.furtherInfoID.stringLength = C2xGetTokenData(packetHandle, "EmergencyVehicleAlert", newPath, elcount(value.furtherInfoID.string), value.furtherInfoID.string);
  }
  snprintf(newPath, elcount(newPath), "%s.%s", oldPath, "regional");
  value.regional.isValidFlag = C2xIsTokenAvailable(packetHandle, "EmergencyVehicleAlert", newPath);
  if(value.regional.isValidFlag==1)
  {
    GetEmergencyVehicleAlertRoadSideAlert_RoadSideAlert_regionalParams(packetHandle, value.regional, newPath);
    result = CheckLastError("EmergencyVehicleAlert", gkFuncRefGet, result);
  }
  return result;
}

int SetEmergencyVehicleAlertRoadSideAlert_RoadSideAlertParams(LONG packetHandle, struct EmergencyVehicleAlertRoadSideAlert_RoadSideAlert value, char oldPath[])
{
  char newPath[300]; 
  int j;
  int result;

  result = 0;

  snprintf(newPath, elcount(newPath), "%s.%s", oldPath, "msgCnt");
  C2xSetTokenInt(packetHandle, "EmergencyVehicleAlert", newPath, value.msgCnt);
  result = CheckLastError("EmergencyVehicleAlert", gkFuncRefGet, result);

  snprintf(newPath, elcount(newPath), "%s.%s", oldPath, "timeStamp");
  if(value.timeStamp.isValidFlag==1)
  {
    C2xSetTokenInt(packetHandle, "EmergencyVehicleAlert", newPath, value.timeStamp.value);
    result = CheckLastError("EmergencyVehicleAlert", gkFuncRefGet, result);
  }
  else
  {
    if( C2xIsTokenAvailable(packetHandle, "EmergencyVehicleAlert", newPath) )
    {
      C2xRemoveToken(packetHandle, "EmergencyVehicleAlert", newPath);
    }
  }

  snprintf(newPath, elcount(newPath), "%s.%s", oldPath, "typeEvent");
  C2xSetTokenInt(packetHandle, "EmergencyVehicleAlert", newPath, value.typeEvent);
  result = CheckLastError("EmergencyVehicleAlert", gkFuncRefGet, result);

  snprintf(newPath, elcount(newPath), "%s.%s", oldPath, "description");
  if(value.description.isValidFlag==1)
  {
    SetEmergencyVehicleAlertRoadSideAlert_RoadSideAlert_descriptionParams(packetHandle, value.description, newPath);
    result = CheckLastError("EmergencyVehicleAlert", gkFuncRefGet, result);
  }
  else
  {
    if( C2xIsTokenAvailable(packetHandle, "EmergencyVehicleAlert", newPath) )
    {
      C2xRemoveToken(packetHandle, "EmergencyVehicleAlert", newPath);
    }
  }

  snprintf(newPath, elcount(newPath), "%s.%s", oldPath, "priority");
  if(value.priority.isValidFlag==1)
  {
    C2xSetTokenData(packetHandle, "EmergencyVehicleAlert", newPath, value.priority.stringLength, value.priority.string);
  }
  else
  {
    if( C2xIsTokenAvailable(packetHandle, "EmergencyVehicleAlert", newPath) )
    {
      C2xRemoveToken(packetHandle, "EmergencyVehicleAlert", newPath);
    }
  }

  snprintf(newPath, elcount(newPath), "%s.%s", oldPath, "heading");
  if(value.heading.isValidFlag==1)
  {
      for(j=0; j<value.heading.stringLength; j++)
      {
        if(value.heading.string[j] == '0')
        {
          C2xSetTokenBitOfBitString(packetHandle, "EmergencyVehicleAlert", newPath, j, 0);
        }
        else
        {
          C2xSetTokenBitOfBitString(packetHandle, "EmergencyVehicleAlert", newPath, j, 1);
        }
        result = CheckLastError("EmergencyVehicleAlert", gkFuncRefGet, result);
      }
  }
  else
  {
    if( C2xIsTokenAvailable(packetHandle, "EmergencyVehicleAlert", newPath) )
    {
      C2xRemoveToken(packetHandle, "EmergencyVehicleAlert", newPath);
    }
  }

  snprintf(newPath, elcount(newPath), "%s.%s", oldPath, "extent");
  if(value.extent.isValidFlag==1)
  {
    C2xSetTokenInt(packetHandle, "EmergencyVehicleAlert", newPath, value.extent.value);
    result = CheckLastError("EmergencyVehicleAlert", gkFuncRefGet, result);
  }
  else
  {
    if( C2xIsTokenAvailable(packetHandle, "EmergencyVehicleAlert", newPath) )
    {
      C2xRemoveToken(packetHandle, "EmergencyVehicleAlert", newPath);
    }
  }

  snprintf(newPath, elcount(newPath), "%s.%s", oldPath, "position");
  if(value.position.isValidFlag==1)
  {
    SetEmergencyVehicleAlertCommon_FullPositionVectorParams(packetHandle, value.position, newPath);
    result = CheckLastError("EmergencyVehicleAlert", gkFuncRefGet, result);
  }
  else
  {
    if( C2xIsTokenAvailable(packetHandle, "EmergencyVehicleAlert", newPath) )
    {
      C2xRemoveToken(packetHandle, "EmergencyVehicleAlert", newPath);
    }
  }

  snprintf(newPath, elcount(newPath), "%s.%s", oldPath, "furtherInfoID");
  if(value.furtherInfoID.isValidFlag==1)
  {
    C2xSetTokenData(packetHandle, "EmergencyVehicleAlert", newPath, value.furtherInfoID.stringLength, value.furtherInfoID.string);
  }
  else
  {
    if( C2xIsTokenAvailable(packetHandle, "EmergencyVehicleAlert", newPath) )
    {
      C2xRemoveToken(packetHandle, "EmergencyVehicleAlert", newPath);
    }
  }

  snprintf(newPath, elcount(newPath), "%s.%s", oldPath, "regional");
  if(value.regional.isValidFlag==1)
  {
    SetEmergencyVehicleAlertRoadSideAlert_RoadSideAlert_regionalParams(packetHandle, value.regional, newPath);
    result = CheckLastError("EmergencyVehicleAlert", gkFuncRefGet, result);
  }
  else
  {
    if( C2xIsTokenAvailable(packetHandle, "EmergencyVehicleAlert", newPath) )
    {
      C2xRemoveToken(packetHandle, "EmergencyVehicleAlert", newPath);
    }
  }

  return result;
}

int GetEmergencyVehicleAlertCommon_PrivilegedEventsParams(LONG packetHandle, struct EmergencyVehicleAlertCommon_PrivilegedEvents value, char oldPath[])
{
  char newPath[300]; 
  int j; 
  int k;
  int result;

  result = 0;

  snprintf(newPath, elcount(newPath), "%s.%s", oldPath, "doNotUse");
  value.doNotUse = C2xGetTokenInt(packetHandle, "EmergencyVehicleAlert", newPath);
  result = CheckLastError("EmergencyVehicleAlert", gkFuncRefGet, result);

  snprintf(newPath, elcount(newPath), "%s.%s", oldPath, "event");
  value.event.isValidFlag = 1;
  value.event.stringLength = C2xGetTokenLengthBit(packetHandle, "EmergencyVehicleAlert", newPath);
  if ((result = CheckLastError("EmergencyVehicleAlert", gkFuncRefGet, result))==0)
  {
    if(value.event.stringLength > 0)
    {
      for(j=0; j<value.event.stringLength; j++)
      {
        if(C2xGetTokenBitOfBitString(packetHandle, "EmergencyVehicleAlert", newPath, j) == 0)
        {
          value.event.string[j] = '0';
        }
        else if(C2xGetTokenBitOfBitString(packetHandle, "EmergencyVehicleAlert", newPath, j) == 1)
        {
          value.event.string[j] = '1';
        }

        if(value.event.stringLength == 1)
        {
          value.event.string[1] = '0';
        }
        result = CheckLastError("EmergencyVehicleAlert", gkFuncRefGet, result);
      }
    }
    else
    {
      for(k = value.event.stringLength+1; k > -1; k--)
      {
        if(value.event.string[k] == '1')
        {
          value.event.string[k] = '0';
        }
      }
    }
  }

  return result;
}

int SetEmergencyVehicleAlertCommon_PrivilegedEventsParams(LONG packetHandle, struct EmergencyVehicleAlertCommon_PrivilegedEvents value, char oldPath[])
{
  char newPath[300]; 
  int j;
  int result;

  result = 0;

  snprintf(newPath, elcount(newPath), "%s.%s", oldPath, "doNotUse");
  C2xSetTokenInt(packetHandle, "EmergencyVehicleAlert", newPath, value.doNotUse);
  result = CheckLastError("EmergencyVehicleAlert", gkFuncRefGet, result);

  snprintf(newPath, elcount(newPath), "%s.%s", oldPath, "event");
    for(j=0; j<value.event.stringLength; j++)
    {
      if(value.event.string[j] == '0')
      {
        C2xSetTokenBitOfBitString(packetHandle, "EmergencyVehicleAlert", newPath, j, 0);
      }
      else
      {
        C2xSetTokenBitOfBitString(packetHandle, "EmergencyVehicleAlert", newPath, j, 1);
      }
      result = CheckLastError("EmergencyVehicleAlert", gkFuncRefGet, result);
    }

  return result;
}

int GetEmergencyVehicleAlertCommon_EmergencyDetailsParams(LONG packetHandle, struct EmergencyVehicleAlertCommon_EmergencyDetails value, char oldPath[])
{
  char newPath[300];
  int result;

  result = 0;

  snprintf(newPath, elcount(newPath), "%s.%s", oldPath, "doNotUse");
  value.doNotUse = C2xGetTokenInt(packetHandle, "EmergencyVehicleAlert", newPath);
  result = CheckLastError("EmergencyVehicleAlert", gkFuncRefGet, result);

  snprintf(newPath, elcount(newPath), "%s.%s", oldPath, "sirenUse");
  value.sirenUse = C2xGetTokenInt(packetHandle, "EmergencyVehicleAlert", newPath);
  result = CheckLastError("EmergencyVehicleAlert", gkFuncRefGet, result);

  snprintf(newPath, elcount(newPath), "%s.%s", oldPath, "lightsUse");
  value.lightsUse = C2xGetTokenInt(packetHandle, "EmergencyVehicleAlert", newPath);
  result = CheckLastError("EmergencyVehicleAlert", gkFuncRefGet, result);

  snprintf(newPath, elcount(newPath), "%s.%s", oldPath, "multi");
  value.multi = C2xGetTokenInt(packetHandle, "EmergencyVehicleAlert", newPath);
  result = CheckLastError("EmergencyVehicleAlert", gkFuncRefGet, result);

  snprintf(newPath, elcount(newPath), "%s.%s", oldPath, "events");
  value.events.isValidFlag = C2xIsTokenAvailable(packetHandle, "EmergencyVehicleAlert", newPath);
  if(value.events.isValidFlag==1)
  {
    GetEmergencyVehicleAlertCommon_PrivilegedEventsParams(packetHandle, value.events, newPath);
    result = CheckLastError("EmergencyVehicleAlert", gkFuncRefGet, result);
  }
  snprintf(newPath, elcount(newPath), "%s.%s", oldPath, "responseType");
  value.responseType.isValidFlag = C2xIsTokenAvailable(packetHandle, "EmergencyVehicleAlert", newPath);
  if(value.responseType.isValidFlag==1)
  {
    value.responseType.value = C2xGetTokenInt(packetHandle, "EmergencyVehicleAlert", newPath);
    result = CheckLastError("EmergencyVehicleAlert", gkFuncRefGet, result);
  }
  return result;
}

int SetEmergencyVehicleAlertCommon_EmergencyDetailsParams(LONG packetHandle, struct EmergencyVehicleAlertCommon_EmergencyDetails value, char oldPath[])
{
  char newPath[300];
  int result;

  result = 0;

  snprintf(newPath, elcount(newPath), "%s.%s", oldPath, "doNotUse");
  C2xSetTokenInt(packetHandle, "EmergencyVehicleAlert", newPath, value.doNotUse);
  result = CheckLastError("EmergencyVehicleAlert", gkFuncRefGet, result);

  snprintf(newPath, elcount(newPath), "%s.%s", oldPath, "sirenUse");
  C2xSetTokenInt(packetHandle, "EmergencyVehicleAlert", newPath, value.sirenUse);
  result = CheckLastError("EmergencyVehicleAlert", gkFuncRefGet, result);

  snprintf(newPath, elcount(newPath), "%s.%s", oldPath, "lightsUse");
  C2xSetTokenInt(packetHandle, "EmergencyVehicleAlert", newPath, value.lightsUse);
  result = CheckLastError("EmergencyVehicleAlert", gkFuncRefGet, result);

  snprintf(newPath, elcount(newPath), "%s.%s", oldPath, "multi");
  C2xSetTokenInt(packetHandle, "EmergencyVehicleAlert", newPath, value.multi);
  result = CheckLastError("EmergencyVehicleAlert", gkFuncRefGet, result);

  snprintf(newPath, elcount(newPath), "%s.%s", oldPath, "events");
  if(value.events.isValidFlag==1)
  {
    SetEmergencyVehicleAlertCommon_PrivilegedEventsParams(packetHandle, value.events, newPath);
    result = CheckLastError("EmergencyVehicleAlert", gkFuncRefGet, result);
  }
  else
  {
    if( C2xIsTokenAvailable(packetHandle, "EmergencyVehicleAlert", newPath) )
    {
      C2xRemoveToken(packetHandle, "EmergencyVehicleAlert", newPath);
    }
  }

  snprintf(newPath, elcount(newPath), "%s.%s", oldPath, "responseType");
  if(value.responseType.isValidFlag==1)
  {
    C2xSetTokenInt(packetHandle, "EmergencyVehicleAlert", newPath, value.responseType.value);
    result = CheckLastError("EmergencyVehicleAlert", gkFuncRefGet, result);
  }
  else
  {
    if( C2xIsTokenAvailable(packetHandle, "EmergencyVehicleAlert", newPath) )
    {
      C2xRemoveToken(packetHandle, "EmergencyVehicleAlert", newPath);
    }
  }

  return result;
}

int GetEmergencyVehicleAlertCommon_RegionalExtension_Reg_EmergencyVehicleAlertParams(LONG packetHandle, struct EmergencyVehicleAlertCommon_RegionalExtension_Reg_EmergencyVehicleAlert value, char oldPath[])
{
  char newPath[300];
  int result;

  result = 0;

  snprintf(newPath, elcount(newPath), "%s.%s", oldPath, "regionId");
  value.regionId = C2xGetTokenInt(packetHandle, "EmergencyVehicleAlert", newPath);
  result = CheckLastError("EmergencyVehicleAlert", gkFuncRefGet, result);

  return result;
}

int SetEmergencyVehicleAlertCommon_RegionalExtension_Reg_EmergencyVehicleAlertParams(LONG packetHandle, struct EmergencyVehicleAlertCommon_RegionalExtension_Reg_EmergencyVehicleAlert value, char oldPath[])
{
  char newPath[300];
  int result;

  result = 0;


  return result;
}

int GetEmergencyVehicleAlertEmergencyVehicleAlert_regionalParams(LONG packetHandle, struct EmergencyVehicleAlertEmergencyVehicleAlert_regional value, char oldPath[])
{
  char newPath[300]; 
  int i;
  int result;

  result = 0;

  value.length = C2xGetTokenInt(packetHandle, "EmergencyVehicleAlert", oldPath);
  if((result = CheckLastError("EmergencyVehicleAlert", gkFuncRefGet, result))==0)
  {
    for(i=0; i<value.length; i++)
    {
      snprintf(newPath, elcount(newPath), "%s[%d]", oldPath, i);
      GetEmergencyVehicleAlertCommon_RegionalExtension_Reg_EmergencyVehicleAlertParams(packetHandle, value.arrayValue[i], newPath);
      result = CheckLastError("EmergencyVehicleAlert", gkFuncRefGet, result);
    }
  }
  return result;
}

int SetEmergencyVehicleAlertEmergencyVehicleAlert_regionalParams(LONG packetHandle, struct EmergencyVehicleAlertEmergencyVehicleAlert_regional value, char oldPath[])
{
  char newPath[300]; 
  int i;
  int result;

  result = 0;

  C2xRemoveToken(packetHandle, "EmergencyVehicleAlert", oldPath);
  for(i=0; i<value.length; i++)
  {
    snprintf(newPath, elcount(newPath), "%s[%d]", oldPath, i);
    SetEmergencyVehicleAlertCommon_RegionalExtension_Reg_EmergencyVehicleAlertParams(packetHandle, value.arrayValue[i], newPath);
    result = CheckLastError("EmergencyVehicleAlert", gkFuncRefGet, result);
  }
  return result;
}

int GetEmergencyVehicleAlert_EmergencyVehicleAlertParams(LONG packetHandle, struct EmergencyVehicleAlert_EmergencyVehicleAlert value, char oldPath[])
{
  char newPath[300];
  int result;

  result = 0;

  snprintf(newPath, elcount(newPath), "%s.%s", oldPath, "timeStamp");
  value.timeStamp.isValidFlag = C2xIsTokenAvailable(packetHandle, "EmergencyVehicleAlert", newPath);
  if(value.timeStamp.isValidFlag==1)
  {
    value.timeStamp.value = C2xGetTokenInt(packetHandle, "EmergencyVehicleAlert", newPath);
    result = CheckLastError("EmergencyVehicleAlert", gkFuncRefGet, result);
  }
  snprintf(newPath, elcount(newPath), "%s.%s", oldPath, "id");
  value.id.isValidFlag = C2xIsTokenAvailable(packetHandle, "EmergencyVehicleAlert", newPath);
  if(value.id.isValidFlag==1)
  {
    value.id.isValidFlag = 1;
    value.id.stringLength = C2xGetTokenData(packetHandle, "EmergencyVehicleAlert", newPath, elcount(value.id.string), value.id.string);
  }
  snprintf(newPath, elcount(newPath), "%s.%s", oldPath, "rsaMsg");
  GetEmergencyVehicleAlertRoadSideAlert_RoadSideAlertParams(packetHandle, value.rsaMsg, newPath);
  result = CheckLastError("EmergencyVehicleAlert", gkFuncRefGet, result);

  snprintf(newPath, elcount(newPath), "%s.%s", oldPath, "responseType");
  value.responseType.isValidFlag = C2xIsTokenAvailable(packetHandle, "EmergencyVehicleAlert", newPath);
  if(value.responseType.isValidFlag==1)
  {
    value.responseType.value = C2xGetTokenInt(packetHandle, "EmergencyVehicleAlert", newPath);
    result = CheckLastError("EmergencyVehicleAlert", gkFuncRefGet, result);
  }
  snprintf(newPath, elcount(newPath), "%s.%s", oldPath, "details");
  value.details.isValidFlag = C2xIsTokenAvailable(packetHandle, "EmergencyVehicleAlert", newPath);
  if(value.details.isValidFlag==1)
  {
    GetEmergencyVehicleAlertCommon_EmergencyDetailsParams(packetHandle, value.details, newPath);
    result = CheckLastError("EmergencyVehicleAlert", gkFuncRefGet, result);
  }
  snprintf(newPath, elcount(newPath), "%s.%s", oldPath, "mass");
  value.mass.isValidFlag = C2xIsTokenAvailable(packetHandle, "EmergencyVehicleAlert", newPath);
  if(value.mass.isValidFlag==1)
  {
    value.mass.value = C2xGetTokenInt(packetHandle, "EmergencyVehicleAlert", newPath);
    result = CheckLastError("EmergencyVehicleAlert", gkFuncRefGet, result);
  }
  snprintf(newPath, elcount(newPath), "%s.%s", oldPath, "basicType");
  value.basicType.isValidFlag = C2xIsTokenAvailable(packetHandle, "EmergencyVehicleAlert", newPath);
  if(value.basicType.isValidFlag==1)
  {
    value.basicType.value = C2xGetTokenInt(packetHandle, "EmergencyVehicleAlert", newPath);
    result = CheckLastError("EmergencyVehicleAlert", gkFuncRefGet, result);
  }
  snprintf(newPath, elcount(newPath), "%s.%s", oldPath, "vehicleType");
  value.vehicleType.isValidFlag = C2xIsTokenAvailable(packetHandle, "EmergencyVehicleAlert", newPath);
  if(value.vehicleType.isValidFlag==1)
  {
    value.vehicleType.value = C2xGetTokenInt(packetHandle, "EmergencyVehicleAlert", newPath);
    result = CheckLastError("EmergencyVehicleAlert", gkFuncRefGet, result);
  }
  snprintf(newPath, elcount(newPath), "%s.%s", oldPath, "responseEquip");
  value.responseEquip.isValidFlag = C2xIsTokenAvailable(packetHandle, "EmergencyVehicleAlert", newPath);
  if(value.responseEquip.isValidFlag==1)
  {
    value.responseEquip.value = C2xGetTokenInt(packetHandle, "EmergencyVehicleAlert", newPath);
    result = CheckLastError("EmergencyVehicleAlert", gkFuncRefGet, result);
  }
  snprintf(newPath, elcount(newPath), "%s.%s", oldPath, "responderType");
  value.responderType.isValidFlag = C2xIsTokenAvailable(packetHandle, "EmergencyVehicleAlert", newPath);
  if(value.responderType.isValidFlag==1)
  {
    value.responderType.value = C2xGetTokenInt(packetHandle, "EmergencyVehicleAlert", newPath);
    result = CheckLastError("EmergencyVehicleAlert", gkFuncRefGet, result);
  }
  snprintf(newPath, elcount(newPath), "%s.%s", oldPath, "regional");
  value.regional.isValidFlag = C2xIsTokenAvailable(packetHandle, "EmergencyVehicleAlert", newPath);
  if(value.regional.isValidFlag==1)
  {
    GetEmergencyVehicleAlertEmergencyVehicleAlert_regionalParams(packetHandle, value.regional, newPath);
    result = CheckLastError("EmergencyVehicleAlert", gkFuncRefGet, result);
  }
  return result;
}

int SetEmergencyVehicleAlert_EmergencyVehicleAlertParams(LONG packetHandle, struct EmergencyVehicleAlert_EmergencyVehicleAlert value, char oldPath[])
{
  char newPath[300];
  int result;

  result = 0;

  snprintf(newPath, elcount(newPath), "%s.%s", oldPath, "timeStamp");
  if(value.timeStamp.isValidFlag==1)
  {
    C2xSetTokenInt(packetHandle, "EmergencyVehicleAlert", newPath, value.timeStamp.value);
    result = CheckLastError("EmergencyVehicleAlert", gkFuncRefGet, result);
  }
  else
  {
    if( C2xIsTokenAvailable(packetHandle, "EmergencyVehicleAlert", newPath) )
    {
      C2xRemoveToken(packetHandle, "EmergencyVehicleAlert", newPath);
    }
  }

  if(value.id.stringLength == 0)
  {
    value.id.stringLength = 4;
    memcpy(value.id.string, "0000", value.id.stringLength);
  }

  snprintf(newPath, elcount(newPath), "%s.%s", oldPath, "id");
  if(value.id.isValidFlag==1)
  {
    C2xSetTokenData(packetHandle, "EmergencyVehicleAlert", newPath, value.id.stringLength, value.id.string);
  }
  else
  {
    if( C2xIsTokenAvailable(packetHandle, "EmergencyVehicleAlert", newPath) )
    {
      C2xRemoveToken(packetHandle, "EmergencyVehicleAlert", newPath);
    }
  }

  snprintf(newPath, elcount(newPath), "%s.%s", oldPath, "rsaMsg");
  SetEmergencyVehicleAlertRoadSideAlert_RoadSideAlertParams(packetHandle, value.rsaMsg, newPath);
  result = CheckLastError("EmergencyVehicleAlert", gkFuncRefGet, result);

  snprintf(newPath, elcount(newPath), "%s.%s", oldPath, "responseType");
  if(value.responseType.isValidFlag==1)
  {
    C2xSetTokenInt(packetHandle, "EmergencyVehicleAlert", newPath, value.responseType.value);
    result = CheckLastError("EmergencyVehicleAlert", gkFuncRefGet, result);
  }
  else
  {
    if( C2xIsTokenAvailable(packetHandle, "EmergencyVehicleAlert", newPath) )
    {
      C2xRemoveToken(packetHandle, "EmergencyVehicleAlert", newPath);
    }
  }

  snprintf(newPath, elcount(newPath), "%s.%s", oldPath, "details");
  if(value.details.isValidFlag==1)
  {
    SetEmergencyVehicleAlertCommon_EmergencyDetailsParams(packetHandle, value.details, newPath);
    result = CheckLastError("EmergencyVehicleAlert", gkFuncRefGet, result);
  }
  else
  {
    if( C2xIsTokenAvailable(packetHandle, "EmergencyVehicleAlert", newPath) )
    {
      C2xRemoveToken(packetHandle, "EmergencyVehicleAlert", newPath);
    }
  }

  snprintf(newPath, elcount(newPath), "%s.%s", oldPath, "mass");
  if(value.mass.isValidFlag==1)
  {
    C2xSetTokenInt(packetHandle, "EmergencyVehicleAlert", newPath, value.mass.value);
    result = CheckLastError("EmergencyVehicleAlert", gkFuncRefGet, result);
  }
  else
  {
    if( C2xIsTokenAvailable(packetHandle, "EmergencyVehicleAlert", newPath) )
    {
      C2xRemoveToken(packetHandle, "EmergencyVehicleAlert", newPath);
    }
  }

  snprintf(newPath, elcount(newPath), "%s.%s", oldPath, "basicType");
  if(value.basicType.isValidFlag==1)
  {
    C2xSetTokenInt(packetHandle, "EmergencyVehicleAlert", newPath, value.basicType.value);
    result = CheckLastError("EmergencyVehicleAlert", gkFuncRefGet, result);
  }
  else
  {
    if( C2xIsTokenAvailable(packetHandle, "EmergencyVehicleAlert", newPath) )
    {
      C2xRemoveToken(packetHandle, "EmergencyVehicleAlert", newPath);
    }
  }

  snprintf(newPath, elcount(newPath), "%s.%s", oldPath, "vehicleType");
  if(value.vehicleType.isValidFlag==1)
  {
    if (value.vehicleType.value < 9217)
    {
        C2xSetTokenInt(packetHandle, "EmergencyVehicleAlert", newPath, 9217);
    }
    else if (value.vehicleType.value > 9251)
    {
        C2xSetTokenInt(packetHandle, "EmergencyVehicleAlert", newPath, 9251);
    }
    else
    {
        C2xSetTokenInt(packetHandle, "EmergencyVehicleAlert", newPath, value.vehicleType.value);
    }
    result = CheckLastError("EmergencyVehicleAlert", gkFuncRefGet, result);
  }
  else
  {
    if( C2xIsTokenAvailable(packetHandle, "EmergencyVehicleAlert", newPath) )
    {
      C2xRemoveToken(packetHandle, "EmergencyVehicleAlert", newPath);
    }
  }

  snprintf(newPath, elcount(newPath), "%s.%s", oldPath, "responseEquip");
  if(value.responseEquip.isValidFlag==1)
  {
    if (value.responseEquip.value < 9985)
    {
        C2xSetTokenInt(packetHandle, "EmergencyVehicleAlert", newPath, 9985);
    }
    else if (value.responseEquip.value > 10113)
    {
        C2xSetTokenInt(packetHandle, "EmergencyVehicleAlert", newPath, 10113);
    }
    else
    {
        C2xSetTokenInt(packetHandle, "EmergencyVehicleAlert", newPath, value.responseEquip.value);
    }
    result = CheckLastError("EmergencyVehicleAlert", gkFuncRefGet, result);
  }
  else
  {
    if( C2xIsTokenAvailable(packetHandle, "EmergencyVehicleAlert", newPath) )
    {
      C2xRemoveToken(packetHandle, "EmergencyVehicleAlert", newPath);
    }
  }

  snprintf(newPath, elcount(newPath), "%s.%s", oldPath, "responderType");
  if(value.responderType.isValidFlag==1)
  {
    if (value.responderType.value < 9729)
    {
        C2xSetTokenInt(packetHandle, "EmergencyVehicleAlert", newPath, 9729);
    }
    else if (value.responderType.value > 9742)
    {
        C2xSetTokenInt(packetHandle, "EmergencyVehicleAlert", newPath, 9742);
    }
    else
    {
        C2xSetTokenInt(packetHandle, "EmergencyVehicleAlert", newPath, value.responderType.value);
    }
    result = CheckLastError("EmergencyVehicleAlert", gkFuncRefGet, result);
  }
  else
  {
    if( C2xIsTokenAvailable(packetHandle, "EmergencyVehicleAlert", newPath) )
    {
      C2xRemoveToken(packetHandle, "EmergencyVehicleAlert", newPath);
    }
  }

  snprintf(newPath, elcount(newPath), "%s.%s", oldPath, "regional");
  if(value.regional.isValidFlag==1)
  {
    SetEmergencyVehicleAlertEmergencyVehicleAlert_regionalParams(packetHandle, value.regional, newPath);
    result = CheckLastError("EmergencyVehicleAlert", gkFuncRefGet, result);
  }
  else
  {
    if( C2xIsTokenAvailable(packetHandle, "EmergencyVehicleAlert", newPath) )
    {
      C2xRemoveToken(packetHandle, "EmergencyVehicleAlert", newPath);
    }
  }

  return result;
}

int GetEmergencyVehicleAlertMESSAGE_ID_AND_TYPEParams(LONG packetHandle, WORD tableKey, struct EmergencyVehicleAlertMESSAGE_ID_AND_TYPE value, char oldPath[])
{
  char newPath[300];
  int result;

  result = 0;

  switch(tableKey)
  {
    case 22:
    {
      snprintf(newPath, elcount(newPath), "%s.%s", oldPath, "emergencyVehicleAlert");
      GetEmergencyVehicleAlert_EmergencyVehicleAlertParams(packetHandle, value.emergencyVehicleAlert, newPath);
      result = CheckLastError("EmergencyVehicleAlert", gkFuncRefGet, result);
    }
    break;
  }
  return result;
}

int SetEmergencyVehicleAlertMESSAGE_ID_AND_TYPEParams(LONG packetHandle, WORD tableKey, struct EmergencyVehicleAlertMESSAGE_ID_AND_TYPE value, char oldPath[])
{
  char newPath[300];
  int result;

  result = 0;

  switch(tableKey)
  {
    case 22:
    {
      snprintf(newPath, elcount(newPath), "%s.%s", oldPath, "emergencyVehicleAlert");
      SetEmergencyVehicleAlert_EmergencyVehicleAlertParams(packetHandle, value.emergencyVehicleAlert, newPath);
      result = CheckLastError("EmergencyVehicleAlert", gkFuncRefGet, result);
    }
    break;
  }
  return result;
}

int API_GetEmergencyVehicleAlertParams(LONG packetHandle, struct EmergencyVehicleAlert value)
{
  int result;
  result = 0;

  value.messageId = C2xGetTokenInt(packetHandle, "EmergencyVehicleAlert", "messageId");
  result = CheckLastError("EmergencyVehicleAlert", gkFuncRefGet, result);

  GetEmergencyVehicleAlertMESSAGE_ID_AND_TYPEParams(packetHandle, value.messageId, value.value, "value");
  result = CheckLastError("EmergencyVehicleAlert", gkFuncRefGet, result);

  return result;
}

int API_SetEmergencyVehicleAlertParams(LONG packetHandle, struct EmergencyVehicleAlert value)
{
  int result;
  result = 0;

  value.messageId = 22;

  SetEmergencyVehicleAlertMESSAGE_ID_AND_TYPEParams(packetHandle, value.messageId, value.value, "value");
  result = CheckLastError("EmergencyVehicleAlert", gkFuncRefGet, result);

  return result;
}

