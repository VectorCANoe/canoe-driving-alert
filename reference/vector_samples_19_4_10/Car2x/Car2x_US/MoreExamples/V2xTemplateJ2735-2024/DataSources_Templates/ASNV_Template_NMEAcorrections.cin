/*@!Encoding:1252*/
/*
//  (c) Vector Informatik GmbH. All rights reserved.
//
//  This file contains definitions of structs and methods that may be used
//  to set and get the values of an ASN.1 defined packet's payload.
//
//  //This example demonstrates how to set a packet's payload:
//  LONG packetHandle;
//  struct NMEAcorrections payload;
//  //you need to set the values of the variable "payload" yourself
//  packetHandle = API_InitNMEAcorrectionsPacket();
//  if (packetHandle!=0) {
//    if (API_SetNMEAcorrectionsParams(packetHandle, payload)==0) {
//      if (C2xCompletePacket(packetHandle)==0) {
//        C2xOutputPacket(packetHandle);
//      }
//    }
//  }
//                                                                             */
includes
{
  #include "ASNV_Template_BaseDatatypes.cin"  // If warning "Duplicate #include, ignoring this include" appears, please remove the ASNV_Template_BaseDatatypes.cin include from your other *.cin files in the project.
}
variables
{
    struct NMEAcorrectionsNMEA_Payload {
        INT isValidFlag;   // necessary if this struct is used as an optional field of a SEQUENCE
        CHAR string[1024];
        INT  stringLength;
    };
    
    struct NMEAcorrectionsCommon_RegionalExtension_Reg_NMEAcorrections_table {
    };
    
    struct NMEAcorrectionsCommon_RegionalExtension_Reg_NMEAcorrections {
        INT isValidFlag;   // necessary if this struct is used as an optional field of a SEQUENCE
        BYTE regionId;  // INTEGER, 0..255, noRegion(0), addGrpA(1), addGrpB(2), addGrpC(3), addGrpD(4);
        struct NMEAcorrectionsCommon_RegionalExtension_Reg_NMEAcorrections_table regExtvalue;  // TABLE;
    };
    
    struct NMEAcorrectionsNMEAcorrections_regional {
        INT isValidFlag;   // necessary if this struct is used as an optional field of a SEQUENCE
        INT length;
        struct NMEAcorrectionsCommon_RegionalExtension_Reg_NMEAcorrections arrayValue[4];  // SEQUENCE;
    };
    
    struct NMEAcorrections_NMEAcorrections {
        INT isValidFlag;   // necessary if this struct is used as an optional field of a SEQUENCE
        struct OPT_DWORD_ASN timeStamp;  // INTEGER, OPTIONAL, 0..527040;
        struct OPT_ENUM_ASN rev;  // ENUMERATED, OPTIONAL, unknown(0), reserved(1), rev1(2), rev2(3), rev3(4), rev4(5), rev5(6);
        struct OPT_WORD_ASN msg;  // INTEGER, OPTIONAL, 0..32767;
        struct OPT_WORD_ASN wdCount;  // INTEGER, OPTIONAL, 0..1023;
        struct NMEAcorrectionsNMEA_Payload payload;  // OCTETSTRING;
        struct NMEAcorrectionsNMEAcorrections_regional regional;  // SEQUENCEOF, OPTIONAL;
    };
    
    struct NMEAcorrectionsMESSAGE_ID_AND_TYPE {
        struct NMEAcorrections_NMEAcorrections nmeaCorrections;  // SEQUENCE;
    };
    
    struct NMEAcorrections {
        INT isValidFlag;   // necessary if this struct is used as an optional field of a SEQUENCE
        WORD messageId;  // INTEGER, 0..32767, mapData(18), signalPhaseAndTimingMessage(19), basicSafetyMessage(20), commonSafetyRequest(21), emergencyVehicleAlert(22), intersectionCollision(23), nmeaCorrections(24), probeDataManagement(25), probeVehicleData(26), roadSideAlert(27), rtcmCorrections(28), signalRequestMessage(29), signalStatusMessage(30), travelerInformation(31), personalSafetyMessage(32), roadSafetyMessage(33), roadWeatherMessage(34), probeDataConfigMessage(35), probeDataReportMessage(36), tollAdvertisementMessage(37), tollUsageMessage(38), tollUsageAckMessage(39), cooperativeControlMessage(40), sensorDataSharingMessage(41), maneuverSharingAndCoordinatingMessage(42), roadGeometryAndAttributes(43), personalSafetyMessage2(44), trafficSignalPhaseAndTiming(45), signalControlAndPrioritizationRequest(46), signalControlAndPrioritizationStatus(47), roadUserChargingConfigMessage(48), roadUserChargingReportMessage(49), trafficLightStatusMessage(50);
        struct NMEAcorrectionsMESSAGE_ID_AND_TYPE value;  // TABLE;
    };
    
}

/*
// init function to create a simple packet handle
*/ 
LONG API_InitNMEAcorrectionsPacket()
{
  return C2xInitPacket("NMEAcorrections"); 
}

/*
// init function to create a simple packet handle and
// initialize the struct with valid data
*/ 
LONG API_InitNMEAcorrectionsPacket(struct NMEAcorrections msgStruct)
{
  long pktHandle;

  pktHandle = API_InitNMEAcorrectionsPacket();

  if (pktHandle != 0)
  {
    // create valid message and application data
    if (C2xCompletePacket(pktHandle) == 0) 
    {
      API_GetNMEAcorrectionsParams(pktHandle, msgStruct);
    }
  }
  return pktHandle;
}

/*
// init function to create a packet with security layer and
// initialize the struct with valid data
*/ 
LONG API_InitNMEAcorrectionsPacket(struct NMEAcorrections msgStruct, char packetTypeDesignator[], char certificateName[])
{
  long pktHandle, certHdl;

  // initialize the packet
  pktHandle = C2xInitPacket("NMEAcorrections", packetTypeDesignator);

  if (pktHandle != 0)
  {
    certHdl = C2xSecCertificateGetHandle(certificateName);  // get the certificate handle for the cert with name "certificateName"
    if (certHdl != 0) 
    {
      C2xSecPacketSetSignerHandle(pktHandle, certHdl); // set the certHdl to the packet
    }

    // create valid message and application data
    if (C2xCompletePacket(pktHandle) == 0) 
    {
      // copy application data to the application structure
      API_GetNMEAcorrectionsParams(pktHandle, msgStruct);
    }
  }
  return pktHandle;
}
    

int GetNMEAcorrectionsCommon_RegionalExtension_Reg_NMEAcorrectionsParams(LONG packetHandle, struct NMEAcorrectionsCommon_RegionalExtension_Reg_NMEAcorrections value, char oldPath[])
{
  char newPath[300];
  int result;

  result = 0;

  snprintf(newPath, elcount(newPath), "%s.%s", oldPath, "regionId");
  value.regionId = C2xGetTokenInt(packetHandle, "NMEAcorrections", newPath);
  result = CheckLastError("NMEAcorrections", gkFuncRefGet, result);

  return result;
}

int SetNMEAcorrectionsCommon_RegionalExtension_Reg_NMEAcorrectionsParams(LONG packetHandle, struct NMEAcorrectionsCommon_RegionalExtension_Reg_NMEAcorrections value, char oldPath[])
{
  char newPath[300];
  int result;

  result = 0;


  return result;
}

int GetNMEAcorrectionsNMEAcorrections_regionalParams(LONG packetHandle, struct NMEAcorrectionsNMEAcorrections_regional value, char oldPath[])
{
  char newPath[300]; 
  int i;
  int result;

  result = 0;

  value.length = C2xGetTokenInt(packetHandle, "NMEAcorrections", oldPath);
  if((result = CheckLastError("NMEAcorrections", gkFuncRefGet, result))==0)
  {
    for(i=0; i<value.length; i++)
    {
      snprintf(newPath, elcount(newPath), "%s[%d]", oldPath, i);
      GetNMEAcorrectionsCommon_RegionalExtension_Reg_NMEAcorrectionsParams(packetHandle, value.arrayValue[i], newPath);
      result = CheckLastError("NMEAcorrections", gkFuncRefGet, result);
    }
  }
  return result;
}

int SetNMEAcorrectionsNMEAcorrections_regionalParams(LONG packetHandle, struct NMEAcorrectionsNMEAcorrections_regional value, char oldPath[])
{
  char newPath[300]; 
  int i;
  int result;

  result = 0;

  C2xRemoveToken(packetHandle, "NMEAcorrections", oldPath);
  for(i=0; i<value.length; i++)
  {
    snprintf(newPath, elcount(newPath), "%s[%d]", oldPath, i);
    SetNMEAcorrectionsCommon_RegionalExtension_Reg_NMEAcorrectionsParams(packetHandle, value.arrayValue[i], newPath);
    result = CheckLastError("NMEAcorrections", gkFuncRefGet, result);
  }
  return result;
}

int GetNMEAcorrections_NMEAcorrectionsParams(LONG packetHandle, struct NMEAcorrections_NMEAcorrections value, char oldPath[])
{
  char newPath[300];
  int result;

  result = 0;

  snprintf(newPath, elcount(newPath), "%s.%s", oldPath, "timeStamp");
  value.timeStamp.isValidFlag = C2xIsTokenAvailable(packetHandle, "NMEAcorrections", newPath);
  if(value.timeStamp.isValidFlag==1)
  {
    value.timeStamp.value = C2xGetTokenInt(packetHandle, "NMEAcorrections", newPath);
    result = CheckLastError("NMEAcorrections", gkFuncRefGet, result);
  }
  snprintf(newPath, elcount(newPath), "%s.%s", oldPath, "rev");
  value.rev.isValidFlag = C2xIsTokenAvailable(packetHandle, "NMEAcorrections", newPath);
  if(value.rev.isValidFlag==1)
  {
    value.rev.value = C2xGetTokenInt(packetHandle, "NMEAcorrections", newPath);
    result = CheckLastError("NMEAcorrections", gkFuncRefGet, result);
  }
  snprintf(newPath, elcount(newPath), "%s.%s", oldPath, "msg");
  value.msg.isValidFlag = C2xIsTokenAvailable(packetHandle, "NMEAcorrections", newPath);
  if(value.msg.isValidFlag==1)
  {
    value.msg.value = C2xGetTokenInt(packetHandle, "NMEAcorrections", newPath);
    result = CheckLastError("NMEAcorrections", gkFuncRefGet, result);
  }
  snprintf(newPath, elcount(newPath), "%s.%s", oldPath, "wdCount");
  value.wdCount.isValidFlag = C2xIsTokenAvailable(packetHandle, "NMEAcorrections", newPath);
  if(value.wdCount.isValidFlag==1)
  {
    value.wdCount.value = C2xGetTokenInt(packetHandle, "NMEAcorrections", newPath);
    result = CheckLastError("NMEAcorrections", gkFuncRefGet, result);
  }
  snprintf(newPath, elcount(newPath), "%s.%s", oldPath, "payload");
  value.payload.stringLength = C2xGetTokenData(packetHandle, "NMEAcorrections", newPath, elcount(value.payload.string), value.payload.string);
  snprintf(newPath, elcount(newPath), "%s.%s", oldPath, "regional");
  value.regional.isValidFlag = C2xIsTokenAvailable(packetHandle, "NMEAcorrections", newPath);
  if(value.regional.isValidFlag==1)
  {
    GetNMEAcorrectionsNMEAcorrections_regionalParams(packetHandle, value.regional, newPath);
    result = CheckLastError("NMEAcorrections", gkFuncRefGet, result);
  }
  return result;
}

int SetNMEAcorrections_NMEAcorrectionsParams(LONG packetHandle, struct NMEAcorrections_NMEAcorrections value, char oldPath[])
{
  char newPath[300];
  int result;

  result = 0;

  snprintf(newPath, elcount(newPath), "%s.%s", oldPath, "timeStamp");
  if(value.timeStamp.isValidFlag==1)
  {
    C2xSetTokenInt(packetHandle, "NMEAcorrections", newPath, value.timeStamp.value);
    result = CheckLastError("NMEAcorrections", gkFuncRefGet, result);
  }
  else
  {
    if( C2xIsTokenAvailable(packetHandle, "NMEAcorrections", newPath) )
    {
      C2xRemoveToken(packetHandle, "NMEAcorrections", newPath);
    }
  }

  snprintf(newPath, elcount(newPath), "%s.%s", oldPath, "rev");
  if(value.rev.isValidFlag==1)
  {
    C2xSetTokenInt(packetHandle, "NMEAcorrections", newPath, value.rev.value);
    result = CheckLastError("NMEAcorrections", gkFuncRefGet, result);
  }
  else
  {
    if( C2xIsTokenAvailable(packetHandle, "NMEAcorrections", newPath) )
    {
      C2xRemoveToken(packetHandle, "NMEAcorrections", newPath);
    }
  }

  snprintf(newPath, elcount(newPath), "%s.%s", oldPath, "msg");
  if(value.msg.isValidFlag==1)
  {
    C2xSetTokenInt(packetHandle, "NMEAcorrections", newPath, value.msg.value);
    result = CheckLastError("NMEAcorrections", gkFuncRefGet, result);
  }
  else
  {
    if( C2xIsTokenAvailable(packetHandle, "NMEAcorrections", newPath) )
    {
      C2xRemoveToken(packetHandle, "NMEAcorrections", newPath);
    }
  }

  snprintf(newPath, elcount(newPath), "%s.%s", oldPath, "wdCount");
  if(value.wdCount.isValidFlag==1)
  {
    C2xSetTokenInt(packetHandle, "NMEAcorrections", newPath, value.wdCount.value);
    result = CheckLastError("NMEAcorrections", gkFuncRefGet, result);
  }
  else
  {
    if( C2xIsTokenAvailable(packetHandle, "NMEAcorrections", newPath) )
    {
      C2xRemoveToken(packetHandle, "NMEAcorrections", newPath);
    }
  }

  snprintf(newPath, elcount(newPath), "%s.%s", oldPath, "payload");
  C2xSetTokenData(packetHandle, "NMEAcorrections", newPath, value.payload.stringLength, value.payload.string);

  snprintf(newPath, elcount(newPath), "%s.%s", oldPath, "regional");
  if(value.regional.isValidFlag==1)
  {
    SetNMEAcorrectionsNMEAcorrections_regionalParams(packetHandle, value.regional, newPath);
    result = CheckLastError("NMEAcorrections", gkFuncRefGet, result);
  }
  else
  {
    if( C2xIsTokenAvailable(packetHandle, "NMEAcorrections", newPath) )
    {
      C2xRemoveToken(packetHandle, "NMEAcorrections", newPath);
    }
  }

  return result;
}

int GetNMEAcorrectionsMESSAGE_ID_AND_TYPEParams(LONG packetHandle, WORD tableKey, struct NMEAcorrectionsMESSAGE_ID_AND_TYPE value, char oldPath[])
{
  char newPath[300];
  int result;

  result = 0;

  switch(tableKey)
  {
    case 24:
    {
      snprintf(newPath, elcount(newPath), "%s.%s", oldPath, "nmeaCorrections");
      GetNMEAcorrections_NMEAcorrectionsParams(packetHandle, value.nmeaCorrections, newPath);
      result = CheckLastError("NMEAcorrections", gkFuncRefGet, result);
    }
    break;
  }
  return result;
}

int SetNMEAcorrectionsMESSAGE_ID_AND_TYPEParams(LONG packetHandle, WORD tableKey, struct NMEAcorrectionsMESSAGE_ID_AND_TYPE value, char oldPath[])
{
  char newPath[300];
  int result;

  result = 0;

  switch(tableKey)
  {
    case 24:
    {
      snprintf(newPath, elcount(newPath), "%s.%s", oldPath, "nmeaCorrections");
      SetNMEAcorrections_NMEAcorrectionsParams(packetHandle, value.nmeaCorrections, newPath);
      result = CheckLastError("NMEAcorrections", gkFuncRefGet, result);
    }
    break;
  }
  return result;
}

int API_GetNMEAcorrectionsParams(LONG packetHandle, struct NMEAcorrections value)
{
  int result;
  result = 0;

  value.messageId = C2xGetTokenInt(packetHandle, "NMEAcorrections", "messageId");
  result = CheckLastError("NMEAcorrections", gkFuncRefGet, result);

  GetNMEAcorrectionsMESSAGE_ID_AND_TYPEParams(packetHandle, value.messageId, value.value, "value");
  result = CheckLastError("NMEAcorrections", gkFuncRefGet, result);

  return result;
}

int API_SetNMEAcorrectionsParams(LONG packetHandle, struct NMEAcorrections value)
{
  int result;
  result = 0;

  value.messageId = 24;

  SetNMEAcorrectionsMESSAGE_ID_AND_TYPEParams(packetHandle, value.messageId, value.value, "value");
  result = CheckLastError("NMEAcorrections", gkFuncRefGet, result);

  return result;
}

