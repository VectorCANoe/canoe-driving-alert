/*@!Encoding:1252*/
/*
//  (c) Vector Informatik GmbH. All rights reserved.
//
//  This file contains definitions of structs and methods that may be used
//  to set and get the values of an ASN.1 defined packet's payload.
//
//  //This example demonstrates how to set a packet's payload:
//  LONG packetHandle;
//  struct CooperativeControlMessage payload;
//  //you need to set the values of the variable "payload" yourself
//  packetHandle = API_InitCooperativeControlMessagePacket();
//  if (packetHandle!=0) {
//    if (API_SetCooperativeControlMessageParams(packetHandle, payload)==0) {
//      if (C2xCompletePacket(packetHandle)==0) {
//        C2xOutputPacket(packetHandle);
//      }
//    }
//  }
//                                                                             */
includes
{
  #include "ASNV_Template_BaseDatatypes.cin"  // If warning "Duplicate #include, ignoring this include" appears, please remove the ASNV_Template_BaseDatatypes.cin include from your other *.cin files in the project.
}
variables
{
    struct CooperativeControlMessageCommon_TemporaryID {
        INT isValidFlag;   // necessary if this struct is used as an optional field of a SEQUENCE
        CHAR string[5];
        INT  stringLength;
    };
    
    struct CooperativeControlMessageCommon_PositionalAccuracy {
        INT isValidFlag;   // necessary if this struct is used as an optional field of a SEQUENCE
        BYTE semiMajor;  // INTEGER, 0..255;
        BYTE semiMinor;  // INTEGER, 0..255;
        WORD orientation;  // INTEGER, 0..65535;
    };
    
    struct CooperativeControlMessageCommon_AccelerationSet4Way {
        INT isValidFlag;   // necessary if this struct is used as an optional field of a SEQUENCE
        INT lon;  // INTEGER, -2000..2001;
        INT lat;  // INTEGER, -2000..2001;
        INT vert;  // INTEGER, -127..127;
        INT yaw;  // INTEGER, -32767..32767;
    };
    
    struct CooperativeControlMessageCommon_BrakeAppliedStatus {
        INT isValidFlag;   // necessary if this struct is used as an optional field of a SEQUENCE
        CHAR string[6];
        INT  stringLength;
    };
    
    struct CooperativeControlMessageCommon_BrakeSystemStatus {
        INT isValidFlag;   // necessary if this struct is used as an optional field of a SEQUENCE
        struct CooperativeControlMessageCommon_BrakeAppliedStatus wheelBrakes;  // BITSTRING;
        INT traction;  // ENUMERATED, unavailable(0), off(1), on(2), engaged(3);
        INT antiLockBrake;  // ENUMERATED, unavailable(0), off(1), on(2), engaged(3);
        INT scs;  // ENUMERATED, unavailable(0), off(1), on(2), engaged(3);
        INT brakeBoost;  // ENUMERATED, unavailable(0), off(1), on(2);
        INT auxBrakes;  // ENUMERATED, unavailable(0), off(1), on(2), reserved(3);
    };
    
    struct CooperativeControlMessageCommon_VehicleSize {
        INT isValidFlag;   // necessary if this struct is used as an optional field of a SEQUENCE
        WORD width;  // INTEGER, 0..1023;
        WORD length;  // INTEGER, 0..4095;
    };
    
    struct CooperativeControlMessageCommon_BSMcoreData {
        INT isValidFlag;   // necessary if this struct is used as an optional field of a SEQUENCE
        BYTE msgCnt;  // INTEGER, 0..127;
        struct CooperativeControlMessageCommon_TemporaryID id;  // OCTETSTRING;
        WORD secMark;  // INTEGER, 0..65535;
        LONG lat;  // INTEGER, -900000000..900000001;
        LONG lon;  // INTEGER, -1799999999..1800000001;
        LONG elev;  // INTEGER, -4096..61439;
        struct CooperativeControlMessageCommon_PositionalAccuracy accuracy;  // SEQUENCE;
        INT transmission;  // ENUMERATED, neutral(0), park(1), forwardGears(2), reverseGears(3), reserved1(4), reserved2(5), reserved3(6), unavailable(7);
        WORD speed;  // INTEGER, 0..8191;
        WORD heading;  // INTEGER, 0..28800;
        INT angle;  // INTEGER, -126..127;
        struct CooperativeControlMessageCommon_AccelerationSet4Way accelSet;  // SEQUENCE;
        struct CooperativeControlMessageCommon_BrakeSystemStatus brakes;  // SEQUENCE;
        struct CooperativeControlMessageCommon_VehicleSize size;  // SEQUENCE;
    };
    
    struct CooperativeControlMessageCommon_VehicleEventFlags {
        INT isValidFlag;   // necessary if this struct is used as an optional field of a SEQUENCE
        CHAR string[15];
        INT  stringLength;
    };
    
    struct CooperativeControlMessageCommon_DDateTime {
        INT isValidFlag;   // necessary if this struct is used as an optional field of a SEQUENCE
        struct OPT_WORD_ASN year;  // INTEGER, OPTIONAL, 0..4095;
        struct OPT_BYTE_ASN month;  // INTEGER, OPTIONAL, 0..12;
        struct OPT_BYTE_ASN day;  // INTEGER, OPTIONAL, 0..31;
        struct OPT_BYTE_ASN hour;  // INTEGER, OPTIONAL, 0..31;
        struct OPT_BYTE_ASN minute;  // INTEGER, OPTIONAL, 0..60;
        struct OPT_WORD_ASN second;  // INTEGER, OPTIONAL, 0..65535;
        struct OPT_INT_ASN offset;  // INTEGER, OPTIONAL, -840..840;
    };
    
    struct CooperativeControlMessageCommon_TransmissionAndSpeed {
        INT isValidFlag;   // necessary if this struct is used as an optional field of a SEQUENCE
        INT transmisson;  // ENUMERATED, neutral(0), park(1), forwardGears(2), reverseGears(3), reserved1(4), reserved2(5), reserved3(6), unavailable(7);
        WORD speed;  // INTEGER, 0..8191;
    };
    
    struct CooperativeControlMessageCommon_PositionConfidenceSet {
        INT isValidFlag;   // necessary if this struct is used as an optional field of a SEQUENCE
        INT pos;  // ENUMERATED, unavailable(0), a500m(1), a200m(2), a100m(3), a50m(4), a20m(5), a10m(6), a5m(7), a2m(8), a1m(9), a50cm(10), a20cm(11), a10cm(12), a5cm(13), a2cm(14), a1cm(15);
        INT elevation;  // ENUMERATED, unavailable(0), elev_500_00(1), elev_200_00(2), elev_100_00(3), elev_050_00(4), elev_020_00(5), elev_010_00(6), elev_005_00(7), elev_002_00(8), elev_001_00(9), elev_000_50(10), elev_000_20(11), elev_000_10(12), elev_000_05(13), elev_000_02(14), elev_000_01(15);
    };
    
    struct CooperativeControlMessageCommon_SpeedandHeadingandThrottleConfidence {
        INT isValidFlag;   // necessary if this struct is used as an optional field of a SEQUENCE
        INT heading;  // ENUMERATED, unavailable(0), prec10deg(1), prec05deg(2), prec01deg(3), prec0_1deg(4), prec0_05deg(5), prec0_01deg(6), prec0_0125deg(7);
        INT speed;  // ENUMERATED, unavailable(0), prec100ms(1), prec10ms(2), prec5ms(3), prec1ms(4), prec0_1ms(5), prec0_05ms(6), prec0_01ms(7);
        INT throttle;  // ENUMERATED, unavailable(0), prec10percent(1), prec1percent(2), prec0_5percent(3);
    };
    
    struct CooperativeControlMessageCommon_FullPositionVector {
        INT isValidFlag;   // necessary if this struct is used as an optional field of a SEQUENCE
        struct CooperativeControlMessageCommon_DDateTime utcTime;  // SEQUENCE, OPTIONAL;
        LONG lon;  // INTEGER, -1799999999..1800000001;
        LONG lat;  // INTEGER, -900000000..900000001;
        struct OPT_LONG_ASN elevation;  // INTEGER, OPTIONAL, -4096..61439;
        struct OPT_WORD_ASN heading;  // INTEGER, OPTIONAL, 0..28800;
        struct CooperativeControlMessageCommon_TransmissionAndSpeed speed;  // SEQUENCE, OPTIONAL;
        struct CooperativeControlMessageCommon_PositionalAccuracy posAccuracy;  // SEQUENCE, OPTIONAL;
        struct OPT_ENUM_ASN timeConfidence;  // ENUMERATED, OPTIONAL, unavailable(0), time_100_000(1), time_050_000(2), time_020_000(3), time_010_000(4), time_002_000(5), time_001_000(6), time_000_500(7), time_000_200(8), time_000_100(9), time_000_050(10), time_000_020(11), time_000_010(12), time_000_005(13), time_000_002(14), time_000_001(15), time_000_000_5(16), time_000_000_2(17), time_000_000_1(18), time_000_000_05(19), time_000_000_02(20), time_000_000_01(21), time_000_000_005(22), time_000_000_002(23), time_000_000_001(24), time_000_000_000_5(25), time_000_000_000_2(26), time_000_000_000_1(27), time_000_000_000_05(28), time_000_000_000_02(29), time_000_000_000_01(30), time_000_000_000_005(31), time_000_000_000_002(32), time_000_000_000_001(33), time_000_000_000_000_5(34), time_000_000_000_000_2(35), time_000_000_000_000_1(36), time_000_000_000_000_05(37), time_000_000_000_000_02(38), time_000_000_000_000_01(39);
        struct CooperativeControlMessageCommon_PositionConfidenceSet posConfidence;  // SEQUENCE, OPTIONAL;
        struct CooperativeControlMessageCommon_SpeedandHeadingandThrottleConfidence speedConfidence;  // SEQUENCE, OPTIONAL;
    };
    
    struct CooperativeControlMessageCommon_GNSSstatus {
        INT isValidFlag;   // necessary if this struct is used as an optional field of a SEQUENCE
        CHAR string[9];
        INT  stringLength;
    };
    
    struct CooperativeControlMessageCommon_PathHistoryPoint {
        INT isValidFlag;   // necessary if this struct is used as an optional field of a SEQUENCE
        LONG latOffset;  // INTEGER, -131072..131071;
        LONG lonOffset;  // INTEGER, -131072..131071;
        INT elevationOffset;  // INTEGER, -2048..2047;
        WORD timeOffset;  // INTEGER, 1..65535;
        struct OPT_WORD_ASN speed;  // INTEGER, OPTIONAL, 0..8191;
        struct CooperativeControlMessageCommon_PositionalAccuracy posAccuracy;  // SEQUENCE, OPTIONAL;
        struct OPT_BYTE_ASN heading;  // INTEGER, OPTIONAL, 0..240;
    };
    
    struct CooperativeControlMessageCommon_PathHistoryPointList {
        INT isValidFlag;   // necessary if this struct is used as an optional field of a SEQUENCE
        INT length;
        struct CooperativeControlMessageCommon_PathHistoryPoint arrayValue[23];  // SEQUENCE;
    };
    
    struct CooperativeControlMessageCommon_PathHistory {
        INT isValidFlag;   // necessary if this struct is used as an optional field of a SEQUENCE
        struct CooperativeControlMessageCommon_FullPositionVector initialPosition;  // SEQUENCE, OPTIONAL;
        struct CooperativeControlMessageCommon_GNSSstatus currGNSSstatus;  // BITSTRING, OPTIONAL;
        struct CooperativeControlMessageCommon_PathHistoryPointList crumbData;  // SEQUENCEOF;
    };
    
    struct CooperativeControlMessageCommon_PathPrediction {
        INT isValidFlag;   // necessary if this struct is used as an optional field of a SEQUENCE
        INT radiusOfCurve;  // INTEGER, -32767..32767;
        BYTE confidence;  // INTEGER, 0..200;
    };
    
    struct CooperativeControlMessageCommon_ExteriorLights {
        INT isValidFlag;   // necessary if this struct is used as an optional field of a SEQUENCE
        CHAR string[10];
        INT  stringLength;
    };
    
    struct CooperativeControlMessageCommon_VehicleSafetyExtensions {
        INT isValidFlag;   // necessary if this struct is used as an optional field of a SEQUENCE
        struct CooperativeControlMessageCommon_VehicleEventFlags events;  // BITSTRING, OPTIONAL;
        struct CooperativeControlMessageCommon_PathHistory pathHistory;  // SEQUENCE, OPTIONAL;
        struct CooperativeControlMessageCommon_PathPrediction pathPrediction;  // SEQUENCE, OPTIONAL;
        struct CooperativeControlMessageCommon_ExteriorLights lights;  // BITSTRING, OPTIONAL;
    };
    
    struct CooperativeControlMessageAccelTimeConstant {
        INT isValidFlag;   // necessary if this struct is used as an optional field of a SEQUENCE
        struct OPT_BYTE_ASN accelTimeConst;  // INTEGER, OPTIONAL, 0..255;
        struct OPT_BYTE_ASN decelTimeConst;  // INTEGER, OPTIONAL, 0..255;
    };
    
    struct CooperativeControlMessageLightVehicleCCMExtensions {
        INT isValidFlag;   // necessary if this struct is used as an optional field of a SEQUENCE
        INT longCntrlState;  // ENUMERATED, unavailable(-0), manual(1), cc(2), acc(3), caccOne(4), caccMultiple(5), sensorAuto(6), fusedAuto(7), manualOver(8);
        struct CooperativeControlMessageCommon_TemporaryID targetId;  // OCTETSTRING, OPTIONAL;
        struct OPT_INT_ASN accelForecast;  // INTEGER, OPTIONAL, -2000..2001;
        struct CooperativeControlMessageAccelTimeConstant accelTimeConst;  // SEQUENCE, OPTIONAL;
        struct OPT_WORD_ASN seperationDist;  // INTEGER, OPTIONAL, 0..2001;
        struct OPT_BOOL_ASN frontCutIn;  // BOOLEAN, OPTIONAL;
    };
    
    struct CooperativeControlMessageAxesMovement {
        INT isValidFlag;   // necessary if this struct is used as an optional field of a SEQUENCE
        struct OPT_WORD_ASN yaw;  // INTEGER, OPTIONAL, 0..28800;
        struct OPT_INT_ASN pitch;  // INTEGER, OPTIONAL, -7200..7201;
        struct OPT_INT_ASN roll;  // INTEGER, OPTIONAL, -7200..7201;
        struct OPT_INT_ASN yawRate;  // INTEGER, OPTIONAL, -32767..32767;
        struct OPT_INT_ASN pitchRate;  // INTEGER, OPTIONAL, -3000..3001;
        struct OPT_INT_ASN rollRate;  // INTEGER, OPTIONAL, -3000..3001;
    };
    
    struct CooperativeControlMessageCCMFaultMode {
        INT isValidFlag;   // necessary if this struct is used as an optional field of a SEQUENCE
        CHAR string[9];
        INT  stringLength;
    };
    
    struct CooperativeControlMessageHeavyTruckCCMExtensions {
        INT isValidFlag;   // necessary if this struct is used as an optional field of a SEQUENCE
        INT longCntrlState;  // ENUMERATED, unavailable(-0), manual(1), cc(2), acc(3), caccOne(4), caccMultiple(5), sensorAuto(6), fusedAuto(7), manualOver(8);
        struct CooperativeControlMessageCommon_TemporaryID targetId;  // OCTETSTRING, OPTIONAL;
        struct OPT_INT_ASN roadGrade;  // INTEGER, OPTIONAL, -100..101;
        struct OPT_BYTE_ASN brakePedalPos;  // INTEGER, OPTIONAL, 0..201;
        struct OPT_BYTE_ASN accelPedalPos;  // INTEGER, OPTIONAL, 0..201;
        struct OPT_WORD_ASN desiredSpeed;  // INTEGER, OPTIONAL, 0..8191;
        struct OPT_INT_ASN desiredAccel;  // INTEGER, OPTIONAL, -2000..2001;
        struct OPT_WORD_ASN desiredTorque;  // INTEGER, OPTIONAL, 0..601;
        struct OPT_WORD_ASN desiredTmRetarderTorque;  // INTEGER, OPTIONAL, 0..601;
        struct OPT_WORD_ASN desiredEngRetarderTorque;  // INTEGER, OPTIONAL, 0..601;
        struct CooperativeControlMessageAxesMovement axesMvmt;  // SEQUENCE, OPTIONAL;
        struct OPT_WORD_ASN separationDist;  // INTEGER, OPTIONAL, 0..2001;
        struct OPT_WORD_ASN totalMass;  // INTEGER, OPTIONAL, 0..1288;
        struct OPT_WORD_ASN maxAvailAccel;  // INTEGER, OPTIONAL, 0..2001;
        struct OPT_INT_ASN maxAvailDecel;  // INTEGER, OPTIONAL, -2001..0;
        struct CooperativeControlMessageCCMFaultMode ccmFaultMode;  // BITSTRING, OPTIONAL;
        struct OPT_BYTE_ASN maneuverID;  // INTEGER, OPTIONAL, 0..255, unavailable(0), stayAtRestManCtl(1), stayAtRestAutoLonCtl(2), autoSpdCtlFollowRefTrafAccel(4), transManToAutoSpdCtl(5), stringForm(6), autoJoinString(7), autoCtl(8), increaseGapAutoCtl(9), leftLnChgEndString(10), rightLnChgEndString(11), virtualGapIncDiffLane(12), virtualGapRedDiffLane(13), emgcyIncInterVehDistToStop(14), vehMrgToStringFrmOnramp(15), leftLnChgJoinString(16), rightLnChgJoinString(17), collisionAvoidLnChgOnly(19), collisionAvoidLnChgWthSpdRed(20), collisionAvoidEmgcyStp(21), autoDecelFollowSpdProfile(28), stoppingClosedloopVehFollowCtl(31), stoppngOpenloopDecelCmd(32), brakeToStopManCtl(33), incGapContString(34), incGapRedSpdToStp(35), cruiseCtl(36), adapCruiseCtl(41), coopAdapCruiseCtl(42), manCtl(46), coordAutoBrkForStringWthSvcBrkEngBrk(47), emgcyBrkForStringOnePlusVehWthSvcBrk(48);
        struct OPT_BOOL_ASN frontCutIn;  // BOOLEAN, OPTIONAL;
    };
    
    struct CooperativeControlMessageCCMPartIIcontent_CCMpartIIExtension_table {
        struct CooperativeControlMessageCommon_VehicleSafetyExtensions vehicleSafetyExt;  // SEQUENCE;
        struct CooperativeControlMessageLightVehicleCCMExtensions lightVehicleCCMExt;  // SEQUENCE;
        struct CooperativeControlMessageHeavyTruckCCMExtensions heavyTruckCCMExt;  // SEQUENCE;
    };
    
    struct CooperativeControlMessageCCMPartIIcontent_CCMpartIIExtension {
        INT isValidFlag;   // necessary if this struct is used as an optional field of a SEQUENCE
        BYTE partII_Id;  // INTEGER, 0..63, vehicleSafetyExt(0), lightVehicleCCMExt(1), heavyTruckCCMExt(2);
        struct CooperativeControlMessageCCMPartIIcontent_CCMpartIIExtension_table partII_Value;  // TABLE;
    };
    
    struct CooperativeControlMessageCooperativeControlMessage_partII {
        INT isValidFlag;   // necessary if this struct is used as an optional field of a SEQUENCE
        INT length;
        struct CooperativeControlMessageCCMPartIIcontent_CCMpartIIExtension arrayValue[8];  // SEQUENCE;
    };
    
    struct CooperativeControlMessage_CooperativeControlMessage {
        INT isValidFlag;   // necessary if this struct is used as an optional field of a SEQUENCE
        struct CooperativeControlMessageCommon_BSMcoreData coreData;  // SEQUENCE;
        struct CooperativeControlMessageCooperativeControlMessage_partII partII;  // SEQUENCEOF, OPTIONAL;
    };
    
    struct CooperativeControlMessageMESSAGE_ID_AND_TYPE {
        struct CooperativeControlMessage_CooperativeControlMessage cooperativeControlMessage;  // SEQUENCE;
    };
    
    struct CooperativeControlMessage {
        INT isValidFlag;   // necessary if this struct is used as an optional field of a SEQUENCE
        WORD messageId;  // INTEGER, 0..32767, mapData(18), signalPhaseAndTimingMessage(19), basicSafetyMessage(20), commonSafetyRequest(21), emergencyVehicleAlert(22), intersectionCollision(23), nmeaCorrections(24), probeDataManagement(25), probeVehicleData(26), roadSideAlert(27), rtcmCorrections(28), signalRequestMessage(29), signalStatusMessage(30), travelerInformation(31), personalSafetyMessage(32), roadSafetyMessage(33), roadWeatherMessage(34), probeDataConfigMessage(35), probeDataReportMessage(36), tollAdvertisementMessage(37), tollUsageMessage(38), tollUsageAckMessage(39), cooperativeControlMessage(40), sensorDataSharingMessage(41), maneuverSharingAndCoordinatingMessage(42), roadGeometryAndAttributes(43), personalSafetyMessage2(44), trafficSignalPhaseAndTiming(45), signalControlAndPrioritizationRequest(46), signalControlAndPrioritizationStatus(47), roadUserChargingConfigMessage(48), roadUserChargingReportMessage(49), trafficLightStatusMessage(50);
        struct CooperativeControlMessageMESSAGE_ID_AND_TYPE value;  // TABLE;
    };
    
}

/*
// init function to create a simple packet handle
*/ 
LONG API_InitCooperativeControlMessagePacket()
{
  return C2xInitPacket("CooperativeControlMessage"); 
}

/*
// init function to create a simple packet handle and
// initialize the struct with valid data
*/ 
LONG API_InitCooperativeControlMessagePacket(struct CooperativeControlMessage msgStruct)
{
  long pktHandle;

  pktHandle = API_InitCooperativeControlMessagePacket();

  if (pktHandle != 0)
  {
    // create valid message and application data
    if (C2xCompletePacket(pktHandle) == 0) 
    {
      API_GetCooperativeControlMessageParams(pktHandle, msgStruct);
    }
  }
  return pktHandle;
}

/*
// init function to create a packet with security layer and
// initialize the struct with valid data
*/ 
LONG API_InitCooperativeControlMessagePacket(struct CooperativeControlMessage msgStruct, char packetTypeDesignator[], char certificateName[])
{
  long pktHandle, certHdl;

  // initialize the packet
  pktHandle = C2xInitPacket("CooperativeControlMessage", packetTypeDesignator);

  if (pktHandle != 0)
  {
    certHdl = C2xSecCertificateGetHandle(certificateName);  // get the certificate handle for the cert with name "certificateName"
    if (certHdl != 0) 
    {
      C2xSecPacketSetSignerHandle(pktHandle, certHdl); // set the certHdl to the packet
    }

    // create valid message and application data
    if (C2xCompletePacket(pktHandle) == 0) 
    {
      // copy application data to the application structure
      API_GetCooperativeControlMessageParams(pktHandle, msgStruct);
    }
  }
  return pktHandle;
}
    

int GetCooperativeControlMessageCommon_PositionalAccuracyParams(LONG packetHandle, struct CooperativeControlMessageCommon_PositionalAccuracy value, char oldPath[])
{
  char newPath[300];
  int result;

  result = 0;

  snprintf(newPath, elcount(newPath), "%s.%s", oldPath, "semiMajor");
  value.semiMajor = C2xGetTokenInt(packetHandle, "CooperativeControlMessage", newPath);
  result = CheckLastError("CooperativeControlMessage", gkFuncRefGet, result);

  snprintf(newPath, elcount(newPath), "%s.%s", oldPath, "semiMinor");
  value.semiMinor = C2xGetTokenInt(packetHandle, "CooperativeControlMessage", newPath);
  result = CheckLastError("CooperativeControlMessage", gkFuncRefGet, result);

  snprintf(newPath, elcount(newPath), "%s.%s", oldPath, "orientation");
  value.orientation = C2xGetTokenInt(packetHandle, "CooperativeControlMessage", newPath);
  result = CheckLastError("CooperativeControlMessage", gkFuncRefGet, result);

  return result;
}

int SetCooperativeControlMessageCommon_PositionalAccuracyParams(LONG packetHandle, struct CooperativeControlMessageCommon_PositionalAccuracy value, char oldPath[])
{
  char newPath[300];
  int result;

  result = 0;

  snprintf(newPath, elcount(newPath), "%s.%s", oldPath, "semiMajor");
  C2xSetTokenInt(packetHandle, "CooperativeControlMessage", newPath, value.semiMajor);
  result = CheckLastError("CooperativeControlMessage", gkFuncRefGet, result);

  snprintf(newPath, elcount(newPath), "%s.%s", oldPath, "semiMinor");
  C2xSetTokenInt(packetHandle, "CooperativeControlMessage", newPath, value.semiMinor);
  result = CheckLastError("CooperativeControlMessage", gkFuncRefGet, result);

  snprintf(newPath, elcount(newPath), "%s.%s", oldPath, "orientation");
  C2xSetTokenInt(packetHandle, "CooperativeControlMessage", newPath, value.orientation);
  result = CheckLastError("CooperativeControlMessage", gkFuncRefGet, result);

  return result;
}

int GetCooperativeControlMessageCommon_AccelerationSet4WayParams(LONG packetHandle, struct CooperativeControlMessageCommon_AccelerationSet4Way value, char oldPath[])
{
  char newPath[300];
  int result;

  result = 0;

  snprintf(newPath, elcount(newPath), "%s.%s", oldPath, "lon");
  value.lon = C2xGetTokenInt(packetHandle, "CooperativeControlMessage", newPath);
  result = CheckLastError("CooperativeControlMessage", gkFuncRefGet, result);

  snprintf(newPath, elcount(newPath), "%s.%s", oldPath, "lat");
  value.lat = C2xGetTokenInt(packetHandle, "CooperativeControlMessage", newPath);
  result = CheckLastError("CooperativeControlMessage", gkFuncRefGet, result);

  snprintf(newPath, elcount(newPath), "%s.%s", oldPath, "vert");
  value.vert = C2xGetTokenInt(packetHandle, "CooperativeControlMessage", newPath);
  result = CheckLastError("CooperativeControlMessage", gkFuncRefGet, result);

  snprintf(newPath, elcount(newPath), "%s.%s", oldPath, "yaw");
  value.yaw = C2xGetTokenInt(packetHandle, "CooperativeControlMessage", newPath);
  result = CheckLastError("CooperativeControlMessage", gkFuncRefGet, result);

  return result;
}

int SetCooperativeControlMessageCommon_AccelerationSet4WayParams(LONG packetHandle, struct CooperativeControlMessageCommon_AccelerationSet4Way value, char oldPath[])
{
  char newPath[300];
  int result;

  result = 0;

  snprintf(newPath, elcount(newPath), "%s.%s", oldPath, "lon");
  C2xSetTokenInt(packetHandle, "CooperativeControlMessage", newPath, value.lon);
  result = CheckLastError("CooperativeControlMessage", gkFuncRefGet, result);

  snprintf(newPath, elcount(newPath), "%s.%s", oldPath, "lat");
  C2xSetTokenInt(packetHandle, "CooperativeControlMessage", newPath, value.lat);
  result = CheckLastError("CooperativeControlMessage", gkFuncRefGet, result);

  snprintf(newPath, elcount(newPath), "%s.%s", oldPath, "vert");
  C2xSetTokenInt(packetHandle, "CooperativeControlMessage", newPath, value.vert);
  result = CheckLastError("CooperativeControlMessage", gkFuncRefGet, result);

  snprintf(newPath, elcount(newPath), "%s.%s", oldPath, "yaw");
  C2xSetTokenInt(packetHandle, "CooperativeControlMessage", newPath, value.yaw);
  result = CheckLastError("CooperativeControlMessage", gkFuncRefGet, result);

  return result;
}

int GetCooperativeControlMessageCommon_BrakeSystemStatusParams(LONG packetHandle, struct CooperativeControlMessageCommon_BrakeSystemStatus value, char oldPath[])
{
  char newPath[300]; 
  int j; 
  int k;
  int result;

  result = 0;

  snprintf(newPath, elcount(newPath), "%s.%s", oldPath, "wheelBrakes");
  value.wheelBrakes.isValidFlag = 1;
  value.wheelBrakes.stringLength = C2xGetTokenLengthBit(packetHandle, "CooperativeControlMessage", newPath);
  if ((result = CheckLastError("CooperativeControlMessage", gkFuncRefGet, result))==0)
  {
    if(value.wheelBrakes.stringLength > 0)
    {
      for(j=0; j<value.wheelBrakes.stringLength; j++)
      {
        if(C2xGetTokenBitOfBitString(packetHandle, "CooperativeControlMessage", newPath, j) == 0)
        {
          value.wheelBrakes.string[j] = '0';
        }
        else if(C2xGetTokenBitOfBitString(packetHandle, "CooperativeControlMessage", newPath, j) == 1)
        {
          value.wheelBrakes.string[j] = '1';
        }

        if(value.wheelBrakes.stringLength == 1)
        {
          value.wheelBrakes.string[1] = '0';
        }
        result = CheckLastError("CooperativeControlMessage", gkFuncRefGet, result);
      }
    }
    else
    {
      for(k = value.wheelBrakes.stringLength+1; k > -1; k--)
      {
        if(value.wheelBrakes.string[k] == '1')
        {
          value.wheelBrakes.string[k] = '0';
        }
      }
    }
  }

  snprintf(newPath, elcount(newPath), "%s.%s", oldPath, "traction");
  value.traction = C2xGetTokenInt(packetHandle, "CooperativeControlMessage", newPath);
  result = CheckLastError("CooperativeControlMessage", gkFuncRefGet, result);

  snprintf(newPath, elcount(newPath), "%s.%s", oldPath, "antiLockBrake");
  value.antiLockBrake = C2xGetTokenInt(packetHandle, "CooperativeControlMessage", newPath);
  result = CheckLastError("CooperativeControlMessage", gkFuncRefGet, result);

  snprintf(newPath, elcount(newPath), "%s.%s", oldPath, "scs");
  value.scs = C2xGetTokenInt(packetHandle, "CooperativeControlMessage", newPath);
  result = CheckLastError("CooperativeControlMessage", gkFuncRefGet, result);

  snprintf(newPath, elcount(newPath), "%s.%s", oldPath, "brakeBoost");
  value.brakeBoost = C2xGetTokenInt(packetHandle, "CooperativeControlMessage", newPath);
  result = CheckLastError("CooperativeControlMessage", gkFuncRefGet, result);

  snprintf(newPath, elcount(newPath), "%s.%s", oldPath, "auxBrakes");
  value.auxBrakes = C2xGetTokenInt(packetHandle, "CooperativeControlMessage", newPath);
  result = CheckLastError("CooperativeControlMessage", gkFuncRefGet, result);

  return result;
}

int SetCooperativeControlMessageCommon_BrakeSystemStatusParams(LONG packetHandle, struct CooperativeControlMessageCommon_BrakeSystemStatus value, char oldPath[])
{
  char newPath[300]; 
  int j;
  int result;

  result = 0;

  snprintf(newPath, elcount(newPath), "%s.%s", oldPath, "wheelBrakes");
    for(j=0; j<value.wheelBrakes.stringLength; j++)
    {
      if(value.wheelBrakes.string[j] == '0')
      {
        C2xSetTokenBitOfBitString(packetHandle, "CooperativeControlMessage", newPath, j, 0);
      }
      else
      {
        C2xSetTokenBitOfBitString(packetHandle, "CooperativeControlMessage", newPath, j, 1);
      }
      result = CheckLastError("CooperativeControlMessage", gkFuncRefGet, result);
    }

  snprintf(newPath, elcount(newPath), "%s.%s", oldPath, "traction");
  C2xSetTokenInt(packetHandle, "CooperativeControlMessage", newPath, value.traction);
  result = CheckLastError("CooperativeControlMessage", gkFuncRefGet, result);

  snprintf(newPath, elcount(newPath), "%s.%s", oldPath, "antiLockBrake");
  C2xSetTokenInt(packetHandle, "CooperativeControlMessage", newPath, value.antiLockBrake);
  result = CheckLastError("CooperativeControlMessage", gkFuncRefGet, result);

  snprintf(newPath, elcount(newPath), "%s.%s", oldPath, "scs");
  C2xSetTokenInt(packetHandle, "CooperativeControlMessage", newPath, value.scs);
  result = CheckLastError("CooperativeControlMessage", gkFuncRefGet, result);

  snprintf(newPath, elcount(newPath), "%s.%s", oldPath, "brakeBoost");
  C2xSetTokenInt(packetHandle, "CooperativeControlMessage", newPath, value.brakeBoost);
  result = CheckLastError("CooperativeControlMessage", gkFuncRefGet, result);

  snprintf(newPath, elcount(newPath), "%s.%s", oldPath, "auxBrakes");
  C2xSetTokenInt(packetHandle, "CooperativeControlMessage", newPath, value.auxBrakes);
  result = CheckLastError("CooperativeControlMessage", gkFuncRefGet, result);

  return result;
}

int GetCooperativeControlMessageCommon_VehicleSizeParams(LONG packetHandle, struct CooperativeControlMessageCommon_VehicleSize value, char oldPath[])
{
  char newPath[300];
  int result;

  result = 0;

  snprintf(newPath, elcount(newPath), "%s.%s", oldPath, "width");
  value.width = C2xGetTokenInt(packetHandle, "CooperativeControlMessage", newPath);
  result = CheckLastError("CooperativeControlMessage", gkFuncRefGet, result);

  snprintf(newPath, elcount(newPath), "%s.%s", oldPath, "length");
  value.length = C2xGetTokenInt(packetHandle, "CooperativeControlMessage", newPath);
  result = CheckLastError("CooperativeControlMessage", gkFuncRefGet, result);

  return result;
}

int SetCooperativeControlMessageCommon_VehicleSizeParams(LONG packetHandle, struct CooperativeControlMessageCommon_VehicleSize value, char oldPath[])
{
  char newPath[300];
  int result;

  result = 0;

  snprintf(newPath, elcount(newPath), "%s.%s", oldPath, "width");
  C2xSetTokenInt(packetHandle, "CooperativeControlMessage", newPath, value.width);
  result = CheckLastError("CooperativeControlMessage", gkFuncRefGet, result);

  snprintf(newPath, elcount(newPath), "%s.%s", oldPath, "length");
  C2xSetTokenInt(packetHandle, "CooperativeControlMessage", newPath, value.length);
  result = CheckLastError("CooperativeControlMessage", gkFuncRefGet, result);

  return result;
}

int GetCooperativeControlMessageCommon_BSMcoreDataParams(LONG packetHandle, struct CooperativeControlMessageCommon_BSMcoreData value, char oldPath[])
{
  char newPath[300];
  int result;

  result = 0;

  snprintf(newPath, elcount(newPath), "%s.%s", oldPath, "msgCnt");
  value.msgCnt = C2xGetTokenInt(packetHandle, "CooperativeControlMessage", newPath);
  result = CheckLastError("CooperativeControlMessage", gkFuncRefGet, result);

  snprintf(newPath, elcount(newPath), "%s.%s", oldPath, "id");
  value.id.stringLength = C2xGetTokenData(packetHandle, "CooperativeControlMessage", newPath, elcount(value.id.string), value.id.string);
  snprintf(newPath, elcount(newPath), "%s.%s", oldPath, "secMark");
  value.secMark = C2xGetTokenInt(packetHandle, "CooperativeControlMessage", newPath);
  result = CheckLastError("CooperativeControlMessage", gkFuncRefGet, result);

  snprintf(newPath, elcount(newPath), "%s.%s", oldPath, "lat");
  value.lat = C2xGetTokenInt(packetHandle, "CooperativeControlMessage", newPath);
  result = CheckLastError("CooperativeControlMessage", gkFuncRefGet, result);

  snprintf(newPath, elcount(newPath), "%s.%s", oldPath, "lon");
  value.lon = C2xGetTokenInt(packetHandle, "CooperativeControlMessage", newPath);
  result = CheckLastError("CooperativeControlMessage", gkFuncRefGet, result);

  snprintf(newPath, elcount(newPath), "%s.%s", oldPath, "elev");
  value.elev = C2xGetTokenInt(packetHandle, "CooperativeControlMessage", newPath);
  result = CheckLastError("CooperativeControlMessage", gkFuncRefGet, result);

  snprintf(newPath, elcount(newPath), "%s.%s", oldPath, "accuracy");
  GetCooperativeControlMessageCommon_PositionalAccuracyParams(packetHandle, value.accuracy, newPath);
  result = CheckLastError("CooperativeControlMessage", gkFuncRefGet, result);

  snprintf(newPath, elcount(newPath), "%s.%s", oldPath, "transmission");
  value.transmission = C2xGetTokenInt(packetHandle, "CooperativeControlMessage", newPath);
  result = CheckLastError("CooperativeControlMessage", gkFuncRefGet, result);

  snprintf(newPath, elcount(newPath), "%s.%s", oldPath, "speed");
  value.speed = C2xGetTokenInt(packetHandle, "CooperativeControlMessage", newPath);
  result = CheckLastError("CooperativeControlMessage", gkFuncRefGet, result);

  snprintf(newPath, elcount(newPath), "%s.%s", oldPath, "heading");
  value.heading = C2xGetTokenInt(packetHandle, "CooperativeControlMessage", newPath);
  result = CheckLastError("CooperativeControlMessage", gkFuncRefGet, result);

  snprintf(newPath, elcount(newPath), "%s.%s", oldPath, "angle");
  value.angle = C2xGetTokenInt(packetHandle, "CooperativeControlMessage", newPath);
  result = CheckLastError("CooperativeControlMessage", gkFuncRefGet, result);

  snprintf(newPath, elcount(newPath), "%s.%s", oldPath, "accelSet");
  GetCooperativeControlMessageCommon_AccelerationSet4WayParams(packetHandle, value.accelSet, newPath);
  result = CheckLastError("CooperativeControlMessage", gkFuncRefGet, result);

  snprintf(newPath, elcount(newPath), "%s.%s", oldPath, "brakes");
  GetCooperativeControlMessageCommon_BrakeSystemStatusParams(packetHandle, value.brakes, newPath);
  result = CheckLastError("CooperativeControlMessage", gkFuncRefGet, result);

  snprintf(newPath, elcount(newPath), "%s.%s", oldPath, "size");
  GetCooperativeControlMessageCommon_VehicleSizeParams(packetHandle, value.size, newPath);
  result = CheckLastError("CooperativeControlMessage", gkFuncRefGet, result);

  return result;
}

int SetCooperativeControlMessageCommon_BSMcoreDataParams(LONG packetHandle, struct CooperativeControlMessageCommon_BSMcoreData value, char oldPath[])
{
  char newPath[300];
  int result;

  result = 0;

  snprintf(newPath, elcount(newPath), "%s.%s", oldPath, "msgCnt");
  C2xSetTokenInt(packetHandle, "CooperativeControlMessage", newPath, value.msgCnt);
  result = CheckLastError("CooperativeControlMessage", gkFuncRefGet, result);

  if(value.id.stringLength == 0)
  {
    value.id.stringLength = 4;
    memcpy(value.id.string, "0000", value.id.stringLength);
  }

  snprintf(newPath, elcount(newPath), "%s.%s", oldPath, "id");
  C2xSetTokenData(packetHandle, "CooperativeControlMessage", newPath, value.id.stringLength, value.id.string);

  snprintf(newPath, elcount(newPath), "%s.%s", oldPath, "secMark");
  C2xSetTokenInt(packetHandle, "CooperativeControlMessage", newPath, value.secMark);
  result = CheckLastError("CooperativeControlMessage", gkFuncRefGet, result);

  snprintf(newPath, elcount(newPath), "%s.%s", oldPath, "lat");
  C2xSetTokenInt(packetHandle, "CooperativeControlMessage", newPath, value.lat);
  result = CheckLastError("CooperativeControlMessage", gkFuncRefGet, result);

  snprintf(newPath, elcount(newPath), "%s.%s", oldPath, "lon");
  C2xSetTokenInt(packetHandle, "CooperativeControlMessage", newPath, value.lon);
  result = CheckLastError("CooperativeControlMessage", gkFuncRefGet, result);

  snprintf(newPath, elcount(newPath), "%s.%s", oldPath, "elev");
  C2xSetTokenInt(packetHandle, "CooperativeControlMessage", newPath, value.elev);
  result = CheckLastError("CooperativeControlMessage", gkFuncRefGet, result);

  snprintf(newPath, elcount(newPath), "%s.%s", oldPath, "accuracy");
  SetCooperativeControlMessageCommon_PositionalAccuracyParams(packetHandle, value.accuracy, newPath);
  result = CheckLastError("CooperativeControlMessage", gkFuncRefGet, result);

  snprintf(newPath, elcount(newPath), "%s.%s", oldPath, "transmission");
  C2xSetTokenInt(packetHandle, "CooperativeControlMessage", newPath, value.transmission);
  result = CheckLastError("CooperativeControlMessage", gkFuncRefGet, result);

  snprintf(newPath, elcount(newPath), "%s.%s", oldPath, "speed");
  C2xSetTokenInt(packetHandle, "CooperativeControlMessage", newPath, value.speed);
  result = CheckLastError("CooperativeControlMessage", gkFuncRefGet, result);

  snprintf(newPath, elcount(newPath), "%s.%s", oldPath, "heading");
  C2xSetTokenInt(packetHandle, "CooperativeControlMessage", newPath, value.heading);
  result = CheckLastError("CooperativeControlMessage", gkFuncRefGet, result);

  snprintf(newPath, elcount(newPath), "%s.%s", oldPath, "angle");
  C2xSetTokenInt(packetHandle, "CooperativeControlMessage", newPath, value.angle);
  result = CheckLastError("CooperativeControlMessage", gkFuncRefGet, result);

  snprintf(newPath, elcount(newPath), "%s.%s", oldPath, "accelSet");
  SetCooperativeControlMessageCommon_AccelerationSet4WayParams(packetHandle, value.accelSet, newPath);
  result = CheckLastError("CooperativeControlMessage", gkFuncRefGet, result);

  snprintf(newPath, elcount(newPath), "%s.%s", oldPath, "brakes");
  SetCooperativeControlMessageCommon_BrakeSystemStatusParams(packetHandle, value.brakes, newPath);
  result = CheckLastError("CooperativeControlMessage", gkFuncRefGet, result);

  snprintf(newPath, elcount(newPath), "%s.%s", oldPath, "size");
  SetCooperativeControlMessageCommon_VehicleSizeParams(packetHandle, value.size, newPath);
  result = CheckLastError("CooperativeControlMessage", gkFuncRefGet, result);

  return result;
}

int GetCooperativeControlMessageCommon_DDateTimeParams(LONG packetHandle, struct CooperativeControlMessageCommon_DDateTime value, char oldPath[])
{
  char newPath[300];
  int result;

  result = 0;

  snprintf(newPath, elcount(newPath), "%s.%s", oldPath, "year");
  value.year.isValidFlag = C2xIsTokenAvailable(packetHandle, "CooperativeControlMessage", newPath);
  if(value.year.isValidFlag==1)
  {
    value.year.value = C2xGetTokenInt(packetHandle, "CooperativeControlMessage", newPath);
    result = CheckLastError("CooperativeControlMessage", gkFuncRefGet, result);
  }
  snprintf(newPath, elcount(newPath), "%s.%s", oldPath, "month");
  value.month.isValidFlag = C2xIsTokenAvailable(packetHandle, "CooperativeControlMessage", newPath);
  if(value.month.isValidFlag==1)
  {
    value.month.value = C2xGetTokenInt(packetHandle, "CooperativeControlMessage", newPath);
    result = CheckLastError("CooperativeControlMessage", gkFuncRefGet, result);
  }
  snprintf(newPath, elcount(newPath), "%s.%s", oldPath, "day");
  value.day.isValidFlag = C2xIsTokenAvailable(packetHandle, "CooperativeControlMessage", newPath);
  if(value.day.isValidFlag==1)
  {
    value.day.value = C2xGetTokenInt(packetHandle, "CooperativeControlMessage", newPath);
    result = CheckLastError("CooperativeControlMessage", gkFuncRefGet, result);
  }
  snprintf(newPath, elcount(newPath), "%s.%s", oldPath, "hour");
  value.hour.isValidFlag = C2xIsTokenAvailable(packetHandle, "CooperativeControlMessage", newPath);
  if(value.hour.isValidFlag==1)
  {
    value.hour.value = C2xGetTokenInt(packetHandle, "CooperativeControlMessage", newPath);
    result = CheckLastError("CooperativeControlMessage", gkFuncRefGet, result);
  }
  snprintf(newPath, elcount(newPath), "%s.%s", oldPath, "minute");
  value.minute.isValidFlag = C2xIsTokenAvailable(packetHandle, "CooperativeControlMessage", newPath);
  if(value.minute.isValidFlag==1)
  {
    value.minute.value = C2xGetTokenInt(packetHandle, "CooperativeControlMessage", newPath);
    result = CheckLastError("CooperativeControlMessage", gkFuncRefGet, result);
  }
  snprintf(newPath, elcount(newPath), "%s.%s", oldPath, "second");
  value.second.isValidFlag = C2xIsTokenAvailable(packetHandle, "CooperativeControlMessage", newPath);
  if(value.second.isValidFlag==1)
  {
    value.second.value = C2xGetTokenInt(packetHandle, "CooperativeControlMessage", newPath);
    result = CheckLastError("CooperativeControlMessage", gkFuncRefGet, result);
  }
  snprintf(newPath, elcount(newPath), "%s.%s", oldPath, "offset");
  value.offset.isValidFlag = C2xIsTokenAvailable(packetHandle, "CooperativeControlMessage", newPath);
  if(value.offset.isValidFlag==1)
  {
    value.offset.value = C2xGetTokenInt(packetHandle, "CooperativeControlMessage", newPath);
    result = CheckLastError("CooperativeControlMessage", gkFuncRefGet, result);
  }
  return result;
}

int SetCooperativeControlMessageCommon_DDateTimeParams(LONG packetHandle, struct CooperativeControlMessageCommon_DDateTime value, char oldPath[])
{
  char newPath[300];
  int result;

  result = 0;

  snprintf(newPath, elcount(newPath), "%s.%s", oldPath, "year");
  if(value.year.isValidFlag==1)
  {
    C2xSetTokenInt(packetHandle, "CooperativeControlMessage", newPath, value.year.value);
    result = CheckLastError("CooperativeControlMessage", gkFuncRefGet, result);
  }
  else
  {
    if( C2xIsTokenAvailable(packetHandle, "CooperativeControlMessage", newPath) )
    {
      C2xRemoveToken(packetHandle, "CooperativeControlMessage", newPath);
    }
  }

  snprintf(newPath, elcount(newPath), "%s.%s", oldPath, "month");
  if(value.month.isValidFlag==1)
  {
    C2xSetTokenInt(packetHandle, "CooperativeControlMessage", newPath, value.month.value);
    result = CheckLastError("CooperativeControlMessage", gkFuncRefGet, result);
  }
  else
  {
    if( C2xIsTokenAvailable(packetHandle, "CooperativeControlMessage", newPath) )
    {
      C2xRemoveToken(packetHandle, "CooperativeControlMessage", newPath);
    }
  }

  snprintf(newPath, elcount(newPath), "%s.%s", oldPath, "day");
  if(value.day.isValidFlag==1)
  {
    C2xSetTokenInt(packetHandle, "CooperativeControlMessage", newPath, value.day.value);
    result = CheckLastError("CooperativeControlMessage", gkFuncRefGet, result);
  }
  else
  {
    if( C2xIsTokenAvailable(packetHandle, "CooperativeControlMessage", newPath) )
    {
      C2xRemoveToken(packetHandle, "CooperativeControlMessage", newPath);
    }
  }

  snprintf(newPath, elcount(newPath), "%s.%s", oldPath, "hour");
  if(value.hour.isValidFlag==1)
  {
    C2xSetTokenInt(packetHandle, "CooperativeControlMessage", newPath, value.hour.value);
    result = CheckLastError("CooperativeControlMessage", gkFuncRefGet, result);
  }
  else
  {
    if( C2xIsTokenAvailable(packetHandle, "CooperativeControlMessage", newPath) )
    {
      C2xRemoveToken(packetHandle, "CooperativeControlMessage", newPath);
    }
  }

  snprintf(newPath, elcount(newPath), "%s.%s", oldPath, "minute");
  if(value.minute.isValidFlag==1)
  {
    C2xSetTokenInt(packetHandle, "CooperativeControlMessage", newPath, value.minute.value);
    result = CheckLastError("CooperativeControlMessage", gkFuncRefGet, result);
  }
  else
  {
    if( C2xIsTokenAvailable(packetHandle, "CooperativeControlMessage", newPath) )
    {
      C2xRemoveToken(packetHandle, "CooperativeControlMessage", newPath);
    }
  }

  snprintf(newPath, elcount(newPath), "%s.%s", oldPath, "second");
  if(value.second.isValidFlag==1)
  {
    C2xSetTokenInt(packetHandle, "CooperativeControlMessage", newPath, value.second.value);
    result = CheckLastError("CooperativeControlMessage", gkFuncRefGet, result);
  }
  else
  {
    if( C2xIsTokenAvailable(packetHandle, "CooperativeControlMessage", newPath) )
    {
      C2xRemoveToken(packetHandle, "CooperativeControlMessage", newPath);
    }
  }

  snprintf(newPath, elcount(newPath), "%s.%s", oldPath, "offset");
  if(value.offset.isValidFlag==1)
  {
    C2xSetTokenInt(packetHandle, "CooperativeControlMessage", newPath, value.offset.value);
    result = CheckLastError("CooperativeControlMessage", gkFuncRefGet, result);
  }
  else
  {
    if( C2xIsTokenAvailable(packetHandle, "CooperativeControlMessage", newPath) )
    {
      C2xRemoveToken(packetHandle, "CooperativeControlMessage", newPath);
    }
  }

  return result;
}

int GetCooperativeControlMessageCommon_TransmissionAndSpeedParams(LONG packetHandle, struct CooperativeControlMessageCommon_TransmissionAndSpeed value, char oldPath[])
{
  char newPath[300];
  int result;

  result = 0;

  snprintf(newPath, elcount(newPath), "%s.%s", oldPath, "transmisson");
  value.transmisson = C2xGetTokenInt(packetHandle, "CooperativeControlMessage", newPath);
  result = CheckLastError("CooperativeControlMessage", gkFuncRefGet, result);

  snprintf(newPath, elcount(newPath), "%s.%s", oldPath, "speed");
  value.speed = C2xGetTokenInt(packetHandle, "CooperativeControlMessage", newPath);
  result = CheckLastError("CooperativeControlMessage", gkFuncRefGet, result);

  return result;
}

int SetCooperativeControlMessageCommon_TransmissionAndSpeedParams(LONG packetHandle, struct CooperativeControlMessageCommon_TransmissionAndSpeed value, char oldPath[])
{
  char newPath[300];
  int result;

  result = 0;

  snprintf(newPath, elcount(newPath), "%s.%s", oldPath, "transmisson");
  C2xSetTokenInt(packetHandle, "CooperativeControlMessage", newPath, value.transmisson);
  result = CheckLastError("CooperativeControlMessage", gkFuncRefGet, result);

  snprintf(newPath, elcount(newPath), "%s.%s", oldPath, "speed");
  C2xSetTokenInt(packetHandle, "CooperativeControlMessage", newPath, value.speed);
  result = CheckLastError("CooperativeControlMessage", gkFuncRefGet, result);

  return result;
}

int GetCooperativeControlMessageCommon_PositionConfidenceSetParams(LONG packetHandle, struct CooperativeControlMessageCommon_PositionConfidenceSet value, char oldPath[])
{
  char newPath[300];
  int result;

  result = 0;

  snprintf(newPath, elcount(newPath), "%s.%s", oldPath, "pos");
  value.pos = C2xGetTokenInt(packetHandle, "CooperativeControlMessage", newPath);
  result = CheckLastError("CooperativeControlMessage", gkFuncRefGet, result);

  snprintf(newPath, elcount(newPath), "%s.%s", oldPath, "elevation");
  value.elevation = C2xGetTokenInt(packetHandle, "CooperativeControlMessage", newPath);
  result = CheckLastError("CooperativeControlMessage", gkFuncRefGet, result);

  return result;
}

int SetCooperativeControlMessageCommon_PositionConfidenceSetParams(LONG packetHandle, struct CooperativeControlMessageCommon_PositionConfidenceSet value, char oldPath[])
{
  char newPath[300];
  int result;

  result = 0;

  snprintf(newPath, elcount(newPath), "%s.%s", oldPath, "pos");
  C2xSetTokenInt(packetHandle, "CooperativeControlMessage", newPath, value.pos);
  result = CheckLastError("CooperativeControlMessage", gkFuncRefGet, result);

  snprintf(newPath, elcount(newPath), "%s.%s", oldPath, "elevation");
  C2xSetTokenInt(packetHandle, "CooperativeControlMessage", newPath, value.elevation);
  result = CheckLastError("CooperativeControlMessage", gkFuncRefGet, result);

  return result;
}

int GetCooperativeControlMessageCommon_SpeedandHeadingandThrottleConfidenceParams(LONG packetHandle, struct CooperativeControlMessageCommon_SpeedandHeadingandThrottleConfidence value, char oldPath[])
{
  char newPath[300];
  int result;

  result = 0;

  snprintf(newPath, elcount(newPath), "%s.%s", oldPath, "heading");
  value.heading = C2xGetTokenInt(packetHandle, "CooperativeControlMessage", newPath);
  result = CheckLastError("CooperativeControlMessage", gkFuncRefGet, result);

  snprintf(newPath, elcount(newPath), "%s.%s", oldPath, "speed");
  value.speed = C2xGetTokenInt(packetHandle, "CooperativeControlMessage", newPath);
  result = CheckLastError("CooperativeControlMessage", gkFuncRefGet, result);

  snprintf(newPath, elcount(newPath), "%s.%s", oldPath, "throttle");
  value.throttle = C2xGetTokenInt(packetHandle, "CooperativeControlMessage", newPath);
  result = CheckLastError("CooperativeControlMessage", gkFuncRefGet, result);

  return result;
}

int SetCooperativeControlMessageCommon_SpeedandHeadingandThrottleConfidenceParams(LONG packetHandle, struct CooperativeControlMessageCommon_SpeedandHeadingandThrottleConfidence value, char oldPath[])
{
  char newPath[300];
  int result;

  result = 0;

  snprintf(newPath, elcount(newPath), "%s.%s", oldPath, "heading");
  C2xSetTokenInt(packetHandle, "CooperativeControlMessage", newPath, value.heading);
  result = CheckLastError("CooperativeControlMessage", gkFuncRefGet, result);

  snprintf(newPath, elcount(newPath), "%s.%s", oldPath, "speed");
  C2xSetTokenInt(packetHandle, "CooperativeControlMessage", newPath, value.speed);
  result = CheckLastError("CooperativeControlMessage", gkFuncRefGet, result);

  snprintf(newPath, elcount(newPath), "%s.%s", oldPath, "throttle");
  C2xSetTokenInt(packetHandle, "CooperativeControlMessage", newPath, value.throttle);
  result = CheckLastError("CooperativeControlMessage", gkFuncRefGet, result);

  return result;
}

int GetCooperativeControlMessageCommon_FullPositionVectorParams(LONG packetHandle, struct CooperativeControlMessageCommon_FullPositionVector value, char oldPath[])
{
  char newPath[300];
  int result;

  result = 0;

  snprintf(newPath, elcount(newPath), "%s.%s", oldPath, "utcTime");
  value.utcTime.isValidFlag = C2xIsTokenAvailable(packetHandle, "CooperativeControlMessage", newPath);
  if(value.utcTime.isValidFlag==1)
  {
    GetCooperativeControlMessageCommon_DDateTimeParams(packetHandle, value.utcTime, newPath);
    result = CheckLastError("CooperativeControlMessage", gkFuncRefGet, result);
  }
  snprintf(newPath, elcount(newPath), "%s.%s", oldPath, "lon");
  value.lon = C2xGetTokenInt(packetHandle, "CooperativeControlMessage", newPath);
  result = CheckLastError("CooperativeControlMessage", gkFuncRefGet, result);

  snprintf(newPath, elcount(newPath), "%s.%s", oldPath, "lat");
  value.lat = C2xGetTokenInt(packetHandle, "CooperativeControlMessage", newPath);
  result = CheckLastError("CooperativeControlMessage", gkFuncRefGet, result);

  snprintf(newPath, elcount(newPath), "%s.%s", oldPath, "elevation");
  value.elevation.isValidFlag = C2xIsTokenAvailable(packetHandle, "CooperativeControlMessage", newPath);
  if(value.elevation.isValidFlag==1)
  {
    value.elevation.value = C2xGetTokenInt(packetHandle, "CooperativeControlMessage", newPath);
    result = CheckLastError("CooperativeControlMessage", gkFuncRefGet, result);
  }
  snprintf(newPath, elcount(newPath), "%s.%s", oldPath, "heading");
  value.heading.isValidFlag = C2xIsTokenAvailable(packetHandle, "CooperativeControlMessage", newPath);
  if(value.heading.isValidFlag==1)
  {
    value.heading.value = C2xGetTokenInt(packetHandle, "CooperativeControlMessage", newPath);
    result = CheckLastError("CooperativeControlMessage", gkFuncRefGet, result);
  }
  snprintf(newPath, elcount(newPath), "%s.%s", oldPath, "speed");
  value.speed.isValidFlag = C2xIsTokenAvailable(packetHandle, "CooperativeControlMessage", newPath);
  if(value.speed.isValidFlag==1)
  {
    GetCooperativeControlMessageCommon_TransmissionAndSpeedParams(packetHandle, value.speed, newPath);
    result = CheckLastError("CooperativeControlMessage", gkFuncRefGet, result);
  }
  snprintf(newPath, elcount(newPath), "%s.%s", oldPath, "posAccuracy");
  value.posAccuracy.isValidFlag = C2xIsTokenAvailable(packetHandle, "CooperativeControlMessage", newPath);
  if(value.posAccuracy.isValidFlag==1)
  {
    GetCooperativeControlMessageCommon_PositionalAccuracyParams(packetHandle, value.posAccuracy, newPath);
    result = CheckLastError("CooperativeControlMessage", gkFuncRefGet, result);
  }
  snprintf(newPath, elcount(newPath), "%s.%s", oldPath, "timeConfidence");
  value.timeConfidence.isValidFlag = C2xIsTokenAvailable(packetHandle, "CooperativeControlMessage", newPath);
  if(value.timeConfidence.isValidFlag==1)
  {
    value.timeConfidence.value = C2xGetTokenInt(packetHandle, "CooperativeControlMessage", newPath);
    result = CheckLastError("CooperativeControlMessage", gkFuncRefGet, result);
  }
  snprintf(newPath, elcount(newPath), "%s.%s", oldPath, "posConfidence");
  value.posConfidence.isValidFlag = C2xIsTokenAvailable(packetHandle, "CooperativeControlMessage", newPath);
  if(value.posConfidence.isValidFlag==1)
  {
    GetCooperativeControlMessageCommon_PositionConfidenceSetParams(packetHandle, value.posConfidence, newPath);
    result = CheckLastError("CooperativeControlMessage", gkFuncRefGet, result);
  }
  snprintf(newPath, elcount(newPath), "%s.%s", oldPath, "speedConfidence");
  value.speedConfidence.isValidFlag = C2xIsTokenAvailable(packetHandle, "CooperativeControlMessage", newPath);
  if(value.speedConfidence.isValidFlag==1)
  {
    GetCooperativeControlMessageCommon_SpeedandHeadingandThrottleConfidenceParams(packetHandle, value.speedConfidence, newPath);
    result = CheckLastError("CooperativeControlMessage", gkFuncRefGet, result);
  }
  return result;
}

int SetCooperativeControlMessageCommon_FullPositionVectorParams(LONG packetHandle, struct CooperativeControlMessageCommon_FullPositionVector value, char oldPath[])
{
  char newPath[300];
  int result;

  result = 0;

  snprintf(newPath, elcount(newPath), "%s.%s", oldPath, "utcTime");
  if(value.utcTime.isValidFlag==1)
  {
    SetCooperativeControlMessageCommon_DDateTimeParams(packetHandle, value.utcTime, newPath);
    result = CheckLastError("CooperativeControlMessage", gkFuncRefGet, result);
  }
  else
  {
    if( C2xIsTokenAvailable(packetHandle, "CooperativeControlMessage", newPath) )
    {
      C2xRemoveToken(packetHandle, "CooperativeControlMessage", newPath);
    }
  }

  snprintf(newPath, elcount(newPath), "%s.%s", oldPath, "lon");
  C2xSetTokenInt(packetHandle, "CooperativeControlMessage", newPath, value.lon);
  result = CheckLastError("CooperativeControlMessage", gkFuncRefGet, result);

  snprintf(newPath, elcount(newPath), "%s.%s", oldPath, "lat");
  C2xSetTokenInt(packetHandle, "CooperativeControlMessage", newPath, value.lat);
  result = CheckLastError("CooperativeControlMessage", gkFuncRefGet, result);

  snprintf(newPath, elcount(newPath), "%s.%s", oldPath, "elevation");
  if(value.elevation.isValidFlag==1)
  {
    C2xSetTokenInt(packetHandle, "CooperativeControlMessage", newPath, value.elevation.value);
    result = CheckLastError("CooperativeControlMessage", gkFuncRefGet, result);
  }
  else
  {
    if( C2xIsTokenAvailable(packetHandle, "CooperativeControlMessage", newPath) )
    {
      C2xRemoveToken(packetHandle, "CooperativeControlMessage", newPath);
    }
  }

  snprintf(newPath, elcount(newPath), "%s.%s", oldPath, "heading");
  if(value.heading.isValidFlag==1)
  {
    C2xSetTokenInt(packetHandle, "CooperativeControlMessage", newPath, value.heading.value);
    result = CheckLastError("CooperativeControlMessage", gkFuncRefGet, result);
  }
  else
  {
    if( C2xIsTokenAvailable(packetHandle, "CooperativeControlMessage", newPath) )
    {
      C2xRemoveToken(packetHandle, "CooperativeControlMessage", newPath);
    }
  }

  snprintf(newPath, elcount(newPath), "%s.%s", oldPath, "speed");
  if(value.speed.isValidFlag==1)
  {
    SetCooperativeControlMessageCommon_TransmissionAndSpeedParams(packetHandle, value.speed, newPath);
    result = CheckLastError("CooperativeControlMessage", gkFuncRefGet, result);
  }
  else
  {
    if( C2xIsTokenAvailable(packetHandle, "CooperativeControlMessage", newPath) )
    {
      C2xRemoveToken(packetHandle, "CooperativeControlMessage", newPath);
    }
  }

  snprintf(newPath, elcount(newPath), "%s.%s", oldPath, "posAccuracy");
  if(value.posAccuracy.isValidFlag==1)
  {
    SetCooperativeControlMessageCommon_PositionalAccuracyParams(packetHandle, value.posAccuracy, newPath);
    result = CheckLastError("CooperativeControlMessage", gkFuncRefGet, result);
  }
  else
  {
    if( C2xIsTokenAvailable(packetHandle, "CooperativeControlMessage", newPath) )
    {
      C2xRemoveToken(packetHandle, "CooperativeControlMessage", newPath);
    }
  }

  snprintf(newPath, elcount(newPath), "%s.%s", oldPath, "timeConfidence");
  if(value.timeConfidence.isValidFlag==1)
  {
    C2xSetTokenInt(packetHandle, "CooperativeControlMessage", newPath, value.timeConfidence.value);
    result = CheckLastError("CooperativeControlMessage", gkFuncRefGet, result);
  }
  else
  {
    if( C2xIsTokenAvailable(packetHandle, "CooperativeControlMessage", newPath) )
    {
      C2xRemoveToken(packetHandle, "CooperativeControlMessage", newPath);
    }
  }

  snprintf(newPath, elcount(newPath), "%s.%s", oldPath, "posConfidence");
  if(value.posConfidence.isValidFlag==1)
  {
    SetCooperativeControlMessageCommon_PositionConfidenceSetParams(packetHandle, value.posConfidence, newPath);
    result = CheckLastError("CooperativeControlMessage", gkFuncRefGet, result);
  }
  else
  {
    if( C2xIsTokenAvailable(packetHandle, "CooperativeControlMessage", newPath) )
    {
      C2xRemoveToken(packetHandle, "CooperativeControlMessage", newPath);
    }
  }

  snprintf(newPath, elcount(newPath), "%s.%s", oldPath, "speedConfidence");
  if(value.speedConfidence.isValidFlag==1)
  {
    SetCooperativeControlMessageCommon_SpeedandHeadingandThrottleConfidenceParams(packetHandle, value.speedConfidence, newPath);
    result = CheckLastError("CooperativeControlMessage", gkFuncRefGet, result);
  }
  else
  {
    if( C2xIsTokenAvailable(packetHandle, "CooperativeControlMessage", newPath) )
    {
      C2xRemoveToken(packetHandle, "CooperativeControlMessage", newPath);
    }
  }

  return result;
}

int GetCooperativeControlMessageCommon_PathHistoryPointParams(LONG packetHandle, struct CooperativeControlMessageCommon_PathHistoryPoint value, char oldPath[])
{
  char newPath[300];
  int result;

  result = 0;

  snprintf(newPath, elcount(newPath), "%s.%s", oldPath, "latOffset");
  value.latOffset = C2xGetTokenInt(packetHandle, "CooperativeControlMessage", newPath);
  result = CheckLastError("CooperativeControlMessage", gkFuncRefGet, result);

  snprintf(newPath, elcount(newPath), "%s.%s", oldPath, "lonOffset");
  value.lonOffset = C2xGetTokenInt(packetHandle, "CooperativeControlMessage", newPath);
  result = CheckLastError("CooperativeControlMessage", gkFuncRefGet, result);

  snprintf(newPath, elcount(newPath), "%s.%s", oldPath, "elevationOffset");
  value.elevationOffset = C2xGetTokenInt(packetHandle, "CooperativeControlMessage", newPath);
  result = CheckLastError("CooperativeControlMessage", gkFuncRefGet, result);

  snprintf(newPath, elcount(newPath), "%s.%s", oldPath, "timeOffset");
  value.timeOffset = C2xGetTokenInt(packetHandle, "CooperativeControlMessage", newPath);
  result = CheckLastError("CooperativeControlMessage", gkFuncRefGet, result);

  snprintf(newPath, elcount(newPath), "%s.%s", oldPath, "speed");
  value.speed.isValidFlag = C2xIsTokenAvailable(packetHandle, "CooperativeControlMessage", newPath);
  if(value.speed.isValidFlag==1)
  {
    value.speed.value = C2xGetTokenInt(packetHandle, "CooperativeControlMessage", newPath);
    result = CheckLastError("CooperativeControlMessage", gkFuncRefGet, result);
  }
  snprintf(newPath, elcount(newPath), "%s.%s", oldPath, "posAccuracy");
  value.posAccuracy.isValidFlag = C2xIsTokenAvailable(packetHandle, "CooperativeControlMessage", newPath);
  if(value.posAccuracy.isValidFlag==1)
  {
    GetCooperativeControlMessageCommon_PositionalAccuracyParams(packetHandle, value.posAccuracy, newPath);
    result = CheckLastError("CooperativeControlMessage", gkFuncRefGet, result);
  }
  snprintf(newPath, elcount(newPath), "%s.%s", oldPath, "heading");
  value.heading.isValidFlag = C2xIsTokenAvailable(packetHandle, "CooperativeControlMessage", newPath);
  if(value.heading.isValidFlag==1)
  {
    value.heading.value = C2xGetTokenInt(packetHandle, "CooperativeControlMessage", newPath);
    result = CheckLastError("CooperativeControlMessage", gkFuncRefGet, result);
  }
  return result;
}

int SetCooperativeControlMessageCommon_PathHistoryPointParams(LONG packetHandle, struct CooperativeControlMessageCommon_PathHistoryPoint value, char oldPath[])
{
  char newPath[300];
  int result;

  result = 0;

  snprintf(newPath, elcount(newPath), "%s.%s", oldPath, "latOffset");
  C2xSetTokenInt(packetHandle, "CooperativeControlMessage", newPath, value.latOffset);
  result = CheckLastError("CooperativeControlMessage", gkFuncRefGet, result);

  snprintf(newPath, elcount(newPath), "%s.%s", oldPath, "lonOffset");
  C2xSetTokenInt(packetHandle, "CooperativeControlMessage", newPath, value.lonOffset);
  result = CheckLastError("CooperativeControlMessage", gkFuncRefGet, result);

  snprintf(newPath, elcount(newPath), "%s.%s", oldPath, "elevationOffset");
  C2xSetTokenInt(packetHandle, "CooperativeControlMessage", newPath, value.elevationOffset);
  result = CheckLastError("CooperativeControlMessage", gkFuncRefGet, result);

  snprintf(newPath, elcount(newPath), "%s.%s", oldPath, "timeOffset");
  if (value.timeOffset < 1)
  {
    C2xSetTokenInt(packetHandle, "CooperativeControlMessage", newPath, 1);
  }
  else if (value.timeOffset > 65535)
  {
    C2xSetTokenInt(packetHandle, "CooperativeControlMessage", newPath, 65535);
  }
  else
  {
    C2xSetTokenInt(packetHandle, "CooperativeControlMessage", newPath, value.timeOffset);
  }
  result = CheckLastError("CooperativeControlMessage", gkFuncRefGet, result);

  snprintf(newPath, elcount(newPath), "%s.%s", oldPath, "speed");
  if(value.speed.isValidFlag==1)
  {
    C2xSetTokenInt(packetHandle, "CooperativeControlMessage", newPath, value.speed.value);
    result = CheckLastError("CooperativeControlMessage", gkFuncRefGet, result);
  }
  else
  {
    if( C2xIsTokenAvailable(packetHandle, "CooperativeControlMessage", newPath) )
    {
      C2xRemoveToken(packetHandle, "CooperativeControlMessage", newPath);
    }
  }

  snprintf(newPath, elcount(newPath), "%s.%s", oldPath, "posAccuracy");
  if(value.posAccuracy.isValidFlag==1)
  {
    SetCooperativeControlMessageCommon_PositionalAccuracyParams(packetHandle, value.posAccuracy, newPath);
    result = CheckLastError("CooperativeControlMessage", gkFuncRefGet, result);
  }
  else
  {
    if( C2xIsTokenAvailable(packetHandle, "CooperativeControlMessage", newPath) )
    {
      C2xRemoveToken(packetHandle, "CooperativeControlMessage", newPath);
    }
  }

  snprintf(newPath, elcount(newPath), "%s.%s", oldPath, "heading");
  if(value.heading.isValidFlag==1)
  {
    C2xSetTokenInt(packetHandle, "CooperativeControlMessage", newPath, value.heading.value);
    result = CheckLastError("CooperativeControlMessage", gkFuncRefGet, result);
  }
  else
  {
    if( C2xIsTokenAvailable(packetHandle, "CooperativeControlMessage", newPath) )
    {
      C2xRemoveToken(packetHandle, "CooperativeControlMessage", newPath);
    }
  }

  return result;
}

int GetCooperativeControlMessageCommon_PathHistoryPointListParams(LONG packetHandle, struct CooperativeControlMessageCommon_PathHistoryPointList value, char oldPath[])
{
  char newPath[300]; 
  int i;
  int result;

  result = 0;

  value.length = C2xGetTokenInt(packetHandle, "CooperativeControlMessage", oldPath);
  if((result = CheckLastError("CooperativeControlMessage", gkFuncRefGet, result))==0)
  {
    for(i=0; i<value.length; i++)
    {
      snprintf(newPath, elcount(newPath), "%s[%d]", oldPath, i);
      GetCooperativeControlMessageCommon_PathHistoryPointParams(packetHandle, value.arrayValue[i], newPath);
      result = CheckLastError("CooperativeControlMessage", gkFuncRefGet, result);
    }
  }
  return result;
}

int SetCooperativeControlMessageCommon_PathHistoryPointListParams(LONG packetHandle, struct CooperativeControlMessageCommon_PathHistoryPointList value, char oldPath[])
{
  char newPath[300]; 
  int i;
  int result;

  result = 0;

  C2xRemoveToken(packetHandle, "CooperativeControlMessage", oldPath);
  for(i=0; i<value.length; i++)
  {
    snprintf(newPath, elcount(newPath), "%s[%d]", oldPath, i);
    SetCooperativeControlMessageCommon_PathHistoryPointParams(packetHandle, value.arrayValue[i], newPath);
    result = CheckLastError("CooperativeControlMessage", gkFuncRefGet, result);
  }
  return result;
}

int GetCooperativeControlMessageCommon_PathHistoryParams(LONG packetHandle, struct CooperativeControlMessageCommon_PathHistory value, char oldPath[])
{
  char newPath[300]; 
  int j; 
  int k;
  int result;

  result = 0;

  snprintf(newPath, elcount(newPath), "%s.%s", oldPath, "initialPosition");
  value.initialPosition.isValidFlag = C2xIsTokenAvailable(packetHandle, "CooperativeControlMessage", newPath);
  if(value.initialPosition.isValidFlag==1)
  {
    GetCooperativeControlMessageCommon_FullPositionVectorParams(packetHandle, value.initialPosition, newPath);
    result = CheckLastError("CooperativeControlMessage", gkFuncRefGet, result);
  }
  snprintf(newPath, elcount(newPath), "%s.%s", oldPath, "currGNSSstatus");
  value.currGNSSstatus.isValidFlag = C2xIsTokenAvailable(packetHandle, "CooperativeControlMessage", newPath);
  if(value.currGNSSstatus.isValidFlag==1)
  {
    value.currGNSSstatus.isValidFlag = 1;
    value.currGNSSstatus.stringLength = C2xGetTokenLengthBit(packetHandle, "CooperativeControlMessage", newPath);
    if ((result = CheckLastError("CooperativeControlMessage", gkFuncRefGet, result))==0)
    {
      if(value.currGNSSstatus.stringLength > 0)
      {
        for(j=0; j<value.currGNSSstatus.stringLength; j++)
        {
          if(C2xGetTokenBitOfBitString(packetHandle, "CooperativeControlMessage", newPath, j) == 0)
          {
            value.currGNSSstatus.string[j] = '0';
          }
          else if(C2xGetTokenBitOfBitString(packetHandle, "CooperativeControlMessage", newPath, j) == 1)
          {
            value.currGNSSstatus.string[j] = '1';
          }

          if(value.currGNSSstatus.stringLength == 1)
          {
            value.currGNSSstatus.string[1] = '0';
          }
          result = CheckLastError("CooperativeControlMessage", gkFuncRefGet, result);
        }
      }
      else
      {
        for(k = value.currGNSSstatus.stringLength+1; k > -1; k--)
        {
          if(value.currGNSSstatus.string[k] == '1')
          {
            value.currGNSSstatus.string[k] = '0';
          }
        }
      }
    }

  }
  snprintf(newPath, elcount(newPath), "%s.%s", oldPath, "crumbData");
  GetCooperativeControlMessageCommon_PathHistoryPointListParams(packetHandle, value.crumbData, newPath);
  result = CheckLastError("CooperativeControlMessage", gkFuncRefGet, result);

  return result;
}

int SetCooperativeControlMessageCommon_PathHistoryParams(LONG packetHandle, struct CooperativeControlMessageCommon_PathHistory value, char oldPath[])
{
  char newPath[300]; 
  int j;
  int result;

  result = 0;

  snprintf(newPath, elcount(newPath), "%s.%s", oldPath, "initialPosition");
  if(value.initialPosition.isValidFlag==1)
  {
    SetCooperativeControlMessageCommon_FullPositionVectorParams(packetHandle, value.initialPosition, newPath);
    result = CheckLastError("CooperativeControlMessage", gkFuncRefGet, result);
  }
  else
  {
    if( C2xIsTokenAvailable(packetHandle, "CooperativeControlMessage", newPath) )
    {
      C2xRemoveToken(packetHandle, "CooperativeControlMessage", newPath);
    }
  }

  snprintf(newPath, elcount(newPath), "%s.%s", oldPath, "currGNSSstatus");
  if(value.currGNSSstatus.isValidFlag==1)
  {
      for(j=0; j<value.currGNSSstatus.stringLength; j++)
      {
        if(value.currGNSSstatus.string[j] == '0')
        {
          C2xSetTokenBitOfBitString(packetHandle, "CooperativeControlMessage", newPath, j, 0);
        }
        else
        {
          C2xSetTokenBitOfBitString(packetHandle, "CooperativeControlMessage", newPath, j, 1);
        }
        result = CheckLastError("CooperativeControlMessage", gkFuncRefGet, result);
      }
  }
  else
  {
    if( C2xIsTokenAvailable(packetHandle, "CooperativeControlMessage", newPath) )
    {
      C2xRemoveToken(packetHandle, "CooperativeControlMessage", newPath);
    }
  }

  snprintf(newPath, elcount(newPath), "%s.%s", oldPath, "crumbData");
  SetCooperativeControlMessageCommon_PathHistoryPointListParams(packetHandle, value.crumbData, newPath);
  result = CheckLastError("CooperativeControlMessage", gkFuncRefGet, result);

  return result;
}

int GetCooperativeControlMessageCommon_PathPredictionParams(LONG packetHandle, struct CooperativeControlMessageCommon_PathPrediction value, char oldPath[])
{
  char newPath[300];
  int result;

  result = 0;

  snprintf(newPath, elcount(newPath), "%s.%s", oldPath, "radiusOfCurve");
  value.radiusOfCurve = C2xGetTokenInt(packetHandle, "CooperativeControlMessage", newPath);
  result = CheckLastError("CooperativeControlMessage", gkFuncRefGet, result);

  snprintf(newPath, elcount(newPath), "%s.%s", oldPath, "confidence");
  value.confidence = C2xGetTokenInt(packetHandle, "CooperativeControlMessage", newPath);
  result = CheckLastError("CooperativeControlMessage", gkFuncRefGet, result);

  return result;
}

int SetCooperativeControlMessageCommon_PathPredictionParams(LONG packetHandle, struct CooperativeControlMessageCommon_PathPrediction value, char oldPath[])
{
  char newPath[300];
  int result;

  result = 0;

  snprintf(newPath, elcount(newPath), "%s.%s", oldPath, "radiusOfCurve");
  C2xSetTokenInt(packetHandle, "CooperativeControlMessage", newPath, value.radiusOfCurve);
  result = CheckLastError("CooperativeControlMessage", gkFuncRefGet, result);

  snprintf(newPath, elcount(newPath), "%s.%s", oldPath, "confidence");
  C2xSetTokenInt(packetHandle, "CooperativeControlMessage", newPath, value.confidence);
  result = CheckLastError("CooperativeControlMessage", gkFuncRefGet, result);

  return result;
}

int GetCooperativeControlMessageCommon_VehicleSafetyExtensionsParams(LONG packetHandle, struct CooperativeControlMessageCommon_VehicleSafetyExtensions value, char oldPath[])
{
  char newPath[300]; 
  int j; 
  int k;
  int result;

  result = 0;

  snprintf(newPath, elcount(newPath), "%s.%s", oldPath, "events");
  value.events.isValidFlag = C2xIsTokenAvailable(packetHandle, "CooperativeControlMessage", newPath);
  if(value.events.isValidFlag==1)
  {
    value.events.isValidFlag = 1;
    value.events.stringLength = C2xGetTokenLengthBit(packetHandle, "CooperativeControlMessage", newPath);
    if ((result = CheckLastError("CooperativeControlMessage", gkFuncRefGet, result))==0)
    {
      if(value.events.stringLength > 0)
      {
        for(j=0; j<value.events.stringLength; j++)
        {
          if(C2xGetTokenBitOfBitString(packetHandle, "CooperativeControlMessage", newPath, j) == 0)
          {
            value.events.string[j] = '0';
          }
          else if(C2xGetTokenBitOfBitString(packetHandle, "CooperativeControlMessage", newPath, j) == 1)
          {
            value.events.string[j] = '1';
          }

          if(value.events.stringLength == 1)
          {
            value.events.string[1] = '0';
          }
          result = CheckLastError("CooperativeControlMessage", gkFuncRefGet, result);
        }
      }
      else
      {
        for(k = value.events.stringLength+1; k > -1; k--)
        {
          if(value.events.string[k] == '1')
          {
            value.events.string[k] = '0';
          }
        }
      }
    }

  }
  snprintf(newPath, elcount(newPath), "%s.%s", oldPath, "pathHistory");
  value.pathHistory.isValidFlag = C2xIsTokenAvailable(packetHandle, "CooperativeControlMessage", newPath);
  if(value.pathHistory.isValidFlag==1)
  {
    GetCooperativeControlMessageCommon_PathHistoryParams(packetHandle, value.pathHistory, newPath);
    result = CheckLastError("CooperativeControlMessage", gkFuncRefGet, result);
  }
  snprintf(newPath, elcount(newPath), "%s.%s", oldPath, "pathPrediction");
  value.pathPrediction.isValidFlag = C2xIsTokenAvailable(packetHandle, "CooperativeControlMessage", newPath);
  if(value.pathPrediction.isValidFlag==1)
  {
    GetCooperativeControlMessageCommon_PathPredictionParams(packetHandle, value.pathPrediction, newPath);
    result = CheckLastError("CooperativeControlMessage", gkFuncRefGet, result);
  }
  snprintf(newPath, elcount(newPath), "%s.%s", oldPath, "lights");
  value.lights.isValidFlag = C2xIsTokenAvailable(packetHandle, "CooperativeControlMessage", newPath);
  if(value.lights.isValidFlag==1)
  {
    value.lights.isValidFlag = 1;
    value.lights.stringLength = C2xGetTokenLengthBit(packetHandle, "CooperativeControlMessage", newPath);
    if ((result = CheckLastError("CooperativeControlMessage", gkFuncRefGet, result))==0)
    {
      if(value.lights.stringLength > 0)
      {
        for(j=0; j<value.lights.stringLength; j++)
        {
          if(C2xGetTokenBitOfBitString(packetHandle, "CooperativeControlMessage", newPath, j) == 0)
          {
            value.lights.string[j] = '0';
          }
          else if(C2xGetTokenBitOfBitString(packetHandle, "CooperativeControlMessage", newPath, j) == 1)
          {
            value.lights.string[j] = '1';
          }

          if(value.lights.stringLength == 1)
          {
            value.lights.string[1] = '0';
          }
          result = CheckLastError("CooperativeControlMessage", gkFuncRefGet, result);
        }
      }
      else
      {
        for(k = value.lights.stringLength+1; k > -1; k--)
        {
          if(value.lights.string[k] == '1')
          {
            value.lights.string[k] = '0';
          }
        }
      }
    }

  }
  return result;
}

int SetCooperativeControlMessageCommon_VehicleSafetyExtensionsParams(LONG packetHandle, struct CooperativeControlMessageCommon_VehicleSafetyExtensions value, char oldPath[])
{
  char newPath[300]; 
  int j;
  int result;

  result = 0;

  snprintf(newPath, elcount(newPath), "%s.%s", oldPath, "events");
  if(value.events.isValidFlag==1)
  {
      for(j=0; j<value.events.stringLength; j++)
      {
        if(value.events.string[j] == '0')
        {
          C2xSetTokenBitOfBitString(packetHandle, "CooperativeControlMessage", newPath, j, 0);
        }
        else
        {
          C2xSetTokenBitOfBitString(packetHandle, "CooperativeControlMessage", newPath, j, 1);
        }
        result = CheckLastError("CooperativeControlMessage", gkFuncRefGet, result);
      }
  }
  else
  {
    if( C2xIsTokenAvailable(packetHandle, "CooperativeControlMessage", newPath) )
    {
      C2xRemoveToken(packetHandle, "CooperativeControlMessage", newPath);
    }
  }

  snprintf(newPath, elcount(newPath), "%s.%s", oldPath, "pathHistory");
  if(value.pathHistory.isValidFlag==1)
  {
    SetCooperativeControlMessageCommon_PathHistoryParams(packetHandle, value.pathHistory, newPath);
    result = CheckLastError("CooperativeControlMessage", gkFuncRefGet, result);
  }
  else
  {
    if( C2xIsTokenAvailable(packetHandle, "CooperativeControlMessage", newPath) )
    {
      C2xRemoveToken(packetHandle, "CooperativeControlMessage", newPath);
    }
  }

  snprintf(newPath, elcount(newPath), "%s.%s", oldPath, "pathPrediction");
  if(value.pathPrediction.isValidFlag==1)
  {
    SetCooperativeControlMessageCommon_PathPredictionParams(packetHandle, value.pathPrediction, newPath);
    result = CheckLastError("CooperativeControlMessage", gkFuncRefGet, result);
  }
  else
  {
    if( C2xIsTokenAvailable(packetHandle, "CooperativeControlMessage", newPath) )
    {
      C2xRemoveToken(packetHandle, "CooperativeControlMessage", newPath);
    }
  }

  snprintf(newPath, elcount(newPath), "%s.%s", oldPath, "lights");
  if(value.lights.isValidFlag==1)
  {
      for(j=0; j<value.lights.stringLength; j++)
      {
        if(value.lights.string[j] == '0')
        {
          C2xSetTokenBitOfBitString(packetHandle, "CooperativeControlMessage", newPath, j, 0);
        }
        else
        {
          C2xSetTokenBitOfBitString(packetHandle, "CooperativeControlMessage", newPath, j, 1);
        }
        result = CheckLastError("CooperativeControlMessage", gkFuncRefGet, result);
      }
  }
  else
  {
    if( C2xIsTokenAvailable(packetHandle, "CooperativeControlMessage", newPath) )
    {
      C2xRemoveToken(packetHandle, "CooperativeControlMessage", newPath);
    }
  }

  return result;
}

int GetCooperativeControlMessageAccelTimeConstantParams(LONG packetHandle, struct CooperativeControlMessageAccelTimeConstant value, char oldPath[])
{
  char newPath[300];
  int result;

  result = 0;

  snprintf(newPath, elcount(newPath), "%s.%s", oldPath, "accelTimeConst");
  value.accelTimeConst.isValidFlag = C2xIsTokenAvailable(packetHandle, "CooperativeControlMessage", newPath);
  if(value.accelTimeConst.isValidFlag==1)
  {
    value.accelTimeConst.value = C2xGetTokenInt(packetHandle, "CooperativeControlMessage", newPath);
    result = CheckLastError("CooperativeControlMessage", gkFuncRefGet, result);
  }
  snprintf(newPath, elcount(newPath), "%s.%s", oldPath, "decelTimeConst");
  value.decelTimeConst.isValidFlag = C2xIsTokenAvailable(packetHandle, "CooperativeControlMessage", newPath);
  if(value.decelTimeConst.isValidFlag==1)
  {
    value.decelTimeConst.value = C2xGetTokenInt(packetHandle, "CooperativeControlMessage", newPath);
    result = CheckLastError("CooperativeControlMessage", gkFuncRefGet, result);
  }
  return result;
}

int SetCooperativeControlMessageAccelTimeConstantParams(LONG packetHandle, struct CooperativeControlMessageAccelTimeConstant value, char oldPath[])
{
  char newPath[300];
  int result;

  result = 0;

  snprintf(newPath, elcount(newPath), "%s.%s", oldPath, "accelTimeConst");
  if(value.accelTimeConst.isValidFlag==1)
  {
    C2xSetTokenInt(packetHandle, "CooperativeControlMessage", newPath, value.accelTimeConst.value);
    result = CheckLastError("CooperativeControlMessage", gkFuncRefGet, result);
  }
  else
  {
    if( C2xIsTokenAvailable(packetHandle, "CooperativeControlMessage", newPath) )
    {
      C2xRemoveToken(packetHandle, "CooperativeControlMessage", newPath);
    }
  }

  snprintf(newPath, elcount(newPath), "%s.%s", oldPath, "decelTimeConst");
  if(value.decelTimeConst.isValidFlag==1)
  {
    C2xSetTokenInt(packetHandle, "CooperativeControlMessage", newPath, value.decelTimeConst.value);
    result = CheckLastError("CooperativeControlMessage", gkFuncRefGet, result);
  }
  else
  {
    if( C2xIsTokenAvailable(packetHandle, "CooperativeControlMessage", newPath) )
    {
      C2xRemoveToken(packetHandle, "CooperativeControlMessage", newPath);
    }
  }

  return result;
}

int GetCooperativeControlMessageLightVehicleCCMExtensionsParams(LONG packetHandle, struct CooperativeControlMessageLightVehicleCCMExtensions value, char oldPath[])
{
  char newPath[300];
  int result;

  result = 0;

  snprintf(newPath, elcount(newPath), "%s.%s", oldPath, "longCntrlState");
  value.longCntrlState = C2xGetTokenInt(packetHandle, "CooperativeControlMessage", newPath);
  result = CheckLastError("CooperativeControlMessage", gkFuncRefGet, result);

  snprintf(newPath, elcount(newPath), "%s.%s", oldPath, "targetId");
  value.targetId.isValidFlag = C2xIsTokenAvailable(packetHandle, "CooperativeControlMessage", newPath);
  if(value.targetId.isValidFlag==1)
  {
    value.targetId.isValidFlag = 1;
    value.targetId.stringLength = C2xGetTokenData(packetHandle, "CooperativeControlMessage", newPath, elcount(value.targetId.string), value.targetId.string);
  }
  snprintf(newPath, elcount(newPath), "%s.%s", oldPath, "accelForecast");
  value.accelForecast.isValidFlag = C2xIsTokenAvailable(packetHandle, "CooperativeControlMessage", newPath);
  if(value.accelForecast.isValidFlag==1)
  {
    value.accelForecast.value = C2xGetTokenInt(packetHandle, "CooperativeControlMessage", newPath);
    result = CheckLastError("CooperativeControlMessage", gkFuncRefGet, result);
  }
  snprintf(newPath, elcount(newPath), "%s.%s", oldPath, "accelTimeConst");
  value.accelTimeConst.isValidFlag = C2xIsTokenAvailable(packetHandle, "CooperativeControlMessage", newPath);
  if(value.accelTimeConst.isValidFlag==1)
  {
    GetCooperativeControlMessageAccelTimeConstantParams(packetHandle, value.accelTimeConst, newPath);
    result = CheckLastError("CooperativeControlMessage", gkFuncRefGet, result);
  }
  snprintf(newPath, elcount(newPath), "%s.%s", oldPath, "seperationDist");
  value.seperationDist.isValidFlag = C2xIsTokenAvailable(packetHandle, "CooperativeControlMessage", newPath);
  if(value.seperationDist.isValidFlag==1)
  {
    value.seperationDist.value = C2xGetTokenInt(packetHandle, "CooperativeControlMessage", newPath);
    result = CheckLastError("CooperativeControlMessage", gkFuncRefGet, result);
  }
  snprintf(newPath, elcount(newPath), "%s.%s", oldPath, "frontCutIn");
  value.frontCutIn.isValidFlag = C2xIsTokenAvailable(packetHandle, "CooperativeControlMessage", newPath);
  if(value.frontCutIn.isValidFlag==1)
  {
    value.frontCutIn.value = C2xGetTokenInt64(packetHandle, "CooperativeControlMessage", newPath);
    result = CheckLastError("CooperativeControlMessage", gkFuncRefGet, result);
  }
  return result;
}

int SetCooperativeControlMessageLightVehicleCCMExtensionsParams(LONG packetHandle, struct CooperativeControlMessageLightVehicleCCMExtensions value, char oldPath[])
{
  char newPath[300];
  int result;

  result = 0;

  snprintf(newPath, elcount(newPath), "%s.%s", oldPath, "longCntrlState");
  C2xSetTokenInt(packetHandle, "CooperativeControlMessage", newPath, value.longCntrlState);
  result = CheckLastError("CooperativeControlMessage", gkFuncRefGet, result);

  snprintf(newPath, elcount(newPath), "%s.%s", oldPath, "targetId");
  if(value.targetId.isValidFlag==1)
  {
    C2xSetTokenData(packetHandle, "CooperativeControlMessage", newPath, value.targetId.stringLength, value.targetId.string);
  }
  else
  {
    if( C2xIsTokenAvailable(packetHandle, "CooperativeControlMessage", newPath) )
    {
      C2xRemoveToken(packetHandle, "CooperativeControlMessage", newPath);
    }
  }

  snprintf(newPath, elcount(newPath), "%s.%s", oldPath, "accelForecast");
  if(value.accelForecast.isValidFlag==1)
  {
    C2xSetTokenInt(packetHandle, "CooperativeControlMessage", newPath, value.accelForecast.value);
    result = CheckLastError("CooperativeControlMessage", gkFuncRefGet, result);
  }
  else
  {
    if( C2xIsTokenAvailable(packetHandle, "CooperativeControlMessage", newPath) )
    {
      C2xRemoveToken(packetHandle, "CooperativeControlMessage", newPath);
    }
  }

  snprintf(newPath, elcount(newPath), "%s.%s", oldPath, "accelTimeConst");
  if(value.accelTimeConst.isValidFlag==1)
  {
    SetCooperativeControlMessageAccelTimeConstantParams(packetHandle, value.accelTimeConst, newPath);
    result = CheckLastError("CooperativeControlMessage", gkFuncRefGet, result);
  }
  else
  {
    if( C2xIsTokenAvailable(packetHandle, "CooperativeControlMessage", newPath) )
    {
      C2xRemoveToken(packetHandle, "CooperativeControlMessage", newPath);
    }
  }

  snprintf(newPath, elcount(newPath), "%s.%s", oldPath, "seperationDist");
  if(value.seperationDist.isValidFlag==1)
  {
    C2xSetTokenInt(packetHandle, "CooperativeControlMessage", newPath, value.seperationDist.value);
    result = CheckLastError("CooperativeControlMessage", gkFuncRefGet, result);
  }
  else
  {
    if( C2xIsTokenAvailable(packetHandle, "CooperativeControlMessage", newPath) )
    {
      C2xRemoveToken(packetHandle, "CooperativeControlMessage", newPath);
    }
  }

  snprintf(newPath, elcount(newPath), "%s.%s", oldPath, "frontCutIn");
  if(value.frontCutIn.isValidFlag==1)
  {
    C2xSetTokenInt64(packetHandle, "CooperativeControlMessage", newPath, value.frontCutIn.value);
    result = CheckLastError("CooperativeControlMessage", gkFuncRefGet, result);
  }
  else
  {
    if( C2xIsTokenAvailable(packetHandle, "CooperativeControlMessage", newPath) )
    {
      C2xRemoveToken(packetHandle, "CooperativeControlMessage", newPath);
    }
  }

  return result;
}

int GetCooperativeControlMessageAxesMovementParams(LONG packetHandle, struct CooperativeControlMessageAxesMovement value, char oldPath[])
{
  char newPath[300];
  int result;

  result = 0;

  snprintf(newPath, elcount(newPath), "%s.%s", oldPath, "yaw");
  value.yaw.isValidFlag = C2xIsTokenAvailable(packetHandle, "CooperativeControlMessage", newPath);
  if(value.yaw.isValidFlag==1)
  {
    value.yaw.value = C2xGetTokenInt(packetHandle, "CooperativeControlMessage", newPath);
    result = CheckLastError("CooperativeControlMessage", gkFuncRefGet, result);
  }
  snprintf(newPath, elcount(newPath), "%s.%s", oldPath, "pitch");
  value.pitch.isValidFlag = C2xIsTokenAvailable(packetHandle, "CooperativeControlMessage", newPath);
  if(value.pitch.isValidFlag==1)
  {
    value.pitch.value = C2xGetTokenInt(packetHandle, "CooperativeControlMessage", newPath);
    result = CheckLastError("CooperativeControlMessage", gkFuncRefGet, result);
  }
  snprintf(newPath, elcount(newPath), "%s.%s", oldPath, "roll");
  value.roll.isValidFlag = C2xIsTokenAvailable(packetHandle, "CooperativeControlMessage", newPath);
  if(value.roll.isValidFlag==1)
  {
    value.roll.value = C2xGetTokenInt(packetHandle, "CooperativeControlMessage", newPath);
    result = CheckLastError("CooperativeControlMessage", gkFuncRefGet, result);
  }
  snprintf(newPath, elcount(newPath), "%s.%s", oldPath, "yawRate");
  value.yawRate.isValidFlag = C2xIsTokenAvailable(packetHandle, "CooperativeControlMessage", newPath);
  if(value.yawRate.isValidFlag==1)
  {
    value.yawRate.value = C2xGetTokenInt(packetHandle, "CooperativeControlMessage", newPath);
    result = CheckLastError("CooperativeControlMessage", gkFuncRefGet, result);
  }
  snprintf(newPath, elcount(newPath), "%s.%s", oldPath, "pitchRate");
  value.pitchRate.isValidFlag = C2xIsTokenAvailable(packetHandle, "CooperativeControlMessage", newPath);
  if(value.pitchRate.isValidFlag==1)
  {
    value.pitchRate.value = C2xGetTokenInt(packetHandle, "CooperativeControlMessage", newPath);
    result = CheckLastError("CooperativeControlMessage", gkFuncRefGet, result);
  }
  snprintf(newPath, elcount(newPath), "%s.%s", oldPath, "rollRate");
  value.rollRate.isValidFlag = C2xIsTokenAvailable(packetHandle, "CooperativeControlMessage", newPath);
  if(value.rollRate.isValidFlag==1)
  {
    value.rollRate.value = C2xGetTokenInt(packetHandle, "CooperativeControlMessage", newPath);
    result = CheckLastError("CooperativeControlMessage", gkFuncRefGet, result);
  }
  return result;
}

int SetCooperativeControlMessageAxesMovementParams(LONG packetHandle, struct CooperativeControlMessageAxesMovement value, char oldPath[])
{
  char newPath[300];
  int result;

  result = 0;

  snprintf(newPath, elcount(newPath), "%s.%s", oldPath, "yaw");
  if(value.yaw.isValidFlag==1)
  {
    C2xSetTokenInt(packetHandle, "CooperativeControlMessage", newPath, value.yaw.value);
    result = CheckLastError("CooperativeControlMessage", gkFuncRefGet, result);
  }
  else
  {
    if( C2xIsTokenAvailable(packetHandle, "CooperativeControlMessage", newPath) )
    {
      C2xRemoveToken(packetHandle, "CooperativeControlMessage", newPath);
    }
  }

  snprintf(newPath, elcount(newPath), "%s.%s", oldPath, "pitch");
  if(value.pitch.isValidFlag==1)
  {
    C2xSetTokenInt(packetHandle, "CooperativeControlMessage", newPath, value.pitch.value);
    result = CheckLastError("CooperativeControlMessage", gkFuncRefGet, result);
  }
  else
  {
    if( C2xIsTokenAvailable(packetHandle, "CooperativeControlMessage", newPath) )
    {
      C2xRemoveToken(packetHandle, "CooperativeControlMessage", newPath);
    }
  }

  snprintf(newPath, elcount(newPath), "%s.%s", oldPath, "roll");
  if(value.roll.isValidFlag==1)
  {
    C2xSetTokenInt(packetHandle, "CooperativeControlMessage", newPath, value.roll.value);
    result = CheckLastError("CooperativeControlMessage", gkFuncRefGet, result);
  }
  else
  {
    if( C2xIsTokenAvailable(packetHandle, "CooperativeControlMessage", newPath) )
    {
      C2xRemoveToken(packetHandle, "CooperativeControlMessage", newPath);
    }
  }

  snprintf(newPath, elcount(newPath), "%s.%s", oldPath, "yawRate");
  if(value.yawRate.isValidFlag==1)
  {
    C2xSetTokenInt(packetHandle, "CooperativeControlMessage", newPath, value.yawRate.value);
    result = CheckLastError("CooperativeControlMessage", gkFuncRefGet, result);
  }
  else
  {
    if( C2xIsTokenAvailable(packetHandle, "CooperativeControlMessage", newPath) )
    {
      C2xRemoveToken(packetHandle, "CooperativeControlMessage", newPath);
    }
  }

  snprintf(newPath, elcount(newPath), "%s.%s", oldPath, "pitchRate");
  if(value.pitchRate.isValidFlag==1)
  {
    C2xSetTokenInt(packetHandle, "CooperativeControlMessage", newPath, value.pitchRate.value);
    result = CheckLastError("CooperativeControlMessage", gkFuncRefGet, result);
  }
  else
  {
    if( C2xIsTokenAvailable(packetHandle, "CooperativeControlMessage", newPath) )
    {
      C2xRemoveToken(packetHandle, "CooperativeControlMessage", newPath);
    }
  }

  snprintf(newPath, elcount(newPath), "%s.%s", oldPath, "rollRate");
  if(value.rollRate.isValidFlag==1)
  {
    C2xSetTokenInt(packetHandle, "CooperativeControlMessage", newPath, value.rollRate.value);
    result = CheckLastError("CooperativeControlMessage", gkFuncRefGet, result);
  }
  else
  {
    if( C2xIsTokenAvailable(packetHandle, "CooperativeControlMessage", newPath) )
    {
      C2xRemoveToken(packetHandle, "CooperativeControlMessage", newPath);
    }
  }

  return result;
}

int GetCooperativeControlMessageHeavyTruckCCMExtensionsParams(LONG packetHandle, struct CooperativeControlMessageHeavyTruckCCMExtensions value, char oldPath[])
{
  char newPath[300]; 
  int j; 
  int k;
  int result;

  result = 0;

  snprintf(newPath, elcount(newPath), "%s.%s", oldPath, "longCntrlState");
  value.longCntrlState = C2xGetTokenInt(packetHandle, "CooperativeControlMessage", newPath);
  result = CheckLastError("CooperativeControlMessage", gkFuncRefGet, result);

  snprintf(newPath, elcount(newPath), "%s.%s", oldPath, "targetId");
  value.targetId.isValidFlag = C2xIsTokenAvailable(packetHandle, "CooperativeControlMessage", newPath);
  if(value.targetId.isValidFlag==1)
  {
    value.targetId.isValidFlag = 1;
    value.targetId.stringLength = C2xGetTokenData(packetHandle, "CooperativeControlMessage", newPath, elcount(value.targetId.string), value.targetId.string);
  }
  snprintf(newPath, elcount(newPath), "%s.%s", oldPath, "roadGrade");
  value.roadGrade.isValidFlag = C2xIsTokenAvailable(packetHandle, "CooperativeControlMessage", newPath);
  if(value.roadGrade.isValidFlag==1)
  {
    value.roadGrade.value = C2xGetTokenInt(packetHandle, "CooperativeControlMessage", newPath);
    result = CheckLastError("CooperativeControlMessage", gkFuncRefGet, result);
  }
  snprintf(newPath, elcount(newPath), "%s.%s", oldPath, "brakePedalPos");
  value.brakePedalPos.isValidFlag = C2xIsTokenAvailable(packetHandle, "CooperativeControlMessage", newPath);
  if(value.brakePedalPos.isValidFlag==1)
  {
    value.brakePedalPos.value = C2xGetTokenInt(packetHandle, "CooperativeControlMessage", newPath);
    result = CheckLastError("CooperativeControlMessage", gkFuncRefGet, result);
  }
  snprintf(newPath, elcount(newPath), "%s.%s", oldPath, "accelPedalPos");
  value.accelPedalPos.isValidFlag = C2xIsTokenAvailable(packetHandle, "CooperativeControlMessage", newPath);
  if(value.accelPedalPos.isValidFlag==1)
  {
    value.accelPedalPos.value = C2xGetTokenInt(packetHandle, "CooperativeControlMessage", newPath);
    result = CheckLastError("CooperativeControlMessage", gkFuncRefGet, result);
  }
  snprintf(newPath, elcount(newPath), "%s.%s", oldPath, "desiredSpeed");
  value.desiredSpeed.isValidFlag = C2xIsTokenAvailable(packetHandle, "CooperativeControlMessage", newPath);
  if(value.desiredSpeed.isValidFlag==1)
  {
    value.desiredSpeed.value = C2xGetTokenInt(packetHandle, "CooperativeControlMessage", newPath);
    result = CheckLastError("CooperativeControlMessage", gkFuncRefGet, result);
  }
  snprintf(newPath, elcount(newPath), "%s.%s", oldPath, "desiredAccel");
  value.desiredAccel.isValidFlag = C2xIsTokenAvailable(packetHandle, "CooperativeControlMessage", newPath);
  if(value.desiredAccel.isValidFlag==1)
  {
    value.desiredAccel.value = C2xGetTokenInt(packetHandle, "CooperativeControlMessage", newPath);
    result = CheckLastError("CooperativeControlMessage", gkFuncRefGet, result);
  }
  snprintf(newPath, elcount(newPath), "%s.%s", oldPath, "desiredTorque");
  value.desiredTorque.isValidFlag = C2xIsTokenAvailable(packetHandle, "CooperativeControlMessage", newPath);
  if(value.desiredTorque.isValidFlag==1)
  {
    value.desiredTorque.value = C2xGetTokenInt(packetHandle, "CooperativeControlMessage", newPath);
    result = CheckLastError("CooperativeControlMessage", gkFuncRefGet, result);
  }
  snprintf(newPath, elcount(newPath), "%s.%s", oldPath, "desiredTmRetarderTorque");
  value.desiredTmRetarderTorque.isValidFlag = C2xIsTokenAvailable(packetHandle, "CooperativeControlMessage", newPath);
  if(value.desiredTmRetarderTorque.isValidFlag==1)
  {
    value.desiredTmRetarderTorque.value = C2xGetTokenInt(packetHandle, "CooperativeControlMessage", newPath);
    result = CheckLastError("CooperativeControlMessage", gkFuncRefGet, result);
  }
  snprintf(newPath, elcount(newPath), "%s.%s", oldPath, "desiredEngRetarderTorque");
  value.desiredEngRetarderTorque.isValidFlag = C2xIsTokenAvailable(packetHandle, "CooperativeControlMessage", newPath);
  if(value.desiredEngRetarderTorque.isValidFlag==1)
  {
    value.desiredEngRetarderTorque.value = C2xGetTokenInt(packetHandle, "CooperativeControlMessage", newPath);
    result = CheckLastError("CooperativeControlMessage", gkFuncRefGet, result);
  }
  snprintf(newPath, elcount(newPath), "%s.%s", oldPath, "axesMvmt");
  value.axesMvmt.isValidFlag = C2xIsTokenAvailable(packetHandle, "CooperativeControlMessage", newPath);
  if(value.axesMvmt.isValidFlag==1)
  {
    GetCooperativeControlMessageAxesMovementParams(packetHandle, value.axesMvmt, newPath);
    result = CheckLastError("CooperativeControlMessage", gkFuncRefGet, result);
  }
  snprintf(newPath, elcount(newPath), "%s.%s", oldPath, "separationDist");
  value.separationDist.isValidFlag = C2xIsTokenAvailable(packetHandle, "CooperativeControlMessage", newPath);
  if(value.separationDist.isValidFlag==1)
  {
    value.separationDist.value = C2xGetTokenInt(packetHandle, "CooperativeControlMessage", newPath);
    result = CheckLastError("CooperativeControlMessage", gkFuncRefGet, result);
  }
  snprintf(newPath, elcount(newPath), "%s.%s", oldPath, "totalMass");
  value.totalMass.isValidFlag = C2xIsTokenAvailable(packetHandle, "CooperativeControlMessage", newPath);
  if(value.totalMass.isValidFlag==1)
  {
    value.totalMass.value = C2xGetTokenInt(packetHandle, "CooperativeControlMessage", newPath);
    result = CheckLastError("CooperativeControlMessage", gkFuncRefGet, result);
  }
  snprintf(newPath, elcount(newPath), "%s.%s", oldPath, "maxAvailAccel");
  value.maxAvailAccel.isValidFlag = C2xIsTokenAvailable(packetHandle, "CooperativeControlMessage", newPath);
  if(value.maxAvailAccel.isValidFlag==1)
  {
    value.maxAvailAccel.value = C2xGetTokenInt(packetHandle, "CooperativeControlMessage", newPath);
    result = CheckLastError("CooperativeControlMessage", gkFuncRefGet, result);
  }
  snprintf(newPath, elcount(newPath), "%s.%s", oldPath, "maxAvailDecel");
  value.maxAvailDecel.isValidFlag = C2xIsTokenAvailable(packetHandle, "CooperativeControlMessage", newPath);
  if(value.maxAvailDecel.isValidFlag==1)
  {
    value.maxAvailDecel.value = C2xGetTokenInt(packetHandle, "CooperativeControlMessage", newPath);
    result = CheckLastError("CooperativeControlMessage", gkFuncRefGet, result);
  }
  snprintf(newPath, elcount(newPath), "%s.%s", oldPath, "ccmFaultMode");
  value.ccmFaultMode.isValidFlag = C2xIsTokenAvailable(packetHandle, "CooperativeControlMessage", newPath);
  if(value.ccmFaultMode.isValidFlag==1)
  {
    value.ccmFaultMode.isValidFlag = 1;
    value.ccmFaultMode.stringLength = C2xGetTokenLengthBit(packetHandle, "CooperativeControlMessage", newPath);
    if ((result = CheckLastError("CooperativeControlMessage", gkFuncRefGet, result))==0)
    {
      if(value.ccmFaultMode.stringLength > 0)
      {
        for(j=0; j<value.ccmFaultMode.stringLength; j++)
        {
          if(C2xGetTokenBitOfBitString(packetHandle, "CooperativeControlMessage", newPath, j) == 0)
          {
            value.ccmFaultMode.string[j] = '0';
          }
          else if(C2xGetTokenBitOfBitString(packetHandle, "CooperativeControlMessage", newPath, j) == 1)
          {
            value.ccmFaultMode.string[j] = '1';
          }

          if(value.ccmFaultMode.stringLength == 1)
          {
            value.ccmFaultMode.string[1] = '0';
          }
          result = CheckLastError("CooperativeControlMessage", gkFuncRefGet, result);
        }
      }
      else
      {
        for(k = value.ccmFaultMode.stringLength+1; k > -1; k--)
        {
          if(value.ccmFaultMode.string[k] == '1')
          {
            value.ccmFaultMode.string[k] = '0';
          }
        }
      }
    }

  }
  snprintf(newPath, elcount(newPath), "%s.%s", oldPath, "maneuverID");
  value.maneuverID.isValidFlag = C2xIsTokenAvailable(packetHandle, "CooperativeControlMessage", newPath);
  if(value.maneuverID.isValidFlag==1)
  {
    value.maneuverID.value = C2xGetTokenInt(packetHandle, "CooperativeControlMessage", newPath);
    result = CheckLastError("CooperativeControlMessage", gkFuncRefGet, result);
  }
  snprintf(newPath, elcount(newPath), "%s.%s", oldPath, "frontCutIn");
  value.frontCutIn.isValidFlag = C2xIsTokenAvailable(packetHandle, "CooperativeControlMessage", newPath);
  if(value.frontCutIn.isValidFlag==1)
  {
    value.frontCutIn.value = C2xGetTokenInt64(packetHandle, "CooperativeControlMessage", newPath);
    result = CheckLastError("CooperativeControlMessage", gkFuncRefGet, result);
  }
  return result;
}

int SetCooperativeControlMessageHeavyTruckCCMExtensionsParams(LONG packetHandle, struct CooperativeControlMessageHeavyTruckCCMExtensions value, char oldPath[])
{
  char newPath[300]; 
  int j;
  int result;

  result = 0;

  snprintf(newPath, elcount(newPath), "%s.%s", oldPath, "longCntrlState");
  C2xSetTokenInt(packetHandle, "CooperativeControlMessage", newPath, value.longCntrlState);
  result = CheckLastError("CooperativeControlMessage", gkFuncRefGet, result);

  snprintf(newPath, elcount(newPath), "%s.%s", oldPath, "targetId");
  if(value.targetId.isValidFlag==1)
  {
    C2xSetTokenData(packetHandle, "CooperativeControlMessage", newPath, value.targetId.stringLength, value.targetId.string);
  }
  else
  {
    if( C2xIsTokenAvailable(packetHandle, "CooperativeControlMessage", newPath) )
    {
      C2xRemoveToken(packetHandle, "CooperativeControlMessage", newPath);
    }
  }

  snprintf(newPath, elcount(newPath), "%s.%s", oldPath, "roadGrade");
  if(value.roadGrade.isValidFlag==1)
  {
    C2xSetTokenInt(packetHandle, "CooperativeControlMessage", newPath, value.roadGrade.value);
    result = CheckLastError("CooperativeControlMessage", gkFuncRefGet, result);
  }
  else
  {
    if( C2xIsTokenAvailable(packetHandle, "CooperativeControlMessage", newPath) )
    {
      C2xRemoveToken(packetHandle, "CooperativeControlMessage", newPath);
    }
  }

  snprintf(newPath, elcount(newPath), "%s.%s", oldPath, "brakePedalPos");
  if(value.brakePedalPos.isValidFlag==1)
  {
    C2xSetTokenInt(packetHandle, "CooperativeControlMessage", newPath, value.brakePedalPos.value);
    result = CheckLastError("CooperativeControlMessage", gkFuncRefGet, result);
  }
  else
  {
    if( C2xIsTokenAvailable(packetHandle, "CooperativeControlMessage", newPath) )
    {
      C2xRemoveToken(packetHandle, "CooperativeControlMessage", newPath);
    }
  }

  snprintf(newPath, elcount(newPath), "%s.%s", oldPath, "accelPedalPos");
  if(value.accelPedalPos.isValidFlag==1)
  {
    C2xSetTokenInt(packetHandle, "CooperativeControlMessage", newPath, value.accelPedalPos.value);
    result = CheckLastError("CooperativeControlMessage", gkFuncRefGet, result);
  }
  else
  {
    if( C2xIsTokenAvailable(packetHandle, "CooperativeControlMessage", newPath) )
    {
      C2xRemoveToken(packetHandle, "CooperativeControlMessage", newPath);
    }
  }

  snprintf(newPath, elcount(newPath), "%s.%s", oldPath, "desiredSpeed");
  if(value.desiredSpeed.isValidFlag==1)
  {
    C2xSetTokenInt(packetHandle, "CooperativeControlMessage", newPath, value.desiredSpeed.value);
    result = CheckLastError("CooperativeControlMessage", gkFuncRefGet, result);
  }
  else
  {
    if( C2xIsTokenAvailable(packetHandle, "CooperativeControlMessage", newPath) )
    {
      C2xRemoveToken(packetHandle, "CooperativeControlMessage", newPath);
    }
  }

  snprintf(newPath, elcount(newPath), "%s.%s", oldPath, "desiredAccel");
  if(value.desiredAccel.isValidFlag==1)
  {
    C2xSetTokenInt(packetHandle, "CooperativeControlMessage", newPath, value.desiredAccel.value);
    result = CheckLastError("CooperativeControlMessage", gkFuncRefGet, result);
  }
  else
  {
    if( C2xIsTokenAvailable(packetHandle, "CooperativeControlMessage", newPath) )
    {
      C2xRemoveToken(packetHandle, "CooperativeControlMessage", newPath);
    }
  }

  snprintf(newPath, elcount(newPath), "%s.%s", oldPath, "desiredTorque");
  if(value.desiredTorque.isValidFlag==1)
  {
    C2xSetTokenInt(packetHandle, "CooperativeControlMessage", newPath, value.desiredTorque.value);
    result = CheckLastError("CooperativeControlMessage", gkFuncRefGet, result);
  }
  else
  {
    if( C2xIsTokenAvailable(packetHandle, "CooperativeControlMessage", newPath) )
    {
      C2xRemoveToken(packetHandle, "CooperativeControlMessage", newPath);
    }
  }

  snprintf(newPath, elcount(newPath), "%s.%s", oldPath, "desiredTmRetarderTorque");
  if(value.desiredTmRetarderTorque.isValidFlag==1)
  {
    C2xSetTokenInt(packetHandle, "CooperativeControlMessage", newPath, value.desiredTmRetarderTorque.value);
    result = CheckLastError("CooperativeControlMessage", gkFuncRefGet, result);
  }
  else
  {
    if( C2xIsTokenAvailable(packetHandle, "CooperativeControlMessage", newPath) )
    {
      C2xRemoveToken(packetHandle, "CooperativeControlMessage", newPath);
    }
  }

  snprintf(newPath, elcount(newPath), "%s.%s", oldPath, "desiredEngRetarderTorque");
  if(value.desiredEngRetarderTorque.isValidFlag==1)
  {
    C2xSetTokenInt(packetHandle, "CooperativeControlMessage", newPath, value.desiredEngRetarderTorque.value);
    result = CheckLastError("CooperativeControlMessage", gkFuncRefGet, result);
  }
  else
  {
    if( C2xIsTokenAvailable(packetHandle, "CooperativeControlMessage", newPath) )
    {
      C2xRemoveToken(packetHandle, "CooperativeControlMessage", newPath);
    }
  }

  snprintf(newPath, elcount(newPath), "%s.%s", oldPath, "axesMvmt");
  if(value.axesMvmt.isValidFlag==1)
  {
    SetCooperativeControlMessageAxesMovementParams(packetHandle, value.axesMvmt, newPath);
    result = CheckLastError("CooperativeControlMessage", gkFuncRefGet, result);
  }
  else
  {
    if( C2xIsTokenAvailable(packetHandle, "CooperativeControlMessage", newPath) )
    {
      C2xRemoveToken(packetHandle, "CooperativeControlMessage", newPath);
    }
  }

  snprintf(newPath, elcount(newPath), "%s.%s", oldPath, "separationDist");
  if(value.separationDist.isValidFlag==1)
  {
    C2xSetTokenInt(packetHandle, "CooperativeControlMessage", newPath, value.separationDist.value);
    result = CheckLastError("CooperativeControlMessage", gkFuncRefGet, result);
  }
  else
  {
    if( C2xIsTokenAvailable(packetHandle, "CooperativeControlMessage", newPath) )
    {
      C2xRemoveToken(packetHandle, "CooperativeControlMessage", newPath);
    }
  }

  snprintf(newPath, elcount(newPath), "%s.%s", oldPath, "totalMass");
  if(value.totalMass.isValidFlag==1)
  {
    C2xSetTokenInt(packetHandle, "CooperativeControlMessage", newPath, value.totalMass.value);
    result = CheckLastError("CooperativeControlMessage", gkFuncRefGet, result);
  }
  else
  {
    if( C2xIsTokenAvailable(packetHandle, "CooperativeControlMessage", newPath) )
    {
      C2xRemoveToken(packetHandle, "CooperativeControlMessage", newPath);
    }
  }

  snprintf(newPath, elcount(newPath), "%s.%s", oldPath, "maxAvailAccel");
  if(value.maxAvailAccel.isValidFlag==1)
  {
    C2xSetTokenInt(packetHandle, "CooperativeControlMessage", newPath, value.maxAvailAccel.value);
    result = CheckLastError("CooperativeControlMessage", gkFuncRefGet, result);
  }
  else
  {
    if( C2xIsTokenAvailable(packetHandle, "CooperativeControlMessage", newPath) )
    {
      C2xRemoveToken(packetHandle, "CooperativeControlMessage", newPath);
    }
  }

  snprintf(newPath, elcount(newPath), "%s.%s", oldPath, "maxAvailDecel");
  if(value.maxAvailDecel.isValidFlag==1)
  {
    C2xSetTokenInt(packetHandle, "CooperativeControlMessage", newPath, value.maxAvailDecel.value);
    result = CheckLastError("CooperativeControlMessage", gkFuncRefGet, result);
  }
  else
  {
    if( C2xIsTokenAvailable(packetHandle, "CooperativeControlMessage", newPath) )
    {
      C2xRemoveToken(packetHandle, "CooperativeControlMessage", newPath);
    }
  }

  snprintf(newPath, elcount(newPath), "%s.%s", oldPath, "ccmFaultMode");
  if(value.ccmFaultMode.isValidFlag==1)
  {
      for(j=0; j<value.ccmFaultMode.stringLength; j++)
      {
        if(value.ccmFaultMode.string[j] == '0')
        {
          C2xSetTokenBitOfBitString(packetHandle, "CooperativeControlMessage", newPath, j, 0);
        }
        else
        {
          C2xSetTokenBitOfBitString(packetHandle, "CooperativeControlMessage", newPath, j, 1);
        }
        result = CheckLastError("CooperativeControlMessage", gkFuncRefGet, result);
      }
  }
  else
  {
    if( C2xIsTokenAvailable(packetHandle, "CooperativeControlMessage", newPath) )
    {
      C2xRemoveToken(packetHandle, "CooperativeControlMessage", newPath);
    }
  }

  snprintf(newPath, elcount(newPath), "%s.%s", oldPath, "maneuverID");
  if(value.maneuverID.isValidFlag==1)
  {
    C2xSetTokenInt(packetHandle, "CooperativeControlMessage", newPath, value.maneuverID.value);
    result = CheckLastError("CooperativeControlMessage", gkFuncRefGet, result);
  }
  else
  {
    if( C2xIsTokenAvailable(packetHandle, "CooperativeControlMessage", newPath) )
    {
      C2xRemoveToken(packetHandle, "CooperativeControlMessage", newPath);
    }
  }

  snprintf(newPath, elcount(newPath), "%s.%s", oldPath, "frontCutIn");
  if(value.frontCutIn.isValidFlag==1)
  {
    C2xSetTokenInt64(packetHandle, "CooperativeControlMessage", newPath, value.frontCutIn.value);
    result = CheckLastError("CooperativeControlMessage", gkFuncRefGet, result);
  }
  else
  {
    if( C2xIsTokenAvailable(packetHandle, "CooperativeControlMessage", newPath) )
    {
      C2xRemoveToken(packetHandle, "CooperativeControlMessage", newPath);
    }
  }

  return result;
}

int GetCooperativeControlMessageCCMPartIIcontent_CCMpartIIExtension_tableParams(LONG packetHandle, WORD tableKey, struct CooperativeControlMessageCCMPartIIcontent_CCMpartIIExtension_table value, char oldPath[])
{
  char newPath[300];
  int result;

  result = 0;

  switch(tableKey)
  {
    case 0:
    {
      snprintf(newPath, elcount(newPath), "%s.%s", oldPath, "vehicleSafetyExt");
      GetCooperativeControlMessageCommon_VehicleSafetyExtensionsParams(packetHandle, value.vehicleSafetyExt, newPath);
      result = CheckLastError("CooperativeControlMessage", gkFuncRefGet, result);
    }
    break;
    case 1:
    {
      snprintf(newPath, elcount(newPath), "%s.%s", oldPath, "lightVehicleCCMExt");
      GetCooperativeControlMessageLightVehicleCCMExtensionsParams(packetHandle, value.lightVehicleCCMExt, newPath);
      result = CheckLastError("CooperativeControlMessage", gkFuncRefGet, result);
    }
    break;
    case 2:
    {
      snprintf(newPath, elcount(newPath), "%s.%s", oldPath, "heavyTruckCCMExt");
      GetCooperativeControlMessageHeavyTruckCCMExtensionsParams(packetHandle, value.heavyTruckCCMExt, newPath);
      result = CheckLastError("CooperativeControlMessage", gkFuncRefGet, result);
    }
    break;
  }
  return result;
}

int SetCooperativeControlMessageCCMPartIIcontent_CCMpartIIExtension_tableParams(LONG packetHandle, WORD tableKey, struct CooperativeControlMessageCCMPartIIcontent_CCMpartIIExtension_table value, char oldPath[])
{
  char newPath[300];
  int result;

  result = 0;

  switch(tableKey)
  {
    case 0:
    {
      snprintf(newPath, elcount(newPath), "%s.%s", oldPath, "vehicleSafetyExt");
      SetCooperativeControlMessageCommon_VehicleSafetyExtensionsParams(packetHandle, value.vehicleSafetyExt, newPath);
      result = CheckLastError("CooperativeControlMessage", gkFuncRefGet, result);
    }
    break;
    case 1:
    {
      snprintf(newPath, elcount(newPath), "%s.%s", oldPath, "lightVehicleCCMExt");
      SetCooperativeControlMessageLightVehicleCCMExtensionsParams(packetHandle, value.lightVehicleCCMExt, newPath);
      result = CheckLastError("CooperativeControlMessage", gkFuncRefGet, result);
    }
    break;
    case 2:
    {
      snprintf(newPath, elcount(newPath), "%s.%s", oldPath, "heavyTruckCCMExt");
      SetCooperativeControlMessageHeavyTruckCCMExtensionsParams(packetHandle, value.heavyTruckCCMExt, newPath);
      result = CheckLastError("CooperativeControlMessage", gkFuncRefGet, result);
    }
    break;
  }
  return result;
}

int GetCooperativeControlMessageCCMPartIIcontent_CCMpartIIExtensionParams(LONG packetHandle, struct CooperativeControlMessageCCMPartIIcontent_CCMpartIIExtension value, char oldPath[])
{
  char newPath[300];
  int result;

  result = 0;

  snprintf(newPath, elcount(newPath), "%s.%s", oldPath, "partII_Id");
  value.partII_Id = C2xGetTokenInt(packetHandle, "CooperativeControlMessage", newPath);
  result = CheckLastError("CooperativeControlMessage", gkFuncRefGet, result);

  snprintf(newPath, elcount(newPath), "%s.%s", oldPath, "partII_Value");
  GetCooperativeControlMessageCCMPartIIcontent_CCMpartIIExtension_tableParams(packetHandle, value.partII_Id, value.partII_Value, newPath);
  result = CheckLastError("CooperativeControlMessage", gkFuncRefGet, result);

  return result;
}

int SetCooperativeControlMessageCCMPartIIcontent_CCMpartIIExtensionParams(LONG packetHandle, struct CooperativeControlMessageCCMPartIIcontent_CCMpartIIExtension value, char oldPath[])
{
  char newPath[300];
  int result;

  result = 0;


  snprintf(newPath, elcount(newPath), "%s.%s", oldPath, "partII_Value");
  SetCooperativeControlMessageCCMPartIIcontent_CCMpartIIExtension_tableParams(packetHandle, value.partII_Id, value.partII_Value, newPath);
  result = CheckLastError("CooperativeControlMessage", gkFuncRefGet, result);

  return result;
}

int GetCooperativeControlMessageCooperativeControlMessage_partIIParams(LONG packetHandle, struct CooperativeControlMessageCooperativeControlMessage_partII value, char oldPath[])
{
  char newPath[300]; 
  int i;
  int result;

  result = 0;

  value.length = C2xGetTokenInt(packetHandle, "CooperativeControlMessage", oldPath);
  if((result = CheckLastError("CooperativeControlMessage", gkFuncRefGet, result))==0)
  {
    for(i=0; i<value.length; i++)
    {
      snprintf(newPath, elcount(newPath), "%s[%d]", oldPath, i);
      GetCooperativeControlMessageCCMPartIIcontent_CCMpartIIExtensionParams(packetHandle, value.arrayValue[i], newPath);
      result = CheckLastError("CooperativeControlMessage", gkFuncRefGet, result);
    }
  }
  return result;
}

int SetCooperativeControlMessageCooperativeControlMessage_partIIParams(LONG packetHandle, struct CooperativeControlMessageCooperativeControlMessage_partII value, char oldPath[])
{
  char newPath[300]; 
  int i;
  int result;

  result = 0;

  C2xRemoveToken(packetHandle, "CooperativeControlMessage", oldPath);
  for(i=0; i<value.length; i++)
  {
    snprintf(newPath, elcount(newPath), "%s[%d]", oldPath, i);
    SetCooperativeControlMessageCCMPartIIcontent_CCMpartIIExtensionParams(packetHandle, value.arrayValue[i], newPath);
    result = CheckLastError("CooperativeControlMessage", gkFuncRefGet, result);
  }
  return result;
}

int GetCooperativeControlMessage_CooperativeControlMessageParams(LONG packetHandle, struct CooperativeControlMessage_CooperativeControlMessage value, char oldPath[])
{
  char newPath[300];
  int result;

  result = 0;

  snprintf(newPath, elcount(newPath), "%s.%s", oldPath, "coreData");
  GetCooperativeControlMessageCommon_BSMcoreDataParams(packetHandle, value.coreData, newPath);
  result = CheckLastError("CooperativeControlMessage", gkFuncRefGet, result);

  snprintf(newPath, elcount(newPath), "%s.%s", oldPath, "partII");
  value.partII.isValidFlag = C2xIsTokenAvailable(packetHandle, "CooperativeControlMessage", newPath);
  if(value.partII.isValidFlag==1)
  {
    GetCooperativeControlMessageCooperativeControlMessage_partIIParams(packetHandle, value.partII, newPath);
    result = CheckLastError("CooperativeControlMessage", gkFuncRefGet, result);
  }
  return result;
}

int SetCooperativeControlMessage_CooperativeControlMessageParams(LONG packetHandle, struct CooperativeControlMessage_CooperativeControlMessage value, char oldPath[])
{
  char newPath[300];
  int result;

  result = 0;

  snprintf(newPath, elcount(newPath), "%s.%s", oldPath, "coreData");
  SetCooperativeControlMessageCommon_BSMcoreDataParams(packetHandle, value.coreData, newPath);
  result = CheckLastError("CooperativeControlMessage", gkFuncRefGet, result);

  snprintf(newPath, elcount(newPath), "%s.%s", oldPath, "partII");
  if(value.partII.isValidFlag==1)
  {
    SetCooperativeControlMessageCooperativeControlMessage_partIIParams(packetHandle, value.partII, newPath);
    result = CheckLastError("CooperativeControlMessage", gkFuncRefGet, result);
  }
  else
  {
    if( C2xIsTokenAvailable(packetHandle, "CooperativeControlMessage", newPath) )
    {
      C2xRemoveToken(packetHandle, "CooperativeControlMessage", newPath);
    }
  }

  return result;
}

int GetCooperativeControlMessageMESSAGE_ID_AND_TYPEParams(LONG packetHandle, WORD tableKey, struct CooperativeControlMessageMESSAGE_ID_AND_TYPE value, char oldPath[])
{
  char newPath[300];
  int result;

  result = 0;

  switch(tableKey)
  {
    case 40:
    {
      snprintf(newPath, elcount(newPath), "%s.%s", oldPath, "cooperativeControlMessage");
      GetCooperativeControlMessage_CooperativeControlMessageParams(packetHandle, value.cooperativeControlMessage, newPath);
      result = CheckLastError("CooperativeControlMessage", gkFuncRefGet, result);
    }
    break;
  }
  return result;
}

int SetCooperativeControlMessageMESSAGE_ID_AND_TYPEParams(LONG packetHandle, WORD tableKey, struct CooperativeControlMessageMESSAGE_ID_AND_TYPE value, char oldPath[])
{
  char newPath[300];
  int result;

  result = 0;

  switch(tableKey)
  {
    case 40:
    {
      snprintf(newPath, elcount(newPath), "%s.%s", oldPath, "cooperativeControlMessage");
      SetCooperativeControlMessage_CooperativeControlMessageParams(packetHandle, value.cooperativeControlMessage, newPath);
      result = CheckLastError("CooperativeControlMessage", gkFuncRefGet, result);
    }
    break;
  }
  return result;
}

int API_GetCooperativeControlMessageParams(LONG packetHandle, struct CooperativeControlMessage value)
{
  int result;
  result = 0;

  value.messageId = C2xGetTokenInt(packetHandle, "CooperativeControlMessage", "messageId");
  result = CheckLastError("CooperativeControlMessage", gkFuncRefGet, result);

  GetCooperativeControlMessageMESSAGE_ID_AND_TYPEParams(packetHandle, value.messageId, value.value, "value");
  result = CheckLastError("CooperativeControlMessage", gkFuncRefGet, result);

  return result;
}

int API_SetCooperativeControlMessageParams(LONG packetHandle, struct CooperativeControlMessage value)
{
  int result;
  result = 0;

  value.messageId = 40;

  SetCooperativeControlMessageMESSAGE_ID_AND_TYPEParams(packetHandle, value.messageId, value.value, "value");
  result = CheckLastError("CooperativeControlMessage", gkFuncRefGet, result);

  return result;
}

