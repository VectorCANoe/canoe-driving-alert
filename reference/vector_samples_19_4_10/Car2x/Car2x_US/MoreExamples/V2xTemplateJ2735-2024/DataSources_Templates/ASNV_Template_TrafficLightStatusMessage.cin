/*@!Encoding:1252*/
/*
//  (c) Vector Informatik GmbH. All rights reserved.
//
//  This file contains definitions of structs and methods that may be used
//  to set and get the values of an ASN.1 defined packet's payload.
//
//  //This example demonstrates how to set a packet's payload:
//  LONG packetHandle;
//  struct TrafficLightStatusMessage payload;
//  //you need to set the values of the variable "payload" yourself
//  packetHandle = API_InitTrafficLightStatusMessagePacket();
//  if (packetHandle!=0) {
//    if (API_SetTrafficLightStatusMessageParams(packetHandle, payload)==0) {
//      if (C2xCompletePacket(packetHandle)==0) {
//        C2xOutputPacket(packetHandle);
//      }
//    }
//  }
//                                                                             */
includes
{
  #include "ASNV_Template_BaseDatatypes.cin"  // If warning "Duplicate #include, ignoring this include" appears, please remove the ASNV_Template_BaseDatatypes.cin include from your other *.cin files in the project.
}
variables
{
    struct TrafficLightStatusMessageTrafficLightID_oid_id {
        INT isValidFlag;   // necessary if this struct is used as an optional field of a SEQUENCE
        INT length;
        INT id;
    };
    
    struct TrafficLightStatusMessageTrafficLightID_oid {
        INT isValidFlag;   // necessary if this struct is used as an optional field of a SEQUENCE
        INT length;
        struct TrafficLightStatusMessageTrafficLightID_oid_id arrayValue[16];
    };
    
    struct TrafficLightStatusMessageTrafficLightID {
        INT isValidFlag;   // necessary if this struct is used as an optional field of a SEQUENCE
        INT choice;
        BYTE id;  // INTEGER, ..;
        struct TrafficLightStatusMessageTrafficLightID_oid oid;  // OBJECTIDENTIFIER;
    };
    
    struct TrafficLightStatusMessageTrafficLightOperationStatus {
        INT isValidFlag;   // necessary if this struct is used as an optional field of a SEQUENCE
        CHAR string[9];
        INT  stringLength;
    };
    
    struct TrafficLightStatusMessageTrafficLightControllerStatus {
        INT isValidFlag;   // necessary if this struct is used as an optional field of a SEQUENCE
        CHAR string[9];
        INT  stringLength;
    };
    
    struct TrafficLightStatusMessageCommon_DDateTime {
        INT isValidFlag;   // necessary if this struct is used as an optional field of a SEQUENCE
        struct OPT_WORD_ASN year;  // INTEGER, OPTIONAL, 0..4095;
        struct OPT_BYTE_ASN month;  // INTEGER, OPTIONAL, 0..12;
        struct OPT_BYTE_ASN day;  // INTEGER, OPTIONAL, 0..31;
        struct OPT_BYTE_ASN hour;  // INTEGER, OPTIONAL, 0..31;
        struct OPT_BYTE_ASN minute;  // INTEGER, OPTIONAL, 0..60;
        struct OPT_WORD_ASN second;  // INTEGER, OPTIONAL, 0..65535;
        struct OPT_INT_ASN offset;  // INTEGER, OPTIONAL, -840..840;
    };
    
    struct TrafficLightStatusMessageTrafficLightStatus {
        INT isValidFlag;   // necessary if this struct is used as an optional field of a SEQUENCE
        INT trafficLightType;  // ENUMERATED, reserved(0), straight(1), left_turn(2), pedestrian(3), bicycle(4), right_turn(5), bus(6), u_turn(7);
        INT consecutiveTrafficLight;  // ENUMERATED, none(0), first(1), second(2);
        INT trafficLightIntervalType;  // ENUMERATED, static(0), variable(1);
        INT pedestrianCall;  // BOOLEAN;
        INT actuatedinterval;  // BOOLEAN;
        INT permissiveNonProtected;  // ENUMERATED, none(0), permissive(1);
        INT lightingStatus;  // ENUMERATED, off(0), red_on(1), yellow_on(2), green_on(3), red_blinking(4), yellow_blinking(5), green_blinking(6);
        BYTE maxIntervalLength;  // INTEGER, 0..255;
        BYTE remainingTime;  // INTEGER, 0..255;
        WORD directionCode;  // INTEGER, 0..359;
        INT reserved;  // BOOLEAN;
    };
    
    struct TrafficLightStatusMessageTrafficLightStatusList {
        INT isValidFlag;   // necessary if this struct is used as an optional field of a SEQUENCE
        INT length;
        struct TrafficLightStatusMessageTrafficLightStatus arrayValue[255];  // SEQUENCE;
    };
    
    struct TrafficLightStatusMessage_TrafficLightStatusMessage {
        INT isValidFlag;   // necessary if this struct is used as an optional field of a SEQUENCE
        struct TrafficLightStatusMessageTrafficLightID trafficLightID;  // CHOICE;
        struct OPT_LONG_ASN lon;  // INTEGER, OPTIONAL, -1799999999..1800000001;
        struct OPT_LONG_ASN lat;  // INTEGER, OPTIONAL, -900000000..900000001;
        struct TrafficLightStatusMessageTrafficLightOperationStatus operationStatus;  // BITSTRING;
        struct TrafficLightStatusMessageTrafficLightControllerStatus controllerStatus;  // BITSTRING;
        WORD cyclecounter;  // INTEGER, 0..65535;
        WORD cycletime;  // INTEGER, 0..65535;
        struct TrafficLightStatusMessageCommon_DDateTime currentTime;  // SEQUENCE;
        struct TrafficLightStatusMessageTrafficLightStatusList trafficLightStatus;  // SEQUENCEOF;
    };
    
    struct TrafficLightStatusMessageMESSAGE_ID_AND_TYPE {
        struct TrafficLightStatusMessage_TrafficLightStatusMessage trafficLightStatusMessage;  // SEQUENCE;
    };
    
    struct TrafficLightStatusMessage {
        INT isValidFlag;   // necessary if this struct is used as an optional field of a SEQUENCE
        WORD messageId;  // INTEGER, 0..32767, mapData(18), signalPhaseAndTimingMessage(19), basicSafetyMessage(20), commonSafetyRequest(21), emergencyVehicleAlert(22), intersectionCollision(23), nmeaCorrections(24), probeDataManagement(25), probeVehicleData(26), roadSideAlert(27), rtcmCorrections(28), signalRequestMessage(29), signalStatusMessage(30), travelerInformation(31), personalSafetyMessage(32), roadSafetyMessage(33), roadWeatherMessage(34), probeDataConfigMessage(35), probeDataReportMessage(36), tollAdvertisementMessage(37), tollUsageMessage(38), tollUsageAckMessage(39), cooperativeControlMessage(40), sensorDataSharingMessage(41), maneuverSharingAndCoordinatingMessage(42), roadGeometryAndAttributes(43), personalSafetyMessage2(44), trafficSignalPhaseAndTiming(45), signalControlAndPrioritizationRequest(46), signalControlAndPrioritizationStatus(47), roadUserChargingConfigMessage(48), roadUserChargingReportMessage(49), trafficLightStatusMessage(50);
        struct TrafficLightStatusMessageMESSAGE_ID_AND_TYPE value;  // TABLE;
    };
    
}

/*
// init function to create a simple packet handle
*/ 
LONG API_InitTrafficLightStatusMessagePacket()
{
  return C2xInitPacket("TrafficLightStatusMessage"); 
}

/*
// init function to create a simple packet handle and
// initialize the struct with valid data
*/ 
LONG API_InitTrafficLightStatusMessagePacket(struct TrafficLightStatusMessage msgStruct)
{
  long pktHandle;

  pktHandle = API_InitTrafficLightStatusMessagePacket();

  if (pktHandle != 0)
  {
    // create valid message and application data
    if (C2xCompletePacket(pktHandle) == 0) 
    {
      API_GetTrafficLightStatusMessageParams(pktHandle, msgStruct);
    }
  }
  return pktHandle;
}

/*
// init function to create a packet with security layer and
// initialize the struct with valid data
*/ 
LONG API_InitTrafficLightStatusMessagePacket(struct TrafficLightStatusMessage msgStruct, char packetTypeDesignator[], char certificateName[])
{
  long pktHandle, certHdl;

  // initialize the packet
  pktHandle = C2xInitPacket("TrafficLightStatusMessage", packetTypeDesignator);

  if (pktHandle != 0)
  {
    certHdl = C2xSecCertificateGetHandle(certificateName);  // get the certificate handle for the cert with name "certificateName"
    if (certHdl != 0) 
    {
      C2xSecPacketSetSignerHandle(pktHandle, certHdl); // set the certHdl to the packet
    }

    // create valid message and application data
    if (C2xCompletePacket(pktHandle) == 0) 
    {
      // copy application data to the application structure
      API_GetTrafficLightStatusMessageParams(pktHandle, msgStruct);
    }
  }
  return pktHandle;
}
    

int GetTrafficLightStatusMessageTrafficLightIDParams(LONG packetHandle, struct TrafficLightStatusMessageTrafficLightID value, char oldPath[])
{
  char newPath[300];
  int i;
  int result;

  result = 0;

  value.choice = C2xGetTokenInt(packetHandle, "TrafficLightStatusMessage", oldPath);

  switch(value.choice)
  {
    case 0:
    {
      snprintf(newPath, elcount(newPath), "%s.%s", oldPath, "id");
      value.id = C2xGetTokenInt64(packetHandle, "TrafficLightStatusMessage", newPath);
      result = CheckLastError("TrafficLightStatusMessage", gkFuncRefGet, result);
    }
    break;
    case 1:
    {
      snprintf(newPath, elcount(newPath), "%s.%s", oldPath, "oid");
      value.oid.length = C2xGetTokenInt(packetHandle, "TrafficLightStatusMessage", newPath);
      if((result = CheckLastError("TrafficLightStatusMessage", gkFuncRefGet, result))==0)
      {
        if(value.oid.length > 0)
        {
          for(i=0; i<value.oid.length; i++)
          {
            value.oid.arrayValue[i].id = C2xGetTokenOidElement(packetHandle, "TrafficLightStatusMessage", newPath, i);
          }
        }
      }
    }
    break;
  }
  return result;
}

int SetTrafficLightStatusMessageTrafficLightIDParams(LONG packetHandle, struct TrafficLightStatusMessageTrafficLightID value, char oldPath[])
{
  char newPath[300];
  int i;
  int result;

  result = 0;

  switch(value.choice)
  {
    case 0:
    {
      snprintf(newPath, elcount(newPath), "%s.%s", oldPath, "id");
      C2xSetTokenInt64(packetHandle, "TrafficLightStatusMessage", newPath, value.id);
      result = CheckLastError("TrafficLightStatusMessage", gkFuncRefGet, result);
    }
    break;
    case 1:
    {
      snprintf(newPath, elcount(newPath), "%s.%s", oldPath, "oid");
      C2xRemoveToken(packetHandle, "TrafficLightStatusMessage", newPath);
      if(value.oid.length > 0)
      {
        for(i=0; i<value.oid.length; i++)
        {
          C2xSetTokenOidElement(packetHandle, "TrafficLightStatusMessage", newPath, i, value.oid.arrayValue[i].id);
        }
      }
      result = CheckLastError("TrafficLightStatusMessage", gkFuncRefGet, result);
    }
    break;
  }
  return result;
}

int GetTrafficLightStatusMessageCommon_DDateTimeParams(LONG packetHandle, struct TrafficLightStatusMessageCommon_DDateTime value, char oldPath[])
{
  char newPath[300];
  int result;

  result = 0;

  snprintf(newPath, elcount(newPath), "%s.%s", oldPath, "year");
  value.year.isValidFlag = C2xIsTokenAvailable(packetHandle, "TrafficLightStatusMessage", newPath);
  if(value.year.isValidFlag==1)
  {
    value.year.value = C2xGetTokenInt(packetHandle, "TrafficLightStatusMessage", newPath);
    result = CheckLastError("TrafficLightStatusMessage", gkFuncRefGet, result);
  }
  snprintf(newPath, elcount(newPath), "%s.%s", oldPath, "month");
  value.month.isValidFlag = C2xIsTokenAvailable(packetHandle, "TrafficLightStatusMessage", newPath);
  if(value.month.isValidFlag==1)
  {
    value.month.value = C2xGetTokenInt(packetHandle, "TrafficLightStatusMessage", newPath);
    result = CheckLastError("TrafficLightStatusMessage", gkFuncRefGet, result);
  }
  snprintf(newPath, elcount(newPath), "%s.%s", oldPath, "day");
  value.day.isValidFlag = C2xIsTokenAvailable(packetHandle, "TrafficLightStatusMessage", newPath);
  if(value.day.isValidFlag==1)
  {
    value.day.value = C2xGetTokenInt(packetHandle, "TrafficLightStatusMessage", newPath);
    result = CheckLastError("TrafficLightStatusMessage", gkFuncRefGet, result);
  }
  snprintf(newPath, elcount(newPath), "%s.%s", oldPath, "hour");
  value.hour.isValidFlag = C2xIsTokenAvailable(packetHandle, "TrafficLightStatusMessage", newPath);
  if(value.hour.isValidFlag==1)
  {
    value.hour.value = C2xGetTokenInt(packetHandle, "TrafficLightStatusMessage", newPath);
    result = CheckLastError("TrafficLightStatusMessage", gkFuncRefGet, result);
  }
  snprintf(newPath, elcount(newPath), "%s.%s", oldPath, "minute");
  value.minute.isValidFlag = C2xIsTokenAvailable(packetHandle, "TrafficLightStatusMessage", newPath);
  if(value.minute.isValidFlag==1)
  {
    value.minute.value = C2xGetTokenInt(packetHandle, "TrafficLightStatusMessage", newPath);
    result = CheckLastError("TrafficLightStatusMessage", gkFuncRefGet, result);
  }
  snprintf(newPath, elcount(newPath), "%s.%s", oldPath, "second");
  value.second.isValidFlag = C2xIsTokenAvailable(packetHandle, "TrafficLightStatusMessage", newPath);
  if(value.second.isValidFlag==1)
  {
    value.second.value = C2xGetTokenInt(packetHandle, "TrafficLightStatusMessage", newPath);
    result = CheckLastError("TrafficLightStatusMessage", gkFuncRefGet, result);
  }
  snprintf(newPath, elcount(newPath), "%s.%s", oldPath, "offset");
  value.offset.isValidFlag = C2xIsTokenAvailable(packetHandle, "TrafficLightStatusMessage", newPath);
  if(value.offset.isValidFlag==1)
  {
    value.offset.value = C2xGetTokenInt(packetHandle, "TrafficLightStatusMessage", newPath);
    result = CheckLastError("TrafficLightStatusMessage", gkFuncRefGet, result);
  }
  return result;
}

int SetTrafficLightStatusMessageCommon_DDateTimeParams(LONG packetHandle, struct TrafficLightStatusMessageCommon_DDateTime value, char oldPath[])
{
  char newPath[300];
  int result;

  result = 0;

  snprintf(newPath, elcount(newPath), "%s.%s", oldPath, "year");
  if(value.year.isValidFlag==1)
  {
    C2xSetTokenInt(packetHandle, "TrafficLightStatusMessage", newPath, value.year.value);
    result = CheckLastError("TrafficLightStatusMessage", gkFuncRefGet, result);
  }
  else
  {
    if( C2xIsTokenAvailable(packetHandle, "TrafficLightStatusMessage", newPath) )
    {
      C2xRemoveToken(packetHandle, "TrafficLightStatusMessage", newPath);
    }
  }

  snprintf(newPath, elcount(newPath), "%s.%s", oldPath, "month");
  if(value.month.isValidFlag==1)
  {
    C2xSetTokenInt(packetHandle, "TrafficLightStatusMessage", newPath, value.month.value);
    result = CheckLastError("TrafficLightStatusMessage", gkFuncRefGet, result);
  }
  else
  {
    if( C2xIsTokenAvailable(packetHandle, "TrafficLightStatusMessage", newPath) )
    {
      C2xRemoveToken(packetHandle, "TrafficLightStatusMessage", newPath);
    }
  }

  snprintf(newPath, elcount(newPath), "%s.%s", oldPath, "day");
  if(value.day.isValidFlag==1)
  {
    C2xSetTokenInt(packetHandle, "TrafficLightStatusMessage", newPath, value.day.value);
    result = CheckLastError("TrafficLightStatusMessage", gkFuncRefGet, result);
  }
  else
  {
    if( C2xIsTokenAvailable(packetHandle, "TrafficLightStatusMessage", newPath) )
    {
      C2xRemoveToken(packetHandle, "TrafficLightStatusMessage", newPath);
    }
  }

  snprintf(newPath, elcount(newPath), "%s.%s", oldPath, "hour");
  if(value.hour.isValidFlag==1)
  {
    C2xSetTokenInt(packetHandle, "TrafficLightStatusMessage", newPath, value.hour.value);
    result = CheckLastError("TrafficLightStatusMessage", gkFuncRefGet, result);
  }
  else
  {
    if( C2xIsTokenAvailable(packetHandle, "TrafficLightStatusMessage", newPath) )
    {
      C2xRemoveToken(packetHandle, "TrafficLightStatusMessage", newPath);
    }
  }

  snprintf(newPath, elcount(newPath), "%s.%s", oldPath, "minute");
  if(value.minute.isValidFlag==1)
  {
    C2xSetTokenInt(packetHandle, "TrafficLightStatusMessage", newPath, value.minute.value);
    result = CheckLastError("TrafficLightStatusMessage", gkFuncRefGet, result);
  }
  else
  {
    if( C2xIsTokenAvailable(packetHandle, "TrafficLightStatusMessage", newPath) )
    {
      C2xRemoveToken(packetHandle, "TrafficLightStatusMessage", newPath);
    }
  }

  snprintf(newPath, elcount(newPath), "%s.%s", oldPath, "second");
  if(value.second.isValidFlag==1)
  {
    C2xSetTokenInt(packetHandle, "TrafficLightStatusMessage", newPath, value.second.value);
    result = CheckLastError("TrafficLightStatusMessage", gkFuncRefGet, result);
  }
  else
  {
    if( C2xIsTokenAvailable(packetHandle, "TrafficLightStatusMessage", newPath) )
    {
      C2xRemoveToken(packetHandle, "TrafficLightStatusMessage", newPath);
    }
  }

  snprintf(newPath, elcount(newPath), "%s.%s", oldPath, "offset");
  if(value.offset.isValidFlag==1)
  {
    C2xSetTokenInt(packetHandle, "TrafficLightStatusMessage", newPath, value.offset.value);
    result = CheckLastError("TrafficLightStatusMessage", gkFuncRefGet, result);
  }
  else
  {
    if( C2xIsTokenAvailable(packetHandle, "TrafficLightStatusMessage", newPath) )
    {
      C2xRemoveToken(packetHandle, "TrafficLightStatusMessage", newPath);
    }
  }

  return result;
}

int GetTrafficLightStatusMessageTrafficLightStatusParams(LONG packetHandle, struct TrafficLightStatusMessageTrafficLightStatus value, char oldPath[])
{
  char newPath[300];
  int result;

  result = 0;

  snprintf(newPath, elcount(newPath), "%s.%s", oldPath, "trafficLightType");
  value.trafficLightType = C2xGetTokenInt(packetHandle, "TrafficLightStatusMessage", newPath);
  result = CheckLastError("TrafficLightStatusMessage", gkFuncRefGet, result);

  snprintf(newPath, elcount(newPath), "%s.%s", oldPath, "consecutiveTrafficLight");
  value.consecutiveTrafficLight = C2xGetTokenInt(packetHandle, "TrafficLightStatusMessage", newPath);
  result = CheckLastError("TrafficLightStatusMessage", gkFuncRefGet, result);

  snprintf(newPath, elcount(newPath), "%s.%s", oldPath, "trafficLightIntervalType");
  value.trafficLightIntervalType = C2xGetTokenInt(packetHandle, "TrafficLightStatusMessage", newPath);
  result = CheckLastError("TrafficLightStatusMessage", gkFuncRefGet, result);

  snprintf(newPath, elcount(newPath), "%s.%s", oldPath, "pedestrianCall");
  value.pedestrianCall = C2xGetTokenInt64(packetHandle, "TrafficLightStatusMessage", newPath);
  result = CheckLastError("TrafficLightStatusMessage", gkFuncRefGet, result);

  snprintf(newPath, elcount(newPath), "%s.%s", oldPath, "actuatedinterval");
  value.actuatedinterval = C2xGetTokenInt64(packetHandle, "TrafficLightStatusMessage", newPath);
  result = CheckLastError("TrafficLightStatusMessage", gkFuncRefGet, result);

  snprintf(newPath, elcount(newPath), "%s.%s", oldPath, "permissiveNonProtected");
  value.permissiveNonProtected = C2xGetTokenInt(packetHandle, "TrafficLightStatusMessage", newPath);
  result = CheckLastError("TrafficLightStatusMessage", gkFuncRefGet, result);

  snprintf(newPath, elcount(newPath), "%s.%s", oldPath, "lightingStatus");
  value.lightingStatus = C2xGetTokenInt(packetHandle, "TrafficLightStatusMessage", newPath);
  result = CheckLastError("TrafficLightStatusMessage", gkFuncRefGet, result);

  snprintf(newPath, elcount(newPath), "%s.%s", oldPath, "maxIntervalLength");
  value.maxIntervalLength = C2xGetTokenInt(packetHandle, "TrafficLightStatusMessage", newPath);
  result = CheckLastError("TrafficLightStatusMessage", gkFuncRefGet, result);

  snprintf(newPath, elcount(newPath), "%s.%s", oldPath, "remainingTime");
  value.remainingTime = C2xGetTokenInt(packetHandle, "TrafficLightStatusMessage", newPath);
  result = CheckLastError("TrafficLightStatusMessage", gkFuncRefGet, result);

  snprintf(newPath, elcount(newPath), "%s.%s", oldPath, "directionCode");
  value.directionCode = C2xGetTokenInt(packetHandle, "TrafficLightStatusMessage", newPath);
  result = CheckLastError("TrafficLightStatusMessage", gkFuncRefGet, result);

  snprintf(newPath, elcount(newPath), "%s.%s", oldPath, "reserved");
  value.reserved = C2xGetTokenInt64(packetHandle, "TrafficLightStatusMessage", newPath);
  result = CheckLastError("TrafficLightStatusMessage", gkFuncRefGet, result);

  return result;
}

int SetTrafficLightStatusMessageTrafficLightStatusParams(LONG packetHandle, struct TrafficLightStatusMessageTrafficLightStatus value, char oldPath[])
{
  char newPath[300];
  int result;

  result = 0;

  snprintf(newPath, elcount(newPath), "%s.%s", oldPath, "trafficLightType");
  C2xSetTokenInt(packetHandle, "TrafficLightStatusMessage", newPath, value.trafficLightType);
  result = CheckLastError("TrafficLightStatusMessage", gkFuncRefGet, result);

  snprintf(newPath, elcount(newPath), "%s.%s", oldPath, "consecutiveTrafficLight");
  C2xSetTokenInt(packetHandle, "TrafficLightStatusMessage", newPath, value.consecutiveTrafficLight);
  result = CheckLastError("TrafficLightStatusMessage", gkFuncRefGet, result);

  snprintf(newPath, elcount(newPath), "%s.%s", oldPath, "trafficLightIntervalType");
  C2xSetTokenInt(packetHandle, "TrafficLightStatusMessage", newPath, value.trafficLightIntervalType);
  result = CheckLastError("TrafficLightStatusMessage", gkFuncRefGet, result);

  snprintf(newPath, elcount(newPath), "%s.%s", oldPath, "pedestrianCall");
  C2xSetTokenInt64(packetHandle, "TrafficLightStatusMessage", newPath, value.pedestrianCall);
  result = CheckLastError("TrafficLightStatusMessage", gkFuncRefGet, result);

  snprintf(newPath, elcount(newPath), "%s.%s", oldPath, "actuatedinterval");
  C2xSetTokenInt64(packetHandle, "TrafficLightStatusMessage", newPath, value.actuatedinterval);
  result = CheckLastError("TrafficLightStatusMessage", gkFuncRefGet, result);

  snprintf(newPath, elcount(newPath), "%s.%s", oldPath, "permissiveNonProtected");
  C2xSetTokenInt(packetHandle, "TrafficLightStatusMessage", newPath, value.permissiveNonProtected);
  result = CheckLastError("TrafficLightStatusMessage", gkFuncRefGet, result);

  snprintf(newPath, elcount(newPath), "%s.%s", oldPath, "lightingStatus");
  C2xSetTokenInt(packetHandle, "TrafficLightStatusMessage", newPath, value.lightingStatus);
  result = CheckLastError("TrafficLightStatusMessage", gkFuncRefGet, result);

  snprintf(newPath, elcount(newPath), "%s.%s", oldPath, "maxIntervalLength");
  C2xSetTokenInt(packetHandle, "TrafficLightStatusMessage", newPath, value.maxIntervalLength);
  result = CheckLastError("TrafficLightStatusMessage", gkFuncRefGet, result);

  snprintf(newPath, elcount(newPath), "%s.%s", oldPath, "remainingTime");
  C2xSetTokenInt(packetHandle, "TrafficLightStatusMessage", newPath, value.remainingTime);
  result = CheckLastError("TrafficLightStatusMessage", gkFuncRefGet, result);

  snprintf(newPath, elcount(newPath), "%s.%s", oldPath, "directionCode");
  C2xSetTokenInt(packetHandle, "TrafficLightStatusMessage", newPath, value.directionCode);
  result = CheckLastError("TrafficLightStatusMessage", gkFuncRefGet, result);

  snprintf(newPath, elcount(newPath), "%s.%s", oldPath, "reserved");
  C2xSetTokenInt64(packetHandle, "TrafficLightStatusMessage", newPath, value.reserved);
  result = CheckLastError("TrafficLightStatusMessage", gkFuncRefGet, result);

  return result;
}

int GetTrafficLightStatusMessageTrafficLightStatusListParams(LONG packetHandle, struct TrafficLightStatusMessageTrafficLightStatusList value, char oldPath[])
{
  char newPath[300]; 
  int i;
  int result;

  result = 0;

  value.length = C2xGetTokenInt(packetHandle, "TrafficLightStatusMessage", oldPath);
  if((result = CheckLastError("TrafficLightStatusMessage", gkFuncRefGet, result))==0)
  {
    for(i=0; i<value.length; i++)
    {
      snprintf(newPath, elcount(newPath), "%s[%d]", oldPath, i);
      GetTrafficLightStatusMessageTrafficLightStatusParams(packetHandle, value.arrayValue[i], newPath);
      result = CheckLastError("TrafficLightStatusMessage", gkFuncRefGet, result);
    }
  }
  return result;
}

int SetTrafficLightStatusMessageTrafficLightStatusListParams(LONG packetHandle, struct TrafficLightStatusMessageTrafficLightStatusList value, char oldPath[])
{
  char newPath[300]; 
  int i;
  int result;

  result = 0;

  C2xRemoveToken(packetHandle, "TrafficLightStatusMessage", oldPath);
  for(i=0; i<value.length; i++)
  {
    snprintf(newPath, elcount(newPath), "%s[%d]", oldPath, i);
    SetTrafficLightStatusMessageTrafficLightStatusParams(packetHandle, value.arrayValue[i], newPath);
    result = CheckLastError("TrafficLightStatusMessage", gkFuncRefGet, result);
  }
  return result;
}

int GetTrafficLightStatusMessage_TrafficLightStatusMessageParams(LONG packetHandle, struct TrafficLightStatusMessage_TrafficLightStatusMessage value, char oldPath[])
{
  char newPath[300]; 
  int j; 
  int k;
  int result;

  result = 0;

  snprintf(newPath, elcount(newPath), "%s.%s", oldPath, "trafficLightID");
  GetTrafficLightStatusMessageTrafficLightIDParams(packetHandle, value.trafficLightID, newPath);
  result = CheckLastError("TrafficLightStatusMessage", gkFuncRefGet, result);

  snprintf(newPath, elcount(newPath), "%s.%s", oldPath, "lon");
  value.lon.isValidFlag = C2xIsTokenAvailable(packetHandle, "TrafficLightStatusMessage", newPath);
  if(value.lon.isValidFlag==1)
  {
    value.lon.value = C2xGetTokenInt(packetHandle, "TrafficLightStatusMessage", newPath);
    result = CheckLastError("TrafficLightStatusMessage", gkFuncRefGet, result);
  }
  snprintf(newPath, elcount(newPath), "%s.%s", oldPath, "lat");
  value.lat.isValidFlag = C2xIsTokenAvailable(packetHandle, "TrafficLightStatusMessage", newPath);
  if(value.lat.isValidFlag==1)
  {
    value.lat.value = C2xGetTokenInt(packetHandle, "TrafficLightStatusMessage", newPath);
    result = CheckLastError("TrafficLightStatusMessage", gkFuncRefGet, result);
  }
  snprintf(newPath, elcount(newPath), "%s.%s", oldPath, "operationStatus");
  value.operationStatus.isValidFlag = 1;
  value.operationStatus.stringLength = C2xGetTokenLengthBit(packetHandle, "TrafficLightStatusMessage", newPath);
  if ((result = CheckLastError("TrafficLightStatusMessage", gkFuncRefGet, result))==0)
  {
    if(value.operationStatus.stringLength > 0)
    {
      for(j=0; j<value.operationStatus.stringLength; j++)
      {
        if(C2xGetTokenBitOfBitString(packetHandle, "TrafficLightStatusMessage", newPath, j) == 0)
        {
          value.operationStatus.string[j] = '0';
        }
        else if(C2xGetTokenBitOfBitString(packetHandle, "TrafficLightStatusMessage", newPath, j) == 1)
        {
          value.operationStatus.string[j] = '1';
        }

        if(value.operationStatus.stringLength == 1)
        {
          value.operationStatus.string[1] = '0';
        }
        result = CheckLastError("TrafficLightStatusMessage", gkFuncRefGet, result);
      }
    }
    else
    {
      for(k = value.operationStatus.stringLength+1; k > -1; k--)
      {
        if(value.operationStatus.string[k] == '1')
        {
          value.operationStatus.string[k] = '0';
        }
      }
    }
  }

  snprintf(newPath, elcount(newPath), "%s.%s", oldPath, "controllerStatus");
  value.controllerStatus.isValidFlag = 1;
  value.controllerStatus.stringLength = C2xGetTokenLengthBit(packetHandle, "TrafficLightStatusMessage", newPath);
  if ((result = CheckLastError("TrafficLightStatusMessage", gkFuncRefGet, result))==0)
  {
    if(value.controllerStatus.stringLength > 0)
    {
      for(j=0; j<value.controllerStatus.stringLength; j++)
      {
        if(C2xGetTokenBitOfBitString(packetHandle, "TrafficLightStatusMessage", newPath, j) == 0)
        {
          value.controllerStatus.string[j] = '0';
        }
        else if(C2xGetTokenBitOfBitString(packetHandle, "TrafficLightStatusMessage", newPath, j) == 1)
        {
          value.controllerStatus.string[j] = '1';
        }

        if(value.controllerStatus.stringLength == 1)
        {
          value.controllerStatus.string[1] = '0';
        }
        result = CheckLastError("TrafficLightStatusMessage", gkFuncRefGet, result);
      }
    }
    else
    {
      for(k = value.controllerStatus.stringLength+1; k > -1; k--)
      {
        if(value.controllerStatus.string[k] == '1')
        {
          value.controllerStatus.string[k] = '0';
        }
      }
    }
  }

  snprintf(newPath, elcount(newPath), "%s.%s", oldPath, "cyclecounter");
  value.cyclecounter = C2xGetTokenInt(packetHandle, "TrafficLightStatusMessage", newPath);
  result = CheckLastError("TrafficLightStatusMessage", gkFuncRefGet, result);

  snprintf(newPath, elcount(newPath), "%s.%s", oldPath, "cycletime");
  value.cycletime = C2xGetTokenInt(packetHandle, "TrafficLightStatusMessage", newPath);
  result = CheckLastError("TrafficLightStatusMessage", gkFuncRefGet, result);

  snprintf(newPath, elcount(newPath), "%s.%s", oldPath, "currentTime");
  GetTrafficLightStatusMessageCommon_DDateTimeParams(packetHandle, value.currentTime, newPath);
  result = CheckLastError("TrafficLightStatusMessage", gkFuncRefGet, result);

  snprintf(newPath, elcount(newPath), "%s.%s", oldPath, "trafficLightStatus");
  GetTrafficLightStatusMessageTrafficLightStatusListParams(packetHandle, value.trafficLightStatus, newPath);
  result = CheckLastError("TrafficLightStatusMessage", gkFuncRefGet, result);

  return result;
}

int SetTrafficLightStatusMessage_TrafficLightStatusMessageParams(LONG packetHandle, struct TrafficLightStatusMessage_TrafficLightStatusMessage value, char oldPath[])
{
  char newPath[300]; 
  int j;
  int result;

  result = 0;

  snprintf(newPath, elcount(newPath), "%s.%s", oldPath, "trafficLightID");
  SetTrafficLightStatusMessageTrafficLightIDParams(packetHandle, value.trafficLightID, newPath);
  result = CheckLastError("TrafficLightStatusMessage", gkFuncRefGet, result);

  snprintf(newPath, elcount(newPath), "%s.%s", oldPath, "lon");
  if(value.lon.isValidFlag==1)
  {
    C2xSetTokenInt(packetHandle, "TrafficLightStatusMessage", newPath, value.lon.value);
    result = CheckLastError("TrafficLightStatusMessage", gkFuncRefGet, result);
  }
  else
  {
    if( C2xIsTokenAvailable(packetHandle, "TrafficLightStatusMessage", newPath) )
    {
      C2xRemoveToken(packetHandle, "TrafficLightStatusMessage", newPath);
    }
  }

  snprintf(newPath, elcount(newPath), "%s.%s", oldPath, "lat");
  if(value.lat.isValidFlag==1)
  {
    C2xSetTokenInt(packetHandle, "TrafficLightStatusMessage", newPath, value.lat.value);
    result = CheckLastError("TrafficLightStatusMessage", gkFuncRefGet, result);
  }
  else
  {
    if( C2xIsTokenAvailable(packetHandle, "TrafficLightStatusMessage", newPath) )
    {
      C2xRemoveToken(packetHandle, "TrafficLightStatusMessage", newPath);
    }
  }

  snprintf(newPath, elcount(newPath), "%s.%s", oldPath, "operationStatus");
    for(j=0; j<value.operationStatus.stringLength; j++)
    {
      if(value.operationStatus.string[j] == '0')
      {
        C2xSetTokenBitOfBitString(packetHandle, "TrafficLightStatusMessage", newPath, j, 0);
      }
      else
      {
        C2xSetTokenBitOfBitString(packetHandle, "TrafficLightStatusMessage", newPath, j, 1);
      }
      result = CheckLastError("TrafficLightStatusMessage", gkFuncRefGet, result);
    }

  snprintf(newPath, elcount(newPath), "%s.%s", oldPath, "controllerStatus");
    for(j=0; j<value.controllerStatus.stringLength; j++)
    {
      if(value.controllerStatus.string[j] == '0')
      {
        C2xSetTokenBitOfBitString(packetHandle, "TrafficLightStatusMessage", newPath, j, 0);
      }
      else
      {
        C2xSetTokenBitOfBitString(packetHandle, "TrafficLightStatusMessage", newPath, j, 1);
      }
      result = CheckLastError("TrafficLightStatusMessage", gkFuncRefGet, result);
    }

  snprintf(newPath, elcount(newPath), "%s.%s", oldPath, "cyclecounter");
  C2xSetTokenInt(packetHandle, "TrafficLightStatusMessage", newPath, value.cyclecounter);
  result = CheckLastError("TrafficLightStatusMessage", gkFuncRefGet, result);

  snprintf(newPath, elcount(newPath), "%s.%s", oldPath, "cycletime");
  C2xSetTokenInt(packetHandle, "TrafficLightStatusMessage", newPath, value.cycletime);
  result = CheckLastError("TrafficLightStatusMessage", gkFuncRefGet, result);

  snprintf(newPath, elcount(newPath), "%s.%s", oldPath, "currentTime");
  SetTrafficLightStatusMessageCommon_DDateTimeParams(packetHandle, value.currentTime, newPath);
  result = CheckLastError("TrafficLightStatusMessage", gkFuncRefGet, result);

  snprintf(newPath, elcount(newPath), "%s.%s", oldPath, "trafficLightStatus");
  SetTrafficLightStatusMessageTrafficLightStatusListParams(packetHandle, value.trafficLightStatus, newPath);
  result = CheckLastError("TrafficLightStatusMessage", gkFuncRefGet, result);

  return result;
}

int GetTrafficLightStatusMessageMESSAGE_ID_AND_TYPEParams(LONG packetHandle, WORD tableKey, struct TrafficLightStatusMessageMESSAGE_ID_AND_TYPE value, char oldPath[])
{
  char newPath[300];
  int result;

  result = 0;

  switch(tableKey)
  {
    case 50:
    {
      snprintf(newPath, elcount(newPath), "%s.%s", oldPath, "trafficLightStatusMessage");
      GetTrafficLightStatusMessage_TrafficLightStatusMessageParams(packetHandle, value.trafficLightStatusMessage, newPath);
      result = CheckLastError("TrafficLightStatusMessage", gkFuncRefGet, result);
    }
    break;
  }
  return result;
}

int SetTrafficLightStatusMessageMESSAGE_ID_AND_TYPEParams(LONG packetHandle, WORD tableKey, struct TrafficLightStatusMessageMESSAGE_ID_AND_TYPE value, char oldPath[])
{
  char newPath[300];
  int result;

  result = 0;

  switch(tableKey)
  {
    case 50:
    {
      snprintf(newPath, elcount(newPath), "%s.%s", oldPath, "trafficLightStatusMessage");
      SetTrafficLightStatusMessage_TrafficLightStatusMessageParams(packetHandle, value.trafficLightStatusMessage, newPath);
      result = CheckLastError("TrafficLightStatusMessage", gkFuncRefGet, result);
    }
    break;
  }
  return result;
}

int API_GetTrafficLightStatusMessageParams(LONG packetHandle, struct TrafficLightStatusMessage value)
{
  int result;
  result = 0;

  value.messageId = C2xGetTokenInt(packetHandle, "TrafficLightStatusMessage", "messageId");
  result = CheckLastError("TrafficLightStatusMessage", gkFuncRefGet, result);

  GetTrafficLightStatusMessageMESSAGE_ID_AND_TYPEParams(packetHandle, value.messageId, value.value, "value");
  result = CheckLastError("TrafficLightStatusMessage", gkFuncRefGet, result);

  return result;
}

int API_SetTrafficLightStatusMessageParams(LONG packetHandle, struct TrafficLightStatusMessage value)
{
  int result;
  result = 0;

  value.messageId = 50;

  SetTrafficLightStatusMessageMESSAGE_ID_AND_TYPEParams(packetHandle, value.messageId, value.value, "value");
  result = CheckLastError("TrafficLightStatusMessage", gkFuncRefGet, result);

  return result;
}

