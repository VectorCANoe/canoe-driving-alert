/*@!Encoding:1252*/
/*
//  (c) Vector Informatik GmbH. All rights reserved.
//
//  This file contains definitions of structs and methods that may be used
//  to set and get the values of an ASN.1 defined packet's payload.
//
//  //This example demonstrates how to set a packet's payload:
//  LONG packetHandle;
//  struct SignalRequestMessage payload;
//  //you need to set the values of the variable "payload" yourself
//  packetHandle = API_InitSignalRequestMessagePacket();
//  if (packetHandle!=0) {
//    if (API_SetSignalRequestMessageParams(packetHandle, payload)==0) {
//      if (C2xCompletePacket(packetHandle)==0) {
//        C2xOutputPacket(packetHandle);
//      }
//    }
//  }
//                                                                             */
includes
{
  #include "ASNV_Template_BaseDatatypes.cin"  // If warning "Duplicate #include, ignoring this include" appears, please remove the ASNV_Template_BaseDatatypes.cin include from your other *.cin files in the project.
}
variables
{
    struct SignalRequestMessageCommon_IntersectionReferenceID {
        INT isValidFlag;   // necessary if this struct is used as an optional field of a SEQUENCE
        struct OPT_WORD_ASN region;  // INTEGER, OPTIONAL, 0..65535;
        WORD id;  // INTEGER, 0..65535;
    };
    
    struct SignalRequestMessageCommon_IntersectionAccessPoint {
        INT isValidFlag;   // necessary if this struct is used as an optional field of a SEQUENCE
        INT choice;
        BYTE lane;  // INTEGER, 0..255;
        BYTE approach;  // INTEGER, 0..15;
        BYTE connection;  // INTEGER, 0..255;
    };
    
    struct SignalRequestMessageCommon_RegionalExtension_Reg_SignalRequest_table {
    };
    
    struct SignalRequestMessageCommon_RegionalExtension_Reg_SignalRequest {
        INT isValidFlag;   // necessary if this struct is used as an optional field of a SEQUENCE
        BYTE regionId;  // INTEGER, 0..255, noRegion(0), addGrpA(1), addGrpB(2), addGrpC(3), addGrpD(4);
        struct SignalRequestMessageCommon_RegionalExtension_Reg_SignalRequest_table regExtvalue;  // TABLE;
    };
    
    struct SignalRequestMessageSignalRequest_regional {
        INT isValidFlag;   // necessary if this struct is used as an optional field of a SEQUENCE
        INT length;
        struct SignalRequestMessageCommon_RegionalExtension_Reg_SignalRequest arrayValue[4];  // SEQUENCE;
    };
    
    struct SignalRequestMessageSignalRequest {
        INT isValidFlag;   // necessary if this struct is used as an optional field of a SEQUENCE
        struct SignalRequestMessageCommon_IntersectionReferenceID id;  // SEQUENCE;
        BYTE requestID;  // INTEGER, 0..255;
        INT requestType;  // ENUMERATED, priorityRequestTypeReserved(0), priorityRequest(1), priorityRequestUpdate(2), priorityCancellation(3);
        struct SignalRequestMessageCommon_IntersectionAccessPoint inBoundLane;  // CHOICE;
        struct SignalRequestMessageCommon_IntersectionAccessPoint outBoundLane;  // CHOICE, OPTIONAL;
        struct SignalRequestMessageSignalRequest_regional regional;  // SEQUENCEOF, OPTIONAL;
    };
    
    struct SignalRequestMessageCommon_RegionalExtension_Reg_SignalRequestPackage_table {
    };
    
    struct SignalRequestMessageCommon_RegionalExtension_Reg_SignalRequestPackage {
        INT isValidFlag;   // necessary if this struct is used as an optional field of a SEQUENCE
        BYTE regionId;  // INTEGER, 0..255, noRegion(0), addGrpA(1), addGrpB(2), addGrpC(3), addGrpD(4);
        struct SignalRequestMessageCommon_RegionalExtension_Reg_SignalRequestPackage_table regExtvalue;  // TABLE;
    };
    
    struct SignalRequestMessageSignalRequestPackage_regional {
        INT isValidFlag;   // necessary if this struct is used as an optional field of a SEQUENCE
        INT length;
        struct SignalRequestMessageCommon_RegionalExtension_Reg_SignalRequestPackage arrayValue[4];  // SEQUENCE;
    };
    
    struct SignalRequestMessageSignalRequestPackage {
        INT isValidFlag;   // necessary if this struct is used as an optional field of a SEQUENCE
        struct SignalRequestMessageSignalRequest request;  // SEQUENCE;
        struct OPT_DWORD_ASN minute;  // INTEGER, OPTIONAL, 0..527040;
        struct OPT_WORD_ASN second;  // INTEGER, OPTIONAL, 0..65535;
        struct OPT_WORD_ASN duration;  // INTEGER, OPTIONAL, 0..65535;
        struct SignalRequestMessageSignalRequestPackage_regional regional;  // SEQUENCEOF, OPTIONAL;
    };
    
    struct SignalRequestMessageSignalRequestList {
        INT isValidFlag;   // necessary if this struct is used as an optional field of a SEQUENCE
        INT length;
        struct SignalRequestMessageSignalRequestPackage arrayValue[32];  // SEQUENCE;
    };
    
    struct SignalRequestMessageCommon_TemporaryID {
        INT isValidFlag;   // necessary if this struct is used as an optional field of a SEQUENCE
        CHAR string[5];
        INT  stringLength;
    };
    
    struct SignalRequestMessageCommon_VehicleID {
        INT isValidFlag;   // necessary if this struct is used as an optional field of a SEQUENCE
        INT choice;
        struct SignalRequestMessageCommon_TemporaryID entityID;  // OCTETSTRING;
        DWORD stationID;  // INTEGER, 0..4294967295;
    };
    
    struct SignalRequestMessageCommon_RegionalExtension_Reg_RequestorType_table {
    };
    
    struct SignalRequestMessageCommon_RegionalExtension_Reg_RequestorType {
        INT isValidFlag;   // necessary if this struct is used as an optional field of a SEQUENCE
        BYTE regionId;  // INTEGER, 0..255, noRegion(0), addGrpA(1), addGrpB(2), addGrpC(3), addGrpD(4);
        struct SignalRequestMessageCommon_RegionalExtension_Reg_RequestorType_table regExtvalue;  // TABLE;
    };
    
    struct SignalRequestMessageCommon_RequestorType {
        INT isValidFlag;   // necessary if this struct is used as an optional field of a SEQUENCE
        INT role;  // ENUMERATED, basicVehicle(0), publicTransport(1), specialTransport(2), dangerousGoods(3), roadWork(4), roadRescue(5), emergency(6), safetyCar(7), none_unknown(8), truck(9), motorcycle(10), roadSideSource(11), police(12), fire(13), ambulance(14), dot(15), transit(16), slowMoving(17), stopNgo(18), cyclist(19), pedestrian(20), nonMotorized(21), military(22);
        struct OPT_ENUM_ASN subrole;  // ENUMERATED, OPTIONAL, requestSubRoleUnKnown(0), requestSubRole1(1), requestSubRole2(2), requestSubRole3(3), requestSubRole4(4), requestSubRole5(5), requestSubRole6(6), requestSubRole7(7), requestSubRole8(8), requestSubRole9(9), requestSubRole10(10), requestSubRole11(11), requestSubRole12(12), requestSubRole13(13), requestSubRole14(14), requestSubRoleReserved(15);
        struct OPT_ENUM_ASN request;  // ENUMERATED, OPTIONAL, requestImportanceLevelUnKnown(0), requestImportanceLevel1(1), requestImportanceLevel2(2), requestImportanceLevel3(3), requestImportanceLevel4(4), requestImportanceLevel5(5), requestImportanceLevel6(6), requestImportanceLevel7(7), requestImportanceLevel8(8), requestImportanceLevel9(9), requestImportanceLevel10(10), requestImportanceLevel11(11), requestImportanceLevel12(12), requestImportanceLevel13(13), requestImportanceLevel14(14), requestImportanceReserved(15);
        struct OPT_BYTE_ASN iso3883;  // INTEGER, OPTIONAL, 0..100;
        struct OPT_ENUM_ASN hpmsType;  // ENUMERATED, OPTIONAL, none(0), unknown(1), special(2), moto(3), car(4), carOther(5), bus(6), axleCnt2(7), axleCnt3(8), axleCnt4(9), axleCnt4Trailer(10), axleCnt5Trailer(11), axleCnt6Trailer(12), axleCnt5MultiTrailer(13), axleCnt6MultiTrailer(14), axleCnt7MultiTrailer(15);
        struct SignalRequestMessageCommon_RegionalExtension_Reg_RequestorType regional;  // SEQUENCE, OPTIONAL;
    };
    
    struct SignalRequestMessageAddGrpB_LatitudeDMS2 {
        INT isValidFlag;   // necessary if this struct is used as an optional field of a SEQUENCE
        INT d;  // INTEGER, -90..90;
        BYTE m;  // INTEGER, 0..59;
        WORD s;  // INTEGER, 0..5999;
    };
    
    struct SignalRequestMessageAddGrpB_LongitudeDMS2 {
        INT isValidFlag;   // necessary if this struct is used as an optional field of a SEQUENCE
        INT d;  // INTEGER, -180..180;
        BYTE m;  // INTEGER, 0..59;
        WORD s;  // INTEGER, 0..5999;
    };
    
    struct SignalRequestMessageAddGrpB_Position3D_addGrpB {
        INT isValidFlag;   // necessary if this struct is used as an optional field of a SEQUENCE
        struct SignalRequestMessageAddGrpB_LatitudeDMS2 latitude;  // SEQUENCE;
        struct SignalRequestMessageAddGrpB_LongitudeDMS2 longitude;  // SEQUENCE;
        INT elevation;  // INTEGER, -32768..32767;
    };
    
    struct SignalRequestMessageAddGrpC_Altitude {
        INT isValidFlag;   // necessary if this struct is used as an optional field of a SEQUENCE
        LONG value;  // INTEGER, -100000..800001;
        INT confidence;  // ENUMERATED, alt_000_01(-0), alt_000_02(1), alt_000_05(2), alt_000_10(3), alt_000_20(4), alt_000_50(5), alt_001_00(6), alt_002_00(7), alt_005_00(8), alt_010_00(9), alt_020_00(10), alt_050_00(11), alt_100_00(12), alt_200_00(13), outOfRange(14), unavailable(15);
    };
    
    struct SignalRequestMessageAddGrpC_Position3D_addGrpC {
        INT isValidFlag;   // necessary if this struct is used as an optional field of a SEQUENCE
        struct SignalRequestMessageAddGrpC_Altitude altitude;  // SEQUENCE;
    };
    
    struct SignalRequestMessageCommon_RegionalExtension_Reg_Position3D_table {
        struct SignalRequestMessageAddGrpB_Position3D_addGrpB addGrpB;  // SEQUENCE;
        struct SignalRequestMessageAddGrpC_Position3D_addGrpC addGrpC;  // SEQUENCE;
    };
    
    struct SignalRequestMessageCommon_RegionalExtension_Reg_Position3D {
        INT isValidFlag;   // necessary if this struct is used as an optional field of a SEQUENCE
        BYTE regionId;  // INTEGER, 0..255, noRegion(0), addGrpA(1), addGrpB(2), addGrpC(3), addGrpD(4);
        struct SignalRequestMessageCommon_RegionalExtension_Reg_Position3D_table regExtvalue;  // TABLE;
    };
    
    struct SignalRequestMessageCommon_Position3D_regional {
        INT isValidFlag;   // necessary if this struct is used as an optional field of a SEQUENCE
        INT length;
        struct SignalRequestMessageCommon_RegionalExtension_Reg_Position3D arrayValue[4];  // SEQUENCE;
    };
    
    struct SignalRequestMessageCommon_Position3D {
        INT isValidFlag;   // necessary if this struct is used as an optional field of a SEQUENCE
        LONG lat;  // INTEGER, -900000000..900000001;
        LONG lon;  // INTEGER, -1799999999..1800000001;
        struct OPT_LONG_ASN elevation;  // INTEGER, OPTIONAL, -4096..61439;
        struct SignalRequestMessageCommon_Position3D_regional regional;  // SEQUENCEOF, OPTIONAL;
    };
    
    struct SignalRequestMessageCommon_TransmissionAndSpeed {
        INT isValidFlag;   // necessary if this struct is used as an optional field of a SEQUENCE
        INT transmisson;  // ENUMERATED, neutral(0), park(1), forwardGears(2), reverseGears(3), reserved1(4), reserved2(5), reserved3(6), unavailable(7);
        WORD speed;  // INTEGER, 0..8191;
    };
    
    struct SignalRequestMessageRequestorPositionVector {
        INT isValidFlag;   // necessary if this struct is used as an optional field of a SEQUENCE
        struct SignalRequestMessageCommon_Position3D position;  // SEQUENCE;
        struct OPT_WORD_ASN heading;  // INTEGER, OPTIONAL, 0..28800;
        struct SignalRequestMessageCommon_TransmissionAndSpeed speed;  // SEQUENCE, OPTIONAL;
    };
    
    struct SignalRequestMessageCommon_DescriptiveName {
        INT isValidFlag;   // necessary if this struct is used as an optional field of a SEQUENCE
        CHAR string[64];
        INT  stringLength;
    };
    
    struct SignalRequestMessageTransitVehicleStatus {
        INT isValidFlag;   // necessary if this struct is used as an optional field of a SEQUENCE
        CHAR string[9];
        INT  stringLength;
    };
    
    struct SignalRequestMessageCommon_RegionalExtension_Reg_RequestorDescription_table {
    };
    
    struct SignalRequestMessageCommon_RegionalExtension_Reg_RequestorDescription {
        INT isValidFlag;   // necessary if this struct is used as an optional field of a SEQUENCE
        BYTE regionId;  // INTEGER, 0..255, noRegion(0), addGrpA(1), addGrpB(2), addGrpC(3), addGrpD(4);
        struct SignalRequestMessageCommon_RegionalExtension_Reg_RequestorDescription_table regExtvalue;  // TABLE;
    };
    
    struct SignalRequestMessageRequestorDescription_regional {
        INT isValidFlag;   // necessary if this struct is used as an optional field of a SEQUENCE
        INT length;
        struct SignalRequestMessageCommon_RegionalExtension_Reg_RequestorDescription arrayValue[4];  // SEQUENCE;
    };
    
    struct SignalRequestMessageRequestorDescription {
        INT isValidFlag;   // necessary if this struct is used as an optional field of a SEQUENCE
        struct SignalRequestMessageCommon_VehicleID id;  // CHOICE;
        struct SignalRequestMessageCommon_RequestorType type;  // SEQUENCE, OPTIONAL;
        struct SignalRequestMessageRequestorPositionVector position;  // SEQUENCE, OPTIONAL;
        struct SignalRequestMessageCommon_DescriptiveName name;  // IA5STRING, OPTIONAL;
        struct SignalRequestMessageCommon_DescriptiveName routeName;  // IA5STRING, OPTIONAL;
        struct SignalRequestMessageTransitVehicleStatus transitStatus;  // BITSTRING, OPTIONAL;
        struct OPT_ENUM_ASN transitOccupancy;  // ENUMERATED, OPTIONAL, occupancyUnknown(0), occupancyEmpty(1), occupancyVeryLow(2), occupancyLow(3), occupancyMed(4), occupancyHigh(5), occupancyNearlyFull(6), occupancyFull(7);
        struct OPT_INT_ASN transitSchedule;  // INTEGER, OPTIONAL, -122..121;
        struct SignalRequestMessageRequestorDescription_regional regional;  // SEQUENCEOF, OPTIONAL;
    };
    
    struct SignalRequestMessageCommon_RegionalExtension_Reg_SignalRequestMessage_table {
    };
    
    struct SignalRequestMessageCommon_RegionalExtension_Reg_SignalRequestMessage {
        INT isValidFlag;   // necessary if this struct is used as an optional field of a SEQUENCE
        BYTE regionId;  // INTEGER, 0..255, noRegion(0), addGrpA(1), addGrpB(2), addGrpC(3), addGrpD(4);
        struct SignalRequestMessageCommon_RegionalExtension_Reg_SignalRequestMessage_table regExtvalue;  // TABLE;
    };
    
    struct SignalRequestMessageSignalRequestMessage_regional {
        INT isValidFlag;   // necessary if this struct is used as an optional field of a SEQUENCE
        INT length;
        struct SignalRequestMessageCommon_RegionalExtension_Reg_SignalRequestMessage arrayValue[4];  // SEQUENCE;
    };
    
    struct SignalRequestMessage_SignalRequestMessage {
        INT isValidFlag;   // necessary if this struct is used as an optional field of a SEQUENCE
        struct OPT_DWORD_ASN timeStamp;  // INTEGER, OPTIONAL, 0..527040;
        WORD second;  // INTEGER, 0..65535;
        struct OPT_BYTE_ASN sequenceNumber;  // INTEGER, OPTIONAL, 0..127;
        struct SignalRequestMessageSignalRequestList requests;  // SEQUENCEOF, OPTIONAL;
        struct SignalRequestMessageRequestorDescription requestor;  // SEQUENCE;
        struct SignalRequestMessageSignalRequestMessage_regional regional;  // SEQUENCEOF, OPTIONAL;
    };
    
    struct SignalRequestMessageMESSAGE_ID_AND_TYPE {
        struct SignalRequestMessage_SignalRequestMessage signalRequestMessage;  // SEQUENCE;
    };
    
    struct SignalRequestMessage {
        INT isValidFlag;   // necessary if this struct is used as an optional field of a SEQUENCE
        WORD messageId;  // INTEGER, 0..32767, mapData(18), signalPhaseAndTimingMessage(19), basicSafetyMessage(20), commonSafetyRequest(21), emergencyVehicleAlert(22), intersectionCollision(23), nmeaCorrections(24), probeDataManagement(25), probeVehicleData(26), roadSideAlert(27), rtcmCorrections(28), signalRequestMessage(29), signalStatusMessage(30), travelerInformation(31), personalSafetyMessage(32), roadSafetyMessage(33), roadWeatherMessage(34), probeDataConfigMessage(35), probeDataReportMessage(36), tollAdvertisementMessage(37), tollUsageMessage(38), tollUsageAckMessage(39), cooperativeControlMessage(40), sensorDataSharingMessage(41), maneuverSharingAndCoordinatingMessage(42), roadGeometryAndAttributes(43), personalSafetyMessage2(44), trafficSignalPhaseAndTiming(45), signalControlAndPrioritizationRequest(46), signalControlAndPrioritizationStatus(47), roadUserChargingConfigMessage(48), roadUserChargingReportMessage(49), trafficLightStatusMessage(50);
        struct SignalRequestMessageMESSAGE_ID_AND_TYPE value;  // TABLE;
    };
    
}

/*
// init function to create a simple packet handle
*/ 
LONG API_InitSignalRequestMessagePacket()
{
  return C2xInitPacket("SignalRequestMessage"); 
}

/*
// init function to create a simple packet handle and
// initialize the struct with valid data
*/ 
LONG API_InitSignalRequestMessagePacket(struct SignalRequestMessage msgStruct)
{
  long pktHandle;

  pktHandle = API_InitSignalRequestMessagePacket();

  if (pktHandle != 0)
  {
    // create valid message and application data
    if (C2xCompletePacket(pktHandle) == 0) 
    {
      API_GetSignalRequestMessageParams(pktHandle, msgStruct);
    }
  }
  return pktHandle;
}

/*
// init function to create a packet with security layer and
// initialize the struct with valid data
*/ 
LONG API_InitSignalRequestMessagePacket(struct SignalRequestMessage msgStruct, char packetTypeDesignator[], char certificateName[])
{
  long pktHandle, certHdl;

  // initialize the packet
  pktHandle = C2xInitPacket("SignalRequestMessage", packetTypeDesignator);

  if (pktHandle != 0)
  {
    certHdl = C2xSecCertificateGetHandle(certificateName);  // get the certificate handle for the cert with name "certificateName"
    if (certHdl != 0) 
    {
      C2xSecPacketSetSignerHandle(pktHandle, certHdl); // set the certHdl to the packet
    }

    // create valid message and application data
    if (C2xCompletePacket(pktHandle) == 0) 
    {
      // copy application data to the application structure
      API_GetSignalRequestMessageParams(pktHandle, msgStruct);
    }
  }
  return pktHandle;
}
    

int GetSignalRequestMessageCommon_IntersectionReferenceIDParams(LONG packetHandle, struct SignalRequestMessageCommon_IntersectionReferenceID value, char oldPath[])
{
  char newPath[300];
  int result;

  result = 0;

  snprintf(newPath, elcount(newPath), "%s.%s", oldPath, "region");
  value.region.isValidFlag = C2xIsTokenAvailable(packetHandle, "SignalRequestMessage", newPath);
  if(value.region.isValidFlag==1)
  {
    value.region.value = C2xGetTokenInt(packetHandle, "SignalRequestMessage", newPath);
    result = CheckLastError("SignalRequestMessage", gkFuncRefGet, result);
  }
  snprintf(newPath, elcount(newPath), "%s.%s", oldPath, "id");
  value.id = C2xGetTokenInt(packetHandle, "SignalRequestMessage", newPath);
  result = CheckLastError("SignalRequestMessage", gkFuncRefGet, result);

  return result;
}

int SetSignalRequestMessageCommon_IntersectionReferenceIDParams(LONG packetHandle, struct SignalRequestMessageCommon_IntersectionReferenceID value, char oldPath[])
{
  char newPath[300];
  int result;

  result = 0;

  snprintf(newPath, elcount(newPath), "%s.%s", oldPath, "region");
  if(value.region.isValidFlag==1)
  {
    C2xSetTokenInt(packetHandle, "SignalRequestMessage", newPath, value.region.value);
    result = CheckLastError("SignalRequestMessage", gkFuncRefGet, result);
  }
  else
  {
    if( C2xIsTokenAvailable(packetHandle, "SignalRequestMessage", newPath) )
    {
      C2xRemoveToken(packetHandle, "SignalRequestMessage", newPath);
    }
  }

  snprintf(newPath, elcount(newPath), "%s.%s", oldPath, "id");
  C2xSetTokenInt(packetHandle, "SignalRequestMessage", newPath, value.id);
  result = CheckLastError("SignalRequestMessage", gkFuncRefGet, result);

  return result;
}

int GetSignalRequestMessageCommon_IntersectionAccessPointParams(LONG packetHandle, struct SignalRequestMessageCommon_IntersectionAccessPoint value, char oldPath[])
{
  char newPath[300];
  int result;

  result = 0;

  value.choice = C2xGetTokenInt(packetHandle, "SignalRequestMessage", oldPath);

  switch(value.choice)
  {
    case 0:
    {
      snprintf(newPath, elcount(newPath), "%s.%s", oldPath, "lane");
      value.lane = C2xGetTokenInt(packetHandle, "SignalRequestMessage", newPath);
      result = CheckLastError("SignalRequestMessage", gkFuncRefGet, result);
    }
    break;
    case 1:
    {
      snprintf(newPath, elcount(newPath), "%s.%s", oldPath, "approach");
      value.approach = C2xGetTokenInt(packetHandle, "SignalRequestMessage", newPath);
      result = CheckLastError("SignalRequestMessage", gkFuncRefGet, result);
    }
    break;
    case 2:
    {
      snprintf(newPath, elcount(newPath), "%s.%s", oldPath, "connection");
      value.connection = C2xGetTokenInt(packetHandle, "SignalRequestMessage", newPath);
      result = CheckLastError("SignalRequestMessage", gkFuncRefGet, result);
    }
    break;
  }
  return result;
}

int SetSignalRequestMessageCommon_IntersectionAccessPointParams(LONG packetHandle, struct SignalRequestMessageCommon_IntersectionAccessPoint value, char oldPath[])
{
  char newPath[300];
  int result;

  result = 0;

  switch(value.choice)
  {
    case 0:
    {
      snprintf(newPath, elcount(newPath), "%s.%s", oldPath, "lane");
      C2xSetTokenInt(packetHandle, "SignalRequestMessage", newPath, value.lane);
      result = CheckLastError("SignalRequestMessage", gkFuncRefGet, result);
    }
    break;
    case 1:
    {
      snprintf(newPath, elcount(newPath), "%s.%s", oldPath, "approach");
      C2xSetTokenInt(packetHandle, "SignalRequestMessage", newPath, value.approach);
      result = CheckLastError("SignalRequestMessage", gkFuncRefGet, result);
    }
    break;
    case 2:
    {
      snprintf(newPath, elcount(newPath), "%s.%s", oldPath, "connection");
      C2xSetTokenInt(packetHandle, "SignalRequestMessage", newPath, value.connection);
      result = CheckLastError("SignalRequestMessage", gkFuncRefGet, result);
    }
    break;
  }
  return result;
}

int GetSignalRequestMessageCommon_RegionalExtension_Reg_SignalRequestParams(LONG packetHandle, struct SignalRequestMessageCommon_RegionalExtension_Reg_SignalRequest value, char oldPath[])
{
  char newPath[300];
  int result;

  result = 0;

  snprintf(newPath, elcount(newPath), "%s.%s", oldPath, "regionId");
  value.regionId = C2xGetTokenInt(packetHandle, "SignalRequestMessage", newPath);
  result = CheckLastError("SignalRequestMessage", gkFuncRefGet, result);

  return result;
}

int SetSignalRequestMessageCommon_RegionalExtension_Reg_SignalRequestParams(LONG packetHandle, struct SignalRequestMessageCommon_RegionalExtension_Reg_SignalRequest value, char oldPath[])
{
  char newPath[300];
  int result;

  result = 0;


  return result;
}

int GetSignalRequestMessageSignalRequest_regionalParams(LONG packetHandle, struct SignalRequestMessageSignalRequest_regional value, char oldPath[])
{
  char newPath[300]; 
  int i;
  int result;

  result = 0;

  value.length = C2xGetTokenInt(packetHandle, "SignalRequestMessage", oldPath);
  if((result = CheckLastError("SignalRequestMessage", gkFuncRefGet, result))==0)
  {
    for(i=0; i<value.length; i++)
    {
      snprintf(newPath, elcount(newPath), "%s[%d]", oldPath, i);
      GetSignalRequestMessageCommon_RegionalExtension_Reg_SignalRequestParams(packetHandle, value.arrayValue[i], newPath);
      result = CheckLastError("SignalRequestMessage", gkFuncRefGet, result);
    }
  }
  return result;
}

int SetSignalRequestMessageSignalRequest_regionalParams(LONG packetHandle, struct SignalRequestMessageSignalRequest_regional value, char oldPath[])
{
  char newPath[300]; 
  int i;
  int result;

  result = 0;

  C2xRemoveToken(packetHandle, "SignalRequestMessage", oldPath);
  for(i=0; i<value.length; i++)
  {
    snprintf(newPath, elcount(newPath), "%s[%d]", oldPath, i);
    SetSignalRequestMessageCommon_RegionalExtension_Reg_SignalRequestParams(packetHandle, value.arrayValue[i], newPath);
    result = CheckLastError("SignalRequestMessage", gkFuncRefGet, result);
  }
  return result;
}

int GetSignalRequestMessageSignalRequestParams(LONG packetHandle, struct SignalRequestMessageSignalRequest value, char oldPath[])
{
  char newPath[300];
  int result;

  result = 0;

  snprintf(newPath, elcount(newPath), "%s.%s", oldPath, "id");
  GetSignalRequestMessageCommon_IntersectionReferenceIDParams(packetHandle, value.id, newPath);
  result = CheckLastError("SignalRequestMessage", gkFuncRefGet, result);

  snprintf(newPath, elcount(newPath), "%s.%s", oldPath, "requestID");
  value.requestID = C2xGetTokenInt(packetHandle, "SignalRequestMessage", newPath);
  result = CheckLastError("SignalRequestMessage", gkFuncRefGet, result);

  snprintf(newPath, elcount(newPath), "%s.%s", oldPath, "requestType");
  value.requestType = C2xGetTokenInt(packetHandle, "SignalRequestMessage", newPath);
  result = CheckLastError("SignalRequestMessage", gkFuncRefGet, result);

  snprintf(newPath, elcount(newPath), "%s.%s", oldPath, "inBoundLane");
  GetSignalRequestMessageCommon_IntersectionAccessPointParams(packetHandle, value.inBoundLane, newPath);
  result = CheckLastError("SignalRequestMessage", gkFuncRefGet, result);

  snprintf(newPath, elcount(newPath), "%s.%s", oldPath, "outBoundLane");
  value.outBoundLane.isValidFlag = C2xIsTokenAvailable(packetHandle, "SignalRequestMessage", newPath);
  if(value.outBoundLane.isValidFlag==1)
  {
    GetSignalRequestMessageCommon_IntersectionAccessPointParams(packetHandle, value.outBoundLane, newPath);
    result = CheckLastError("SignalRequestMessage", gkFuncRefGet, result);
  }
  snprintf(newPath, elcount(newPath), "%s.%s", oldPath, "regional");
  value.regional.isValidFlag = C2xIsTokenAvailable(packetHandle, "SignalRequestMessage", newPath);
  if(value.regional.isValidFlag==1)
  {
    GetSignalRequestMessageSignalRequest_regionalParams(packetHandle, value.regional, newPath);
    result = CheckLastError("SignalRequestMessage", gkFuncRefGet, result);
  }
  return result;
}

int SetSignalRequestMessageSignalRequestParams(LONG packetHandle, struct SignalRequestMessageSignalRequest value, char oldPath[])
{
  char newPath[300];
  int result;

  result = 0;

  snprintf(newPath, elcount(newPath), "%s.%s", oldPath, "id");
  SetSignalRequestMessageCommon_IntersectionReferenceIDParams(packetHandle, value.id, newPath);
  result = CheckLastError("SignalRequestMessage", gkFuncRefGet, result);

  snprintf(newPath, elcount(newPath), "%s.%s", oldPath, "requestID");
  C2xSetTokenInt(packetHandle, "SignalRequestMessage", newPath, value.requestID);
  result = CheckLastError("SignalRequestMessage", gkFuncRefGet, result);

  snprintf(newPath, elcount(newPath), "%s.%s", oldPath, "requestType");
  C2xSetTokenInt(packetHandle, "SignalRequestMessage", newPath, value.requestType);
  result = CheckLastError("SignalRequestMessage", gkFuncRefGet, result);

  snprintf(newPath, elcount(newPath), "%s.%s", oldPath, "inBoundLane");
  SetSignalRequestMessageCommon_IntersectionAccessPointParams(packetHandle, value.inBoundLane, newPath);
  result = CheckLastError("SignalRequestMessage", gkFuncRefGet, result);

  snprintf(newPath, elcount(newPath), "%s.%s", oldPath, "outBoundLane");
  if(value.outBoundLane.isValidFlag==1)
  {
    SetSignalRequestMessageCommon_IntersectionAccessPointParams(packetHandle, value.outBoundLane, newPath);
    result = CheckLastError("SignalRequestMessage", gkFuncRefGet, result);
  }
  else
  {
    if( C2xIsTokenAvailable(packetHandle, "SignalRequestMessage", newPath) )
    {
      C2xRemoveToken(packetHandle, "SignalRequestMessage", newPath);
    }
  }

  snprintf(newPath, elcount(newPath), "%s.%s", oldPath, "regional");
  if(value.regional.isValidFlag==1)
  {
    SetSignalRequestMessageSignalRequest_regionalParams(packetHandle, value.regional, newPath);
    result = CheckLastError("SignalRequestMessage", gkFuncRefGet, result);
  }
  else
  {
    if( C2xIsTokenAvailable(packetHandle, "SignalRequestMessage", newPath) )
    {
      C2xRemoveToken(packetHandle, "SignalRequestMessage", newPath);
    }
  }

  return result;
}

int GetSignalRequestMessageCommon_RegionalExtension_Reg_SignalRequestPackageParams(LONG packetHandle, struct SignalRequestMessageCommon_RegionalExtension_Reg_SignalRequestPackage value, char oldPath[])
{
  char newPath[300];
  int result;

  result = 0;

  snprintf(newPath, elcount(newPath), "%s.%s", oldPath, "regionId");
  value.regionId = C2xGetTokenInt(packetHandle, "SignalRequestMessage", newPath);
  result = CheckLastError("SignalRequestMessage", gkFuncRefGet, result);

  return result;
}

int SetSignalRequestMessageCommon_RegionalExtension_Reg_SignalRequestPackageParams(LONG packetHandle, struct SignalRequestMessageCommon_RegionalExtension_Reg_SignalRequestPackage value, char oldPath[])
{
  char newPath[300];
  int result;

  result = 0;


  return result;
}

int GetSignalRequestMessageSignalRequestPackage_regionalParams(LONG packetHandle, struct SignalRequestMessageSignalRequestPackage_regional value, char oldPath[])
{
  char newPath[300]; 
  int i;
  int result;

  result = 0;

  value.length = C2xGetTokenInt(packetHandle, "SignalRequestMessage", oldPath);
  if((result = CheckLastError("SignalRequestMessage", gkFuncRefGet, result))==0)
  {
    for(i=0; i<value.length; i++)
    {
      snprintf(newPath, elcount(newPath), "%s[%d]", oldPath, i);
      GetSignalRequestMessageCommon_RegionalExtension_Reg_SignalRequestPackageParams(packetHandle, value.arrayValue[i], newPath);
      result = CheckLastError("SignalRequestMessage", gkFuncRefGet, result);
    }
  }
  return result;
}

int SetSignalRequestMessageSignalRequestPackage_regionalParams(LONG packetHandle, struct SignalRequestMessageSignalRequestPackage_regional value, char oldPath[])
{
  char newPath[300]; 
  int i;
  int result;

  result = 0;

  C2xRemoveToken(packetHandle, "SignalRequestMessage", oldPath);
  for(i=0; i<value.length; i++)
  {
    snprintf(newPath, elcount(newPath), "%s[%d]", oldPath, i);
    SetSignalRequestMessageCommon_RegionalExtension_Reg_SignalRequestPackageParams(packetHandle, value.arrayValue[i], newPath);
    result = CheckLastError("SignalRequestMessage", gkFuncRefGet, result);
  }
  return result;
}

int GetSignalRequestMessageSignalRequestPackageParams(LONG packetHandle, struct SignalRequestMessageSignalRequestPackage value, char oldPath[])
{
  char newPath[300];
  int result;

  result = 0;

  snprintf(newPath, elcount(newPath), "%s.%s", oldPath, "request");
  GetSignalRequestMessageSignalRequestParams(packetHandle, value.request, newPath);
  result = CheckLastError("SignalRequestMessage", gkFuncRefGet, result);

  snprintf(newPath, elcount(newPath), "%s.%s", oldPath, "minute");
  value.minute.isValidFlag = C2xIsTokenAvailable(packetHandle, "SignalRequestMessage", newPath);
  if(value.minute.isValidFlag==1)
  {
    value.minute.value = C2xGetTokenInt(packetHandle, "SignalRequestMessage", newPath);
    result = CheckLastError("SignalRequestMessage", gkFuncRefGet, result);
  }
  snprintf(newPath, elcount(newPath), "%s.%s", oldPath, "second");
  value.second.isValidFlag = C2xIsTokenAvailable(packetHandle, "SignalRequestMessage", newPath);
  if(value.second.isValidFlag==1)
  {
    value.second.value = C2xGetTokenInt(packetHandle, "SignalRequestMessage", newPath);
    result = CheckLastError("SignalRequestMessage", gkFuncRefGet, result);
  }
  snprintf(newPath, elcount(newPath), "%s.%s", oldPath, "duration");
  value.duration.isValidFlag = C2xIsTokenAvailable(packetHandle, "SignalRequestMessage", newPath);
  if(value.duration.isValidFlag==1)
  {
    value.duration.value = C2xGetTokenInt(packetHandle, "SignalRequestMessage", newPath);
    result = CheckLastError("SignalRequestMessage", gkFuncRefGet, result);
  }
  snprintf(newPath, elcount(newPath), "%s.%s", oldPath, "regional");
  value.regional.isValidFlag = C2xIsTokenAvailable(packetHandle, "SignalRequestMessage", newPath);
  if(value.regional.isValidFlag==1)
  {
    GetSignalRequestMessageSignalRequestPackage_regionalParams(packetHandle, value.regional, newPath);
    result = CheckLastError("SignalRequestMessage", gkFuncRefGet, result);
  }
  return result;
}

int SetSignalRequestMessageSignalRequestPackageParams(LONG packetHandle, struct SignalRequestMessageSignalRequestPackage value, char oldPath[])
{
  char newPath[300];
  int result;

  result = 0;

  snprintf(newPath, elcount(newPath), "%s.%s", oldPath, "request");
  SetSignalRequestMessageSignalRequestParams(packetHandle, value.request, newPath);
  result = CheckLastError("SignalRequestMessage", gkFuncRefGet, result);

  snprintf(newPath, elcount(newPath), "%s.%s", oldPath, "minute");
  if(value.minute.isValidFlag==1)
  {
    C2xSetTokenInt(packetHandle, "SignalRequestMessage", newPath, value.minute.value);
    result = CheckLastError("SignalRequestMessage", gkFuncRefGet, result);
  }
  else
  {
    if( C2xIsTokenAvailable(packetHandle, "SignalRequestMessage", newPath) )
    {
      C2xRemoveToken(packetHandle, "SignalRequestMessage", newPath);
    }
  }

  snprintf(newPath, elcount(newPath), "%s.%s", oldPath, "second");
  if(value.second.isValidFlag==1)
  {
    C2xSetTokenInt(packetHandle, "SignalRequestMessage", newPath, value.second.value);
    result = CheckLastError("SignalRequestMessage", gkFuncRefGet, result);
  }
  else
  {
    if( C2xIsTokenAvailable(packetHandle, "SignalRequestMessage", newPath) )
    {
      C2xRemoveToken(packetHandle, "SignalRequestMessage", newPath);
    }
  }

  snprintf(newPath, elcount(newPath), "%s.%s", oldPath, "duration");
  if(value.duration.isValidFlag==1)
  {
    C2xSetTokenInt(packetHandle, "SignalRequestMessage", newPath, value.duration.value);
    result = CheckLastError("SignalRequestMessage", gkFuncRefGet, result);
  }
  else
  {
    if( C2xIsTokenAvailable(packetHandle, "SignalRequestMessage", newPath) )
    {
      C2xRemoveToken(packetHandle, "SignalRequestMessage", newPath);
    }
  }

  snprintf(newPath, elcount(newPath), "%s.%s", oldPath, "regional");
  if(value.regional.isValidFlag==1)
  {
    SetSignalRequestMessageSignalRequestPackage_regionalParams(packetHandle, value.regional, newPath);
    result = CheckLastError("SignalRequestMessage", gkFuncRefGet, result);
  }
  else
  {
    if( C2xIsTokenAvailable(packetHandle, "SignalRequestMessage", newPath) )
    {
      C2xRemoveToken(packetHandle, "SignalRequestMessage", newPath);
    }
  }

  return result;
}

int GetSignalRequestMessageSignalRequestListParams(LONG packetHandle, struct SignalRequestMessageSignalRequestList value, char oldPath[])
{
  char newPath[300]; 
  int i;
  int result;

  result = 0;

  value.length = C2xGetTokenInt(packetHandle, "SignalRequestMessage", oldPath);
  if((result = CheckLastError("SignalRequestMessage", gkFuncRefGet, result))==0)
  {
    for(i=0; i<value.length; i++)
    {
      snprintf(newPath, elcount(newPath), "%s[%d]", oldPath, i);
      GetSignalRequestMessageSignalRequestPackageParams(packetHandle, value.arrayValue[i], newPath);
      result = CheckLastError("SignalRequestMessage", gkFuncRefGet, result);
    }
  }
  return result;
}

int SetSignalRequestMessageSignalRequestListParams(LONG packetHandle, struct SignalRequestMessageSignalRequestList value, char oldPath[])
{
  char newPath[300]; 
  int i;
  int result;

  result = 0;

  C2xRemoveToken(packetHandle, "SignalRequestMessage", oldPath);
  for(i=0; i<value.length; i++)
  {
    snprintf(newPath, elcount(newPath), "%s[%d]", oldPath, i);
    SetSignalRequestMessageSignalRequestPackageParams(packetHandle, value.arrayValue[i], newPath);
    result = CheckLastError("SignalRequestMessage", gkFuncRefGet, result);
  }
  return result;
}

int GetSignalRequestMessageCommon_VehicleIDParams(LONG packetHandle, struct SignalRequestMessageCommon_VehicleID value, char oldPath[])
{
  char newPath[300];
  char buffer[300];
  int result;

  result = 0;

  value.choice = C2xGetTokenInt(packetHandle, "SignalRequestMessage", oldPath);

  switch(value.choice)
  {
    case 0:
    {
      snprintf(newPath, elcount(newPath), "%s.%s", oldPath, "entityID");
      value.entityID.stringLength = C2xGetTokenData(packetHandle, "SignalRequestMessage", newPath, elcount(value.entityID.string), value.entityID.string);
      result = CheckLastError("SignalRequestMessage", gkFuncRefGet, result);
    }
    break;
    case 1:
    {
      snprintf(newPath, elcount(newPath), "%s.%s", oldPath, "stationID");
      value.stationID = C2xGetTokenInt64(packetHandle, "SignalRequestMessage", newPath);
      result = CheckLastError("SignalRequestMessage", gkFuncRefGet, result);
    }
    break;
  }
  return result;
}

int SetSignalRequestMessageCommon_VehicleIDParams(LONG packetHandle, struct SignalRequestMessageCommon_VehicleID value, char oldPath[])
{
  char newPath[300];
  char buffer[300];
  int result;

  result = 0;

  switch(value.choice)
  {
    case 0:
    {
      snprintf(newPath, elcount(newPath), "%s.%s", oldPath, "entityID");
      C2xSetTokenData(packetHandle, "SignalRequestMessage", newPath, value.entityID.stringLength, value.entityID.string);
      result = CheckLastError("SignalRequestMessage", gkFuncRefGet, result);
    }
    break;
    case 1:
    {
      snprintf(newPath, elcount(newPath), "%s.%s", oldPath, "stationID");
      C2xSetTokenInt64(packetHandle, "SignalRequestMessage", newPath, value.stationID);
      result = CheckLastError("SignalRequestMessage", gkFuncRefGet, result);
    }
    break;
  }
  return result;
}

int GetSignalRequestMessageCommon_RegionalExtension_Reg_RequestorTypeParams(LONG packetHandle, struct SignalRequestMessageCommon_RegionalExtension_Reg_RequestorType value, char oldPath[])
{
  char newPath[300];
  int result;

  result = 0;

  snprintf(newPath, elcount(newPath), "%s.%s", oldPath, "regionId");
  value.regionId = C2xGetTokenInt(packetHandle, "SignalRequestMessage", newPath);
  result = CheckLastError("SignalRequestMessage", gkFuncRefGet, result);

  return result;
}

int SetSignalRequestMessageCommon_RegionalExtension_Reg_RequestorTypeParams(LONG packetHandle, struct SignalRequestMessageCommon_RegionalExtension_Reg_RequestorType value, char oldPath[])
{
  char newPath[300];
  int result;

  result = 0;


  return result;
}

int GetSignalRequestMessageCommon_RequestorTypeParams(LONG packetHandle, struct SignalRequestMessageCommon_RequestorType value, char oldPath[])
{
  char newPath[300];
  int result;

  result = 0;

  snprintf(newPath, elcount(newPath), "%s.%s", oldPath, "role");
  value.role = C2xGetTokenInt(packetHandle, "SignalRequestMessage", newPath);
  result = CheckLastError("SignalRequestMessage", gkFuncRefGet, result);

  snprintf(newPath, elcount(newPath), "%s.%s", oldPath, "subrole");
  value.subrole.isValidFlag = C2xIsTokenAvailable(packetHandle, "SignalRequestMessage", newPath);
  if(value.subrole.isValidFlag==1)
  {
    value.subrole.value = C2xGetTokenInt(packetHandle, "SignalRequestMessage", newPath);
    result = CheckLastError("SignalRequestMessage", gkFuncRefGet, result);
  }
  snprintf(newPath, elcount(newPath), "%s.%s", oldPath, "request");
  value.request.isValidFlag = C2xIsTokenAvailable(packetHandle, "SignalRequestMessage", newPath);
  if(value.request.isValidFlag==1)
  {
    value.request.value = C2xGetTokenInt(packetHandle, "SignalRequestMessage", newPath);
    result = CheckLastError("SignalRequestMessage", gkFuncRefGet, result);
  }
  snprintf(newPath, elcount(newPath), "%s.%s", oldPath, "iso3883");
  value.iso3883.isValidFlag = C2xIsTokenAvailable(packetHandle, "SignalRequestMessage", newPath);
  if(value.iso3883.isValidFlag==1)
  {
    value.iso3883.value = C2xGetTokenInt(packetHandle, "SignalRequestMessage", newPath);
    result = CheckLastError("SignalRequestMessage", gkFuncRefGet, result);
  }
  snprintf(newPath, elcount(newPath), "%s.%s", oldPath, "hpmsType");
  value.hpmsType.isValidFlag = C2xIsTokenAvailable(packetHandle, "SignalRequestMessage", newPath);
  if(value.hpmsType.isValidFlag==1)
  {
    value.hpmsType.value = C2xGetTokenInt(packetHandle, "SignalRequestMessage", newPath);
    result = CheckLastError("SignalRequestMessage", gkFuncRefGet, result);
  }
  snprintf(newPath, elcount(newPath), "%s.%s", oldPath, "regional");
  value.regional.isValidFlag = C2xIsTokenAvailable(packetHandle, "SignalRequestMessage", newPath);
  if(value.regional.isValidFlag==1)
  {
    GetSignalRequestMessageCommon_RegionalExtension_Reg_RequestorTypeParams(packetHandle, value.regional, newPath);
    result = CheckLastError("SignalRequestMessage", gkFuncRefGet, result);
  }
  return result;
}

int SetSignalRequestMessageCommon_RequestorTypeParams(LONG packetHandle, struct SignalRequestMessageCommon_RequestorType value, char oldPath[])
{
  char newPath[300];
  int result;

  result = 0;

  snprintf(newPath, elcount(newPath), "%s.%s", oldPath, "role");
  C2xSetTokenInt(packetHandle, "SignalRequestMessage", newPath, value.role);
  result = CheckLastError("SignalRequestMessage", gkFuncRefGet, result);

  snprintf(newPath, elcount(newPath), "%s.%s", oldPath, "subrole");
  if(value.subrole.isValidFlag==1)
  {
    C2xSetTokenInt(packetHandle, "SignalRequestMessage", newPath, value.subrole.value);
    result = CheckLastError("SignalRequestMessage", gkFuncRefGet, result);
  }
  else
  {
    if( C2xIsTokenAvailable(packetHandle, "SignalRequestMessage", newPath) )
    {
      C2xRemoveToken(packetHandle, "SignalRequestMessage", newPath);
    }
  }

  snprintf(newPath, elcount(newPath), "%s.%s", oldPath, "request");
  if(value.request.isValidFlag==1)
  {
    C2xSetTokenInt(packetHandle, "SignalRequestMessage", newPath, value.request.value);
    result = CheckLastError("SignalRequestMessage", gkFuncRefGet, result);
  }
  else
  {
    if( C2xIsTokenAvailable(packetHandle, "SignalRequestMessage", newPath) )
    {
      C2xRemoveToken(packetHandle, "SignalRequestMessage", newPath);
    }
  }

  snprintf(newPath, elcount(newPath), "%s.%s", oldPath, "iso3883");
  if(value.iso3883.isValidFlag==1)
  {
    C2xSetTokenInt(packetHandle, "SignalRequestMessage", newPath, value.iso3883.value);
    result = CheckLastError("SignalRequestMessage", gkFuncRefGet, result);
  }
  else
  {
    if( C2xIsTokenAvailable(packetHandle, "SignalRequestMessage", newPath) )
    {
      C2xRemoveToken(packetHandle, "SignalRequestMessage", newPath);
    }
  }

  snprintf(newPath, elcount(newPath), "%s.%s", oldPath, "hpmsType");
  if(value.hpmsType.isValidFlag==1)
  {
    C2xSetTokenInt(packetHandle, "SignalRequestMessage", newPath, value.hpmsType.value);
    result = CheckLastError("SignalRequestMessage", gkFuncRefGet, result);
  }
  else
  {
    if( C2xIsTokenAvailable(packetHandle, "SignalRequestMessage", newPath) )
    {
      C2xRemoveToken(packetHandle, "SignalRequestMessage", newPath);
    }
  }

  snprintf(newPath, elcount(newPath), "%s.%s", oldPath, "regional");
  if(value.regional.isValidFlag==1)
  {
    SetSignalRequestMessageCommon_RegionalExtension_Reg_RequestorTypeParams(packetHandle, value.regional, newPath);
    result = CheckLastError("SignalRequestMessage", gkFuncRefGet, result);
  }
  else
  {
    if( C2xIsTokenAvailable(packetHandle, "SignalRequestMessage", newPath) )
    {
      C2xRemoveToken(packetHandle, "SignalRequestMessage", newPath);
    }
  }

  return result;
}

int GetSignalRequestMessageAddGrpB_LatitudeDMS2Params(LONG packetHandle, struct SignalRequestMessageAddGrpB_LatitudeDMS2 value, char oldPath[])
{
  char newPath[300];
  int result;

  result = 0;

  snprintf(newPath, elcount(newPath), "%s.%s", oldPath, "d");
  value.d = C2xGetTokenInt(packetHandle, "SignalRequestMessage", newPath);
  result = CheckLastError("SignalRequestMessage", gkFuncRefGet, result);

  snprintf(newPath, elcount(newPath), "%s.%s", oldPath, "m");
  value.m = C2xGetTokenInt(packetHandle, "SignalRequestMessage", newPath);
  result = CheckLastError("SignalRequestMessage", gkFuncRefGet, result);

  snprintf(newPath, elcount(newPath), "%s.%s", oldPath, "s");
  value.s = C2xGetTokenInt(packetHandle, "SignalRequestMessage", newPath);
  result = CheckLastError("SignalRequestMessage", gkFuncRefGet, result);

  return result;
}

int SetSignalRequestMessageAddGrpB_LatitudeDMS2Params(LONG packetHandle, struct SignalRequestMessageAddGrpB_LatitudeDMS2 value, char oldPath[])
{
  char newPath[300];
  int result;

  result = 0;

  snprintf(newPath, elcount(newPath), "%s.%s", oldPath, "d");
  C2xSetTokenInt(packetHandle, "SignalRequestMessage", newPath, value.d);
  result = CheckLastError("SignalRequestMessage", gkFuncRefGet, result);

  snprintf(newPath, elcount(newPath), "%s.%s", oldPath, "m");
  C2xSetTokenInt(packetHandle, "SignalRequestMessage", newPath, value.m);
  result = CheckLastError("SignalRequestMessage", gkFuncRefGet, result);

  snprintf(newPath, elcount(newPath), "%s.%s", oldPath, "s");
  C2xSetTokenInt(packetHandle, "SignalRequestMessage", newPath, value.s);
  result = CheckLastError("SignalRequestMessage", gkFuncRefGet, result);

  return result;
}

int GetSignalRequestMessageAddGrpB_LongitudeDMS2Params(LONG packetHandle, struct SignalRequestMessageAddGrpB_LongitudeDMS2 value, char oldPath[])
{
  char newPath[300];
  int result;

  result = 0;

  snprintf(newPath, elcount(newPath), "%s.%s", oldPath, "d");
  value.d = C2xGetTokenInt(packetHandle, "SignalRequestMessage", newPath);
  result = CheckLastError("SignalRequestMessage", gkFuncRefGet, result);

  snprintf(newPath, elcount(newPath), "%s.%s", oldPath, "m");
  value.m = C2xGetTokenInt(packetHandle, "SignalRequestMessage", newPath);
  result = CheckLastError("SignalRequestMessage", gkFuncRefGet, result);

  snprintf(newPath, elcount(newPath), "%s.%s", oldPath, "s");
  value.s = C2xGetTokenInt(packetHandle, "SignalRequestMessage", newPath);
  result = CheckLastError("SignalRequestMessage", gkFuncRefGet, result);

  return result;
}

int SetSignalRequestMessageAddGrpB_LongitudeDMS2Params(LONG packetHandle, struct SignalRequestMessageAddGrpB_LongitudeDMS2 value, char oldPath[])
{
  char newPath[300];
  int result;

  result = 0;

  snprintf(newPath, elcount(newPath), "%s.%s", oldPath, "d");
  C2xSetTokenInt(packetHandle, "SignalRequestMessage", newPath, value.d);
  result = CheckLastError("SignalRequestMessage", gkFuncRefGet, result);

  snprintf(newPath, elcount(newPath), "%s.%s", oldPath, "m");
  C2xSetTokenInt(packetHandle, "SignalRequestMessage", newPath, value.m);
  result = CheckLastError("SignalRequestMessage", gkFuncRefGet, result);

  snprintf(newPath, elcount(newPath), "%s.%s", oldPath, "s");
  C2xSetTokenInt(packetHandle, "SignalRequestMessage", newPath, value.s);
  result = CheckLastError("SignalRequestMessage", gkFuncRefGet, result);

  return result;
}

int GetSignalRequestMessageAddGrpB_Position3D_addGrpBParams(LONG packetHandle, struct SignalRequestMessageAddGrpB_Position3D_addGrpB value, char oldPath[])
{
  char newPath[300];
  int result;

  result = 0;

  snprintf(newPath, elcount(newPath), "%s.%s", oldPath, "latitude");
  GetSignalRequestMessageAddGrpB_LatitudeDMS2Params(packetHandle, value.latitude, newPath);
  result = CheckLastError("SignalRequestMessage", gkFuncRefGet, result);

  snprintf(newPath, elcount(newPath), "%s.%s", oldPath, "longitude");
  GetSignalRequestMessageAddGrpB_LongitudeDMS2Params(packetHandle, value.longitude, newPath);
  result = CheckLastError("SignalRequestMessage", gkFuncRefGet, result);

  snprintf(newPath, elcount(newPath), "%s.%s", oldPath, "elevation");
  value.elevation = C2xGetTokenInt(packetHandle, "SignalRequestMessage", newPath);
  result = CheckLastError("SignalRequestMessage", gkFuncRefGet, result);

  return result;
}

int SetSignalRequestMessageAddGrpB_Position3D_addGrpBParams(LONG packetHandle, struct SignalRequestMessageAddGrpB_Position3D_addGrpB value, char oldPath[])
{
  char newPath[300];
  int result;

  result = 0;

  snprintf(newPath, elcount(newPath), "%s.%s", oldPath, "latitude");
  SetSignalRequestMessageAddGrpB_LatitudeDMS2Params(packetHandle, value.latitude, newPath);
  result = CheckLastError("SignalRequestMessage", gkFuncRefGet, result);

  snprintf(newPath, elcount(newPath), "%s.%s", oldPath, "longitude");
  SetSignalRequestMessageAddGrpB_LongitudeDMS2Params(packetHandle, value.longitude, newPath);
  result = CheckLastError("SignalRequestMessage", gkFuncRefGet, result);

  snprintf(newPath, elcount(newPath), "%s.%s", oldPath, "elevation");
  C2xSetTokenInt(packetHandle, "SignalRequestMessage", newPath, value.elevation);
  result = CheckLastError("SignalRequestMessage", gkFuncRefGet, result);

  return result;
}

int GetSignalRequestMessageAddGrpC_AltitudeParams(LONG packetHandle, struct SignalRequestMessageAddGrpC_Altitude value, char oldPath[])
{
  char newPath[300];
  int result;

  result = 0;

  snprintf(newPath, elcount(newPath), "%s.%s", oldPath, "value");
  value.value = C2xGetTokenInt(packetHandle, "SignalRequestMessage", newPath);
  result = CheckLastError("SignalRequestMessage", gkFuncRefGet, result);

  snprintf(newPath, elcount(newPath), "%s.%s", oldPath, "confidence");
  value.confidence = C2xGetTokenInt(packetHandle, "SignalRequestMessage", newPath);
  result = CheckLastError("SignalRequestMessage", gkFuncRefGet, result);

  return result;
}

int SetSignalRequestMessageAddGrpC_AltitudeParams(LONG packetHandle, struct SignalRequestMessageAddGrpC_Altitude value, char oldPath[])
{
  char newPath[300];
  int result;

  result = 0;

  snprintf(newPath, elcount(newPath), "%s.%s", oldPath, "value");
  C2xSetTokenInt(packetHandle, "SignalRequestMessage", newPath, value.value);
  result = CheckLastError("SignalRequestMessage", gkFuncRefGet, result);

  snprintf(newPath, elcount(newPath), "%s.%s", oldPath, "confidence");
  C2xSetTokenInt(packetHandle, "SignalRequestMessage", newPath, value.confidence);
  result = CheckLastError("SignalRequestMessage", gkFuncRefGet, result);

  return result;
}

int GetSignalRequestMessageAddGrpC_Position3D_addGrpCParams(LONG packetHandle, struct SignalRequestMessageAddGrpC_Position3D_addGrpC value, char oldPath[])
{
  char newPath[300];
  int result;

  result = 0;

  snprintf(newPath, elcount(newPath), "%s.%s", oldPath, "altitude");
  GetSignalRequestMessageAddGrpC_AltitudeParams(packetHandle, value.altitude, newPath);
  result = CheckLastError("SignalRequestMessage", gkFuncRefGet, result);

  return result;
}

int SetSignalRequestMessageAddGrpC_Position3D_addGrpCParams(LONG packetHandle, struct SignalRequestMessageAddGrpC_Position3D_addGrpC value, char oldPath[])
{
  char newPath[300];
  int result;

  result = 0;

  snprintf(newPath, elcount(newPath), "%s.%s", oldPath, "altitude");
  SetSignalRequestMessageAddGrpC_AltitudeParams(packetHandle, value.altitude, newPath);
  result = CheckLastError("SignalRequestMessage", gkFuncRefGet, result);

  return result;
}

int GetSignalRequestMessageCommon_RegionalExtension_Reg_Position3D_tableParams(LONG packetHandle, WORD tableKey, struct SignalRequestMessageCommon_RegionalExtension_Reg_Position3D_table value, char oldPath[])
{
  char newPath[300];
  int result;

  result = 0;

  switch(tableKey)
  {
    case 2:
    {
      snprintf(newPath, elcount(newPath), "%s.%s", oldPath, "addGrpB");
      GetSignalRequestMessageAddGrpB_Position3D_addGrpBParams(packetHandle, value.addGrpB, newPath);
      result = CheckLastError("SignalRequestMessage", gkFuncRefGet, result);
    }
    break;
    case 3:
    {
      snprintf(newPath, elcount(newPath), "%s.%s", oldPath, "addGrpC");
      GetSignalRequestMessageAddGrpC_Position3D_addGrpCParams(packetHandle, value.addGrpC, newPath);
      result = CheckLastError("SignalRequestMessage", gkFuncRefGet, result);
    }
    break;
  }
  return result;
}

int SetSignalRequestMessageCommon_RegionalExtension_Reg_Position3D_tableParams(LONG packetHandle, WORD tableKey, struct SignalRequestMessageCommon_RegionalExtension_Reg_Position3D_table value, char oldPath[])
{
  char newPath[300];
  int result;

  result = 0;

  switch(tableKey)
  {
    case 2:
    {
      snprintf(newPath, elcount(newPath), "%s.%s", oldPath, "addGrpB");
      SetSignalRequestMessageAddGrpB_Position3D_addGrpBParams(packetHandle, value.addGrpB, newPath);
      result = CheckLastError("SignalRequestMessage", gkFuncRefGet, result);
    }
    break;
    case 3:
    {
      snprintf(newPath, elcount(newPath), "%s.%s", oldPath, "addGrpC");
      SetSignalRequestMessageAddGrpC_Position3D_addGrpCParams(packetHandle, value.addGrpC, newPath);
      result = CheckLastError("SignalRequestMessage", gkFuncRefGet, result);
    }
    break;
  }
  return result;
}

int GetSignalRequestMessageCommon_RegionalExtension_Reg_Position3DParams(LONG packetHandle, struct SignalRequestMessageCommon_RegionalExtension_Reg_Position3D value, char oldPath[])
{
  char newPath[300];
  int result;

  result = 0;

  snprintf(newPath, elcount(newPath), "%s.%s", oldPath, "regionId");
  value.regionId = C2xGetTokenInt(packetHandle, "SignalRequestMessage", newPath);
  result = CheckLastError("SignalRequestMessage", gkFuncRefGet, result);

  snprintf(newPath, elcount(newPath), "%s.%s", oldPath, "regExtvalue");
  GetSignalRequestMessageCommon_RegionalExtension_Reg_Position3D_tableParams(packetHandle, value.regionId, value.regExtvalue, newPath);
  result = CheckLastError("SignalRequestMessage", gkFuncRefGet, result);

  return result;
}

int SetSignalRequestMessageCommon_RegionalExtension_Reg_Position3DParams(LONG packetHandle, struct SignalRequestMessageCommon_RegionalExtension_Reg_Position3D value, char oldPath[])
{
  char newPath[300];
  int result;

  result = 0;


  snprintf(newPath, elcount(newPath), "%s.%s", oldPath, "regExtvalue");
  SetSignalRequestMessageCommon_RegionalExtension_Reg_Position3D_tableParams(packetHandle, value.regionId, value.regExtvalue, newPath);
  result = CheckLastError("SignalRequestMessage", gkFuncRefGet, result);

  return result;
}

int GetSignalRequestMessageCommon_Position3D_regionalParams(LONG packetHandle, struct SignalRequestMessageCommon_Position3D_regional value, char oldPath[])
{
  char newPath[300]; 
  int i;
  int result;

  result = 0;

  value.length = C2xGetTokenInt(packetHandle, "SignalRequestMessage", oldPath);
  if((result = CheckLastError("SignalRequestMessage", gkFuncRefGet, result))==0)
  {
    for(i=0; i<value.length; i++)
    {
      snprintf(newPath, elcount(newPath), "%s[%d]", oldPath, i);
      GetSignalRequestMessageCommon_RegionalExtension_Reg_Position3DParams(packetHandle, value.arrayValue[i], newPath);
      result = CheckLastError("SignalRequestMessage", gkFuncRefGet, result);
    }
  }
  return result;
}

int SetSignalRequestMessageCommon_Position3D_regionalParams(LONG packetHandle, struct SignalRequestMessageCommon_Position3D_regional value, char oldPath[])
{
  char newPath[300]; 
  int i;
  int result;

  result = 0;

  C2xRemoveToken(packetHandle, "SignalRequestMessage", oldPath);
  for(i=0; i<value.length; i++)
  {
    snprintf(newPath, elcount(newPath), "%s[%d]", oldPath, i);
    SetSignalRequestMessageCommon_RegionalExtension_Reg_Position3DParams(packetHandle, value.arrayValue[i], newPath);
    result = CheckLastError("SignalRequestMessage", gkFuncRefGet, result);
  }
  return result;
}

int GetSignalRequestMessageCommon_Position3DParams(LONG packetHandle, struct SignalRequestMessageCommon_Position3D value, char oldPath[])
{
  char newPath[300];
  int result;

  result = 0;

  snprintf(newPath, elcount(newPath), "%s.%s", oldPath, "lat");
  value.lat = C2xGetTokenInt(packetHandle, "SignalRequestMessage", newPath);
  result = CheckLastError("SignalRequestMessage", gkFuncRefGet, result);

  snprintf(newPath, elcount(newPath), "%s.%s", oldPath, "lon");
  value.lon = C2xGetTokenInt(packetHandle, "SignalRequestMessage", newPath);
  result = CheckLastError("SignalRequestMessage", gkFuncRefGet, result);

  snprintf(newPath, elcount(newPath), "%s.%s", oldPath, "elevation");
  value.elevation.isValidFlag = C2xIsTokenAvailable(packetHandle, "SignalRequestMessage", newPath);
  if(value.elevation.isValidFlag==1)
  {
    value.elevation.value = C2xGetTokenInt(packetHandle, "SignalRequestMessage", newPath);
    result = CheckLastError("SignalRequestMessage", gkFuncRefGet, result);
  }
  snprintf(newPath, elcount(newPath), "%s.%s", oldPath, "regional");
  value.regional.isValidFlag = C2xIsTokenAvailable(packetHandle, "SignalRequestMessage", newPath);
  if(value.regional.isValidFlag==1)
  {
    GetSignalRequestMessageCommon_Position3D_regionalParams(packetHandle, value.regional, newPath);
    result = CheckLastError("SignalRequestMessage", gkFuncRefGet, result);
  }
  return result;
}

int SetSignalRequestMessageCommon_Position3DParams(LONG packetHandle, struct SignalRequestMessageCommon_Position3D value, char oldPath[])
{
  char newPath[300];
  int result;

  result = 0;

  snprintf(newPath, elcount(newPath), "%s.%s", oldPath, "lat");
  C2xSetTokenInt(packetHandle, "SignalRequestMessage", newPath, value.lat);
  result = CheckLastError("SignalRequestMessage", gkFuncRefGet, result);

  snprintf(newPath, elcount(newPath), "%s.%s", oldPath, "lon");
  C2xSetTokenInt(packetHandle, "SignalRequestMessage", newPath, value.lon);
  result = CheckLastError("SignalRequestMessage", gkFuncRefGet, result);

  snprintf(newPath, elcount(newPath), "%s.%s", oldPath, "elevation");
  if(value.elevation.isValidFlag==1)
  {
    C2xSetTokenInt(packetHandle, "SignalRequestMessage", newPath, value.elevation.value);
    result = CheckLastError("SignalRequestMessage", gkFuncRefGet, result);
  }
  else
  {
    if( C2xIsTokenAvailable(packetHandle, "SignalRequestMessage", newPath) )
    {
      C2xRemoveToken(packetHandle, "SignalRequestMessage", newPath);
    }
  }

  snprintf(newPath, elcount(newPath), "%s.%s", oldPath, "regional");
  if(value.regional.isValidFlag==1)
  {
    SetSignalRequestMessageCommon_Position3D_regionalParams(packetHandle, value.regional, newPath);
    result = CheckLastError("SignalRequestMessage", gkFuncRefGet, result);
  }
  else
  {
    if( C2xIsTokenAvailable(packetHandle, "SignalRequestMessage", newPath) )
    {
      C2xRemoveToken(packetHandle, "SignalRequestMessage", newPath);
    }
  }

  return result;
}

int GetSignalRequestMessageCommon_TransmissionAndSpeedParams(LONG packetHandle, struct SignalRequestMessageCommon_TransmissionAndSpeed value, char oldPath[])
{
  char newPath[300];
  int result;

  result = 0;

  snprintf(newPath, elcount(newPath), "%s.%s", oldPath, "transmisson");
  value.transmisson = C2xGetTokenInt(packetHandle, "SignalRequestMessage", newPath);
  result = CheckLastError("SignalRequestMessage", gkFuncRefGet, result);

  snprintf(newPath, elcount(newPath), "%s.%s", oldPath, "speed");
  value.speed = C2xGetTokenInt(packetHandle, "SignalRequestMessage", newPath);
  result = CheckLastError("SignalRequestMessage", gkFuncRefGet, result);

  return result;
}

int SetSignalRequestMessageCommon_TransmissionAndSpeedParams(LONG packetHandle, struct SignalRequestMessageCommon_TransmissionAndSpeed value, char oldPath[])
{
  char newPath[300];
  int result;

  result = 0;

  snprintf(newPath, elcount(newPath), "%s.%s", oldPath, "transmisson");
  C2xSetTokenInt(packetHandle, "SignalRequestMessage", newPath, value.transmisson);
  result = CheckLastError("SignalRequestMessage", gkFuncRefGet, result);

  snprintf(newPath, elcount(newPath), "%s.%s", oldPath, "speed");
  C2xSetTokenInt(packetHandle, "SignalRequestMessage", newPath, value.speed);
  result = CheckLastError("SignalRequestMessage", gkFuncRefGet, result);

  return result;
}

int GetSignalRequestMessageRequestorPositionVectorParams(LONG packetHandle, struct SignalRequestMessageRequestorPositionVector value, char oldPath[])
{
  char newPath[300];
  int result;

  result = 0;

  snprintf(newPath, elcount(newPath), "%s.%s", oldPath, "position");
  GetSignalRequestMessageCommon_Position3DParams(packetHandle, value.position, newPath);
  result = CheckLastError("SignalRequestMessage", gkFuncRefGet, result);

  snprintf(newPath, elcount(newPath), "%s.%s", oldPath, "heading");
  value.heading.isValidFlag = C2xIsTokenAvailable(packetHandle, "SignalRequestMessage", newPath);
  if(value.heading.isValidFlag==1)
  {
    value.heading.value = C2xGetTokenInt(packetHandle, "SignalRequestMessage", newPath);
    result = CheckLastError("SignalRequestMessage", gkFuncRefGet, result);
  }
  snprintf(newPath, elcount(newPath), "%s.%s", oldPath, "speed");
  value.speed.isValidFlag = C2xIsTokenAvailable(packetHandle, "SignalRequestMessage", newPath);
  if(value.speed.isValidFlag==1)
  {
    GetSignalRequestMessageCommon_TransmissionAndSpeedParams(packetHandle, value.speed, newPath);
    result = CheckLastError("SignalRequestMessage", gkFuncRefGet, result);
  }
  return result;
}

int SetSignalRequestMessageRequestorPositionVectorParams(LONG packetHandle, struct SignalRequestMessageRequestorPositionVector value, char oldPath[])
{
  char newPath[300];
  int result;

  result = 0;

  snprintf(newPath, elcount(newPath), "%s.%s", oldPath, "position");
  SetSignalRequestMessageCommon_Position3DParams(packetHandle, value.position, newPath);
  result = CheckLastError("SignalRequestMessage", gkFuncRefGet, result);

  snprintf(newPath, elcount(newPath), "%s.%s", oldPath, "heading");
  if(value.heading.isValidFlag==1)
  {
    C2xSetTokenInt(packetHandle, "SignalRequestMessage", newPath, value.heading.value);
    result = CheckLastError("SignalRequestMessage", gkFuncRefGet, result);
  }
  else
  {
    if( C2xIsTokenAvailable(packetHandle, "SignalRequestMessage", newPath) )
    {
      C2xRemoveToken(packetHandle, "SignalRequestMessage", newPath);
    }
  }

  snprintf(newPath, elcount(newPath), "%s.%s", oldPath, "speed");
  if(value.speed.isValidFlag==1)
  {
    SetSignalRequestMessageCommon_TransmissionAndSpeedParams(packetHandle, value.speed, newPath);
    result = CheckLastError("SignalRequestMessage", gkFuncRefGet, result);
  }
  else
  {
    if( C2xIsTokenAvailable(packetHandle, "SignalRequestMessage", newPath) )
    {
      C2xRemoveToken(packetHandle, "SignalRequestMessage", newPath);
    }
  }

  return result;
}

int GetSignalRequestMessageCommon_RegionalExtension_Reg_RequestorDescriptionParams(LONG packetHandle, struct SignalRequestMessageCommon_RegionalExtension_Reg_RequestorDescription value, char oldPath[])
{
  char newPath[300];
  int result;

  result = 0;

  snprintf(newPath, elcount(newPath), "%s.%s", oldPath, "regionId");
  value.regionId = C2xGetTokenInt(packetHandle, "SignalRequestMessage", newPath);
  result = CheckLastError("SignalRequestMessage", gkFuncRefGet, result);

  return result;
}

int SetSignalRequestMessageCommon_RegionalExtension_Reg_RequestorDescriptionParams(LONG packetHandle, struct SignalRequestMessageCommon_RegionalExtension_Reg_RequestorDescription value, char oldPath[])
{
  char newPath[300];
  int result;

  result = 0;


  return result;
}

int GetSignalRequestMessageRequestorDescription_regionalParams(LONG packetHandle, struct SignalRequestMessageRequestorDescription_regional value, char oldPath[])
{
  char newPath[300]; 
  int i;
  int result;

  result = 0;

  value.length = C2xGetTokenInt(packetHandle, "SignalRequestMessage", oldPath);
  if((result = CheckLastError("SignalRequestMessage", gkFuncRefGet, result))==0)
  {
    for(i=0; i<value.length; i++)
    {
      snprintf(newPath, elcount(newPath), "%s[%d]", oldPath, i);
      GetSignalRequestMessageCommon_RegionalExtension_Reg_RequestorDescriptionParams(packetHandle, value.arrayValue[i], newPath);
      result = CheckLastError("SignalRequestMessage", gkFuncRefGet, result);
    }
  }
  return result;
}

int SetSignalRequestMessageRequestorDescription_regionalParams(LONG packetHandle, struct SignalRequestMessageRequestorDescription_regional value, char oldPath[])
{
  char newPath[300]; 
  int i;
  int result;

  result = 0;

  C2xRemoveToken(packetHandle, "SignalRequestMessage", oldPath);
  for(i=0; i<value.length; i++)
  {
    snprintf(newPath, elcount(newPath), "%s[%d]", oldPath, i);
    SetSignalRequestMessageCommon_RegionalExtension_Reg_RequestorDescriptionParams(packetHandle, value.arrayValue[i], newPath);
    result = CheckLastError("SignalRequestMessage", gkFuncRefGet, result);
  }
  return result;
}

int GetSignalRequestMessageRequestorDescriptionParams(LONG packetHandle, struct SignalRequestMessageRequestorDescription value, char oldPath[])
{
  char newPath[300]; 
  int j; 
  int k;
  int result;

  result = 0;

  snprintf(newPath, elcount(newPath), "%s.%s", oldPath, "id");
  GetSignalRequestMessageCommon_VehicleIDParams(packetHandle, value.id, newPath);
  result = CheckLastError("SignalRequestMessage", gkFuncRefGet, result);

  snprintf(newPath, elcount(newPath), "%s.%s", oldPath, "type");
  value.type.isValidFlag = C2xIsTokenAvailable(packetHandle, "SignalRequestMessage", newPath);
  if(value.type.isValidFlag==1)
  {
    GetSignalRequestMessageCommon_RequestorTypeParams(packetHandle, value.type, newPath);
    result = CheckLastError("SignalRequestMessage", gkFuncRefGet, result);
  }
  snprintf(newPath, elcount(newPath), "%s.%s", oldPath, "position");
  value.position.isValidFlag = C2xIsTokenAvailable(packetHandle, "SignalRequestMessage", newPath);
  if(value.position.isValidFlag==1)
  {
    GetSignalRequestMessageRequestorPositionVectorParams(packetHandle, value.position, newPath);
    result = CheckLastError("SignalRequestMessage", gkFuncRefGet, result);
  }
  snprintf(newPath, elcount(newPath), "%s.%s", oldPath, "name");
  value.name.isValidFlag = C2xIsTokenAvailable(packetHandle, "SignalRequestMessage", newPath);
  if(value.name.isValidFlag==1)
  {
    value.name.stringLength = C2xGetTokenData(packetHandle, "SignalRequestMessage", newPath, elcount(value.name.string), value.name.string);
    result = CheckLastError("SignalRequestMessage", gkFuncRefGet, result);
  }
  snprintf(newPath, elcount(newPath), "%s.%s", oldPath, "routeName");
  value.routeName.isValidFlag = C2xIsTokenAvailable(packetHandle, "SignalRequestMessage", newPath);
  if(value.routeName.isValidFlag==1)
  {
    value.routeName.stringLength = C2xGetTokenData(packetHandle, "SignalRequestMessage", newPath, elcount(value.routeName.string), value.routeName.string);
    result = CheckLastError("SignalRequestMessage", gkFuncRefGet, result);
  }
  snprintf(newPath, elcount(newPath), "%s.%s", oldPath, "transitStatus");
  value.transitStatus.isValidFlag = C2xIsTokenAvailable(packetHandle, "SignalRequestMessage", newPath);
  if(value.transitStatus.isValidFlag==1)
  {
    value.transitStatus.isValidFlag = 1;
    value.transitStatus.stringLength = C2xGetTokenLengthBit(packetHandle, "SignalRequestMessage", newPath);
    if ((result = CheckLastError("SignalRequestMessage", gkFuncRefGet, result))==0)
    {
      if(value.transitStatus.stringLength > 0)
      {
        for(j=0; j<value.transitStatus.stringLength; j++)
        {
          if(C2xGetTokenBitOfBitString(packetHandle, "SignalRequestMessage", newPath, j) == 0)
          {
            value.transitStatus.string[j] = '0';
          }
          else if(C2xGetTokenBitOfBitString(packetHandle, "SignalRequestMessage", newPath, j) == 1)
          {
            value.transitStatus.string[j] = '1';
          }

          if(value.transitStatus.stringLength == 1)
          {
            value.transitStatus.string[1] = '0';
          }
          result = CheckLastError("SignalRequestMessage", gkFuncRefGet, result);
        }
      }
      else
      {
        for(k = value.transitStatus.stringLength+1; k > -1; k--)
        {
          if(value.transitStatus.string[k] == '1')
          {
            value.transitStatus.string[k] = '0';
          }
        }
      }
    }

  }
  snprintf(newPath, elcount(newPath), "%s.%s", oldPath, "transitOccupancy");
  value.transitOccupancy.isValidFlag = C2xIsTokenAvailable(packetHandle, "SignalRequestMessage", newPath);
  if(value.transitOccupancy.isValidFlag==1)
  {
    value.transitOccupancy.value = C2xGetTokenInt(packetHandle, "SignalRequestMessage", newPath);
    result = CheckLastError("SignalRequestMessage", gkFuncRefGet, result);
  }
  snprintf(newPath, elcount(newPath), "%s.%s", oldPath, "transitSchedule");
  value.transitSchedule.isValidFlag = C2xIsTokenAvailable(packetHandle, "SignalRequestMessage", newPath);
  if(value.transitSchedule.isValidFlag==1)
  {
    value.transitSchedule.value = C2xGetTokenInt(packetHandle, "SignalRequestMessage", newPath);
    result = CheckLastError("SignalRequestMessage", gkFuncRefGet, result);
  }
  snprintf(newPath, elcount(newPath), "%s.%s", oldPath, "regional");
  value.regional.isValidFlag = C2xIsTokenAvailable(packetHandle, "SignalRequestMessage", newPath);
  if(value.regional.isValidFlag==1)
  {
    GetSignalRequestMessageRequestorDescription_regionalParams(packetHandle, value.regional, newPath);
    result = CheckLastError("SignalRequestMessage", gkFuncRefGet, result);
  }
  return result;
}

int SetSignalRequestMessageRequestorDescriptionParams(LONG packetHandle, struct SignalRequestMessageRequestorDescription value, char oldPath[])
{
  char newPath[300]; 
  int j;
  int result;

  result = 0;

  snprintf(newPath, elcount(newPath), "%s.%s", oldPath, "id");
  SetSignalRequestMessageCommon_VehicleIDParams(packetHandle, value.id, newPath);
  result = CheckLastError("SignalRequestMessage", gkFuncRefGet, result);

  snprintf(newPath, elcount(newPath), "%s.%s", oldPath, "type");
  if(value.type.isValidFlag==1)
  {
    SetSignalRequestMessageCommon_RequestorTypeParams(packetHandle, value.type, newPath);
    result = CheckLastError("SignalRequestMessage", gkFuncRefGet, result);
  }
  else
  {
    if( C2xIsTokenAvailable(packetHandle, "SignalRequestMessage", newPath) )
    {
      C2xRemoveToken(packetHandle, "SignalRequestMessage", newPath);
    }
  }

  snprintf(newPath, elcount(newPath), "%s.%s", oldPath, "position");
  if(value.position.isValidFlag==1)
  {
    SetSignalRequestMessageRequestorPositionVectorParams(packetHandle, value.position, newPath);
    result = CheckLastError("SignalRequestMessage", gkFuncRefGet, result);
  }
  else
  {
    if( C2xIsTokenAvailable(packetHandle, "SignalRequestMessage", newPath) )
    {
      C2xRemoveToken(packetHandle, "SignalRequestMessage", newPath);
    }
  }

  snprintf(newPath, elcount(newPath), "%s.%s", oldPath, "name");
  if(value.name.isValidFlag==1)
  {
    C2xSetTokenData(packetHandle, "SignalRequestMessage", newPath, value.name.stringLength, value.name.string);
    result = CheckLastError("SignalRequestMessage", gkFuncRefGet, result);
  }
  else
  {
    if( C2xIsTokenAvailable(packetHandle, "SignalRequestMessage", newPath) )
    {
      C2xRemoveToken(packetHandle, "SignalRequestMessage", newPath);
    }
  }

  snprintf(newPath, elcount(newPath), "%s.%s", oldPath, "routeName");
  if(value.routeName.isValidFlag==1)
  {
    C2xSetTokenData(packetHandle, "SignalRequestMessage", newPath, value.routeName.stringLength, value.routeName.string);
    result = CheckLastError("SignalRequestMessage", gkFuncRefGet, result);
  }
  else
  {
    if( C2xIsTokenAvailable(packetHandle, "SignalRequestMessage", newPath) )
    {
      C2xRemoveToken(packetHandle, "SignalRequestMessage", newPath);
    }
  }

  snprintf(newPath, elcount(newPath), "%s.%s", oldPath, "transitStatus");
  if(value.transitStatus.isValidFlag==1)
  {
      for(j=0; j<value.transitStatus.stringLength; j++)
      {
        if(value.transitStatus.string[j] == '0')
        {
          C2xSetTokenBitOfBitString(packetHandle, "SignalRequestMessage", newPath, j, 0);
        }
        else
        {
          C2xSetTokenBitOfBitString(packetHandle, "SignalRequestMessage", newPath, j, 1);
        }
        result = CheckLastError("SignalRequestMessage", gkFuncRefGet, result);
      }
  }
  else
  {
    if( C2xIsTokenAvailable(packetHandle, "SignalRequestMessage", newPath) )
    {
      C2xRemoveToken(packetHandle, "SignalRequestMessage", newPath);
    }
  }

  snprintf(newPath, elcount(newPath), "%s.%s", oldPath, "transitOccupancy");
  if(value.transitOccupancy.isValidFlag==1)
  {
    C2xSetTokenInt(packetHandle, "SignalRequestMessage", newPath, value.transitOccupancy.value);
    result = CheckLastError("SignalRequestMessage", gkFuncRefGet, result);
  }
  else
  {
    if( C2xIsTokenAvailable(packetHandle, "SignalRequestMessage", newPath) )
    {
      C2xRemoveToken(packetHandle, "SignalRequestMessage", newPath);
    }
  }

  snprintf(newPath, elcount(newPath), "%s.%s", oldPath, "transitSchedule");
  if(value.transitSchedule.isValidFlag==1)
  {
    C2xSetTokenInt(packetHandle, "SignalRequestMessage", newPath, value.transitSchedule.value);
    result = CheckLastError("SignalRequestMessage", gkFuncRefGet, result);
  }
  else
  {
    if( C2xIsTokenAvailable(packetHandle, "SignalRequestMessage", newPath) )
    {
      C2xRemoveToken(packetHandle, "SignalRequestMessage", newPath);
    }
  }

  snprintf(newPath, elcount(newPath), "%s.%s", oldPath, "regional");
  if(value.regional.isValidFlag==1)
  {
    SetSignalRequestMessageRequestorDescription_regionalParams(packetHandle, value.regional, newPath);
    result = CheckLastError("SignalRequestMessage", gkFuncRefGet, result);
  }
  else
  {
    if( C2xIsTokenAvailable(packetHandle, "SignalRequestMessage", newPath) )
    {
      C2xRemoveToken(packetHandle, "SignalRequestMessage", newPath);
    }
  }

  return result;
}

int GetSignalRequestMessageCommon_RegionalExtension_Reg_SignalRequestMessageParams(LONG packetHandle, struct SignalRequestMessageCommon_RegionalExtension_Reg_SignalRequestMessage value, char oldPath[])
{
  char newPath[300];
  int result;

  result = 0;

  snprintf(newPath, elcount(newPath), "%s.%s", oldPath, "regionId");
  value.regionId = C2xGetTokenInt(packetHandle, "SignalRequestMessage", newPath);
  result = CheckLastError("SignalRequestMessage", gkFuncRefGet, result);

  return result;
}

int SetSignalRequestMessageCommon_RegionalExtension_Reg_SignalRequestMessageParams(LONG packetHandle, struct SignalRequestMessageCommon_RegionalExtension_Reg_SignalRequestMessage value, char oldPath[])
{
  char newPath[300];
  int result;

  result = 0;


  return result;
}

int GetSignalRequestMessageSignalRequestMessage_regionalParams(LONG packetHandle, struct SignalRequestMessageSignalRequestMessage_regional value, char oldPath[])
{
  char newPath[300]; 
  int i;
  int result;

  result = 0;

  value.length = C2xGetTokenInt(packetHandle, "SignalRequestMessage", oldPath);
  if((result = CheckLastError("SignalRequestMessage", gkFuncRefGet, result))==0)
  {
    for(i=0; i<value.length; i++)
    {
      snprintf(newPath, elcount(newPath), "%s[%d]", oldPath, i);
      GetSignalRequestMessageCommon_RegionalExtension_Reg_SignalRequestMessageParams(packetHandle, value.arrayValue[i], newPath);
      result = CheckLastError("SignalRequestMessage", gkFuncRefGet, result);
    }
  }
  return result;
}

int SetSignalRequestMessageSignalRequestMessage_regionalParams(LONG packetHandle, struct SignalRequestMessageSignalRequestMessage_regional value, char oldPath[])
{
  char newPath[300]; 
  int i;
  int result;

  result = 0;

  C2xRemoveToken(packetHandle, "SignalRequestMessage", oldPath);
  for(i=0; i<value.length; i++)
  {
    snprintf(newPath, elcount(newPath), "%s[%d]", oldPath, i);
    SetSignalRequestMessageCommon_RegionalExtension_Reg_SignalRequestMessageParams(packetHandle, value.arrayValue[i], newPath);
    result = CheckLastError("SignalRequestMessage", gkFuncRefGet, result);
  }
  return result;
}

int GetSignalRequestMessage_SignalRequestMessageParams(LONG packetHandle, struct SignalRequestMessage_SignalRequestMessage value, char oldPath[])
{
  char newPath[300];
  int result;

  result = 0;

  snprintf(newPath, elcount(newPath), "%s.%s", oldPath, "timeStamp");
  value.timeStamp.isValidFlag = C2xIsTokenAvailable(packetHandle, "SignalRequestMessage", newPath);
  if(value.timeStamp.isValidFlag==1)
  {
    value.timeStamp.value = C2xGetTokenInt(packetHandle, "SignalRequestMessage", newPath);
    result = CheckLastError("SignalRequestMessage", gkFuncRefGet, result);
  }
  snprintf(newPath, elcount(newPath), "%s.%s", oldPath, "second");
  value.second = C2xGetTokenInt(packetHandle, "SignalRequestMessage", newPath);
  result = CheckLastError("SignalRequestMessage", gkFuncRefGet, result);

  snprintf(newPath, elcount(newPath), "%s.%s", oldPath, "sequenceNumber");
  value.sequenceNumber.isValidFlag = C2xIsTokenAvailable(packetHandle, "SignalRequestMessage", newPath);
  if(value.sequenceNumber.isValidFlag==1)
  {
    value.sequenceNumber.value = C2xGetTokenInt(packetHandle, "SignalRequestMessage", newPath);
    result = CheckLastError("SignalRequestMessage", gkFuncRefGet, result);
  }
  snprintf(newPath, elcount(newPath), "%s.%s", oldPath, "requests");
  value.requests.isValidFlag = C2xIsTokenAvailable(packetHandle, "SignalRequestMessage", newPath);
  if(value.requests.isValidFlag==1)
  {
    GetSignalRequestMessageSignalRequestListParams(packetHandle, value.requests, newPath);
    result = CheckLastError("SignalRequestMessage", gkFuncRefGet, result);
  }
  snprintf(newPath, elcount(newPath), "%s.%s", oldPath, "requestor");
  GetSignalRequestMessageRequestorDescriptionParams(packetHandle, value.requestor, newPath);
  result = CheckLastError("SignalRequestMessage", gkFuncRefGet, result);

  snprintf(newPath, elcount(newPath), "%s.%s", oldPath, "regional");
  value.regional.isValidFlag = C2xIsTokenAvailable(packetHandle, "SignalRequestMessage", newPath);
  if(value.regional.isValidFlag==1)
  {
    GetSignalRequestMessageSignalRequestMessage_regionalParams(packetHandle, value.regional, newPath);
    result = CheckLastError("SignalRequestMessage", gkFuncRefGet, result);
  }
  return result;
}

int SetSignalRequestMessage_SignalRequestMessageParams(LONG packetHandle, struct SignalRequestMessage_SignalRequestMessage value, char oldPath[])
{
  char newPath[300];
  int result;

  result = 0;

  snprintf(newPath, elcount(newPath), "%s.%s", oldPath, "timeStamp");
  if(value.timeStamp.isValidFlag==1)
  {
    C2xSetTokenInt(packetHandle, "SignalRequestMessage", newPath, value.timeStamp.value);
    result = CheckLastError("SignalRequestMessage", gkFuncRefGet, result);
  }
  else
  {
    if( C2xIsTokenAvailable(packetHandle, "SignalRequestMessage", newPath) )
    {
      C2xRemoveToken(packetHandle, "SignalRequestMessage", newPath);
    }
  }

  snprintf(newPath, elcount(newPath), "%s.%s", oldPath, "second");
  C2xSetTokenInt(packetHandle, "SignalRequestMessage", newPath, value.second);
  result = CheckLastError("SignalRequestMessage", gkFuncRefGet, result);

  snprintf(newPath, elcount(newPath), "%s.%s", oldPath, "sequenceNumber");
  if(value.sequenceNumber.isValidFlag==1)
  {
    C2xSetTokenInt(packetHandle, "SignalRequestMessage", newPath, value.sequenceNumber.value);
    result = CheckLastError("SignalRequestMessage", gkFuncRefGet, result);
  }
  else
  {
    if( C2xIsTokenAvailable(packetHandle, "SignalRequestMessage", newPath) )
    {
      C2xRemoveToken(packetHandle, "SignalRequestMessage", newPath);
    }
  }

  snprintf(newPath, elcount(newPath), "%s.%s", oldPath, "requests");
  if(value.requests.isValidFlag==1)
  {
    SetSignalRequestMessageSignalRequestListParams(packetHandle, value.requests, newPath);
    result = CheckLastError("SignalRequestMessage", gkFuncRefGet, result);
  }
  else
  {
    if( C2xIsTokenAvailable(packetHandle, "SignalRequestMessage", newPath) )
    {
      C2xRemoveToken(packetHandle, "SignalRequestMessage", newPath);
    }
  }

  snprintf(newPath, elcount(newPath), "%s.%s", oldPath, "requestor");
  SetSignalRequestMessageRequestorDescriptionParams(packetHandle, value.requestor, newPath);
  result = CheckLastError("SignalRequestMessage", gkFuncRefGet, result);

  snprintf(newPath, elcount(newPath), "%s.%s", oldPath, "regional");
  if(value.regional.isValidFlag==1)
  {
    SetSignalRequestMessageSignalRequestMessage_regionalParams(packetHandle, value.regional, newPath);
    result = CheckLastError("SignalRequestMessage", gkFuncRefGet, result);
  }
  else
  {
    if( C2xIsTokenAvailable(packetHandle, "SignalRequestMessage", newPath) )
    {
      C2xRemoveToken(packetHandle, "SignalRequestMessage", newPath);
    }
  }

  return result;
}

int GetSignalRequestMessageMESSAGE_ID_AND_TYPEParams(LONG packetHandle, WORD tableKey, struct SignalRequestMessageMESSAGE_ID_AND_TYPE value, char oldPath[])
{
  char newPath[300];
  int result;

  result = 0;

  switch(tableKey)
  {
    case 29:
    {
      snprintf(newPath, elcount(newPath), "%s.%s", oldPath, "signalRequestMessage");
      GetSignalRequestMessage_SignalRequestMessageParams(packetHandle, value.signalRequestMessage, newPath);
      result = CheckLastError("SignalRequestMessage", gkFuncRefGet, result);
    }
    break;
  }
  return result;
}

int SetSignalRequestMessageMESSAGE_ID_AND_TYPEParams(LONG packetHandle, WORD tableKey, struct SignalRequestMessageMESSAGE_ID_AND_TYPE value, char oldPath[])
{
  char newPath[300];
  int result;

  result = 0;

  switch(tableKey)
  {
    case 29:
    {
      snprintf(newPath, elcount(newPath), "%s.%s", oldPath, "signalRequestMessage");
      SetSignalRequestMessage_SignalRequestMessageParams(packetHandle, value.signalRequestMessage, newPath);
      result = CheckLastError("SignalRequestMessage", gkFuncRefGet, result);
    }
    break;
  }
  return result;
}

int API_GetSignalRequestMessageParams(LONG packetHandle, struct SignalRequestMessage value)
{
  int result;
  result = 0;

  value.messageId = C2xGetTokenInt(packetHandle, "SignalRequestMessage", "messageId");
  result = CheckLastError("SignalRequestMessage", gkFuncRefGet, result);

  GetSignalRequestMessageMESSAGE_ID_AND_TYPEParams(packetHandle, value.messageId, value.value, "value");
  result = CheckLastError("SignalRequestMessage", gkFuncRefGet, result);

  return result;
}

int API_SetSignalRequestMessageParams(LONG packetHandle, struct SignalRequestMessage value)
{
  int result;
  result = 0;

  value.messageId = 29;

  SetSignalRequestMessageMESSAGE_ID_AND_TYPEParams(packetHandle, value.messageId, value.value, "value");
  result = CheckLastError("SignalRequestMessage", gkFuncRefGet, result);

  return result;
}

