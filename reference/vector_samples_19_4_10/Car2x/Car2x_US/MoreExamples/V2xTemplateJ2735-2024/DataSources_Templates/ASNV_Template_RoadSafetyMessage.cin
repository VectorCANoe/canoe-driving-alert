/*@!Encoding:1252*/
/*
//  (c) Vector Informatik GmbH. All rights reserved.
//
//  This file contains definitions of structs and methods that may be used
//  to set and get the values of an ASN.1 defined packet's payload.
//
//  //This example demonstrates how to set a packet's payload:
//  LONG packetHandle;
//  struct RoadSafetyMessage payload;
//  //you need to set the values of the variable "payload" yourself
//  packetHandle = API_InitRoadSafetyMessagePacket();
//  if (packetHandle!=0) {
//    if (API_SetRoadSafetyMessageParams(packetHandle, payload)==0) {
//      if (C2xCompletePacket(packetHandle)==0) {
//        C2xOutputPacket(packetHandle);
//      }
//    }
//  }
//                                                                             */
includes
{
  #include "ASNV_Template_BaseDatatypes.cin"  // If warning "Duplicate #include, ignoring this include" appears, please remove the ASNV_Template_BaseDatatypes.cin include from your other *.cin files in the project.
}
variables
{
    struct RoadSafetyMessageCommon_FullRoadAuthorityID_id {
        INT isValidFlag;   // necessary if this struct is used as an optional field of a SEQUENCE
        INT length;
        INT id;
    };
    
    struct RoadSafetyMessageCommon_FullRoadAuthorityID {
        INT isValidFlag;   // necessary if this struct is used as an optional field of a SEQUENCE
        INT length;
        struct RoadSafetyMessageCommon_FullRoadAuthorityID_id arrayValue[16];
    };
    
    struct RoadSafetyMessageCommon_RelativeRoadAuthorityID_id {
        INT isValidFlag;   // necessary if this struct is used as an optional field of a SEQUENCE
        INT length;
        INT id;
    };
    
    struct RoadSafetyMessageCommon_RelativeRoadAuthorityID {
        INT isValidFlag;   // necessary if this struct is used as an optional field of a SEQUENCE
        INT length;
        struct RoadSafetyMessageCommon_RelativeRoadAuthorityID_id arrayValue[16];
    };
    
    struct RoadSafetyMessageCommon_RoadAuthorityID {
        INT isValidFlag;   // necessary if this struct is used as an optional field of a SEQUENCE
        INT choice;
        struct RoadSafetyMessageCommon_FullRoadAuthorityID fullRdAuthID;  // OBJECTIDENTIFIER;
        struct RoadSafetyMessageCommon_RelativeRoadAuthorityID relRdAuthID;  // RELATIVEOID;
    };
    
    struct RoadSafetyMessageCommon_TemporaryID {
        INT isValidFlag;   // necessary if this struct is used as an optional field of a SEQUENCE
        CHAR string[5];
        INT  stringLength;
    };
    
    struct RoadSafetyMessageEventIdentifier {
        INT isValidFlag;   // necessary if this struct is used as an optional field of a SEQUENCE
        struct RoadSafetyMessageCommon_RoadAuthorityID operatorID;  // CHOICE;
        struct RoadSafetyMessageCommon_TemporaryID uniqueID;  // OCTETSTRING;
    };
    
    struct RoadSafetyMessageCommon_DDateTime {
        INT isValidFlag;   // necessary if this struct is used as an optional field of a SEQUENCE
        struct OPT_WORD_ASN year;  // INTEGER, OPTIONAL, 0..4095;
        struct OPT_BYTE_ASN month;  // INTEGER, OPTIONAL, 0..12;
        struct OPT_BYTE_ASN day;  // INTEGER, OPTIONAL, 0..31;
        struct OPT_BYTE_ASN hour;  // INTEGER, OPTIONAL, 0..31;
        struct OPT_BYTE_ASN minute;  // INTEGER, OPTIONAL, 0..60;
        struct OPT_WORD_ASN second;  // INTEGER, OPTIONAL, 0..65535;
        struct OPT_INT_ASN offset;  // INTEGER, OPTIONAL, -840..840;
    };
    
    struct RoadSafetyMessageCommon_DTime {
        INT isValidFlag;   // necessary if this struct is used as an optional field of a SEQUENCE
        BYTE hour;  // INTEGER, 0..31;
        BYTE minute;  // INTEGER, 0..60;
        WORD second;  // INTEGER, 0..65535;
        struct OPT_INT_ASN offset;  // INTEGER, OPTIONAL, -840..840;
    };
    
    struct RoadSafetyMessageCommon_DDate {
        INT isValidFlag;   // necessary if this struct is used as an optional field of a SEQUENCE
        WORD year;  // INTEGER, 0..4095;
        BYTE month;  // INTEGER, 0..12;
        BYTE day;  // INTEGER, 0..31;
    };
    
    struct RoadSafetyMessageEventRecurrence {
        INT isValidFlag;   // necessary if this struct is used as an optional field of a SEQUENCE
        struct RoadSafetyMessageCommon_DTime startTime;  // SEQUENCE, OPTIONAL;
        struct RoadSafetyMessageCommon_DTime endTime;  // SEQUENCE, OPTIONAL;
        struct RoadSafetyMessageCommon_DDate startDate;  // SEQUENCE, OPTIONAL;
        struct RoadSafetyMessageCommon_DDate endDate;  // SEQUENCE, OPTIONAL;
        INT monday;  // BOOLEAN;
        INT tuesday;  // BOOLEAN;
        INT wednesday;  // BOOLEAN;
        INT thursday;  // BOOLEAN;
        INT friday;  // BOOLEAN;
        INT saturday;  // BOOLEAN;
        INT sunday;  // BOOLEAN;
        struct OPT_BOOL_ASN exclusion;  // BOOLEAN, OPTIONAL;
    };
    
    struct RoadSafetyMessageEventInfo_eventRecurrence {
        INT isValidFlag;   // necessary if this struct is used as an optional field of a SEQUENCE
        INT length;
        struct RoadSafetyMessageEventRecurrence arrayValue[5];  // SEQUENCE;
    };
    
    struct RoadSafetyMessageEventInfo_affectedVehicles {
        INT isValidFlag;   // necessary if this struct is used as an optional field of a SEQUENCE
        INT length;
        INT arrayValue[10];  // ENUMERATED, all_vehicles(9217), bicycles(9218), motorcycles(9219), cars(9220), light_vehicles(9221), cars_and_light_vehicles(9222), cars_with_trailers(9223), cars_with_recreational_trailers(9224), vehicles_with_trailers(9225), heavy_vehicles(9226), trucks(9227), buses(9228), articulated_buses(9229), school_buses(9230), vehicles_with_semi_trailers(9231), vehicles_with_double_trailers(9232), high_profile_vehicles(9233), wide_vehicles(9234), long_vehicles(9235), hazardous_loads(9236), exceptional_loads(9237), abnormal_loads(9238), convoys(9239), maintenance_vehicles(9240), delivery_vehicles(9241), vehicles_with_even_numbered_license_plates(9242), vehicles_with_odd_numbered_license_plates(9243), vehicles_with_parking_permits(9244), vehicles_with_catalytic_converters(9245), vehicles_without_catalytic_converters(9246), gas_powered_vehicles(9247), diesel_powered_vehicles(9248), lPG_vehicles(9249), military_convoys(9250), military_vehicles(9251);
    };
    
    struct RoadSafetyMessageEventInfo {
        INT isValidFlag;   // necessary if this struct is used as an optional field of a SEQUENCE
        struct RoadSafetyMessageEventIdentifier eventID;  // SEQUENCE;
        BYTE eventUpdate;  // INTEGER, 0..127;
        INT eventCancellation;  // BOOLEAN;
        struct RoadSafetyMessageCommon_DDateTime startDateTime;  // SEQUENCE;
        struct RoadSafetyMessageCommon_DDateTime endDateTime;  // SEQUENCE, OPTIONAL;
        struct RoadSafetyMessageEventInfo_eventRecurrence eventRecurrence;  // SEQUENCEOF, OPTIONAL;
        BYTE causeCode;  // INTEGER, 0..255, trafficConditions(1), accidentsAndIncidents(2), closures(3), roadwork(4), obstruction(5), delayStatusCancellation(6), unusualDriving(7), mobileSituation(8), deviceStatus(9), restrictionClass(10), incidentResponseStatus(11), disasters(12), disturbances(13), sportingEvents(14), specialEvents(15), parkingInformation(16), systemInformation(17), weatherConditions(18), precipitation(19), winds(20), visibilityAndAirQuality(21), temperature(22), pavementConditions(23), winterDrivingRestrictions(24), winterDrivingIndex(25), suggestionAdvice(26), warningAdvice(27), adviceInstructionsRecommendations(28), adviceInstructionsMandatory(29), qualifiers(30), genericLocations(31), laneRoadway(32), alternateRoute(33), units(34), transitMode(35), vehicleGroupAffected(36), travelerGroupAffected(37), responderGroupAffected(38), incidentResponseEquipment(39), assetStatus(40), roadsideAssets(41), transitOperations(42), objects(43), validManeuvers(44), largeNumbers(45), namedObjects(46), recreationalObjectsAndActivities(47), regulatoryAndWarningSigns(48), smallNumbers(49), states(50), structures(51), streetSuffixes(52), mUTCDLocations(53);
        struct OPT_WORD_ASN subCauseCode;  // INTEGER, OPTIONAL, 0..65535;
        struct RoadSafetyMessageEventInfo_affectedVehicles affectedVehicles;  // SEQUENCEOF, OPTIONAL;
    };
    
    struct RoadSafetyMessageAddGrpB_LatitudeDMS2 {
        INT isValidFlag;   // necessary if this struct is used as an optional field of a SEQUENCE
        INT d;  // INTEGER, -90..90;
        BYTE m;  // INTEGER, 0..59;
        WORD s;  // INTEGER, 0..5999;
    };
    
    struct RoadSafetyMessageAddGrpB_LongitudeDMS2 {
        INT isValidFlag;   // necessary if this struct is used as an optional field of a SEQUENCE
        INT d;  // INTEGER, -180..180;
        BYTE m;  // INTEGER, 0..59;
        WORD s;  // INTEGER, 0..5999;
    };
    
    struct RoadSafetyMessageAddGrpB_Position3D_addGrpB {
        INT isValidFlag;   // necessary if this struct is used as an optional field of a SEQUENCE
        struct RoadSafetyMessageAddGrpB_LatitudeDMS2 latitude;  // SEQUENCE;
        struct RoadSafetyMessageAddGrpB_LongitudeDMS2 longitude;  // SEQUENCE;
        INT elevation;  // INTEGER, -32768..32767;
    };
    
    struct RoadSafetyMessageAddGrpC_Altitude {
        INT isValidFlag;   // necessary if this struct is used as an optional field of a SEQUENCE
        LONG value;  // INTEGER, -100000..800001;
        INT confidence;  // ENUMERATED, alt_000_01(-0), alt_000_02(1), alt_000_05(2), alt_000_10(3), alt_000_20(4), alt_000_50(5), alt_001_00(6), alt_002_00(7), alt_005_00(8), alt_010_00(9), alt_020_00(10), alt_050_00(11), alt_100_00(12), alt_200_00(13), outOfRange(14), unavailable(15);
    };
    
    struct RoadSafetyMessageAddGrpC_Position3D_addGrpC {
        INT isValidFlag;   // necessary if this struct is used as an optional field of a SEQUENCE
        struct RoadSafetyMessageAddGrpC_Altitude altitude;  // SEQUENCE;
    };
    
    struct RoadSafetyMessageCommon_RegionalExtension_Reg_Position3D_table {
        struct RoadSafetyMessageAddGrpB_Position3D_addGrpB addGrpB;  // SEQUENCE;
        struct RoadSafetyMessageAddGrpC_Position3D_addGrpC addGrpC;  // SEQUENCE;
    };
    
    struct RoadSafetyMessageCommon_RegionalExtension_Reg_Position3D {
        INT isValidFlag;   // necessary if this struct is used as an optional field of a SEQUENCE
        BYTE regionId;  // INTEGER, 0..255, noRegion(0), addGrpA(1), addGrpB(2), addGrpC(3), addGrpD(4);
        struct RoadSafetyMessageCommon_RegionalExtension_Reg_Position3D_table regExtvalue;  // TABLE;
    };
    
    struct RoadSafetyMessageCommon_Position3D_regional {
        INT isValidFlag;   // necessary if this struct is used as an optional field of a SEQUENCE
        INT length;
        struct RoadSafetyMessageCommon_RegionalExtension_Reg_Position3D arrayValue[4];  // SEQUENCE;
    };
    
    struct RoadSafetyMessageCommon_Position3D {
        INT isValidFlag;   // necessary if this struct is used as an optional field of a SEQUENCE
        LONG lat;  // INTEGER, -900000000..900000001;
        LONG lon;  // INTEGER, -1799999999..1800000001;
        struct OPT_LONG_ASN elevation;  // INTEGER, OPTIONAL, -4096..61439;
        struct RoadSafetyMessageCommon_Position3D_regional regional;  // SEQUENCEOF, OPTIONAL;
    };
    
    struct RoadSafetyMessageOffset3D {
        INT isValidFlag;   // necessary if this struct is used as an optional field of a SEQUENCE
        INT lat_offset;  // INTEGER, -16384..16383;
        INT long_offset;  // INTEGER, -16384..16383;
        struct OPT_INT_ASN elev_offset;  // INTEGER, OPTIONAL, -4096..4095;
    };
    
    struct RoadSafetyMessageRegionUncertainty {
        INT isValidFlag;   // necessary if this struct is used as an optional field of a SEQUENCE
        INT choice;
        struct RoadSafetyMessageOffset3D alongPath;  // SEQUENCE;
        struct RoadSafetyMessageOffset3D inCoordinateFrame;  // SEQUENCE;
    };
    
    struct RoadSafetyMessageCommon_DescriptiveName {
        INT isValidFlag;   // necessary if this struct is used as an optional field of a SEQUENCE
        CHAR string[64];
        INT  stringLength;
    };
    
    struct RoadSafetyMessageApplicableHeading {
        INT isValidFlag;   // necessary if this struct is used as an optional field of a SEQUENCE
        WORD heading;  // INTEGER, 0..359;
        BYTE tolerance;  // INTEGER, 0..180;
    };
    
    struct RoadSafetyMessageNodePointLLE {
        INT isValidFlag;   // necessary if this struct is used as an optional field of a SEQUENCE
        INT choice;
        struct RoadSafetyMessageCommon_Position3D node_3Dabsolute;  // SEQUENCE;
        struct RoadSafetyMessageOffset3D node_3Doffset;  // SEQUENCE;
    };
    
    struct RoadSafetyMessageRSMPolygon {
        INT isValidFlag;   // necessary if this struct is used as an optional field of a SEQUENCE
        INT length;
        struct RoadSafetyMessageNodePointLLE arrayValue[63];  // CHOICE;
    };
    
    struct RoadSafetyMessageTravelerInformation_Circle {
        INT isValidFlag;   // necessary if this struct is used as an optional field of a SEQUENCE
        struct RoadSafetyMessageCommon_Position3D center;  // SEQUENCE;
        WORD radius;  // INTEGER, 0..4095;
        INT units;  // ENUMERATED, centimeter(0), cm2_5(1), decimeter(2), meter(3), kilometer(4), foot(5), yard(6), mile(7);
    };
    
    struct RoadSafetyMessageBroadRegionArea {
        INT isValidFlag;   // necessary if this struct is used as an optional field of a SEQUENCE
        INT choice;
        struct RoadSafetyMessageRSMPolygon polygon;  // SEQUENCEOF;
        struct RoadSafetyMessageTravelerInformation_Circle circle;  // SEQUENCE;
    };
    
    struct RoadSafetyMessageBroadRegion {
        INT isValidFlag;   // necessary if this struct is used as an optional field of a SEQUENCE
        struct RoadSafetyMessageApplicableHeading applicableHeading;  // SEQUENCE;
        struct RoadSafetyMessageBroadRegionArea broadArea;  // CHOICE;
    };
    
    struct RoadSafetyMessagePathPoints {
        INT isValidFlag;   // necessary if this struct is used as an optional field of a SEQUENCE
        INT length;
        struct RoadSafetyMessageNodePointLLE arrayValue[63];  // CHOICE;
    };
    
    struct RoadSafetyMessagePath {
        INT isValidFlag;   // necessary if this struct is used as an optional field of a SEQUENCE
        WORD pathWidth;  // INTEGER, 0..1000;
        struct RoadSafetyMessagePathPoints pathPoints;  // SEQUENCEOF;
    };
    
    struct RoadSafetyMessagePathList {
        INT isValidFlag;   // necessary if this struct is used as an optional field of a SEQUENCE
        INT length;
        struct RoadSafetyMessagePath arrayValue[10];  // SEQUENCE;
    };
    
    struct RoadSafetyMessageAreaType {
        INT isValidFlag;   // necessary if this struct is used as an optional field of a SEQUENCE
        INT choice;
        struct RoadSafetyMessageBroadRegion broadRegion;  // SEQUENCE;
        struct RoadSafetyMessagePathList paths;  // SEQUENCEOF;
    };
    
    struct RoadSafetyMessageRegionInfo {
        INT isValidFlag;   // necessary if this struct is used as an optional field of a SEQUENCE
        struct RoadSafetyMessageCommon_Position3D referencePoint;  // SEQUENCE;
        struct RoadSafetyMessageRegionUncertainty locationUncertainty;  // CHOICE, OPTIONAL;
        struct OPT_ENUM_ASN referencePointType;  // ENUMERATED, OPTIONAL, startOfEvent(0), arbitrary(1);
        struct RoadSafetyMessageCommon_DescriptiveName descriptiveName;  // IA5STRING, OPTIONAL;
        struct OPT_BYTE_ASN scale;  // INTEGER, OPTIONAL, 0..15;
        struct RoadSafetyMessageAreaType approachRegion;  // CHOICE, OPTIONAL;
    };
    
    struct RoadSafetyMessageCommonContainer_regionInfo {
        INT isValidFlag;   // necessary if this struct is used as an optional field of a SEQUENCE
        INT length;
        struct RoadSafetyMessageRegionInfo arrayValue[4];  // SEQUENCE;
    };
    
    struct RoadSafetyMessageAudioLink_urlChannel {
        INT isValidFlag;   // necessary if this struct is used as an optional field of a SEQUENCE
        CHAR string[501];
        INT  stringLength;
    };
    
    struct RoadSafetyMessageAudioLink {
        INT isValidFlag;   // necessary if this struct is used as an optional field of a SEQUENCE
        struct OPT_WORD_ASN amChannel;  // INTEGER, OPTIONAL, 531..1710;
        struct OPT_DWORD_ASN fmChannel;  // INTEGER, OPTIONAL, 65800..108009;
        struct OPT_WORD_ASN satelliteChannel;  // INTEGER, OPTIONAL, 1..9999;
        struct RoadSafetyMessageAudioLink_urlChannel urlChannel;  // IA5STRING, OPTIONAL;
    };
    
    struct RoadSafetyMessageCrossLinking_audioLinks {
        INT isValidFlag;   // necessary if this struct is used as an optional field of a SEQUENCE
        INT length;
        struct RoadSafetyMessageAudioLink arrayValue[4];  // SEQUENCE;
    };
    
    struct RoadSafetyMessageVisualLink_urlLink {
        INT isValidFlag;   // necessary if this struct is used as an optional field of a SEQUENCE
        CHAR string[501];
        INT  stringLength;
    };
    
    struct RoadSafetyMessageVisualLink {
        INT isValidFlag;   // necessary if this struct is used as an optional field of a SEQUENCE
        struct RoadSafetyMessageVisualLink_urlLink urlLink;  // IA5STRING, OPTIONAL;
    };
    
    struct RoadSafetyMessageCrossLinking_visualLink {
        INT isValidFlag;   // necessary if this struct is used as an optional field of a SEQUENCE
        INT length;
        struct RoadSafetyMessageVisualLink arrayValue[4];  // SEQUENCE;
    };
    
    struct RoadSafetyMessageCrossLinking_rsmLink {
        INT isValidFlag;   // necessary if this struct is used as an optional field of a SEQUENCE
        INT length;
        struct RoadSafetyMessageEventIdentifier arrayValue[4];  // SEQUENCE;
    };
    
    struct RoadSafetyMessageCrossLinking {
        INT isValidFlag;   // necessary if this struct is used as an optional field of a SEQUENCE
        struct RoadSafetyMessageCrossLinking_audioLinks audioLinks;  // SEQUENCEOF, OPTIONAL;
        struct RoadSafetyMessageCrossLinking_visualLink visualLink;  // SEQUENCEOF, OPTIONAL;
        struct RoadSafetyMessageCrossLinking_rsmLink rsmLink;  // SEQUENCEOF, OPTIONAL;
    };
    
    struct RoadSafetyMessageCommonContainer {
        INT isValidFlag;   // necessary if this struct is used as an optional field of a SEQUENCE
        struct RoadSafetyMessageEventInfo eventInfo;  // SEQUENCE;
        struct RoadSafetyMessageCommonContainer_regionInfo regionInfo;  // SEQUENCEOF;
        struct RoadSafetyMessageCrossLinking crossLinking;  // SEQUENCE, OPTIONAL;
    };
    
    struct RoadSafetyMessageCommon_RegulatorySpeedLimit {
        INT isValidFlag;   // necessary if this struct is used as an optional field of a SEQUENCE
        INT type;  // ENUMERATED, unknown(-0), maxSpeedInSchoolZone(1), maxSpeedInSchoolZoneWhenChildrenArePresent(2), maxSpeedInConstructionZone(3), vehicleMinSpeed(4), vehicleMaxSpeed(5), vehicleNightMaxSpeed(6), truckMinSpeed(7), truckMaxSpeed(8), truckNightMaxSpeed(9), vehiclesWithTrailersMinSpeed(10), vehiclesWithTrailersMaxSpeed(11), vehiclesWithTrailersNightMaxSpeed(12);
        WORD speed;  // INTEGER, 0..8191;
    };
    
    struct RoadSafetyMessageReducedSpeedZoneContainer {
        INT isValidFlag;   // necessary if this struct is used as an optional field of a SEQUENCE
        struct RoadSafetyMessageCommon_RegulatorySpeedLimit speedLimit;  // SEQUENCE;
        struct RoadSafetyMessageRegionInfo rszRegion;  // SEQUENCE;
    };
    
    struct RoadSafetyMessageLaneInfo {
        INT isValidFlag;   // necessary if this struct is used as an optional field of a SEQUENCE
        BYTE lanePosition;  // INTEGER, 1..32;
        INT laneClosed;  // BOOLEAN;
        struct OPT_WORD_ASN laneCloseOffset;  // INTEGER, OPTIONAL, 0..32767;
    };
    
    struct RoadSafetyMessageLaneClosureContainer_laneStatus {
        INT isValidFlag;   // necessary if this struct is used as an optional field of a SEQUENCE
        INT length;
        struct RoadSafetyMessageLaneInfo arrayValue[10];  // SEQUENCE;
    };
    
    struct RoadSafetyMessageLaneClosureContainer {
        INT isValidFlag;   // necessary if this struct is used as an optional field of a SEQUENCE
        struct RoadSafetyMessageLaneClosureContainer_laneStatus laneStatus;  // SEQUENCEOF, OPTIONAL;
        struct OPT_BOOL_ASN laneStatusVaries;  // BOOLEAN, OPTIONAL;
        struct RoadSafetyMessageRegionInfo closureRegion;  // SEQUENCE;
    };
    
    struct RoadSafetyMessageCommon_PortlandCement {
        INT isValidFlag;   // necessary if this struct is used as an optional field of a SEQUENCE
        INT type;  // ENUMERATED, newSharp(-0), traveled(1), trafficPolished(2);
    };
    
    struct RoadSafetyMessageCommon_AsphaltOrTar {
        INT isValidFlag;   // necessary if this struct is used as an optional field of a SEQUENCE
        INT type;  // ENUMERATED, newSharp(-0), traveled(1), trafficPolished(2), excessTar(3);
    };
    
    struct RoadSafetyMessageCommon_Gravel {
        INT isValidFlag;   // necessary if this struct is used as an optional field of a SEQUENCE
        INT type;  // ENUMERATED, packedOiled(-0), loose(1);
    };
    
    struct RoadSafetyMessageCommon_Grass {
        INT isValidFlag;   // necessary if this struct is used as an optional field of a SEQUENCE
        INT type;  // ENUMERATED, lessThan30Mph(-0);
    };
    
    struct RoadSafetyMessageCommon_Cinders {
        INT isValidFlag;   // necessary if this struct is used as an optional field of a SEQUENCE
        INT type;  // ENUMERATED, packed(-0);
    };
    
    struct RoadSafetyMessageCommon_Rock {
        INT isValidFlag;   // necessary if this struct is used as an optional field of a SEQUENCE
        INT type;  // ENUMERATED, crushed(-0);
    };
    
    struct RoadSafetyMessageCommon_Ice {
        INT isValidFlag;   // necessary if this struct is used as an optional field of a SEQUENCE
        INT type;  // ENUMERATED, smooth(-0);
    };
    
    struct RoadSafetyMessageCommon_Snow {
        INT isValidFlag;   // necessary if this struct is used as an optional field of a SEQUENCE
        INT type;  // ENUMERATED, packed(-0), loose(1);
    };
    
    struct RoadSafetyMessageCommon_DescriptionOfRoadSurface {
        INT isValidFlag;   // necessary if this struct is used as an optional field of a SEQUENCE
        INT choice;
        struct RoadSafetyMessageCommon_PortlandCement portlandCement;  // SEQUENCE;
        struct RoadSafetyMessageCommon_AsphaltOrTar asphaltOrTar;  // SEQUENCE;
        struct RoadSafetyMessageCommon_Gravel gravel;  // SEQUENCE;
        struct RoadSafetyMessageCommon_Grass grass;  // SEQUENCE;
        struct RoadSafetyMessageCommon_Cinders cinders;  // SEQUENCE;
        struct RoadSafetyMessageCommon_Rock rock;  // SEQUENCE;
        struct RoadSafetyMessageCommon_Ice ice;  // SEQUENCE;
        struct RoadSafetyMessageCommon_Snow snow;  // SEQUENCE;
    };
    
    struct RoadSafetyMessageCommon_RoadRoughness {
        INT isValidFlag;   // necessary if this struct is used as an optional field of a SEQUENCE
        WORD meanVerticalVariation;  // INTEGER, 0..25000;
        struct OPT_WORD_ASN verticalVariationStdDev;  // INTEGER, OPTIONAL, 0..2500;
        struct OPT_WORD_ASN meanHorizontalVariation;  // INTEGER, OPTIONAL, 0..25000;
        struct OPT_WORD_ASN horizontalVariationStdDev;  // INTEGER, OPTIONAL, 0..2500;
    };
    
    struct RoadSafetyMessageCommon_FrictionInformation {
        INT isValidFlag;   // necessary if this struct is used as an optional field of a SEQUENCE
        struct RoadSafetyMessageCommon_DescriptionOfRoadSurface roadSurfaceDescription;  // CHOICE;
        struct OPT_ENUM_ASN dryOrWet;  // ENUMERATED, OPTIONAL, dry(-0), wet(1);
        struct RoadSafetyMessageCommon_RoadRoughness roadRoughness;  // SEQUENCE, OPTIONAL;
    };
    
    struct RoadSafetyMessageCurveContainer {
        INT isValidFlag;   // necessary if this struct is used as an optional field of a SEQUENCE
        WORD advisorySpeed;  // INTEGER, 0..500;
        struct RoadSafetyMessageCommon_FrictionInformation surfaceCondition;  // SEQUENCE, OPTIONAL;
        struct OPT_WORD_ASN minRadius;  // INTEGER, OPTIONAL, 0..65535;
        struct OPT_INT_ASN bankAngle;  // INTEGER, OPTIONAL, -512..512;
        struct RoadSafetyMessageRegionInfo curveRegion;  // SEQUENCE, OPTIONAL;
    };
    
    struct RoadSafetyMessageShortString {
        INT isValidFlag;   // necessary if this struct is used as an optional field of a SEQUENCE
        CHAR string[21];
        INT  stringLength;
    };
    
    struct RoadSafetyMessageDynamicInfoContainer_dmsSignString {
        INT isValidFlag;   // necessary if this struct is used as an optional field of a SEQUENCE
        INT length;
        struct RoadSafetyMessageShortString arrayValue[12];  // IA5STRING;
    };
    
    struct RoadSafetyMessageDynamicInfoContainer {
        INT isValidFlag;   // necessary if this struct is used as an optional field of a SEQUENCE
        INT priority;  // ENUMERATED, low_priority(0), medium_priority(1), high_priority(2), critical(3);
        struct RoadSafetyMessageDynamicInfoContainer_dmsSignString dmsSignString;  // SEQUENCEOF;
        struct RoadSafetyMessageRegionInfo applicableRegion;  // SEQUENCE;
    };
    
    struct RoadSafetyMessageIncidentsContainer_responderType {
        INT isValidFlag;   // necessary if this struct is used as an optional field of a SEQUENCE
        INT length;
        INT arrayValue[5];  // ENUMERATED, emergency_vehicle_units(9729), federal_law_enforcement_units(9730), state_police_units(9731), county_police_units(9732), local_police_units(9733), ambulance_units(9734), rescue_units(9735), fire_units(9736), hAZMAT_units(9737), light_tow_unit(9738), heavy_tow_unit(9739), freeway_service_patrols(9740), transportation_response_units(9741), private_contractor_response_units(9742);
    };
    
    struct RoadSafetyMessageIncidentsContainer {
        INT isValidFlag;   // necessary if this struct is used as an optional field of a SEQUENCE
        struct RoadSafetyMessageIncidentsContainer_responderType responderType;  // SEQUENCEOF, OPTIONAL;
        struct RoadSafetyMessageRegionInfo incidentLocation;  // SEQUENCE;
    };
    
    struct RoadSafetyMessageObstructions {
        INT isValidFlag;   // necessary if this struct is used as an optional field of a SEQUENCE
        struct RoadSafetyMessageCommon_Position3D location;  // SEQUENCE;
        struct OPT_WORD_ASN description;  // INTEGER, OPTIONAL, 0..65535;
    };
    
    struct RoadSafetyMessageSituationalContainer {
        INT isValidFlag;   // necessary if this struct is used as an optional field of a SEQUENCE
        struct RoadSafetyMessageObstructions obstructions;  // SEQUENCE, OPTIONAL;
        struct OPT_DWORD_ASN visibility;  // INTEGER, OPTIONAL, 0..1000001;
        struct OPT_BOOL_ASN peoplePresent;  // BOOLEAN, OPTIONAL;
        struct OPT_BOOL_ASN anomalousTraffic;  // BOOLEAN, OPTIONAL;
        struct RoadSafetyMessageRegionInfo applicableRegion;  // SEQUENCE;
    };
    
    struct RoadSafetyMessageContentContainer {
        INT isValidFlag;   // necessary if this struct is used as an optional field of a SEQUENCE
        INT choice;
        struct RoadSafetyMessageReducedSpeedZoneContainer rszContainer;  // SEQUENCE;
        struct RoadSafetyMessageLaneClosureContainer laneClosureContainer;  // SEQUENCE;
        struct RoadSafetyMessageCurveContainer curveContainer;  // SEQUENCE;
        struct RoadSafetyMessageDynamicInfoContainer dynamicInfoContainer;  // SEQUENCE;
        struct RoadSafetyMessageIncidentsContainer incidentsContainer;  // SEQUENCE;
        struct RoadSafetyMessageSituationalContainer situationalContainer;  // SEQUENCE;
    };
    
    struct RoadSafetyMessageRoadSafetyMessage_content {
        INT isValidFlag;   // necessary if this struct is used as an optional field of a SEQUENCE
        INT length;
        struct RoadSafetyMessageContentContainer arrayValue[4];  // CHOICE;
    };
    
    struct RoadSafetyMessage_RoadSafetyMessage {
        INT isValidFlag;   // necessary if this struct is used as an optional field of a SEQUENCE
        struct RoadSafetyMessageCommonContainer commonContainer;  // SEQUENCE;
        struct RoadSafetyMessageRoadSafetyMessage_content content;  // SEQUENCEOF;
    };
    
    struct RoadSafetyMessageMESSAGE_ID_AND_TYPE {
        struct RoadSafetyMessage_RoadSafetyMessage roadSafetyMessage;  // SEQUENCE;
    };
    
    struct RoadSafetyMessage {
        INT isValidFlag;   // necessary if this struct is used as an optional field of a SEQUENCE
        WORD messageId;  // INTEGER, 0..32767, mapData(18), signalPhaseAndTimingMessage(19), basicSafetyMessage(20), commonSafetyRequest(21), emergencyVehicleAlert(22), intersectionCollision(23), nmeaCorrections(24), probeDataManagement(25), probeVehicleData(26), roadSideAlert(27), rtcmCorrections(28), signalRequestMessage(29), signalStatusMessage(30), travelerInformation(31), personalSafetyMessage(32), roadSafetyMessage(33), roadWeatherMessage(34), probeDataConfigMessage(35), probeDataReportMessage(36), tollAdvertisementMessage(37), tollUsageMessage(38), tollUsageAckMessage(39), cooperativeControlMessage(40), sensorDataSharingMessage(41), maneuverSharingAndCoordinatingMessage(42), roadGeometryAndAttributes(43), personalSafetyMessage2(44), trafficSignalPhaseAndTiming(45), signalControlAndPrioritizationRequest(46), signalControlAndPrioritizationStatus(47), roadUserChargingConfigMessage(48), roadUserChargingReportMessage(49), trafficLightStatusMessage(50);
        struct RoadSafetyMessageMESSAGE_ID_AND_TYPE value;  // TABLE;
    };
    
}

/*
// init function to create a simple packet handle
*/ 
LONG API_InitRoadSafetyMessagePacket()
{
  return C2xInitPacket("RoadSafetyMessage"); 
}

/*
// init function to create a simple packet handle and
// initialize the struct with valid data
*/ 
LONG API_InitRoadSafetyMessagePacket(struct RoadSafetyMessage msgStruct)
{
  long pktHandle;

  pktHandle = API_InitRoadSafetyMessagePacket();

  if (pktHandle != 0)
  {
    // create valid message and application data
    if (C2xCompletePacket(pktHandle) == 0) 
    {
      API_GetRoadSafetyMessageParams(pktHandle, msgStruct);
    }
  }
  return pktHandle;
}

/*
// init function to create a packet with security layer and
// initialize the struct with valid data
*/ 
LONG API_InitRoadSafetyMessagePacket(struct RoadSafetyMessage msgStruct, char packetTypeDesignator[], char certificateName[])
{
  long pktHandle, certHdl;

  // initialize the packet
  pktHandle = C2xInitPacket("RoadSafetyMessage", packetTypeDesignator);

  if (pktHandle != 0)
  {
    certHdl = C2xSecCertificateGetHandle(certificateName);  // get the certificate handle for the cert with name "certificateName"
    if (certHdl != 0) 
    {
      C2xSecPacketSetSignerHandle(pktHandle, certHdl); // set the certHdl to the packet
    }

    // create valid message and application data
    if (C2xCompletePacket(pktHandle) == 0) 
    {
      // copy application data to the application structure
      API_GetRoadSafetyMessageParams(pktHandle, msgStruct);
    }
  }
  return pktHandle;
}
    

int GetRoadSafetyMessageCommon_RoadAuthorityIDParams(LONG packetHandle, struct RoadSafetyMessageCommon_RoadAuthorityID value, char oldPath[])
{
  char newPath[300];
  int i;
  int result;

  result = 0;

  value.choice = C2xGetTokenInt(packetHandle, "RoadSafetyMessage", oldPath);

  switch(value.choice)
  {
    case 0:
    {
      snprintf(newPath, elcount(newPath), "%s.%s", oldPath, "fullRdAuthID");
      value.fullRdAuthID.length = C2xGetTokenInt(packetHandle, "RoadSafetyMessage", newPath);
      if((result = CheckLastError("RoadSafetyMessage", gkFuncRefGet, result))==0)
      {
        if(value.fullRdAuthID.length > 0)
        {
          for(i=0; i<value.fullRdAuthID.length; i++)
          {
            value.fullRdAuthID.arrayValue[i].id = C2xGetTokenOidElement(packetHandle, "RoadSafetyMessage", newPath, i);
          }
        }
      }
    }
    break;
    case 1:
    {
      snprintf(newPath, elcount(newPath), "%s.%s", oldPath, "relRdAuthID");
      value.relRdAuthID.length = C2xGetTokenInt(packetHandle, "RoadSafetyMessage", newPath);
      if((result = CheckLastError("RoadSafetyMessage", gkFuncRefGet, result))==0)
      {
        if(value.relRdAuthID.length > 0)
        {
          for(i=0; i<value.relRdAuthID.length; i++)
          {
            value.relRdAuthID.arrayValue[i].id = C2xGetTokenOidElement(packetHandle, "RoadSafetyMessage", newPath, i);
          }
        }
      }
    }
    break;
  }
  return result;
}

int SetRoadSafetyMessageCommon_RoadAuthorityIDParams(LONG packetHandle, struct RoadSafetyMessageCommon_RoadAuthorityID value, char oldPath[])
{
  char newPath[300];
  int i;
  int result;

  result = 0;

  switch(value.choice)
  {
    case 0:
    {
      snprintf(newPath, elcount(newPath), "%s.%s", oldPath, "fullRdAuthID");
      C2xRemoveToken(packetHandle, "RoadSafetyMessage", newPath);
      if(value.fullRdAuthID.length > 0)
      {
        for(i=0; i<value.fullRdAuthID.length; i++)
        {
          C2xSetTokenOidElement(packetHandle, "RoadSafetyMessage", newPath, i, value.fullRdAuthID.arrayValue[i].id);
        }
      }
      result = CheckLastError("RoadSafetyMessage", gkFuncRefGet, result);
    }
    break;
    case 1:
    {
      snprintf(newPath, elcount(newPath), "%s.%s", oldPath, "relRdAuthID");
      C2xRemoveToken(packetHandle, "RoadSafetyMessage", newPath);
      if(value.relRdAuthID.length > 0)
      {
        for(i=0; i<value.relRdAuthID.length; i++)
        {
          C2xSetTokenOidElement(packetHandle, "RoadSafetyMessage", newPath, i, value.relRdAuthID.arrayValue[i].id);
        }
      }
      result = CheckLastError("RoadSafetyMessage", gkFuncRefGet, result);
    }
    break;
  }
  return result;
}

int GetRoadSafetyMessageEventIdentifierParams(LONG packetHandle, struct RoadSafetyMessageEventIdentifier value, char oldPath[])
{
  char newPath[300];
  int result;

  result = 0;

  snprintf(newPath, elcount(newPath), "%s.%s", oldPath, "operatorID");
  GetRoadSafetyMessageCommon_RoadAuthorityIDParams(packetHandle, value.operatorID, newPath);
  result = CheckLastError("RoadSafetyMessage", gkFuncRefGet, result);

  snprintf(newPath, elcount(newPath), "%s.%s", oldPath, "uniqueID");
  value.uniqueID.stringLength = C2xGetTokenData(packetHandle, "RoadSafetyMessage", newPath, elcount(value.uniqueID.string), value.uniqueID.string);
  return result;
}

int SetRoadSafetyMessageEventIdentifierParams(LONG packetHandle, struct RoadSafetyMessageEventIdentifier value, char oldPath[])
{
  char newPath[300];
  int result;

  result = 0;

  snprintf(newPath, elcount(newPath), "%s.%s", oldPath, "operatorID");
  SetRoadSafetyMessageCommon_RoadAuthorityIDParams(packetHandle, value.operatorID, newPath);
  result = CheckLastError("RoadSafetyMessage", gkFuncRefGet, result);

  snprintf(newPath, elcount(newPath), "%s.%s", oldPath, "uniqueID");
  C2xSetTokenData(packetHandle, "RoadSafetyMessage", newPath, value.uniqueID.stringLength, value.uniqueID.string);

  return result;
}

int GetRoadSafetyMessageCommon_DDateTimeParams(LONG packetHandle, struct RoadSafetyMessageCommon_DDateTime value, char oldPath[])
{
  char newPath[300];
  int result;

  result = 0;

  snprintf(newPath, elcount(newPath), "%s.%s", oldPath, "year");
  value.year.isValidFlag = C2xIsTokenAvailable(packetHandle, "RoadSafetyMessage", newPath);
  if(value.year.isValidFlag==1)
  {
    value.year.value = C2xGetTokenInt(packetHandle, "RoadSafetyMessage", newPath);
    result = CheckLastError("RoadSafetyMessage", gkFuncRefGet, result);
  }
  snprintf(newPath, elcount(newPath), "%s.%s", oldPath, "month");
  value.month.isValidFlag = C2xIsTokenAvailable(packetHandle, "RoadSafetyMessage", newPath);
  if(value.month.isValidFlag==1)
  {
    value.month.value = C2xGetTokenInt(packetHandle, "RoadSafetyMessage", newPath);
    result = CheckLastError("RoadSafetyMessage", gkFuncRefGet, result);
  }
  snprintf(newPath, elcount(newPath), "%s.%s", oldPath, "day");
  value.day.isValidFlag = C2xIsTokenAvailable(packetHandle, "RoadSafetyMessage", newPath);
  if(value.day.isValidFlag==1)
  {
    value.day.value = C2xGetTokenInt(packetHandle, "RoadSafetyMessage", newPath);
    result = CheckLastError("RoadSafetyMessage", gkFuncRefGet, result);
  }
  snprintf(newPath, elcount(newPath), "%s.%s", oldPath, "hour");
  value.hour.isValidFlag = C2xIsTokenAvailable(packetHandle, "RoadSafetyMessage", newPath);
  if(value.hour.isValidFlag==1)
  {
    value.hour.value = C2xGetTokenInt(packetHandle, "RoadSafetyMessage", newPath);
    result = CheckLastError("RoadSafetyMessage", gkFuncRefGet, result);
  }
  snprintf(newPath, elcount(newPath), "%s.%s", oldPath, "minute");
  value.minute.isValidFlag = C2xIsTokenAvailable(packetHandle, "RoadSafetyMessage", newPath);
  if(value.minute.isValidFlag==1)
  {
    value.minute.value = C2xGetTokenInt(packetHandle, "RoadSafetyMessage", newPath);
    result = CheckLastError("RoadSafetyMessage", gkFuncRefGet, result);
  }
  snprintf(newPath, elcount(newPath), "%s.%s", oldPath, "second");
  value.second.isValidFlag = C2xIsTokenAvailable(packetHandle, "RoadSafetyMessage", newPath);
  if(value.second.isValidFlag==1)
  {
    value.second.value = C2xGetTokenInt(packetHandle, "RoadSafetyMessage", newPath);
    result = CheckLastError("RoadSafetyMessage", gkFuncRefGet, result);
  }
  snprintf(newPath, elcount(newPath), "%s.%s", oldPath, "offset");
  value.offset.isValidFlag = C2xIsTokenAvailable(packetHandle, "RoadSafetyMessage", newPath);
  if(value.offset.isValidFlag==1)
  {
    value.offset.value = C2xGetTokenInt(packetHandle, "RoadSafetyMessage", newPath);
    result = CheckLastError("RoadSafetyMessage", gkFuncRefGet, result);
  }
  return result;
}

int SetRoadSafetyMessageCommon_DDateTimeParams(LONG packetHandle, struct RoadSafetyMessageCommon_DDateTime value, char oldPath[])
{
  char newPath[300];
  int result;

  result = 0;

  snprintf(newPath, elcount(newPath), "%s.%s", oldPath, "year");
  if(value.year.isValidFlag==1)
  {
    C2xSetTokenInt(packetHandle, "RoadSafetyMessage", newPath, value.year.value);
    result = CheckLastError("RoadSafetyMessage", gkFuncRefGet, result);
  }
  else
  {
    if( C2xIsTokenAvailable(packetHandle, "RoadSafetyMessage", newPath) )
    {
      C2xRemoveToken(packetHandle, "RoadSafetyMessage", newPath);
    }
  }

  snprintf(newPath, elcount(newPath), "%s.%s", oldPath, "month");
  if(value.month.isValidFlag==1)
  {
    C2xSetTokenInt(packetHandle, "RoadSafetyMessage", newPath, value.month.value);
    result = CheckLastError("RoadSafetyMessage", gkFuncRefGet, result);
  }
  else
  {
    if( C2xIsTokenAvailable(packetHandle, "RoadSafetyMessage", newPath) )
    {
      C2xRemoveToken(packetHandle, "RoadSafetyMessage", newPath);
    }
  }

  snprintf(newPath, elcount(newPath), "%s.%s", oldPath, "day");
  if(value.day.isValidFlag==1)
  {
    C2xSetTokenInt(packetHandle, "RoadSafetyMessage", newPath, value.day.value);
    result = CheckLastError("RoadSafetyMessage", gkFuncRefGet, result);
  }
  else
  {
    if( C2xIsTokenAvailable(packetHandle, "RoadSafetyMessage", newPath) )
    {
      C2xRemoveToken(packetHandle, "RoadSafetyMessage", newPath);
    }
  }

  snprintf(newPath, elcount(newPath), "%s.%s", oldPath, "hour");
  if(value.hour.isValidFlag==1)
  {
    C2xSetTokenInt(packetHandle, "RoadSafetyMessage", newPath, value.hour.value);
    result = CheckLastError("RoadSafetyMessage", gkFuncRefGet, result);
  }
  else
  {
    if( C2xIsTokenAvailable(packetHandle, "RoadSafetyMessage", newPath) )
    {
      C2xRemoveToken(packetHandle, "RoadSafetyMessage", newPath);
    }
  }

  snprintf(newPath, elcount(newPath), "%s.%s", oldPath, "minute");
  if(value.minute.isValidFlag==1)
  {
    C2xSetTokenInt(packetHandle, "RoadSafetyMessage", newPath, value.minute.value);
    result = CheckLastError("RoadSafetyMessage", gkFuncRefGet, result);
  }
  else
  {
    if( C2xIsTokenAvailable(packetHandle, "RoadSafetyMessage", newPath) )
    {
      C2xRemoveToken(packetHandle, "RoadSafetyMessage", newPath);
    }
  }

  snprintf(newPath, elcount(newPath), "%s.%s", oldPath, "second");
  if(value.second.isValidFlag==1)
  {
    C2xSetTokenInt(packetHandle, "RoadSafetyMessage", newPath, value.second.value);
    result = CheckLastError("RoadSafetyMessage", gkFuncRefGet, result);
  }
  else
  {
    if( C2xIsTokenAvailable(packetHandle, "RoadSafetyMessage", newPath) )
    {
      C2xRemoveToken(packetHandle, "RoadSafetyMessage", newPath);
    }
  }

  snprintf(newPath, elcount(newPath), "%s.%s", oldPath, "offset");
  if(value.offset.isValidFlag==1)
  {
    C2xSetTokenInt(packetHandle, "RoadSafetyMessage", newPath, value.offset.value);
    result = CheckLastError("RoadSafetyMessage", gkFuncRefGet, result);
  }
  else
  {
    if( C2xIsTokenAvailable(packetHandle, "RoadSafetyMessage", newPath) )
    {
      C2xRemoveToken(packetHandle, "RoadSafetyMessage", newPath);
    }
  }

  return result;
}

int GetRoadSafetyMessageCommon_DTimeParams(LONG packetHandle, struct RoadSafetyMessageCommon_DTime value, char oldPath[])
{
  char newPath[300];
  int result;

  result = 0;

  snprintf(newPath, elcount(newPath), "%s.%s", oldPath, "hour");
  value.hour = C2xGetTokenInt(packetHandle, "RoadSafetyMessage", newPath);
  result = CheckLastError("RoadSafetyMessage", gkFuncRefGet, result);

  snprintf(newPath, elcount(newPath), "%s.%s", oldPath, "minute");
  value.minute = C2xGetTokenInt(packetHandle, "RoadSafetyMessage", newPath);
  result = CheckLastError("RoadSafetyMessage", gkFuncRefGet, result);

  snprintf(newPath, elcount(newPath), "%s.%s", oldPath, "second");
  value.second = C2xGetTokenInt(packetHandle, "RoadSafetyMessage", newPath);
  result = CheckLastError("RoadSafetyMessage", gkFuncRefGet, result);

  snprintf(newPath, elcount(newPath), "%s.%s", oldPath, "offset");
  value.offset.isValidFlag = C2xIsTokenAvailable(packetHandle, "RoadSafetyMessage", newPath);
  if(value.offset.isValidFlag==1)
  {
    value.offset.value = C2xGetTokenInt(packetHandle, "RoadSafetyMessage", newPath);
    result = CheckLastError("RoadSafetyMessage", gkFuncRefGet, result);
  }
  return result;
}

int SetRoadSafetyMessageCommon_DTimeParams(LONG packetHandle, struct RoadSafetyMessageCommon_DTime value, char oldPath[])
{
  char newPath[300];
  int result;

  result = 0;

  snprintf(newPath, elcount(newPath), "%s.%s", oldPath, "hour");
  C2xSetTokenInt(packetHandle, "RoadSafetyMessage", newPath, value.hour);
  result = CheckLastError("RoadSafetyMessage", gkFuncRefGet, result);

  snprintf(newPath, elcount(newPath), "%s.%s", oldPath, "minute");
  C2xSetTokenInt(packetHandle, "RoadSafetyMessage", newPath, value.minute);
  result = CheckLastError("RoadSafetyMessage", gkFuncRefGet, result);

  snprintf(newPath, elcount(newPath), "%s.%s", oldPath, "second");
  C2xSetTokenInt(packetHandle, "RoadSafetyMessage", newPath, value.second);
  result = CheckLastError("RoadSafetyMessage", gkFuncRefGet, result);

  snprintf(newPath, elcount(newPath), "%s.%s", oldPath, "offset");
  if(value.offset.isValidFlag==1)
  {
    C2xSetTokenInt(packetHandle, "RoadSafetyMessage", newPath, value.offset.value);
    result = CheckLastError("RoadSafetyMessage", gkFuncRefGet, result);
  }
  else
  {
    if( C2xIsTokenAvailable(packetHandle, "RoadSafetyMessage", newPath) )
    {
      C2xRemoveToken(packetHandle, "RoadSafetyMessage", newPath);
    }
  }

  return result;
}

int GetRoadSafetyMessageCommon_DDateParams(LONG packetHandle, struct RoadSafetyMessageCommon_DDate value, char oldPath[])
{
  char newPath[300];
  int result;

  result = 0;

  snprintf(newPath, elcount(newPath), "%s.%s", oldPath, "year");
  value.year = C2xGetTokenInt(packetHandle, "RoadSafetyMessage", newPath);
  result = CheckLastError("RoadSafetyMessage", gkFuncRefGet, result);

  snprintf(newPath, elcount(newPath), "%s.%s", oldPath, "month");
  value.month = C2xGetTokenInt(packetHandle, "RoadSafetyMessage", newPath);
  result = CheckLastError("RoadSafetyMessage", gkFuncRefGet, result);

  snprintf(newPath, elcount(newPath), "%s.%s", oldPath, "day");
  value.day = C2xGetTokenInt(packetHandle, "RoadSafetyMessage", newPath);
  result = CheckLastError("RoadSafetyMessage", gkFuncRefGet, result);

  return result;
}

int SetRoadSafetyMessageCommon_DDateParams(LONG packetHandle, struct RoadSafetyMessageCommon_DDate value, char oldPath[])
{
  char newPath[300];
  int result;

  result = 0;

  snprintf(newPath, elcount(newPath), "%s.%s", oldPath, "year");
  C2xSetTokenInt(packetHandle, "RoadSafetyMessage", newPath, value.year);
  result = CheckLastError("RoadSafetyMessage", gkFuncRefGet, result);

  snprintf(newPath, elcount(newPath), "%s.%s", oldPath, "month");
  C2xSetTokenInt(packetHandle, "RoadSafetyMessage", newPath, value.month);
  result = CheckLastError("RoadSafetyMessage", gkFuncRefGet, result);

  snprintf(newPath, elcount(newPath), "%s.%s", oldPath, "day");
  C2xSetTokenInt(packetHandle, "RoadSafetyMessage", newPath, value.day);
  result = CheckLastError("RoadSafetyMessage", gkFuncRefGet, result);

  return result;
}

int GetRoadSafetyMessageEventRecurrenceParams(LONG packetHandle, struct RoadSafetyMessageEventRecurrence value, char oldPath[])
{
  char newPath[300];
  int result;

  result = 0;

  snprintf(newPath, elcount(newPath), "%s.%s", oldPath, "startTime");
  value.startTime.isValidFlag = C2xIsTokenAvailable(packetHandle, "RoadSafetyMessage", newPath);
  if(value.startTime.isValidFlag==1)
  {
    GetRoadSafetyMessageCommon_DTimeParams(packetHandle, value.startTime, newPath);
    result = CheckLastError("RoadSafetyMessage", gkFuncRefGet, result);
  }
  snprintf(newPath, elcount(newPath), "%s.%s", oldPath, "endTime");
  value.endTime.isValidFlag = C2xIsTokenAvailable(packetHandle, "RoadSafetyMessage", newPath);
  if(value.endTime.isValidFlag==1)
  {
    GetRoadSafetyMessageCommon_DTimeParams(packetHandle, value.endTime, newPath);
    result = CheckLastError("RoadSafetyMessage", gkFuncRefGet, result);
  }
  snprintf(newPath, elcount(newPath), "%s.%s", oldPath, "startDate");
  value.startDate.isValidFlag = C2xIsTokenAvailable(packetHandle, "RoadSafetyMessage", newPath);
  if(value.startDate.isValidFlag==1)
  {
    GetRoadSafetyMessageCommon_DDateParams(packetHandle, value.startDate, newPath);
    result = CheckLastError("RoadSafetyMessage", gkFuncRefGet, result);
  }
  snprintf(newPath, elcount(newPath), "%s.%s", oldPath, "endDate");
  value.endDate.isValidFlag = C2xIsTokenAvailable(packetHandle, "RoadSafetyMessage", newPath);
  if(value.endDate.isValidFlag==1)
  {
    GetRoadSafetyMessageCommon_DDateParams(packetHandle, value.endDate, newPath);
    result = CheckLastError("RoadSafetyMessage", gkFuncRefGet, result);
  }
  snprintf(newPath, elcount(newPath), "%s.%s", oldPath, "monday");
  value.monday = C2xGetTokenInt64(packetHandle, "RoadSafetyMessage", newPath);
  result = CheckLastError("RoadSafetyMessage", gkFuncRefGet, result);

  snprintf(newPath, elcount(newPath), "%s.%s", oldPath, "tuesday");
  value.tuesday = C2xGetTokenInt64(packetHandle, "RoadSafetyMessage", newPath);
  result = CheckLastError("RoadSafetyMessage", gkFuncRefGet, result);

  snprintf(newPath, elcount(newPath), "%s.%s", oldPath, "wednesday");
  value.wednesday = C2xGetTokenInt64(packetHandle, "RoadSafetyMessage", newPath);
  result = CheckLastError("RoadSafetyMessage", gkFuncRefGet, result);

  snprintf(newPath, elcount(newPath), "%s.%s", oldPath, "thursday");
  value.thursday = C2xGetTokenInt64(packetHandle, "RoadSafetyMessage", newPath);
  result = CheckLastError("RoadSafetyMessage", gkFuncRefGet, result);

  snprintf(newPath, elcount(newPath), "%s.%s", oldPath, "friday");
  value.friday = C2xGetTokenInt64(packetHandle, "RoadSafetyMessage", newPath);
  result = CheckLastError("RoadSafetyMessage", gkFuncRefGet, result);

  snprintf(newPath, elcount(newPath), "%s.%s", oldPath, "saturday");
  value.saturday = C2xGetTokenInt64(packetHandle, "RoadSafetyMessage", newPath);
  result = CheckLastError("RoadSafetyMessage", gkFuncRefGet, result);

  snprintf(newPath, elcount(newPath), "%s.%s", oldPath, "sunday");
  value.sunday = C2xGetTokenInt64(packetHandle, "RoadSafetyMessage", newPath);
  result = CheckLastError("RoadSafetyMessage", gkFuncRefGet, result);

  snprintf(newPath, elcount(newPath), "%s.%s", oldPath, "exclusion");
  value.exclusion.isValidFlag = C2xIsTokenAvailable(packetHandle, "RoadSafetyMessage", newPath);
  if(value.exclusion.isValidFlag==1)
  {
    value.exclusion.value = C2xGetTokenInt64(packetHandle, "RoadSafetyMessage", newPath);
    result = CheckLastError("RoadSafetyMessage", gkFuncRefGet, result);
  }
  return result;
}

int SetRoadSafetyMessageEventRecurrenceParams(LONG packetHandle, struct RoadSafetyMessageEventRecurrence value, char oldPath[])
{
  char newPath[300];
  int result;

  result = 0;

  snprintf(newPath, elcount(newPath), "%s.%s", oldPath, "startTime");
  if(value.startTime.isValidFlag==1)
  {
    SetRoadSafetyMessageCommon_DTimeParams(packetHandle, value.startTime, newPath);
    result = CheckLastError("RoadSafetyMessage", gkFuncRefGet, result);
  }
  else
  {
    if( C2xIsTokenAvailable(packetHandle, "RoadSafetyMessage", newPath) )
    {
      C2xRemoveToken(packetHandle, "RoadSafetyMessage", newPath);
    }
  }

  snprintf(newPath, elcount(newPath), "%s.%s", oldPath, "endTime");
  if(value.endTime.isValidFlag==1)
  {
    SetRoadSafetyMessageCommon_DTimeParams(packetHandle, value.endTime, newPath);
    result = CheckLastError("RoadSafetyMessage", gkFuncRefGet, result);
  }
  else
  {
    if( C2xIsTokenAvailable(packetHandle, "RoadSafetyMessage", newPath) )
    {
      C2xRemoveToken(packetHandle, "RoadSafetyMessage", newPath);
    }
  }

  snprintf(newPath, elcount(newPath), "%s.%s", oldPath, "startDate");
  if(value.startDate.isValidFlag==1)
  {
    SetRoadSafetyMessageCommon_DDateParams(packetHandle, value.startDate, newPath);
    result = CheckLastError("RoadSafetyMessage", gkFuncRefGet, result);
  }
  else
  {
    if( C2xIsTokenAvailable(packetHandle, "RoadSafetyMessage", newPath) )
    {
      C2xRemoveToken(packetHandle, "RoadSafetyMessage", newPath);
    }
  }

  snprintf(newPath, elcount(newPath), "%s.%s", oldPath, "endDate");
  if(value.endDate.isValidFlag==1)
  {
    SetRoadSafetyMessageCommon_DDateParams(packetHandle, value.endDate, newPath);
    result = CheckLastError("RoadSafetyMessage", gkFuncRefGet, result);
  }
  else
  {
    if( C2xIsTokenAvailable(packetHandle, "RoadSafetyMessage", newPath) )
    {
      C2xRemoveToken(packetHandle, "RoadSafetyMessage", newPath);
    }
  }

  snprintf(newPath, elcount(newPath), "%s.%s", oldPath, "monday");
  C2xSetTokenInt64(packetHandle, "RoadSafetyMessage", newPath, value.monday);
  result = CheckLastError("RoadSafetyMessage", gkFuncRefGet, result);

  snprintf(newPath, elcount(newPath), "%s.%s", oldPath, "tuesday");
  C2xSetTokenInt64(packetHandle, "RoadSafetyMessage", newPath, value.tuesday);
  result = CheckLastError("RoadSafetyMessage", gkFuncRefGet, result);

  snprintf(newPath, elcount(newPath), "%s.%s", oldPath, "wednesday");
  C2xSetTokenInt64(packetHandle, "RoadSafetyMessage", newPath, value.wednesday);
  result = CheckLastError("RoadSafetyMessage", gkFuncRefGet, result);

  snprintf(newPath, elcount(newPath), "%s.%s", oldPath, "thursday");
  C2xSetTokenInt64(packetHandle, "RoadSafetyMessage", newPath, value.thursday);
  result = CheckLastError("RoadSafetyMessage", gkFuncRefGet, result);

  snprintf(newPath, elcount(newPath), "%s.%s", oldPath, "friday");
  C2xSetTokenInt64(packetHandle, "RoadSafetyMessage", newPath, value.friday);
  result = CheckLastError("RoadSafetyMessage", gkFuncRefGet, result);

  snprintf(newPath, elcount(newPath), "%s.%s", oldPath, "saturday");
  C2xSetTokenInt64(packetHandle, "RoadSafetyMessage", newPath, value.saturday);
  result = CheckLastError("RoadSafetyMessage", gkFuncRefGet, result);

  snprintf(newPath, elcount(newPath), "%s.%s", oldPath, "sunday");
  C2xSetTokenInt64(packetHandle, "RoadSafetyMessage", newPath, value.sunday);
  result = CheckLastError("RoadSafetyMessage", gkFuncRefGet, result);

  snprintf(newPath, elcount(newPath), "%s.%s", oldPath, "exclusion");
  if(value.exclusion.isValidFlag==1)
  {
    C2xSetTokenInt64(packetHandle, "RoadSafetyMessage", newPath, value.exclusion.value);
    result = CheckLastError("RoadSafetyMessage", gkFuncRefGet, result);
  }
  else
  {
    if( C2xIsTokenAvailable(packetHandle, "RoadSafetyMessage", newPath) )
    {
      C2xRemoveToken(packetHandle, "RoadSafetyMessage", newPath);
    }
  }

  return result;
}

int GetRoadSafetyMessageEventInfo_eventRecurrenceParams(LONG packetHandle, struct RoadSafetyMessageEventInfo_eventRecurrence value, char oldPath[])
{
  char newPath[300]; 
  int i;
  int result;

  result = 0;

  value.length = C2xGetTokenInt(packetHandle, "RoadSafetyMessage", oldPath);
  if((result = CheckLastError("RoadSafetyMessage", gkFuncRefGet, result))==0)
  {
    for(i=0; i<value.length; i++)
    {
      snprintf(newPath, elcount(newPath), "%s[%d]", oldPath, i);
      GetRoadSafetyMessageEventRecurrenceParams(packetHandle, value.arrayValue[i], newPath);
      result = CheckLastError("RoadSafetyMessage", gkFuncRefGet, result);
    }
  }
  return result;
}

int SetRoadSafetyMessageEventInfo_eventRecurrenceParams(LONG packetHandle, struct RoadSafetyMessageEventInfo_eventRecurrence value, char oldPath[])
{
  char newPath[300]; 
  int i;
  int result;

  result = 0;

  C2xRemoveToken(packetHandle, "RoadSafetyMessage", oldPath);
  for(i=0; i<value.length; i++)
  {
    snprintf(newPath, elcount(newPath), "%s[%d]", oldPath, i);
    SetRoadSafetyMessageEventRecurrenceParams(packetHandle, value.arrayValue[i], newPath);
    result = CheckLastError("RoadSafetyMessage", gkFuncRefGet, result);
  }
  return result;
}

int GetRoadSafetyMessageEventInfo_affectedVehiclesParams(LONG packetHandle, struct RoadSafetyMessageEventInfo_affectedVehicles value, char oldPath[])
{
  char newPath[300]; 
  int i;
  int result;

  result = 0;

  value.length = C2xGetTokenInt(packetHandle, "RoadSafetyMessage", oldPath);
  if((result = CheckLastError("RoadSafetyMessage", gkFuncRefGet, result))==0)
  {
    for(i=0; i<value.length; i++)
    {
      snprintf(newPath, elcount(newPath), "%s[%d]", oldPath, i);
      value.arrayValue[i] = C2xGetTokenInt64(packetHandle, "RoadSafetyMessage", newPath);
      result = CheckLastError("RoadSafetyMessage", gkFuncRefGet, result);
    }
  }
  return result;
}

int SetRoadSafetyMessageEventInfo_affectedVehiclesParams(LONG packetHandle, struct RoadSafetyMessageEventInfo_affectedVehicles value, char oldPath[])
{
  char newPath[300]; 
  int i;
  int result;

  result = 0;

  C2xRemoveToken(packetHandle, "RoadSafetyMessage", oldPath);
  for(i=0; i<value.length; i++)
  {
    snprintf(newPath, elcount(newPath), "%s[%d]", oldPath, i);
    C2xSetTokenInt64(packetHandle, "RoadSafetyMessage", newPath, value.arrayValue[i]);
    result = CheckLastError("RoadSafetyMessage", gkFuncRefGet, result);
  }
  return result;
}

int GetRoadSafetyMessageEventInfoParams(LONG packetHandle, struct RoadSafetyMessageEventInfo value, char oldPath[])
{
  char newPath[300];
  int result;

  result = 0;

  snprintf(newPath, elcount(newPath), "%s.%s", oldPath, "eventID");
  GetRoadSafetyMessageEventIdentifierParams(packetHandle, value.eventID, newPath);
  result = CheckLastError("RoadSafetyMessage", gkFuncRefGet, result);

  snprintf(newPath, elcount(newPath), "%s.%s", oldPath, "eventUpdate");
  value.eventUpdate = C2xGetTokenInt(packetHandle, "RoadSafetyMessage", newPath);
  result = CheckLastError("RoadSafetyMessage", gkFuncRefGet, result);

  snprintf(newPath, elcount(newPath), "%s.%s", oldPath, "eventCancellation");
  value.eventCancellation = C2xGetTokenInt64(packetHandle, "RoadSafetyMessage", newPath);
  result = CheckLastError("RoadSafetyMessage", gkFuncRefGet, result);

  snprintf(newPath, elcount(newPath), "%s.%s", oldPath, "startDateTime");
  GetRoadSafetyMessageCommon_DDateTimeParams(packetHandle, value.startDateTime, newPath);
  result = CheckLastError("RoadSafetyMessage", gkFuncRefGet, result);

  snprintf(newPath, elcount(newPath), "%s.%s", oldPath, "endDateTime");
  value.endDateTime.isValidFlag = C2xIsTokenAvailable(packetHandle, "RoadSafetyMessage", newPath);
  if(value.endDateTime.isValidFlag==1)
  {
    GetRoadSafetyMessageCommon_DDateTimeParams(packetHandle, value.endDateTime, newPath);
    result = CheckLastError("RoadSafetyMessage", gkFuncRefGet, result);
  }
  snprintf(newPath, elcount(newPath), "%s.%s", oldPath, "eventRecurrence");
  value.eventRecurrence.isValidFlag = C2xIsTokenAvailable(packetHandle, "RoadSafetyMessage", newPath);
  if(value.eventRecurrence.isValidFlag==1)
  {
    GetRoadSafetyMessageEventInfo_eventRecurrenceParams(packetHandle, value.eventRecurrence, newPath);
    result = CheckLastError("RoadSafetyMessage", gkFuncRefGet, result);
  }
  snprintf(newPath, elcount(newPath), "%s.%s", oldPath, "causeCode");
  value.causeCode = C2xGetTokenInt(packetHandle, "RoadSafetyMessage", newPath);
  result = CheckLastError("RoadSafetyMessage", gkFuncRefGet, result);

  snprintf(newPath, elcount(newPath), "%s.%s", oldPath, "subCauseCode");
  value.subCauseCode.isValidFlag = C2xIsTokenAvailable(packetHandle, "RoadSafetyMessage", newPath);
  if(value.subCauseCode.isValidFlag==1)
  {
    value.subCauseCode.value = C2xGetTokenInt(packetHandle, "RoadSafetyMessage", newPath);
    result = CheckLastError("RoadSafetyMessage", gkFuncRefGet, result);
  }
  snprintf(newPath, elcount(newPath), "%s.%s", oldPath, "affectedVehicles");
  value.affectedVehicles.isValidFlag = C2xIsTokenAvailable(packetHandle, "RoadSafetyMessage", newPath);
  if(value.affectedVehicles.isValidFlag==1)
  {
    GetRoadSafetyMessageEventInfo_affectedVehiclesParams(packetHandle, value.affectedVehicles, newPath);
    result = CheckLastError("RoadSafetyMessage", gkFuncRefGet, result);
  }
  return result;
}

int SetRoadSafetyMessageEventInfoParams(LONG packetHandle, struct RoadSafetyMessageEventInfo value, char oldPath[])
{
  char newPath[300];
  int result;

  result = 0;

  snprintf(newPath, elcount(newPath), "%s.%s", oldPath, "eventID");
  SetRoadSafetyMessageEventIdentifierParams(packetHandle, value.eventID, newPath);
  result = CheckLastError("RoadSafetyMessage", gkFuncRefGet, result);

  snprintf(newPath, elcount(newPath), "%s.%s", oldPath, "eventUpdate");
  C2xSetTokenInt(packetHandle, "RoadSafetyMessage", newPath, value.eventUpdate);
  result = CheckLastError("RoadSafetyMessage", gkFuncRefGet, result);

  snprintf(newPath, elcount(newPath), "%s.%s", oldPath, "eventCancellation");
  C2xSetTokenInt64(packetHandle, "RoadSafetyMessage", newPath, value.eventCancellation);
  result = CheckLastError("RoadSafetyMessage", gkFuncRefGet, result);

  snprintf(newPath, elcount(newPath), "%s.%s", oldPath, "startDateTime");
  SetRoadSafetyMessageCommon_DDateTimeParams(packetHandle, value.startDateTime, newPath);
  result = CheckLastError("RoadSafetyMessage", gkFuncRefGet, result);

  snprintf(newPath, elcount(newPath), "%s.%s", oldPath, "endDateTime");
  if(value.endDateTime.isValidFlag==1)
  {
    SetRoadSafetyMessageCommon_DDateTimeParams(packetHandle, value.endDateTime, newPath);
    result = CheckLastError("RoadSafetyMessage", gkFuncRefGet, result);
  }
  else
  {
    if( C2xIsTokenAvailable(packetHandle, "RoadSafetyMessage", newPath) )
    {
      C2xRemoveToken(packetHandle, "RoadSafetyMessage", newPath);
    }
  }

  snprintf(newPath, elcount(newPath), "%s.%s", oldPath, "eventRecurrence");
  if(value.eventRecurrence.isValidFlag==1)
  {
    SetRoadSafetyMessageEventInfo_eventRecurrenceParams(packetHandle, value.eventRecurrence, newPath);
    result = CheckLastError("RoadSafetyMessage", gkFuncRefGet, result);
  }
  else
  {
    if( C2xIsTokenAvailable(packetHandle, "RoadSafetyMessage", newPath) )
    {
      C2xRemoveToken(packetHandle, "RoadSafetyMessage", newPath);
    }
  }

  snprintf(newPath, elcount(newPath), "%s.%s", oldPath, "causeCode");
  C2xSetTokenInt(packetHandle, "RoadSafetyMessage", newPath, value.causeCode);
  result = CheckLastError("RoadSafetyMessage", gkFuncRefGet, result);

  snprintf(newPath, elcount(newPath), "%s.%s", oldPath, "subCauseCode");
  if(value.subCauseCode.isValidFlag==1)
  {
    C2xSetTokenInt(packetHandle, "RoadSafetyMessage", newPath, value.subCauseCode.value);
    result = CheckLastError("RoadSafetyMessage", gkFuncRefGet, result);
  }
  else
  {
    if( C2xIsTokenAvailable(packetHandle, "RoadSafetyMessage", newPath) )
    {
      C2xRemoveToken(packetHandle, "RoadSafetyMessage", newPath);
    }
  }

  snprintf(newPath, elcount(newPath), "%s.%s", oldPath, "affectedVehicles");
  if(value.affectedVehicles.isValidFlag==1)
  {
    SetRoadSafetyMessageEventInfo_affectedVehiclesParams(packetHandle, value.affectedVehicles, newPath);
    result = CheckLastError("RoadSafetyMessage", gkFuncRefGet, result);
  }
  else
  {
    if( C2xIsTokenAvailable(packetHandle, "RoadSafetyMessage", newPath) )
    {
      C2xRemoveToken(packetHandle, "RoadSafetyMessage", newPath);
    }
  }

  return result;
}

int GetRoadSafetyMessageAddGrpB_LatitudeDMS2Params(LONG packetHandle, struct RoadSafetyMessageAddGrpB_LatitudeDMS2 value, char oldPath[])
{
  char newPath[300];
  int result;

  result = 0;

  snprintf(newPath, elcount(newPath), "%s.%s", oldPath, "d");
  value.d = C2xGetTokenInt(packetHandle, "RoadSafetyMessage", newPath);
  result = CheckLastError("RoadSafetyMessage", gkFuncRefGet, result);

  snprintf(newPath, elcount(newPath), "%s.%s", oldPath, "m");
  value.m = C2xGetTokenInt(packetHandle, "RoadSafetyMessage", newPath);
  result = CheckLastError("RoadSafetyMessage", gkFuncRefGet, result);

  snprintf(newPath, elcount(newPath), "%s.%s", oldPath, "s");
  value.s = C2xGetTokenInt(packetHandle, "RoadSafetyMessage", newPath);
  result = CheckLastError("RoadSafetyMessage", gkFuncRefGet, result);

  return result;
}

int SetRoadSafetyMessageAddGrpB_LatitudeDMS2Params(LONG packetHandle, struct RoadSafetyMessageAddGrpB_LatitudeDMS2 value, char oldPath[])
{
  char newPath[300];
  int result;

  result = 0;

  snprintf(newPath, elcount(newPath), "%s.%s", oldPath, "d");
  C2xSetTokenInt(packetHandle, "RoadSafetyMessage", newPath, value.d);
  result = CheckLastError("RoadSafetyMessage", gkFuncRefGet, result);

  snprintf(newPath, elcount(newPath), "%s.%s", oldPath, "m");
  C2xSetTokenInt(packetHandle, "RoadSafetyMessage", newPath, value.m);
  result = CheckLastError("RoadSafetyMessage", gkFuncRefGet, result);

  snprintf(newPath, elcount(newPath), "%s.%s", oldPath, "s");
  C2xSetTokenInt(packetHandle, "RoadSafetyMessage", newPath, value.s);
  result = CheckLastError("RoadSafetyMessage", gkFuncRefGet, result);

  return result;
}

int GetRoadSafetyMessageAddGrpB_LongitudeDMS2Params(LONG packetHandle, struct RoadSafetyMessageAddGrpB_LongitudeDMS2 value, char oldPath[])
{
  char newPath[300];
  int result;

  result = 0;

  snprintf(newPath, elcount(newPath), "%s.%s", oldPath, "d");
  value.d = C2xGetTokenInt(packetHandle, "RoadSafetyMessage", newPath);
  result = CheckLastError("RoadSafetyMessage", gkFuncRefGet, result);

  snprintf(newPath, elcount(newPath), "%s.%s", oldPath, "m");
  value.m = C2xGetTokenInt(packetHandle, "RoadSafetyMessage", newPath);
  result = CheckLastError("RoadSafetyMessage", gkFuncRefGet, result);

  snprintf(newPath, elcount(newPath), "%s.%s", oldPath, "s");
  value.s = C2xGetTokenInt(packetHandle, "RoadSafetyMessage", newPath);
  result = CheckLastError("RoadSafetyMessage", gkFuncRefGet, result);

  return result;
}

int SetRoadSafetyMessageAddGrpB_LongitudeDMS2Params(LONG packetHandle, struct RoadSafetyMessageAddGrpB_LongitudeDMS2 value, char oldPath[])
{
  char newPath[300];
  int result;

  result = 0;

  snprintf(newPath, elcount(newPath), "%s.%s", oldPath, "d");
  C2xSetTokenInt(packetHandle, "RoadSafetyMessage", newPath, value.d);
  result = CheckLastError("RoadSafetyMessage", gkFuncRefGet, result);

  snprintf(newPath, elcount(newPath), "%s.%s", oldPath, "m");
  C2xSetTokenInt(packetHandle, "RoadSafetyMessage", newPath, value.m);
  result = CheckLastError("RoadSafetyMessage", gkFuncRefGet, result);

  snprintf(newPath, elcount(newPath), "%s.%s", oldPath, "s");
  C2xSetTokenInt(packetHandle, "RoadSafetyMessage", newPath, value.s);
  result = CheckLastError("RoadSafetyMessage", gkFuncRefGet, result);

  return result;
}

int GetRoadSafetyMessageAddGrpB_Position3D_addGrpBParams(LONG packetHandle, struct RoadSafetyMessageAddGrpB_Position3D_addGrpB value, char oldPath[])
{
  char newPath[300];
  int result;

  result = 0;

  snprintf(newPath, elcount(newPath), "%s.%s", oldPath, "latitude");
  GetRoadSafetyMessageAddGrpB_LatitudeDMS2Params(packetHandle, value.latitude, newPath);
  result = CheckLastError("RoadSafetyMessage", gkFuncRefGet, result);

  snprintf(newPath, elcount(newPath), "%s.%s", oldPath, "longitude");
  GetRoadSafetyMessageAddGrpB_LongitudeDMS2Params(packetHandle, value.longitude, newPath);
  result = CheckLastError("RoadSafetyMessage", gkFuncRefGet, result);

  snprintf(newPath, elcount(newPath), "%s.%s", oldPath, "elevation");
  value.elevation = C2xGetTokenInt(packetHandle, "RoadSafetyMessage", newPath);
  result = CheckLastError("RoadSafetyMessage", gkFuncRefGet, result);

  return result;
}

int SetRoadSafetyMessageAddGrpB_Position3D_addGrpBParams(LONG packetHandle, struct RoadSafetyMessageAddGrpB_Position3D_addGrpB value, char oldPath[])
{
  char newPath[300];
  int result;

  result = 0;

  snprintf(newPath, elcount(newPath), "%s.%s", oldPath, "latitude");
  SetRoadSafetyMessageAddGrpB_LatitudeDMS2Params(packetHandle, value.latitude, newPath);
  result = CheckLastError("RoadSafetyMessage", gkFuncRefGet, result);

  snprintf(newPath, elcount(newPath), "%s.%s", oldPath, "longitude");
  SetRoadSafetyMessageAddGrpB_LongitudeDMS2Params(packetHandle, value.longitude, newPath);
  result = CheckLastError("RoadSafetyMessage", gkFuncRefGet, result);

  snprintf(newPath, elcount(newPath), "%s.%s", oldPath, "elevation");
  C2xSetTokenInt(packetHandle, "RoadSafetyMessage", newPath, value.elevation);
  result = CheckLastError("RoadSafetyMessage", gkFuncRefGet, result);

  return result;
}

int GetRoadSafetyMessageAddGrpC_AltitudeParams(LONG packetHandle, struct RoadSafetyMessageAddGrpC_Altitude value, char oldPath[])
{
  char newPath[300];
  int result;

  result = 0;

  snprintf(newPath, elcount(newPath), "%s.%s", oldPath, "value");
  value.value = C2xGetTokenInt(packetHandle, "RoadSafetyMessage", newPath);
  result = CheckLastError("RoadSafetyMessage", gkFuncRefGet, result);

  snprintf(newPath, elcount(newPath), "%s.%s", oldPath, "confidence");
  value.confidence = C2xGetTokenInt(packetHandle, "RoadSafetyMessage", newPath);
  result = CheckLastError("RoadSafetyMessage", gkFuncRefGet, result);

  return result;
}

int SetRoadSafetyMessageAddGrpC_AltitudeParams(LONG packetHandle, struct RoadSafetyMessageAddGrpC_Altitude value, char oldPath[])
{
  char newPath[300];
  int result;

  result = 0;

  snprintf(newPath, elcount(newPath), "%s.%s", oldPath, "value");
  C2xSetTokenInt(packetHandle, "RoadSafetyMessage", newPath, value.value);
  result = CheckLastError("RoadSafetyMessage", gkFuncRefGet, result);

  snprintf(newPath, elcount(newPath), "%s.%s", oldPath, "confidence");
  C2xSetTokenInt(packetHandle, "RoadSafetyMessage", newPath, value.confidence);
  result = CheckLastError("RoadSafetyMessage", gkFuncRefGet, result);

  return result;
}

int GetRoadSafetyMessageAddGrpC_Position3D_addGrpCParams(LONG packetHandle, struct RoadSafetyMessageAddGrpC_Position3D_addGrpC value, char oldPath[])
{
  char newPath[300];
  int result;

  result = 0;

  snprintf(newPath, elcount(newPath), "%s.%s", oldPath, "altitude");
  GetRoadSafetyMessageAddGrpC_AltitudeParams(packetHandle, value.altitude, newPath);
  result = CheckLastError("RoadSafetyMessage", gkFuncRefGet, result);

  return result;
}

int SetRoadSafetyMessageAddGrpC_Position3D_addGrpCParams(LONG packetHandle, struct RoadSafetyMessageAddGrpC_Position3D_addGrpC value, char oldPath[])
{
  char newPath[300];
  int result;

  result = 0;

  snprintf(newPath, elcount(newPath), "%s.%s", oldPath, "altitude");
  SetRoadSafetyMessageAddGrpC_AltitudeParams(packetHandle, value.altitude, newPath);
  result = CheckLastError("RoadSafetyMessage", gkFuncRefGet, result);

  return result;
}

int GetRoadSafetyMessageCommon_RegionalExtension_Reg_Position3D_tableParams(LONG packetHandle, WORD tableKey, struct RoadSafetyMessageCommon_RegionalExtension_Reg_Position3D_table value, char oldPath[])
{
  char newPath[300];
  int result;

  result = 0;

  switch(tableKey)
  {
    case 2:
    {
      snprintf(newPath, elcount(newPath), "%s.%s", oldPath, "addGrpB");
      GetRoadSafetyMessageAddGrpB_Position3D_addGrpBParams(packetHandle, value.addGrpB, newPath);
      result = CheckLastError("RoadSafetyMessage", gkFuncRefGet, result);
    }
    break;
    case 3:
    {
      snprintf(newPath, elcount(newPath), "%s.%s", oldPath, "addGrpC");
      GetRoadSafetyMessageAddGrpC_Position3D_addGrpCParams(packetHandle, value.addGrpC, newPath);
      result = CheckLastError("RoadSafetyMessage", gkFuncRefGet, result);
    }
    break;
  }
  return result;
}

int SetRoadSafetyMessageCommon_RegionalExtension_Reg_Position3D_tableParams(LONG packetHandle, WORD tableKey, struct RoadSafetyMessageCommon_RegionalExtension_Reg_Position3D_table value, char oldPath[])
{
  char newPath[300];
  int result;

  result = 0;

  switch(tableKey)
  {
    case 2:
    {
      snprintf(newPath, elcount(newPath), "%s.%s", oldPath, "addGrpB");
      SetRoadSafetyMessageAddGrpB_Position3D_addGrpBParams(packetHandle, value.addGrpB, newPath);
      result = CheckLastError("RoadSafetyMessage", gkFuncRefGet, result);
    }
    break;
    case 3:
    {
      snprintf(newPath, elcount(newPath), "%s.%s", oldPath, "addGrpC");
      SetRoadSafetyMessageAddGrpC_Position3D_addGrpCParams(packetHandle, value.addGrpC, newPath);
      result = CheckLastError("RoadSafetyMessage", gkFuncRefGet, result);
    }
    break;
  }
  return result;
}

int GetRoadSafetyMessageCommon_RegionalExtension_Reg_Position3DParams(LONG packetHandle, struct RoadSafetyMessageCommon_RegionalExtension_Reg_Position3D value, char oldPath[])
{
  char newPath[300];
  int result;

  result = 0;

  snprintf(newPath, elcount(newPath), "%s.%s", oldPath, "regionId");
  value.regionId = C2xGetTokenInt(packetHandle, "RoadSafetyMessage", newPath);
  result = CheckLastError("RoadSafetyMessage", gkFuncRefGet, result);

  snprintf(newPath, elcount(newPath), "%s.%s", oldPath, "regExtvalue");
  GetRoadSafetyMessageCommon_RegionalExtension_Reg_Position3D_tableParams(packetHandle, value.regionId, value.regExtvalue, newPath);
  result = CheckLastError("RoadSafetyMessage", gkFuncRefGet, result);

  return result;
}

int SetRoadSafetyMessageCommon_RegionalExtension_Reg_Position3DParams(LONG packetHandle, struct RoadSafetyMessageCommon_RegionalExtension_Reg_Position3D value, char oldPath[])
{
  char newPath[300];
  int result;

  result = 0;


  snprintf(newPath, elcount(newPath), "%s.%s", oldPath, "regExtvalue");
  SetRoadSafetyMessageCommon_RegionalExtension_Reg_Position3D_tableParams(packetHandle, value.regionId, value.regExtvalue, newPath);
  result = CheckLastError("RoadSafetyMessage", gkFuncRefGet, result);

  return result;
}

int GetRoadSafetyMessageCommon_Position3D_regionalParams(LONG packetHandle, struct RoadSafetyMessageCommon_Position3D_regional value, char oldPath[])
{
  char newPath[300]; 
  int i;
  int result;

  result = 0;

  value.length = C2xGetTokenInt(packetHandle, "RoadSafetyMessage", oldPath);
  if((result = CheckLastError("RoadSafetyMessage", gkFuncRefGet, result))==0)
  {
    for(i=0; i<value.length; i++)
    {
      snprintf(newPath, elcount(newPath), "%s[%d]", oldPath, i);
      GetRoadSafetyMessageCommon_RegionalExtension_Reg_Position3DParams(packetHandle, value.arrayValue[i], newPath);
      result = CheckLastError("RoadSafetyMessage", gkFuncRefGet, result);
    }
  }
  return result;
}

int SetRoadSafetyMessageCommon_Position3D_regionalParams(LONG packetHandle, struct RoadSafetyMessageCommon_Position3D_regional value, char oldPath[])
{
  char newPath[300]; 
  int i;
  int result;

  result = 0;

  C2xRemoveToken(packetHandle, "RoadSafetyMessage", oldPath);
  for(i=0; i<value.length; i++)
  {
    snprintf(newPath, elcount(newPath), "%s[%d]", oldPath, i);
    SetRoadSafetyMessageCommon_RegionalExtension_Reg_Position3DParams(packetHandle, value.arrayValue[i], newPath);
    result = CheckLastError("RoadSafetyMessage", gkFuncRefGet, result);
  }
  return result;
}

int GetRoadSafetyMessageCommon_Position3DParams(LONG packetHandle, struct RoadSafetyMessageCommon_Position3D value, char oldPath[])
{
  char newPath[300];
  int result;

  result = 0;

  snprintf(newPath, elcount(newPath), "%s.%s", oldPath, "lat");
  value.lat = C2xGetTokenInt(packetHandle, "RoadSafetyMessage", newPath);
  result = CheckLastError("RoadSafetyMessage", gkFuncRefGet, result);

  snprintf(newPath, elcount(newPath), "%s.%s", oldPath, "lon");
  value.lon = C2xGetTokenInt(packetHandle, "RoadSafetyMessage", newPath);
  result = CheckLastError("RoadSafetyMessage", gkFuncRefGet, result);

  snprintf(newPath, elcount(newPath), "%s.%s", oldPath, "elevation");
  value.elevation.isValidFlag = C2xIsTokenAvailable(packetHandle, "RoadSafetyMessage", newPath);
  if(value.elevation.isValidFlag==1)
  {
    value.elevation.value = C2xGetTokenInt(packetHandle, "RoadSafetyMessage", newPath);
    result = CheckLastError("RoadSafetyMessage", gkFuncRefGet, result);
  }
  snprintf(newPath, elcount(newPath), "%s.%s", oldPath, "regional");
  value.regional.isValidFlag = C2xIsTokenAvailable(packetHandle, "RoadSafetyMessage", newPath);
  if(value.regional.isValidFlag==1)
  {
    GetRoadSafetyMessageCommon_Position3D_regionalParams(packetHandle, value.regional, newPath);
    result = CheckLastError("RoadSafetyMessage", gkFuncRefGet, result);
  }
  return result;
}

int SetRoadSafetyMessageCommon_Position3DParams(LONG packetHandle, struct RoadSafetyMessageCommon_Position3D value, char oldPath[])
{
  char newPath[300];
  int result;

  result = 0;

  snprintf(newPath, elcount(newPath), "%s.%s", oldPath, "lat");
  C2xSetTokenInt(packetHandle, "RoadSafetyMessage", newPath, value.lat);
  result = CheckLastError("RoadSafetyMessage", gkFuncRefGet, result);

  snprintf(newPath, elcount(newPath), "%s.%s", oldPath, "lon");
  C2xSetTokenInt(packetHandle, "RoadSafetyMessage", newPath, value.lon);
  result = CheckLastError("RoadSafetyMessage", gkFuncRefGet, result);

  snprintf(newPath, elcount(newPath), "%s.%s", oldPath, "elevation");
  if(value.elevation.isValidFlag==1)
  {
    C2xSetTokenInt(packetHandle, "RoadSafetyMessage", newPath, value.elevation.value);
    result = CheckLastError("RoadSafetyMessage", gkFuncRefGet, result);
  }
  else
  {
    if( C2xIsTokenAvailable(packetHandle, "RoadSafetyMessage", newPath) )
    {
      C2xRemoveToken(packetHandle, "RoadSafetyMessage", newPath);
    }
  }

  snprintf(newPath, elcount(newPath), "%s.%s", oldPath, "regional");
  if(value.regional.isValidFlag==1)
  {
    SetRoadSafetyMessageCommon_Position3D_regionalParams(packetHandle, value.regional, newPath);
    result = CheckLastError("RoadSafetyMessage", gkFuncRefGet, result);
  }
  else
  {
    if( C2xIsTokenAvailable(packetHandle, "RoadSafetyMessage", newPath) )
    {
      C2xRemoveToken(packetHandle, "RoadSafetyMessage", newPath);
    }
  }

  return result;
}

int GetRoadSafetyMessageOffset3DParams(LONG packetHandle, struct RoadSafetyMessageOffset3D value, char oldPath[])
{
  char newPath[300];
  int result;

  result = 0;

  snprintf(newPath, elcount(newPath), "%s.%s", oldPath, "lat_offset");
  value.lat_offset = C2xGetTokenInt(packetHandle, "RoadSafetyMessage", newPath);
  result = CheckLastError("RoadSafetyMessage", gkFuncRefGet, result);

  snprintf(newPath, elcount(newPath), "%s.%s", oldPath, "long_offset");
  value.long_offset = C2xGetTokenInt(packetHandle, "RoadSafetyMessage", newPath);
  result = CheckLastError("RoadSafetyMessage", gkFuncRefGet, result);

  snprintf(newPath, elcount(newPath), "%s.%s", oldPath, "elev_offset");
  value.elev_offset.isValidFlag = C2xIsTokenAvailable(packetHandle, "RoadSafetyMessage", newPath);
  if(value.elev_offset.isValidFlag==1)
  {
    value.elev_offset.value = C2xGetTokenInt(packetHandle, "RoadSafetyMessage", newPath);
    result = CheckLastError("RoadSafetyMessage", gkFuncRefGet, result);
  }
  return result;
}

int SetRoadSafetyMessageOffset3DParams(LONG packetHandle, struct RoadSafetyMessageOffset3D value, char oldPath[])
{
  char newPath[300];
  int result;

  result = 0;

  snprintf(newPath, elcount(newPath), "%s.%s", oldPath, "lat_offset");
  C2xSetTokenInt(packetHandle, "RoadSafetyMessage", newPath, value.lat_offset);
  result = CheckLastError("RoadSafetyMessage", gkFuncRefGet, result);

  snprintf(newPath, elcount(newPath), "%s.%s", oldPath, "long_offset");
  C2xSetTokenInt(packetHandle, "RoadSafetyMessage", newPath, value.long_offset);
  result = CheckLastError("RoadSafetyMessage", gkFuncRefGet, result);

  snprintf(newPath, elcount(newPath), "%s.%s", oldPath, "elev_offset");
  if(value.elev_offset.isValidFlag==1)
  {
    C2xSetTokenInt(packetHandle, "RoadSafetyMessage", newPath, value.elev_offset.value);
    result = CheckLastError("RoadSafetyMessage", gkFuncRefGet, result);
  }
  else
  {
    if( C2xIsTokenAvailable(packetHandle, "RoadSafetyMessage", newPath) )
    {
      C2xRemoveToken(packetHandle, "RoadSafetyMessage", newPath);
    }
  }

  return result;
}

int GetRoadSafetyMessageRegionUncertaintyParams(LONG packetHandle, struct RoadSafetyMessageRegionUncertainty value, char oldPath[])
{
  char newPath[300];
  int result;

  result = 0;

  value.choice = C2xGetTokenInt(packetHandle, "RoadSafetyMessage", oldPath);

  switch(value.choice)
  {
    case 0:
    {
      snprintf(newPath, elcount(newPath), "%s.%s", oldPath, "alongPath");
      GetRoadSafetyMessageOffset3DParams(packetHandle, value.alongPath, newPath);
      result = CheckLastError("RoadSafetyMessage", gkFuncRefGet, result);
    }
    break;
    case 1:
    {
      snprintf(newPath, elcount(newPath), "%s.%s", oldPath, "inCoordinateFrame");
      GetRoadSafetyMessageOffset3DParams(packetHandle, value.inCoordinateFrame, newPath);
      result = CheckLastError("RoadSafetyMessage", gkFuncRefGet, result);
    }
    break;
  }
  return result;
}

int SetRoadSafetyMessageRegionUncertaintyParams(LONG packetHandle, struct RoadSafetyMessageRegionUncertainty value, char oldPath[])
{
  char newPath[300];
  int result;

  result = 0;

  switch(value.choice)
  {
    case 0:
    {
      snprintf(newPath, elcount(newPath), "%s.%s", oldPath, "alongPath");
      SetRoadSafetyMessageOffset3DParams(packetHandle, value.alongPath, newPath);
      result = CheckLastError("RoadSafetyMessage", gkFuncRefGet, result);
    }
    break;
    case 1:
    {
      snprintf(newPath, elcount(newPath), "%s.%s", oldPath, "inCoordinateFrame");
      SetRoadSafetyMessageOffset3DParams(packetHandle, value.inCoordinateFrame, newPath);
      result = CheckLastError("RoadSafetyMessage", gkFuncRefGet, result);
    }
    break;
  }
  return result;
}

int GetRoadSafetyMessageApplicableHeadingParams(LONG packetHandle, struct RoadSafetyMessageApplicableHeading value, char oldPath[])
{
  char newPath[300];
  int result;

  result = 0;

  snprintf(newPath, elcount(newPath), "%s.%s", oldPath, "heading");
  value.heading = C2xGetTokenInt(packetHandle, "RoadSafetyMessage", newPath);
  result = CheckLastError("RoadSafetyMessage", gkFuncRefGet, result);

  snprintf(newPath, elcount(newPath), "%s.%s", oldPath, "tolerance");
  value.tolerance = C2xGetTokenInt(packetHandle, "RoadSafetyMessage", newPath);
  result = CheckLastError("RoadSafetyMessage", gkFuncRefGet, result);

  return result;
}

int SetRoadSafetyMessageApplicableHeadingParams(LONG packetHandle, struct RoadSafetyMessageApplicableHeading value, char oldPath[])
{
  char newPath[300];
  int result;

  result = 0;

  snprintf(newPath, elcount(newPath), "%s.%s", oldPath, "heading");
  C2xSetTokenInt(packetHandle, "RoadSafetyMessage", newPath, value.heading);
  result = CheckLastError("RoadSafetyMessage", gkFuncRefGet, result);

  snprintf(newPath, elcount(newPath), "%s.%s", oldPath, "tolerance");
  C2xSetTokenInt(packetHandle, "RoadSafetyMessage", newPath, value.tolerance);
  result = CheckLastError("RoadSafetyMessage", gkFuncRefGet, result);

  return result;
}

int GetRoadSafetyMessageNodePointLLEParams(LONG packetHandle, struct RoadSafetyMessageNodePointLLE value, char oldPath[])
{
  char newPath[300];
  int result;

  result = 0;

  value.choice = C2xGetTokenInt(packetHandle, "RoadSafetyMessage", oldPath);

  switch(value.choice)
  {
    case 0:
    {
      snprintf(newPath, elcount(newPath), "%s.%s", oldPath, "node_3Dabsolute");
      GetRoadSafetyMessageCommon_Position3DParams(packetHandle, value.node_3Dabsolute, newPath);
      result = CheckLastError("RoadSafetyMessage", gkFuncRefGet, result);
    }
    break;
    case 1:
    {
      snprintf(newPath, elcount(newPath), "%s.%s", oldPath, "node_3Doffset");
      GetRoadSafetyMessageOffset3DParams(packetHandle, value.node_3Doffset, newPath);
      result = CheckLastError("RoadSafetyMessage", gkFuncRefGet, result);
    }
    break;
  }
  return result;
}

int SetRoadSafetyMessageNodePointLLEParams(LONG packetHandle, struct RoadSafetyMessageNodePointLLE value, char oldPath[])
{
  char newPath[300];
  int result;

  result = 0;

  switch(value.choice)
  {
    case 0:
    {
      snprintf(newPath, elcount(newPath), "%s.%s", oldPath, "node_3Dabsolute");
      SetRoadSafetyMessageCommon_Position3DParams(packetHandle, value.node_3Dabsolute, newPath);
      result = CheckLastError("RoadSafetyMessage", gkFuncRefGet, result);
    }
    break;
    case 1:
    {
      snprintf(newPath, elcount(newPath), "%s.%s", oldPath, "node_3Doffset");
      SetRoadSafetyMessageOffset3DParams(packetHandle, value.node_3Doffset, newPath);
      result = CheckLastError("RoadSafetyMessage", gkFuncRefGet, result);
    }
    break;
  }
  return result;
}

int GetRoadSafetyMessageRSMPolygonParams(LONG packetHandle, struct RoadSafetyMessageRSMPolygon value, char oldPath[])
{
  char newPath[300]; 
  int i;
  int result;

  result = 0;

  value.length = C2xGetTokenInt(packetHandle, "RoadSafetyMessage", oldPath);
  if((result = CheckLastError("RoadSafetyMessage", gkFuncRefGet, result))==0)
  {
    for(i=0; i<value.length; i++)
    {
      snprintf(newPath, elcount(newPath), "%s[%d]", oldPath, i);
      GetRoadSafetyMessageNodePointLLEParams(packetHandle, value.arrayValue[i], newPath);
      result = CheckLastError("RoadSafetyMessage", gkFuncRefGet, result);
    }
  }
  return result;
}

int SetRoadSafetyMessageRSMPolygonParams(LONG packetHandle, struct RoadSafetyMessageRSMPolygon value, char oldPath[])
{
  char newPath[300]; 
  int i;
  int result;

  result = 0;

  C2xRemoveToken(packetHandle, "RoadSafetyMessage", oldPath);
  for(i=0; i<value.length; i++)
  {
    snprintf(newPath, elcount(newPath), "%s[%d]", oldPath, i);
    SetRoadSafetyMessageNodePointLLEParams(packetHandle, value.arrayValue[i], newPath);
    result = CheckLastError("RoadSafetyMessage", gkFuncRefGet, result);
  }
  return result;
}

int GetRoadSafetyMessageTravelerInformation_CircleParams(LONG packetHandle, struct RoadSafetyMessageTravelerInformation_Circle value, char oldPath[])
{
  char newPath[300];
  int result;

  result = 0;

  snprintf(newPath, elcount(newPath), "%s.%s", oldPath, "center");
  GetRoadSafetyMessageCommon_Position3DParams(packetHandle, value.center, newPath);
  result = CheckLastError("RoadSafetyMessage", gkFuncRefGet, result);

  snprintf(newPath, elcount(newPath), "%s.%s", oldPath, "radius");
  value.radius = C2xGetTokenInt(packetHandle, "RoadSafetyMessage", newPath);
  result = CheckLastError("RoadSafetyMessage", gkFuncRefGet, result);

  snprintf(newPath, elcount(newPath), "%s.%s", oldPath, "units");
  value.units = C2xGetTokenInt(packetHandle, "RoadSafetyMessage", newPath);
  result = CheckLastError("RoadSafetyMessage", gkFuncRefGet, result);

  return result;
}

int SetRoadSafetyMessageTravelerInformation_CircleParams(LONG packetHandle, struct RoadSafetyMessageTravelerInformation_Circle value, char oldPath[])
{
  char newPath[300];
  int result;

  result = 0;

  snprintf(newPath, elcount(newPath), "%s.%s", oldPath, "center");
  SetRoadSafetyMessageCommon_Position3DParams(packetHandle, value.center, newPath);
  result = CheckLastError("RoadSafetyMessage", gkFuncRefGet, result);

  snprintf(newPath, elcount(newPath), "%s.%s", oldPath, "radius");
  C2xSetTokenInt(packetHandle, "RoadSafetyMessage", newPath, value.radius);
  result = CheckLastError("RoadSafetyMessage", gkFuncRefGet, result);

  snprintf(newPath, elcount(newPath), "%s.%s", oldPath, "units");
  C2xSetTokenInt(packetHandle, "RoadSafetyMessage", newPath, value.units);
  result = CheckLastError("RoadSafetyMessage", gkFuncRefGet, result);

  return result;
}

int GetRoadSafetyMessageBroadRegionAreaParams(LONG packetHandle, struct RoadSafetyMessageBroadRegionArea value, char oldPath[])
{
  char newPath[300];
  int result;

  result = 0;

  value.choice = C2xGetTokenInt(packetHandle, "RoadSafetyMessage", oldPath);

  switch(value.choice)
  {
    case 0:
    {
      snprintf(newPath, elcount(newPath), "%s.%s", oldPath, "polygon");
      GetRoadSafetyMessageRSMPolygonParams(packetHandle, value.polygon, newPath);
      result = CheckLastError("RoadSafetyMessage", gkFuncRefGet, result);
    }
    break;
    case 1:
    {
      snprintf(newPath, elcount(newPath), "%s.%s", oldPath, "circle");
      GetRoadSafetyMessageTravelerInformation_CircleParams(packetHandle, value.circle, newPath);
      result = CheckLastError("RoadSafetyMessage", gkFuncRefGet, result);
    }
    break;
  }
  return result;
}

int SetRoadSafetyMessageBroadRegionAreaParams(LONG packetHandle, struct RoadSafetyMessageBroadRegionArea value, char oldPath[])
{
  char newPath[300];
  int result;

  result = 0;

  switch(value.choice)
  {
    case 0:
    {
      snprintf(newPath, elcount(newPath), "%s.%s", oldPath, "polygon");
      SetRoadSafetyMessageRSMPolygonParams(packetHandle, value.polygon, newPath);
      result = CheckLastError("RoadSafetyMessage", gkFuncRefGet, result);
    }
    break;
    case 1:
    {
      snprintf(newPath, elcount(newPath), "%s.%s", oldPath, "circle");
      SetRoadSafetyMessageTravelerInformation_CircleParams(packetHandle, value.circle, newPath);
      result = CheckLastError("RoadSafetyMessage", gkFuncRefGet, result);
    }
    break;
  }
  return result;
}

int GetRoadSafetyMessageBroadRegionParams(LONG packetHandle, struct RoadSafetyMessageBroadRegion value, char oldPath[])
{
  char newPath[300];
  int result;

  result = 0;

  snprintf(newPath, elcount(newPath), "%s.%s", oldPath, "applicableHeading");
  GetRoadSafetyMessageApplicableHeadingParams(packetHandle, value.applicableHeading, newPath);
  result = CheckLastError("RoadSafetyMessage", gkFuncRefGet, result);

  snprintf(newPath, elcount(newPath), "%s.%s", oldPath, "broadArea");
  GetRoadSafetyMessageBroadRegionAreaParams(packetHandle, value.broadArea, newPath);
  result = CheckLastError("RoadSafetyMessage", gkFuncRefGet, result);

  return result;
}

int SetRoadSafetyMessageBroadRegionParams(LONG packetHandle, struct RoadSafetyMessageBroadRegion value, char oldPath[])
{
  char newPath[300];
  int result;

  result = 0;

  snprintf(newPath, elcount(newPath), "%s.%s", oldPath, "applicableHeading");
  SetRoadSafetyMessageApplicableHeadingParams(packetHandle, value.applicableHeading, newPath);
  result = CheckLastError("RoadSafetyMessage", gkFuncRefGet, result);

  snprintf(newPath, elcount(newPath), "%s.%s", oldPath, "broadArea");
  SetRoadSafetyMessageBroadRegionAreaParams(packetHandle, value.broadArea, newPath);
  result = CheckLastError("RoadSafetyMessage", gkFuncRefGet, result);

  return result;
}

int GetRoadSafetyMessagePathPointsParams(LONG packetHandle, struct RoadSafetyMessagePathPoints value, char oldPath[])
{
  char newPath[300]; 
  int i;
  int result;

  result = 0;

  value.length = C2xGetTokenInt(packetHandle, "RoadSafetyMessage", oldPath);
  if((result = CheckLastError("RoadSafetyMessage", gkFuncRefGet, result))==0)
  {
    for(i=0; i<value.length; i++)
    {
      snprintf(newPath, elcount(newPath), "%s[%d]", oldPath, i);
      GetRoadSafetyMessageNodePointLLEParams(packetHandle, value.arrayValue[i], newPath);
      result = CheckLastError("RoadSafetyMessage", gkFuncRefGet, result);
    }
  }
  return result;
}

int SetRoadSafetyMessagePathPointsParams(LONG packetHandle, struct RoadSafetyMessagePathPoints value, char oldPath[])
{
  char newPath[300]; 
  int i;
  int result;

  result = 0;

  C2xRemoveToken(packetHandle, "RoadSafetyMessage", oldPath);
  for(i=0; i<value.length; i++)
  {
    snprintf(newPath, elcount(newPath), "%s[%d]", oldPath, i);
    SetRoadSafetyMessageNodePointLLEParams(packetHandle, value.arrayValue[i], newPath);
    result = CheckLastError("RoadSafetyMessage", gkFuncRefGet, result);
  }
  return result;
}

int GetRoadSafetyMessagePathParams(LONG packetHandle, struct RoadSafetyMessagePath value, char oldPath[])
{
  char newPath[300];
  int result;

  result = 0;

  snprintf(newPath, elcount(newPath), "%s.%s", oldPath, "pathWidth");
  value.pathWidth = C2xGetTokenInt(packetHandle, "RoadSafetyMessage", newPath);
  result = CheckLastError("RoadSafetyMessage", gkFuncRefGet, result);

  snprintf(newPath, elcount(newPath), "%s.%s", oldPath, "pathPoints");
  GetRoadSafetyMessagePathPointsParams(packetHandle, value.pathPoints, newPath);
  result = CheckLastError("RoadSafetyMessage", gkFuncRefGet, result);

  return result;
}

int SetRoadSafetyMessagePathParams(LONG packetHandle, struct RoadSafetyMessagePath value, char oldPath[])
{
  char newPath[300];
  int result;

  result = 0;

  snprintf(newPath, elcount(newPath), "%s.%s", oldPath, "pathWidth");
  C2xSetTokenInt(packetHandle, "RoadSafetyMessage", newPath, value.pathWidth);
  result = CheckLastError("RoadSafetyMessage", gkFuncRefGet, result);

  snprintf(newPath, elcount(newPath), "%s.%s", oldPath, "pathPoints");
  SetRoadSafetyMessagePathPointsParams(packetHandle, value.pathPoints, newPath);
  result = CheckLastError("RoadSafetyMessage", gkFuncRefGet, result);

  return result;
}

int GetRoadSafetyMessagePathListParams(LONG packetHandle, struct RoadSafetyMessagePathList value, char oldPath[])
{
  char newPath[300]; 
  int i;
  int result;

  result = 0;

  value.length = C2xGetTokenInt(packetHandle, "RoadSafetyMessage", oldPath);
  if((result = CheckLastError("RoadSafetyMessage", gkFuncRefGet, result))==0)
  {
    for(i=0; i<value.length; i++)
    {
      snprintf(newPath, elcount(newPath), "%s[%d]", oldPath, i);
      GetRoadSafetyMessagePathParams(packetHandle, value.arrayValue[i], newPath);
      result = CheckLastError("RoadSafetyMessage", gkFuncRefGet, result);
    }
  }
  return result;
}

int SetRoadSafetyMessagePathListParams(LONG packetHandle, struct RoadSafetyMessagePathList value, char oldPath[])
{
  char newPath[300]; 
  int i;
  int result;

  result = 0;

  C2xRemoveToken(packetHandle, "RoadSafetyMessage", oldPath);
  for(i=0; i<value.length; i++)
  {
    snprintf(newPath, elcount(newPath), "%s[%d]", oldPath, i);
    SetRoadSafetyMessagePathParams(packetHandle, value.arrayValue[i], newPath);
    result = CheckLastError("RoadSafetyMessage", gkFuncRefGet, result);
  }
  return result;
}

int GetRoadSafetyMessageAreaTypeParams(LONG packetHandle, struct RoadSafetyMessageAreaType value, char oldPath[])
{
  char newPath[300];
  int result;

  result = 0;

  value.choice = C2xGetTokenInt(packetHandle, "RoadSafetyMessage", oldPath);

  switch(value.choice)
  {
    case 0:
    {
      snprintf(newPath, elcount(newPath), "%s.%s", oldPath, "broadRegion");
      GetRoadSafetyMessageBroadRegionParams(packetHandle, value.broadRegion, newPath);
      result = CheckLastError("RoadSafetyMessage", gkFuncRefGet, result);
    }
    break;
    case 1:
    {
      snprintf(newPath, elcount(newPath), "%s.%s", oldPath, "paths");
      GetRoadSafetyMessagePathListParams(packetHandle, value.paths, newPath);
      result = CheckLastError("RoadSafetyMessage", gkFuncRefGet, result);
    }
    break;
  }
  return result;
}

int SetRoadSafetyMessageAreaTypeParams(LONG packetHandle, struct RoadSafetyMessageAreaType value, char oldPath[])
{
  char newPath[300];
  int result;

  result = 0;

  switch(value.choice)
  {
    case 0:
    {
      snprintf(newPath, elcount(newPath), "%s.%s", oldPath, "broadRegion");
      SetRoadSafetyMessageBroadRegionParams(packetHandle, value.broadRegion, newPath);
      result = CheckLastError("RoadSafetyMessage", gkFuncRefGet, result);
    }
    break;
    case 1:
    {
      snprintf(newPath, elcount(newPath), "%s.%s", oldPath, "paths");
      SetRoadSafetyMessagePathListParams(packetHandle, value.paths, newPath);
      result = CheckLastError("RoadSafetyMessage", gkFuncRefGet, result);
    }
    break;
  }
  return result;
}

int GetRoadSafetyMessageRegionInfoParams(LONG packetHandle, struct RoadSafetyMessageRegionInfo value, char oldPath[])
{
  char newPath[300];
  int result;

  result = 0;

  snprintf(newPath, elcount(newPath), "%s.%s", oldPath, "referencePoint");
  GetRoadSafetyMessageCommon_Position3DParams(packetHandle, value.referencePoint, newPath);
  result = CheckLastError("RoadSafetyMessage", gkFuncRefGet, result);

  snprintf(newPath, elcount(newPath), "%s.%s", oldPath, "locationUncertainty");
  value.locationUncertainty.isValidFlag = C2xIsTokenAvailable(packetHandle, "RoadSafetyMessage", newPath);
  if(value.locationUncertainty.isValidFlag==1)
  {
    GetRoadSafetyMessageRegionUncertaintyParams(packetHandle, value.locationUncertainty, newPath);
    result = CheckLastError("RoadSafetyMessage", gkFuncRefGet, result);
  }
  snprintf(newPath, elcount(newPath), "%s.%s", oldPath, "referencePointType");
  value.referencePointType.isValidFlag = C2xIsTokenAvailable(packetHandle, "RoadSafetyMessage", newPath);
  if(value.referencePointType.isValidFlag==1)
  {
    value.referencePointType.value = C2xGetTokenInt(packetHandle, "RoadSafetyMessage", newPath);
    result = CheckLastError("RoadSafetyMessage", gkFuncRefGet, result);
  }
  snprintf(newPath, elcount(newPath), "%s.%s", oldPath, "descriptiveName");
  value.descriptiveName.isValidFlag = C2xIsTokenAvailable(packetHandle, "RoadSafetyMessage", newPath);
  if(value.descriptiveName.isValidFlag==1)
  {
    value.descriptiveName.stringLength = C2xGetTokenData(packetHandle, "RoadSafetyMessage", newPath, elcount(value.descriptiveName.string), value.descriptiveName.string);
    result = CheckLastError("RoadSafetyMessage", gkFuncRefGet, result);
  }
  snprintf(newPath, elcount(newPath), "%s.%s", oldPath, "scale");
  value.scale.isValidFlag = C2xIsTokenAvailable(packetHandle, "RoadSafetyMessage", newPath);
  if(value.scale.isValidFlag==1)
  {
    value.scale.value = C2xGetTokenInt(packetHandle, "RoadSafetyMessage", newPath);
    result = CheckLastError("RoadSafetyMessage", gkFuncRefGet, result);
  }
  snprintf(newPath, elcount(newPath), "%s.%s", oldPath, "approachRegion");
  value.approachRegion.isValidFlag = C2xIsTokenAvailable(packetHandle, "RoadSafetyMessage", newPath);
  if(value.approachRegion.isValidFlag==1)
  {
    GetRoadSafetyMessageAreaTypeParams(packetHandle, value.approachRegion, newPath);
    result = CheckLastError("RoadSafetyMessage", gkFuncRefGet, result);
  }
  return result;
}

int SetRoadSafetyMessageRegionInfoParams(LONG packetHandle, struct RoadSafetyMessageRegionInfo value, char oldPath[])
{
  char newPath[300];
  int result;

  result = 0;

  snprintf(newPath, elcount(newPath), "%s.%s", oldPath, "referencePoint");
  SetRoadSafetyMessageCommon_Position3DParams(packetHandle, value.referencePoint, newPath);
  result = CheckLastError("RoadSafetyMessage", gkFuncRefGet, result);

  snprintf(newPath, elcount(newPath), "%s.%s", oldPath, "locationUncertainty");
  if(value.locationUncertainty.isValidFlag==1)
  {
    SetRoadSafetyMessageRegionUncertaintyParams(packetHandle, value.locationUncertainty, newPath);
    result = CheckLastError("RoadSafetyMessage", gkFuncRefGet, result);
  }
  else
  {
    if( C2xIsTokenAvailable(packetHandle, "RoadSafetyMessage", newPath) )
    {
      C2xRemoveToken(packetHandle, "RoadSafetyMessage", newPath);
    }
  }

  snprintf(newPath, elcount(newPath), "%s.%s", oldPath, "referencePointType");
  if(value.referencePointType.isValidFlag==1)
  {
    C2xSetTokenInt(packetHandle, "RoadSafetyMessage", newPath, value.referencePointType.value);
    result = CheckLastError("RoadSafetyMessage", gkFuncRefGet, result);
  }
  else
  {
    if( C2xIsTokenAvailable(packetHandle, "RoadSafetyMessage", newPath) )
    {
      C2xRemoveToken(packetHandle, "RoadSafetyMessage", newPath);
    }
  }

  snprintf(newPath, elcount(newPath), "%s.%s", oldPath, "descriptiveName");
  if(value.descriptiveName.isValidFlag==1)
  {
    C2xSetTokenData(packetHandle, "RoadSafetyMessage", newPath, value.descriptiveName.stringLength, value.descriptiveName.string);
    result = CheckLastError("RoadSafetyMessage", gkFuncRefGet, result);
  }
  else
  {
    if( C2xIsTokenAvailable(packetHandle, "RoadSafetyMessage", newPath) )
    {
      C2xRemoveToken(packetHandle, "RoadSafetyMessage", newPath);
    }
  }

  snprintf(newPath, elcount(newPath), "%s.%s", oldPath, "scale");
  if(value.scale.isValidFlag==1)
  {
    C2xSetTokenInt(packetHandle, "RoadSafetyMessage", newPath, value.scale.value);
    result = CheckLastError("RoadSafetyMessage", gkFuncRefGet, result);
  }
  else
  {
    if( C2xIsTokenAvailable(packetHandle, "RoadSafetyMessage", newPath) )
    {
      C2xRemoveToken(packetHandle, "RoadSafetyMessage", newPath);
    }
  }

  snprintf(newPath, elcount(newPath), "%s.%s", oldPath, "approachRegion");
  if(value.approachRegion.isValidFlag==1)
  {
    SetRoadSafetyMessageAreaTypeParams(packetHandle, value.approachRegion, newPath);
    result = CheckLastError("RoadSafetyMessage", gkFuncRefGet, result);
  }
  else
  {
    if( C2xIsTokenAvailable(packetHandle, "RoadSafetyMessage", newPath) )
    {
      C2xRemoveToken(packetHandle, "RoadSafetyMessage", newPath);
    }
  }

  return result;
}

int GetRoadSafetyMessageCommonContainer_regionInfoParams(LONG packetHandle, struct RoadSafetyMessageCommonContainer_regionInfo value, char oldPath[])
{
  char newPath[300]; 
  int i;
  int result;

  result = 0;

  value.length = C2xGetTokenInt(packetHandle, "RoadSafetyMessage", oldPath);
  if((result = CheckLastError("RoadSafetyMessage", gkFuncRefGet, result))==0)
  {
    for(i=0; i<value.length; i++)
    {
      snprintf(newPath, elcount(newPath), "%s[%d]", oldPath, i);
      GetRoadSafetyMessageRegionInfoParams(packetHandle, value.arrayValue[i], newPath);
      result = CheckLastError("RoadSafetyMessage", gkFuncRefGet, result);
    }
  }
  return result;
}

int SetRoadSafetyMessageCommonContainer_regionInfoParams(LONG packetHandle, struct RoadSafetyMessageCommonContainer_regionInfo value, char oldPath[])
{
  char newPath[300]; 
  int i;
  int result;

  result = 0;

  C2xRemoveToken(packetHandle, "RoadSafetyMessage", oldPath);
  for(i=0; i<value.length; i++)
  {
    snprintf(newPath, elcount(newPath), "%s[%d]", oldPath, i);
    SetRoadSafetyMessageRegionInfoParams(packetHandle, value.arrayValue[i], newPath);
    result = CheckLastError("RoadSafetyMessage", gkFuncRefGet, result);
  }
  return result;
}

int GetRoadSafetyMessageAudioLinkParams(LONG packetHandle, struct RoadSafetyMessageAudioLink value, char oldPath[])
{
  char newPath[300];
  int result;

  result = 0;

  snprintf(newPath, elcount(newPath), "%s.%s", oldPath, "amChannel");
  value.amChannel.isValidFlag = C2xIsTokenAvailable(packetHandle, "RoadSafetyMessage", newPath);
  if(value.amChannel.isValidFlag==1)
  {
    value.amChannel.value = C2xGetTokenInt(packetHandle, "RoadSafetyMessage", newPath);
    result = CheckLastError("RoadSafetyMessage", gkFuncRefGet, result);
  }
  snprintf(newPath, elcount(newPath), "%s.%s", oldPath, "fmChannel");
  value.fmChannel.isValidFlag = C2xIsTokenAvailable(packetHandle, "RoadSafetyMessage", newPath);
  if(value.fmChannel.isValidFlag==1)
  {
    value.fmChannel.value = C2xGetTokenInt(packetHandle, "RoadSafetyMessage", newPath);
    result = CheckLastError("RoadSafetyMessage", gkFuncRefGet, result);
  }
  snprintf(newPath, elcount(newPath), "%s.%s", oldPath, "satelliteChannel");
  value.satelliteChannel.isValidFlag = C2xIsTokenAvailable(packetHandle, "RoadSafetyMessage", newPath);
  if(value.satelliteChannel.isValidFlag==1)
  {
    value.satelliteChannel.value = C2xGetTokenInt(packetHandle, "RoadSafetyMessage", newPath);
    result = CheckLastError("RoadSafetyMessage", gkFuncRefGet, result);
  }
  snprintf(newPath, elcount(newPath), "%s.%s", oldPath, "urlChannel");
  value.urlChannel.isValidFlag = C2xIsTokenAvailable(packetHandle, "RoadSafetyMessage", newPath);
  if(value.urlChannel.isValidFlag==1)
  {
    value.urlChannel.stringLength = C2xGetTokenData(packetHandle, "RoadSafetyMessage", newPath, elcount(value.urlChannel.string), value.urlChannel.string);
    result = CheckLastError("RoadSafetyMessage", gkFuncRefGet, result);
  }
  return result;
}

int SetRoadSafetyMessageAudioLinkParams(LONG packetHandle, struct RoadSafetyMessageAudioLink value, char oldPath[])
{
  char newPath[300];
  int result;

  result = 0;

  snprintf(newPath, elcount(newPath), "%s.%s", oldPath, "amChannel");
  if(value.amChannel.isValidFlag==1)
  {
    if (value.amChannel.value < 531)
    {
        C2xSetTokenInt(packetHandle, "RoadSafetyMessage", newPath, 531);
    }
    else if (value.amChannel.value > 1710)
    {
        C2xSetTokenInt(packetHandle, "RoadSafetyMessage", newPath, 1710);
    }
    else
    {
        C2xSetTokenInt(packetHandle, "RoadSafetyMessage", newPath, value.amChannel.value);
    }
    result = CheckLastError("RoadSafetyMessage", gkFuncRefGet, result);
  }
  else
  {
    if( C2xIsTokenAvailable(packetHandle, "RoadSafetyMessage", newPath) )
    {
      C2xRemoveToken(packetHandle, "RoadSafetyMessage", newPath);
    }
  }

  snprintf(newPath, elcount(newPath), "%s.%s", oldPath, "fmChannel");
  if(value.fmChannel.isValidFlag==1)
  {
    if (value.fmChannel.value < 65800)
    {
        C2xSetTokenInt(packetHandle, "RoadSafetyMessage", newPath, 65800);
    }
    else if (value.fmChannel.value > 108009)
    {
        C2xSetTokenInt(packetHandle, "RoadSafetyMessage", newPath, 108009);
    }
    else
    {
        C2xSetTokenInt(packetHandle, "RoadSafetyMessage", newPath, value.fmChannel.value);
    }
    result = CheckLastError("RoadSafetyMessage", gkFuncRefGet, result);
  }
  else
  {
    if( C2xIsTokenAvailable(packetHandle, "RoadSafetyMessage", newPath) )
    {
      C2xRemoveToken(packetHandle, "RoadSafetyMessage", newPath);
    }
  }

  snprintf(newPath, elcount(newPath), "%s.%s", oldPath, "satelliteChannel");
  if(value.satelliteChannel.isValidFlag==1)
  {
    if (value.satelliteChannel.value < 1)
    {
        C2xSetTokenInt(packetHandle, "RoadSafetyMessage", newPath, 1);
    }
    else if (value.satelliteChannel.value > 9999)
    {
        C2xSetTokenInt(packetHandle, "RoadSafetyMessage", newPath, 9999);
    }
    else
    {
        C2xSetTokenInt(packetHandle, "RoadSafetyMessage", newPath, value.satelliteChannel.value);
    }
    result = CheckLastError("RoadSafetyMessage", gkFuncRefGet, result);
  }
  else
  {
    if( C2xIsTokenAvailable(packetHandle, "RoadSafetyMessage", newPath) )
    {
      C2xRemoveToken(packetHandle, "RoadSafetyMessage", newPath);
    }
  }

  snprintf(newPath, elcount(newPath), "%s.%s", oldPath, "urlChannel");
  if(value.urlChannel.isValidFlag==1)
  {
    C2xSetTokenData(packetHandle, "RoadSafetyMessage", newPath, value.urlChannel.stringLength, value.urlChannel.string);
    result = CheckLastError("RoadSafetyMessage", gkFuncRefGet, result);
  }
  else
  {
    if( C2xIsTokenAvailable(packetHandle, "RoadSafetyMessage", newPath) )
    {
      C2xRemoveToken(packetHandle, "RoadSafetyMessage", newPath);
    }
  }

  return result;
}

int GetRoadSafetyMessageCrossLinking_audioLinksParams(LONG packetHandle, struct RoadSafetyMessageCrossLinking_audioLinks value, char oldPath[])
{
  char newPath[300]; 
  int i;
  int result;

  result = 0;

  value.length = C2xGetTokenInt(packetHandle, "RoadSafetyMessage", oldPath);
  if((result = CheckLastError("RoadSafetyMessage", gkFuncRefGet, result))==0)
  {
    for(i=0; i<value.length; i++)
    {
      snprintf(newPath, elcount(newPath), "%s[%d]", oldPath, i);
      GetRoadSafetyMessageAudioLinkParams(packetHandle, value.arrayValue[i], newPath);
      result = CheckLastError("RoadSafetyMessage", gkFuncRefGet, result);
    }
  }
  return result;
}

int SetRoadSafetyMessageCrossLinking_audioLinksParams(LONG packetHandle, struct RoadSafetyMessageCrossLinking_audioLinks value, char oldPath[])
{
  char newPath[300]; 
  int i;
  int result;

  result = 0;

  C2xRemoveToken(packetHandle, "RoadSafetyMessage", oldPath);
  for(i=0; i<value.length; i++)
  {
    snprintf(newPath, elcount(newPath), "%s[%d]", oldPath, i);
    SetRoadSafetyMessageAudioLinkParams(packetHandle, value.arrayValue[i], newPath);
    result = CheckLastError("RoadSafetyMessage", gkFuncRefGet, result);
  }
  return result;
}

int GetRoadSafetyMessageVisualLinkParams(LONG packetHandle, struct RoadSafetyMessageVisualLink value, char oldPath[])
{
  char newPath[300];
  int result;

  result = 0;

  snprintf(newPath, elcount(newPath), "%s.%s", oldPath, "urlLink");
  value.urlLink.isValidFlag = C2xIsTokenAvailable(packetHandle, "RoadSafetyMessage", newPath);
  if(value.urlLink.isValidFlag==1)
  {
    value.urlLink.stringLength = C2xGetTokenData(packetHandle, "RoadSafetyMessage", newPath, elcount(value.urlLink.string), value.urlLink.string);
    result = CheckLastError("RoadSafetyMessage", gkFuncRefGet, result);
  }
  return result;
}

int SetRoadSafetyMessageVisualLinkParams(LONG packetHandle, struct RoadSafetyMessageVisualLink value, char oldPath[])
{
  char newPath[300];
  int result;

  result = 0;

  snprintf(newPath, elcount(newPath), "%s.%s", oldPath, "urlLink");
  if(value.urlLink.isValidFlag==1)
  {
    C2xSetTokenData(packetHandle, "RoadSafetyMessage", newPath, value.urlLink.stringLength, value.urlLink.string);
    result = CheckLastError("RoadSafetyMessage", gkFuncRefGet, result);
  }
  else
  {
    if( C2xIsTokenAvailable(packetHandle, "RoadSafetyMessage", newPath) )
    {
      C2xRemoveToken(packetHandle, "RoadSafetyMessage", newPath);
    }
  }

  return result;
}

int GetRoadSafetyMessageCrossLinking_visualLinkParams(LONG packetHandle, struct RoadSafetyMessageCrossLinking_visualLink value, char oldPath[])
{
  char newPath[300]; 
  int i;
  int result;

  result = 0;

  value.length = C2xGetTokenInt(packetHandle, "RoadSafetyMessage", oldPath);
  if((result = CheckLastError("RoadSafetyMessage", gkFuncRefGet, result))==0)
  {
    for(i=0; i<value.length; i++)
    {
      snprintf(newPath, elcount(newPath), "%s[%d]", oldPath, i);
      GetRoadSafetyMessageVisualLinkParams(packetHandle, value.arrayValue[i], newPath);
      result = CheckLastError("RoadSafetyMessage", gkFuncRefGet, result);
    }
  }
  return result;
}

int SetRoadSafetyMessageCrossLinking_visualLinkParams(LONG packetHandle, struct RoadSafetyMessageCrossLinking_visualLink value, char oldPath[])
{
  char newPath[300]; 
  int i;
  int result;

  result = 0;

  C2xRemoveToken(packetHandle, "RoadSafetyMessage", oldPath);
  for(i=0; i<value.length; i++)
  {
    snprintf(newPath, elcount(newPath), "%s[%d]", oldPath, i);
    SetRoadSafetyMessageVisualLinkParams(packetHandle, value.arrayValue[i], newPath);
    result = CheckLastError("RoadSafetyMessage", gkFuncRefGet, result);
  }
  return result;
}

int GetRoadSafetyMessageCrossLinking_rsmLinkParams(LONG packetHandle, struct RoadSafetyMessageCrossLinking_rsmLink value, char oldPath[])
{
  char newPath[300]; 
  int i;
  int result;

  result = 0;

  value.length = C2xGetTokenInt(packetHandle, "RoadSafetyMessage", oldPath);
  if((result = CheckLastError("RoadSafetyMessage", gkFuncRefGet, result))==0)
  {
    for(i=0; i<value.length; i++)
    {
      snprintf(newPath, elcount(newPath), "%s[%d]", oldPath, i);
      GetRoadSafetyMessageEventIdentifierParams(packetHandle, value.arrayValue[i], newPath);
      result = CheckLastError("RoadSafetyMessage", gkFuncRefGet, result);
    }
  }
  return result;
}

int SetRoadSafetyMessageCrossLinking_rsmLinkParams(LONG packetHandle, struct RoadSafetyMessageCrossLinking_rsmLink value, char oldPath[])
{
  char newPath[300]; 
  int i;
  int result;

  result = 0;

  C2xRemoveToken(packetHandle, "RoadSafetyMessage", oldPath);
  for(i=0; i<value.length; i++)
  {
    snprintf(newPath, elcount(newPath), "%s[%d]", oldPath, i);
    SetRoadSafetyMessageEventIdentifierParams(packetHandle, value.arrayValue[i], newPath);
    result = CheckLastError("RoadSafetyMessage", gkFuncRefGet, result);
  }
  return result;
}

int GetRoadSafetyMessageCrossLinkingParams(LONG packetHandle, struct RoadSafetyMessageCrossLinking value, char oldPath[])
{
  char newPath[300];
  int result;

  result = 0;

  snprintf(newPath, elcount(newPath), "%s.%s", oldPath, "audioLinks");
  value.audioLinks.isValidFlag = C2xIsTokenAvailable(packetHandle, "RoadSafetyMessage", newPath);
  if(value.audioLinks.isValidFlag==1)
  {
    GetRoadSafetyMessageCrossLinking_audioLinksParams(packetHandle, value.audioLinks, newPath);
    result = CheckLastError("RoadSafetyMessage", gkFuncRefGet, result);
  }
  snprintf(newPath, elcount(newPath), "%s.%s", oldPath, "visualLink");
  value.visualLink.isValidFlag = C2xIsTokenAvailable(packetHandle, "RoadSafetyMessage", newPath);
  if(value.visualLink.isValidFlag==1)
  {
    GetRoadSafetyMessageCrossLinking_visualLinkParams(packetHandle, value.visualLink, newPath);
    result = CheckLastError("RoadSafetyMessage", gkFuncRefGet, result);
  }
  snprintf(newPath, elcount(newPath), "%s.%s", oldPath, "rsmLink");
  value.rsmLink.isValidFlag = C2xIsTokenAvailable(packetHandle, "RoadSafetyMessage", newPath);
  if(value.rsmLink.isValidFlag==1)
  {
    GetRoadSafetyMessageCrossLinking_rsmLinkParams(packetHandle, value.rsmLink, newPath);
    result = CheckLastError("RoadSafetyMessage", gkFuncRefGet, result);
  }
  return result;
}

int SetRoadSafetyMessageCrossLinkingParams(LONG packetHandle, struct RoadSafetyMessageCrossLinking value, char oldPath[])
{
  char newPath[300];
  int result;

  result = 0;

  snprintf(newPath, elcount(newPath), "%s.%s", oldPath, "audioLinks");
  if(value.audioLinks.isValidFlag==1)
  {
    SetRoadSafetyMessageCrossLinking_audioLinksParams(packetHandle, value.audioLinks, newPath);
    result = CheckLastError("RoadSafetyMessage", gkFuncRefGet, result);
  }
  else
  {
    if( C2xIsTokenAvailable(packetHandle, "RoadSafetyMessage", newPath) )
    {
      C2xRemoveToken(packetHandle, "RoadSafetyMessage", newPath);
    }
  }

  snprintf(newPath, elcount(newPath), "%s.%s", oldPath, "visualLink");
  if(value.visualLink.isValidFlag==1)
  {
    SetRoadSafetyMessageCrossLinking_visualLinkParams(packetHandle, value.visualLink, newPath);
    result = CheckLastError("RoadSafetyMessage", gkFuncRefGet, result);
  }
  else
  {
    if( C2xIsTokenAvailable(packetHandle, "RoadSafetyMessage", newPath) )
    {
      C2xRemoveToken(packetHandle, "RoadSafetyMessage", newPath);
    }
  }

  snprintf(newPath, elcount(newPath), "%s.%s", oldPath, "rsmLink");
  if(value.rsmLink.isValidFlag==1)
  {
    SetRoadSafetyMessageCrossLinking_rsmLinkParams(packetHandle, value.rsmLink, newPath);
    result = CheckLastError("RoadSafetyMessage", gkFuncRefGet, result);
  }
  else
  {
    if( C2xIsTokenAvailable(packetHandle, "RoadSafetyMessage", newPath) )
    {
      C2xRemoveToken(packetHandle, "RoadSafetyMessage", newPath);
    }
  }

  return result;
}

int GetRoadSafetyMessageCommonContainerParams(LONG packetHandle, struct RoadSafetyMessageCommonContainer value, char oldPath[])
{
  char newPath[300];
  int result;

  result = 0;

  snprintf(newPath, elcount(newPath), "%s.%s", oldPath, "eventInfo");
  GetRoadSafetyMessageEventInfoParams(packetHandle, value.eventInfo, newPath);
  result = CheckLastError("RoadSafetyMessage", gkFuncRefGet, result);

  snprintf(newPath, elcount(newPath), "%s.%s", oldPath, "regionInfo");
  GetRoadSafetyMessageCommonContainer_regionInfoParams(packetHandle, value.regionInfo, newPath);
  result = CheckLastError("RoadSafetyMessage", gkFuncRefGet, result);

  snprintf(newPath, elcount(newPath), "%s.%s", oldPath, "crossLinking");
  value.crossLinking.isValidFlag = C2xIsTokenAvailable(packetHandle, "RoadSafetyMessage", newPath);
  if(value.crossLinking.isValidFlag==1)
  {
    GetRoadSafetyMessageCrossLinkingParams(packetHandle, value.crossLinking, newPath);
    result = CheckLastError("RoadSafetyMessage", gkFuncRefGet, result);
  }
  return result;
}

int SetRoadSafetyMessageCommonContainerParams(LONG packetHandle, struct RoadSafetyMessageCommonContainer value, char oldPath[])
{
  char newPath[300];
  int result;

  result = 0;

  snprintf(newPath, elcount(newPath), "%s.%s", oldPath, "eventInfo");
  SetRoadSafetyMessageEventInfoParams(packetHandle, value.eventInfo, newPath);
  result = CheckLastError("RoadSafetyMessage", gkFuncRefGet, result);

  snprintf(newPath, elcount(newPath), "%s.%s", oldPath, "regionInfo");
  SetRoadSafetyMessageCommonContainer_regionInfoParams(packetHandle, value.regionInfo, newPath);
  result = CheckLastError("RoadSafetyMessage", gkFuncRefGet, result);

  snprintf(newPath, elcount(newPath), "%s.%s", oldPath, "crossLinking");
  if(value.crossLinking.isValidFlag==1)
  {
    SetRoadSafetyMessageCrossLinkingParams(packetHandle, value.crossLinking, newPath);
    result = CheckLastError("RoadSafetyMessage", gkFuncRefGet, result);
  }
  else
  {
    if( C2xIsTokenAvailable(packetHandle, "RoadSafetyMessage", newPath) )
    {
      C2xRemoveToken(packetHandle, "RoadSafetyMessage", newPath);
    }
  }

  return result;
}

int GetRoadSafetyMessageCommon_RegulatorySpeedLimitParams(LONG packetHandle, struct RoadSafetyMessageCommon_RegulatorySpeedLimit value, char oldPath[])
{
  char newPath[300];
  int result;

  result = 0;

  snprintf(newPath, elcount(newPath), "%s.%s", oldPath, "type");
  value.type = C2xGetTokenInt(packetHandle, "RoadSafetyMessage", newPath);
  result = CheckLastError("RoadSafetyMessage", gkFuncRefGet, result);

  snprintf(newPath, elcount(newPath), "%s.%s", oldPath, "speed");
  value.speed = C2xGetTokenInt(packetHandle, "RoadSafetyMessage", newPath);
  result = CheckLastError("RoadSafetyMessage", gkFuncRefGet, result);

  return result;
}

int SetRoadSafetyMessageCommon_RegulatorySpeedLimitParams(LONG packetHandle, struct RoadSafetyMessageCommon_RegulatorySpeedLimit value, char oldPath[])
{
  char newPath[300];
  int result;

  result = 0;

  snprintf(newPath, elcount(newPath), "%s.%s", oldPath, "type");
  C2xSetTokenInt(packetHandle, "RoadSafetyMessage", newPath, value.type);
  result = CheckLastError("RoadSafetyMessage", gkFuncRefGet, result);

  snprintf(newPath, elcount(newPath), "%s.%s", oldPath, "speed");
  C2xSetTokenInt(packetHandle, "RoadSafetyMessage", newPath, value.speed);
  result = CheckLastError("RoadSafetyMessage", gkFuncRefGet, result);

  return result;
}

int GetRoadSafetyMessageReducedSpeedZoneContainerParams(LONG packetHandle, struct RoadSafetyMessageReducedSpeedZoneContainer value, char oldPath[])
{
  char newPath[300];
  int result;

  result = 0;

  snprintf(newPath, elcount(newPath), "%s.%s", oldPath, "speedLimit");
  GetRoadSafetyMessageCommon_RegulatorySpeedLimitParams(packetHandle, value.speedLimit, newPath);
  result = CheckLastError("RoadSafetyMessage", gkFuncRefGet, result);

  snprintf(newPath, elcount(newPath), "%s.%s", oldPath, "rszRegion");
  GetRoadSafetyMessageRegionInfoParams(packetHandle, value.rszRegion, newPath);
  result = CheckLastError("RoadSafetyMessage", gkFuncRefGet, result);

  return result;
}

int SetRoadSafetyMessageReducedSpeedZoneContainerParams(LONG packetHandle, struct RoadSafetyMessageReducedSpeedZoneContainer value, char oldPath[])
{
  char newPath[300];
  int result;

  result = 0;

  snprintf(newPath, elcount(newPath), "%s.%s", oldPath, "speedLimit");
  SetRoadSafetyMessageCommon_RegulatorySpeedLimitParams(packetHandle, value.speedLimit, newPath);
  result = CheckLastError("RoadSafetyMessage", gkFuncRefGet, result);

  snprintf(newPath, elcount(newPath), "%s.%s", oldPath, "rszRegion");
  SetRoadSafetyMessageRegionInfoParams(packetHandle, value.rszRegion, newPath);
  result = CheckLastError("RoadSafetyMessage", gkFuncRefGet, result);

  return result;
}

int GetRoadSafetyMessageLaneInfoParams(LONG packetHandle, struct RoadSafetyMessageLaneInfo value, char oldPath[])
{
  char newPath[300];
  int result;

  result = 0;

  snprintf(newPath, elcount(newPath), "%s.%s", oldPath, "lanePosition");
  value.lanePosition = C2xGetTokenInt(packetHandle, "RoadSafetyMessage", newPath);
  result = CheckLastError("RoadSafetyMessage", gkFuncRefGet, result);

  snprintf(newPath, elcount(newPath), "%s.%s", oldPath, "laneClosed");
  value.laneClosed = C2xGetTokenInt64(packetHandle, "RoadSafetyMessage", newPath);
  result = CheckLastError("RoadSafetyMessage", gkFuncRefGet, result);

  snprintf(newPath, elcount(newPath), "%s.%s", oldPath, "laneCloseOffset");
  value.laneCloseOffset.isValidFlag = C2xIsTokenAvailable(packetHandle, "RoadSafetyMessage", newPath);
  if(value.laneCloseOffset.isValidFlag==1)
  {
    value.laneCloseOffset.value = C2xGetTokenInt(packetHandle, "RoadSafetyMessage", newPath);
    result = CheckLastError("RoadSafetyMessage", gkFuncRefGet, result);
  }
  return result;
}

int SetRoadSafetyMessageLaneInfoParams(LONG packetHandle, struct RoadSafetyMessageLaneInfo value, char oldPath[])
{
  char newPath[300];
  int result;

  result = 0;

  snprintf(newPath, elcount(newPath), "%s.%s", oldPath, "lanePosition");
  if (value.lanePosition < 1)
  {
    C2xSetTokenInt(packetHandle, "RoadSafetyMessage", newPath, 1);
  }
  else if (value.lanePosition > 32)
  {
    C2xSetTokenInt(packetHandle, "RoadSafetyMessage", newPath, 32);
  }
  else
  {
    C2xSetTokenInt(packetHandle, "RoadSafetyMessage", newPath, value.lanePosition);
  }
  result = CheckLastError("RoadSafetyMessage", gkFuncRefGet, result);

  snprintf(newPath, elcount(newPath), "%s.%s", oldPath, "laneClosed");
  C2xSetTokenInt64(packetHandle, "RoadSafetyMessage", newPath, value.laneClosed);
  result = CheckLastError("RoadSafetyMessage", gkFuncRefGet, result);

  snprintf(newPath, elcount(newPath), "%s.%s", oldPath, "laneCloseOffset");
  if(value.laneCloseOffset.isValidFlag==1)
  {
    C2xSetTokenInt(packetHandle, "RoadSafetyMessage", newPath, value.laneCloseOffset.value);
    result = CheckLastError("RoadSafetyMessage", gkFuncRefGet, result);
  }
  else
  {
    if( C2xIsTokenAvailable(packetHandle, "RoadSafetyMessage", newPath) )
    {
      C2xRemoveToken(packetHandle, "RoadSafetyMessage", newPath);
    }
  }

  return result;
}

int GetRoadSafetyMessageLaneClosureContainer_laneStatusParams(LONG packetHandle, struct RoadSafetyMessageLaneClosureContainer_laneStatus value, char oldPath[])
{
  char newPath[300]; 
  int i;
  int result;

  result = 0;

  value.length = C2xGetTokenInt(packetHandle, "RoadSafetyMessage", oldPath);
  if((result = CheckLastError("RoadSafetyMessage", gkFuncRefGet, result))==0)
  {
    for(i=0; i<value.length; i++)
    {
      snprintf(newPath, elcount(newPath), "%s[%d]", oldPath, i);
      GetRoadSafetyMessageLaneInfoParams(packetHandle, value.arrayValue[i], newPath);
      result = CheckLastError("RoadSafetyMessage", gkFuncRefGet, result);
    }
  }
  return result;
}

int SetRoadSafetyMessageLaneClosureContainer_laneStatusParams(LONG packetHandle, struct RoadSafetyMessageLaneClosureContainer_laneStatus value, char oldPath[])
{
  char newPath[300]; 
  int i;
  int result;

  result = 0;

  C2xRemoveToken(packetHandle, "RoadSafetyMessage", oldPath);
  for(i=0; i<value.length; i++)
  {
    snprintf(newPath, elcount(newPath), "%s[%d]", oldPath, i);
    SetRoadSafetyMessageLaneInfoParams(packetHandle, value.arrayValue[i], newPath);
    result = CheckLastError("RoadSafetyMessage", gkFuncRefGet, result);
  }
  return result;
}

int GetRoadSafetyMessageLaneClosureContainerParams(LONG packetHandle, struct RoadSafetyMessageLaneClosureContainer value, char oldPath[])
{
  char newPath[300];
  int result;

  result = 0;

  snprintf(newPath, elcount(newPath), "%s.%s", oldPath, "laneStatus");
  value.laneStatus.isValidFlag = C2xIsTokenAvailable(packetHandle, "RoadSafetyMessage", newPath);
  if(value.laneStatus.isValidFlag==1)
  {
    GetRoadSafetyMessageLaneClosureContainer_laneStatusParams(packetHandle, value.laneStatus, newPath);
    result = CheckLastError("RoadSafetyMessage", gkFuncRefGet, result);
  }
  snprintf(newPath, elcount(newPath), "%s.%s", oldPath, "laneStatusVaries");
  value.laneStatusVaries.isValidFlag = C2xIsTokenAvailable(packetHandle, "RoadSafetyMessage", newPath);
  if(value.laneStatusVaries.isValidFlag==1)
  {
    value.laneStatusVaries.value = C2xGetTokenInt64(packetHandle, "RoadSafetyMessage", newPath);
    result = CheckLastError("RoadSafetyMessage", gkFuncRefGet, result);
  }
  snprintf(newPath, elcount(newPath), "%s.%s", oldPath, "closureRegion");
  GetRoadSafetyMessageRegionInfoParams(packetHandle, value.closureRegion, newPath);
  result = CheckLastError("RoadSafetyMessage", gkFuncRefGet, result);

  return result;
}

int SetRoadSafetyMessageLaneClosureContainerParams(LONG packetHandle, struct RoadSafetyMessageLaneClosureContainer value, char oldPath[])
{
  char newPath[300];
  int result;

  result = 0;

  snprintf(newPath, elcount(newPath), "%s.%s", oldPath, "laneStatus");
  if(value.laneStatus.isValidFlag==1)
  {
    SetRoadSafetyMessageLaneClosureContainer_laneStatusParams(packetHandle, value.laneStatus, newPath);
    result = CheckLastError("RoadSafetyMessage", gkFuncRefGet, result);
  }
  else
  {
    if( C2xIsTokenAvailable(packetHandle, "RoadSafetyMessage", newPath) )
    {
      C2xRemoveToken(packetHandle, "RoadSafetyMessage", newPath);
    }
  }

  snprintf(newPath, elcount(newPath), "%s.%s", oldPath, "laneStatusVaries");
  if(value.laneStatusVaries.isValidFlag==1)
  {
    C2xSetTokenInt64(packetHandle, "RoadSafetyMessage", newPath, value.laneStatusVaries.value);
    result = CheckLastError("RoadSafetyMessage", gkFuncRefGet, result);
  }
  else
  {
    if( C2xIsTokenAvailable(packetHandle, "RoadSafetyMessage", newPath) )
    {
      C2xRemoveToken(packetHandle, "RoadSafetyMessage", newPath);
    }
  }

  snprintf(newPath, elcount(newPath), "%s.%s", oldPath, "closureRegion");
  SetRoadSafetyMessageRegionInfoParams(packetHandle, value.closureRegion, newPath);
  result = CheckLastError("RoadSafetyMessage", gkFuncRefGet, result);

  return result;
}

int GetRoadSafetyMessageCommon_PortlandCementParams(LONG packetHandle, struct RoadSafetyMessageCommon_PortlandCement value, char oldPath[])
{
  char newPath[300];
  int result;

  result = 0;

  snprintf(newPath, elcount(newPath), "%s.%s", oldPath, "type");
  value.type = C2xGetTokenInt(packetHandle, "RoadSafetyMessage", newPath);
  result = CheckLastError("RoadSafetyMessage", gkFuncRefGet, result);

  return result;
}

int SetRoadSafetyMessageCommon_PortlandCementParams(LONG packetHandle, struct RoadSafetyMessageCommon_PortlandCement value, char oldPath[])
{
  char newPath[300];
  int result;

  result = 0;

  snprintf(newPath, elcount(newPath), "%s.%s", oldPath, "type");
  C2xSetTokenInt(packetHandle, "RoadSafetyMessage", newPath, value.type);
  result = CheckLastError("RoadSafetyMessage", gkFuncRefGet, result);

  return result;
}

int GetRoadSafetyMessageCommon_AsphaltOrTarParams(LONG packetHandle, struct RoadSafetyMessageCommon_AsphaltOrTar value, char oldPath[])
{
  char newPath[300];
  int result;

  result = 0;

  snprintf(newPath, elcount(newPath), "%s.%s", oldPath, "type");
  value.type = C2xGetTokenInt(packetHandle, "RoadSafetyMessage", newPath);
  result = CheckLastError("RoadSafetyMessage", gkFuncRefGet, result);

  return result;
}

int SetRoadSafetyMessageCommon_AsphaltOrTarParams(LONG packetHandle, struct RoadSafetyMessageCommon_AsphaltOrTar value, char oldPath[])
{
  char newPath[300];
  int result;

  result = 0;

  snprintf(newPath, elcount(newPath), "%s.%s", oldPath, "type");
  C2xSetTokenInt(packetHandle, "RoadSafetyMessage", newPath, value.type);
  result = CheckLastError("RoadSafetyMessage", gkFuncRefGet, result);

  return result;
}

int GetRoadSafetyMessageCommon_GravelParams(LONG packetHandle, struct RoadSafetyMessageCommon_Gravel value, char oldPath[])
{
  char newPath[300];
  int result;

  result = 0;

  snprintf(newPath, elcount(newPath), "%s.%s", oldPath, "type");
  value.type = C2xGetTokenInt(packetHandle, "RoadSafetyMessage", newPath);
  result = CheckLastError("RoadSafetyMessage", gkFuncRefGet, result);

  return result;
}

int SetRoadSafetyMessageCommon_GravelParams(LONG packetHandle, struct RoadSafetyMessageCommon_Gravel value, char oldPath[])
{
  char newPath[300];
  int result;

  result = 0;

  snprintf(newPath, elcount(newPath), "%s.%s", oldPath, "type");
  C2xSetTokenInt(packetHandle, "RoadSafetyMessage", newPath, value.type);
  result = CheckLastError("RoadSafetyMessage", gkFuncRefGet, result);

  return result;
}

int GetRoadSafetyMessageCommon_GrassParams(LONG packetHandle, struct RoadSafetyMessageCommon_Grass value, char oldPath[])
{
  char newPath[300];
  int result;

  result = 0;

  snprintf(newPath, elcount(newPath), "%s.%s", oldPath, "type");
  value.type = C2xGetTokenInt(packetHandle, "RoadSafetyMessage", newPath);
  result = CheckLastError("RoadSafetyMessage", gkFuncRefGet, result);

  return result;
}

int SetRoadSafetyMessageCommon_GrassParams(LONG packetHandle, struct RoadSafetyMessageCommon_Grass value, char oldPath[])
{
  char newPath[300];
  int result;

  result = 0;

  snprintf(newPath, elcount(newPath), "%s.%s", oldPath, "type");
  C2xSetTokenInt(packetHandle, "RoadSafetyMessage", newPath, value.type);
  result = CheckLastError("RoadSafetyMessage", gkFuncRefGet, result);

  return result;
}

int GetRoadSafetyMessageCommon_CindersParams(LONG packetHandle, struct RoadSafetyMessageCommon_Cinders value, char oldPath[])
{
  char newPath[300];
  int result;

  result = 0;

  snprintf(newPath, elcount(newPath), "%s.%s", oldPath, "type");
  value.type = C2xGetTokenInt(packetHandle, "RoadSafetyMessage", newPath);
  result = CheckLastError("RoadSafetyMessage", gkFuncRefGet, result);

  return result;
}

int SetRoadSafetyMessageCommon_CindersParams(LONG packetHandle, struct RoadSafetyMessageCommon_Cinders value, char oldPath[])
{
  char newPath[300];
  int result;

  result = 0;

  snprintf(newPath, elcount(newPath), "%s.%s", oldPath, "type");
  C2xSetTokenInt(packetHandle, "RoadSafetyMessage", newPath, value.type);
  result = CheckLastError("RoadSafetyMessage", gkFuncRefGet, result);

  return result;
}

int GetRoadSafetyMessageCommon_RockParams(LONG packetHandle, struct RoadSafetyMessageCommon_Rock value, char oldPath[])
{
  char newPath[300];
  int result;

  result = 0;

  snprintf(newPath, elcount(newPath), "%s.%s", oldPath, "type");
  value.type = C2xGetTokenInt(packetHandle, "RoadSafetyMessage", newPath);
  result = CheckLastError("RoadSafetyMessage", gkFuncRefGet, result);

  return result;
}

int SetRoadSafetyMessageCommon_RockParams(LONG packetHandle, struct RoadSafetyMessageCommon_Rock value, char oldPath[])
{
  char newPath[300];
  int result;

  result = 0;

  snprintf(newPath, elcount(newPath), "%s.%s", oldPath, "type");
  C2xSetTokenInt(packetHandle, "RoadSafetyMessage", newPath, value.type);
  result = CheckLastError("RoadSafetyMessage", gkFuncRefGet, result);

  return result;
}

int GetRoadSafetyMessageCommon_IceParams(LONG packetHandle, struct RoadSafetyMessageCommon_Ice value, char oldPath[])
{
  char newPath[300];
  int result;

  result = 0;

  snprintf(newPath, elcount(newPath), "%s.%s", oldPath, "type");
  value.type = C2xGetTokenInt(packetHandle, "RoadSafetyMessage", newPath);
  result = CheckLastError("RoadSafetyMessage", gkFuncRefGet, result);

  return result;
}

int SetRoadSafetyMessageCommon_IceParams(LONG packetHandle, struct RoadSafetyMessageCommon_Ice value, char oldPath[])
{
  char newPath[300];
  int result;

  result = 0;

  snprintf(newPath, elcount(newPath), "%s.%s", oldPath, "type");
  C2xSetTokenInt(packetHandle, "RoadSafetyMessage", newPath, value.type);
  result = CheckLastError("RoadSafetyMessage", gkFuncRefGet, result);

  return result;
}

int GetRoadSafetyMessageCommon_SnowParams(LONG packetHandle, struct RoadSafetyMessageCommon_Snow value, char oldPath[])
{
  char newPath[300];
  int result;

  result = 0;

  snprintf(newPath, elcount(newPath), "%s.%s", oldPath, "type");
  value.type = C2xGetTokenInt(packetHandle, "RoadSafetyMessage", newPath);
  result = CheckLastError("RoadSafetyMessage", gkFuncRefGet, result);

  return result;
}

int SetRoadSafetyMessageCommon_SnowParams(LONG packetHandle, struct RoadSafetyMessageCommon_Snow value, char oldPath[])
{
  char newPath[300];
  int result;

  result = 0;

  snprintf(newPath, elcount(newPath), "%s.%s", oldPath, "type");
  C2xSetTokenInt(packetHandle, "RoadSafetyMessage", newPath, value.type);
  result = CheckLastError("RoadSafetyMessage", gkFuncRefGet, result);

  return result;
}

int GetRoadSafetyMessageCommon_DescriptionOfRoadSurfaceParams(LONG packetHandle, struct RoadSafetyMessageCommon_DescriptionOfRoadSurface value, char oldPath[])
{
  char newPath[300];
  int result;

  result = 0;

  value.choice = C2xGetTokenInt(packetHandle, "RoadSafetyMessage", oldPath);

  switch(value.choice)
  {
    case 0:
    {
      snprintf(newPath, elcount(newPath), "%s.%s", oldPath, "portlandCement");
      GetRoadSafetyMessageCommon_PortlandCementParams(packetHandle, value.portlandCement, newPath);
      result = CheckLastError("RoadSafetyMessage", gkFuncRefGet, result);
    }
    break;
    case 1:
    {
      snprintf(newPath, elcount(newPath), "%s.%s", oldPath, "asphaltOrTar");
      GetRoadSafetyMessageCommon_AsphaltOrTarParams(packetHandle, value.asphaltOrTar, newPath);
      result = CheckLastError("RoadSafetyMessage", gkFuncRefGet, result);
    }
    break;
    case 2:
    {
      snprintf(newPath, elcount(newPath), "%s.%s", oldPath, "gravel");
      GetRoadSafetyMessageCommon_GravelParams(packetHandle, value.gravel, newPath);
      result = CheckLastError("RoadSafetyMessage", gkFuncRefGet, result);
    }
    break;
    case 3:
    {
      snprintf(newPath, elcount(newPath), "%s.%s", oldPath, "grass");
      GetRoadSafetyMessageCommon_GrassParams(packetHandle, value.grass, newPath);
      result = CheckLastError("RoadSafetyMessage", gkFuncRefGet, result);
    }
    break;
    case 4:
    {
      snprintf(newPath, elcount(newPath), "%s.%s", oldPath, "cinders");
      GetRoadSafetyMessageCommon_CindersParams(packetHandle, value.cinders, newPath);
      result = CheckLastError("RoadSafetyMessage", gkFuncRefGet, result);
    }
    break;
    case 5:
    {
      snprintf(newPath, elcount(newPath), "%s.%s", oldPath, "rock");
      GetRoadSafetyMessageCommon_RockParams(packetHandle, value.rock, newPath);
      result = CheckLastError("RoadSafetyMessage", gkFuncRefGet, result);
    }
    break;
    case 6:
    {
      snprintf(newPath, elcount(newPath), "%s.%s", oldPath, "ice");
      GetRoadSafetyMessageCommon_IceParams(packetHandle, value.ice, newPath);
      result = CheckLastError("RoadSafetyMessage", gkFuncRefGet, result);
    }
    break;
    case 7:
    {
      snprintf(newPath, elcount(newPath), "%s.%s", oldPath, "snow");
      GetRoadSafetyMessageCommon_SnowParams(packetHandle, value.snow, newPath);
      result = CheckLastError("RoadSafetyMessage", gkFuncRefGet, result);
    }
    break;
  }
  return result;
}

int SetRoadSafetyMessageCommon_DescriptionOfRoadSurfaceParams(LONG packetHandle, struct RoadSafetyMessageCommon_DescriptionOfRoadSurface value, char oldPath[])
{
  char newPath[300];
  int result;

  result = 0;

  switch(value.choice)
  {
    case 0:
    {
      snprintf(newPath, elcount(newPath), "%s.%s", oldPath, "portlandCement");
      SetRoadSafetyMessageCommon_PortlandCementParams(packetHandle, value.portlandCement, newPath);
      result = CheckLastError("RoadSafetyMessage", gkFuncRefGet, result);
    }
    break;
    case 1:
    {
      snprintf(newPath, elcount(newPath), "%s.%s", oldPath, "asphaltOrTar");
      SetRoadSafetyMessageCommon_AsphaltOrTarParams(packetHandle, value.asphaltOrTar, newPath);
      result = CheckLastError("RoadSafetyMessage", gkFuncRefGet, result);
    }
    break;
    case 2:
    {
      snprintf(newPath, elcount(newPath), "%s.%s", oldPath, "gravel");
      SetRoadSafetyMessageCommon_GravelParams(packetHandle, value.gravel, newPath);
      result = CheckLastError("RoadSafetyMessage", gkFuncRefGet, result);
    }
    break;
    case 3:
    {
      snprintf(newPath, elcount(newPath), "%s.%s", oldPath, "grass");
      SetRoadSafetyMessageCommon_GrassParams(packetHandle, value.grass, newPath);
      result = CheckLastError("RoadSafetyMessage", gkFuncRefGet, result);
    }
    break;
    case 4:
    {
      snprintf(newPath, elcount(newPath), "%s.%s", oldPath, "cinders");
      SetRoadSafetyMessageCommon_CindersParams(packetHandle, value.cinders, newPath);
      result = CheckLastError("RoadSafetyMessage", gkFuncRefGet, result);
    }
    break;
    case 5:
    {
      snprintf(newPath, elcount(newPath), "%s.%s", oldPath, "rock");
      SetRoadSafetyMessageCommon_RockParams(packetHandle, value.rock, newPath);
      result = CheckLastError("RoadSafetyMessage", gkFuncRefGet, result);
    }
    break;
    case 6:
    {
      snprintf(newPath, elcount(newPath), "%s.%s", oldPath, "ice");
      SetRoadSafetyMessageCommon_IceParams(packetHandle, value.ice, newPath);
      result = CheckLastError("RoadSafetyMessage", gkFuncRefGet, result);
    }
    break;
    case 7:
    {
      snprintf(newPath, elcount(newPath), "%s.%s", oldPath, "snow");
      SetRoadSafetyMessageCommon_SnowParams(packetHandle, value.snow, newPath);
      result = CheckLastError("RoadSafetyMessage", gkFuncRefGet, result);
    }
    break;
  }
  return result;
}

int GetRoadSafetyMessageCommon_RoadRoughnessParams(LONG packetHandle, struct RoadSafetyMessageCommon_RoadRoughness value, char oldPath[])
{
  char newPath[300];
  int result;

  result = 0;

  snprintf(newPath, elcount(newPath), "%s.%s", oldPath, "meanVerticalVariation");
  value.meanVerticalVariation = C2xGetTokenInt(packetHandle, "RoadSafetyMessage", newPath);
  result = CheckLastError("RoadSafetyMessage", gkFuncRefGet, result);

  snprintf(newPath, elcount(newPath), "%s.%s", oldPath, "verticalVariationStdDev");
  value.verticalVariationStdDev.isValidFlag = C2xIsTokenAvailable(packetHandle, "RoadSafetyMessage", newPath);
  if(value.verticalVariationStdDev.isValidFlag==1)
  {
    value.verticalVariationStdDev.value = C2xGetTokenInt(packetHandle, "RoadSafetyMessage", newPath);
    result = CheckLastError("RoadSafetyMessage", gkFuncRefGet, result);
  }
  snprintf(newPath, elcount(newPath), "%s.%s", oldPath, "meanHorizontalVariation");
  value.meanHorizontalVariation.isValidFlag = C2xIsTokenAvailable(packetHandle, "RoadSafetyMessage", newPath);
  if(value.meanHorizontalVariation.isValidFlag==1)
  {
    value.meanHorizontalVariation.value = C2xGetTokenInt(packetHandle, "RoadSafetyMessage", newPath);
    result = CheckLastError("RoadSafetyMessage", gkFuncRefGet, result);
  }
  snprintf(newPath, elcount(newPath), "%s.%s", oldPath, "horizontalVariationStdDev");
  value.horizontalVariationStdDev.isValidFlag = C2xIsTokenAvailable(packetHandle, "RoadSafetyMessage", newPath);
  if(value.horizontalVariationStdDev.isValidFlag==1)
  {
    value.horizontalVariationStdDev.value = C2xGetTokenInt(packetHandle, "RoadSafetyMessage", newPath);
    result = CheckLastError("RoadSafetyMessage", gkFuncRefGet, result);
  }
  return result;
}

int SetRoadSafetyMessageCommon_RoadRoughnessParams(LONG packetHandle, struct RoadSafetyMessageCommon_RoadRoughness value, char oldPath[])
{
  char newPath[300];
  int result;

  result = 0;

  snprintf(newPath, elcount(newPath), "%s.%s", oldPath, "meanVerticalVariation");
  C2xSetTokenInt(packetHandle, "RoadSafetyMessage", newPath, value.meanVerticalVariation);
  result = CheckLastError("RoadSafetyMessage", gkFuncRefGet, result);

  snprintf(newPath, elcount(newPath), "%s.%s", oldPath, "verticalVariationStdDev");
  if(value.verticalVariationStdDev.isValidFlag==1)
  {
    C2xSetTokenInt(packetHandle, "RoadSafetyMessage", newPath, value.verticalVariationStdDev.value);
    result = CheckLastError("RoadSafetyMessage", gkFuncRefGet, result);
  }
  else
  {
    if( C2xIsTokenAvailable(packetHandle, "RoadSafetyMessage", newPath) )
    {
      C2xRemoveToken(packetHandle, "RoadSafetyMessage", newPath);
    }
  }

  snprintf(newPath, elcount(newPath), "%s.%s", oldPath, "meanHorizontalVariation");
  if(value.meanHorizontalVariation.isValidFlag==1)
  {
    C2xSetTokenInt(packetHandle, "RoadSafetyMessage", newPath, value.meanHorizontalVariation.value);
    result = CheckLastError("RoadSafetyMessage", gkFuncRefGet, result);
  }
  else
  {
    if( C2xIsTokenAvailable(packetHandle, "RoadSafetyMessage", newPath) )
    {
      C2xRemoveToken(packetHandle, "RoadSafetyMessage", newPath);
    }
  }

  snprintf(newPath, elcount(newPath), "%s.%s", oldPath, "horizontalVariationStdDev");
  if(value.horizontalVariationStdDev.isValidFlag==1)
  {
    C2xSetTokenInt(packetHandle, "RoadSafetyMessage", newPath, value.horizontalVariationStdDev.value);
    result = CheckLastError("RoadSafetyMessage", gkFuncRefGet, result);
  }
  else
  {
    if( C2xIsTokenAvailable(packetHandle, "RoadSafetyMessage", newPath) )
    {
      C2xRemoveToken(packetHandle, "RoadSafetyMessage", newPath);
    }
  }

  return result;
}

int GetRoadSafetyMessageCommon_FrictionInformationParams(LONG packetHandle, struct RoadSafetyMessageCommon_FrictionInformation value, char oldPath[])
{
  char newPath[300];
  int result;

  result = 0;

  snprintf(newPath, elcount(newPath), "%s.%s", oldPath, "roadSurfaceDescription");
  GetRoadSafetyMessageCommon_DescriptionOfRoadSurfaceParams(packetHandle, value.roadSurfaceDescription, newPath);
  result = CheckLastError("RoadSafetyMessage", gkFuncRefGet, result);

  snprintf(newPath, elcount(newPath), "%s.%s", oldPath, "dryOrWet");
  value.dryOrWet.isValidFlag = C2xIsTokenAvailable(packetHandle, "RoadSafetyMessage", newPath);
  if(value.dryOrWet.isValidFlag==1)
  {
    value.dryOrWet.value = C2xGetTokenInt(packetHandle, "RoadSafetyMessage", newPath);
    result = CheckLastError("RoadSafetyMessage", gkFuncRefGet, result);
  }
  snprintf(newPath, elcount(newPath), "%s.%s", oldPath, "roadRoughness");
  value.roadRoughness.isValidFlag = C2xIsTokenAvailable(packetHandle, "RoadSafetyMessage", newPath);
  if(value.roadRoughness.isValidFlag==1)
  {
    GetRoadSafetyMessageCommon_RoadRoughnessParams(packetHandle, value.roadRoughness, newPath);
    result = CheckLastError("RoadSafetyMessage", gkFuncRefGet, result);
  }
  return result;
}

int SetRoadSafetyMessageCommon_FrictionInformationParams(LONG packetHandle, struct RoadSafetyMessageCommon_FrictionInformation value, char oldPath[])
{
  char newPath[300];
  int result;

  result = 0;

  snprintf(newPath, elcount(newPath), "%s.%s", oldPath, "roadSurfaceDescription");
  SetRoadSafetyMessageCommon_DescriptionOfRoadSurfaceParams(packetHandle, value.roadSurfaceDescription, newPath);
  result = CheckLastError("RoadSafetyMessage", gkFuncRefGet, result);

  snprintf(newPath, elcount(newPath), "%s.%s", oldPath, "dryOrWet");
  if(value.dryOrWet.isValidFlag==1)
  {
    C2xSetTokenInt(packetHandle, "RoadSafetyMessage", newPath, value.dryOrWet.value);
    result = CheckLastError("RoadSafetyMessage", gkFuncRefGet, result);
  }
  else
  {
    if( C2xIsTokenAvailable(packetHandle, "RoadSafetyMessage", newPath) )
    {
      C2xRemoveToken(packetHandle, "RoadSafetyMessage", newPath);
    }
  }

  snprintf(newPath, elcount(newPath), "%s.%s", oldPath, "roadRoughness");
  if(value.roadRoughness.isValidFlag==1)
  {
    SetRoadSafetyMessageCommon_RoadRoughnessParams(packetHandle, value.roadRoughness, newPath);
    result = CheckLastError("RoadSafetyMessage", gkFuncRefGet, result);
  }
  else
  {
    if( C2xIsTokenAvailable(packetHandle, "RoadSafetyMessage", newPath) )
    {
      C2xRemoveToken(packetHandle, "RoadSafetyMessage", newPath);
    }
  }

  return result;
}

int GetRoadSafetyMessageCurveContainerParams(LONG packetHandle, struct RoadSafetyMessageCurveContainer value, char oldPath[])
{
  char newPath[300];
  int result;

  result = 0;

  snprintf(newPath, elcount(newPath), "%s.%s", oldPath, "advisorySpeed");
  value.advisorySpeed = C2xGetTokenInt(packetHandle, "RoadSafetyMessage", newPath);
  result = CheckLastError("RoadSafetyMessage", gkFuncRefGet, result);

  snprintf(newPath, elcount(newPath), "%s.%s", oldPath, "surfaceCondition");
  value.surfaceCondition.isValidFlag = C2xIsTokenAvailable(packetHandle, "RoadSafetyMessage", newPath);
  if(value.surfaceCondition.isValidFlag==1)
  {
    GetRoadSafetyMessageCommon_FrictionInformationParams(packetHandle, value.surfaceCondition, newPath);
    result = CheckLastError("RoadSafetyMessage", gkFuncRefGet, result);
  }
  snprintf(newPath, elcount(newPath), "%s.%s", oldPath, "minRadius");
  value.minRadius.isValidFlag = C2xIsTokenAvailable(packetHandle, "RoadSafetyMessage", newPath);
  if(value.minRadius.isValidFlag==1)
  {
    value.minRadius.value = C2xGetTokenInt(packetHandle, "RoadSafetyMessage", newPath);
    result = CheckLastError("RoadSafetyMessage", gkFuncRefGet, result);
  }
  snprintf(newPath, elcount(newPath), "%s.%s", oldPath, "bankAngle");
  value.bankAngle.isValidFlag = C2xIsTokenAvailable(packetHandle, "RoadSafetyMessage", newPath);
  if(value.bankAngle.isValidFlag==1)
  {
    value.bankAngle.value = C2xGetTokenInt(packetHandle, "RoadSafetyMessage", newPath);
    result = CheckLastError("RoadSafetyMessage", gkFuncRefGet, result);
  }
  snprintf(newPath, elcount(newPath), "%s.%s", oldPath, "curveRegion");
  value.curveRegion.isValidFlag = C2xIsTokenAvailable(packetHandle, "RoadSafetyMessage", newPath);
  if(value.curveRegion.isValidFlag==1)
  {
    GetRoadSafetyMessageRegionInfoParams(packetHandle, value.curveRegion, newPath);
    result = CheckLastError("RoadSafetyMessage", gkFuncRefGet, result);
  }
  return result;
}

int SetRoadSafetyMessageCurveContainerParams(LONG packetHandle, struct RoadSafetyMessageCurveContainer value, char oldPath[])
{
  char newPath[300];
  int result;

  result = 0;

  snprintf(newPath, elcount(newPath), "%s.%s", oldPath, "advisorySpeed");
  C2xSetTokenInt(packetHandle, "RoadSafetyMessage", newPath, value.advisorySpeed);
  result = CheckLastError("RoadSafetyMessage", gkFuncRefGet, result);

  snprintf(newPath, elcount(newPath), "%s.%s", oldPath, "surfaceCondition");
  if(value.surfaceCondition.isValidFlag==1)
  {
    SetRoadSafetyMessageCommon_FrictionInformationParams(packetHandle, value.surfaceCondition, newPath);
    result = CheckLastError("RoadSafetyMessage", gkFuncRefGet, result);
  }
  else
  {
    if( C2xIsTokenAvailable(packetHandle, "RoadSafetyMessage", newPath) )
    {
      C2xRemoveToken(packetHandle, "RoadSafetyMessage", newPath);
    }
  }

  snprintf(newPath, elcount(newPath), "%s.%s", oldPath, "minRadius");
  if(value.minRadius.isValidFlag==1)
  {
    C2xSetTokenInt(packetHandle, "RoadSafetyMessage", newPath, value.minRadius.value);
    result = CheckLastError("RoadSafetyMessage", gkFuncRefGet, result);
  }
  else
  {
    if( C2xIsTokenAvailable(packetHandle, "RoadSafetyMessage", newPath) )
    {
      C2xRemoveToken(packetHandle, "RoadSafetyMessage", newPath);
    }
  }

  snprintf(newPath, elcount(newPath), "%s.%s", oldPath, "bankAngle");
  if(value.bankAngle.isValidFlag==1)
  {
    C2xSetTokenInt(packetHandle, "RoadSafetyMessage", newPath, value.bankAngle.value);
    result = CheckLastError("RoadSafetyMessage", gkFuncRefGet, result);
  }
  else
  {
    if( C2xIsTokenAvailable(packetHandle, "RoadSafetyMessage", newPath) )
    {
      C2xRemoveToken(packetHandle, "RoadSafetyMessage", newPath);
    }
  }

  snprintf(newPath, elcount(newPath), "%s.%s", oldPath, "curveRegion");
  if(value.curveRegion.isValidFlag==1)
  {
    SetRoadSafetyMessageRegionInfoParams(packetHandle, value.curveRegion, newPath);
    result = CheckLastError("RoadSafetyMessage", gkFuncRefGet, result);
  }
  else
  {
    if( C2xIsTokenAvailable(packetHandle, "RoadSafetyMessage", newPath) )
    {
      C2xRemoveToken(packetHandle, "RoadSafetyMessage", newPath);
    }
  }

  return result;
}

int GetRoadSafetyMessageDynamicInfoContainer_dmsSignStringParams(LONG packetHandle, struct RoadSafetyMessageDynamicInfoContainer_dmsSignString value, char oldPath[])
{
  char newPath[300]; 
  int i;
  int result;

  result = 0;

  value.isValidFlag = C2xIsTokenAvailable(packetHandle, "RoadSafetyMessage", oldPath);
  if((result = CheckLastError("RoadSafetyMessage", gkFuncRefGet, result))==0)
  {
    for(i=0; i<value.length; i++)
    {
      snprintf(newPath, elcount(newPath), "%s[%d]", oldPath, i);
      value.arrayValue[i].stringLength = C2xGetTokenData(packetHandle, "RoadSafetyMessage", oldPath, elcount(value.arrayValue[i].string), value.arrayValue[i].string);
      result = CheckLastError("RoadSafetyMessage", gkFuncRefGet, result);
    }
  }
  return result;
}

int SetRoadSafetyMessageDynamicInfoContainer_dmsSignStringParams(LONG packetHandle, struct RoadSafetyMessageDynamicInfoContainer_dmsSignString value, char oldPath[])
{
  char newPath[300]; 
  int i;
  int result;

  result = 0;

  C2xRemoveToken(packetHandle, "RoadSafetyMessage", oldPath);
  for(i=0; i<value.length; i++)
  {
    snprintf(newPath, elcount(newPath), "%s[%d]", oldPath, i);
    C2xSetTokenData(packetHandle, "RoadSafetyMessage", newPath, value.arrayValue[i].stringLength, value.arrayValue[i].string);
    result = CheckLastError("RoadSafetyMessage", gkFuncRefGet, result);
  }
  return result;
}

int GetRoadSafetyMessageDynamicInfoContainerParams(LONG packetHandle, struct RoadSafetyMessageDynamicInfoContainer value, char oldPath[])
{
  char newPath[300];
  int result;

  result = 0;

  snprintf(newPath, elcount(newPath), "%s.%s", oldPath, "priority");
  value.priority = C2xGetTokenInt(packetHandle, "RoadSafetyMessage", newPath);
  result = CheckLastError("RoadSafetyMessage", gkFuncRefGet, result);

  snprintf(newPath, elcount(newPath), "%s.%s", oldPath, "dmsSignString");
  GetRoadSafetyMessageDynamicInfoContainer_dmsSignStringParams(packetHandle, value.dmsSignString, newPath);
  result = CheckLastError("RoadSafetyMessage", gkFuncRefGet, result);

  snprintf(newPath, elcount(newPath), "%s.%s", oldPath, "applicableRegion");
  GetRoadSafetyMessageRegionInfoParams(packetHandle, value.applicableRegion, newPath);
  result = CheckLastError("RoadSafetyMessage", gkFuncRefGet, result);

  return result;
}

int SetRoadSafetyMessageDynamicInfoContainerParams(LONG packetHandle, struct RoadSafetyMessageDynamicInfoContainer value, char oldPath[])
{
  char newPath[300];
  int result;

  result = 0;

  snprintf(newPath, elcount(newPath), "%s.%s", oldPath, "priority");
  C2xSetTokenInt(packetHandle, "RoadSafetyMessage", newPath, value.priority);
  result = CheckLastError("RoadSafetyMessage", gkFuncRefGet, result);

  snprintf(newPath, elcount(newPath), "%s.%s", oldPath, "dmsSignString");
  SetRoadSafetyMessageDynamicInfoContainer_dmsSignStringParams(packetHandle, value.dmsSignString, newPath);
  result = CheckLastError("RoadSafetyMessage", gkFuncRefGet, result);

  snprintf(newPath, elcount(newPath), "%s.%s", oldPath, "applicableRegion");
  SetRoadSafetyMessageRegionInfoParams(packetHandle, value.applicableRegion, newPath);
  result = CheckLastError("RoadSafetyMessage", gkFuncRefGet, result);

  return result;
}

int GetRoadSafetyMessageIncidentsContainer_responderTypeParams(LONG packetHandle, struct RoadSafetyMessageIncidentsContainer_responderType value, char oldPath[])
{
  char newPath[300]; 
  int i;
  int result;

  result = 0;

  value.length = C2xGetTokenInt(packetHandle, "RoadSafetyMessage", oldPath);
  if((result = CheckLastError("RoadSafetyMessage", gkFuncRefGet, result))==0)
  {
    for(i=0; i<value.length; i++)
    {
      snprintf(newPath, elcount(newPath), "%s[%d]", oldPath, i);
      value.arrayValue[i] = C2xGetTokenInt64(packetHandle, "RoadSafetyMessage", newPath);
      result = CheckLastError("RoadSafetyMessage", gkFuncRefGet, result);
    }
  }
  return result;
}

int SetRoadSafetyMessageIncidentsContainer_responderTypeParams(LONG packetHandle, struct RoadSafetyMessageIncidentsContainer_responderType value, char oldPath[])
{
  char newPath[300]; 
  int i;
  int result;

  result = 0;

  C2xRemoveToken(packetHandle, "RoadSafetyMessage", oldPath);
  for(i=0; i<value.length; i++)
  {
    snprintf(newPath, elcount(newPath), "%s[%d]", oldPath, i);
    C2xSetTokenInt64(packetHandle, "RoadSafetyMessage", newPath, value.arrayValue[i]);
    result = CheckLastError("RoadSafetyMessage", gkFuncRefGet, result);
  }
  return result;
}

int GetRoadSafetyMessageIncidentsContainerParams(LONG packetHandle, struct RoadSafetyMessageIncidentsContainer value, char oldPath[])
{
  char newPath[300];
  int result;

  result = 0;

  snprintf(newPath, elcount(newPath), "%s.%s", oldPath, "responderType");
  value.responderType.isValidFlag = C2xIsTokenAvailable(packetHandle, "RoadSafetyMessage", newPath);
  if(value.responderType.isValidFlag==1)
  {
    GetRoadSafetyMessageIncidentsContainer_responderTypeParams(packetHandle, value.responderType, newPath);
    result = CheckLastError("RoadSafetyMessage", gkFuncRefGet, result);
  }
  snprintf(newPath, elcount(newPath), "%s.%s", oldPath, "incidentLocation");
  GetRoadSafetyMessageRegionInfoParams(packetHandle, value.incidentLocation, newPath);
  result = CheckLastError("RoadSafetyMessage", gkFuncRefGet, result);

  return result;
}

int SetRoadSafetyMessageIncidentsContainerParams(LONG packetHandle, struct RoadSafetyMessageIncidentsContainer value, char oldPath[])
{
  char newPath[300];
  int result;

  result = 0;

  snprintf(newPath, elcount(newPath), "%s.%s", oldPath, "responderType");
  if(value.responderType.isValidFlag==1)
  {
    SetRoadSafetyMessageIncidentsContainer_responderTypeParams(packetHandle, value.responderType, newPath);
    result = CheckLastError("RoadSafetyMessage", gkFuncRefGet, result);
  }
  else
  {
    if( C2xIsTokenAvailable(packetHandle, "RoadSafetyMessage", newPath) )
    {
      C2xRemoveToken(packetHandle, "RoadSafetyMessage", newPath);
    }
  }

  snprintf(newPath, elcount(newPath), "%s.%s", oldPath, "incidentLocation");
  SetRoadSafetyMessageRegionInfoParams(packetHandle, value.incidentLocation, newPath);
  result = CheckLastError("RoadSafetyMessage", gkFuncRefGet, result);

  return result;
}

int GetRoadSafetyMessageObstructionsParams(LONG packetHandle, struct RoadSafetyMessageObstructions value, char oldPath[])
{
  char newPath[300];
  int result;

  result = 0;

  snprintf(newPath, elcount(newPath), "%s.%s", oldPath, "location");
  GetRoadSafetyMessageCommon_Position3DParams(packetHandle, value.location, newPath);
  result = CheckLastError("RoadSafetyMessage", gkFuncRefGet, result);

  snprintf(newPath, elcount(newPath), "%s.%s", oldPath, "description");
  value.description.isValidFlag = C2xIsTokenAvailable(packetHandle, "RoadSafetyMessage", newPath);
  if(value.description.isValidFlag==1)
  {
    value.description.value = C2xGetTokenInt(packetHandle, "RoadSafetyMessage", newPath);
    result = CheckLastError("RoadSafetyMessage", gkFuncRefGet, result);
  }
  return result;
}

int SetRoadSafetyMessageObstructionsParams(LONG packetHandle, struct RoadSafetyMessageObstructions value, char oldPath[])
{
  char newPath[300];
  int result;

  result = 0;

  snprintf(newPath, elcount(newPath), "%s.%s", oldPath, "location");
  SetRoadSafetyMessageCommon_Position3DParams(packetHandle, value.location, newPath);
  result = CheckLastError("RoadSafetyMessage", gkFuncRefGet, result);

  snprintf(newPath, elcount(newPath), "%s.%s", oldPath, "description");
  if(value.description.isValidFlag==1)
  {
    C2xSetTokenInt(packetHandle, "RoadSafetyMessage", newPath, value.description.value);
    result = CheckLastError("RoadSafetyMessage", gkFuncRefGet, result);
  }
  else
  {
    if( C2xIsTokenAvailable(packetHandle, "RoadSafetyMessage", newPath) )
    {
      C2xRemoveToken(packetHandle, "RoadSafetyMessage", newPath);
    }
  }

  return result;
}

int GetRoadSafetyMessageSituationalContainerParams(LONG packetHandle, struct RoadSafetyMessageSituationalContainer value, char oldPath[])
{
  char newPath[300];
  int result;

  result = 0;

  snprintf(newPath, elcount(newPath), "%s.%s", oldPath, "obstructions");
  value.obstructions.isValidFlag = C2xIsTokenAvailable(packetHandle, "RoadSafetyMessage", newPath);
  if(value.obstructions.isValidFlag==1)
  {
    GetRoadSafetyMessageObstructionsParams(packetHandle, value.obstructions, newPath);
    result = CheckLastError("RoadSafetyMessage", gkFuncRefGet, result);
  }
  snprintf(newPath, elcount(newPath), "%s.%s", oldPath, "visibility");
  value.visibility.isValidFlag = C2xIsTokenAvailable(packetHandle, "RoadSafetyMessage", newPath);
  if(value.visibility.isValidFlag==1)
  {
    value.visibility.value = C2xGetTokenInt(packetHandle, "RoadSafetyMessage", newPath);
    result = CheckLastError("RoadSafetyMessage", gkFuncRefGet, result);
  }
  snprintf(newPath, elcount(newPath), "%s.%s", oldPath, "peoplePresent");
  value.peoplePresent.isValidFlag = C2xIsTokenAvailable(packetHandle, "RoadSafetyMessage", newPath);
  if(value.peoplePresent.isValidFlag==1)
  {
    value.peoplePresent.value = C2xGetTokenInt64(packetHandle, "RoadSafetyMessage", newPath);
    result = CheckLastError("RoadSafetyMessage", gkFuncRefGet, result);
  }
  snprintf(newPath, elcount(newPath), "%s.%s", oldPath, "anomalousTraffic");
  value.anomalousTraffic.isValidFlag = C2xIsTokenAvailable(packetHandle, "RoadSafetyMessage", newPath);
  if(value.anomalousTraffic.isValidFlag==1)
  {
    value.anomalousTraffic.value = C2xGetTokenInt64(packetHandle, "RoadSafetyMessage", newPath);
    result = CheckLastError("RoadSafetyMessage", gkFuncRefGet, result);
  }
  snprintf(newPath, elcount(newPath), "%s.%s", oldPath, "applicableRegion");
  GetRoadSafetyMessageRegionInfoParams(packetHandle, value.applicableRegion, newPath);
  result = CheckLastError("RoadSafetyMessage", gkFuncRefGet, result);

  return result;
}

int SetRoadSafetyMessageSituationalContainerParams(LONG packetHandle, struct RoadSafetyMessageSituationalContainer value, char oldPath[])
{
  char newPath[300];
  int result;

  result = 0;

  snprintf(newPath, elcount(newPath), "%s.%s", oldPath, "obstructions");
  if(value.obstructions.isValidFlag==1)
  {
    SetRoadSafetyMessageObstructionsParams(packetHandle, value.obstructions, newPath);
    result = CheckLastError("RoadSafetyMessage", gkFuncRefGet, result);
  }
  else
  {
    if( C2xIsTokenAvailable(packetHandle, "RoadSafetyMessage", newPath) )
    {
      C2xRemoveToken(packetHandle, "RoadSafetyMessage", newPath);
    }
  }

  snprintf(newPath, elcount(newPath), "%s.%s", oldPath, "visibility");
  if(value.visibility.isValidFlag==1)
  {
    C2xSetTokenInt(packetHandle, "RoadSafetyMessage", newPath, value.visibility.value);
    result = CheckLastError("RoadSafetyMessage", gkFuncRefGet, result);
  }
  else
  {
    if( C2xIsTokenAvailable(packetHandle, "RoadSafetyMessage", newPath) )
    {
      C2xRemoveToken(packetHandle, "RoadSafetyMessage", newPath);
    }
  }

  snprintf(newPath, elcount(newPath), "%s.%s", oldPath, "peoplePresent");
  if(value.peoplePresent.isValidFlag==1)
  {
    C2xSetTokenInt64(packetHandle, "RoadSafetyMessage", newPath, value.peoplePresent.value);
    result = CheckLastError("RoadSafetyMessage", gkFuncRefGet, result);
  }
  else
  {
    if( C2xIsTokenAvailable(packetHandle, "RoadSafetyMessage", newPath) )
    {
      C2xRemoveToken(packetHandle, "RoadSafetyMessage", newPath);
    }
  }

  snprintf(newPath, elcount(newPath), "%s.%s", oldPath, "anomalousTraffic");
  if(value.anomalousTraffic.isValidFlag==1)
  {
    C2xSetTokenInt64(packetHandle, "RoadSafetyMessage", newPath, value.anomalousTraffic.value);
    result = CheckLastError("RoadSafetyMessage", gkFuncRefGet, result);
  }
  else
  {
    if( C2xIsTokenAvailable(packetHandle, "RoadSafetyMessage", newPath) )
    {
      C2xRemoveToken(packetHandle, "RoadSafetyMessage", newPath);
    }
  }

  snprintf(newPath, elcount(newPath), "%s.%s", oldPath, "applicableRegion");
  SetRoadSafetyMessageRegionInfoParams(packetHandle, value.applicableRegion, newPath);
  result = CheckLastError("RoadSafetyMessage", gkFuncRefGet, result);

  return result;
}

int GetRoadSafetyMessageContentContainerParams(LONG packetHandle, struct RoadSafetyMessageContentContainer value, char oldPath[])
{
  char newPath[300];
  int result;

  result = 0;

  value.choice = C2xGetTokenInt(packetHandle, "RoadSafetyMessage", oldPath);

  switch(value.choice)
  {
    case 0:
    {
      snprintf(newPath, elcount(newPath), "%s.%s", oldPath, "rszContainer");
      GetRoadSafetyMessageReducedSpeedZoneContainerParams(packetHandle, value.rszContainer, newPath);
      result = CheckLastError("RoadSafetyMessage", gkFuncRefGet, result);
    }
    break;
    case 1:
    {
      snprintf(newPath, elcount(newPath), "%s.%s", oldPath, "laneClosureContainer");
      GetRoadSafetyMessageLaneClosureContainerParams(packetHandle, value.laneClosureContainer, newPath);
      result = CheckLastError("RoadSafetyMessage", gkFuncRefGet, result);
    }
    break;
    case 2:
    {
      snprintf(newPath, elcount(newPath), "%s.%s", oldPath, "curveContainer");
      GetRoadSafetyMessageCurveContainerParams(packetHandle, value.curveContainer, newPath);
      result = CheckLastError("RoadSafetyMessage", gkFuncRefGet, result);
    }
    break;
    case 3:
    {
      snprintf(newPath, elcount(newPath), "%s.%s", oldPath, "dynamicInfoContainer");
      GetRoadSafetyMessageDynamicInfoContainerParams(packetHandle, value.dynamicInfoContainer, newPath);
      result = CheckLastError("RoadSafetyMessage", gkFuncRefGet, result);
    }
    break;
    case 4:
    {
      snprintf(newPath, elcount(newPath), "%s.%s", oldPath, "incidentsContainer");
      GetRoadSafetyMessageIncidentsContainerParams(packetHandle, value.incidentsContainer, newPath);
      result = CheckLastError("RoadSafetyMessage", gkFuncRefGet, result);
    }
    break;
    case 5:
    {
      snprintf(newPath, elcount(newPath), "%s.%s", oldPath, "situationalContainer");
      GetRoadSafetyMessageSituationalContainerParams(packetHandle, value.situationalContainer, newPath);
      result = CheckLastError("RoadSafetyMessage", gkFuncRefGet, result);
    }
    break;
  }
  return result;
}

int SetRoadSafetyMessageContentContainerParams(LONG packetHandle, struct RoadSafetyMessageContentContainer value, char oldPath[])
{
  char newPath[300];
  int result;

  result = 0;

  switch(value.choice)
  {
    case 0:
    {
      snprintf(newPath, elcount(newPath), "%s.%s", oldPath, "rszContainer");
      SetRoadSafetyMessageReducedSpeedZoneContainerParams(packetHandle, value.rszContainer, newPath);
      result = CheckLastError("RoadSafetyMessage", gkFuncRefGet, result);
    }
    break;
    case 1:
    {
      snprintf(newPath, elcount(newPath), "%s.%s", oldPath, "laneClosureContainer");
      SetRoadSafetyMessageLaneClosureContainerParams(packetHandle, value.laneClosureContainer, newPath);
      result = CheckLastError("RoadSafetyMessage", gkFuncRefGet, result);
    }
    break;
    case 2:
    {
      snprintf(newPath, elcount(newPath), "%s.%s", oldPath, "curveContainer");
      SetRoadSafetyMessageCurveContainerParams(packetHandle, value.curveContainer, newPath);
      result = CheckLastError("RoadSafetyMessage", gkFuncRefGet, result);
    }
    break;
    case 3:
    {
      snprintf(newPath, elcount(newPath), "%s.%s", oldPath, "dynamicInfoContainer");
      SetRoadSafetyMessageDynamicInfoContainerParams(packetHandle, value.dynamicInfoContainer, newPath);
      result = CheckLastError("RoadSafetyMessage", gkFuncRefGet, result);
    }
    break;
    case 4:
    {
      snprintf(newPath, elcount(newPath), "%s.%s", oldPath, "incidentsContainer");
      SetRoadSafetyMessageIncidentsContainerParams(packetHandle, value.incidentsContainer, newPath);
      result = CheckLastError("RoadSafetyMessage", gkFuncRefGet, result);
    }
    break;
    case 5:
    {
      snprintf(newPath, elcount(newPath), "%s.%s", oldPath, "situationalContainer");
      SetRoadSafetyMessageSituationalContainerParams(packetHandle, value.situationalContainer, newPath);
      result = CheckLastError("RoadSafetyMessage", gkFuncRefGet, result);
    }
    break;
  }
  return result;
}

int GetRoadSafetyMessageRoadSafetyMessage_contentParams(LONG packetHandle, struct RoadSafetyMessageRoadSafetyMessage_content value, char oldPath[])
{
  char newPath[300]; 
  int i;
  int result;

  result = 0;

  value.length = C2xGetTokenInt(packetHandle, "RoadSafetyMessage", oldPath);
  if((result = CheckLastError("RoadSafetyMessage", gkFuncRefGet, result))==0)
  {
    for(i=0; i<value.length; i++)
    {
      snprintf(newPath, elcount(newPath), "%s[%d]", oldPath, i);
      GetRoadSafetyMessageContentContainerParams(packetHandle, value.arrayValue[i], newPath);
      result = CheckLastError("RoadSafetyMessage", gkFuncRefGet, result);
    }
  }
  return result;
}

int SetRoadSafetyMessageRoadSafetyMessage_contentParams(LONG packetHandle, struct RoadSafetyMessageRoadSafetyMessage_content value, char oldPath[])
{
  char newPath[300]; 
  int i;
  int result;

  result = 0;

  C2xRemoveToken(packetHandle, "RoadSafetyMessage", oldPath);
  for(i=0; i<value.length; i++)
  {
    snprintf(newPath, elcount(newPath), "%s[%d]", oldPath, i);
    SetRoadSafetyMessageContentContainerParams(packetHandle, value.arrayValue[i], newPath);
    result = CheckLastError("RoadSafetyMessage", gkFuncRefGet, result);
  }
  return result;
}

int GetRoadSafetyMessage_RoadSafetyMessageParams(LONG packetHandle, struct RoadSafetyMessage_RoadSafetyMessage value, char oldPath[])
{
  char newPath[300];
  int result;

  result = 0;

  snprintf(newPath, elcount(newPath), "%s.%s", oldPath, "commonContainer");
  GetRoadSafetyMessageCommonContainerParams(packetHandle, value.commonContainer, newPath);
  result = CheckLastError("RoadSafetyMessage", gkFuncRefGet, result);

  snprintf(newPath, elcount(newPath), "%s.%s", oldPath, "content");
  GetRoadSafetyMessageRoadSafetyMessage_contentParams(packetHandle, value.content, newPath);
  result = CheckLastError("RoadSafetyMessage", gkFuncRefGet, result);

  return result;
}

int SetRoadSafetyMessage_RoadSafetyMessageParams(LONG packetHandle, struct RoadSafetyMessage_RoadSafetyMessage value, char oldPath[])
{
  char newPath[300];
  int result;

  result = 0;

  snprintf(newPath, elcount(newPath), "%s.%s", oldPath, "commonContainer");
  SetRoadSafetyMessageCommonContainerParams(packetHandle, value.commonContainer, newPath);
  result = CheckLastError("RoadSafetyMessage", gkFuncRefGet, result);

  snprintf(newPath, elcount(newPath), "%s.%s", oldPath, "content");
  SetRoadSafetyMessageRoadSafetyMessage_contentParams(packetHandle, value.content, newPath);
  result = CheckLastError("RoadSafetyMessage", gkFuncRefGet, result);

  return result;
}

int GetRoadSafetyMessageMESSAGE_ID_AND_TYPEParams(LONG packetHandle, WORD tableKey, struct RoadSafetyMessageMESSAGE_ID_AND_TYPE value, char oldPath[])
{
  char newPath[300];
  int result;

  result = 0;

  switch(tableKey)
  {
    case 33:
    {
      snprintf(newPath, elcount(newPath), "%s.%s", oldPath, "roadSafetyMessage");
      GetRoadSafetyMessage_RoadSafetyMessageParams(packetHandle, value.roadSafetyMessage, newPath);
      result = CheckLastError("RoadSafetyMessage", gkFuncRefGet, result);
    }
    break;
  }
  return result;
}

int SetRoadSafetyMessageMESSAGE_ID_AND_TYPEParams(LONG packetHandle, WORD tableKey, struct RoadSafetyMessageMESSAGE_ID_AND_TYPE value, char oldPath[])
{
  char newPath[300];
  int result;

  result = 0;

  switch(tableKey)
  {
    case 33:
    {
      snprintf(newPath, elcount(newPath), "%s.%s", oldPath, "roadSafetyMessage");
      SetRoadSafetyMessage_RoadSafetyMessageParams(packetHandle, value.roadSafetyMessage, newPath);
      result = CheckLastError("RoadSafetyMessage", gkFuncRefGet, result);
    }
    break;
  }
  return result;
}

int API_GetRoadSafetyMessageParams(LONG packetHandle, struct RoadSafetyMessage value)
{
  int result;
  result = 0;

  value.messageId = C2xGetTokenInt(packetHandle, "RoadSafetyMessage", "messageId");
  result = CheckLastError("RoadSafetyMessage", gkFuncRefGet, result);

  GetRoadSafetyMessageMESSAGE_ID_AND_TYPEParams(packetHandle, value.messageId, value.value, "value");
  result = CheckLastError("RoadSafetyMessage", gkFuncRefGet, result);

  return result;
}

int API_SetRoadSafetyMessageParams(LONG packetHandle, struct RoadSafetyMessage value)
{
  int result;
  result = 0;

  value.messageId = 33;

  SetRoadSafetyMessageMESSAGE_ID_AND_TYPEParams(packetHandle, value.messageId, value.value, "value");
  result = CheckLastError("RoadSafetyMessage", gkFuncRefGet, result);

  return result;
}

