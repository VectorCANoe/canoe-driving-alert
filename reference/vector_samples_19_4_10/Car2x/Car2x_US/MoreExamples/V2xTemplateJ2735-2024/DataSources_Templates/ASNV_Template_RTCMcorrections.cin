/*@!Encoding:1252*/
/*
//  (c) Vector Informatik GmbH. All rights reserved.
//
//  This file contains definitions of structs and methods that may be used
//  to set and get the values of an ASN.1 defined packet's payload.
//
//  //This example demonstrates how to set a packet's payload:
//  LONG packetHandle;
//  struct RTCMcorrections payload;
//  //you need to set the values of the variable "payload" yourself
//  packetHandle = API_InitRTCMcorrectionsPacket();
//  if (packetHandle!=0) {
//    if (API_SetRTCMcorrectionsParams(packetHandle, payload)==0) {
//      if (C2xCompletePacket(packetHandle)==0) {
//        C2xOutputPacket(packetHandle);
//      }
//    }
//  }
//                                                                             */
includes
{
  #include "ASNV_Template_BaseDatatypes.cin"  // If warning "Duplicate #include, ignoring this include" appears, please remove the ASNV_Template_BaseDatatypes.cin include from your other *.cin files in the project.
}
variables
{
    struct RTCMcorrectionsCommon_DDateTime {
        INT isValidFlag;   // necessary if this struct is used as an optional field of a SEQUENCE
        struct OPT_WORD_ASN year;  // INTEGER, OPTIONAL, 0..4095;
        struct OPT_BYTE_ASN month;  // INTEGER, OPTIONAL, 0..12;
        struct OPT_BYTE_ASN day;  // INTEGER, OPTIONAL, 0..31;
        struct OPT_BYTE_ASN hour;  // INTEGER, OPTIONAL, 0..31;
        struct OPT_BYTE_ASN minute;  // INTEGER, OPTIONAL, 0..60;
        struct OPT_WORD_ASN second;  // INTEGER, OPTIONAL, 0..65535;
        struct OPT_INT_ASN offset;  // INTEGER, OPTIONAL, -840..840;
    };
    
    struct RTCMcorrectionsCommon_TransmissionAndSpeed {
        INT isValidFlag;   // necessary if this struct is used as an optional field of a SEQUENCE
        INT transmisson;  // ENUMERATED, neutral(0), park(1), forwardGears(2), reverseGears(3), reserved1(4), reserved2(5), reserved3(6), unavailable(7);
        WORD speed;  // INTEGER, 0..8191;
    };
    
    struct RTCMcorrectionsCommon_PositionalAccuracy {
        INT isValidFlag;   // necessary if this struct is used as an optional field of a SEQUENCE
        BYTE semiMajor;  // INTEGER, 0..255;
        BYTE semiMinor;  // INTEGER, 0..255;
        WORD orientation;  // INTEGER, 0..65535;
    };
    
    struct RTCMcorrectionsCommon_PositionConfidenceSet {
        INT isValidFlag;   // necessary if this struct is used as an optional field of a SEQUENCE
        INT pos;  // ENUMERATED, unavailable(0), a500m(1), a200m(2), a100m(3), a50m(4), a20m(5), a10m(6), a5m(7), a2m(8), a1m(9), a50cm(10), a20cm(11), a10cm(12), a5cm(13), a2cm(14), a1cm(15);
        INT elevation;  // ENUMERATED, unavailable(0), elev_500_00(1), elev_200_00(2), elev_100_00(3), elev_050_00(4), elev_020_00(5), elev_010_00(6), elev_005_00(7), elev_002_00(8), elev_001_00(9), elev_000_50(10), elev_000_20(11), elev_000_10(12), elev_000_05(13), elev_000_02(14), elev_000_01(15);
    };
    
    struct RTCMcorrectionsCommon_SpeedandHeadingandThrottleConfidence {
        INT isValidFlag;   // necessary if this struct is used as an optional field of a SEQUENCE
        INT heading;  // ENUMERATED, unavailable(0), prec10deg(1), prec05deg(2), prec01deg(3), prec0_1deg(4), prec0_05deg(5), prec0_01deg(6), prec0_0125deg(7);
        INT speed;  // ENUMERATED, unavailable(0), prec100ms(1), prec10ms(2), prec5ms(3), prec1ms(4), prec0_1ms(5), prec0_05ms(6), prec0_01ms(7);
        INT throttle;  // ENUMERATED, unavailable(0), prec10percent(1), prec1percent(2), prec0_5percent(3);
    };
    
    struct RTCMcorrectionsCommon_FullPositionVector {
        INT isValidFlag;   // necessary if this struct is used as an optional field of a SEQUENCE
        struct RTCMcorrectionsCommon_DDateTime utcTime;  // SEQUENCE, OPTIONAL;
        LONG lon;  // INTEGER, -1799999999..1800000001;
        LONG lat;  // INTEGER, -900000000..900000001;
        struct OPT_LONG_ASN elevation;  // INTEGER, OPTIONAL, -4096..61439;
        struct OPT_WORD_ASN heading;  // INTEGER, OPTIONAL, 0..28800;
        struct RTCMcorrectionsCommon_TransmissionAndSpeed speed;  // SEQUENCE, OPTIONAL;
        struct RTCMcorrectionsCommon_PositionalAccuracy posAccuracy;  // SEQUENCE, OPTIONAL;
        struct OPT_ENUM_ASN timeConfidence;  // ENUMERATED, OPTIONAL, unavailable(0), time_100_000(1), time_050_000(2), time_020_000(3), time_010_000(4), time_002_000(5), time_001_000(6), time_000_500(7), time_000_200(8), time_000_100(9), time_000_050(10), time_000_020(11), time_000_010(12), time_000_005(13), time_000_002(14), time_000_001(15), time_000_000_5(16), time_000_000_2(17), time_000_000_1(18), time_000_000_05(19), time_000_000_02(20), time_000_000_01(21), time_000_000_005(22), time_000_000_002(23), time_000_000_001(24), time_000_000_000_5(25), time_000_000_000_2(26), time_000_000_000_1(27), time_000_000_000_05(28), time_000_000_000_02(29), time_000_000_000_01(30), time_000_000_000_005(31), time_000_000_000_002(32), time_000_000_000_001(33), time_000_000_000_000_5(34), time_000_000_000_000_2(35), time_000_000_000_000_1(36), time_000_000_000_000_05(37), time_000_000_000_000_02(38), time_000_000_000_000_01(39);
        struct RTCMcorrectionsCommon_PositionConfidenceSet posConfidence;  // SEQUENCE, OPTIONAL;
        struct RTCMcorrectionsCommon_SpeedandHeadingandThrottleConfidence speedConfidence;  // SEQUENCE, OPTIONAL;
    };
    
    struct RTCMcorrectionsCommon_GNSSstatus {
        INT isValidFlag;   // necessary if this struct is used as an optional field of a SEQUENCE
        CHAR string[9];
        INT  stringLength;
    };
    
    struct RTCMcorrectionsCommon_AntennaOffsetSet {
        INT isValidFlag;   // necessary if this struct is used as an optional field of a SEQUENCE
        INT antOffsetX;  // INTEGER, -2048..2047;
        INT antOffsetY;  // INTEGER, -256..255;
        INT antOffsetZ;  // INTEGER, -512..511;
    };
    
    struct RTCMcorrectionsCommon_RTCMheader {
        INT isValidFlag;   // necessary if this struct is used as an optional field of a SEQUENCE
        struct RTCMcorrectionsCommon_GNSSstatus status;  // BITSTRING;
        struct RTCMcorrectionsCommon_AntennaOffsetSet offsetSet;  // SEQUENCE;
    };
    
    struct RTCMcorrectionsCommon_RTCMmessage {
        INT isValidFlag;   // necessary if this struct is used as an optional field of a SEQUENCE
        CHAR string[1024];
        INT  stringLength;
    };
    
    struct RTCMcorrectionsCommon_RTCMmessageList {
        INT isValidFlag;   // necessary if this struct is used as an optional field of a SEQUENCE
        INT length;
        struct RTCMcorrectionsCommon_RTCMmessage arrayValue[5];  // OCTETSTRING;
    };
    
    struct RTCMcorrectionsCommon_RegionalExtension_Reg_RTCMcorrections_table {
    };
    
    struct RTCMcorrectionsCommon_RegionalExtension_Reg_RTCMcorrections {
        INT isValidFlag;   // necessary if this struct is used as an optional field of a SEQUENCE
        BYTE regionId;  // INTEGER, 0..255, noRegion(0), addGrpA(1), addGrpB(2), addGrpC(3), addGrpD(4);
        struct RTCMcorrectionsCommon_RegionalExtension_Reg_RTCMcorrections_table regExtvalue;  // TABLE;
    };
    
    struct RTCMcorrectionsRTCMcorrections_regional {
        INT isValidFlag;   // necessary if this struct is used as an optional field of a SEQUENCE
        INT length;
        struct RTCMcorrectionsCommon_RegionalExtension_Reg_RTCMcorrections arrayValue[4];  // SEQUENCE;
    };
    
    struct RTCMcorrections_RTCMcorrections {
        INT isValidFlag;   // necessary if this struct is used as an optional field of a SEQUENCE
        BYTE msgCnt;  // INTEGER, 0..127;
        INT rev;  // ENUMERATED, unknown(0), rtcmRev2(1), rtcmRev3(2), reserved(3);
        struct OPT_DWORD_ASN timeStamp;  // INTEGER, OPTIONAL, 0..527040;
        struct RTCMcorrectionsCommon_FullPositionVector anchorPoint;  // SEQUENCE, OPTIONAL;
        struct RTCMcorrectionsCommon_RTCMheader rtcmHeader;  // SEQUENCE, OPTIONAL;
        struct RTCMcorrectionsCommon_RTCMmessageList msgs;  // SEQUENCEOF;
        struct RTCMcorrectionsRTCMcorrections_regional regional;  // SEQUENCEOF, OPTIONAL;
    };
    
    struct RTCMcorrectionsMESSAGE_ID_AND_TYPE {
        struct RTCMcorrections_RTCMcorrections rtcmCorrections;  // SEQUENCE;
    };
    
    struct RTCMcorrections {
        INT isValidFlag;   // necessary if this struct is used as an optional field of a SEQUENCE
        WORD messageId;  // INTEGER, 0..32767, mapData(18), signalPhaseAndTimingMessage(19), basicSafetyMessage(20), commonSafetyRequest(21), emergencyVehicleAlert(22), intersectionCollision(23), nmeaCorrections(24), probeDataManagement(25), probeVehicleData(26), roadSideAlert(27), rtcmCorrections(28), signalRequestMessage(29), signalStatusMessage(30), travelerInformation(31), personalSafetyMessage(32), roadSafetyMessage(33), roadWeatherMessage(34), probeDataConfigMessage(35), probeDataReportMessage(36), tollAdvertisementMessage(37), tollUsageMessage(38), tollUsageAckMessage(39), cooperativeControlMessage(40), sensorDataSharingMessage(41), maneuverSharingAndCoordinatingMessage(42), roadGeometryAndAttributes(43), personalSafetyMessage2(44), trafficSignalPhaseAndTiming(45), signalControlAndPrioritizationRequest(46), signalControlAndPrioritizationStatus(47), roadUserChargingConfigMessage(48), roadUserChargingReportMessage(49), trafficLightStatusMessage(50);
        struct RTCMcorrectionsMESSAGE_ID_AND_TYPE value;  // TABLE;
    };
    
}

/*
// init function to create a simple packet handle
*/ 
LONG API_InitRTCMcorrectionsPacket()
{
  return C2xInitPacket("RTCMcorrections"); 
}

/*
// init function to create a simple packet handle and
// initialize the struct with valid data
*/ 
LONG API_InitRTCMcorrectionsPacket(struct RTCMcorrections msgStruct)
{
  long pktHandle;

  pktHandle = API_InitRTCMcorrectionsPacket();

  if (pktHandle != 0)
  {
    // create valid message and application data
    if (C2xCompletePacket(pktHandle) == 0) 
    {
      API_GetRTCMcorrectionsParams(pktHandle, msgStruct);
    }
  }
  return pktHandle;
}

/*
// init function to create a packet with security layer and
// initialize the struct with valid data
*/ 
LONG API_InitRTCMcorrectionsPacket(struct RTCMcorrections msgStruct, char packetTypeDesignator[], char certificateName[])
{
  long pktHandle, certHdl;

  // initialize the packet
  pktHandle = C2xInitPacket("RTCMcorrections", packetTypeDesignator);

  if (pktHandle != 0)
  {
    certHdl = C2xSecCertificateGetHandle(certificateName);  // get the certificate handle for the cert with name "certificateName"
    if (certHdl != 0) 
    {
      C2xSecPacketSetSignerHandle(pktHandle, certHdl); // set the certHdl to the packet
    }

    // create valid message and application data
    if (C2xCompletePacket(pktHandle) == 0) 
    {
      // copy application data to the application structure
      API_GetRTCMcorrectionsParams(pktHandle, msgStruct);
    }
  }
  return pktHandle;
}
    

int GetRTCMcorrectionsCommon_DDateTimeParams(LONG packetHandle, struct RTCMcorrectionsCommon_DDateTime value, char oldPath[])
{
  char newPath[300];
  int result;

  result = 0;

  snprintf(newPath, elcount(newPath), "%s.%s", oldPath, "year");
  value.year.isValidFlag = C2xIsTokenAvailable(packetHandle, "RTCMcorrections", newPath);
  if(value.year.isValidFlag==1)
  {
    value.year.value = C2xGetTokenInt(packetHandle, "RTCMcorrections", newPath);
    result = CheckLastError("RTCMcorrections", gkFuncRefGet, result);
  }
  snprintf(newPath, elcount(newPath), "%s.%s", oldPath, "month");
  value.month.isValidFlag = C2xIsTokenAvailable(packetHandle, "RTCMcorrections", newPath);
  if(value.month.isValidFlag==1)
  {
    value.month.value = C2xGetTokenInt(packetHandle, "RTCMcorrections", newPath);
    result = CheckLastError("RTCMcorrections", gkFuncRefGet, result);
  }
  snprintf(newPath, elcount(newPath), "%s.%s", oldPath, "day");
  value.day.isValidFlag = C2xIsTokenAvailable(packetHandle, "RTCMcorrections", newPath);
  if(value.day.isValidFlag==1)
  {
    value.day.value = C2xGetTokenInt(packetHandle, "RTCMcorrections", newPath);
    result = CheckLastError("RTCMcorrections", gkFuncRefGet, result);
  }
  snprintf(newPath, elcount(newPath), "%s.%s", oldPath, "hour");
  value.hour.isValidFlag = C2xIsTokenAvailable(packetHandle, "RTCMcorrections", newPath);
  if(value.hour.isValidFlag==1)
  {
    value.hour.value = C2xGetTokenInt(packetHandle, "RTCMcorrections", newPath);
    result = CheckLastError("RTCMcorrections", gkFuncRefGet, result);
  }
  snprintf(newPath, elcount(newPath), "%s.%s", oldPath, "minute");
  value.minute.isValidFlag = C2xIsTokenAvailable(packetHandle, "RTCMcorrections", newPath);
  if(value.minute.isValidFlag==1)
  {
    value.minute.value = C2xGetTokenInt(packetHandle, "RTCMcorrections", newPath);
    result = CheckLastError("RTCMcorrections", gkFuncRefGet, result);
  }
  snprintf(newPath, elcount(newPath), "%s.%s", oldPath, "second");
  value.second.isValidFlag = C2xIsTokenAvailable(packetHandle, "RTCMcorrections", newPath);
  if(value.second.isValidFlag==1)
  {
    value.second.value = C2xGetTokenInt(packetHandle, "RTCMcorrections", newPath);
    result = CheckLastError("RTCMcorrections", gkFuncRefGet, result);
  }
  snprintf(newPath, elcount(newPath), "%s.%s", oldPath, "offset");
  value.offset.isValidFlag = C2xIsTokenAvailable(packetHandle, "RTCMcorrections", newPath);
  if(value.offset.isValidFlag==1)
  {
    value.offset.value = C2xGetTokenInt(packetHandle, "RTCMcorrections", newPath);
    result = CheckLastError("RTCMcorrections", gkFuncRefGet, result);
  }
  return result;
}

int SetRTCMcorrectionsCommon_DDateTimeParams(LONG packetHandle, struct RTCMcorrectionsCommon_DDateTime value, char oldPath[])
{
  char newPath[300];
  int result;

  result = 0;

  snprintf(newPath, elcount(newPath), "%s.%s", oldPath, "year");
  if(value.year.isValidFlag==1)
  {
    C2xSetTokenInt(packetHandle, "RTCMcorrections", newPath, value.year.value);
    result = CheckLastError("RTCMcorrections", gkFuncRefGet, result);
  }
  else
  {
    if( C2xIsTokenAvailable(packetHandle, "RTCMcorrections", newPath) )
    {
      C2xRemoveToken(packetHandle, "RTCMcorrections", newPath);
    }
  }

  snprintf(newPath, elcount(newPath), "%s.%s", oldPath, "month");
  if(value.month.isValidFlag==1)
  {
    C2xSetTokenInt(packetHandle, "RTCMcorrections", newPath, value.month.value);
    result = CheckLastError("RTCMcorrections", gkFuncRefGet, result);
  }
  else
  {
    if( C2xIsTokenAvailable(packetHandle, "RTCMcorrections", newPath) )
    {
      C2xRemoveToken(packetHandle, "RTCMcorrections", newPath);
    }
  }

  snprintf(newPath, elcount(newPath), "%s.%s", oldPath, "day");
  if(value.day.isValidFlag==1)
  {
    C2xSetTokenInt(packetHandle, "RTCMcorrections", newPath, value.day.value);
    result = CheckLastError("RTCMcorrections", gkFuncRefGet, result);
  }
  else
  {
    if( C2xIsTokenAvailable(packetHandle, "RTCMcorrections", newPath) )
    {
      C2xRemoveToken(packetHandle, "RTCMcorrections", newPath);
    }
  }

  snprintf(newPath, elcount(newPath), "%s.%s", oldPath, "hour");
  if(value.hour.isValidFlag==1)
  {
    C2xSetTokenInt(packetHandle, "RTCMcorrections", newPath, value.hour.value);
    result = CheckLastError("RTCMcorrections", gkFuncRefGet, result);
  }
  else
  {
    if( C2xIsTokenAvailable(packetHandle, "RTCMcorrections", newPath) )
    {
      C2xRemoveToken(packetHandle, "RTCMcorrections", newPath);
    }
  }

  snprintf(newPath, elcount(newPath), "%s.%s", oldPath, "minute");
  if(value.minute.isValidFlag==1)
  {
    C2xSetTokenInt(packetHandle, "RTCMcorrections", newPath, value.minute.value);
    result = CheckLastError("RTCMcorrections", gkFuncRefGet, result);
  }
  else
  {
    if( C2xIsTokenAvailable(packetHandle, "RTCMcorrections", newPath) )
    {
      C2xRemoveToken(packetHandle, "RTCMcorrections", newPath);
    }
  }

  snprintf(newPath, elcount(newPath), "%s.%s", oldPath, "second");
  if(value.second.isValidFlag==1)
  {
    C2xSetTokenInt(packetHandle, "RTCMcorrections", newPath, value.second.value);
    result = CheckLastError("RTCMcorrections", gkFuncRefGet, result);
  }
  else
  {
    if( C2xIsTokenAvailable(packetHandle, "RTCMcorrections", newPath) )
    {
      C2xRemoveToken(packetHandle, "RTCMcorrections", newPath);
    }
  }

  snprintf(newPath, elcount(newPath), "%s.%s", oldPath, "offset");
  if(value.offset.isValidFlag==1)
  {
    C2xSetTokenInt(packetHandle, "RTCMcorrections", newPath, value.offset.value);
    result = CheckLastError("RTCMcorrections", gkFuncRefGet, result);
  }
  else
  {
    if( C2xIsTokenAvailable(packetHandle, "RTCMcorrections", newPath) )
    {
      C2xRemoveToken(packetHandle, "RTCMcorrections", newPath);
    }
  }

  return result;
}

int GetRTCMcorrectionsCommon_TransmissionAndSpeedParams(LONG packetHandle, struct RTCMcorrectionsCommon_TransmissionAndSpeed value, char oldPath[])
{
  char newPath[300];
  int result;

  result = 0;

  snprintf(newPath, elcount(newPath), "%s.%s", oldPath, "transmisson");
  value.transmisson = C2xGetTokenInt(packetHandle, "RTCMcorrections", newPath);
  result = CheckLastError("RTCMcorrections", gkFuncRefGet, result);

  snprintf(newPath, elcount(newPath), "%s.%s", oldPath, "speed");
  value.speed = C2xGetTokenInt(packetHandle, "RTCMcorrections", newPath);
  result = CheckLastError("RTCMcorrections", gkFuncRefGet, result);

  return result;
}

int SetRTCMcorrectionsCommon_TransmissionAndSpeedParams(LONG packetHandle, struct RTCMcorrectionsCommon_TransmissionAndSpeed value, char oldPath[])
{
  char newPath[300];
  int result;

  result = 0;

  snprintf(newPath, elcount(newPath), "%s.%s", oldPath, "transmisson");
  C2xSetTokenInt(packetHandle, "RTCMcorrections", newPath, value.transmisson);
  result = CheckLastError("RTCMcorrections", gkFuncRefGet, result);

  snprintf(newPath, elcount(newPath), "%s.%s", oldPath, "speed");
  C2xSetTokenInt(packetHandle, "RTCMcorrections", newPath, value.speed);
  result = CheckLastError("RTCMcorrections", gkFuncRefGet, result);

  return result;
}

int GetRTCMcorrectionsCommon_PositionalAccuracyParams(LONG packetHandle, struct RTCMcorrectionsCommon_PositionalAccuracy value, char oldPath[])
{
  char newPath[300];
  int result;

  result = 0;

  snprintf(newPath, elcount(newPath), "%s.%s", oldPath, "semiMajor");
  value.semiMajor = C2xGetTokenInt(packetHandle, "RTCMcorrections", newPath);
  result = CheckLastError("RTCMcorrections", gkFuncRefGet, result);

  snprintf(newPath, elcount(newPath), "%s.%s", oldPath, "semiMinor");
  value.semiMinor = C2xGetTokenInt(packetHandle, "RTCMcorrections", newPath);
  result = CheckLastError("RTCMcorrections", gkFuncRefGet, result);

  snprintf(newPath, elcount(newPath), "%s.%s", oldPath, "orientation");
  value.orientation = C2xGetTokenInt(packetHandle, "RTCMcorrections", newPath);
  result = CheckLastError("RTCMcorrections", gkFuncRefGet, result);

  return result;
}

int SetRTCMcorrectionsCommon_PositionalAccuracyParams(LONG packetHandle, struct RTCMcorrectionsCommon_PositionalAccuracy value, char oldPath[])
{
  char newPath[300];
  int result;

  result = 0;

  snprintf(newPath, elcount(newPath), "%s.%s", oldPath, "semiMajor");
  C2xSetTokenInt(packetHandle, "RTCMcorrections", newPath, value.semiMajor);
  result = CheckLastError("RTCMcorrections", gkFuncRefGet, result);

  snprintf(newPath, elcount(newPath), "%s.%s", oldPath, "semiMinor");
  C2xSetTokenInt(packetHandle, "RTCMcorrections", newPath, value.semiMinor);
  result = CheckLastError("RTCMcorrections", gkFuncRefGet, result);

  snprintf(newPath, elcount(newPath), "%s.%s", oldPath, "orientation");
  C2xSetTokenInt(packetHandle, "RTCMcorrections", newPath, value.orientation);
  result = CheckLastError("RTCMcorrections", gkFuncRefGet, result);

  return result;
}

int GetRTCMcorrectionsCommon_PositionConfidenceSetParams(LONG packetHandle, struct RTCMcorrectionsCommon_PositionConfidenceSet value, char oldPath[])
{
  char newPath[300];
  int result;

  result = 0;

  snprintf(newPath, elcount(newPath), "%s.%s", oldPath, "pos");
  value.pos = C2xGetTokenInt(packetHandle, "RTCMcorrections", newPath);
  result = CheckLastError("RTCMcorrections", gkFuncRefGet, result);

  snprintf(newPath, elcount(newPath), "%s.%s", oldPath, "elevation");
  value.elevation = C2xGetTokenInt(packetHandle, "RTCMcorrections", newPath);
  result = CheckLastError("RTCMcorrections", gkFuncRefGet, result);

  return result;
}

int SetRTCMcorrectionsCommon_PositionConfidenceSetParams(LONG packetHandle, struct RTCMcorrectionsCommon_PositionConfidenceSet value, char oldPath[])
{
  char newPath[300];
  int result;

  result = 0;

  snprintf(newPath, elcount(newPath), "%s.%s", oldPath, "pos");
  C2xSetTokenInt(packetHandle, "RTCMcorrections", newPath, value.pos);
  result = CheckLastError("RTCMcorrections", gkFuncRefGet, result);

  snprintf(newPath, elcount(newPath), "%s.%s", oldPath, "elevation");
  C2xSetTokenInt(packetHandle, "RTCMcorrections", newPath, value.elevation);
  result = CheckLastError("RTCMcorrections", gkFuncRefGet, result);

  return result;
}

int GetRTCMcorrectionsCommon_SpeedandHeadingandThrottleConfidenceParams(LONG packetHandle, struct RTCMcorrectionsCommon_SpeedandHeadingandThrottleConfidence value, char oldPath[])
{
  char newPath[300];
  int result;

  result = 0;

  snprintf(newPath, elcount(newPath), "%s.%s", oldPath, "heading");
  value.heading = C2xGetTokenInt(packetHandle, "RTCMcorrections", newPath);
  result = CheckLastError("RTCMcorrections", gkFuncRefGet, result);

  snprintf(newPath, elcount(newPath), "%s.%s", oldPath, "speed");
  value.speed = C2xGetTokenInt(packetHandle, "RTCMcorrections", newPath);
  result = CheckLastError("RTCMcorrections", gkFuncRefGet, result);

  snprintf(newPath, elcount(newPath), "%s.%s", oldPath, "throttle");
  value.throttle = C2xGetTokenInt(packetHandle, "RTCMcorrections", newPath);
  result = CheckLastError("RTCMcorrections", gkFuncRefGet, result);

  return result;
}

int SetRTCMcorrectionsCommon_SpeedandHeadingandThrottleConfidenceParams(LONG packetHandle, struct RTCMcorrectionsCommon_SpeedandHeadingandThrottleConfidence value, char oldPath[])
{
  char newPath[300];
  int result;

  result = 0;

  snprintf(newPath, elcount(newPath), "%s.%s", oldPath, "heading");
  C2xSetTokenInt(packetHandle, "RTCMcorrections", newPath, value.heading);
  result = CheckLastError("RTCMcorrections", gkFuncRefGet, result);

  snprintf(newPath, elcount(newPath), "%s.%s", oldPath, "speed");
  C2xSetTokenInt(packetHandle, "RTCMcorrections", newPath, value.speed);
  result = CheckLastError("RTCMcorrections", gkFuncRefGet, result);

  snprintf(newPath, elcount(newPath), "%s.%s", oldPath, "throttle");
  C2xSetTokenInt(packetHandle, "RTCMcorrections", newPath, value.throttle);
  result = CheckLastError("RTCMcorrections", gkFuncRefGet, result);

  return result;
}

int GetRTCMcorrectionsCommon_FullPositionVectorParams(LONG packetHandle, struct RTCMcorrectionsCommon_FullPositionVector value, char oldPath[])
{
  char newPath[300];
  int result;

  result = 0;

  snprintf(newPath, elcount(newPath), "%s.%s", oldPath, "utcTime");
  value.utcTime.isValidFlag = C2xIsTokenAvailable(packetHandle, "RTCMcorrections", newPath);
  if(value.utcTime.isValidFlag==1)
  {
    GetRTCMcorrectionsCommon_DDateTimeParams(packetHandle, value.utcTime, newPath);
    result = CheckLastError("RTCMcorrections", gkFuncRefGet, result);
  }
  snprintf(newPath, elcount(newPath), "%s.%s", oldPath, "lon");
  value.lon = C2xGetTokenInt(packetHandle, "RTCMcorrections", newPath);
  result = CheckLastError("RTCMcorrections", gkFuncRefGet, result);

  snprintf(newPath, elcount(newPath), "%s.%s", oldPath, "lat");
  value.lat = C2xGetTokenInt(packetHandle, "RTCMcorrections", newPath);
  result = CheckLastError("RTCMcorrections", gkFuncRefGet, result);

  snprintf(newPath, elcount(newPath), "%s.%s", oldPath, "elevation");
  value.elevation.isValidFlag = C2xIsTokenAvailable(packetHandle, "RTCMcorrections", newPath);
  if(value.elevation.isValidFlag==1)
  {
    value.elevation.value = C2xGetTokenInt(packetHandle, "RTCMcorrections", newPath);
    result = CheckLastError("RTCMcorrections", gkFuncRefGet, result);
  }
  snprintf(newPath, elcount(newPath), "%s.%s", oldPath, "heading");
  value.heading.isValidFlag = C2xIsTokenAvailable(packetHandle, "RTCMcorrections", newPath);
  if(value.heading.isValidFlag==1)
  {
    value.heading.value = C2xGetTokenInt(packetHandle, "RTCMcorrections", newPath);
    result = CheckLastError("RTCMcorrections", gkFuncRefGet, result);
  }
  snprintf(newPath, elcount(newPath), "%s.%s", oldPath, "speed");
  value.speed.isValidFlag = C2xIsTokenAvailable(packetHandle, "RTCMcorrections", newPath);
  if(value.speed.isValidFlag==1)
  {
    GetRTCMcorrectionsCommon_TransmissionAndSpeedParams(packetHandle, value.speed, newPath);
    result = CheckLastError("RTCMcorrections", gkFuncRefGet, result);
  }
  snprintf(newPath, elcount(newPath), "%s.%s", oldPath, "posAccuracy");
  value.posAccuracy.isValidFlag = C2xIsTokenAvailable(packetHandle, "RTCMcorrections", newPath);
  if(value.posAccuracy.isValidFlag==1)
  {
    GetRTCMcorrectionsCommon_PositionalAccuracyParams(packetHandle, value.posAccuracy, newPath);
    result = CheckLastError("RTCMcorrections", gkFuncRefGet, result);
  }
  snprintf(newPath, elcount(newPath), "%s.%s", oldPath, "timeConfidence");
  value.timeConfidence.isValidFlag = C2xIsTokenAvailable(packetHandle, "RTCMcorrections", newPath);
  if(value.timeConfidence.isValidFlag==1)
  {
    value.timeConfidence.value = C2xGetTokenInt(packetHandle, "RTCMcorrections", newPath);
    result = CheckLastError("RTCMcorrections", gkFuncRefGet, result);
  }
  snprintf(newPath, elcount(newPath), "%s.%s", oldPath, "posConfidence");
  value.posConfidence.isValidFlag = C2xIsTokenAvailable(packetHandle, "RTCMcorrections", newPath);
  if(value.posConfidence.isValidFlag==1)
  {
    GetRTCMcorrectionsCommon_PositionConfidenceSetParams(packetHandle, value.posConfidence, newPath);
    result = CheckLastError("RTCMcorrections", gkFuncRefGet, result);
  }
  snprintf(newPath, elcount(newPath), "%s.%s", oldPath, "speedConfidence");
  value.speedConfidence.isValidFlag = C2xIsTokenAvailable(packetHandle, "RTCMcorrections", newPath);
  if(value.speedConfidence.isValidFlag==1)
  {
    GetRTCMcorrectionsCommon_SpeedandHeadingandThrottleConfidenceParams(packetHandle, value.speedConfidence, newPath);
    result = CheckLastError("RTCMcorrections", gkFuncRefGet, result);
  }
  return result;
}

int SetRTCMcorrectionsCommon_FullPositionVectorParams(LONG packetHandle, struct RTCMcorrectionsCommon_FullPositionVector value, char oldPath[])
{
  char newPath[300];
  int result;

  result = 0;

  snprintf(newPath, elcount(newPath), "%s.%s", oldPath, "utcTime");
  if(value.utcTime.isValidFlag==1)
  {
    SetRTCMcorrectionsCommon_DDateTimeParams(packetHandle, value.utcTime, newPath);
    result = CheckLastError("RTCMcorrections", gkFuncRefGet, result);
  }
  else
  {
    if( C2xIsTokenAvailable(packetHandle, "RTCMcorrections", newPath) )
    {
      C2xRemoveToken(packetHandle, "RTCMcorrections", newPath);
    }
  }

  snprintf(newPath, elcount(newPath), "%s.%s", oldPath, "lon");
  C2xSetTokenInt(packetHandle, "RTCMcorrections", newPath, value.lon);
  result = CheckLastError("RTCMcorrections", gkFuncRefGet, result);

  snprintf(newPath, elcount(newPath), "%s.%s", oldPath, "lat");
  C2xSetTokenInt(packetHandle, "RTCMcorrections", newPath, value.lat);
  result = CheckLastError("RTCMcorrections", gkFuncRefGet, result);

  snprintf(newPath, elcount(newPath), "%s.%s", oldPath, "elevation");
  if(value.elevation.isValidFlag==1)
  {
    C2xSetTokenInt(packetHandle, "RTCMcorrections", newPath, value.elevation.value);
    result = CheckLastError("RTCMcorrections", gkFuncRefGet, result);
  }
  else
  {
    if( C2xIsTokenAvailable(packetHandle, "RTCMcorrections", newPath) )
    {
      C2xRemoveToken(packetHandle, "RTCMcorrections", newPath);
    }
  }

  snprintf(newPath, elcount(newPath), "%s.%s", oldPath, "heading");
  if(value.heading.isValidFlag==1)
  {
    C2xSetTokenInt(packetHandle, "RTCMcorrections", newPath, value.heading.value);
    result = CheckLastError("RTCMcorrections", gkFuncRefGet, result);
  }
  else
  {
    if( C2xIsTokenAvailable(packetHandle, "RTCMcorrections", newPath) )
    {
      C2xRemoveToken(packetHandle, "RTCMcorrections", newPath);
    }
  }

  snprintf(newPath, elcount(newPath), "%s.%s", oldPath, "speed");
  if(value.speed.isValidFlag==1)
  {
    SetRTCMcorrectionsCommon_TransmissionAndSpeedParams(packetHandle, value.speed, newPath);
    result = CheckLastError("RTCMcorrections", gkFuncRefGet, result);
  }
  else
  {
    if( C2xIsTokenAvailable(packetHandle, "RTCMcorrections", newPath) )
    {
      C2xRemoveToken(packetHandle, "RTCMcorrections", newPath);
    }
  }

  snprintf(newPath, elcount(newPath), "%s.%s", oldPath, "posAccuracy");
  if(value.posAccuracy.isValidFlag==1)
  {
    SetRTCMcorrectionsCommon_PositionalAccuracyParams(packetHandle, value.posAccuracy, newPath);
    result = CheckLastError("RTCMcorrections", gkFuncRefGet, result);
  }
  else
  {
    if( C2xIsTokenAvailable(packetHandle, "RTCMcorrections", newPath) )
    {
      C2xRemoveToken(packetHandle, "RTCMcorrections", newPath);
    }
  }

  snprintf(newPath, elcount(newPath), "%s.%s", oldPath, "timeConfidence");
  if(value.timeConfidence.isValidFlag==1)
  {
    C2xSetTokenInt(packetHandle, "RTCMcorrections", newPath, value.timeConfidence.value);
    result = CheckLastError("RTCMcorrections", gkFuncRefGet, result);
  }
  else
  {
    if( C2xIsTokenAvailable(packetHandle, "RTCMcorrections", newPath) )
    {
      C2xRemoveToken(packetHandle, "RTCMcorrections", newPath);
    }
  }

  snprintf(newPath, elcount(newPath), "%s.%s", oldPath, "posConfidence");
  if(value.posConfidence.isValidFlag==1)
  {
    SetRTCMcorrectionsCommon_PositionConfidenceSetParams(packetHandle, value.posConfidence, newPath);
    result = CheckLastError("RTCMcorrections", gkFuncRefGet, result);
  }
  else
  {
    if( C2xIsTokenAvailable(packetHandle, "RTCMcorrections", newPath) )
    {
      C2xRemoveToken(packetHandle, "RTCMcorrections", newPath);
    }
  }

  snprintf(newPath, elcount(newPath), "%s.%s", oldPath, "speedConfidence");
  if(value.speedConfidence.isValidFlag==1)
  {
    SetRTCMcorrectionsCommon_SpeedandHeadingandThrottleConfidenceParams(packetHandle, value.speedConfidence, newPath);
    result = CheckLastError("RTCMcorrections", gkFuncRefGet, result);
  }
  else
  {
    if( C2xIsTokenAvailable(packetHandle, "RTCMcorrections", newPath) )
    {
      C2xRemoveToken(packetHandle, "RTCMcorrections", newPath);
    }
  }

  return result;
}

int GetRTCMcorrectionsCommon_AntennaOffsetSetParams(LONG packetHandle, struct RTCMcorrectionsCommon_AntennaOffsetSet value, char oldPath[])
{
  char newPath[300];
  int result;

  result = 0;

  snprintf(newPath, elcount(newPath), "%s.%s", oldPath, "antOffsetX");
  value.antOffsetX = C2xGetTokenInt(packetHandle, "RTCMcorrections", newPath);
  result = CheckLastError("RTCMcorrections", gkFuncRefGet, result);

  snprintf(newPath, elcount(newPath), "%s.%s", oldPath, "antOffsetY");
  value.antOffsetY = C2xGetTokenInt(packetHandle, "RTCMcorrections", newPath);
  result = CheckLastError("RTCMcorrections", gkFuncRefGet, result);

  snprintf(newPath, elcount(newPath), "%s.%s", oldPath, "antOffsetZ");
  value.antOffsetZ = C2xGetTokenInt(packetHandle, "RTCMcorrections", newPath);
  result = CheckLastError("RTCMcorrections", gkFuncRefGet, result);

  return result;
}

int SetRTCMcorrectionsCommon_AntennaOffsetSetParams(LONG packetHandle, struct RTCMcorrectionsCommon_AntennaOffsetSet value, char oldPath[])
{
  char newPath[300];
  int result;

  result = 0;

  snprintf(newPath, elcount(newPath), "%s.%s", oldPath, "antOffsetX");
  C2xSetTokenInt(packetHandle, "RTCMcorrections", newPath, value.antOffsetX);
  result = CheckLastError("RTCMcorrections", gkFuncRefGet, result);

  snprintf(newPath, elcount(newPath), "%s.%s", oldPath, "antOffsetY");
  C2xSetTokenInt(packetHandle, "RTCMcorrections", newPath, value.antOffsetY);
  result = CheckLastError("RTCMcorrections", gkFuncRefGet, result);

  snprintf(newPath, elcount(newPath), "%s.%s", oldPath, "antOffsetZ");
  C2xSetTokenInt(packetHandle, "RTCMcorrections", newPath, value.antOffsetZ);
  result = CheckLastError("RTCMcorrections", gkFuncRefGet, result);

  return result;
}

int GetRTCMcorrectionsCommon_RTCMheaderParams(LONG packetHandle, struct RTCMcorrectionsCommon_RTCMheader value, char oldPath[])
{
  char newPath[300]; 
  int j; 
  int k;
  int result;

  result = 0;

  snprintf(newPath, elcount(newPath), "%s.%s", oldPath, "status");
  value.status.isValidFlag = 1;
  value.status.stringLength = C2xGetTokenLengthBit(packetHandle, "RTCMcorrections", newPath);
  if ((result = CheckLastError("RTCMcorrections", gkFuncRefGet, result))==0)
  {
    if(value.status.stringLength > 0)
    {
      for(j=0; j<value.status.stringLength; j++)
      {
        if(C2xGetTokenBitOfBitString(packetHandle, "RTCMcorrections", newPath, j) == 0)
        {
          value.status.string[j] = '0';
        }
        else if(C2xGetTokenBitOfBitString(packetHandle, "RTCMcorrections", newPath, j) == 1)
        {
          value.status.string[j] = '1';
        }

        if(value.status.stringLength == 1)
        {
          value.status.string[1] = '0';
        }
        result = CheckLastError("RTCMcorrections", gkFuncRefGet, result);
      }
    }
    else
    {
      for(k = value.status.stringLength+1; k > -1; k--)
      {
        if(value.status.string[k] == '1')
        {
          value.status.string[k] = '0';
        }
      }
    }
  }

  snprintf(newPath, elcount(newPath), "%s.%s", oldPath, "offsetSet");
  GetRTCMcorrectionsCommon_AntennaOffsetSetParams(packetHandle, value.offsetSet, newPath);
  result = CheckLastError("RTCMcorrections", gkFuncRefGet, result);

  return result;
}

int SetRTCMcorrectionsCommon_RTCMheaderParams(LONG packetHandle, struct RTCMcorrectionsCommon_RTCMheader value, char oldPath[])
{
  char newPath[300]; 
  int j;
  int result;

  result = 0;

  snprintf(newPath, elcount(newPath), "%s.%s", oldPath, "status");
    for(j=0; j<value.status.stringLength; j++)
    {
      if(value.status.string[j] == '0')
      {
        C2xSetTokenBitOfBitString(packetHandle, "RTCMcorrections", newPath, j, 0);
      }
      else
      {
        C2xSetTokenBitOfBitString(packetHandle, "RTCMcorrections", newPath, j, 1);
      }
      result = CheckLastError("RTCMcorrections", gkFuncRefGet, result);
    }

  snprintf(newPath, elcount(newPath), "%s.%s", oldPath, "offsetSet");
  SetRTCMcorrectionsCommon_AntennaOffsetSetParams(packetHandle, value.offsetSet, newPath);
  result = CheckLastError("RTCMcorrections", gkFuncRefGet, result);

  return result;
}

int GetRTCMcorrectionsCommon_RTCMmessageListParams(LONG packetHandle, struct RTCMcorrectionsCommon_RTCMmessageList value, char oldPath[])
{
  char newPath[300]; 
  int i;
  char buffer[300];
  int result;

  result = 0;

  value.length = C2xGetTokenInt(packetHandle, "RTCMcorrections", oldPath);
  if((result = CheckLastError("RTCMcorrections", gkFuncRefGet, result))==0)
  {
    for(i=0; i<value.length; i++)
    {
      snprintf(newPath, elcount(newPath), "%s[%d]", oldPath, i);
      C2xGetTokenData(packetHandle, "RTCMcorrections", newPath, elcount(buffer), buffer);
      strncpy(value.arrayValue[i].string , buffer, value.arrayValue[i].stringLength );
      result = CheckLastError("RTCMcorrections", gkFuncRefGet, result);
    }
  }
  return result;
}

int SetRTCMcorrectionsCommon_RTCMmessageListParams(LONG packetHandle, struct RTCMcorrectionsCommon_RTCMmessageList value, char oldPath[])
{
  char newPath[300]; 
  int i;
  char buffer[300];
  int result;

  result = 0;

  C2xRemoveToken(packetHandle, "RTCMcorrections", oldPath);
  for(i=0; i<value.length; i++)
  {
    snprintf(newPath, elcount(newPath), "%s[%d]", oldPath, i);
    strncpy(buffer,value.arrayValue[i].string , elcount(buffer));
    C2xSetTokenData(packetHandle, "RTCMcorrections", newPath, elcount(buffer), buffer);
    result = CheckLastError("RTCMcorrections", gkFuncRefGet, result);
  }
  return result;
}

int GetRTCMcorrectionsCommon_RegionalExtension_Reg_RTCMcorrectionsParams(LONG packetHandle, struct RTCMcorrectionsCommon_RegionalExtension_Reg_RTCMcorrections value, char oldPath[])
{
  char newPath[300];
  int result;

  result = 0;

  snprintf(newPath, elcount(newPath), "%s.%s", oldPath, "regionId");
  value.regionId = C2xGetTokenInt(packetHandle, "RTCMcorrections", newPath);
  result = CheckLastError("RTCMcorrections", gkFuncRefGet, result);

  return result;
}

int SetRTCMcorrectionsCommon_RegionalExtension_Reg_RTCMcorrectionsParams(LONG packetHandle, struct RTCMcorrectionsCommon_RegionalExtension_Reg_RTCMcorrections value, char oldPath[])
{
  char newPath[300];
  int result;

  result = 0;


  return result;
}

int GetRTCMcorrectionsRTCMcorrections_regionalParams(LONG packetHandle, struct RTCMcorrectionsRTCMcorrections_regional value, char oldPath[])
{
  char newPath[300]; 
  int i;
  int result;

  result = 0;

  value.length = C2xGetTokenInt(packetHandle, "RTCMcorrections", oldPath);
  if((result = CheckLastError("RTCMcorrections", gkFuncRefGet, result))==0)
  {
    for(i=0; i<value.length; i++)
    {
      snprintf(newPath, elcount(newPath), "%s[%d]", oldPath, i);
      GetRTCMcorrectionsCommon_RegionalExtension_Reg_RTCMcorrectionsParams(packetHandle, value.arrayValue[i], newPath);
      result = CheckLastError("RTCMcorrections", gkFuncRefGet, result);
    }
  }
  return result;
}

int SetRTCMcorrectionsRTCMcorrections_regionalParams(LONG packetHandle, struct RTCMcorrectionsRTCMcorrections_regional value, char oldPath[])
{
  char newPath[300]; 
  int i;
  int result;

  result = 0;

  C2xRemoveToken(packetHandle, "RTCMcorrections", oldPath);
  for(i=0; i<value.length; i++)
  {
    snprintf(newPath, elcount(newPath), "%s[%d]", oldPath, i);
    SetRTCMcorrectionsCommon_RegionalExtension_Reg_RTCMcorrectionsParams(packetHandle, value.arrayValue[i], newPath);
    result = CheckLastError("RTCMcorrections", gkFuncRefGet, result);
  }
  return result;
}

int GetRTCMcorrections_RTCMcorrectionsParams(LONG packetHandle, struct RTCMcorrections_RTCMcorrections value, char oldPath[])
{
  char newPath[300];
  int result;

  result = 0;

  snprintf(newPath, elcount(newPath), "%s.%s", oldPath, "msgCnt");
  value.msgCnt = C2xGetTokenInt(packetHandle, "RTCMcorrections", newPath);
  result = CheckLastError("RTCMcorrections", gkFuncRefGet, result);

  snprintf(newPath, elcount(newPath), "%s.%s", oldPath, "rev");
  value.rev = C2xGetTokenInt(packetHandle, "RTCMcorrections", newPath);
  result = CheckLastError("RTCMcorrections", gkFuncRefGet, result);

  snprintf(newPath, elcount(newPath), "%s.%s", oldPath, "timeStamp");
  value.timeStamp.isValidFlag = C2xIsTokenAvailable(packetHandle, "RTCMcorrections", newPath);
  if(value.timeStamp.isValidFlag==1)
  {
    value.timeStamp.value = C2xGetTokenInt(packetHandle, "RTCMcorrections", newPath);
    result = CheckLastError("RTCMcorrections", gkFuncRefGet, result);
  }
  snprintf(newPath, elcount(newPath), "%s.%s", oldPath, "anchorPoint");
  value.anchorPoint.isValidFlag = C2xIsTokenAvailable(packetHandle, "RTCMcorrections", newPath);
  if(value.anchorPoint.isValidFlag==1)
  {
    GetRTCMcorrectionsCommon_FullPositionVectorParams(packetHandle, value.anchorPoint, newPath);
    result = CheckLastError("RTCMcorrections", gkFuncRefGet, result);
  }
  snprintf(newPath, elcount(newPath), "%s.%s", oldPath, "rtcmHeader");
  value.rtcmHeader.isValidFlag = C2xIsTokenAvailable(packetHandle, "RTCMcorrections", newPath);
  if(value.rtcmHeader.isValidFlag==1)
  {
    GetRTCMcorrectionsCommon_RTCMheaderParams(packetHandle, value.rtcmHeader, newPath);
    result = CheckLastError("RTCMcorrections", gkFuncRefGet, result);
  }
  snprintf(newPath, elcount(newPath), "%s.%s", oldPath, "msgs");
  GetRTCMcorrectionsCommon_RTCMmessageListParams(packetHandle, value.msgs, newPath);
  result = CheckLastError("RTCMcorrections", gkFuncRefGet, result);

  snprintf(newPath, elcount(newPath), "%s.%s", oldPath, "regional");
  value.regional.isValidFlag = C2xIsTokenAvailable(packetHandle, "RTCMcorrections", newPath);
  if(value.regional.isValidFlag==1)
  {
    GetRTCMcorrectionsRTCMcorrections_regionalParams(packetHandle, value.regional, newPath);
    result = CheckLastError("RTCMcorrections", gkFuncRefGet, result);
  }
  return result;
}

int SetRTCMcorrections_RTCMcorrectionsParams(LONG packetHandle, struct RTCMcorrections_RTCMcorrections value, char oldPath[])
{
  char newPath[300];
  int result;

  result = 0;

  snprintf(newPath, elcount(newPath), "%s.%s", oldPath, "msgCnt");
  C2xSetTokenInt(packetHandle, "RTCMcorrections", newPath, value.msgCnt);
  result = CheckLastError("RTCMcorrections", gkFuncRefGet, result);

  snprintf(newPath, elcount(newPath), "%s.%s", oldPath, "rev");
  C2xSetTokenInt(packetHandle, "RTCMcorrections", newPath, value.rev);
  result = CheckLastError("RTCMcorrections", gkFuncRefGet, result);

  snprintf(newPath, elcount(newPath), "%s.%s", oldPath, "timeStamp");
  if(value.timeStamp.isValidFlag==1)
  {
    C2xSetTokenInt(packetHandle, "RTCMcorrections", newPath, value.timeStamp.value);
    result = CheckLastError("RTCMcorrections", gkFuncRefGet, result);
  }
  else
  {
    if( C2xIsTokenAvailable(packetHandle, "RTCMcorrections", newPath) )
    {
      C2xRemoveToken(packetHandle, "RTCMcorrections", newPath);
    }
  }

  snprintf(newPath, elcount(newPath), "%s.%s", oldPath, "anchorPoint");
  if(value.anchorPoint.isValidFlag==1)
  {
    SetRTCMcorrectionsCommon_FullPositionVectorParams(packetHandle, value.anchorPoint, newPath);
    result = CheckLastError("RTCMcorrections", gkFuncRefGet, result);
  }
  else
  {
    if( C2xIsTokenAvailable(packetHandle, "RTCMcorrections", newPath) )
    {
      C2xRemoveToken(packetHandle, "RTCMcorrections", newPath);
    }
  }

  snprintf(newPath, elcount(newPath), "%s.%s", oldPath, "rtcmHeader");
  if(value.rtcmHeader.isValidFlag==1)
  {
    SetRTCMcorrectionsCommon_RTCMheaderParams(packetHandle, value.rtcmHeader, newPath);
    result = CheckLastError("RTCMcorrections", gkFuncRefGet, result);
  }
  else
  {
    if( C2xIsTokenAvailable(packetHandle, "RTCMcorrections", newPath) )
    {
      C2xRemoveToken(packetHandle, "RTCMcorrections", newPath);
    }
  }

  snprintf(newPath, elcount(newPath), "%s.%s", oldPath, "msgs");
  SetRTCMcorrectionsCommon_RTCMmessageListParams(packetHandle, value.msgs, newPath);
  result = CheckLastError("RTCMcorrections", gkFuncRefGet, result);

  snprintf(newPath, elcount(newPath), "%s.%s", oldPath, "regional");
  if(value.regional.isValidFlag==1)
  {
    SetRTCMcorrectionsRTCMcorrections_regionalParams(packetHandle, value.regional, newPath);
    result = CheckLastError("RTCMcorrections", gkFuncRefGet, result);
  }
  else
  {
    if( C2xIsTokenAvailable(packetHandle, "RTCMcorrections", newPath) )
    {
      C2xRemoveToken(packetHandle, "RTCMcorrections", newPath);
    }
  }

  return result;
}

int GetRTCMcorrectionsMESSAGE_ID_AND_TYPEParams(LONG packetHandle, WORD tableKey, struct RTCMcorrectionsMESSAGE_ID_AND_TYPE value, char oldPath[])
{
  char newPath[300];
  int result;

  result = 0;

  switch(tableKey)
  {
    case 28:
    {
      snprintf(newPath, elcount(newPath), "%s.%s", oldPath, "rtcmCorrections");
      GetRTCMcorrections_RTCMcorrectionsParams(packetHandle, value.rtcmCorrections, newPath);
      result = CheckLastError("RTCMcorrections", gkFuncRefGet, result);
    }
    break;
  }
  return result;
}

int SetRTCMcorrectionsMESSAGE_ID_AND_TYPEParams(LONG packetHandle, WORD tableKey, struct RTCMcorrectionsMESSAGE_ID_AND_TYPE value, char oldPath[])
{
  char newPath[300];
  int result;

  result = 0;

  switch(tableKey)
  {
    case 28:
    {
      snprintf(newPath, elcount(newPath), "%s.%s", oldPath, "rtcmCorrections");
      SetRTCMcorrections_RTCMcorrectionsParams(packetHandle, value.rtcmCorrections, newPath);
      result = CheckLastError("RTCMcorrections", gkFuncRefGet, result);
    }
    break;
  }
  return result;
}

int API_GetRTCMcorrectionsParams(LONG packetHandle, struct RTCMcorrections value)
{
  int result;
  result = 0;

  value.messageId = C2xGetTokenInt(packetHandle, "RTCMcorrections", "messageId");
  result = CheckLastError("RTCMcorrections", gkFuncRefGet, result);

  GetRTCMcorrectionsMESSAGE_ID_AND_TYPEParams(packetHandle, value.messageId, value.value, "value");
  result = CheckLastError("RTCMcorrections", gkFuncRefGet, result);

  return result;
}

int API_SetRTCMcorrectionsParams(LONG packetHandle, struct RTCMcorrections value)
{
  int result;
  result = 0;

  value.messageId = 28;

  SetRTCMcorrectionsMESSAGE_ID_AND_TYPEParams(packetHandle, value.messageId, value.value, "value");
  result = CheckLastError("RTCMcorrections", gkFuncRefGet, result);

  return result;
}

