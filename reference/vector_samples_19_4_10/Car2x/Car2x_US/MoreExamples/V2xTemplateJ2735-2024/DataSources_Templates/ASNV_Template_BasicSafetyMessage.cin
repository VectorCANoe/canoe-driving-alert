/*@!Encoding:1252*/
/*
//  (c) Vector Informatik GmbH. All rights reserved.
//
//  This file contains definitions of structs and methods that may be used
//  to set and get the values of an ASN.1 defined packet's payload.
//
//  //This example demonstrates how to set a packet's payload:
//  LONG packetHandle;
//  struct BasicSafetyMessage payload;
//  //you need to set the values of the variable "payload" yourself
//  packetHandle = API_InitBasicSafetyMessagePacket();
//  if (packetHandle!=0) {
//    if (API_SetBasicSafetyMessageParams(packetHandle, payload)==0) {
//      if (C2xCompletePacket(packetHandle)==0) {
//        C2xOutputPacket(packetHandle);
//      }
//    }
//  }
//                                                                             */
includes
{
  #include "ASNV_Template_BaseDatatypes.cin"  // If warning "Duplicate #include, ignoring this include" appears, please remove the ASNV_Template_BaseDatatypes.cin include from your other *.cin files in the project.
}
variables
{
    struct BasicSafetyMessageTemporaryID {
        INT isValidFlag;   // necessary if this struct is used as an optional field of a SEQUENCE
        CHAR string[5];
        INT  stringLength;
    };
    
    struct BasicSafetyMessagePositionalAccuracy {
        INT isValidFlag;   // necessary if this struct is used as an optional field of a SEQUENCE
        BYTE semiMajor;  // INTEGER, 0..255;
        BYTE semiMinor;  // INTEGER, 0..255;
        WORD orientation;  // INTEGER, 0..65535;
    };
    
    struct BasicSafetyMessageAccelerationSet4Way {
        INT isValidFlag;   // necessary if this struct is used as an optional field of a SEQUENCE
        INT lon;  // INTEGER, -2000..2001;
        INT lat;  // INTEGER, -2000..2001;
        INT vert;  // INTEGER, -127..127;
        INT yaw;  // INTEGER, -32767..32767;
    };
    
    struct BasicSafetyMessageBrakeAppliedStatus {
        INT isValidFlag;   // necessary if this struct is used as an optional field of a SEQUENCE
        CHAR string[6];
        INT  stringLength;
    };
    
    struct BasicSafetyMessageBrakeSystemStatus {
        INT isValidFlag;   // necessary if this struct is used as an optional field of a SEQUENCE
        struct BasicSafetyMessageBrakeAppliedStatus wheelBrakes;  // BITSTRING;
        INT traction;  // ENUMERATED, unavailable(0), off(1), on(2), engaged(3);
        INT antiLockBrake;  // ENUMERATED, unavailable(0), off(1), on(2), engaged(3);
        INT scs;  // ENUMERATED, unavailable(0), off(1), on(2), engaged(3);
        INT brakeBoost;  // ENUMERATED, unavailable(0), off(1), on(2);
        INT auxBrakes;  // ENUMERATED, unavailable(0), off(1), on(2), reserved(3);
    };
    
    struct BasicSafetyMessageVehicleSize {
        INT isValidFlag;   // necessary if this struct is used as an optional field of a SEQUENCE
        WORD width;  // INTEGER, 0..1023;
        WORD length;  // INTEGER, 0..4095;
    };
    
    struct BasicSafetyMessageBSMcoreData {
        INT isValidFlag;   // necessary if this struct is used as an optional field of a SEQUENCE
        BYTE msgCnt;  // INTEGER, 0..127;
        struct BasicSafetyMessageTemporaryID id;  // OCTETSTRING;
        WORD secMark;  // INTEGER, 0..65535;
        LONG lat;  // INTEGER, -900000000..900000001;
        LONG lon;  // INTEGER, -1799999999..1800000001;
        LONG elev;  // INTEGER, -4096..61439;
        struct BasicSafetyMessagePositionalAccuracy accuracy;  // SEQUENCE;
        INT transmission;  // ENUMERATED, neutral(0), park(1), forwardGears(2), reverseGears(3), reserved1(4), reserved2(5), reserved3(6), unavailable(7);
        WORD speed;  // INTEGER, 0..8191;
        WORD heading;  // INTEGER, 0..28800;
        INT angle;  // INTEGER, -126..127;
        struct BasicSafetyMessageAccelerationSet4Way accelSet;  // SEQUENCE;
        struct BasicSafetyMessageBrakeSystemStatus brakes;  // SEQUENCE;
        struct BasicSafetyMessageVehicleSize size;  // SEQUENCE;
    };
    
    struct BasicSafetyMessageVehicleEventFlags {
        INT isValidFlag;   // necessary if this struct is used as an optional field of a SEQUENCE
        CHAR string[15];
        INT  stringLength;
    };
    
    struct BasicSafetyMessageDDateTime {
        INT isValidFlag;   // necessary if this struct is used as an optional field of a SEQUENCE
        struct OPT_WORD_ASN year;  // INTEGER, OPTIONAL, 0..4095;
        struct OPT_BYTE_ASN month;  // INTEGER, OPTIONAL, 0..12;
        struct OPT_BYTE_ASN day;  // INTEGER, OPTIONAL, 0..31;
        struct OPT_BYTE_ASN hour;  // INTEGER, OPTIONAL, 0..31;
        struct OPT_BYTE_ASN minute;  // INTEGER, OPTIONAL, 0..60;
        struct OPT_WORD_ASN second;  // INTEGER, OPTIONAL, 0..65535;
        struct OPT_INT_ASN offset;  // INTEGER, OPTIONAL, -840..840;
    };
    
    struct BasicSafetyMessageTransmissionAndSpeed {
        INT isValidFlag;   // necessary if this struct is used as an optional field of a SEQUENCE
        INT transmisson;  // ENUMERATED, neutral(0), park(1), forwardGears(2), reverseGears(3), reserved1(4), reserved2(5), reserved3(6), unavailable(7);
        WORD speed;  // INTEGER, 0..8191;
    };
    
    struct BasicSafetyMessagePositionConfidenceSet {
        INT isValidFlag;   // necessary if this struct is used as an optional field of a SEQUENCE
        INT pos;  // ENUMERATED, unavailable(0), a500m(1), a200m(2), a100m(3), a50m(4), a20m(5), a10m(6), a5m(7), a2m(8), a1m(9), a50cm(10), a20cm(11), a10cm(12), a5cm(13), a2cm(14), a1cm(15);
        INT elevation;  // ENUMERATED, unavailable(0), elev_500_00(1), elev_200_00(2), elev_100_00(3), elev_050_00(4), elev_020_00(5), elev_010_00(6), elev_005_00(7), elev_002_00(8), elev_001_00(9), elev_000_50(10), elev_000_20(11), elev_000_10(12), elev_000_05(13), elev_000_02(14), elev_000_01(15);
    };
    
    struct BasicSafetyMessageSpeedandHeadingandThrottleConfidence {
        INT isValidFlag;   // necessary if this struct is used as an optional field of a SEQUENCE
        INT heading;  // ENUMERATED, unavailable(0), prec10deg(1), prec05deg(2), prec01deg(3), prec0_1deg(4), prec0_05deg(5), prec0_01deg(6), prec0_0125deg(7);
        INT speed;  // ENUMERATED, unavailable(0), prec100ms(1), prec10ms(2), prec5ms(3), prec1ms(4), prec0_1ms(5), prec0_05ms(6), prec0_01ms(7);
        INT throttle;  // ENUMERATED, unavailable(0), prec10percent(1), prec1percent(2), prec0_5percent(3);
    };
    
    struct BasicSafetyMessageFullPositionVector {
        INT isValidFlag;   // necessary if this struct is used as an optional field of a SEQUENCE
        struct BasicSafetyMessageDDateTime utcTime;  // SEQUENCE, OPTIONAL;
        LONG lon;  // INTEGER, -1799999999..1800000001;
        LONG lat;  // INTEGER, -900000000..900000001;
        struct OPT_LONG_ASN elevation;  // INTEGER, OPTIONAL, -4096..61439;
        struct OPT_WORD_ASN heading;  // INTEGER, OPTIONAL, 0..28800;
        struct BasicSafetyMessageTransmissionAndSpeed speed;  // SEQUENCE, OPTIONAL;
        struct BasicSafetyMessagePositionalAccuracy posAccuracy;  // SEQUENCE, OPTIONAL;
        struct OPT_ENUM_ASN timeConfidence;  // ENUMERATED, OPTIONAL, unavailable(0), time_100_000(1), time_050_000(2), time_020_000(3), time_010_000(4), time_002_000(5), time_001_000(6), time_000_500(7), time_000_200(8), time_000_100(9), time_000_050(10), time_000_020(11), time_000_010(12), time_000_005(13), time_000_002(14), time_000_001(15), time_000_000_5(16), time_000_000_2(17), time_000_000_1(18), time_000_000_05(19), time_000_000_02(20), time_000_000_01(21), time_000_000_005(22), time_000_000_002(23), time_000_000_001(24), time_000_000_000_5(25), time_000_000_000_2(26), time_000_000_000_1(27), time_000_000_000_05(28), time_000_000_000_02(29), time_000_000_000_01(30), time_000_000_000_005(31), time_000_000_000_002(32), time_000_000_000_001(33), time_000_000_000_000_5(34), time_000_000_000_000_2(35), time_000_000_000_000_1(36), time_000_000_000_000_05(37), time_000_000_000_000_02(38), time_000_000_000_000_01(39);
        struct BasicSafetyMessagePositionConfidenceSet posConfidence;  // SEQUENCE, OPTIONAL;
        struct BasicSafetyMessageSpeedandHeadingandThrottleConfidence speedConfidence;  // SEQUENCE, OPTIONAL;
    };
    
    struct BasicSafetyMessageGNSSstatus {
        INT isValidFlag;   // necessary if this struct is used as an optional field of a SEQUENCE
        CHAR string[9];
        INT  stringLength;
    };
    
    struct BasicSafetyMessagePathHistoryPoint {
        INT isValidFlag;   // necessary if this struct is used as an optional field of a SEQUENCE
        LONG latOffset;  // INTEGER, -131072..131071;
        LONG lonOffset;  // INTEGER, -131072..131071;
        INT elevationOffset;  // INTEGER, -2048..2047;
        WORD timeOffset;  // INTEGER, 1..65535;
        struct OPT_WORD_ASN speed;  // INTEGER, OPTIONAL, 0..8191;
        struct BasicSafetyMessagePositionalAccuracy posAccuracy;  // SEQUENCE, OPTIONAL;
        struct OPT_BYTE_ASN heading;  // INTEGER, OPTIONAL, 0..240;
    };
    
    struct BasicSafetyMessagePathHistoryPointList {
        INT isValidFlag;   // necessary if this struct is used as an optional field of a SEQUENCE
        INT length;
        struct BasicSafetyMessagePathHistoryPoint arrayValue[23];  // SEQUENCE;
    };
    
    struct BasicSafetyMessagePathHistory {
        INT isValidFlag;   // necessary if this struct is used as an optional field of a SEQUENCE
        struct BasicSafetyMessageFullPositionVector initialPosition;  // SEQUENCE, OPTIONAL;
        struct BasicSafetyMessageGNSSstatus currGNSSstatus;  // BITSTRING, OPTIONAL;
        struct BasicSafetyMessagePathHistoryPointList crumbData;  // SEQUENCEOF;
    };
    
    struct BasicSafetyMessagePathPrediction {
        INT isValidFlag;   // necessary if this struct is used as an optional field of a SEQUENCE
        INT radiusOfCurve;  // INTEGER, -32767..32767;
        BYTE confidence;  // INTEGER, 0..200;
    };
    
    struct BasicSafetyMessageExteriorLights {
        INT isValidFlag;   // necessary if this struct is used as an optional field of a SEQUENCE
        CHAR string[10];
        INT  stringLength;
    };
    
    struct BasicSafetyMessageVehicleSafetyExtensions {
        INT isValidFlag;   // necessary if this struct is used as an optional field of a SEQUENCE
        struct BasicSafetyMessageVehicleEventFlags events;  // BITSTRING, OPTIONAL;
        struct BasicSafetyMessagePathHistory pathHistory;  // SEQUENCE, OPTIONAL;
        struct BasicSafetyMessagePathPrediction pathPrediction;  // SEQUENCE, OPTIONAL;
        struct BasicSafetyMessageExteriorLights lights;  // BITSTRING, OPTIONAL;
    };
    
    struct BasicSafetyMessagePrivilegedEventFlags {
        INT isValidFlag;   // necessary if this struct is used as an optional field of a SEQUENCE
        CHAR string[17];
        INT  stringLength;
    };
    
    struct BasicSafetyMessagePrivilegedEvents {
        INT isValidFlag;   // necessary if this struct is used as an optional field of a SEQUENCE
        BYTE doNotUse;  // INTEGER, 0..31;
        struct BasicSafetyMessagePrivilegedEventFlags event;  // BITSTRING;
    };
    
    struct BasicSafetyMessageEmergencyDetails {
        INT isValidFlag;   // necessary if this struct is used as an optional field of a SEQUENCE
        BYTE doNotUse;  // INTEGER, 0..31;
        INT sirenUse;  // ENUMERATED, unavailable(0), notInUse(1), inUse(2), reserved(3);
        INT lightsUse;  // ENUMERATED, unavailable(0), notInUse(1), inUse(2), yellowCautionLights(3), schooldBusLights(4), arrowSignsActive(5), slowMovingVehicle(6), freqStops(7);
        INT multi;  // ENUMERATED, unavailable(0), singleVehicle(1), multiVehicle(2), reserved(3);
        struct BasicSafetyMessagePrivilegedEvents events;  // SEQUENCE, OPTIONAL;
        struct OPT_ENUM_ASN responseType;  // ENUMERATED, OPTIONAL, notInUseOrNotEquipped(0), emergency(1), nonEmergency(2), pursuit(3), stationary(4), slowMoving(5), stopAndGoMovement(6);
    };
    
    struct BasicSafetyMessageEventDescription_description {
        INT isValidFlag;   // necessary if this struct is used as an optional field of a SEQUENCE
        INT length;
        WORD arrayValue[8];  // INTEGER, 0..65535;
    };
    
    struct BasicSafetyMessagePriority {
        INT isValidFlag;   // necessary if this struct is used as an optional field of a SEQUENCE
        CHAR string[2];
        INT  stringLength;
    };
    
    struct BasicSafetyMessageHeadingSlice {
        INT isValidFlag;   // necessary if this struct is used as an optional field of a SEQUENCE
        CHAR string[17];
        INT  stringLength;
    };
    
    struct BasicSafetyMessageRegionalExtension_table {
    };
    
    struct BasicSafetyMessageRegionalExtension {
        INT isValidFlag;   // necessary if this struct is used as an optional field of a SEQUENCE
        BYTE regionId;  // INTEGER, 0..255, noRegion(0), addGrpA(1), addGrpB(2), addGrpC(3), addGrpD(4);
        struct BasicSafetyMessageRegionalExtension_table regExtvalue;  // TABLE;
    };
    
    struct BasicSafetyMessageEventDescription_regional {
        INT isValidFlag;   // necessary if this struct is used as an optional field of a SEQUENCE
        INT length;
        struct BasicSafetyMessageRegionalExtension arrayValue[4];  // SEQUENCE;
    };
    
    struct BasicSafetyMessageEventDescription {
        INT isValidFlag;   // necessary if this struct is used as an optional field of a SEQUENCE
        WORD typeEvent;  // INTEGER, 0..65535;
        struct BasicSafetyMessageEventDescription_description description;  // SEQUENCEOF, OPTIONAL;
        struct BasicSafetyMessagePriority priority;  // OCTETSTRING, OPTIONAL;
        struct BasicSafetyMessageHeadingSlice heading;  // BITSTRING, OPTIONAL;
        struct OPT_ENUM_ASN extent;  // ENUMERATED, OPTIONAL, useInstantlyOnly(0), useFor3meters(1), useFor10meters(2), useFor50meters(3), useFor100meters(4), useFor500meters(5), useFor1000meters(6), useFor5000meters(7), useFor10000meters(8), useFor50000meters(9), useFor100000meters(10), useFor500000meters(11), useFor1000000meters(12), useFor5000000meters(13), useFor10000000meters(14), forever(15);
        struct BasicSafetyMessageEventDescription_regional regional;  // SEQUENCEOF, OPTIONAL;
    };
    
    struct BasicSafetyMessagePivotPointDescription {
        INT isValidFlag;   // necessary if this struct is used as an optional field of a SEQUENCE
        INT pivotOffset;  // INTEGER, -1024..1023;
        WORD pivotAngle;  // INTEGER, 0..28800;
        INT pivots;  // BOOLEAN;
    };
    
    struct BasicSafetyMessageBumperHeights {
        INT isValidFlag;   // necessary if this struct is used as an optional field of a SEQUENCE
        BYTE front;  // INTEGER, 0..127;
        BYTE rear;  // INTEGER, 0..127;
    };
    
    struct BasicSafetyMessageNode_XY_24b {
        INT isValidFlag;   // necessary if this struct is used as an optional field of a SEQUENCE
        INT x;  // INTEGER, -2048..2047;
        INT y;  // INTEGER, -2048..2047;
    };
    
    struct BasicSafetyMessageTrailerHistoryPoint {
        INT isValidFlag;   // necessary if this struct is used as an optional field of a SEQUENCE
        WORD pivotAngle;  // INTEGER, 0..28800;
        WORD timeOffset;  // INTEGER, 1..65535;
        struct BasicSafetyMessageNode_XY_24b positionOffset;  // SEQUENCE;
        struct OPT_INT_ASN elevationOffset;  // INTEGER, OPTIONAL, -64..63;
        struct OPT_BYTE_ASN heading;  // INTEGER, OPTIONAL, 0..240;
    };
    
    struct BasicSafetyMessageTrailerHistoryPointList {
        INT isValidFlag;   // necessary if this struct is used as an optional field of a SEQUENCE
        INT length;
        struct BasicSafetyMessageTrailerHistoryPoint arrayValue[23];  // SEQUENCE;
    };
    
    struct BasicSafetyMessageTrailerUnitDescription {
        INT isValidFlag;   // necessary if this struct is used as an optional field of a SEQUENCE
        INT isDolly;  // BOOLEAN;
        WORD width;  // INTEGER, 0..1023;
        WORD length;  // INTEGER, 0..4095;
        struct OPT_BYTE_ASN height;  // INTEGER, OPTIONAL, 0..127;
        struct OPT_BYTE_ASN mass;  // INTEGER, OPTIONAL, 0..255;
        struct BasicSafetyMessageBumperHeights bumperHeights;  // SEQUENCE, OPTIONAL;
        struct OPT_BYTE_ASN centerOfGravity;  // INTEGER, OPTIONAL, 0..127;
        struct BasicSafetyMessagePivotPointDescription frontPivot;  // SEQUENCE;
        struct BasicSafetyMessagePivotPointDescription rearPivot;  // SEQUENCE, OPTIONAL;
        struct OPT_INT_ASN rearWheelOffset;  // INTEGER, OPTIONAL, -2048..2047;
        struct BasicSafetyMessageNode_XY_24b positionOffset;  // SEQUENCE;
        struct OPT_INT_ASN elevationOffset;  // INTEGER, OPTIONAL, -64..63;
        struct BasicSafetyMessageTrailerHistoryPointList crumbData;  // SEQUENCEOF, OPTIONAL;
    };
    
    struct BasicSafetyMessageTrailerUnitDescriptionList {
        INT isValidFlag;   // necessary if this struct is used as an optional field of a SEQUENCE
        INT length;
        struct BasicSafetyMessageTrailerUnitDescription arrayValue[8];  // SEQUENCE;
    };
    
    struct BasicSafetyMessageTrailerData {
        INT isValidFlag;   // necessary if this struct is used as an optional field of a SEQUENCE
        BYTE doNotUse;  // INTEGER, 0..31;
        struct BasicSafetyMessagePivotPointDescription connection;  // SEQUENCE;
        struct BasicSafetyMessageTrailerUnitDescriptionList units;  // SEQUENCEOF;
    };
    
    struct BasicSafetyMessageSpecialVehicleExtensions {
        INT isValidFlag;   // necessary if this struct is used as an optional field of a SEQUENCE
        struct BasicSafetyMessageEmergencyDetails vehicleAlerts;  // SEQUENCE, OPTIONAL;
        struct BasicSafetyMessageEventDescription description;  // SEQUENCE, OPTIONAL;
        struct BasicSafetyMessageTrailerData doNotUse;  // SEQUENCE, OPTIONAL;
    };
    
    struct BasicSafetyMessageRegionalExtension_Reg_VehicleClassification_table {
    };
    
    struct BasicSafetyMessageRegionalExtension_Reg_VehicleClassification {
        INT isValidFlag;   // necessary if this struct is used as an optional field of a SEQUENCE
        BYTE regionId;  // INTEGER, 0..255, noRegion(0), addGrpA(1), addGrpB(2), addGrpC(3), addGrpD(4);
        struct BasicSafetyMessageRegionalExtension_Reg_VehicleClassification_table regExtvalue;  // TABLE;
    };
    
    struct BasicSafetyMessageVehicleClassification_regional {
        INT isValidFlag;   // necessary if this struct is used as an optional field of a SEQUENCE
        INT length;
        struct BasicSafetyMessageRegionalExtension_Reg_VehicleClassification arrayValue[4];  // SEQUENCE;
    };
    
    struct BasicSafetyMessageVehicleClassification {
        INT isValidFlag;   // necessary if this struct is used as an optional field of a SEQUENCE
        struct OPT_BYTE_ASN keyType;  // INTEGER, OPTIONAL, 0..255, unknownVehicleClass(0), specialVehicleClass(1), passenger_Vehicle_TypeUnknown(10), passenger_Vehicle_TypeOther(11), lightTruck_Vehicle_TypeUnknown(20), lightTruck_Vehicle_TypeOther(21), truck_Vehicle_TypeUnknown(25), truck_Vehicle_TypeOther(26), truck_axleCnt2(27), truck_axleCnt3(28), truck_axleCnt4(29), truck_axleCnt4Trailer(30), truck_axleCnt5Trailer(31), truck_axleCnt6Trailer(32), truck_axleCnt5MultiTrailer(33), truck_axleCnt6MultiTrailer(34), truck_axleCnt7MultiTrailer(35), motorcycle_TypeUnknown(40), motorcycle_TypeOther(41), motorcycle_Cruiser_Standard(42), motorcycle_SportUnclad(43), motorcycle_SportTouring(44), motorcycle_SuperSport(45), motorcycle_Touring(46), motorcycle_Trike(47), motorcycle_wPassengers(48), transit_TypeUnknown(50), transit_TypeOther(51), transit_BRT(52), transit_ExpressBus(53), transit_LocalBus(54), transit_SchoolBus(55), transit_FixedGuideway(56), transit_Paratransit(57), transit_Paratransit_Ambulance(58), emergency_TypeUnknown(60), emergency_TypeOther(61), emergency_Fire_Light_Vehicle(62), emergency_Fire_Heavy_Vehicle(63), emergency_Fire_Paramedic_Vehicle(64), emergency_Fire_Ambulance_Vehicle(65), emergency_Police_Light_Vehicle(66), emergency_Police_Heavy_Vehicle(67), emergency_Other_Responder(68), emergency_Other_Ambulance(69), otherTraveler_TypeUnknown(80), otherTraveler_TypeOther(81), otherTraveler_Pedestrian(82), otherTraveler_Visually_Disabled(83), otherTraveler_Physically_Disabled(84), otherTraveler_Bicycle(85), otherTraveler_Vulnerable_Roadworker(86), infrastructure_TypeUnknown(90), infrastructure_Fixed(91), infrastructure_Movable(92), equipped_CargoTrailer(93);
        struct OPT_ENUM_ASN role;  // ENUMERATED, OPTIONAL, basicVehicle(0), publicTransport(1), specialTransport(2), dangerousGoods(3), roadWork(4), roadRescue(5), emergency(6), safetyCar(7), none_unknown(8), truck(9), motorcycle(10), roadSideSource(11), police(12), fire(13), ambulance(14), dot(15), transit(16), slowMoving(17), stopNgo(18), cyclist(19), pedestrian(20), nonMotorized(21), military(22);
        struct OPT_BYTE_ASN iso3883;  // INTEGER, OPTIONAL, 0..100;
        struct OPT_ENUM_ASN hpmsType;  // ENUMERATED, OPTIONAL, none(0), unknown(1), special(2), moto(3), car(4), carOther(5), bus(6), axleCnt2(7), axleCnt3(8), axleCnt4(9), axleCnt4Trailer(10), axleCnt5Trailer(11), axleCnt6Trailer(12), axleCnt5MultiTrailer(13), axleCnt6MultiTrailer(14), axleCnt7MultiTrailer(15);
        struct OPT_ENUM_ASN vehicleType;  // ENUMERATED, OPTIONAL, all_vehicles(9217), bicycles(9218), motorcycles(9219), cars(9220), light_vehicles(9221), cars_and_light_vehicles(9222), cars_with_trailers(9223), cars_with_recreational_trailers(9224), vehicles_with_trailers(9225), heavy_vehicles(9226), trucks(9227), buses(9228), articulated_buses(9229), school_buses(9230), vehicles_with_semi_trailers(9231), vehicles_with_double_trailers(9232), high_profile_vehicles(9233), wide_vehicles(9234), long_vehicles(9235), hazardous_loads(9236), exceptional_loads(9237), abnormal_loads(9238), convoys(9239), maintenance_vehicles(9240), delivery_vehicles(9241), vehicles_with_even_numbered_license_plates(9242), vehicles_with_odd_numbered_license_plates(9243), vehicles_with_parking_permits(9244), vehicles_with_catalytic_converters(9245), vehicles_without_catalytic_converters(9246), gas_powered_vehicles(9247), diesel_powered_vehicles(9248), lPG_vehicles(9249), military_convoys(9250), military_vehicles(9251);
        struct OPT_ENUM_ASN responseEquip;  // ENUMERATED, OPTIONAL, ground_fire_suppression(9985), heavy_ground_equipment(9986), aircraft(9988), marine_equipment(9989), support_equipment(9990), medical_rescue_unit(9991), other(9993), ground_fire_suppression_other(9994), engine(9995), truck_or_aerial(9996), quint(9997), tanker_pumper_combination(9998), brush_truck(10000), aircraft_rescue_firefighting(10001), heavy_ground_equipment_other(10004), dozer_or_plow(10005), tractor(10006), tanker_or_tender(10008), aircraft_other(10024), aircraft_fixed_wing_tanker(10025), helitanker(10026), helicopter(10027), marine_equipment_other(10034), fire_boat_with_pump(10035), boat_no_pump(10036), support_apparatus_other(10044), breathing_apparatus_support(10045), light_and_air_unit(10046), medical_rescue_unit_other(10054), rescue_unit(10055), urban_search_rescue_unit(10056), high_angle_rescue(10057), crash_fire_rescue(10058), bLS_unit(10059), aLS_unit(10060), mobile_command_post(10075), chief_officer_car(10076), hAZMAT_unit(10077), type_i_hand_crew(10078), type_ii_hand_crew(10079), privately_owned_vehicle(10083), other_apparatus_resource(10084), ambulance(10085), bomb_squad_van(10086), combine_harvester(10087), construction_vehicle(10088), farm_tractor(10089), grass_cutting_machines(10090), hAZMAT_containment_tow(10091), heavy_tow(10092), light_tow(10094), flatbed_tow(10114), hedge_cutting_machines(10093), mobile_crane(10095), refuse_collection_vehicle(10096), resurfacing_vehicle(10097), road_sweeper(10098), roadside_litter_collection_crews(10099), salvage_vehicle(10100), sand_truck(10101), snowplow(10102), steam_roller(10103), swat_team_van(10104), track_laying_vehicle(10105), unknown_vehicle(10106), white_lining_vehicle(10107), dump_truck(10108), supervisor_vehicle(10109), snow_blower(10110), rotary_snow_blower(10111), road_grader(10112), steam_truck(10113);
        struct OPT_ENUM_ASN responderType;  // ENUMERATED, OPTIONAL, emergency_vehicle_units(9729), federal_law_enforcement_units(9730), state_police_units(9731), county_police_units(9732), local_police_units(9733), ambulance_units(9734), rescue_units(9735), fire_units(9736), hAZMAT_units(9737), light_tow_unit(9738), heavy_tow_unit(9739), freeway_service_patrols(9740), transportation_response_units(9741), private_contractor_response_units(9742);
        struct OPT_BYTE_ASN fuelType;  // INTEGER, OPTIONAL, 0..15, unknownFuel(0), gasoline(1), ethanol(2), diesel(3), electric(4), hybrid(5), hydrogen(6), natGasLiquid(7), natGasComp(8), propane(9);
        struct BasicSafetyMessageVehicleClassification_regional regional;  // SEQUENCEOF, OPTIONAL;
    };
    
    struct BasicSafetyMessageAxles {
        INT isValidFlag;   // necessary if this struct is used as an optional field of a SEQUENCE
        BYTE totalAxles;  // INTEGER, 1..10;
        struct OPT_BYTE_ASN frontAxles;  // INTEGER, OPTIONAL, 0..10;
        struct OPT_BYTE_ASN rearAxles;  // INTEGER, OPTIONAL, 0..10;
    };
    
    struct BasicSafetyMessageVehicleData {
        INT isValidFlag;   // necessary if this struct is used as an optional field of a SEQUENCE
        struct OPT_BYTE_ASN height;  // INTEGER, OPTIONAL, 0..127;
        struct BasicSafetyMessageBumperHeights bumpers;  // SEQUENCE, OPTIONAL;
        struct OPT_BYTE_ASN mass;  // INTEGER, OPTIONAL, 0..255;
        struct OPT_WORD_ASN doNotUse;  // INTEGER, OPTIONAL, 0..64255;
        struct OPT_BOOL_ASN trailerPresent;  // BOOLEAN, OPTIONAL;
        struct BasicSafetyMessagePivotPointDescription pivotPoint;  // SEQUENCE, OPTIONAL;
        struct BasicSafetyMessageAxles axles;  // SEQUENCE, OPTIONAL;
        struct OPT_INT_ASN leanAngle;  // INTEGER, OPTIONAL, -90..90;
    };
    
    struct BasicSafetyMessageWeatherReport {
        INT isValidFlag;   // necessary if this struct is used as an optional field of a SEQUENCE
        INT isRaining;  // ENUMERATED, precip(1), noPrecip(2), error(3);
        struct OPT_WORD_ASN rainRate;  // INTEGER, OPTIONAL, 0..65535;
        struct OPT_ENUM_ASN precipSituation;  // ENUMERATED, OPTIONAL, other(1), unknown(2), noPrecipitation(3), unidentifiedSlight(4), unidentifiedModerate(5), unidentifiedHeavy(6), snowSlight(7), snowModerate(8), snowHeavy(9), rainSlight(10), rainModerate(11), rainHeavy(12), frozenPrecipitationSlight(13), frozenPrecipitationModerate(14), frozenPrecipitationHeavy(15);
        struct OPT_WORD_ASN solarRadiation;  // INTEGER, OPTIONAL, 0..65535;
        struct OPT_BYTE_ASN friction;  // INTEGER, OPTIONAL, 0..101;
        struct OPT_BYTE_ASN roadFriction;  // INTEGER, OPTIONAL, 0..50;
    };
    
    struct BasicSafetyMessageWiperSet {
        INT isValidFlag;   // necessary if this struct is used as an optional field of a SEQUENCE
        INT statusFront;  // ENUMERATED, unavailable(0), off(1), intermittent(2), low(3), high(4), washerInUse(5), automaticPresent(6);
        BYTE rateFront;  // INTEGER, 0..127;
        struct OPT_ENUM_ASN statusRear;  // ENUMERATED, OPTIONAL, unavailable(0), off(1), intermittent(2), low(3), high(4), washerInUse(5), automaticPresent(6);
        struct OPT_BYTE_ASN rateRear;  // INTEGER, OPTIONAL, 0..127;
    };
    
    struct BasicSafetyMessageWeatherProbe {
        INT isValidFlag;   // necessary if this struct is used as an optional field of a SEQUENCE
        struct OPT_BYTE_ASN airTemp;  // INTEGER, OPTIONAL, 0..191;
        struct OPT_BYTE_ASN airPressure;  // INTEGER, OPTIONAL, 0..255;
        struct BasicSafetyMessageWiperSet rainRates;  // SEQUENCE, OPTIONAL;
    };
    
    struct BasicSafetyMessageVerticalAccelerationThreshold {
        INT isValidFlag;   // necessary if this struct is used as an optional field of a SEQUENCE
        CHAR string[6];
        INT  stringLength;
    };
    
    struct BasicSafetyMessageObstacleDetection {
        INT isValidFlag;   // necessary if this struct is used as an optional field of a SEQUENCE
        WORD obDist;  // INTEGER, 0..32767;
        WORD obDirect;  // INTEGER, 0..28800;
        struct OPT_WORD_ASN description;  // INTEGER, OPTIONAL, 0..65535;
        struct OPT_ENUM_ASN locationDetails;  // ENUMERATED, OPTIONAL, on_bridges(7937), in_tunnels(7938), entering_or_leaving_tunnels(7939), on_ramps(7940), in_road_construction_area(7941), around_a_curve(7942), on_curve(8026), on_tracks(8009), in_street(8025), shoulder(8027), on_minor_roads(7943), in_the_opposing_lanes(7944), adjacent_to_roadway(7945), across_tracks(8024), on_bend(7946), intersection(8032), entire_intersection(7947), in_the_median(7948), moved_to_side_of_road(7949), moved_to_shoulder(7950), on_the_roadway(7951), dip(8010), traffic_circle(8011), crossover(8028), cross_road(8029), side_road(8030), to(8014), by(8015), through(8016), area_of(8017), under(8018), over(8019), from(8020), approaching(8021), entering_at(8022), exiting_at(8023), in_shaded_areas(7952), in_low_lying_areas(7953), in_the_downtown_area(7954), in_the_inner_city_area(7955), in_parts(7956), in_some_places(7957), in_the_ditch(7958), in_the_valley(7959), on_hill_top(7960), near_the_foothills(7961), at_high_altitudes(7962), near_the_lake(7963), near_the_shore(7964), nearby_basin(8008), over_the_crest_of_a_hill(7965), other_than_on_the_roadway(7966), near_the_beach(7967), near_beach_access_point(7968), mountain_pass(8006), lower_level(7969), upper_level(7970), airport(7971), concourse(7972), gate(7973), baggage_claim(7974), customs_point(7975), reservation_center(8007), station(7976), platform(7977), dock(7978), depot(7979), ev_charging_point(7980), information_welcome_point(7981), at_rest_area(7982), at_service_area(7983), at_weigh_station(7984), roadside_park(8033), picnic_areas(7985), rest_area(7986), service_stations(7987), toilets(7988), bus_stop(8031), park_and_ride_lot(8012), on_the_right(7989), on_the_left(7990), in_the_center(7991), in_the_opposite_direction(7992), cross_traffic(7993), northbound_traffic(7994), eastbound_traffic(7995), southbound_traffic(7996), westbound_traffic(7997), north(7998), south(7999), east(8000), west(8001), northeast(8002), northwest(8003), southeast(8004), southwest(8005);
        struct BasicSafetyMessageDDateTime dateTime;  // SEQUENCE;
        struct BasicSafetyMessageVerticalAccelerationThreshold vertEvent;  // BITSTRING, OPTIONAL;
    };
    
    struct BasicSafetyMessageDisabledVehicle {
        INT isValidFlag;   // necessary if this struct is used as an optional field of a SEQUENCE
        WORD statusDetails;  // INTEGER, 0..65535;
        struct OPT_ENUM_ASN locationDetails;  // ENUMERATED, OPTIONAL, on_bridges(7937), in_tunnels(7938), entering_or_leaving_tunnels(7939), on_ramps(7940), in_road_construction_area(7941), around_a_curve(7942), on_curve(8026), on_tracks(8009), in_street(8025), shoulder(8027), on_minor_roads(7943), in_the_opposing_lanes(7944), adjacent_to_roadway(7945), across_tracks(8024), on_bend(7946), intersection(8032), entire_intersection(7947), in_the_median(7948), moved_to_side_of_road(7949), moved_to_shoulder(7950), on_the_roadway(7951), dip(8010), traffic_circle(8011), crossover(8028), cross_road(8029), side_road(8030), to(8014), by(8015), through(8016), area_of(8017), under(8018), over(8019), from(8020), approaching(8021), entering_at(8022), exiting_at(8023), in_shaded_areas(7952), in_low_lying_areas(7953), in_the_downtown_area(7954), in_the_inner_city_area(7955), in_parts(7956), in_some_places(7957), in_the_ditch(7958), in_the_valley(7959), on_hill_top(7960), near_the_foothills(7961), at_high_altitudes(7962), near_the_lake(7963), near_the_shore(7964), nearby_basin(8008), over_the_crest_of_a_hill(7965), other_than_on_the_roadway(7966), near_the_beach(7967), near_beach_access_point(7968), mountain_pass(8006), lower_level(7969), upper_level(7970), airport(7971), concourse(7972), gate(7973), baggage_claim(7974), customs_point(7975), reservation_center(8007), station(7976), platform(7977), dock(7978), depot(7979), ev_charging_point(7980), information_welcome_point(7981), at_rest_area(7982), at_service_area(7983), at_weigh_station(7984), roadside_park(8033), picnic_areas(7985), rest_area(7986), service_stations(7987), toilets(7988), bus_stop(8031), park_and_ride_lot(8012), on_the_right(7989), on_the_left(7990), in_the_center(7991), in_the_opposite_direction(7992), cross_traffic(7993), northbound_traffic(7994), eastbound_traffic(7995), southbound_traffic(7996), westbound_traffic(7997), north(7998), south(7999), east(8000), west(8001), northeast(8002), northwest(8003), southeast(8004), southwest(8005);
    };
    
    struct BasicSafetyMessageSpeedProfileMeasurementList {
        INT isValidFlag;   // necessary if this struct is used as an optional field of a SEQUENCE
        INT length;
        BYTE arrayValue[20];  // INTEGER, 0..31;
    };
    
    struct BasicSafetyMessageSpeedProfile {
        INT isValidFlag;   // necessary if this struct is used as an optional field of a SEQUENCE
        struct BasicSafetyMessageSpeedProfileMeasurementList speedReports;  // SEQUENCEOF;
    };
    
    struct BasicSafetyMessageAntennaOffsetSet {
        INT isValidFlag;   // necessary if this struct is used as an optional field of a SEQUENCE
        INT antOffsetX;  // INTEGER, -2048..2047;
        INT antOffsetY;  // INTEGER, -256..255;
        INT antOffsetZ;  // INTEGER, -512..511;
    };
    
    struct BasicSafetyMessageRTCMheader {
        INT isValidFlag;   // necessary if this struct is used as an optional field of a SEQUENCE
        struct BasicSafetyMessageGNSSstatus status;  // BITSTRING;
        struct BasicSafetyMessageAntennaOffsetSet offsetSet;  // SEQUENCE;
    };
    
    struct BasicSafetyMessageRTCMmessage {
        INT isValidFlag;   // necessary if this struct is used as an optional field of a SEQUENCE
        CHAR string[1024];
        INT  stringLength;
    };
    
    struct BasicSafetyMessageRTCMmessageList {
        INT isValidFlag;   // necessary if this struct is used as an optional field of a SEQUENCE
        INT length;
        struct BasicSafetyMessageRTCMmessage arrayValue[5];  // OCTETSTRING;
    };
    
    struct BasicSafetyMessageRTCMPackage {
        INT isValidFlag;   // necessary if this struct is used as an optional field of a SEQUENCE
        struct BasicSafetyMessageRTCMheader rtcmHeader;  // SEQUENCE, OPTIONAL;
        struct BasicSafetyMessageRTCMmessageList msgs;  // SEQUENCEOF;
    };
    
    struct BasicSafetyMessageRegionalExtension_Reg_SupplementalVehicleExtensions_table {
    };
    
    struct BasicSafetyMessageRegionalExtension_Reg_SupplementalVehicleExtensions {
        INT isValidFlag;   // necessary if this struct is used as an optional field of a SEQUENCE
        BYTE regionId;  // INTEGER, 0..255, noRegion(0), addGrpA(1), addGrpB(2), addGrpC(3), addGrpD(4);
        struct BasicSafetyMessageRegionalExtension_Reg_SupplementalVehicleExtensions_table regExtvalue;  // TABLE;
    };
    
    struct BasicSafetyMessageSupplementalVehicleExtensions_regional {
        INT isValidFlag;   // necessary if this struct is used as an optional field of a SEQUENCE
        INT length;
        struct BasicSafetyMessageRegionalExtension_Reg_SupplementalVehicleExtensions arrayValue[4];  // SEQUENCE;
    };
    
    struct BasicSafetyMessageTrailerUnitDescJ2945Slash1B {
        INT isValidFlag;   // necessary if this struct is used as an optional field of a SEQUENCE
        WORD width;  // INTEGER, 0..1023;
        WORD length;  // INTEGER, 0..4095;
        struct OPT_BYTE_ASN height;  // INTEGER, OPTIONAL, 0..127;
        struct OPT_WORD_ASN weight;  // INTEGER, OPTIONAL, 0..64255;
        struct BasicSafetyMessagePivotPointDescription frontPivot;  // SEQUENCE;
        struct BasicSafetyMessagePivotPointDescription rearPivot;  // SEQUENCE, OPTIONAL;
        struct BasicSafetyMessageBumperHeights bumpers;  // SEQUENCE, OPTIONAL;
        struct BasicSafetyMessageAxles axles;  // SEQUENCE, OPTIONAL;
    };
    
    struct BasicSafetyMessageTrailersJ2945Slash1B {
        INT isValidFlag;   // necessary if this struct is used as an optional field of a SEQUENCE
        INT length;
        struct BasicSafetyMessageTrailerUnitDescJ2945Slash1B arrayValue[8];  // SEQUENCE;
    };
    
    struct BasicSafetyMessageSchoolBusJ2945Slash1C {
        INT isValidFlag;   // necessary if this struct is used as an optional field of a SEQUENCE
        INT flashingAmberLights;  // BOOLEAN;
        INT flashingRedLights;  // BOOLEAN;
        struct OPT_BOOL_ASN studentsCrossingFront;  // BOOLEAN, OPTIONAL;
        struct OPT_BOOL_ASN studentsCrossingBehind;  // BOOLEAN, OPTIONAL;
        struct OPT_BOOL_ASN studentsLoading;  // BOOLEAN, OPTIONAL;
        struct OPT_BOOL_ASN studentsUnloading;  // BOOLEAN, OPTIONAL;
        struct OPT_BOOL_ASN wheelchairLiftInUse;  // BOOLEAN, OPTIONAL;
        struct OPT_BOOL_ASN emergencyExitOpen;  // BOOLEAN, OPTIONAL;
        struct OPT_BOOL_ASN emergencyRequestMedical;  // BOOLEAN, OPTIONAL;
        struct OPT_BOOL_ASN emergencyRequestFire;  // BOOLEAN, OPTIONAL;
        struct OPT_BOOL_ASN emergencyRequestPolice;  // BOOLEAN, OPTIONAL;
    };
    
    struct BasicSafetyMessageSupplementalVehicleExtensions {
        INT isValidFlag;   // necessary if this struct is used as an optional field of a SEQUENCE
        struct OPT_BYTE_ASN classification;  // INTEGER, OPTIONAL, 0..255, unknownVehicleClass(0), specialVehicleClass(1), passenger_Vehicle_TypeUnknown(10), passenger_Vehicle_TypeOther(11), lightTruck_Vehicle_TypeUnknown(20), lightTruck_Vehicle_TypeOther(21), truck_Vehicle_TypeUnknown(25), truck_Vehicle_TypeOther(26), truck_axleCnt2(27), truck_axleCnt3(28), truck_axleCnt4(29), truck_axleCnt4Trailer(30), truck_axleCnt5Trailer(31), truck_axleCnt6Trailer(32), truck_axleCnt5MultiTrailer(33), truck_axleCnt6MultiTrailer(34), truck_axleCnt7MultiTrailer(35), motorcycle_TypeUnknown(40), motorcycle_TypeOther(41), motorcycle_Cruiser_Standard(42), motorcycle_SportUnclad(43), motorcycle_SportTouring(44), motorcycle_SuperSport(45), motorcycle_Touring(46), motorcycle_Trike(47), motorcycle_wPassengers(48), transit_TypeUnknown(50), transit_TypeOther(51), transit_BRT(52), transit_ExpressBus(53), transit_LocalBus(54), transit_SchoolBus(55), transit_FixedGuideway(56), transit_Paratransit(57), transit_Paratransit_Ambulance(58), emergency_TypeUnknown(60), emergency_TypeOther(61), emergency_Fire_Light_Vehicle(62), emergency_Fire_Heavy_Vehicle(63), emergency_Fire_Paramedic_Vehicle(64), emergency_Fire_Ambulance_Vehicle(65), emergency_Police_Light_Vehicle(66), emergency_Police_Heavy_Vehicle(67), emergency_Other_Responder(68), emergency_Other_Ambulance(69), otherTraveler_TypeUnknown(80), otherTraveler_TypeOther(81), otherTraveler_Pedestrian(82), otherTraveler_Visually_Disabled(83), otherTraveler_Physically_Disabled(84), otherTraveler_Bicycle(85), otherTraveler_Vulnerable_Roadworker(86), infrastructure_TypeUnknown(90), infrastructure_Fixed(91), infrastructure_Movable(92), equipped_CargoTrailer(93);
        struct BasicSafetyMessageVehicleClassification classDetails;  // SEQUENCE, OPTIONAL;
        struct BasicSafetyMessageVehicleData vehicleData;  // SEQUENCE, OPTIONAL;
        struct BasicSafetyMessageWeatherReport doNotUse1;  // SEQUENCE, OPTIONAL;
        struct BasicSafetyMessageWeatherProbe doNotUse2;  // SEQUENCE, OPTIONAL;
        struct BasicSafetyMessageObstacleDetection doNotUse3;  // SEQUENCE, OPTIONAL;
        struct BasicSafetyMessageDisabledVehicle status;  // SEQUENCE, OPTIONAL;
        struct BasicSafetyMessageSpeedProfile doNotUse4;  // SEQUENCE, OPTIONAL;
        struct BasicSafetyMessageRTCMPackage doNotUse5;  // SEQUENCE, OPTIONAL;
        struct BasicSafetyMessageSupplementalVehicleExtensions_regional regional;  // SEQUENCEOF, OPTIONAL;
        INT fhwaVehicleClass;  // ENUMERATED, motorcycles(1), passengerCars(2), other2axle4tireSingleUnitVehs(3), buses(4), twoAxle6TireSingleUnitTrucks(5), threeAxleSingleUnitTrucks(6), fourOrMoreAxleSingleUnitTrucks(7), fourOrFewerAxleSingleTrailerTrucks(8), fiveAxleSingleTrailerTrucks(9), sixOrMoreAxleSingleTrailerTrucks(10), fiveOrFewerAxleMultiTrailerTrucks(11), sixAxleMultiTrailerTrucks(12), sevenOrMoreAxleMultiTrailerTrucks(13);
        struct BasicSafetyMessageTrailersJ2945Slash1B trailers;  // SEQUENCEOF, OPTIONAL;
        struct BasicSafetyMessageSchoolBusJ2945Slash1C schoolBus;  // SEQUENCE, OPTIONAL;
    };
    
    struct BasicSafetyMessagePartIIcontent_table {
        struct BasicSafetyMessageVehicleSafetyExtensions vehicleSafetyExt;  // SEQUENCE;
        struct BasicSafetyMessageSpecialVehicleExtensions specialVehicleExt;  // SEQUENCE;
        struct BasicSafetyMessageSupplementalVehicleExtensions supplementalVehicleExt;  // SEQUENCE;
    };
    
    struct BasicSafetyMessagePartIIcontent {
        INT isValidFlag;   // necessary if this struct is used as an optional field of a SEQUENCE
        BYTE partII_Id;  // INTEGER, 0..63, vehicleSafetyExt(0), specialVehicleExt(1), supplementalVehicleExt(2);
        struct BasicSafetyMessagePartIIcontent_table partII_Value;  // TABLE;
    };
    
    struct BasicSafetyMessageBasicSafetyMessage_partII {
        INT isValidFlag;   // necessary if this struct is used as an optional field of a SEQUENCE
        INT length;
        struct BasicSafetyMessagePartIIcontent arrayValue[8];  // SEQUENCE;
    };
    
    struct BasicSafetyMessageRegionalExtension_Reg_BasicSafetyMessage_table {
    };
    
    struct BasicSafetyMessageRegionalExtension_Reg_BasicSafetyMessage {
        INT isValidFlag;   // necessary if this struct is used as an optional field of a SEQUENCE
        BYTE regionId;  // INTEGER, 0..255, noRegion(0), addGrpA(1), addGrpB(2), addGrpC(3), addGrpD(4);
        struct BasicSafetyMessageRegionalExtension_Reg_BasicSafetyMessage_table regExtvalue;  // TABLE;
    };
    
    struct BasicSafetyMessageBasicSafetyMessage_regional {
        INT isValidFlag;   // necessary if this struct is used as an optional field of a SEQUENCE
        INT length;
        struct BasicSafetyMessageRegionalExtension_Reg_BasicSafetyMessage arrayValue[4];  // SEQUENCE;
    };
    
    struct BasicSafetyMessage_BasicSafetyMessage {
        INT isValidFlag;   // necessary if this struct is used as an optional field of a SEQUENCE
        struct BasicSafetyMessageBSMcoreData coreData;  // SEQUENCE;
        struct BasicSafetyMessageBasicSafetyMessage_partII partII;  // SEQUENCEOF, OPTIONAL;
        struct BasicSafetyMessageBasicSafetyMessage_regional regional;  // SEQUENCEOF, OPTIONAL;
    };
    
    struct BasicSafetyMessageMESSAGE_ID_AND_TYPE {
        struct BasicSafetyMessage_BasicSafetyMessage basicSafetyMessage;  // SEQUENCE;
    };
    
    struct BasicSafetyMessage {
        INT isValidFlag;   // necessary if this struct is used as an optional field of a SEQUENCE
        WORD messageId;  // INTEGER, 0..32767, mapData(18), signalPhaseAndTimingMessage(19), basicSafetyMessage(20), commonSafetyRequest(21), emergencyVehicleAlert(22), intersectionCollision(23), nmeaCorrections(24), probeDataManagement(25), probeVehicleData(26), roadSideAlert(27), rtcmCorrections(28), signalRequestMessage(29), signalStatusMessage(30), travelerInformation(31), personalSafetyMessage(32), roadSafetyMessage(33), roadWeatherMessage(34), probeDataConfigMessage(35), probeDataReportMessage(36), tollAdvertisementMessage(37), tollUsageMessage(38), tollUsageAckMessage(39), cooperativeControlMessage(40), sensorDataSharingMessage(41), maneuverSharingAndCoordinatingMessage(42), roadGeometryAndAttributes(43), personalSafetyMessage2(44), trafficSignalPhaseAndTiming(45), signalControlAndPrioritizationRequest(46), signalControlAndPrioritizationStatus(47), roadUserChargingConfigMessage(48), roadUserChargingReportMessage(49), trafficLightStatusMessage(50);
        struct BasicSafetyMessageMESSAGE_ID_AND_TYPE value;  // TABLE;
    };
    
}

/*
// init function to create a simple packet handle
*/ 
LONG API_InitBasicSafetyMessagePacket()
{
  return C2xInitPacket("BasicSafetyMessage"); 
}

/*
// init function to create a simple packet handle and
// initialize the struct with valid data
*/ 
LONG API_InitBasicSafetyMessagePacket(struct BasicSafetyMessage msgStruct)
{
  long pktHandle;

  pktHandle = API_InitBasicSafetyMessagePacket();

  if (pktHandle != 0)
  {
    // create valid message and application data
    if (C2xCompletePacket(pktHandle) == 0) 
    {
      API_GetBasicSafetyMessageParams(pktHandle, msgStruct);
    }
  }
  return pktHandle;
}

/*
// init function to create a packet with security layer and
// initialize the struct with valid data
*/ 
LONG API_InitBasicSafetyMessagePacket(struct BasicSafetyMessage msgStruct, char packetTypeDesignator[], char certificateName[])
{
  long pktHandle, certHdl;

  // initialize the packet
  pktHandle = C2xInitPacket("BasicSafetyMessage", packetTypeDesignator);

  if (pktHandle != 0)
  {
    certHdl = C2xSecCertificateGetHandle(certificateName);  // get the certificate handle for the cert with name "certificateName"
    if (certHdl != 0) 
    {
      C2xSecPacketSetSignerHandle(pktHandle, certHdl); // set the certHdl to the packet
    }

    // create valid message and application data
    if (C2xCompletePacket(pktHandle) == 0) 
    {
      // copy application data to the application structure
      API_GetBasicSafetyMessageParams(pktHandle, msgStruct);
    }
  }
  return pktHandle;
}
    

int GetBasicSafetyMessagePositionalAccuracyParams(LONG packetHandle, struct BasicSafetyMessagePositionalAccuracy value, char oldPath[])
{
  char newPath[300];
  int result;

  result = 0;

  snprintf(newPath, elcount(newPath), "%s.%s", oldPath, "semiMajor");
  value.semiMajor = C2xGetTokenInt(packetHandle, "BasicSafetyMessage", newPath);
  result = CheckLastError("BasicSafetyMessage", gkFuncRefGet, result);

  snprintf(newPath, elcount(newPath), "%s.%s", oldPath, "semiMinor");
  value.semiMinor = C2xGetTokenInt(packetHandle, "BasicSafetyMessage", newPath);
  result = CheckLastError("BasicSafetyMessage", gkFuncRefGet, result);

  snprintf(newPath, elcount(newPath), "%s.%s", oldPath, "orientation");
  value.orientation = C2xGetTokenInt(packetHandle, "BasicSafetyMessage", newPath);
  result = CheckLastError("BasicSafetyMessage", gkFuncRefGet, result);

  return result;
}

int SetBasicSafetyMessagePositionalAccuracyParams(LONG packetHandle, struct BasicSafetyMessagePositionalAccuracy value, char oldPath[])
{
  char newPath[300];
  int result;

  result = 0;

  snprintf(newPath, elcount(newPath), "%s.%s", oldPath, "semiMajor");
  C2xSetTokenInt(packetHandle, "BasicSafetyMessage", newPath, value.semiMajor);
  result = CheckLastError("BasicSafetyMessage", gkFuncRefGet, result);

  snprintf(newPath, elcount(newPath), "%s.%s", oldPath, "semiMinor");
  C2xSetTokenInt(packetHandle, "BasicSafetyMessage", newPath, value.semiMinor);
  result = CheckLastError("BasicSafetyMessage", gkFuncRefGet, result);

  snprintf(newPath, elcount(newPath), "%s.%s", oldPath, "orientation");
  C2xSetTokenInt(packetHandle, "BasicSafetyMessage", newPath, value.orientation);
  result = CheckLastError("BasicSafetyMessage", gkFuncRefGet, result);

  return result;
}

int GetBasicSafetyMessageAccelerationSet4WayParams(LONG packetHandle, struct BasicSafetyMessageAccelerationSet4Way value, char oldPath[])
{
  char newPath[300];
  int result;

  result = 0;

  snprintf(newPath, elcount(newPath), "%s.%s", oldPath, "lon");
  value.lon = C2xGetTokenInt(packetHandle, "BasicSafetyMessage", newPath);
  result = CheckLastError("BasicSafetyMessage", gkFuncRefGet, result);

  snprintf(newPath, elcount(newPath), "%s.%s", oldPath, "lat");
  value.lat = C2xGetTokenInt(packetHandle, "BasicSafetyMessage", newPath);
  result = CheckLastError("BasicSafetyMessage", gkFuncRefGet, result);

  snprintf(newPath, elcount(newPath), "%s.%s", oldPath, "vert");
  value.vert = C2xGetTokenInt(packetHandle, "BasicSafetyMessage", newPath);
  result = CheckLastError("BasicSafetyMessage", gkFuncRefGet, result);

  snprintf(newPath, elcount(newPath), "%s.%s", oldPath, "yaw");
  value.yaw = C2xGetTokenInt(packetHandle, "BasicSafetyMessage", newPath);
  result = CheckLastError("BasicSafetyMessage", gkFuncRefGet, result);

  return result;
}

int SetBasicSafetyMessageAccelerationSet4WayParams(LONG packetHandle, struct BasicSafetyMessageAccelerationSet4Way value, char oldPath[])
{
  char newPath[300];
  int result;

  result = 0;

  snprintf(newPath, elcount(newPath), "%s.%s", oldPath, "lon");
  C2xSetTokenInt(packetHandle, "BasicSafetyMessage", newPath, value.lon);
  result = CheckLastError("BasicSafetyMessage", gkFuncRefGet, result);

  snprintf(newPath, elcount(newPath), "%s.%s", oldPath, "lat");
  C2xSetTokenInt(packetHandle, "BasicSafetyMessage", newPath, value.lat);
  result = CheckLastError("BasicSafetyMessage", gkFuncRefGet, result);

  snprintf(newPath, elcount(newPath), "%s.%s", oldPath, "vert");
  C2xSetTokenInt(packetHandle, "BasicSafetyMessage", newPath, value.vert);
  result = CheckLastError("BasicSafetyMessage", gkFuncRefGet, result);

  snprintf(newPath, elcount(newPath), "%s.%s", oldPath, "yaw");
  C2xSetTokenInt(packetHandle, "BasicSafetyMessage", newPath, value.yaw);
  result = CheckLastError("BasicSafetyMessage", gkFuncRefGet, result);

  return result;
}

int GetBasicSafetyMessageBrakeSystemStatusParams(LONG packetHandle, struct BasicSafetyMessageBrakeSystemStatus value, char oldPath[])
{
  char newPath[300]; 
  int j; 
  int k;
  int result;

  result = 0;

  snprintf(newPath, elcount(newPath), "%s.%s", oldPath, "wheelBrakes");
  value.wheelBrakes.isValidFlag = 1;
  value.wheelBrakes.stringLength = C2xGetTokenLengthBit(packetHandle, "BasicSafetyMessage", newPath);
  if ((result = CheckLastError("BasicSafetyMessage", gkFuncRefGet, result))==0)
  {
    if(value.wheelBrakes.stringLength > 0)
    {
      for(j=0; j<value.wheelBrakes.stringLength; j++)
      {
        if(C2xGetTokenBitOfBitString(packetHandle, "BasicSafetyMessage", newPath, j) == 0)
        {
          value.wheelBrakes.string[j] = '0';
        }
        else if(C2xGetTokenBitOfBitString(packetHandle, "BasicSafetyMessage", newPath, j) == 1)
        {
          value.wheelBrakes.string[j] = '1';
        }

        if(value.wheelBrakes.stringLength == 1)
        {
          value.wheelBrakes.string[1] = '0';
        }
        result = CheckLastError("BasicSafetyMessage", gkFuncRefGet, result);
      }
    }
    else
    {
      for(k = value.wheelBrakes.stringLength+1; k > -1; k--)
      {
        if(value.wheelBrakes.string[k] == '1')
        {
          value.wheelBrakes.string[k] = '0';
        }
      }
    }
  }

  snprintf(newPath, elcount(newPath), "%s.%s", oldPath, "traction");
  value.traction = C2xGetTokenInt(packetHandle, "BasicSafetyMessage", newPath);
  result = CheckLastError("BasicSafetyMessage", gkFuncRefGet, result);

  snprintf(newPath, elcount(newPath), "%s.%s", oldPath, "antiLockBrake");
  value.antiLockBrake = C2xGetTokenInt(packetHandle, "BasicSafetyMessage", newPath);
  result = CheckLastError("BasicSafetyMessage", gkFuncRefGet, result);

  snprintf(newPath, elcount(newPath), "%s.%s", oldPath, "scs");
  value.scs = C2xGetTokenInt(packetHandle, "BasicSafetyMessage", newPath);
  result = CheckLastError("BasicSafetyMessage", gkFuncRefGet, result);

  snprintf(newPath, elcount(newPath), "%s.%s", oldPath, "brakeBoost");
  value.brakeBoost = C2xGetTokenInt(packetHandle, "BasicSafetyMessage", newPath);
  result = CheckLastError("BasicSafetyMessage", gkFuncRefGet, result);

  snprintf(newPath, elcount(newPath), "%s.%s", oldPath, "auxBrakes");
  value.auxBrakes = C2xGetTokenInt(packetHandle, "BasicSafetyMessage", newPath);
  result = CheckLastError("BasicSafetyMessage", gkFuncRefGet, result);

  return result;
}

int SetBasicSafetyMessageBrakeSystemStatusParams(LONG packetHandle, struct BasicSafetyMessageBrakeSystemStatus value, char oldPath[])
{
  char newPath[300]; 
  int j;
  int result;

  result = 0;

  snprintf(newPath, elcount(newPath), "%s.%s", oldPath, "wheelBrakes");
    for(j=0; j<value.wheelBrakes.stringLength; j++)
    {
      if(value.wheelBrakes.string[j] == '0')
      {
        C2xSetTokenBitOfBitString(packetHandle, "BasicSafetyMessage", newPath, j, 0);
      }
      else
      {
        C2xSetTokenBitOfBitString(packetHandle, "BasicSafetyMessage", newPath, j, 1);
      }
      result = CheckLastError("BasicSafetyMessage", gkFuncRefGet, result);
    }

  snprintf(newPath, elcount(newPath), "%s.%s", oldPath, "traction");
  C2xSetTokenInt(packetHandle, "BasicSafetyMessage", newPath, value.traction);
  result = CheckLastError("BasicSafetyMessage", gkFuncRefGet, result);

  snprintf(newPath, elcount(newPath), "%s.%s", oldPath, "antiLockBrake");
  C2xSetTokenInt(packetHandle, "BasicSafetyMessage", newPath, value.antiLockBrake);
  result = CheckLastError("BasicSafetyMessage", gkFuncRefGet, result);

  snprintf(newPath, elcount(newPath), "%s.%s", oldPath, "scs");
  C2xSetTokenInt(packetHandle, "BasicSafetyMessage", newPath, value.scs);
  result = CheckLastError("BasicSafetyMessage", gkFuncRefGet, result);

  snprintf(newPath, elcount(newPath), "%s.%s", oldPath, "brakeBoost");
  C2xSetTokenInt(packetHandle, "BasicSafetyMessage", newPath, value.brakeBoost);
  result = CheckLastError("BasicSafetyMessage", gkFuncRefGet, result);

  snprintf(newPath, elcount(newPath), "%s.%s", oldPath, "auxBrakes");
  C2xSetTokenInt(packetHandle, "BasicSafetyMessage", newPath, value.auxBrakes);
  result = CheckLastError("BasicSafetyMessage", gkFuncRefGet, result);

  return result;
}

int GetBasicSafetyMessageVehicleSizeParams(LONG packetHandle, struct BasicSafetyMessageVehicleSize value, char oldPath[])
{
  char newPath[300];
  int result;

  result = 0;

  snprintf(newPath, elcount(newPath), "%s.%s", oldPath, "width");
  value.width = C2xGetTokenInt(packetHandle, "BasicSafetyMessage", newPath);
  result = CheckLastError("BasicSafetyMessage", gkFuncRefGet, result);

  snprintf(newPath, elcount(newPath), "%s.%s", oldPath, "length");
  value.length = C2xGetTokenInt(packetHandle, "BasicSafetyMessage", newPath);
  result = CheckLastError("BasicSafetyMessage", gkFuncRefGet, result);

  return result;
}

int SetBasicSafetyMessageVehicleSizeParams(LONG packetHandle, struct BasicSafetyMessageVehicleSize value, char oldPath[])
{
  char newPath[300];
  int result;

  result = 0;

  snprintf(newPath, elcount(newPath), "%s.%s", oldPath, "width");
  C2xSetTokenInt(packetHandle, "BasicSafetyMessage", newPath, value.width);
  result = CheckLastError("BasicSafetyMessage", gkFuncRefGet, result);

  snprintf(newPath, elcount(newPath), "%s.%s", oldPath, "length");
  C2xSetTokenInt(packetHandle, "BasicSafetyMessage", newPath, value.length);
  result = CheckLastError("BasicSafetyMessage", gkFuncRefGet, result);

  return result;
}

int GetBasicSafetyMessageBSMcoreDataParams(LONG packetHandle, struct BasicSafetyMessageBSMcoreData value, char oldPath[])
{
  char newPath[300];
  int result;

  result = 0;

  snprintf(newPath, elcount(newPath), "%s.%s", oldPath, "msgCnt");
  value.msgCnt = C2xGetTokenInt(packetHandle, "BasicSafetyMessage", newPath);
  result = CheckLastError("BasicSafetyMessage", gkFuncRefGet, result);

  snprintf(newPath, elcount(newPath), "%s.%s", oldPath, "id");
  value.id.stringLength = C2xGetTokenData(packetHandle, "BasicSafetyMessage", newPath, elcount(value.id.string), value.id.string);
  snprintf(newPath, elcount(newPath), "%s.%s", oldPath, "secMark");
  value.secMark = C2xGetTokenInt(packetHandle, "BasicSafetyMessage", newPath);
  result = CheckLastError("BasicSafetyMessage", gkFuncRefGet, result);

  snprintf(newPath, elcount(newPath), "%s.%s", oldPath, "lat");
  value.lat = C2xGetTokenInt(packetHandle, "BasicSafetyMessage", newPath);
  result = CheckLastError("BasicSafetyMessage", gkFuncRefGet, result);

  snprintf(newPath, elcount(newPath), "%s.%s", oldPath, "lon");
  value.lon = C2xGetTokenInt(packetHandle, "BasicSafetyMessage", newPath);
  result = CheckLastError("BasicSafetyMessage", gkFuncRefGet, result);

  snprintf(newPath, elcount(newPath), "%s.%s", oldPath, "elev");
  value.elev = C2xGetTokenInt(packetHandle, "BasicSafetyMessage", newPath);
  result = CheckLastError("BasicSafetyMessage", gkFuncRefGet, result);

  snprintf(newPath, elcount(newPath), "%s.%s", oldPath, "accuracy");
  GetBasicSafetyMessagePositionalAccuracyParams(packetHandle, value.accuracy, newPath);
  result = CheckLastError("BasicSafetyMessage", gkFuncRefGet, result);

  snprintf(newPath, elcount(newPath), "%s.%s", oldPath, "transmission");
  value.transmission = C2xGetTokenInt(packetHandle, "BasicSafetyMessage", newPath);
  result = CheckLastError("BasicSafetyMessage", gkFuncRefGet, result);

  snprintf(newPath, elcount(newPath), "%s.%s", oldPath, "speed");
  value.speed = C2xGetTokenInt(packetHandle, "BasicSafetyMessage", newPath);
  result = CheckLastError("BasicSafetyMessage", gkFuncRefGet, result);

  snprintf(newPath, elcount(newPath), "%s.%s", oldPath, "heading");
  value.heading = C2xGetTokenInt(packetHandle, "BasicSafetyMessage", newPath);
  result = CheckLastError("BasicSafetyMessage", gkFuncRefGet, result);

  snprintf(newPath, elcount(newPath), "%s.%s", oldPath, "angle");
  value.angle = C2xGetTokenInt(packetHandle, "BasicSafetyMessage", newPath);
  result = CheckLastError("BasicSafetyMessage", gkFuncRefGet, result);

  snprintf(newPath, elcount(newPath), "%s.%s", oldPath, "accelSet");
  GetBasicSafetyMessageAccelerationSet4WayParams(packetHandle, value.accelSet, newPath);
  result = CheckLastError("BasicSafetyMessage", gkFuncRefGet, result);

  snprintf(newPath, elcount(newPath), "%s.%s", oldPath, "brakes");
  GetBasicSafetyMessageBrakeSystemStatusParams(packetHandle, value.brakes, newPath);
  result = CheckLastError("BasicSafetyMessage", gkFuncRefGet, result);

  snprintf(newPath, elcount(newPath), "%s.%s", oldPath, "size");
  GetBasicSafetyMessageVehicleSizeParams(packetHandle, value.size, newPath);
  result = CheckLastError("BasicSafetyMessage", gkFuncRefGet, result);

  return result;
}

int SetBasicSafetyMessageBSMcoreDataParams(LONG packetHandle, struct BasicSafetyMessageBSMcoreData value, char oldPath[])
{
  char newPath[300];
  int result;

  result = 0;

  snprintf(newPath, elcount(newPath), "%s.%s", oldPath, "msgCnt");
  C2xSetTokenInt(packetHandle, "BasicSafetyMessage", newPath, value.msgCnt);
  result = CheckLastError("BasicSafetyMessage", gkFuncRefGet, result);

  if(value.id.stringLength == 0)
  {
    value.id.stringLength = 4;
    memcpy(value.id.string, "0000", value.id.stringLength);
  }

  snprintf(newPath, elcount(newPath), "%s.%s", oldPath, "id");
  C2xSetTokenData(packetHandle, "BasicSafetyMessage", newPath, value.id.stringLength, value.id.string);

  snprintf(newPath, elcount(newPath), "%s.%s", oldPath, "secMark");
  C2xSetTokenInt(packetHandle, "BasicSafetyMessage", newPath, value.secMark);
  result = CheckLastError("BasicSafetyMessage", gkFuncRefGet, result);

  snprintf(newPath, elcount(newPath), "%s.%s", oldPath, "lat");
  C2xSetTokenInt(packetHandle, "BasicSafetyMessage", newPath, value.lat);
  result = CheckLastError("BasicSafetyMessage", gkFuncRefGet, result);

  snprintf(newPath, elcount(newPath), "%s.%s", oldPath, "lon");
  C2xSetTokenInt(packetHandle, "BasicSafetyMessage", newPath, value.lon);
  result = CheckLastError("BasicSafetyMessage", gkFuncRefGet, result);

  snprintf(newPath, elcount(newPath), "%s.%s", oldPath, "elev");
  C2xSetTokenInt(packetHandle, "BasicSafetyMessage", newPath, value.elev);
  result = CheckLastError("BasicSafetyMessage", gkFuncRefGet, result);

  snprintf(newPath, elcount(newPath), "%s.%s", oldPath, "accuracy");
  SetBasicSafetyMessagePositionalAccuracyParams(packetHandle, value.accuracy, newPath);
  result = CheckLastError("BasicSafetyMessage", gkFuncRefGet, result);

  snprintf(newPath, elcount(newPath), "%s.%s", oldPath, "transmission");
  C2xSetTokenInt(packetHandle, "BasicSafetyMessage", newPath, value.transmission);
  result = CheckLastError("BasicSafetyMessage", gkFuncRefGet, result);

  snprintf(newPath, elcount(newPath), "%s.%s", oldPath, "speed");
  C2xSetTokenInt(packetHandle, "BasicSafetyMessage", newPath, value.speed);
  result = CheckLastError("BasicSafetyMessage", gkFuncRefGet, result);

  snprintf(newPath, elcount(newPath), "%s.%s", oldPath, "heading");
  C2xSetTokenInt(packetHandle, "BasicSafetyMessage", newPath, value.heading);
  result = CheckLastError("BasicSafetyMessage", gkFuncRefGet, result);

  snprintf(newPath, elcount(newPath), "%s.%s", oldPath, "angle");
  C2xSetTokenInt(packetHandle, "BasicSafetyMessage", newPath, value.angle);
  result = CheckLastError("BasicSafetyMessage", gkFuncRefGet, result);

  snprintf(newPath, elcount(newPath), "%s.%s", oldPath, "accelSet");
  SetBasicSafetyMessageAccelerationSet4WayParams(packetHandle, value.accelSet, newPath);
  result = CheckLastError("BasicSafetyMessage", gkFuncRefGet, result);

  snprintf(newPath, elcount(newPath), "%s.%s", oldPath, "brakes");
  SetBasicSafetyMessageBrakeSystemStatusParams(packetHandle, value.brakes, newPath);
  result = CheckLastError("BasicSafetyMessage", gkFuncRefGet, result);

  snprintf(newPath, elcount(newPath), "%s.%s", oldPath, "size");
  SetBasicSafetyMessageVehicleSizeParams(packetHandle, value.size, newPath);
  result = CheckLastError("BasicSafetyMessage", gkFuncRefGet, result);

  return result;
}

int GetBasicSafetyMessageDDateTimeParams(LONG packetHandle, struct BasicSafetyMessageDDateTime value, char oldPath[])
{
  char newPath[300];
  int result;

  result = 0;

  snprintf(newPath, elcount(newPath), "%s.%s", oldPath, "year");
  value.year.isValidFlag = C2xIsTokenAvailable(packetHandle, "BasicSafetyMessage", newPath);
  if(value.year.isValidFlag==1)
  {
    value.year.value = C2xGetTokenInt(packetHandle, "BasicSafetyMessage", newPath);
    result = CheckLastError("BasicSafetyMessage", gkFuncRefGet, result);
  }
  snprintf(newPath, elcount(newPath), "%s.%s", oldPath, "month");
  value.month.isValidFlag = C2xIsTokenAvailable(packetHandle, "BasicSafetyMessage", newPath);
  if(value.month.isValidFlag==1)
  {
    value.month.value = C2xGetTokenInt(packetHandle, "BasicSafetyMessage", newPath);
    result = CheckLastError("BasicSafetyMessage", gkFuncRefGet, result);
  }
  snprintf(newPath, elcount(newPath), "%s.%s", oldPath, "day");
  value.day.isValidFlag = C2xIsTokenAvailable(packetHandle, "BasicSafetyMessage", newPath);
  if(value.day.isValidFlag==1)
  {
    value.day.value = C2xGetTokenInt(packetHandle, "BasicSafetyMessage", newPath);
    result = CheckLastError("BasicSafetyMessage", gkFuncRefGet, result);
  }
  snprintf(newPath, elcount(newPath), "%s.%s", oldPath, "hour");
  value.hour.isValidFlag = C2xIsTokenAvailable(packetHandle, "BasicSafetyMessage", newPath);
  if(value.hour.isValidFlag==1)
  {
    value.hour.value = C2xGetTokenInt(packetHandle, "BasicSafetyMessage", newPath);
    result = CheckLastError("BasicSafetyMessage", gkFuncRefGet, result);
  }
  snprintf(newPath, elcount(newPath), "%s.%s", oldPath, "minute");
  value.minute.isValidFlag = C2xIsTokenAvailable(packetHandle, "BasicSafetyMessage", newPath);
  if(value.minute.isValidFlag==1)
  {
    value.minute.value = C2xGetTokenInt(packetHandle, "BasicSafetyMessage", newPath);
    result = CheckLastError("BasicSafetyMessage", gkFuncRefGet, result);
  }
  snprintf(newPath, elcount(newPath), "%s.%s", oldPath, "second");
  value.second.isValidFlag = C2xIsTokenAvailable(packetHandle, "BasicSafetyMessage", newPath);
  if(value.second.isValidFlag==1)
  {
    value.second.value = C2xGetTokenInt(packetHandle, "BasicSafetyMessage", newPath);
    result = CheckLastError("BasicSafetyMessage", gkFuncRefGet, result);
  }
  snprintf(newPath, elcount(newPath), "%s.%s", oldPath, "offset");
  value.offset.isValidFlag = C2xIsTokenAvailable(packetHandle, "BasicSafetyMessage", newPath);
  if(value.offset.isValidFlag==1)
  {
    value.offset.value = C2xGetTokenInt(packetHandle, "BasicSafetyMessage", newPath);
    result = CheckLastError("BasicSafetyMessage", gkFuncRefGet, result);
  }
  return result;
}

int SetBasicSafetyMessageDDateTimeParams(LONG packetHandle, struct BasicSafetyMessageDDateTime value, char oldPath[])
{
  char newPath[300];
  int result;

  result = 0;

  snprintf(newPath, elcount(newPath), "%s.%s", oldPath, "year");
  if(value.year.isValidFlag==1)
  {
    C2xSetTokenInt(packetHandle, "BasicSafetyMessage", newPath, value.year.value);
    result = CheckLastError("BasicSafetyMessage", gkFuncRefGet, result);
  }
  else
  {
    if( C2xIsTokenAvailable(packetHandle, "BasicSafetyMessage", newPath) )
    {
      C2xRemoveToken(packetHandle, "BasicSafetyMessage", newPath);
    }
  }

  snprintf(newPath, elcount(newPath), "%s.%s", oldPath, "month");
  if(value.month.isValidFlag==1)
  {
    C2xSetTokenInt(packetHandle, "BasicSafetyMessage", newPath, value.month.value);
    result = CheckLastError("BasicSafetyMessage", gkFuncRefGet, result);
  }
  else
  {
    if( C2xIsTokenAvailable(packetHandle, "BasicSafetyMessage", newPath) )
    {
      C2xRemoveToken(packetHandle, "BasicSafetyMessage", newPath);
    }
  }

  snprintf(newPath, elcount(newPath), "%s.%s", oldPath, "day");
  if(value.day.isValidFlag==1)
  {
    C2xSetTokenInt(packetHandle, "BasicSafetyMessage", newPath, value.day.value);
    result = CheckLastError("BasicSafetyMessage", gkFuncRefGet, result);
  }
  else
  {
    if( C2xIsTokenAvailable(packetHandle, "BasicSafetyMessage", newPath) )
    {
      C2xRemoveToken(packetHandle, "BasicSafetyMessage", newPath);
    }
  }

  snprintf(newPath, elcount(newPath), "%s.%s", oldPath, "hour");
  if(value.hour.isValidFlag==1)
  {
    C2xSetTokenInt(packetHandle, "BasicSafetyMessage", newPath, value.hour.value);
    result = CheckLastError("BasicSafetyMessage", gkFuncRefGet, result);
  }
  else
  {
    if( C2xIsTokenAvailable(packetHandle, "BasicSafetyMessage", newPath) )
    {
      C2xRemoveToken(packetHandle, "BasicSafetyMessage", newPath);
    }
  }

  snprintf(newPath, elcount(newPath), "%s.%s", oldPath, "minute");
  if(value.minute.isValidFlag==1)
  {
    C2xSetTokenInt(packetHandle, "BasicSafetyMessage", newPath, value.minute.value);
    result = CheckLastError("BasicSafetyMessage", gkFuncRefGet, result);
  }
  else
  {
    if( C2xIsTokenAvailable(packetHandle, "BasicSafetyMessage", newPath) )
    {
      C2xRemoveToken(packetHandle, "BasicSafetyMessage", newPath);
    }
  }

  snprintf(newPath, elcount(newPath), "%s.%s", oldPath, "second");
  if(value.second.isValidFlag==1)
  {
    C2xSetTokenInt(packetHandle, "BasicSafetyMessage", newPath, value.second.value);
    result = CheckLastError("BasicSafetyMessage", gkFuncRefGet, result);
  }
  else
  {
    if( C2xIsTokenAvailable(packetHandle, "BasicSafetyMessage", newPath) )
    {
      C2xRemoveToken(packetHandle, "BasicSafetyMessage", newPath);
    }
  }

  snprintf(newPath, elcount(newPath), "%s.%s", oldPath, "offset");
  if(value.offset.isValidFlag==1)
  {
    C2xSetTokenInt(packetHandle, "BasicSafetyMessage", newPath, value.offset.value);
    result = CheckLastError("BasicSafetyMessage", gkFuncRefGet, result);
  }
  else
  {
    if( C2xIsTokenAvailable(packetHandle, "BasicSafetyMessage", newPath) )
    {
      C2xRemoveToken(packetHandle, "BasicSafetyMessage", newPath);
    }
  }

  return result;
}

int GetBasicSafetyMessageTransmissionAndSpeedParams(LONG packetHandle, struct BasicSafetyMessageTransmissionAndSpeed value, char oldPath[])
{
  char newPath[300];
  int result;

  result = 0;

  snprintf(newPath, elcount(newPath), "%s.%s", oldPath, "transmisson");
  value.transmisson = C2xGetTokenInt(packetHandle, "BasicSafetyMessage", newPath);
  result = CheckLastError("BasicSafetyMessage", gkFuncRefGet, result);

  snprintf(newPath, elcount(newPath), "%s.%s", oldPath, "speed");
  value.speed = C2xGetTokenInt(packetHandle, "BasicSafetyMessage", newPath);
  result = CheckLastError("BasicSafetyMessage", gkFuncRefGet, result);

  return result;
}

int SetBasicSafetyMessageTransmissionAndSpeedParams(LONG packetHandle, struct BasicSafetyMessageTransmissionAndSpeed value, char oldPath[])
{
  char newPath[300];
  int result;

  result = 0;

  snprintf(newPath, elcount(newPath), "%s.%s", oldPath, "transmisson");
  C2xSetTokenInt(packetHandle, "BasicSafetyMessage", newPath, value.transmisson);
  result = CheckLastError("BasicSafetyMessage", gkFuncRefGet, result);

  snprintf(newPath, elcount(newPath), "%s.%s", oldPath, "speed");
  C2xSetTokenInt(packetHandle, "BasicSafetyMessage", newPath, value.speed);
  result = CheckLastError("BasicSafetyMessage", gkFuncRefGet, result);

  return result;
}

int GetBasicSafetyMessagePositionConfidenceSetParams(LONG packetHandle, struct BasicSafetyMessagePositionConfidenceSet value, char oldPath[])
{
  char newPath[300];
  int result;

  result = 0;

  snprintf(newPath, elcount(newPath), "%s.%s", oldPath, "pos");
  value.pos = C2xGetTokenInt(packetHandle, "BasicSafetyMessage", newPath);
  result = CheckLastError("BasicSafetyMessage", gkFuncRefGet, result);

  snprintf(newPath, elcount(newPath), "%s.%s", oldPath, "elevation");
  value.elevation = C2xGetTokenInt(packetHandle, "BasicSafetyMessage", newPath);
  result = CheckLastError("BasicSafetyMessage", gkFuncRefGet, result);

  return result;
}

int SetBasicSafetyMessagePositionConfidenceSetParams(LONG packetHandle, struct BasicSafetyMessagePositionConfidenceSet value, char oldPath[])
{
  char newPath[300];
  int result;

  result = 0;

  snprintf(newPath, elcount(newPath), "%s.%s", oldPath, "pos");
  C2xSetTokenInt(packetHandle, "BasicSafetyMessage", newPath, value.pos);
  result = CheckLastError("BasicSafetyMessage", gkFuncRefGet, result);

  snprintf(newPath, elcount(newPath), "%s.%s", oldPath, "elevation");
  C2xSetTokenInt(packetHandle, "BasicSafetyMessage", newPath, value.elevation);
  result = CheckLastError("BasicSafetyMessage", gkFuncRefGet, result);

  return result;
}

int GetBasicSafetyMessageSpeedandHeadingandThrottleConfidenceParams(LONG packetHandle, struct BasicSafetyMessageSpeedandHeadingandThrottleConfidence value, char oldPath[])
{
  char newPath[300];
  int result;

  result = 0;

  snprintf(newPath, elcount(newPath), "%s.%s", oldPath, "heading");
  value.heading = C2xGetTokenInt(packetHandle, "BasicSafetyMessage", newPath);
  result = CheckLastError("BasicSafetyMessage", gkFuncRefGet, result);

  snprintf(newPath, elcount(newPath), "%s.%s", oldPath, "speed");
  value.speed = C2xGetTokenInt(packetHandle, "BasicSafetyMessage", newPath);
  result = CheckLastError("BasicSafetyMessage", gkFuncRefGet, result);

  snprintf(newPath, elcount(newPath), "%s.%s", oldPath, "throttle");
  value.throttle = C2xGetTokenInt(packetHandle, "BasicSafetyMessage", newPath);
  result = CheckLastError("BasicSafetyMessage", gkFuncRefGet, result);

  return result;
}

int SetBasicSafetyMessageSpeedandHeadingandThrottleConfidenceParams(LONG packetHandle, struct BasicSafetyMessageSpeedandHeadingandThrottleConfidence value, char oldPath[])
{
  char newPath[300];
  int result;

  result = 0;

  snprintf(newPath, elcount(newPath), "%s.%s", oldPath, "heading");
  C2xSetTokenInt(packetHandle, "BasicSafetyMessage", newPath, value.heading);
  result = CheckLastError("BasicSafetyMessage", gkFuncRefGet, result);

  snprintf(newPath, elcount(newPath), "%s.%s", oldPath, "speed");
  C2xSetTokenInt(packetHandle, "BasicSafetyMessage", newPath, value.speed);
  result = CheckLastError("BasicSafetyMessage", gkFuncRefGet, result);

  snprintf(newPath, elcount(newPath), "%s.%s", oldPath, "throttle");
  C2xSetTokenInt(packetHandle, "BasicSafetyMessage", newPath, value.throttle);
  result = CheckLastError("BasicSafetyMessage", gkFuncRefGet, result);

  return result;
}

int GetBasicSafetyMessageFullPositionVectorParams(LONG packetHandle, struct BasicSafetyMessageFullPositionVector value, char oldPath[])
{
  char newPath[300];
  int result;

  result = 0;

  snprintf(newPath, elcount(newPath), "%s.%s", oldPath, "utcTime");
  value.utcTime.isValidFlag = C2xIsTokenAvailable(packetHandle, "BasicSafetyMessage", newPath);
  if(value.utcTime.isValidFlag==1)
  {
    GetBasicSafetyMessageDDateTimeParams(packetHandle, value.utcTime, newPath);
    result = CheckLastError("BasicSafetyMessage", gkFuncRefGet, result);
  }
  snprintf(newPath, elcount(newPath), "%s.%s", oldPath, "lon");
  value.lon = C2xGetTokenInt(packetHandle, "BasicSafetyMessage", newPath);
  result = CheckLastError("BasicSafetyMessage", gkFuncRefGet, result);

  snprintf(newPath, elcount(newPath), "%s.%s", oldPath, "lat");
  value.lat = C2xGetTokenInt(packetHandle, "BasicSafetyMessage", newPath);
  result = CheckLastError("BasicSafetyMessage", gkFuncRefGet, result);

  snprintf(newPath, elcount(newPath), "%s.%s", oldPath, "elevation");
  value.elevation.isValidFlag = C2xIsTokenAvailable(packetHandle, "BasicSafetyMessage", newPath);
  if(value.elevation.isValidFlag==1)
  {
    value.elevation.value = C2xGetTokenInt(packetHandle, "BasicSafetyMessage", newPath);
    result = CheckLastError("BasicSafetyMessage", gkFuncRefGet, result);
  }
  snprintf(newPath, elcount(newPath), "%s.%s", oldPath, "heading");
  value.heading.isValidFlag = C2xIsTokenAvailable(packetHandle, "BasicSafetyMessage", newPath);
  if(value.heading.isValidFlag==1)
  {
    value.heading.value = C2xGetTokenInt(packetHandle, "BasicSafetyMessage", newPath);
    result = CheckLastError("BasicSafetyMessage", gkFuncRefGet, result);
  }
  snprintf(newPath, elcount(newPath), "%s.%s", oldPath, "speed");
  value.speed.isValidFlag = C2xIsTokenAvailable(packetHandle, "BasicSafetyMessage", newPath);
  if(value.speed.isValidFlag==1)
  {
    GetBasicSafetyMessageTransmissionAndSpeedParams(packetHandle, value.speed, newPath);
    result = CheckLastError("BasicSafetyMessage", gkFuncRefGet, result);
  }
  snprintf(newPath, elcount(newPath), "%s.%s", oldPath, "posAccuracy");
  value.posAccuracy.isValidFlag = C2xIsTokenAvailable(packetHandle, "BasicSafetyMessage", newPath);
  if(value.posAccuracy.isValidFlag==1)
  {
    GetBasicSafetyMessagePositionalAccuracyParams(packetHandle, value.posAccuracy, newPath);
    result = CheckLastError("BasicSafetyMessage", gkFuncRefGet, result);
  }
  snprintf(newPath, elcount(newPath), "%s.%s", oldPath, "timeConfidence");
  value.timeConfidence.isValidFlag = C2xIsTokenAvailable(packetHandle, "BasicSafetyMessage", newPath);
  if(value.timeConfidence.isValidFlag==1)
  {
    value.timeConfidence.value = C2xGetTokenInt(packetHandle, "BasicSafetyMessage", newPath);
    result = CheckLastError("BasicSafetyMessage", gkFuncRefGet, result);
  }
  snprintf(newPath, elcount(newPath), "%s.%s", oldPath, "posConfidence");
  value.posConfidence.isValidFlag = C2xIsTokenAvailable(packetHandle, "BasicSafetyMessage", newPath);
  if(value.posConfidence.isValidFlag==1)
  {
    GetBasicSafetyMessagePositionConfidenceSetParams(packetHandle, value.posConfidence, newPath);
    result = CheckLastError("BasicSafetyMessage", gkFuncRefGet, result);
  }
  snprintf(newPath, elcount(newPath), "%s.%s", oldPath, "speedConfidence");
  value.speedConfidence.isValidFlag = C2xIsTokenAvailable(packetHandle, "BasicSafetyMessage", newPath);
  if(value.speedConfidence.isValidFlag==1)
  {
    GetBasicSafetyMessageSpeedandHeadingandThrottleConfidenceParams(packetHandle, value.speedConfidence, newPath);
    result = CheckLastError("BasicSafetyMessage", gkFuncRefGet, result);
  }
  return result;
}

int SetBasicSafetyMessageFullPositionVectorParams(LONG packetHandle, struct BasicSafetyMessageFullPositionVector value, char oldPath[])
{
  char newPath[300];
  int result;

  result = 0;

  snprintf(newPath, elcount(newPath), "%s.%s", oldPath, "utcTime");
  if(value.utcTime.isValidFlag==1)
  {
    SetBasicSafetyMessageDDateTimeParams(packetHandle, value.utcTime, newPath);
    result = CheckLastError("BasicSafetyMessage", gkFuncRefGet, result);
  }
  else
  {
    if( C2xIsTokenAvailable(packetHandle, "BasicSafetyMessage", newPath) )
    {
      C2xRemoveToken(packetHandle, "BasicSafetyMessage", newPath);
    }
  }

  snprintf(newPath, elcount(newPath), "%s.%s", oldPath, "lon");
  C2xSetTokenInt(packetHandle, "BasicSafetyMessage", newPath, value.lon);
  result = CheckLastError("BasicSafetyMessage", gkFuncRefGet, result);

  snprintf(newPath, elcount(newPath), "%s.%s", oldPath, "lat");
  C2xSetTokenInt(packetHandle, "BasicSafetyMessage", newPath, value.lat);
  result = CheckLastError("BasicSafetyMessage", gkFuncRefGet, result);

  snprintf(newPath, elcount(newPath), "%s.%s", oldPath, "elevation");
  if(value.elevation.isValidFlag==1)
  {
    C2xSetTokenInt(packetHandle, "BasicSafetyMessage", newPath, value.elevation.value);
    result = CheckLastError("BasicSafetyMessage", gkFuncRefGet, result);
  }
  else
  {
    if( C2xIsTokenAvailable(packetHandle, "BasicSafetyMessage", newPath) )
    {
      C2xRemoveToken(packetHandle, "BasicSafetyMessage", newPath);
    }
  }

  snprintf(newPath, elcount(newPath), "%s.%s", oldPath, "heading");
  if(value.heading.isValidFlag==1)
  {
    C2xSetTokenInt(packetHandle, "BasicSafetyMessage", newPath, value.heading.value);
    result = CheckLastError("BasicSafetyMessage", gkFuncRefGet, result);
  }
  else
  {
    if( C2xIsTokenAvailable(packetHandle, "BasicSafetyMessage", newPath) )
    {
      C2xRemoveToken(packetHandle, "BasicSafetyMessage", newPath);
    }
  }

  snprintf(newPath, elcount(newPath), "%s.%s", oldPath, "speed");
  if(value.speed.isValidFlag==1)
  {
    SetBasicSafetyMessageTransmissionAndSpeedParams(packetHandle, value.speed, newPath);
    result = CheckLastError("BasicSafetyMessage", gkFuncRefGet, result);
  }
  else
  {
    if( C2xIsTokenAvailable(packetHandle, "BasicSafetyMessage", newPath) )
    {
      C2xRemoveToken(packetHandle, "BasicSafetyMessage", newPath);
    }
  }

  snprintf(newPath, elcount(newPath), "%s.%s", oldPath, "posAccuracy");
  if(value.posAccuracy.isValidFlag==1)
  {
    SetBasicSafetyMessagePositionalAccuracyParams(packetHandle, value.posAccuracy, newPath);
    result = CheckLastError("BasicSafetyMessage", gkFuncRefGet, result);
  }
  else
  {
    if( C2xIsTokenAvailable(packetHandle, "BasicSafetyMessage", newPath) )
    {
      C2xRemoveToken(packetHandle, "BasicSafetyMessage", newPath);
    }
  }

  snprintf(newPath, elcount(newPath), "%s.%s", oldPath, "timeConfidence");
  if(value.timeConfidence.isValidFlag==1)
  {
    C2xSetTokenInt(packetHandle, "BasicSafetyMessage", newPath, value.timeConfidence.value);
    result = CheckLastError("BasicSafetyMessage", gkFuncRefGet, result);
  }
  else
  {
    if( C2xIsTokenAvailable(packetHandle, "BasicSafetyMessage", newPath) )
    {
      C2xRemoveToken(packetHandle, "BasicSafetyMessage", newPath);
    }
  }

  snprintf(newPath, elcount(newPath), "%s.%s", oldPath, "posConfidence");
  if(value.posConfidence.isValidFlag==1)
  {
    SetBasicSafetyMessagePositionConfidenceSetParams(packetHandle, value.posConfidence, newPath);
    result = CheckLastError("BasicSafetyMessage", gkFuncRefGet, result);
  }
  else
  {
    if( C2xIsTokenAvailable(packetHandle, "BasicSafetyMessage", newPath) )
    {
      C2xRemoveToken(packetHandle, "BasicSafetyMessage", newPath);
    }
  }

  snprintf(newPath, elcount(newPath), "%s.%s", oldPath, "speedConfidence");
  if(value.speedConfidence.isValidFlag==1)
  {
    SetBasicSafetyMessageSpeedandHeadingandThrottleConfidenceParams(packetHandle, value.speedConfidence, newPath);
    result = CheckLastError("BasicSafetyMessage", gkFuncRefGet, result);
  }
  else
  {
    if( C2xIsTokenAvailable(packetHandle, "BasicSafetyMessage", newPath) )
    {
      C2xRemoveToken(packetHandle, "BasicSafetyMessage", newPath);
    }
  }

  return result;
}

int GetBasicSafetyMessagePathHistoryPointParams(LONG packetHandle, struct BasicSafetyMessagePathHistoryPoint value, char oldPath[])
{
  char newPath[300];
  int result;

  result = 0;

  snprintf(newPath, elcount(newPath), "%s.%s", oldPath, "latOffset");
  value.latOffset = C2xGetTokenInt(packetHandle, "BasicSafetyMessage", newPath);
  result = CheckLastError("BasicSafetyMessage", gkFuncRefGet, result);

  snprintf(newPath, elcount(newPath), "%s.%s", oldPath, "lonOffset");
  value.lonOffset = C2xGetTokenInt(packetHandle, "BasicSafetyMessage", newPath);
  result = CheckLastError("BasicSafetyMessage", gkFuncRefGet, result);

  snprintf(newPath, elcount(newPath), "%s.%s", oldPath, "elevationOffset");
  value.elevationOffset = C2xGetTokenInt(packetHandle, "BasicSafetyMessage", newPath);
  result = CheckLastError("BasicSafetyMessage", gkFuncRefGet, result);

  snprintf(newPath, elcount(newPath), "%s.%s", oldPath, "timeOffset");
  value.timeOffset = C2xGetTokenInt(packetHandle, "BasicSafetyMessage", newPath);
  result = CheckLastError("BasicSafetyMessage", gkFuncRefGet, result);

  snprintf(newPath, elcount(newPath), "%s.%s", oldPath, "speed");
  value.speed.isValidFlag = C2xIsTokenAvailable(packetHandle, "BasicSafetyMessage", newPath);
  if(value.speed.isValidFlag==1)
  {
    value.speed.value = C2xGetTokenInt(packetHandle, "BasicSafetyMessage", newPath);
    result = CheckLastError("BasicSafetyMessage", gkFuncRefGet, result);
  }
  snprintf(newPath, elcount(newPath), "%s.%s", oldPath, "posAccuracy");
  value.posAccuracy.isValidFlag = C2xIsTokenAvailable(packetHandle, "BasicSafetyMessage", newPath);
  if(value.posAccuracy.isValidFlag==1)
  {
    GetBasicSafetyMessagePositionalAccuracyParams(packetHandle, value.posAccuracy, newPath);
    result = CheckLastError("BasicSafetyMessage", gkFuncRefGet, result);
  }
  snprintf(newPath, elcount(newPath), "%s.%s", oldPath, "heading");
  value.heading.isValidFlag = C2xIsTokenAvailable(packetHandle, "BasicSafetyMessage", newPath);
  if(value.heading.isValidFlag==1)
  {
    value.heading.value = C2xGetTokenInt(packetHandle, "BasicSafetyMessage", newPath);
    result = CheckLastError("BasicSafetyMessage", gkFuncRefGet, result);
  }
  return result;
}

int SetBasicSafetyMessagePathHistoryPointParams(LONG packetHandle, struct BasicSafetyMessagePathHistoryPoint value, char oldPath[])
{
  char newPath[300];
  int result;

  result = 0;

  snprintf(newPath, elcount(newPath), "%s.%s", oldPath, "latOffset");
  C2xSetTokenInt(packetHandle, "BasicSafetyMessage", newPath, value.latOffset);
  result = CheckLastError("BasicSafetyMessage", gkFuncRefGet, result);

  snprintf(newPath, elcount(newPath), "%s.%s", oldPath, "lonOffset");
  C2xSetTokenInt(packetHandle, "BasicSafetyMessage", newPath, value.lonOffset);
  result = CheckLastError("BasicSafetyMessage", gkFuncRefGet, result);

  snprintf(newPath, elcount(newPath), "%s.%s", oldPath, "elevationOffset");
  C2xSetTokenInt(packetHandle, "BasicSafetyMessage", newPath, value.elevationOffset);
  result = CheckLastError("BasicSafetyMessage", gkFuncRefGet, result);

  snprintf(newPath, elcount(newPath), "%s.%s", oldPath, "timeOffset");
  if (value.timeOffset < 1)
  {
    C2xSetTokenInt(packetHandle, "BasicSafetyMessage", newPath, 1);
  }
  else if (value.timeOffset > 65535)
  {
    C2xSetTokenInt(packetHandle, "BasicSafetyMessage", newPath, 65535);
  }
  else
  {
    C2xSetTokenInt(packetHandle, "BasicSafetyMessage", newPath, value.timeOffset);
  }
  result = CheckLastError("BasicSafetyMessage", gkFuncRefGet, result);

  snprintf(newPath, elcount(newPath), "%s.%s", oldPath, "speed");
  if(value.speed.isValidFlag==1)
  {
    C2xSetTokenInt(packetHandle, "BasicSafetyMessage", newPath, value.speed.value);
    result = CheckLastError("BasicSafetyMessage", gkFuncRefGet, result);
  }
  else
  {
    if( C2xIsTokenAvailable(packetHandle, "BasicSafetyMessage", newPath) )
    {
      C2xRemoveToken(packetHandle, "BasicSafetyMessage", newPath);
    }
  }

  snprintf(newPath, elcount(newPath), "%s.%s", oldPath, "posAccuracy");
  if(value.posAccuracy.isValidFlag==1)
  {
    SetBasicSafetyMessagePositionalAccuracyParams(packetHandle, value.posAccuracy, newPath);
    result = CheckLastError("BasicSafetyMessage", gkFuncRefGet, result);
  }
  else
  {
    if( C2xIsTokenAvailable(packetHandle, "BasicSafetyMessage", newPath) )
    {
      C2xRemoveToken(packetHandle, "BasicSafetyMessage", newPath);
    }
  }

  snprintf(newPath, elcount(newPath), "%s.%s", oldPath, "heading");
  if(value.heading.isValidFlag==1)
  {
    C2xSetTokenInt(packetHandle, "BasicSafetyMessage", newPath, value.heading.value);
    result = CheckLastError("BasicSafetyMessage", gkFuncRefGet, result);
  }
  else
  {
    if( C2xIsTokenAvailable(packetHandle, "BasicSafetyMessage", newPath) )
    {
      C2xRemoveToken(packetHandle, "BasicSafetyMessage", newPath);
    }
  }

  return result;
}

int GetBasicSafetyMessagePathHistoryPointListParams(LONG packetHandle, struct BasicSafetyMessagePathHistoryPointList value, char oldPath[])
{
  char newPath[300]; 
  int i;
  int result;

  result = 0;

  value.length = C2xGetTokenInt(packetHandle, "BasicSafetyMessage", oldPath);
  if((result = CheckLastError("BasicSafetyMessage", gkFuncRefGet, result))==0)
  {
    for(i=0; i<value.length; i++)
    {
      snprintf(newPath, elcount(newPath), "%s[%d]", oldPath, i);
      GetBasicSafetyMessagePathHistoryPointParams(packetHandle, value.arrayValue[i], newPath);
      result = CheckLastError("BasicSafetyMessage", gkFuncRefGet, result);
    }
  }
  return result;
}

int SetBasicSafetyMessagePathHistoryPointListParams(LONG packetHandle, struct BasicSafetyMessagePathHistoryPointList value, char oldPath[])
{
  char newPath[300]; 
  int i;
  int result;

  result = 0;

  C2xRemoveToken(packetHandle, "BasicSafetyMessage", oldPath);
  for(i=0; i<value.length; i++)
  {
    snprintf(newPath, elcount(newPath), "%s[%d]", oldPath, i);
    SetBasicSafetyMessagePathHistoryPointParams(packetHandle, value.arrayValue[i], newPath);
    result = CheckLastError("BasicSafetyMessage", gkFuncRefGet, result);
  }
  return result;
}

int GetBasicSafetyMessagePathHistoryParams(LONG packetHandle, struct BasicSafetyMessagePathHistory value, char oldPath[])
{
  char newPath[300]; 
  int j; 
  int k;
  int result;

  result = 0;

  snprintf(newPath, elcount(newPath), "%s.%s", oldPath, "initialPosition");
  value.initialPosition.isValidFlag = C2xIsTokenAvailable(packetHandle, "BasicSafetyMessage", newPath);
  if(value.initialPosition.isValidFlag==1)
  {
    GetBasicSafetyMessageFullPositionVectorParams(packetHandle, value.initialPosition, newPath);
    result = CheckLastError("BasicSafetyMessage", gkFuncRefGet, result);
  }
  snprintf(newPath, elcount(newPath), "%s.%s", oldPath, "currGNSSstatus");
  value.currGNSSstatus.isValidFlag = C2xIsTokenAvailable(packetHandle, "BasicSafetyMessage", newPath);
  if(value.currGNSSstatus.isValidFlag==1)
  {
    value.currGNSSstatus.isValidFlag = 1;
    value.currGNSSstatus.stringLength = C2xGetTokenLengthBit(packetHandle, "BasicSafetyMessage", newPath);
    if ((result = CheckLastError("BasicSafetyMessage", gkFuncRefGet, result))==0)
    {
      if(value.currGNSSstatus.stringLength > 0)
      {
        for(j=0; j<value.currGNSSstatus.stringLength; j++)
        {
          if(C2xGetTokenBitOfBitString(packetHandle, "BasicSafetyMessage", newPath, j) == 0)
          {
            value.currGNSSstatus.string[j] = '0';
          }
          else if(C2xGetTokenBitOfBitString(packetHandle, "BasicSafetyMessage", newPath, j) == 1)
          {
            value.currGNSSstatus.string[j] = '1';
          }

          if(value.currGNSSstatus.stringLength == 1)
          {
            value.currGNSSstatus.string[1] = '0';
          }
          result = CheckLastError("BasicSafetyMessage", gkFuncRefGet, result);
        }
      }
      else
      {
        for(k = value.currGNSSstatus.stringLength+1; k > -1; k--)
        {
          if(value.currGNSSstatus.string[k] == '1')
          {
            value.currGNSSstatus.string[k] = '0';
          }
        }
      }
    }

  }
  snprintf(newPath, elcount(newPath), "%s.%s", oldPath, "crumbData");
  GetBasicSafetyMessagePathHistoryPointListParams(packetHandle, value.crumbData, newPath);
  result = CheckLastError("BasicSafetyMessage", gkFuncRefGet, result);

  return result;
}

int SetBasicSafetyMessagePathHistoryParams(LONG packetHandle, struct BasicSafetyMessagePathHistory value, char oldPath[])
{
  char newPath[300]; 
  int j;
  int result;

  result = 0;

  snprintf(newPath, elcount(newPath), "%s.%s", oldPath, "initialPosition");
  if(value.initialPosition.isValidFlag==1)
  {
    SetBasicSafetyMessageFullPositionVectorParams(packetHandle, value.initialPosition, newPath);
    result = CheckLastError("BasicSafetyMessage", gkFuncRefGet, result);
  }
  else
  {
    if( C2xIsTokenAvailable(packetHandle, "BasicSafetyMessage", newPath) )
    {
      C2xRemoveToken(packetHandle, "BasicSafetyMessage", newPath);
    }
  }

  snprintf(newPath, elcount(newPath), "%s.%s", oldPath, "currGNSSstatus");
  if(value.currGNSSstatus.isValidFlag==1)
  {
      for(j=0; j<value.currGNSSstatus.stringLength; j++)
      {
        if(value.currGNSSstatus.string[j] == '0')
        {
          C2xSetTokenBitOfBitString(packetHandle, "BasicSafetyMessage", newPath, j, 0);
        }
        else
        {
          C2xSetTokenBitOfBitString(packetHandle, "BasicSafetyMessage", newPath, j, 1);
        }
        result = CheckLastError("BasicSafetyMessage", gkFuncRefGet, result);
      }
  }
  else
  {
    if( C2xIsTokenAvailable(packetHandle, "BasicSafetyMessage", newPath) )
    {
      C2xRemoveToken(packetHandle, "BasicSafetyMessage", newPath);
    }
  }

  snprintf(newPath, elcount(newPath), "%s.%s", oldPath, "crumbData");
  SetBasicSafetyMessagePathHistoryPointListParams(packetHandle, value.crumbData, newPath);
  result = CheckLastError("BasicSafetyMessage", gkFuncRefGet, result);

  return result;
}

int GetBasicSafetyMessagePathPredictionParams(LONG packetHandle, struct BasicSafetyMessagePathPrediction value, char oldPath[])
{
  char newPath[300];
  int result;

  result = 0;

  snprintf(newPath, elcount(newPath), "%s.%s", oldPath, "radiusOfCurve");
  value.radiusOfCurve = C2xGetTokenInt(packetHandle, "BasicSafetyMessage", newPath);
  result = CheckLastError("BasicSafetyMessage", gkFuncRefGet, result);

  snprintf(newPath, elcount(newPath), "%s.%s", oldPath, "confidence");
  value.confidence = C2xGetTokenInt(packetHandle, "BasicSafetyMessage", newPath);
  result = CheckLastError("BasicSafetyMessage", gkFuncRefGet, result);

  return result;
}

int SetBasicSafetyMessagePathPredictionParams(LONG packetHandle, struct BasicSafetyMessagePathPrediction value, char oldPath[])
{
  char newPath[300];
  int result;

  result = 0;

  snprintf(newPath, elcount(newPath), "%s.%s", oldPath, "radiusOfCurve");
  C2xSetTokenInt(packetHandle, "BasicSafetyMessage", newPath, value.radiusOfCurve);
  result = CheckLastError("BasicSafetyMessage", gkFuncRefGet, result);

  snprintf(newPath, elcount(newPath), "%s.%s", oldPath, "confidence");
  C2xSetTokenInt(packetHandle, "BasicSafetyMessage", newPath, value.confidence);
  result = CheckLastError("BasicSafetyMessage", gkFuncRefGet, result);

  return result;
}

int GetBasicSafetyMessageVehicleSafetyExtensionsParams(LONG packetHandle, struct BasicSafetyMessageVehicleSafetyExtensions value, char oldPath[])
{
  char newPath[300]; 
  int j; 
  int k;
  int result;

  result = 0;

  snprintf(newPath, elcount(newPath), "%s.%s", oldPath, "events");
  value.events.isValidFlag = C2xIsTokenAvailable(packetHandle, "BasicSafetyMessage", newPath);
  if(value.events.isValidFlag==1)
  {
    value.events.isValidFlag = 1;
    value.events.stringLength = C2xGetTokenLengthBit(packetHandle, "BasicSafetyMessage", newPath);
    if ((result = CheckLastError("BasicSafetyMessage", gkFuncRefGet, result))==0)
    {
      if(value.events.stringLength > 0)
      {
        for(j=0; j<value.events.stringLength; j++)
        {
          if(C2xGetTokenBitOfBitString(packetHandle, "BasicSafetyMessage", newPath, j) == 0)
          {
            value.events.string[j] = '0';
          }
          else if(C2xGetTokenBitOfBitString(packetHandle, "BasicSafetyMessage", newPath, j) == 1)
          {
            value.events.string[j] = '1';
          }

          if(value.events.stringLength == 1)
          {
            value.events.string[1] = '0';
          }
          result = CheckLastError("BasicSafetyMessage", gkFuncRefGet, result);
        }
      }
      else
      {
        for(k = value.events.stringLength+1; k > -1; k--)
        {
          if(value.events.string[k] == '1')
          {
            value.events.string[k] = '0';
          }
        }
      }
    }

  }
  snprintf(newPath, elcount(newPath), "%s.%s", oldPath, "pathHistory");
  value.pathHistory.isValidFlag = C2xIsTokenAvailable(packetHandle, "BasicSafetyMessage", newPath);
  if(value.pathHistory.isValidFlag==1)
  {
    GetBasicSafetyMessagePathHistoryParams(packetHandle, value.pathHistory, newPath);
    result = CheckLastError("BasicSafetyMessage", gkFuncRefGet, result);
  }
  snprintf(newPath, elcount(newPath), "%s.%s", oldPath, "pathPrediction");
  value.pathPrediction.isValidFlag = C2xIsTokenAvailable(packetHandle, "BasicSafetyMessage", newPath);
  if(value.pathPrediction.isValidFlag==1)
  {
    GetBasicSafetyMessagePathPredictionParams(packetHandle, value.pathPrediction, newPath);
    result = CheckLastError("BasicSafetyMessage", gkFuncRefGet, result);
  }
  snprintf(newPath, elcount(newPath), "%s.%s", oldPath, "lights");
  value.lights.isValidFlag = C2xIsTokenAvailable(packetHandle, "BasicSafetyMessage", newPath);
  if(value.lights.isValidFlag==1)
  {
    value.lights.isValidFlag = 1;
    value.lights.stringLength = C2xGetTokenLengthBit(packetHandle, "BasicSafetyMessage", newPath);
    if ((result = CheckLastError("BasicSafetyMessage", gkFuncRefGet, result))==0)
    {
      if(value.lights.stringLength > 0)
      {
        for(j=0; j<value.lights.stringLength; j++)
        {
          if(C2xGetTokenBitOfBitString(packetHandle, "BasicSafetyMessage", newPath, j) == 0)
          {
            value.lights.string[j] = '0';
          }
          else if(C2xGetTokenBitOfBitString(packetHandle, "BasicSafetyMessage", newPath, j) == 1)
          {
            value.lights.string[j] = '1';
          }

          if(value.lights.stringLength == 1)
          {
            value.lights.string[1] = '0';
          }
          result = CheckLastError("BasicSafetyMessage", gkFuncRefGet, result);
        }
      }
      else
      {
        for(k = value.lights.stringLength+1; k > -1; k--)
        {
          if(value.lights.string[k] == '1')
          {
            value.lights.string[k] = '0';
          }
        }
      }
    }

  }
  return result;
}

int SetBasicSafetyMessageVehicleSafetyExtensionsParams(LONG packetHandle, struct BasicSafetyMessageVehicleSafetyExtensions value, char oldPath[])
{
  char newPath[300]; 
  int j;
  int result;

  result = 0;

  snprintf(newPath, elcount(newPath), "%s.%s", oldPath, "events");
  if(value.events.isValidFlag==1)
  {
      for(j=0; j<value.events.stringLength; j++)
      {
        if(value.events.string[j] == '0')
        {
          C2xSetTokenBitOfBitString(packetHandle, "BasicSafetyMessage", newPath, j, 0);
        }
        else
        {
          C2xSetTokenBitOfBitString(packetHandle, "BasicSafetyMessage", newPath, j, 1);
        }
        result = CheckLastError("BasicSafetyMessage", gkFuncRefGet, result);
      }
  }
  else
  {
    if( C2xIsTokenAvailable(packetHandle, "BasicSafetyMessage", newPath) )
    {
      C2xRemoveToken(packetHandle, "BasicSafetyMessage", newPath);
    }
  }

  snprintf(newPath, elcount(newPath), "%s.%s", oldPath, "pathHistory");
  if(value.pathHistory.isValidFlag==1)
  {
    SetBasicSafetyMessagePathHistoryParams(packetHandle, value.pathHistory, newPath);
    result = CheckLastError("BasicSafetyMessage", gkFuncRefGet, result);
  }
  else
  {
    if( C2xIsTokenAvailable(packetHandle, "BasicSafetyMessage", newPath) )
    {
      C2xRemoveToken(packetHandle, "BasicSafetyMessage", newPath);
    }
  }

  snprintf(newPath, elcount(newPath), "%s.%s", oldPath, "pathPrediction");
  if(value.pathPrediction.isValidFlag==1)
  {
    SetBasicSafetyMessagePathPredictionParams(packetHandle, value.pathPrediction, newPath);
    result = CheckLastError("BasicSafetyMessage", gkFuncRefGet, result);
  }
  else
  {
    if( C2xIsTokenAvailable(packetHandle, "BasicSafetyMessage", newPath) )
    {
      C2xRemoveToken(packetHandle, "BasicSafetyMessage", newPath);
    }
  }

  snprintf(newPath, elcount(newPath), "%s.%s", oldPath, "lights");
  if(value.lights.isValidFlag==1)
  {
      for(j=0; j<value.lights.stringLength; j++)
      {
        if(value.lights.string[j] == '0')
        {
          C2xSetTokenBitOfBitString(packetHandle, "BasicSafetyMessage", newPath, j, 0);
        }
        else
        {
          C2xSetTokenBitOfBitString(packetHandle, "BasicSafetyMessage", newPath, j, 1);
        }
        result = CheckLastError("BasicSafetyMessage", gkFuncRefGet, result);
      }
  }
  else
  {
    if( C2xIsTokenAvailable(packetHandle, "BasicSafetyMessage", newPath) )
    {
      C2xRemoveToken(packetHandle, "BasicSafetyMessage", newPath);
    }
  }

  return result;
}

int GetBasicSafetyMessagePrivilegedEventsParams(LONG packetHandle, struct BasicSafetyMessagePrivilegedEvents value, char oldPath[])
{
  char newPath[300]; 
  int j; 
  int k;
  int result;

  result = 0;

  snprintf(newPath, elcount(newPath), "%s.%s", oldPath, "doNotUse");
  value.doNotUse = C2xGetTokenInt(packetHandle, "BasicSafetyMessage", newPath);
  result = CheckLastError("BasicSafetyMessage", gkFuncRefGet, result);

  snprintf(newPath, elcount(newPath), "%s.%s", oldPath, "event");
  value.event.isValidFlag = 1;
  value.event.stringLength = C2xGetTokenLengthBit(packetHandle, "BasicSafetyMessage", newPath);
  if ((result = CheckLastError("BasicSafetyMessage", gkFuncRefGet, result))==0)
  {
    if(value.event.stringLength > 0)
    {
      for(j=0; j<value.event.stringLength; j++)
      {
        if(C2xGetTokenBitOfBitString(packetHandle, "BasicSafetyMessage", newPath, j) == 0)
        {
          value.event.string[j] = '0';
        }
        else if(C2xGetTokenBitOfBitString(packetHandle, "BasicSafetyMessage", newPath, j) == 1)
        {
          value.event.string[j] = '1';
        }

        if(value.event.stringLength == 1)
        {
          value.event.string[1] = '0';
        }
        result = CheckLastError("BasicSafetyMessage", gkFuncRefGet, result);
      }
    }
    else
    {
      for(k = value.event.stringLength+1; k > -1; k--)
      {
        if(value.event.string[k] == '1')
        {
          value.event.string[k] = '0';
        }
      }
    }
  }

  return result;
}

int SetBasicSafetyMessagePrivilegedEventsParams(LONG packetHandle, struct BasicSafetyMessagePrivilegedEvents value, char oldPath[])
{
  char newPath[300]; 
  int j;
  int result;

  result = 0;

  snprintf(newPath, elcount(newPath), "%s.%s", oldPath, "doNotUse");
  C2xSetTokenInt(packetHandle, "BasicSafetyMessage", newPath, value.doNotUse);
  result = CheckLastError("BasicSafetyMessage", gkFuncRefGet, result);

  snprintf(newPath, elcount(newPath), "%s.%s", oldPath, "event");
    for(j=0; j<value.event.stringLength; j++)
    {
      if(value.event.string[j] == '0')
      {
        C2xSetTokenBitOfBitString(packetHandle, "BasicSafetyMessage", newPath, j, 0);
      }
      else
      {
        C2xSetTokenBitOfBitString(packetHandle, "BasicSafetyMessage", newPath, j, 1);
      }
      result = CheckLastError("BasicSafetyMessage", gkFuncRefGet, result);
    }

  return result;
}

int GetBasicSafetyMessageEmergencyDetailsParams(LONG packetHandle, struct BasicSafetyMessageEmergencyDetails value, char oldPath[])
{
  char newPath[300];
  int result;

  result = 0;

  snprintf(newPath, elcount(newPath), "%s.%s", oldPath, "doNotUse");
  value.doNotUse = C2xGetTokenInt(packetHandle, "BasicSafetyMessage", newPath);
  result = CheckLastError("BasicSafetyMessage", gkFuncRefGet, result);

  snprintf(newPath, elcount(newPath), "%s.%s", oldPath, "sirenUse");
  value.sirenUse = C2xGetTokenInt(packetHandle, "BasicSafetyMessage", newPath);
  result = CheckLastError("BasicSafetyMessage", gkFuncRefGet, result);

  snprintf(newPath, elcount(newPath), "%s.%s", oldPath, "lightsUse");
  value.lightsUse = C2xGetTokenInt(packetHandle, "BasicSafetyMessage", newPath);
  result = CheckLastError("BasicSafetyMessage", gkFuncRefGet, result);

  snprintf(newPath, elcount(newPath), "%s.%s", oldPath, "multi");
  value.multi = C2xGetTokenInt(packetHandle, "BasicSafetyMessage", newPath);
  result = CheckLastError("BasicSafetyMessage", gkFuncRefGet, result);

  snprintf(newPath, elcount(newPath), "%s.%s", oldPath, "events");
  value.events.isValidFlag = C2xIsTokenAvailable(packetHandle, "BasicSafetyMessage", newPath);
  if(value.events.isValidFlag==1)
  {
    GetBasicSafetyMessagePrivilegedEventsParams(packetHandle, value.events, newPath);
    result = CheckLastError("BasicSafetyMessage", gkFuncRefGet, result);
  }
  snprintf(newPath, elcount(newPath), "%s.%s", oldPath, "responseType");
  value.responseType.isValidFlag = C2xIsTokenAvailable(packetHandle, "BasicSafetyMessage", newPath);
  if(value.responseType.isValidFlag==1)
  {
    value.responseType.value = C2xGetTokenInt(packetHandle, "BasicSafetyMessage", newPath);
    result = CheckLastError("BasicSafetyMessage", gkFuncRefGet, result);
  }
  return result;
}

int SetBasicSafetyMessageEmergencyDetailsParams(LONG packetHandle, struct BasicSafetyMessageEmergencyDetails value, char oldPath[])
{
  char newPath[300];
  int result;

  result = 0;

  snprintf(newPath, elcount(newPath), "%s.%s", oldPath, "doNotUse");
  C2xSetTokenInt(packetHandle, "BasicSafetyMessage", newPath, value.doNotUse);
  result = CheckLastError("BasicSafetyMessage", gkFuncRefGet, result);

  snprintf(newPath, elcount(newPath), "%s.%s", oldPath, "sirenUse");
  C2xSetTokenInt(packetHandle, "BasicSafetyMessage", newPath, value.sirenUse);
  result = CheckLastError("BasicSafetyMessage", gkFuncRefGet, result);

  snprintf(newPath, elcount(newPath), "%s.%s", oldPath, "lightsUse");
  C2xSetTokenInt(packetHandle, "BasicSafetyMessage", newPath, value.lightsUse);
  result = CheckLastError("BasicSafetyMessage", gkFuncRefGet, result);

  snprintf(newPath, elcount(newPath), "%s.%s", oldPath, "multi");
  C2xSetTokenInt(packetHandle, "BasicSafetyMessage", newPath, value.multi);
  result = CheckLastError("BasicSafetyMessage", gkFuncRefGet, result);

  snprintf(newPath, elcount(newPath), "%s.%s", oldPath, "events");
  if(value.events.isValidFlag==1)
  {
    SetBasicSafetyMessagePrivilegedEventsParams(packetHandle, value.events, newPath);
    result = CheckLastError("BasicSafetyMessage", gkFuncRefGet, result);
  }
  else
  {
    if( C2xIsTokenAvailable(packetHandle, "BasicSafetyMessage", newPath) )
    {
      C2xRemoveToken(packetHandle, "BasicSafetyMessage", newPath);
    }
  }

  snprintf(newPath, elcount(newPath), "%s.%s", oldPath, "responseType");
  if(value.responseType.isValidFlag==1)
  {
    C2xSetTokenInt(packetHandle, "BasicSafetyMessage", newPath, value.responseType.value);
    result = CheckLastError("BasicSafetyMessage", gkFuncRefGet, result);
  }
  else
  {
    if( C2xIsTokenAvailable(packetHandle, "BasicSafetyMessage", newPath) )
    {
      C2xRemoveToken(packetHandle, "BasicSafetyMessage", newPath);
    }
  }

  return result;
}

int GetBasicSafetyMessageEventDescription_descriptionParams(LONG packetHandle, struct BasicSafetyMessageEventDescription_description value, char oldPath[])
{
  char newPath[300]; 
  int i;
  int result;

  result = 0;

  value.length = C2xGetTokenInt(packetHandle, "BasicSafetyMessage", oldPath);
  if((result = CheckLastError("BasicSafetyMessage", gkFuncRefGet, result))==0)
  {
    for(i=0; i<value.length; i++)
    {
      snprintf(newPath, elcount(newPath), "%s[%d]", oldPath, i);
      value.arrayValue[i] = C2xGetTokenInt64(packetHandle, "BasicSafetyMessage", newPath);
      result = CheckLastError("BasicSafetyMessage", gkFuncRefGet, result);
    }
  }
  return result;
}

int SetBasicSafetyMessageEventDescription_descriptionParams(LONG packetHandle, struct BasicSafetyMessageEventDescription_description value, char oldPath[])
{
  char newPath[300]; 
  int i;
  int result;

  result = 0;

  C2xRemoveToken(packetHandle, "BasicSafetyMessage", oldPath);
  for(i=0; i<value.length; i++)
  {
    snprintf(newPath, elcount(newPath), "%s[%d]", oldPath, i);
    C2xSetTokenInt64(packetHandle, "BasicSafetyMessage", newPath, value.arrayValue[i]);
    result = CheckLastError("BasicSafetyMessage", gkFuncRefGet, result);
  }
  return result;
}

int GetBasicSafetyMessageRegionalExtensionParams(LONG packetHandle, struct BasicSafetyMessageRegionalExtension value, char oldPath[])
{
  char newPath[300];
  int result;

  result = 0;

  snprintf(newPath, elcount(newPath), "%s.%s", oldPath, "regionId");
  value.regionId = C2xGetTokenInt(packetHandle, "BasicSafetyMessage", newPath);
  result = CheckLastError("BasicSafetyMessage", gkFuncRefGet, result);

  return result;
}

int SetBasicSafetyMessageRegionalExtensionParams(LONG packetHandle, struct BasicSafetyMessageRegionalExtension value, char oldPath[])
{
  char newPath[300];
  int result;

  result = 0;


  return result;
}

int GetBasicSafetyMessageEventDescription_regionalParams(LONG packetHandle, struct BasicSafetyMessageEventDescription_regional value, char oldPath[])
{
  char newPath[300]; 
  int i;
  int result;

  result = 0;

  value.length = C2xGetTokenInt(packetHandle, "BasicSafetyMessage", oldPath);
  if((result = CheckLastError("BasicSafetyMessage", gkFuncRefGet, result))==0)
  {
    for(i=0; i<value.length; i++)
    {
      snprintf(newPath, elcount(newPath), "%s[%d]", oldPath, i);
      GetBasicSafetyMessageRegionalExtensionParams(packetHandle, value.arrayValue[i], newPath);
      result = CheckLastError("BasicSafetyMessage", gkFuncRefGet, result);
    }
  }
  return result;
}

int SetBasicSafetyMessageEventDescription_regionalParams(LONG packetHandle, struct BasicSafetyMessageEventDescription_regional value, char oldPath[])
{
  char newPath[300]; 
  int i;
  int result;

  result = 0;

  C2xRemoveToken(packetHandle, "BasicSafetyMessage", oldPath);
  for(i=0; i<value.length; i++)
  {
    snprintf(newPath, elcount(newPath), "%s[%d]", oldPath, i);
    SetBasicSafetyMessageRegionalExtensionParams(packetHandle, value.arrayValue[i], newPath);
    result = CheckLastError("BasicSafetyMessage", gkFuncRefGet, result);
  }
  return result;
}

int GetBasicSafetyMessageEventDescriptionParams(LONG packetHandle, struct BasicSafetyMessageEventDescription value, char oldPath[])
{
  char newPath[300]; 
  int j; 
  int k;
  int result;

  result = 0;

  snprintf(newPath, elcount(newPath), "%s.%s", oldPath, "typeEvent");
  value.typeEvent = C2xGetTokenInt(packetHandle, "BasicSafetyMessage", newPath);
  result = CheckLastError("BasicSafetyMessage", gkFuncRefGet, result);

  snprintf(newPath, elcount(newPath), "%s.%s", oldPath, "description");
  value.description.isValidFlag = C2xIsTokenAvailable(packetHandle, "BasicSafetyMessage", newPath);
  if(value.description.isValidFlag==1)
  {
    GetBasicSafetyMessageEventDescription_descriptionParams(packetHandle, value.description, newPath);
    result = CheckLastError("BasicSafetyMessage", gkFuncRefGet, result);
  }
  snprintf(newPath, elcount(newPath), "%s.%s", oldPath, "priority");
  value.priority.isValidFlag = C2xIsTokenAvailable(packetHandle, "BasicSafetyMessage", newPath);
  if(value.priority.isValidFlag==1)
  {
    value.priority.isValidFlag = 1;
    value.priority.stringLength = C2xGetTokenData(packetHandle, "BasicSafetyMessage", newPath, elcount(value.priority.string), value.priority.string);
  }
  snprintf(newPath, elcount(newPath), "%s.%s", oldPath, "heading");
  value.heading.isValidFlag = C2xIsTokenAvailable(packetHandle, "BasicSafetyMessage", newPath);
  if(value.heading.isValidFlag==1)
  {
    value.heading.isValidFlag = 1;
    value.heading.stringLength = C2xGetTokenLengthBit(packetHandle, "BasicSafetyMessage", newPath);
    if ((result = CheckLastError("BasicSafetyMessage", gkFuncRefGet, result))==0)
    {
      if(value.heading.stringLength > 0)
      {
        for(j=0; j<value.heading.stringLength; j++)
        {
          if(C2xGetTokenBitOfBitString(packetHandle, "BasicSafetyMessage", newPath, j) == 0)
          {
            value.heading.string[j] = '0';
          }
          else if(C2xGetTokenBitOfBitString(packetHandle, "BasicSafetyMessage", newPath, j) == 1)
          {
            value.heading.string[j] = '1';
          }

          if(value.heading.stringLength == 1)
          {
            value.heading.string[1] = '0';
          }
          result = CheckLastError("BasicSafetyMessage", gkFuncRefGet, result);
        }
      }
      else
      {
        for(k = value.heading.stringLength+1; k > -1; k--)
        {
          if(value.heading.string[k] == '1')
          {
            value.heading.string[k] = '0';
          }
        }
      }
    }

  }
  snprintf(newPath, elcount(newPath), "%s.%s", oldPath, "extent");
  value.extent.isValidFlag = C2xIsTokenAvailable(packetHandle, "BasicSafetyMessage", newPath);
  if(value.extent.isValidFlag==1)
  {
    value.extent.value = C2xGetTokenInt(packetHandle, "BasicSafetyMessage", newPath);
    result = CheckLastError("BasicSafetyMessage", gkFuncRefGet, result);
  }
  snprintf(newPath, elcount(newPath), "%s.%s", oldPath, "regional");
  value.regional.isValidFlag = C2xIsTokenAvailable(packetHandle, "BasicSafetyMessage", newPath);
  if(value.regional.isValidFlag==1)
  {
    GetBasicSafetyMessageEventDescription_regionalParams(packetHandle, value.regional, newPath);
    result = CheckLastError("BasicSafetyMessage", gkFuncRefGet, result);
  }
  return result;
}

int SetBasicSafetyMessageEventDescriptionParams(LONG packetHandle, struct BasicSafetyMessageEventDescription value, char oldPath[])
{
  char newPath[300]; 
  int j;
  int result;

  result = 0;

  snprintf(newPath, elcount(newPath), "%s.%s", oldPath, "typeEvent");
  C2xSetTokenInt(packetHandle, "BasicSafetyMessage", newPath, value.typeEvent);
  result = CheckLastError("BasicSafetyMessage", gkFuncRefGet, result);

  snprintf(newPath, elcount(newPath), "%s.%s", oldPath, "description");
  if(value.description.isValidFlag==1)
  {
    SetBasicSafetyMessageEventDescription_descriptionParams(packetHandle, value.description, newPath);
    result = CheckLastError("BasicSafetyMessage", gkFuncRefGet, result);
  }
  else
  {
    if( C2xIsTokenAvailable(packetHandle, "BasicSafetyMessage", newPath) )
    {
      C2xRemoveToken(packetHandle, "BasicSafetyMessage", newPath);
    }
  }

  snprintf(newPath, elcount(newPath), "%s.%s", oldPath, "priority");
  if(value.priority.isValidFlag==1)
  {
    C2xSetTokenData(packetHandle, "BasicSafetyMessage", newPath, value.priority.stringLength, value.priority.string);
  }
  else
  {
    if( C2xIsTokenAvailable(packetHandle, "BasicSafetyMessage", newPath) )
    {
      C2xRemoveToken(packetHandle, "BasicSafetyMessage", newPath);
    }
  }

  snprintf(newPath, elcount(newPath), "%s.%s", oldPath, "heading");
  if(value.heading.isValidFlag==1)
  {
      for(j=0; j<value.heading.stringLength; j++)
      {
        if(value.heading.string[j] == '0')
        {
          C2xSetTokenBitOfBitString(packetHandle, "BasicSafetyMessage", newPath, j, 0);
        }
        else
        {
          C2xSetTokenBitOfBitString(packetHandle, "BasicSafetyMessage", newPath, j, 1);
        }
        result = CheckLastError("BasicSafetyMessage", gkFuncRefGet, result);
      }
  }
  else
  {
    if( C2xIsTokenAvailable(packetHandle, "BasicSafetyMessage", newPath) )
    {
      C2xRemoveToken(packetHandle, "BasicSafetyMessage", newPath);
    }
  }

  snprintf(newPath, elcount(newPath), "%s.%s", oldPath, "extent");
  if(value.extent.isValidFlag==1)
  {
    C2xSetTokenInt(packetHandle, "BasicSafetyMessage", newPath, value.extent.value);
    result = CheckLastError("BasicSafetyMessage", gkFuncRefGet, result);
  }
  else
  {
    if( C2xIsTokenAvailable(packetHandle, "BasicSafetyMessage", newPath) )
    {
      C2xRemoveToken(packetHandle, "BasicSafetyMessage", newPath);
    }
  }

  snprintf(newPath, elcount(newPath), "%s.%s", oldPath, "regional");
  if(value.regional.isValidFlag==1)
  {
    SetBasicSafetyMessageEventDescription_regionalParams(packetHandle, value.regional, newPath);
    result = CheckLastError("BasicSafetyMessage", gkFuncRefGet, result);
  }
  else
  {
    if( C2xIsTokenAvailable(packetHandle, "BasicSafetyMessage", newPath) )
    {
      C2xRemoveToken(packetHandle, "BasicSafetyMessage", newPath);
    }
  }

  return result;
}

int GetBasicSafetyMessagePivotPointDescriptionParams(LONG packetHandle, struct BasicSafetyMessagePivotPointDescription value, char oldPath[])
{
  char newPath[300];
  int result;

  result = 0;

  snprintf(newPath, elcount(newPath), "%s.%s", oldPath, "pivotOffset");
  value.pivotOffset = C2xGetTokenInt(packetHandle, "BasicSafetyMessage", newPath);
  result = CheckLastError("BasicSafetyMessage", gkFuncRefGet, result);

  snprintf(newPath, elcount(newPath), "%s.%s", oldPath, "pivotAngle");
  value.pivotAngle = C2xGetTokenInt(packetHandle, "BasicSafetyMessage", newPath);
  result = CheckLastError("BasicSafetyMessage", gkFuncRefGet, result);

  snprintf(newPath, elcount(newPath), "%s.%s", oldPath, "pivots");
  value.pivots = C2xGetTokenInt64(packetHandle, "BasicSafetyMessage", newPath);
  result = CheckLastError("BasicSafetyMessage", gkFuncRefGet, result);

  return result;
}

int SetBasicSafetyMessagePivotPointDescriptionParams(LONG packetHandle, struct BasicSafetyMessagePivotPointDescription value, char oldPath[])
{
  char newPath[300];
  int result;

  result = 0;

  snprintf(newPath, elcount(newPath), "%s.%s", oldPath, "pivotOffset");
  C2xSetTokenInt(packetHandle, "BasicSafetyMessage", newPath, value.pivotOffset);
  result = CheckLastError("BasicSafetyMessage", gkFuncRefGet, result);

  snprintf(newPath, elcount(newPath), "%s.%s", oldPath, "pivotAngle");
  C2xSetTokenInt(packetHandle, "BasicSafetyMessage", newPath, value.pivotAngle);
  result = CheckLastError("BasicSafetyMessage", gkFuncRefGet, result);

  snprintf(newPath, elcount(newPath), "%s.%s", oldPath, "pivots");
  C2xSetTokenInt64(packetHandle, "BasicSafetyMessage", newPath, value.pivots);
  result = CheckLastError("BasicSafetyMessage", gkFuncRefGet, result);

  return result;
}

int GetBasicSafetyMessageBumperHeightsParams(LONG packetHandle, struct BasicSafetyMessageBumperHeights value, char oldPath[])
{
  char newPath[300];
  int result;

  result = 0;

  snprintf(newPath, elcount(newPath), "%s.%s", oldPath, "front");
  value.front = C2xGetTokenInt(packetHandle, "BasicSafetyMessage", newPath);
  result = CheckLastError("BasicSafetyMessage", gkFuncRefGet, result);

  snprintf(newPath, elcount(newPath), "%s.%s", oldPath, "rear");
  value.rear = C2xGetTokenInt(packetHandle, "BasicSafetyMessage", newPath);
  result = CheckLastError("BasicSafetyMessage", gkFuncRefGet, result);

  return result;
}

int SetBasicSafetyMessageBumperHeightsParams(LONG packetHandle, struct BasicSafetyMessageBumperHeights value, char oldPath[])
{
  char newPath[300];
  int result;

  result = 0;

  snprintf(newPath, elcount(newPath), "%s.%s", oldPath, "front");
  C2xSetTokenInt(packetHandle, "BasicSafetyMessage", newPath, value.front);
  result = CheckLastError("BasicSafetyMessage", gkFuncRefGet, result);

  snprintf(newPath, elcount(newPath), "%s.%s", oldPath, "rear");
  C2xSetTokenInt(packetHandle, "BasicSafetyMessage", newPath, value.rear);
  result = CheckLastError("BasicSafetyMessage", gkFuncRefGet, result);

  return result;
}

int GetBasicSafetyMessageNode_XY_24bParams(LONG packetHandle, struct BasicSafetyMessageNode_XY_24b value, char oldPath[])
{
  char newPath[300];
  int result;

  result = 0;

  snprintf(newPath, elcount(newPath), "%s.%s", oldPath, "x");
  value.x = C2xGetTokenInt(packetHandle, "BasicSafetyMessage", newPath);
  result = CheckLastError("BasicSafetyMessage", gkFuncRefGet, result);

  snprintf(newPath, elcount(newPath), "%s.%s", oldPath, "y");
  value.y = C2xGetTokenInt(packetHandle, "BasicSafetyMessage", newPath);
  result = CheckLastError("BasicSafetyMessage", gkFuncRefGet, result);

  return result;
}

int SetBasicSafetyMessageNode_XY_24bParams(LONG packetHandle, struct BasicSafetyMessageNode_XY_24b value, char oldPath[])
{
  char newPath[300];
  int result;

  result = 0;

  snprintf(newPath, elcount(newPath), "%s.%s", oldPath, "x");
  C2xSetTokenInt(packetHandle, "BasicSafetyMessage", newPath, value.x);
  result = CheckLastError("BasicSafetyMessage", gkFuncRefGet, result);

  snprintf(newPath, elcount(newPath), "%s.%s", oldPath, "y");
  C2xSetTokenInt(packetHandle, "BasicSafetyMessage", newPath, value.y);
  result = CheckLastError("BasicSafetyMessage", gkFuncRefGet, result);

  return result;
}

int GetBasicSafetyMessageTrailerHistoryPointParams(LONG packetHandle, struct BasicSafetyMessageTrailerHistoryPoint value, char oldPath[])
{
  char newPath[300];
  int result;

  result = 0;

  snprintf(newPath, elcount(newPath), "%s.%s", oldPath, "pivotAngle");
  value.pivotAngle = C2xGetTokenInt(packetHandle, "BasicSafetyMessage", newPath);
  result = CheckLastError("BasicSafetyMessage", gkFuncRefGet, result);

  snprintf(newPath, elcount(newPath), "%s.%s", oldPath, "timeOffset");
  value.timeOffset = C2xGetTokenInt(packetHandle, "BasicSafetyMessage", newPath);
  result = CheckLastError("BasicSafetyMessage", gkFuncRefGet, result);

  snprintf(newPath, elcount(newPath), "%s.%s", oldPath, "positionOffset");
  GetBasicSafetyMessageNode_XY_24bParams(packetHandle, value.positionOffset, newPath);
  result = CheckLastError("BasicSafetyMessage", gkFuncRefGet, result);

  snprintf(newPath, elcount(newPath), "%s.%s", oldPath, "elevationOffset");
  value.elevationOffset.isValidFlag = C2xIsTokenAvailable(packetHandle, "BasicSafetyMessage", newPath);
  if(value.elevationOffset.isValidFlag==1)
  {
    value.elevationOffset.value = C2xGetTokenInt(packetHandle, "BasicSafetyMessage", newPath);
    result = CheckLastError("BasicSafetyMessage", gkFuncRefGet, result);
  }
  snprintf(newPath, elcount(newPath), "%s.%s", oldPath, "heading");
  value.heading.isValidFlag = C2xIsTokenAvailable(packetHandle, "BasicSafetyMessage", newPath);
  if(value.heading.isValidFlag==1)
  {
    value.heading.value = C2xGetTokenInt(packetHandle, "BasicSafetyMessage", newPath);
    result = CheckLastError("BasicSafetyMessage", gkFuncRefGet, result);
  }
  return result;
}

int SetBasicSafetyMessageTrailerHistoryPointParams(LONG packetHandle, struct BasicSafetyMessageTrailerHistoryPoint value, char oldPath[])
{
  char newPath[300];
  int result;

  result = 0;

  snprintf(newPath, elcount(newPath), "%s.%s", oldPath, "pivotAngle");
  C2xSetTokenInt(packetHandle, "BasicSafetyMessage", newPath, value.pivotAngle);
  result = CheckLastError("BasicSafetyMessage", gkFuncRefGet, result);

  snprintf(newPath, elcount(newPath), "%s.%s", oldPath, "timeOffset");
  if (value.timeOffset < 1)
  {
    C2xSetTokenInt(packetHandle, "BasicSafetyMessage", newPath, 1);
  }
  else if (value.timeOffset > 65535)
  {
    C2xSetTokenInt(packetHandle, "BasicSafetyMessage", newPath, 65535);
  }
  else
  {
    C2xSetTokenInt(packetHandle, "BasicSafetyMessage", newPath, value.timeOffset);
  }
  result = CheckLastError("BasicSafetyMessage", gkFuncRefGet, result);

  snprintf(newPath, elcount(newPath), "%s.%s", oldPath, "positionOffset");
  SetBasicSafetyMessageNode_XY_24bParams(packetHandle, value.positionOffset, newPath);
  result = CheckLastError("BasicSafetyMessage", gkFuncRefGet, result);

  snprintf(newPath, elcount(newPath), "%s.%s", oldPath, "elevationOffset");
  if(value.elevationOffset.isValidFlag==1)
  {
    C2xSetTokenInt(packetHandle, "BasicSafetyMessage", newPath, value.elevationOffset.value);
    result = CheckLastError("BasicSafetyMessage", gkFuncRefGet, result);
  }
  else
  {
    if( C2xIsTokenAvailable(packetHandle, "BasicSafetyMessage", newPath) )
    {
      C2xRemoveToken(packetHandle, "BasicSafetyMessage", newPath);
    }
  }

  snprintf(newPath, elcount(newPath), "%s.%s", oldPath, "heading");
  if(value.heading.isValidFlag==1)
  {
    C2xSetTokenInt(packetHandle, "BasicSafetyMessage", newPath, value.heading.value);
    result = CheckLastError("BasicSafetyMessage", gkFuncRefGet, result);
  }
  else
  {
    if( C2xIsTokenAvailable(packetHandle, "BasicSafetyMessage", newPath) )
    {
      C2xRemoveToken(packetHandle, "BasicSafetyMessage", newPath);
    }
  }

  return result;
}

int GetBasicSafetyMessageTrailerHistoryPointListParams(LONG packetHandle, struct BasicSafetyMessageTrailerHistoryPointList value, char oldPath[])
{
  char newPath[300]; 
  int i;
  int result;

  result = 0;

  value.length = C2xGetTokenInt(packetHandle, "BasicSafetyMessage", oldPath);
  if((result = CheckLastError("BasicSafetyMessage", gkFuncRefGet, result))==0)
  {
    for(i=0; i<value.length; i++)
    {
      snprintf(newPath, elcount(newPath), "%s[%d]", oldPath, i);
      GetBasicSafetyMessageTrailerHistoryPointParams(packetHandle, value.arrayValue[i], newPath);
      result = CheckLastError("BasicSafetyMessage", gkFuncRefGet, result);
    }
  }
  return result;
}

int SetBasicSafetyMessageTrailerHistoryPointListParams(LONG packetHandle, struct BasicSafetyMessageTrailerHistoryPointList value, char oldPath[])
{
  char newPath[300]; 
  int i;
  int result;

  result = 0;

  C2xRemoveToken(packetHandle, "BasicSafetyMessage", oldPath);
  for(i=0; i<value.length; i++)
  {
    snprintf(newPath, elcount(newPath), "%s[%d]", oldPath, i);
    SetBasicSafetyMessageTrailerHistoryPointParams(packetHandle, value.arrayValue[i], newPath);
    result = CheckLastError("BasicSafetyMessage", gkFuncRefGet, result);
  }
  return result;
}

int GetBasicSafetyMessageTrailerUnitDescriptionParams(LONG packetHandle, struct BasicSafetyMessageTrailerUnitDescription value, char oldPath[])
{
  char newPath[300];
  int result;

  result = 0;

  snprintf(newPath, elcount(newPath), "%s.%s", oldPath, "isDolly");
  value.isDolly = C2xGetTokenInt64(packetHandle, "BasicSafetyMessage", newPath);
  result = CheckLastError("BasicSafetyMessage", gkFuncRefGet, result);

  snprintf(newPath, elcount(newPath), "%s.%s", oldPath, "width");
  value.width = C2xGetTokenInt(packetHandle, "BasicSafetyMessage", newPath);
  result = CheckLastError("BasicSafetyMessage", gkFuncRefGet, result);

  snprintf(newPath, elcount(newPath), "%s.%s", oldPath, "length");
  value.length = C2xGetTokenInt(packetHandle, "BasicSafetyMessage", newPath);
  result = CheckLastError("BasicSafetyMessage", gkFuncRefGet, result);

  snprintf(newPath, elcount(newPath), "%s.%s", oldPath, "height");
  value.height.isValidFlag = C2xIsTokenAvailable(packetHandle, "BasicSafetyMessage", newPath);
  if(value.height.isValidFlag==1)
  {
    value.height.value = C2xGetTokenInt(packetHandle, "BasicSafetyMessage", newPath);
    result = CheckLastError("BasicSafetyMessage", gkFuncRefGet, result);
  }
  snprintf(newPath, elcount(newPath), "%s.%s", oldPath, "mass");
  value.mass.isValidFlag = C2xIsTokenAvailable(packetHandle, "BasicSafetyMessage", newPath);
  if(value.mass.isValidFlag==1)
  {
    value.mass.value = C2xGetTokenInt(packetHandle, "BasicSafetyMessage", newPath);
    result = CheckLastError("BasicSafetyMessage", gkFuncRefGet, result);
  }
  snprintf(newPath, elcount(newPath), "%s.%s", oldPath, "bumperHeights");
  value.bumperHeights.isValidFlag = C2xIsTokenAvailable(packetHandle, "BasicSafetyMessage", newPath);
  if(value.bumperHeights.isValidFlag==1)
  {
    GetBasicSafetyMessageBumperHeightsParams(packetHandle, value.bumperHeights, newPath);
    result = CheckLastError("BasicSafetyMessage", gkFuncRefGet, result);
  }
  snprintf(newPath, elcount(newPath), "%s.%s", oldPath, "centerOfGravity");
  value.centerOfGravity.isValidFlag = C2xIsTokenAvailable(packetHandle, "BasicSafetyMessage", newPath);
  if(value.centerOfGravity.isValidFlag==1)
  {
    value.centerOfGravity.value = C2xGetTokenInt(packetHandle, "BasicSafetyMessage", newPath);
    result = CheckLastError("BasicSafetyMessage", gkFuncRefGet, result);
  }
  snprintf(newPath, elcount(newPath), "%s.%s", oldPath, "frontPivot");
  GetBasicSafetyMessagePivotPointDescriptionParams(packetHandle, value.frontPivot, newPath);
  result = CheckLastError("BasicSafetyMessage", gkFuncRefGet, result);

  snprintf(newPath, elcount(newPath), "%s.%s", oldPath, "rearPivot");
  value.rearPivot.isValidFlag = C2xIsTokenAvailable(packetHandle, "BasicSafetyMessage", newPath);
  if(value.rearPivot.isValidFlag==1)
  {
    GetBasicSafetyMessagePivotPointDescriptionParams(packetHandle, value.rearPivot, newPath);
    result = CheckLastError("BasicSafetyMessage", gkFuncRefGet, result);
  }
  snprintf(newPath, elcount(newPath), "%s.%s", oldPath, "rearWheelOffset");
  value.rearWheelOffset.isValidFlag = C2xIsTokenAvailable(packetHandle, "BasicSafetyMessage", newPath);
  if(value.rearWheelOffset.isValidFlag==1)
  {
    value.rearWheelOffset.value = C2xGetTokenInt(packetHandle, "BasicSafetyMessage", newPath);
    result = CheckLastError("BasicSafetyMessage", gkFuncRefGet, result);
  }
  snprintf(newPath, elcount(newPath), "%s.%s", oldPath, "positionOffset");
  GetBasicSafetyMessageNode_XY_24bParams(packetHandle, value.positionOffset, newPath);
  result = CheckLastError("BasicSafetyMessage", gkFuncRefGet, result);

  snprintf(newPath, elcount(newPath), "%s.%s", oldPath, "elevationOffset");
  value.elevationOffset.isValidFlag = C2xIsTokenAvailable(packetHandle, "BasicSafetyMessage", newPath);
  if(value.elevationOffset.isValidFlag==1)
  {
    value.elevationOffset.value = C2xGetTokenInt(packetHandle, "BasicSafetyMessage", newPath);
    result = CheckLastError("BasicSafetyMessage", gkFuncRefGet, result);
  }
  snprintf(newPath, elcount(newPath), "%s.%s", oldPath, "crumbData");
  value.crumbData.isValidFlag = C2xIsTokenAvailable(packetHandle, "BasicSafetyMessage", newPath);
  if(value.crumbData.isValidFlag==1)
  {
    GetBasicSafetyMessageTrailerHistoryPointListParams(packetHandle, value.crumbData, newPath);
    result = CheckLastError("BasicSafetyMessage", gkFuncRefGet, result);
  }
  return result;
}

int SetBasicSafetyMessageTrailerUnitDescriptionParams(LONG packetHandle, struct BasicSafetyMessageTrailerUnitDescription value, char oldPath[])
{
  char newPath[300];
  int result;

  result = 0;

  snprintf(newPath, elcount(newPath), "%s.%s", oldPath, "isDolly");
  C2xSetTokenInt64(packetHandle, "BasicSafetyMessage", newPath, value.isDolly);
  result = CheckLastError("BasicSafetyMessage", gkFuncRefGet, result);

  snprintf(newPath, elcount(newPath), "%s.%s", oldPath, "width");
  C2xSetTokenInt(packetHandle, "BasicSafetyMessage", newPath, value.width);
  result = CheckLastError("BasicSafetyMessage", gkFuncRefGet, result);

  snprintf(newPath, elcount(newPath), "%s.%s", oldPath, "length");
  C2xSetTokenInt(packetHandle, "BasicSafetyMessage", newPath, value.length);
  result = CheckLastError("BasicSafetyMessage", gkFuncRefGet, result);

  snprintf(newPath, elcount(newPath), "%s.%s", oldPath, "height");
  if(value.height.isValidFlag==1)
  {
    C2xSetTokenInt(packetHandle, "BasicSafetyMessage", newPath, value.height.value);
    result = CheckLastError("BasicSafetyMessage", gkFuncRefGet, result);
  }
  else
  {
    if( C2xIsTokenAvailable(packetHandle, "BasicSafetyMessage", newPath) )
    {
      C2xRemoveToken(packetHandle, "BasicSafetyMessage", newPath);
    }
  }

  snprintf(newPath, elcount(newPath), "%s.%s", oldPath, "mass");
  if(value.mass.isValidFlag==1)
  {
    C2xSetTokenInt(packetHandle, "BasicSafetyMessage", newPath, value.mass.value);
    result = CheckLastError("BasicSafetyMessage", gkFuncRefGet, result);
  }
  else
  {
    if( C2xIsTokenAvailable(packetHandle, "BasicSafetyMessage", newPath) )
    {
      C2xRemoveToken(packetHandle, "BasicSafetyMessage", newPath);
    }
  }

  snprintf(newPath, elcount(newPath), "%s.%s", oldPath, "bumperHeights");
  if(value.bumperHeights.isValidFlag==1)
  {
    SetBasicSafetyMessageBumperHeightsParams(packetHandle, value.bumperHeights, newPath);
    result = CheckLastError("BasicSafetyMessage", gkFuncRefGet, result);
  }
  else
  {
    if( C2xIsTokenAvailable(packetHandle, "BasicSafetyMessage", newPath) )
    {
      C2xRemoveToken(packetHandle, "BasicSafetyMessage", newPath);
    }
  }

  snprintf(newPath, elcount(newPath), "%s.%s", oldPath, "centerOfGravity");
  if(value.centerOfGravity.isValidFlag==1)
  {
    C2xSetTokenInt(packetHandle, "BasicSafetyMessage", newPath, value.centerOfGravity.value);
    result = CheckLastError("BasicSafetyMessage", gkFuncRefGet, result);
  }
  else
  {
    if( C2xIsTokenAvailable(packetHandle, "BasicSafetyMessage", newPath) )
    {
      C2xRemoveToken(packetHandle, "BasicSafetyMessage", newPath);
    }
  }

  snprintf(newPath, elcount(newPath), "%s.%s", oldPath, "frontPivot");
  SetBasicSafetyMessagePivotPointDescriptionParams(packetHandle, value.frontPivot, newPath);
  result = CheckLastError("BasicSafetyMessage", gkFuncRefGet, result);

  snprintf(newPath, elcount(newPath), "%s.%s", oldPath, "rearPivot");
  if(value.rearPivot.isValidFlag==1)
  {
    SetBasicSafetyMessagePivotPointDescriptionParams(packetHandle, value.rearPivot, newPath);
    result = CheckLastError("BasicSafetyMessage", gkFuncRefGet, result);
  }
  else
  {
    if( C2xIsTokenAvailable(packetHandle, "BasicSafetyMessage", newPath) )
    {
      C2xRemoveToken(packetHandle, "BasicSafetyMessage", newPath);
    }
  }

  snprintf(newPath, elcount(newPath), "%s.%s", oldPath, "rearWheelOffset");
  if(value.rearWheelOffset.isValidFlag==1)
  {
    C2xSetTokenInt(packetHandle, "BasicSafetyMessage", newPath, value.rearWheelOffset.value);
    result = CheckLastError("BasicSafetyMessage", gkFuncRefGet, result);
  }
  else
  {
    if( C2xIsTokenAvailable(packetHandle, "BasicSafetyMessage", newPath) )
    {
      C2xRemoveToken(packetHandle, "BasicSafetyMessage", newPath);
    }
  }

  snprintf(newPath, elcount(newPath), "%s.%s", oldPath, "positionOffset");
  SetBasicSafetyMessageNode_XY_24bParams(packetHandle, value.positionOffset, newPath);
  result = CheckLastError("BasicSafetyMessage", gkFuncRefGet, result);

  snprintf(newPath, elcount(newPath), "%s.%s", oldPath, "elevationOffset");
  if(value.elevationOffset.isValidFlag==1)
  {
    C2xSetTokenInt(packetHandle, "BasicSafetyMessage", newPath, value.elevationOffset.value);
    result = CheckLastError("BasicSafetyMessage", gkFuncRefGet, result);
  }
  else
  {
    if( C2xIsTokenAvailable(packetHandle, "BasicSafetyMessage", newPath) )
    {
      C2xRemoveToken(packetHandle, "BasicSafetyMessage", newPath);
    }
  }

  snprintf(newPath, elcount(newPath), "%s.%s", oldPath, "crumbData");
  if(value.crumbData.isValidFlag==1)
  {
    SetBasicSafetyMessageTrailerHistoryPointListParams(packetHandle, value.crumbData, newPath);
    result = CheckLastError("BasicSafetyMessage", gkFuncRefGet, result);
  }
  else
  {
    if( C2xIsTokenAvailable(packetHandle, "BasicSafetyMessage", newPath) )
    {
      C2xRemoveToken(packetHandle, "BasicSafetyMessage", newPath);
    }
  }

  return result;
}

int GetBasicSafetyMessageTrailerUnitDescriptionListParams(LONG packetHandle, struct BasicSafetyMessageTrailerUnitDescriptionList value, char oldPath[])
{
  char newPath[300]; 
  int i;
  int result;

  result = 0;

  value.length = C2xGetTokenInt(packetHandle, "BasicSafetyMessage", oldPath);
  if((result = CheckLastError("BasicSafetyMessage", gkFuncRefGet, result))==0)
  {
    for(i=0; i<value.length; i++)
    {
      snprintf(newPath, elcount(newPath), "%s[%d]", oldPath, i);
      GetBasicSafetyMessageTrailerUnitDescriptionParams(packetHandle, value.arrayValue[i], newPath);
      result = CheckLastError("BasicSafetyMessage", gkFuncRefGet, result);
    }
  }
  return result;
}

int SetBasicSafetyMessageTrailerUnitDescriptionListParams(LONG packetHandle, struct BasicSafetyMessageTrailerUnitDescriptionList value, char oldPath[])
{
  char newPath[300]; 
  int i;
  int result;

  result = 0;

  C2xRemoveToken(packetHandle, "BasicSafetyMessage", oldPath);
  for(i=0; i<value.length; i++)
  {
    snprintf(newPath, elcount(newPath), "%s[%d]", oldPath, i);
    SetBasicSafetyMessageTrailerUnitDescriptionParams(packetHandle, value.arrayValue[i], newPath);
    result = CheckLastError("BasicSafetyMessage", gkFuncRefGet, result);
  }
  return result;
}

int GetBasicSafetyMessageTrailerDataParams(LONG packetHandle, struct BasicSafetyMessageTrailerData value, char oldPath[])
{
  char newPath[300];
  int result;

  result = 0;

  snprintf(newPath, elcount(newPath), "%s.%s", oldPath, "doNotUse");
  value.doNotUse = C2xGetTokenInt(packetHandle, "BasicSafetyMessage", newPath);
  result = CheckLastError("BasicSafetyMessage", gkFuncRefGet, result);

  snprintf(newPath, elcount(newPath), "%s.%s", oldPath, "connection");
  GetBasicSafetyMessagePivotPointDescriptionParams(packetHandle, value.connection, newPath);
  result = CheckLastError("BasicSafetyMessage", gkFuncRefGet, result);

  snprintf(newPath, elcount(newPath), "%s.%s", oldPath, "units");
  GetBasicSafetyMessageTrailerUnitDescriptionListParams(packetHandle, value.units, newPath);
  result = CheckLastError("BasicSafetyMessage", gkFuncRefGet, result);

  return result;
}

int SetBasicSafetyMessageTrailerDataParams(LONG packetHandle, struct BasicSafetyMessageTrailerData value, char oldPath[])
{
  char newPath[300];
  int result;

  result = 0;

  snprintf(newPath, elcount(newPath), "%s.%s", oldPath, "doNotUse");
  C2xSetTokenInt(packetHandle, "BasicSafetyMessage", newPath, value.doNotUse);
  result = CheckLastError("BasicSafetyMessage", gkFuncRefGet, result);

  snprintf(newPath, elcount(newPath), "%s.%s", oldPath, "connection");
  SetBasicSafetyMessagePivotPointDescriptionParams(packetHandle, value.connection, newPath);
  result = CheckLastError("BasicSafetyMessage", gkFuncRefGet, result);

  snprintf(newPath, elcount(newPath), "%s.%s", oldPath, "units");
  SetBasicSafetyMessageTrailerUnitDescriptionListParams(packetHandle, value.units, newPath);
  result = CheckLastError("BasicSafetyMessage", gkFuncRefGet, result);

  return result;
}

int GetBasicSafetyMessageSpecialVehicleExtensionsParams(LONG packetHandle, struct BasicSafetyMessageSpecialVehicleExtensions value, char oldPath[])
{
  char newPath[300];
  int result;

  result = 0;

  snprintf(newPath, elcount(newPath), "%s.%s", oldPath, "vehicleAlerts");
  value.vehicleAlerts.isValidFlag = C2xIsTokenAvailable(packetHandle, "BasicSafetyMessage", newPath);
  if(value.vehicleAlerts.isValidFlag==1)
  {
    GetBasicSafetyMessageEmergencyDetailsParams(packetHandle, value.vehicleAlerts, newPath);
    result = CheckLastError("BasicSafetyMessage", gkFuncRefGet, result);
  }
  snprintf(newPath, elcount(newPath), "%s.%s", oldPath, "description");
  value.description.isValidFlag = C2xIsTokenAvailable(packetHandle, "BasicSafetyMessage", newPath);
  if(value.description.isValidFlag==1)
  {
    GetBasicSafetyMessageEventDescriptionParams(packetHandle, value.description, newPath);
    result = CheckLastError("BasicSafetyMessage", gkFuncRefGet, result);
  }
  snprintf(newPath, elcount(newPath), "%s.%s", oldPath, "doNotUse");
  value.doNotUse.isValidFlag = C2xIsTokenAvailable(packetHandle, "BasicSafetyMessage", newPath);
  if(value.doNotUse.isValidFlag==1)
  {
    GetBasicSafetyMessageTrailerDataParams(packetHandle, value.doNotUse, newPath);
    result = CheckLastError("BasicSafetyMessage", gkFuncRefGet, result);
  }
  return result;
}

int SetBasicSafetyMessageSpecialVehicleExtensionsParams(LONG packetHandle, struct BasicSafetyMessageSpecialVehicleExtensions value, char oldPath[])
{
  char newPath[300];
  int result;

  result = 0;

  snprintf(newPath, elcount(newPath), "%s.%s", oldPath, "vehicleAlerts");
  if(value.vehicleAlerts.isValidFlag==1)
  {
    SetBasicSafetyMessageEmergencyDetailsParams(packetHandle, value.vehicleAlerts, newPath);
    result = CheckLastError("BasicSafetyMessage", gkFuncRefGet, result);
  }
  else
  {
    if( C2xIsTokenAvailable(packetHandle, "BasicSafetyMessage", newPath) )
    {
      C2xRemoveToken(packetHandle, "BasicSafetyMessage", newPath);
    }
  }

  snprintf(newPath, elcount(newPath), "%s.%s", oldPath, "description");
  if(value.description.isValidFlag==1)
  {
    SetBasicSafetyMessageEventDescriptionParams(packetHandle, value.description, newPath);
    result = CheckLastError("BasicSafetyMessage", gkFuncRefGet, result);
  }
  else
  {
    if( C2xIsTokenAvailable(packetHandle, "BasicSafetyMessage", newPath) )
    {
      C2xRemoveToken(packetHandle, "BasicSafetyMessage", newPath);
    }
  }

  snprintf(newPath, elcount(newPath), "%s.%s", oldPath, "doNotUse");
  if(value.doNotUse.isValidFlag==1)
  {
    SetBasicSafetyMessageTrailerDataParams(packetHandle, value.doNotUse, newPath);
    result = CheckLastError("BasicSafetyMessage", gkFuncRefGet, result);
  }
  else
  {
    if( C2xIsTokenAvailable(packetHandle, "BasicSafetyMessage", newPath) )
    {
      C2xRemoveToken(packetHandle, "BasicSafetyMessage", newPath);
    }
  }

  return result;
}

int GetBasicSafetyMessageRegionalExtension_Reg_VehicleClassificationParams(LONG packetHandle, struct BasicSafetyMessageRegionalExtension_Reg_VehicleClassification value, char oldPath[])
{
  char newPath[300];
  int result;

  result = 0;

  snprintf(newPath, elcount(newPath), "%s.%s", oldPath, "regionId");
  value.regionId = C2xGetTokenInt(packetHandle, "BasicSafetyMessage", newPath);
  result = CheckLastError("BasicSafetyMessage", gkFuncRefGet, result);

  return result;
}

int SetBasicSafetyMessageRegionalExtension_Reg_VehicleClassificationParams(LONG packetHandle, struct BasicSafetyMessageRegionalExtension_Reg_VehicleClassification value, char oldPath[])
{
  char newPath[300];
  int result;

  result = 0;


  return result;
}

int GetBasicSafetyMessageVehicleClassification_regionalParams(LONG packetHandle, struct BasicSafetyMessageVehicleClassification_regional value, char oldPath[])
{
  char newPath[300]; 
  int i;
  int result;

  result = 0;

  value.length = C2xGetTokenInt(packetHandle, "BasicSafetyMessage", oldPath);
  if((result = CheckLastError("BasicSafetyMessage", gkFuncRefGet, result))==0)
  {
    for(i=0; i<value.length; i++)
    {
      snprintf(newPath, elcount(newPath), "%s[%d]", oldPath, i);
      GetBasicSafetyMessageRegionalExtension_Reg_VehicleClassificationParams(packetHandle, value.arrayValue[i], newPath);
      result = CheckLastError("BasicSafetyMessage", gkFuncRefGet, result);
    }
  }
  return result;
}

int SetBasicSafetyMessageVehicleClassification_regionalParams(LONG packetHandle, struct BasicSafetyMessageVehicleClassification_regional value, char oldPath[])
{
  char newPath[300]; 
  int i;
  int result;

  result = 0;

  C2xRemoveToken(packetHandle, "BasicSafetyMessage", oldPath);
  for(i=0; i<value.length; i++)
  {
    snprintf(newPath, elcount(newPath), "%s[%d]", oldPath, i);
    SetBasicSafetyMessageRegionalExtension_Reg_VehicleClassificationParams(packetHandle, value.arrayValue[i], newPath);
    result = CheckLastError("BasicSafetyMessage", gkFuncRefGet, result);
  }
  return result;
}

int GetBasicSafetyMessageVehicleClassificationParams(LONG packetHandle, struct BasicSafetyMessageVehicleClassification value, char oldPath[])
{
  char newPath[300];
  int result;

  result = 0;

  snprintf(newPath, elcount(newPath), "%s.%s", oldPath, "keyType");
  value.keyType.isValidFlag = C2xIsTokenAvailable(packetHandle, "BasicSafetyMessage", newPath);
  if(value.keyType.isValidFlag==1)
  {
    value.keyType.value = C2xGetTokenInt(packetHandle, "BasicSafetyMessage", newPath);
    result = CheckLastError("BasicSafetyMessage", gkFuncRefGet, result);
  }
  snprintf(newPath, elcount(newPath), "%s.%s", oldPath, "role");
  value.role.isValidFlag = C2xIsTokenAvailable(packetHandle, "BasicSafetyMessage", newPath);
  if(value.role.isValidFlag==1)
  {
    value.role.value = C2xGetTokenInt(packetHandle, "BasicSafetyMessage", newPath);
    result = CheckLastError("BasicSafetyMessage", gkFuncRefGet, result);
  }
  snprintf(newPath, elcount(newPath), "%s.%s", oldPath, "iso3883");
  value.iso3883.isValidFlag = C2xIsTokenAvailable(packetHandle, "BasicSafetyMessage", newPath);
  if(value.iso3883.isValidFlag==1)
  {
    value.iso3883.value = C2xGetTokenInt(packetHandle, "BasicSafetyMessage", newPath);
    result = CheckLastError("BasicSafetyMessage", gkFuncRefGet, result);
  }
  snprintf(newPath, elcount(newPath), "%s.%s", oldPath, "hpmsType");
  value.hpmsType.isValidFlag = C2xIsTokenAvailable(packetHandle, "BasicSafetyMessage", newPath);
  if(value.hpmsType.isValidFlag==1)
  {
    value.hpmsType.value = C2xGetTokenInt(packetHandle, "BasicSafetyMessage", newPath);
    result = CheckLastError("BasicSafetyMessage", gkFuncRefGet, result);
  }
  snprintf(newPath, elcount(newPath), "%s.%s", oldPath, "vehicleType");
  value.vehicleType.isValidFlag = C2xIsTokenAvailable(packetHandle, "BasicSafetyMessage", newPath);
  if(value.vehicleType.isValidFlag==1)
  {
    value.vehicleType.value = C2xGetTokenInt(packetHandle, "BasicSafetyMessage", newPath);
    result = CheckLastError("BasicSafetyMessage", gkFuncRefGet, result);
  }
  snprintf(newPath, elcount(newPath), "%s.%s", oldPath, "responseEquip");
  value.responseEquip.isValidFlag = C2xIsTokenAvailable(packetHandle, "BasicSafetyMessage", newPath);
  if(value.responseEquip.isValidFlag==1)
  {
    value.responseEquip.value = C2xGetTokenInt(packetHandle, "BasicSafetyMessage", newPath);
    result = CheckLastError("BasicSafetyMessage", gkFuncRefGet, result);
  }
  snprintf(newPath, elcount(newPath), "%s.%s", oldPath, "responderType");
  value.responderType.isValidFlag = C2xIsTokenAvailable(packetHandle, "BasicSafetyMessage", newPath);
  if(value.responderType.isValidFlag==1)
  {
    value.responderType.value = C2xGetTokenInt(packetHandle, "BasicSafetyMessage", newPath);
    result = CheckLastError("BasicSafetyMessage", gkFuncRefGet, result);
  }
  snprintf(newPath, elcount(newPath), "%s.%s", oldPath, "fuelType");
  value.fuelType.isValidFlag = C2xIsTokenAvailable(packetHandle, "BasicSafetyMessage", newPath);
  if(value.fuelType.isValidFlag==1)
  {
    value.fuelType.value = C2xGetTokenInt(packetHandle, "BasicSafetyMessage", newPath);
    result = CheckLastError("BasicSafetyMessage", gkFuncRefGet, result);
  }
  snprintf(newPath, elcount(newPath), "%s.%s", oldPath, "regional");
  value.regional.isValidFlag = C2xIsTokenAvailable(packetHandle, "BasicSafetyMessage", newPath);
  if(value.regional.isValidFlag==1)
  {
    GetBasicSafetyMessageVehicleClassification_regionalParams(packetHandle, value.regional, newPath);
    result = CheckLastError("BasicSafetyMessage", gkFuncRefGet, result);
  }
  return result;
}

int SetBasicSafetyMessageVehicleClassificationParams(LONG packetHandle, struct BasicSafetyMessageVehicleClassification value, char oldPath[])
{
  char newPath[300];
  int result;

  result = 0;

  snprintf(newPath, elcount(newPath), "%s.%s", oldPath, "keyType");
  if(value.keyType.isValidFlag==1)
  {
    C2xSetTokenInt(packetHandle, "BasicSafetyMessage", newPath, value.keyType.value);
    result = CheckLastError("BasicSafetyMessage", gkFuncRefGet, result);
  }
  else
  {
    if( C2xIsTokenAvailable(packetHandle, "BasicSafetyMessage", newPath) )
    {
      C2xRemoveToken(packetHandle, "BasicSafetyMessage", newPath);
    }
  }

  snprintf(newPath, elcount(newPath), "%s.%s", oldPath, "role");
  if(value.role.isValidFlag==1)
  {
    C2xSetTokenInt(packetHandle, "BasicSafetyMessage", newPath, value.role.value);
    result = CheckLastError("BasicSafetyMessage", gkFuncRefGet, result);
  }
  else
  {
    if( C2xIsTokenAvailable(packetHandle, "BasicSafetyMessage", newPath) )
    {
      C2xRemoveToken(packetHandle, "BasicSafetyMessage", newPath);
    }
  }

  snprintf(newPath, elcount(newPath), "%s.%s", oldPath, "iso3883");
  if(value.iso3883.isValidFlag==1)
  {
    C2xSetTokenInt(packetHandle, "BasicSafetyMessage", newPath, value.iso3883.value);
    result = CheckLastError("BasicSafetyMessage", gkFuncRefGet, result);
  }
  else
  {
    if( C2xIsTokenAvailable(packetHandle, "BasicSafetyMessage", newPath) )
    {
      C2xRemoveToken(packetHandle, "BasicSafetyMessage", newPath);
    }
  }

  snprintf(newPath, elcount(newPath), "%s.%s", oldPath, "hpmsType");
  if(value.hpmsType.isValidFlag==1)
  {
    C2xSetTokenInt(packetHandle, "BasicSafetyMessage", newPath, value.hpmsType.value);
    result = CheckLastError("BasicSafetyMessage", gkFuncRefGet, result);
  }
  else
  {
    if( C2xIsTokenAvailable(packetHandle, "BasicSafetyMessage", newPath) )
    {
      C2xRemoveToken(packetHandle, "BasicSafetyMessage", newPath);
    }
  }

  snprintf(newPath, elcount(newPath), "%s.%s", oldPath, "vehicleType");
  if(value.vehicleType.isValidFlag==1)
  {
    if (value.vehicleType.value < 9217)
    {
        C2xSetTokenInt(packetHandle, "BasicSafetyMessage", newPath, 9217);
    }
    else if (value.vehicleType.value > 9251)
    {
        C2xSetTokenInt(packetHandle, "BasicSafetyMessage", newPath, 9251);
    }
    else
    {
        C2xSetTokenInt(packetHandle, "BasicSafetyMessage", newPath, value.vehicleType.value);
    }
    result = CheckLastError("BasicSafetyMessage", gkFuncRefGet, result);
  }
  else
  {
    if( C2xIsTokenAvailable(packetHandle, "BasicSafetyMessage", newPath) )
    {
      C2xRemoveToken(packetHandle, "BasicSafetyMessage", newPath);
    }
  }

  snprintf(newPath, elcount(newPath), "%s.%s", oldPath, "responseEquip");
  if(value.responseEquip.isValidFlag==1)
  {
    if (value.responseEquip.value < 9985)
    {
        C2xSetTokenInt(packetHandle, "BasicSafetyMessage", newPath, 9985);
    }
    else if (value.responseEquip.value > 10113)
    {
        C2xSetTokenInt(packetHandle, "BasicSafetyMessage", newPath, 10113);
    }
    else
    {
        C2xSetTokenInt(packetHandle, "BasicSafetyMessage", newPath, value.responseEquip.value);
    }
    result = CheckLastError("BasicSafetyMessage", gkFuncRefGet, result);
  }
  else
  {
    if( C2xIsTokenAvailable(packetHandle, "BasicSafetyMessage", newPath) )
    {
      C2xRemoveToken(packetHandle, "BasicSafetyMessage", newPath);
    }
  }

  snprintf(newPath, elcount(newPath), "%s.%s", oldPath, "responderType");
  if(value.responderType.isValidFlag==1)
  {
    if (value.responderType.value < 9729)
    {
        C2xSetTokenInt(packetHandle, "BasicSafetyMessage", newPath, 9729);
    }
    else if (value.responderType.value > 9742)
    {
        C2xSetTokenInt(packetHandle, "BasicSafetyMessage", newPath, 9742);
    }
    else
    {
        C2xSetTokenInt(packetHandle, "BasicSafetyMessage", newPath, value.responderType.value);
    }
    result = CheckLastError("BasicSafetyMessage", gkFuncRefGet, result);
  }
  else
  {
    if( C2xIsTokenAvailable(packetHandle, "BasicSafetyMessage", newPath) )
    {
      C2xRemoveToken(packetHandle, "BasicSafetyMessage", newPath);
    }
  }

  snprintf(newPath, elcount(newPath), "%s.%s", oldPath, "fuelType");
  if(value.fuelType.isValidFlag==1)
  {
    C2xSetTokenInt(packetHandle, "BasicSafetyMessage", newPath, value.fuelType.value);
    result = CheckLastError("BasicSafetyMessage", gkFuncRefGet, result);
  }
  else
  {
    if( C2xIsTokenAvailable(packetHandle, "BasicSafetyMessage", newPath) )
    {
      C2xRemoveToken(packetHandle, "BasicSafetyMessage", newPath);
    }
  }

  snprintf(newPath, elcount(newPath), "%s.%s", oldPath, "regional");
  if(value.regional.isValidFlag==1)
  {
    SetBasicSafetyMessageVehicleClassification_regionalParams(packetHandle, value.regional, newPath);
    result = CheckLastError("BasicSafetyMessage", gkFuncRefGet, result);
  }
  else
  {
    if( C2xIsTokenAvailable(packetHandle, "BasicSafetyMessage", newPath) )
    {
      C2xRemoveToken(packetHandle, "BasicSafetyMessage", newPath);
    }
  }

  return result;
}

int GetBasicSafetyMessageAxlesParams(LONG packetHandle, struct BasicSafetyMessageAxles value, char oldPath[])
{
  char newPath[300];
  int result;

  result = 0;

  snprintf(newPath, elcount(newPath), "%s.%s", oldPath, "totalAxles");
  value.totalAxles = C2xGetTokenInt(packetHandle, "BasicSafetyMessage", newPath);
  result = CheckLastError("BasicSafetyMessage", gkFuncRefGet, result);

  snprintf(newPath, elcount(newPath), "%s.%s", oldPath, "frontAxles");
  value.frontAxles.isValidFlag = C2xIsTokenAvailable(packetHandle, "BasicSafetyMessage", newPath);
  if(value.frontAxles.isValidFlag==1)
  {
    value.frontAxles.value = C2xGetTokenInt(packetHandle, "BasicSafetyMessage", newPath);
    result = CheckLastError("BasicSafetyMessage", gkFuncRefGet, result);
  }
  snprintf(newPath, elcount(newPath), "%s.%s", oldPath, "rearAxles");
  value.rearAxles.isValidFlag = C2xIsTokenAvailable(packetHandle, "BasicSafetyMessage", newPath);
  if(value.rearAxles.isValidFlag==1)
  {
    value.rearAxles.value = C2xGetTokenInt(packetHandle, "BasicSafetyMessage", newPath);
    result = CheckLastError("BasicSafetyMessage", gkFuncRefGet, result);
  }
  return result;
}

int SetBasicSafetyMessageAxlesParams(LONG packetHandle, struct BasicSafetyMessageAxles value, char oldPath[])
{
  char newPath[300];
  int result;

  result = 0;

  snprintf(newPath, elcount(newPath), "%s.%s", oldPath, "totalAxles");
  if (value.totalAxles < 1)
  {
    C2xSetTokenInt(packetHandle, "BasicSafetyMessage", newPath, 1);
  }
  else if (value.totalAxles > 10)
  {
    C2xSetTokenInt(packetHandle, "BasicSafetyMessage", newPath, 10);
  }
  else
  {
    C2xSetTokenInt(packetHandle, "BasicSafetyMessage", newPath, value.totalAxles);
  }
  result = CheckLastError("BasicSafetyMessage", gkFuncRefGet, result);

  snprintf(newPath, elcount(newPath), "%s.%s", oldPath, "frontAxles");
  if(value.frontAxles.isValidFlag==1)
  {
    C2xSetTokenInt(packetHandle, "BasicSafetyMessage", newPath, value.frontAxles.value);
    result = CheckLastError("BasicSafetyMessage", gkFuncRefGet, result);
  }
  else
  {
    if( C2xIsTokenAvailable(packetHandle, "BasicSafetyMessage", newPath) )
    {
      C2xRemoveToken(packetHandle, "BasicSafetyMessage", newPath);
    }
  }

  snprintf(newPath, elcount(newPath), "%s.%s", oldPath, "rearAxles");
  if(value.rearAxles.isValidFlag==1)
  {
    C2xSetTokenInt(packetHandle, "BasicSafetyMessage", newPath, value.rearAxles.value);
    result = CheckLastError("BasicSafetyMessage", gkFuncRefGet, result);
  }
  else
  {
    if( C2xIsTokenAvailable(packetHandle, "BasicSafetyMessage", newPath) )
    {
      C2xRemoveToken(packetHandle, "BasicSafetyMessage", newPath);
    }
  }

  return result;
}

int GetBasicSafetyMessageVehicleDataParams(LONG packetHandle, struct BasicSafetyMessageVehicleData value, char oldPath[])
{
  char newPath[300];
  int result;

  result = 0;

  snprintf(newPath, elcount(newPath), "%s.%s", oldPath, "height");
  value.height.isValidFlag = C2xIsTokenAvailable(packetHandle, "BasicSafetyMessage", newPath);
  if(value.height.isValidFlag==1)
  {
    value.height.value = C2xGetTokenInt(packetHandle, "BasicSafetyMessage", newPath);
    result = CheckLastError("BasicSafetyMessage", gkFuncRefGet, result);
  }
  snprintf(newPath, elcount(newPath), "%s.%s", oldPath, "bumpers");
  value.bumpers.isValidFlag = C2xIsTokenAvailable(packetHandle, "BasicSafetyMessage", newPath);
  if(value.bumpers.isValidFlag==1)
  {
    GetBasicSafetyMessageBumperHeightsParams(packetHandle, value.bumpers, newPath);
    result = CheckLastError("BasicSafetyMessage", gkFuncRefGet, result);
  }
  snprintf(newPath, elcount(newPath), "%s.%s", oldPath, "mass");
  value.mass.isValidFlag = C2xIsTokenAvailable(packetHandle, "BasicSafetyMessage", newPath);
  if(value.mass.isValidFlag==1)
  {
    value.mass.value = C2xGetTokenInt(packetHandle, "BasicSafetyMessage", newPath);
    result = CheckLastError("BasicSafetyMessage", gkFuncRefGet, result);
  }
  snprintf(newPath, elcount(newPath), "%s.%s", oldPath, "doNotUse");
  value.doNotUse.isValidFlag = C2xIsTokenAvailable(packetHandle, "BasicSafetyMessage", newPath);
  if(value.doNotUse.isValidFlag==1)
  {
    value.doNotUse.value = C2xGetTokenInt(packetHandle, "BasicSafetyMessage", newPath);
    result = CheckLastError("BasicSafetyMessage", gkFuncRefGet, result);
  }
  snprintf(newPath, elcount(newPath), "%s.%s", oldPath, "trailerPresent");
  value.trailerPresent.isValidFlag = C2xIsTokenAvailable(packetHandle, "BasicSafetyMessage", newPath);
  if(value.trailerPresent.isValidFlag==1)
  {
    value.trailerPresent.value = C2xGetTokenInt64(packetHandle, "BasicSafetyMessage", newPath);
    result = CheckLastError("BasicSafetyMessage", gkFuncRefGet, result);
  }
  snprintf(newPath, elcount(newPath), "%s.%s", oldPath, "pivotPoint");
  value.pivotPoint.isValidFlag = C2xIsTokenAvailable(packetHandle, "BasicSafetyMessage", newPath);
  if(value.pivotPoint.isValidFlag==1)
  {
    GetBasicSafetyMessagePivotPointDescriptionParams(packetHandle, value.pivotPoint, newPath);
    result = CheckLastError("BasicSafetyMessage", gkFuncRefGet, result);
  }
  snprintf(newPath, elcount(newPath), "%s.%s", oldPath, "axles");
  value.axles.isValidFlag = C2xIsTokenAvailable(packetHandle, "BasicSafetyMessage", newPath);
  if(value.axles.isValidFlag==1)
  {
    GetBasicSafetyMessageAxlesParams(packetHandle, value.axles, newPath);
    result = CheckLastError("BasicSafetyMessage", gkFuncRefGet, result);
  }
  snprintf(newPath, elcount(newPath), "%s.%s", oldPath, "leanAngle");
  value.leanAngle.isValidFlag = C2xIsTokenAvailable(packetHandle, "BasicSafetyMessage", newPath);
  if(value.leanAngle.isValidFlag==1)
  {
    value.leanAngle.value = C2xGetTokenInt(packetHandle, "BasicSafetyMessage", newPath);
    result = CheckLastError("BasicSafetyMessage", gkFuncRefGet, result);
  }
  return result;
}

int SetBasicSafetyMessageVehicleDataParams(LONG packetHandle, struct BasicSafetyMessageVehicleData value, char oldPath[])
{
  char newPath[300];
  int result;

  result = 0;

  snprintf(newPath, elcount(newPath), "%s.%s", oldPath, "height");
  if(value.height.isValidFlag==1)
  {
    C2xSetTokenInt(packetHandle, "BasicSafetyMessage", newPath, value.height.value);
    result = CheckLastError("BasicSafetyMessage", gkFuncRefGet, result);
  }
  else
  {
    if( C2xIsTokenAvailable(packetHandle, "BasicSafetyMessage", newPath) )
    {
      C2xRemoveToken(packetHandle, "BasicSafetyMessage", newPath);
    }
  }

  snprintf(newPath, elcount(newPath), "%s.%s", oldPath, "bumpers");
  if(value.bumpers.isValidFlag==1)
  {
    SetBasicSafetyMessageBumperHeightsParams(packetHandle, value.bumpers, newPath);
    result = CheckLastError("BasicSafetyMessage", gkFuncRefGet, result);
  }
  else
  {
    if( C2xIsTokenAvailable(packetHandle, "BasicSafetyMessage", newPath) )
    {
      C2xRemoveToken(packetHandle, "BasicSafetyMessage", newPath);
    }
  }

  snprintf(newPath, elcount(newPath), "%s.%s", oldPath, "mass");
  if(value.mass.isValidFlag==1)
  {
    C2xSetTokenInt(packetHandle, "BasicSafetyMessage", newPath, value.mass.value);
    result = CheckLastError("BasicSafetyMessage", gkFuncRefGet, result);
  }
  else
  {
    if( C2xIsTokenAvailable(packetHandle, "BasicSafetyMessage", newPath) )
    {
      C2xRemoveToken(packetHandle, "BasicSafetyMessage", newPath);
    }
  }

  snprintf(newPath, elcount(newPath), "%s.%s", oldPath, "doNotUse");
  if(value.doNotUse.isValidFlag==1)
  {
    C2xSetTokenInt(packetHandle, "BasicSafetyMessage", newPath, value.doNotUse.value);
    result = CheckLastError("BasicSafetyMessage", gkFuncRefGet, result);
  }
  else
  {
    if( C2xIsTokenAvailable(packetHandle, "BasicSafetyMessage", newPath) )
    {
      C2xRemoveToken(packetHandle, "BasicSafetyMessage", newPath);
    }
  }

  snprintf(newPath, elcount(newPath), "%s.%s", oldPath, "trailerPresent");
  if(value.trailerPresent.isValidFlag==1)
  {
    C2xSetTokenInt64(packetHandle, "BasicSafetyMessage", newPath, value.trailerPresent.value);
    result = CheckLastError("BasicSafetyMessage", gkFuncRefGet, result);
  }
  else
  {
    if( C2xIsTokenAvailable(packetHandle, "BasicSafetyMessage", newPath) )
    {
      C2xRemoveToken(packetHandle, "BasicSafetyMessage", newPath);
    }
  }

  snprintf(newPath, elcount(newPath), "%s.%s", oldPath, "pivotPoint");
  if(value.pivotPoint.isValidFlag==1)
  {
    SetBasicSafetyMessagePivotPointDescriptionParams(packetHandle, value.pivotPoint, newPath);
    result = CheckLastError("BasicSafetyMessage", gkFuncRefGet, result);
  }
  else
  {
    if( C2xIsTokenAvailable(packetHandle, "BasicSafetyMessage", newPath) )
    {
      C2xRemoveToken(packetHandle, "BasicSafetyMessage", newPath);
    }
  }

  snprintf(newPath, elcount(newPath), "%s.%s", oldPath, "axles");
  if(value.axles.isValidFlag==1)
  {
    SetBasicSafetyMessageAxlesParams(packetHandle, value.axles, newPath);
    result = CheckLastError("BasicSafetyMessage", gkFuncRefGet, result);
  }
  else
  {
    if( C2xIsTokenAvailable(packetHandle, "BasicSafetyMessage", newPath) )
    {
      C2xRemoveToken(packetHandle, "BasicSafetyMessage", newPath);
    }
  }

  snprintf(newPath, elcount(newPath), "%s.%s", oldPath, "leanAngle");
  if(value.leanAngle.isValidFlag==1)
  {
    C2xSetTokenInt(packetHandle, "BasicSafetyMessage", newPath, value.leanAngle.value);
    result = CheckLastError("BasicSafetyMessage", gkFuncRefGet, result);
  }
  else
  {
    if( C2xIsTokenAvailable(packetHandle, "BasicSafetyMessage", newPath) )
    {
      C2xRemoveToken(packetHandle, "BasicSafetyMessage", newPath);
    }
  }

  return result;
}

int GetBasicSafetyMessageWeatherReportParams(LONG packetHandle, struct BasicSafetyMessageWeatherReport value, char oldPath[])
{
  char newPath[300];
  int result;

  result = 0;

  snprintf(newPath, elcount(newPath), "%s.%s", oldPath, "isRaining");
  value.isRaining = C2xGetTokenInt(packetHandle, "BasicSafetyMessage", newPath);
  result = CheckLastError("BasicSafetyMessage", gkFuncRefGet, result);

  snprintf(newPath, elcount(newPath), "%s.%s", oldPath, "rainRate");
  value.rainRate.isValidFlag = C2xIsTokenAvailable(packetHandle, "BasicSafetyMessage", newPath);
  if(value.rainRate.isValidFlag==1)
  {
    value.rainRate.value = C2xGetTokenInt(packetHandle, "BasicSafetyMessage", newPath);
    result = CheckLastError("BasicSafetyMessage", gkFuncRefGet, result);
  }
  snprintf(newPath, elcount(newPath), "%s.%s", oldPath, "precipSituation");
  value.precipSituation.isValidFlag = C2xIsTokenAvailable(packetHandle, "BasicSafetyMessage", newPath);
  if(value.precipSituation.isValidFlag==1)
  {
    value.precipSituation.value = C2xGetTokenInt(packetHandle, "BasicSafetyMessage", newPath);
    result = CheckLastError("BasicSafetyMessage", gkFuncRefGet, result);
  }
  snprintf(newPath, elcount(newPath), "%s.%s", oldPath, "solarRadiation");
  value.solarRadiation.isValidFlag = C2xIsTokenAvailable(packetHandle, "BasicSafetyMessage", newPath);
  if(value.solarRadiation.isValidFlag==1)
  {
    value.solarRadiation.value = C2xGetTokenInt(packetHandle, "BasicSafetyMessage", newPath);
    result = CheckLastError("BasicSafetyMessage", gkFuncRefGet, result);
  }
  snprintf(newPath, elcount(newPath), "%s.%s", oldPath, "friction");
  value.friction.isValidFlag = C2xIsTokenAvailable(packetHandle, "BasicSafetyMessage", newPath);
  if(value.friction.isValidFlag==1)
  {
    value.friction.value = C2xGetTokenInt(packetHandle, "BasicSafetyMessage", newPath);
    result = CheckLastError("BasicSafetyMessage", gkFuncRefGet, result);
  }
  snprintf(newPath, elcount(newPath), "%s.%s", oldPath, "roadFriction");
  value.roadFriction.isValidFlag = C2xIsTokenAvailable(packetHandle, "BasicSafetyMessage", newPath);
  if(value.roadFriction.isValidFlag==1)
  {
    value.roadFriction.value = C2xGetTokenInt(packetHandle, "BasicSafetyMessage", newPath);
    result = CheckLastError("BasicSafetyMessage", gkFuncRefGet, result);
  }
  return result;
}

int SetBasicSafetyMessageWeatherReportParams(LONG packetHandle, struct BasicSafetyMessageWeatherReport value, char oldPath[])
{
  char newPath[300];
  int result;

  result = 0;

  snprintf(newPath, elcount(newPath), "%s.%s", oldPath, "isRaining");
  if (value.isRaining < 1)
  {
    C2xSetTokenInt(packetHandle, "BasicSafetyMessage", newPath, 1);
  }
  else if (value.isRaining > 3)
  {
    C2xSetTokenInt(packetHandle, "BasicSafetyMessage", newPath, 3);
  }
  else
  {
    C2xSetTokenInt(packetHandle, "BasicSafetyMessage", newPath, value.isRaining);
  }
  result = CheckLastError("BasicSafetyMessage", gkFuncRefGet, result);

  snprintf(newPath, elcount(newPath), "%s.%s", oldPath, "rainRate");
  if(value.rainRate.isValidFlag==1)
  {
    C2xSetTokenInt(packetHandle, "BasicSafetyMessage", newPath, value.rainRate.value);
    result = CheckLastError("BasicSafetyMessage", gkFuncRefGet, result);
  }
  else
  {
    if( C2xIsTokenAvailable(packetHandle, "BasicSafetyMessage", newPath) )
    {
      C2xRemoveToken(packetHandle, "BasicSafetyMessage", newPath);
    }
  }

  snprintf(newPath, elcount(newPath), "%s.%s", oldPath, "precipSituation");
  if(value.precipSituation.isValidFlag==1)
  {
    if (value.precipSituation.value < 1)
    {
        C2xSetTokenInt(packetHandle, "BasicSafetyMessage", newPath, 1);
    }
    else if (value.precipSituation.value > 15)
    {
        C2xSetTokenInt(packetHandle, "BasicSafetyMessage", newPath, 15);
    }
    else
    {
        C2xSetTokenInt(packetHandle, "BasicSafetyMessage", newPath, value.precipSituation.value);
    }
    result = CheckLastError("BasicSafetyMessage", gkFuncRefGet, result);
  }
  else
  {
    if( C2xIsTokenAvailable(packetHandle, "BasicSafetyMessage", newPath) )
    {
      C2xRemoveToken(packetHandle, "BasicSafetyMessage", newPath);
    }
  }

  snprintf(newPath, elcount(newPath), "%s.%s", oldPath, "solarRadiation");
  if(value.solarRadiation.isValidFlag==1)
  {
    C2xSetTokenInt(packetHandle, "BasicSafetyMessage", newPath, value.solarRadiation.value);
    result = CheckLastError("BasicSafetyMessage", gkFuncRefGet, result);
  }
  else
  {
    if( C2xIsTokenAvailable(packetHandle, "BasicSafetyMessage", newPath) )
    {
      C2xRemoveToken(packetHandle, "BasicSafetyMessage", newPath);
    }
  }

  snprintf(newPath, elcount(newPath), "%s.%s", oldPath, "friction");
  if(value.friction.isValidFlag==1)
  {
    C2xSetTokenInt(packetHandle, "BasicSafetyMessage", newPath, value.friction.value);
    result = CheckLastError("BasicSafetyMessage", gkFuncRefGet, result);
  }
  else
  {
    if( C2xIsTokenAvailable(packetHandle, "BasicSafetyMessage", newPath) )
    {
      C2xRemoveToken(packetHandle, "BasicSafetyMessage", newPath);
    }
  }

  snprintf(newPath, elcount(newPath), "%s.%s", oldPath, "roadFriction");
  if(value.roadFriction.isValidFlag==1)
  {
    C2xSetTokenInt(packetHandle, "BasicSafetyMessage", newPath, value.roadFriction.value);
    result = CheckLastError("BasicSafetyMessage", gkFuncRefGet, result);
  }
  else
  {
    if( C2xIsTokenAvailable(packetHandle, "BasicSafetyMessage", newPath) )
    {
      C2xRemoveToken(packetHandle, "BasicSafetyMessage", newPath);
    }
  }

  return result;
}

int GetBasicSafetyMessageWiperSetParams(LONG packetHandle, struct BasicSafetyMessageWiperSet value, char oldPath[])
{
  char newPath[300];
  int result;

  result = 0;

  snprintf(newPath, elcount(newPath), "%s.%s", oldPath, "statusFront");
  value.statusFront = C2xGetTokenInt(packetHandle, "BasicSafetyMessage", newPath);
  result = CheckLastError("BasicSafetyMessage", gkFuncRefGet, result);

  snprintf(newPath, elcount(newPath), "%s.%s", oldPath, "rateFront");
  value.rateFront = C2xGetTokenInt(packetHandle, "BasicSafetyMessage", newPath);
  result = CheckLastError("BasicSafetyMessage", gkFuncRefGet, result);

  snprintf(newPath, elcount(newPath), "%s.%s", oldPath, "statusRear");
  value.statusRear.isValidFlag = C2xIsTokenAvailable(packetHandle, "BasicSafetyMessage", newPath);
  if(value.statusRear.isValidFlag==1)
  {
    value.statusRear.value = C2xGetTokenInt(packetHandle, "BasicSafetyMessage", newPath);
    result = CheckLastError("BasicSafetyMessage", gkFuncRefGet, result);
  }
  snprintf(newPath, elcount(newPath), "%s.%s", oldPath, "rateRear");
  value.rateRear.isValidFlag = C2xIsTokenAvailable(packetHandle, "BasicSafetyMessage", newPath);
  if(value.rateRear.isValidFlag==1)
  {
    value.rateRear.value = C2xGetTokenInt(packetHandle, "BasicSafetyMessage", newPath);
    result = CheckLastError("BasicSafetyMessage", gkFuncRefGet, result);
  }
  return result;
}

int SetBasicSafetyMessageWiperSetParams(LONG packetHandle, struct BasicSafetyMessageWiperSet value, char oldPath[])
{
  char newPath[300];
  int result;

  result = 0;

  snprintf(newPath, elcount(newPath), "%s.%s", oldPath, "statusFront");
  C2xSetTokenInt(packetHandle, "BasicSafetyMessage", newPath, value.statusFront);
  result = CheckLastError("BasicSafetyMessage", gkFuncRefGet, result);

  snprintf(newPath, elcount(newPath), "%s.%s", oldPath, "rateFront");
  C2xSetTokenInt(packetHandle, "BasicSafetyMessage", newPath, value.rateFront);
  result = CheckLastError("BasicSafetyMessage", gkFuncRefGet, result);

  snprintf(newPath, elcount(newPath), "%s.%s", oldPath, "statusRear");
  if(value.statusRear.isValidFlag==1)
  {
    C2xSetTokenInt(packetHandle, "BasicSafetyMessage", newPath, value.statusRear.value);
    result = CheckLastError("BasicSafetyMessage", gkFuncRefGet, result);
  }
  else
  {
    if( C2xIsTokenAvailable(packetHandle, "BasicSafetyMessage", newPath) )
    {
      C2xRemoveToken(packetHandle, "BasicSafetyMessage", newPath);
    }
  }

  snprintf(newPath, elcount(newPath), "%s.%s", oldPath, "rateRear");
  if(value.rateRear.isValidFlag==1)
  {
    C2xSetTokenInt(packetHandle, "BasicSafetyMessage", newPath, value.rateRear.value);
    result = CheckLastError("BasicSafetyMessage", gkFuncRefGet, result);
  }
  else
  {
    if( C2xIsTokenAvailable(packetHandle, "BasicSafetyMessage", newPath) )
    {
      C2xRemoveToken(packetHandle, "BasicSafetyMessage", newPath);
    }
  }

  return result;
}

int GetBasicSafetyMessageWeatherProbeParams(LONG packetHandle, struct BasicSafetyMessageWeatherProbe value, char oldPath[])
{
  char newPath[300];
  int result;

  result = 0;

  snprintf(newPath, elcount(newPath), "%s.%s", oldPath, "airTemp");
  value.airTemp.isValidFlag = C2xIsTokenAvailable(packetHandle, "BasicSafetyMessage", newPath);
  if(value.airTemp.isValidFlag==1)
  {
    value.airTemp.value = C2xGetTokenInt(packetHandle, "BasicSafetyMessage", newPath);
    result = CheckLastError("BasicSafetyMessage", gkFuncRefGet, result);
  }
  snprintf(newPath, elcount(newPath), "%s.%s", oldPath, "airPressure");
  value.airPressure.isValidFlag = C2xIsTokenAvailable(packetHandle, "BasicSafetyMessage", newPath);
  if(value.airPressure.isValidFlag==1)
  {
    value.airPressure.value = C2xGetTokenInt(packetHandle, "BasicSafetyMessage", newPath);
    result = CheckLastError("BasicSafetyMessage", gkFuncRefGet, result);
  }
  snprintf(newPath, elcount(newPath), "%s.%s", oldPath, "rainRates");
  value.rainRates.isValidFlag = C2xIsTokenAvailable(packetHandle, "BasicSafetyMessage", newPath);
  if(value.rainRates.isValidFlag==1)
  {
    GetBasicSafetyMessageWiperSetParams(packetHandle, value.rainRates, newPath);
    result = CheckLastError("BasicSafetyMessage", gkFuncRefGet, result);
  }
  return result;
}

int SetBasicSafetyMessageWeatherProbeParams(LONG packetHandle, struct BasicSafetyMessageWeatherProbe value, char oldPath[])
{
  char newPath[300];
  int result;

  result = 0;

  snprintf(newPath, elcount(newPath), "%s.%s", oldPath, "airTemp");
  if(value.airTemp.isValidFlag==1)
  {
    C2xSetTokenInt(packetHandle, "BasicSafetyMessage", newPath, value.airTemp.value);
    result = CheckLastError("BasicSafetyMessage", gkFuncRefGet, result);
  }
  else
  {
    if( C2xIsTokenAvailable(packetHandle, "BasicSafetyMessage", newPath) )
    {
      C2xRemoveToken(packetHandle, "BasicSafetyMessage", newPath);
    }
  }

  snprintf(newPath, elcount(newPath), "%s.%s", oldPath, "airPressure");
  if(value.airPressure.isValidFlag==1)
  {
    C2xSetTokenInt(packetHandle, "BasicSafetyMessage", newPath, value.airPressure.value);
    result = CheckLastError("BasicSafetyMessage", gkFuncRefGet, result);
  }
  else
  {
    if( C2xIsTokenAvailable(packetHandle, "BasicSafetyMessage", newPath) )
    {
      C2xRemoveToken(packetHandle, "BasicSafetyMessage", newPath);
    }
  }

  snprintf(newPath, elcount(newPath), "%s.%s", oldPath, "rainRates");
  if(value.rainRates.isValidFlag==1)
  {
    SetBasicSafetyMessageWiperSetParams(packetHandle, value.rainRates, newPath);
    result = CheckLastError("BasicSafetyMessage", gkFuncRefGet, result);
  }
  else
  {
    if( C2xIsTokenAvailable(packetHandle, "BasicSafetyMessage", newPath) )
    {
      C2xRemoveToken(packetHandle, "BasicSafetyMessage", newPath);
    }
  }

  return result;
}

int GetBasicSafetyMessageObstacleDetectionParams(LONG packetHandle, struct BasicSafetyMessageObstacleDetection value, char oldPath[])
{
  char newPath[300]; 
  int j; 
  int k;
  int result;

  result = 0;

  snprintf(newPath, elcount(newPath), "%s.%s", oldPath, "obDist");
  value.obDist = C2xGetTokenInt(packetHandle, "BasicSafetyMessage", newPath);
  result = CheckLastError("BasicSafetyMessage", gkFuncRefGet, result);

  snprintf(newPath, elcount(newPath), "%s.%s", oldPath, "obDirect");
  value.obDirect = C2xGetTokenInt(packetHandle, "BasicSafetyMessage", newPath);
  result = CheckLastError("BasicSafetyMessage", gkFuncRefGet, result);

  snprintf(newPath, elcount(newPath), "%s.%s", oldPath, "description");
  value.description.isValidFlag = C2xIsTokenAvailable(packetHandle, "BasicSafetyMessage", newPath);
  if(value.description.isValidFlag==1)
  {
    value.description.value = C2xGetTokenInt(packetHandle, "BasicSafetyMessage", newPath);
    result = CheckLastError("BasicSafetyMessage", gkFuncRefGet, result);
  }
  snprintf(newPath, elcount(newPath), "%s.%s", oldPath, "locationDetails");
  value.locationDetails.isValidFlag = C2xIsTokenAvailable(packetHandle, "BasicSafetyMessage", newPath);
  if(value.locationDetails.isValidFlag==1)
  {
    value.locationDetails.value = C2xGetTokenInt(packetHandle, "BasicSafetyMessage", newPath);
    result = CheckLastError("BasicSafetyMessage", gkFuncRefGet, result);
  }
  snprintf(newPath, elcount(newPath), "%s.%s", oldPath, "dateTime");
  GetBasicSafetyMessageDDateTimeParams(packetHandle, value.dateTime, newPath);
  result = CheckLastError("BasicSafetyMessage", gkFuncRefGet, result);

  snprintf(newPath, elcount(newPath), "%s.%s", oldPath, "vertEvent");
  value.vertEvent.isValidFlag = C2xIsTokenAvailable(packetHandle, "BasicSafetyMessage", newPath);
  if(value.vertEvent.isValidFlag==1)
  {
    value.vertEvent.isValidFlag = 1;
    value.vertEvent.stringLength = C2xGetTokenLengthBit(packetHandle, "BasicSafetyMessage", newPath);
    if ((result = CheckLastError("BasicSafetyMessage", gkFuncRefGet, result))==0)
    {
      if(value.vertEvent.stringLength > 0)
      {
        for(j=0; j<value.vertEvent.stringLength; j++)
        {
          if(C2xGetTokenBitOfBitString(packetHandle, "BasicSafetyMessage", newPath, j) == 0)
          {
            value.vertEvent.string[j] = '0';
          }
          else if(C2xGetTokenBitOfBitString(packetHandle, "BasicSafetyMessage", newPath, j) == 1)
          {
            value.vertEvent.string[j] = '1';
          }

          if(value.vertEvent.stringLength == 1)
          {
            value.vertEvent.string[1] = '0';
          }
          result = CheckLastError("BasicSafetyMessage", gkFuncRefGet, result);
        }
      }
      else
      {
        for(k = value.vertEvent.stringLength+1; k > -1; k--)
        {
          if(value.vertEvent.string[k] == '1')
          {
            value.vertEvent.string[k] = '0';
          }
        }
      }
    }

  }
  return result;
}

int SetBasicSafetyMessageObstacleDetectionParams(LONG packetHandle, struct BasicSafetyMessageObstacleDetection value, char oldPath[])
{
  char newPath[300]; 
  int j;
  int result;

  result = 0;

  snprintf(newPath, elcount(newPath), "%s.%s", oldPath, "obDist");
  C2xSetTokenInt(packetHandle, "BasicSafetyMessage", newPath, value.obDist);
  result = CheckLastError("BasicSafetyMessage", gkFuncRefGet, result);

  snprintf(newPath, elcount(newPath), "%s.%s", oldPath, "obDirect");
  C2xSetTokenInt(packetHandle, "BasicSafetyMessage", newPath, value.obDirect);
  result = CheckLastError("BasicSafetyMessage", gkFuncRefGet, result);

  snprintf(newPath, elcount(newPath), "%s.%s", oldPath, "description");
  if(value.description.isValidFlag==1)
  {
    C2xSetTokenInt(packetHandle, "BasicSafetyMessage", newPath, value.description.value);
    result = CheckLastError("BasicSafetyMessage", gkFuncRefGet, result);
  }
  else
  {
    if( C2xIsTokenAvailable(packetHandle, "BasicSafetyMessage", newPath) )
    {
      C2xRemoveToken(packetHandle, "BasicSafetyMessage", newPath);
    }
  }

  snprintf(newPath, elcount(newPath), "%s.%s", oldPath, "locationDetails");
  if(value.locationDetails.isValidFlag==1)
  {
    if (value.locationDetails.value < 7937)
    {
        C2xSetTokenInt(packetHandle, "BasicSafetyMessage", newPath, 7937);
    }
    else if (value.locationDetails.value > 8005)
    {
        C2xSetTokenInt(packetHandle, "BasicSafetyMessage", newPath, 8005);
    }
    else
    {
        C2xSetTokenInt(packetHandle, "BasicSafetyMessage", newPath, value.locationDetails.value);
    }
    result = CheckLastError("BasicSafetyMessage", gkFuncRefGet, result);
  }
  else
  {
    if( C2xIsTokenAvailable(packetHandle, "BasicSafetyMessage", newPath) )
    {
      C2xRemoveToken(packetHandle, "BasicSafetyMessage", newPath);
    }
  }

  snprintf(newPath, elcount(newPath), "%s.%s", oldPath, "dateTime");
  SetBasicSafetyMessageDDateTimeParams(packetHandle, value.dateTime, newPath);
  result = CheckLastError("BasicSafetyMessage", gkFuncRefGet, result);

  snprintf(newPath, elcount(newPath), "%s.%s", oldPath, "vertEvent");
  if(value.vertEvent.isValidFlag==1)
  {
      for(j=0; j<value.vertEvent.stringLength; j++)
      {
        if(value.vertEvent.string[j] == '0')
        {
          C2xSetTokenBitOfBitString(packetHandle, "BasicSafetyMessage", newPath, j, 0);
        }
        else
        {
          C2xSetTokenBitOfBitString(packetHandle, "BasicSafetyMessage", newPath, j, 1);
        }
        result = CheckLastError("BasicSafetyMessage", gkFuncRefGet, result);
      }
  }
  else
  {
    if( C2xIsTokenAvailable(packetHandle, "BasicSafetyMessage", newPath) )
    {
      C2xRemoveToken(packetHandle, "BasicSafetyMessage", newPath);
    }
  }

  return result;
}

int GetBasicSafetyMessageDisabledVehicleParams(LONG packetHandle, struct BasicSafetyMessageDisabledVehicle value, char oldPath[])
{
  char newPath[300];
  int result;

  result = 0;

  snprintf(newPath, elcount(newPath), "%s.%s", oldPath, "statusDetails");
  value.statusDetails = C2xGetTokenInt(packetHandle, "BasicSafetyMessage", newPath);
  result = CheckLastError("BasicSafetyMessage", gkFuncRefGet, result);

  snprintf(newPath, elcount(newPath), "%s.%s", oldPath, "locationDetails");
  value.locationDetails.isValidFlag = C2xIsTokenAvailable(packetHandle, "BasicSafetyMessage", newPath);
  if(value.locationDetails.isValidFlag==1)
  {
    value.locationDetails.value = C2xGetTokenInt(packetHandle, "BasicSafetyMessage", newPath);
    result = CheckLastError("BasicSafetyMessage", gkFuncRefGet, result);
  }
  return result;
}

int SetBasicSafetyMessageDisabledVehicleParams(LONG packetHandle, struct BasicSafetyMessageDisabledVehicle value, char oldPath[])
{
  char newPath[300];
  int result;

  result = 0;

  snprintf(newPath, elcount(newPath), "%s.%s", oldPath, "statusDetails");
  C2xSetTokenInt(packetHandle, "BasicSafetyMessage", newPath, value.statusDetails);
  result = CheckLastError("BasicSafetyMessage", gkFuncRefGet, result);

  snprintf(newPath, elcount(newPath), "%s.%s", oldPath, "locationDetails");
  if(value.locationDetails.isValidFlag==1)
  {
    if (value.locationDetails.value < 7937)
    {
        C2xSetTokenInt(packetHandle, "BasicSafetyMessage", newPath, 7937);
    }
    else if (value.locationDetails.value > 8005)
    {
        C2xSetTokenInt(packetHandle, "BasicSafetyMessage", newPath, 8005);
    }
    else
    {
        C2xSetTokenInt(packetHandle, "BasicSafetyMessage", newPath, value.locationDetails.value);
    }
    result = CheckLastError("BasicSafetyMessage", gkFuncRefGet, result);
  }
  else
  {
    if( C2xIsTokenAvailable(packetHandle, "BasicSafetyMessage", newPath) )
    {
      C2xRemoveToken(packetHandle, "BasicSafetyMessage", newPath);
    }
  }

  return result;
}

int GetBasicSafetyMessageSpeedProfileMeasurementListParams(LONG packetHandle, struct BasicSafetyMessageSpeedProfileMeasurementList value, char oldPath[])
{
  char newPath[300]; 
  int i;
  int result;

  result = 0;

  value.length = C2xGetTokenInt(packetHandle, "BasicSafetyMessage", oldPath);
  if((result = CheckLastError("BasicSafetyMessage", gkFuncRefGet, result))==0)
  {
    for(i=0; i<value.length; i++)
    {
      snprintf(newPath, elcount(newPath), "%s[%d]", oldPath, i);
      value.arrayValue[i] = C2xGetTokenInt64(packetHandle, "BasicSafetyMessage", newPath);
      result = CheckLastError("BasicSafetyMessage", gkFuncRefGet, result);
    }
  }
  return result;
}

int SetBasicSafetyMessageSpeedProfileMeasurementListParams(LONG packetHandle, struct BasicSafetyMessageSpeedProfileMeasurementList value, char oldPath[])
{
  char newPath[300]; 
  int i;
  int result;

  result = 0;

  C2xRemoveToken(packetHandle, "BasicSafetyMessage", oldPath);
  for(i=0; i<value.length; i++)
  {
    snprintf(newPath, elcount(newPath), "%s[%d]", oldPath, i);
    C2xSetTokenInt64(packetHandle, "BasicSafetyMessage", newPath, value.arrayValue[i]);
    result = CheckLastError("BasicSafetyMessage", gkFuncRefGet, result);
  }
  return result;
}

int GetBasicSafetyMessageSpeedProfileParams(LONG packetHandle, struct BasicSafetyMessageSpeedProfile value, char oldPath[])
{
  char newPath[300];
  int result;

  result = 0;

  snprintf(newPath, elcount(newPath), "%s.%s", oldPath, "speedReports");
  GetBasicSafetyMessageSpeedProfileMeasurementListParams(packetHandle, value.speedReports, newPath);
  result = CheckLastError("BasicSafetyMessage", gkFuncRefGet, result);

  return result;
}

int SetBasicSafetyMessageSpeedProfileParams(LONG packetHandle, struct BasicSafetyMessageSpeedProfile value, char oldPath[])
{
  char newPath[300];
  int result;

  result = 0;

  snprintf(newPath, elcount(newPath), "%s.%s", oldPath, "speedReports");
  SetBasicSafetyMessageSpeedProfileMeasurementListParams(packetHandle, value.speedReports, newPath);
  result = CheckLastError("BasicSafetyMessage", gkFuncRefGet, result);

  return result;
}

int GetBasicSafetyMessageAntennaOffsetSetParams(LONG packetHandle, struct BasicSafetyMessageAntennaOffsetSet value, char oldPath[])
{
  char newPath[300];
  int result;

  result = 0;

  snprintf(newPath, elcount(newPath), "%s.%s", oldPath, "antOffsetX");
  value.antOffsetX = C2xGetTokenInt(packetHandle, "BasicSafetyMessage", newPath);
  result = CheckLastError("BasicSafetyMessage", gkFuncRefGet, result);

  snprintf(newPath, elcount(newPath), "%s.%s", oldPath, "antOffsetY");
  value.antOffsetY = C2xGetTokenInt(packetHandle, "BasicSafetyMessage", newPath);
  result = CheckLastError("BasicSafetyMessage", gkFuncRefGet, result);

  snprintf(newPath, elcount(newPath), "%s.%s", oldPath, "antOffsetZ");
  value.antOffsetZ = C2xGetTokenInt(packetHandle, "BasicSafetyMessage", newPath);
  result = CheckLastError("BasicSafetyMessage", gkFuncRefGet, result);

  return result;
}

int SetBasicSafetyMessageAntennaOffsetSetParams(LONG packetHandle, struct BasicSafetyMessageAntennaOffsetSet value, char oldPath[])
{
  char newPath[300];
  int result;

  result = 0;

  snprintf(newPath, elcount(newPath), "%s.%s", oldPath, "antOffsetX");
  C2xSetTokenInt(packetHandle, "BasicSafetyMessage", newPath, value.antOffsetX);
  result = CheckLastError("BasicSafetyMessage", gkFuncRefGet, result);

  snprintf(newPath, elcount(newPath), "%s.%s", oldPath, "antOffsetY");
  C2xSetTokenInt(packetHandle, "BasicSafetyMessage", newPath, value.antOffsetY);
  result = CheckLastError("BasicSafetyMessage", gkFuncRefGet, result);

  snprintf(newPath, elcount(newPath), "%s.%s", oldPath, "antOffsetZ");
  C2xSetTokenInt(packetHandle, "BasicSafetyMessage", newPath, value.antOffsetZ);
  result = CheckLastError("BasicSafetyMessage", gkFuncRefGet, result);

  return result;
}

int GetBasicSafetyMessageRTCMheaderParams(LONG packetHandle, struct BasicSafetyMessageRTCMheader value, char oldPath[])
{
  char newPath[300]; 
  int j; 
  int k;
  int result;

  result = 0;

  snprintf(newPath, elcount(newPath), "%s.%s", oldPath, "status");
  value.status.isValidFlag = 1;
  value.status.stringLength = C2xGetTokenLengthBit(packetHandle, "BasicSafetyMessage", newPath);
  if ((result = CheckLastError("BasicSafetyMessage", gkFuncRefGet, result))==0)
  {
    if(value.status.stringLength > 0)
    {
      for(j=0; j<value.status.stringLength; j++)
      {
        if(C2xGetTokenBitOfBitString(packetHandle, "BasicSafetyMessage", newPath, j) == 0)
        {
          value.status.string[j] = '0';
        }
        else if(C2xGetTokenBitOfBitString(packetHandle, "BasicSafetyMessage", newPath, j) == 1)
        {
          value.status.string[j] = '1';
        }

        if(value.status.stringLength == 1)
        {
          value.status.string[1] = '0';
        }
        result = CheckLastError("BasicSafetyMessage", gkFuncRefGet, result);
      }
    }
    else
    {
      for(k = value.status.stringLength+1; k > -1; k--)
      {
        if(value.status.string[k] == '1')
        {
          value.status.string[k] = '0';
        }
      }
    }
  }

  snprintf(newPath, elcount(newPath), "%s.%s", oldPath, "offsetSet");
  GetBasicSafetyMessageAntennaOffsetSetParams(packetHandle, value.offsetSet, newPath);
  result = CheckLastError("BasicSafetyMessage", gkFuncRefGet, result);

  return result;
}

int SetBasicSafetyMessageRTCMheaderParams(LONG packetHandle, struct BasicSafetyMessageRTCMheader value, char oldPath[])
{
  char newPath[300]; 
  int j;
  int result;

  result = 0;

  snprintf(newPath, elcount(newPath), "%s.%s", oldPath, "status");
    for(j=0; j<value.status.stringLength; j++)
    {
      if(value.status.string[j] == '0')
      {
        C2xSetTokenBitOfBitString(packetHandle, "BasicSafetyMessage", newPath, j, 0);
      }
      else
      {
        C2xSetTokenBitOfBitString(packetHandle, "BasicSafetyMessage", newPath, j, 1);
      }
      result = CheckLastError("BasicSafetyMessage", gkFuncRefGet, result);
    }

  snprintf(newPath, elcount(newPath), "%s.%s", oldPath, "offsetSet");
  SetBasicSafetyMessageAntennaOffsetSetParams(packetHandle, value.offsetSet, newPath);
  result = CheckLastError("BasicSafetyMessage", gkFuncRefGet, result);

  return result;
}

int GetBasicSafetyMessageRTCMmessageListParams(LONG packetHandle, struct BasicSafetyMessageRTCMmessageList value, char oldPath[])
{
  char newPath[300]; 
  int i;
  char buffer[300];
  int result;

  result = 0;

  value.length = C2xGetTokenInt(packetHandle, "BasicSafetyMessage", oldPath);
  if((result = CheckLastError("BasicSafetyMessage", gkFuncRefGet, result))==0)
  {
    for(i=0; i<value.length; i++)
    {
      snprintf(newPath, elcount(newPath), "%s[%d]", oldPath, i);
      C2xGetTokenData(packetHandle, "BasicSafetyMessage", newPath, elcount(buffer), buffer);
      strncpy(value.arrayValue[i].string , buffer, value.arrayValue[i].stringLength );
      result = CheckLastError("BasicSafetyMessage", gkFuncRefGet, result);
    }
  }
  return result;
}

int SetBasicSafetyMessageRTCMmessageListParams(LONG packetHandle, struct BasicSafetyMessageRTCMmessageList value, char oldPath[])
{
  char newPath[300]; 
  int i;
  char buffer[300];
  int result;

  result = 0;

  C2xRemoveToken(packetHandle, "BasicSafetyMessage", oldPath);
  for(i=0; i<value.length; i++)
  {
    snprintf(newPath, elcount(newPath), "%s[%d]", oldPath, i);
    strncpy(buffer,value.arrayValue[i].string , elcount(buffer));
    C2xSetTokenData(packetHandle, "BasicSafetyMessage", newPath, elcount(buffer), buffer);
    result = CheckLastError("BasicSafetyMessage", gkFuncRefGet, result);
  }
  return result;
}

int GetBasicSafetyMessageRTCMPackageParams(LONG packetHandle, struct BasicSafetyMessageRTCMPackage value, char oldPath[])
{
  char newPath[300];
  int result;

  result = 0;

  snprintf(newPath, elcount(newPath), "%s.%s", oldPath, "rtcmHeader");
  value.rtcmHeader.isValidFlag = C2xIsTokenAvailable(packetHandle, "BasicSafetyMessage", newPath);
  if(value.rtcmHeader.isValidFlag==1)
  {
    GetBasicSafetyMessageRTCMheaderParams(packetHandle, value.rtcmHeader, newPath);
    result = CheckLastError("BasicSafetyMessage", gkFuncRefGet, result);
  }
  snprintf(newPath, elcount(newPath), "%s.%s", oldPath, "msgs");
  GetBasicSafetyMessageRTCMmessageListParams(packetHandle, value.msgs, newPath);
  result = CheckLastError("BasicSafetyMessage", gkFuncRefGet, result);

  return result;
}

int SetBasicSafetyMessageRTCMPackageParams(LONG packetHandle, struct BasicSafetyMessageRTCMPackage value, char oldPath[])
{
  char newPath[300];
  int result;

  result = 0;

  snprintf(newPath, elcount(newPath), "%s.%s", oldPath, "rtcmHeader");
  if(value.rtcmHeader.isValidFlag==1)
  {
    SetBasicSafetyMessageRTCMheaderParams(packetHandle, value.rtcmHeader, newPath);
    result = CheckLastError("BasicSafetyMessage", gkFuncRefGet, result);
  }
  else
  {
    if( C2xIsTokenAvailable(packetHandle, "BasicSafetyMessage", newPath) )
    {
      C2xRemoveToken(packetHandle, "BasicSafetyMessage", newPath);
    }
  }

  snprintf(newPath, elcount(newPath), "%s.%s", oldPath, "msgs");
  SetBasicSafetyMessageRTCMmessageListParams(packetHandle, value.msgs, newPath);
  result = CheckLastError("BasicSafetyMessage", gkFuncRefGet, result);

  return result;
}

int GetBasicSafetyMessageRegionalExtension_Reg_SupplementalVehicleExtensionsParams(LONG packetHandle, struct BasicSafetyMessageRegionalExtension_Reg_SupplementalVehicleExtensions value, char oldPath[])
{
  char newPath[300];
  int result;

  result = 0;

  snprintf(newPath, elcount(newPath), "%s.%s", oldPath, "regionId");
  value.regionId = C2xGetTokenInt(packetHandle, "BasicSafetyMessage", newPath);
  result = CheckLastError("BasicSafetyMessage", gkFuncRefGet, result);

  return result;
}

int SetBasicSafetyMessageRegionalExtension_Reg_SupplementalVehicleExtensionsParams(LONG packetHandle, struct BasicSafetyMessageRegionalExtension_Reg_SupplementalVehicleExtensions value, char oldPath[])
{
  char newPath[300];
  int result;

  result = 0;


  return result;
}

int GetBasicSafetyMessageSupplementalVehicleExtensions_regionalParams(LONG packetHandle, struct BasicSafetyMessageSupplementalVehicleExtensions_regional value, char oldPath[])
{
  char newPath[300]; 
  int i;
  int result;

  result = 0;

  value.length = C2xGetTokenInt(packetHandle, "BasicSafetyMessage", oldPath);
  if((result = CheckLastError("BasicSafetyMessage", gkFuncRefGet, result))==0)
  {
    for(i=0; i<value.length; i++)
    {
      snprintf(newPath, elcount(newPath), "%s[%d]", oldPath, i);
      GetBasicSafetyMessageRegionalExtension_Reg_SupplementalVehicleExtensionsParams(packetHandle, value.arrayValue[i], newPath);
      result = CheckLastError("BasicSafetyMessage", gkFuncRefGet, result);
    }
  }
  return result;
}

int SetBasicSafetyMessageSupplementalVehicleExtensions_regionalParams(LONG packetHandle, struct BasicSafetyMessageSupplementalVehicleExtensions_regional value, char oldPath[])
{
  char newPath[300]; 
  int i;
  int result;

  result = 0;

  C2xRemoveToken(packetHandle, "BasicSafetyMessage", oldPath);
  for(i=0; i<value.length; i++)
  {
    snprintf(newPath, elcount(newPath), "%s[%d]", oldPath, i);
    SetBasicSafetyMessageRegionalExtension_Reg_SupplementalVehicleExtensionsParams(packetHandle, value.arrayValue[i], newPath);
    result = CheckLastError("BasicSafetyMessage", gkFuncRefGet, result);
  }
  return result;
}

int GetBasicSafetyMessageTrailerUnitDescJ2945Slash1BParams(LONG packetHandle, struct BasicSafetyMessageTrailerUnitDescJ2945Slash1B value, char oldPath[])
{
  char newPath[300];
  int result;

  result = 0;

  snprintf(newPath, elcount(newPath), "%s.%s", oldPath, "width");
  value.width = C2xGetTokenInt(packetHandle, "BasicSafetyMessage", newPath);
  result = CheckLastError("BasicSafetyMessage", gkFuncRefGet, result);

  snprintf(newPath, elcount(newPath), "%s.%s", oldPath, "length");
  value.length = C2xGetTokenInt(packetHandle, "BasicSafetyMessage", newPath);
  result = CheckLastError("BasicSafetyMessage", gkFuncRefGet, result);

  snprintf(newPath, elcount(newPath), "%s.%s", oldPath, "height");
  value.height.isValidFlag = C2xIsTokenAvailable(packetHandle, "BasicSafetyMessage", newPath);
  if(value.height.isValidFlag==1)
  {
    value.height.value = C2xGetTokenInt(packetHandle, "BasicSafetyMessage", newPath);
    result = CheckLastError("BasicSafetyMessage", gkFuncRefGet, result);
  }
  snprintf(newPath, elcount(newPath), "%s.%s", oldPath, "weight");
  value.weight.isValidFlag = C2xIsTokenAvailable(packetHandle, "BasicSafetyMessage", newPath);
  if(value.weight.isValidFlag==1)
  {
    value.weight.value = C2xGetTokenInt(packetHandle, "BasicSafetyMessage", newPath);
    result = CheckLastError("BasicSafetyMessage", gkFuncRefGet, result);
  }
  snprintf(newPath, elcount(newPath), "%s.%s", oldPath, "frontPivot");
  GetBasicSafetyMessagePivotPointDescriptionParams(packetHandle, value.frontPivot, newPath);
  result = CheckLastError("BasicSafetyMessage", gkFuncRefGet, result);

  snprintf(newPath, elcount(newPath), "%s.%s", oldPath, "rearPivot");
  value.rearPivot.isValidFlag = C2xIsTokenAvailable(packetHandle, "BasicSafetyMessage", newPath);
  if(value.rearPivot.isValidFlag==1)
  {
    GetBasicSafetyMessagePivotPointDescriptionParams(packetHandle, value.rearPivot, newPath);
    result = CheckLastError("BasicSafetyMessage", gkFuncRefGet, result);
  }
  snprintf(newPath, elcount(newPath), "%s.%s", oldPath, "bumpers");
  value.bumpers.isValidFlag = C2xIsTokenAvailable(packetHandle, "BasicSafetyMessage", newPath);
  if(value.bumpers.isValidFlag==1)
  {
    GetBasicSafetyMessageBumperHeightsParams(packetHandle, value.bumpers, newPath);
    result = CheckLastError("BasicSafetyMessage", gkFuncRefGet, result);
  }
  snprintf(newPath, elcount(newPath), "%s.%s", oldPath, "axles");
  value.axles.isValidFlag = C2xIsTokenAvailable(packetHandle, "BasicSafetyMessage", newPath);
  if(value.axles.isValidFlag==1)
  {
    GetBasicSafetyMessageAxlesParams(packetHandle, value.axles, newPath);
    result = CheckLastError("BasicSafetyMessage", gkFuncRefGet, result);
  }
  return result;
}

int SetBasicSafetyMessageTrailerUnitDescJ2945Slash1BParams(LONG packetHandle, struct BasicSafetyMessageTrailerUnitDescJ2945Slash1B value, char oldPath[])
{
  char newPath[300];
  int result;

  result = 0;

  snprintf(newPath, elcount(newPath), "%s.%s", oldPath, "width");
  C2xSetTokenInt(packetHandle, "BasicSafetyMessage", newPath, value.width);
  result = CheckLastError("BasicSafetyMessage", gkFuncRefGet, result);

  snprintf(newPath, elcount(newPath), "%s.%s", oldPath, "length");
  C2xSetTokenInt(packetHandle, "BasicSafetyMessage", newPath, value.length);
  result = CheckLastError("BasicSafetyMessage", gkFuncRefGet, result);

  snprintf(newPath, elcount(newPath), "%s.%s", oldPath, "height");
  if(value.height.isValidFlag==1)
  {
    C2xSetTokenInt(packetHandle, "BasicSafetyMessage", newPath, value.height.value);
    result = CheckLastError("BasicSafetyMessage", gkFuncRefGet, result);
  }
  else
  {
    if( C2xIsTokenAvailable(packetHandle, "BasicSafetyMessage", newPath) )
    {
      C2xRemoveToken(packetHandle, "BasicSafetyMessage", newPath);
    }
  }

  snprintf(newPath, elcount(newPath), "%s.%s", oldPath, "weight");
  if(value.weight.isValidFlag==1)
  {
    C2xSetTokenInt(packetHandle, "BasicSafetyMessage", newPath, value.weight.value);
    result = CheckLastError("BasicSafetyMessage", gkFuncRefGet, result);
  }
  else
  {
    if( C2xIsTokenAvailable(packetHandle, "BasicSafetyMessage", newPath) )
    {
      C2xRemoveToken(packetHandle, "BasicSafetyMessage", newPath);
    }
  }

  snprintf(newPath, elcount(newPath), "%s.%s", oldPath, "frontPivot");
  SetBasicSafetyMessagePivotPointDescriptionParams(packetHandle, value.frontPivot, newPath);
  result = CheckLastError("BasicSafetyMessage", gkFuncRefGet, result);

  snprintf(newPath, elcount(newPath), "%s.%s", oldPath, "rearPivot");
  if(value.rearPivot.isValidFlag==1)
  {
    SetBasicSafetyMessagePivotPointDescriptionParams(packetHandle, value.rearPivot, newPath);
    result = CheckLastError("BasicSafetyMessage", gkFuncRefGet, result);
  }
  else
  {
    if( C2xIsTokenAvailable(packetHandle, "BasicSafetyMessage", newPath) )
    {
      C2xRemoveToken(packetHandle, "BasicSafetyMessage", newPath);
    }
  }

  snprintf(newPath, elcount(newPath), "%s.%s", oldPath, "bumpers");
  if(value.bumpers.isValidFlag==1)
  {
    SetBasicSafetyMessageBumperHeightsParams(packetHandle, value.bumpers, newPath);
    result = CheckLastError("BasicSafetyMessage", gkFuncRefGet, result);
  }
  else
  {
    if( C2xIsTokenAvailable(packetHandle, "BasicSafetyMessage", newPath) )
    {
      C2xRemoveToken(packetHandle, "BasicSafetyMessage", newPath);
    }
  }

  snprintf(newPath, elcount(newPath), "%s.%s", oldPath, "axles");
  if(value.axles.isValidFlag==1)
  {
    SetBasicSafetyMessageAxlesParams(packetHandle, value.axles, newPath);
    result = CheckLastError("BasicSafetyMessage", gkFuncRefGet, result);
  }
  else
  {
    if( C2xIsTokenAvailable(packetHandle, "BasicSafetyMessage", newPath) )
    {
      C2xRemoveToken(packetHandle, "BasicSafetyMessage", newPath);
    }
  }

  return result;
}

int GetBasicSafetyMessageTrailersJ2945Slash1BParams(LONG packetHandle, struct BasicSafetyMessageTrailersJ2945Slash1B value, char oldPath[])
{
  char newPath[300]; 
  int i;
  int result;

  result = 0;

  value.length = C2xGetTokenInt(packetHandle, "BasicSafetyMessage", oldPath);
  if((result = CheckLastError("BasicSafetyMessage", gkFuncRefGet, result))==0)
  {
    for(i=0; i<value.length; i++)
    {
      snprintf(newPath, elcount(newPath), "%s[%d]", oldPath, i);
      GetBasicSafetyMessageTrailerUnitDescJ2945Slash1BParams(packetHandle, value.arrayValue[i], newPath);
      result = CheckLastError("BasicSafetyMessage", gkFuncRefGet, result);
    }
  }
  return result;
}

int SetBasicSafetyMessageTrailersJ2945Slash1BParams(LONG packetHandle, struct BasicSafetyMessageTrailersJ2945Slash1B value, char oldPath[])
{
  char newPath[300]; 
  int i;
  int result;

  result = 0;

  C2xRemoveToken(packetHandle, "BasicSafetyMessage", oldPath);
  for(i=0; i<value.length; i++)
  {
    snprintf(newPath, elcount(newPath), "%s[%d]", oldPath, i);
    SetBasicSafetyMessageTrailerUnitDescJ2945Slash1BParams(packetHandle, value.arrayValue[i], newPath);
    result = CheckLastError("BasicSafetyMessage", gkFuncRefGet, result);
  }
  return result;
}

int GetBasicSafetyMessageSchoolBusJ2945Slash1CParams(LONG packetHandle, struct BasicSafetyMessageSchoolBusJ2945Slash1C value, char oldPath[])
{
  char newPath[300];
  int result;

  result = 0;

  snprintf(newPath, elcount(newPath), "%s.%s", oldPath, "flashingAmberLights");
  value.flashingAmberLights = C2xGetTokenInt64(packetHandle, "BasicSafetyMessage", newPath);
  result = CheckLastError("BasicSafetyMessage", gkFuncRefGet, result);

  snprintf(newPath, elcount(newPath), "%s.%s", oldPath, "flashingRedLights");
  value.flashingRedLights = C2xGetTokenInt64(packetHandle, "BasicSafetyMessage", newPath);
  result = CheckLastError("BasicSafetyMessage", gkFuncRefGet, result);

  snprintf(newPath, elcount(newPath), "%s.%s", oldPath, "studentsCrossingFront");
  value.studentsCrossingFront.isValidFlag = C2xIsTokenAvailable(packetHandle, "BasicSafetyMessage", newPath);
  if(value.studentsCrossingFront.isValidFlag==1)
  {
    value.studentsCrossingFront.value = C2xGetTokenInt64(packetHandle, "BasicSafetyMessage", newPath);
    result = CheckLastError("BasicSafetyMessage", gkFuncRefGet, result);
  }
  snprintf(newPath, elcount(newPath), "%s.%s", oldPath, "studentsCrossingBehind");
  value.studentsCrossingBehind.isValidFlag = C2xIsTokenAvailable(packetHandle, "BasicSafetyMessage", newPath);
  if(value.studentsCrossingBehind.isValidFlag==1)
  {
    value.studentsCrossingBehind.value = C2xGetTokenInt64(packetHandle, "BasicSafetyMessage", newPath);
    result = CheckLastError("BasicSafetyMessage", gkFuncRefGet, result);
  }
  snprintf(newPath, elcount(newPath), "%s.%s", oldPath, "studentsLoading");
  value.studentsLoading.isValidFlag = C2xIsTokenAvailable(packetHandle, "BasicSafetyMessage", newPath);
  if(value.studentsLoading.isValidFlag==1)
  {
    value.studentsLoading.value = C2xGetTokenInt64(packetHandle, "BasicSafetyMessage", newPath);
    result = CheckLastError("BasicSafetyMessage", gkFuncRefGet, result);
  }
  snprintf(newPath, elcount(newPath), "%s.%s", oldPath, "studentsUnloading");
  value.studentsUnloading.isValidFlag = C2xIsTokenAvailable(packetHandle, "BasicSafetyMessage", newPath);
  if(value.studentsUnloading.isValidFlag==1)
  {
    value.studentsUnloading.value = C2xGetTokenInt64(packetHandle, "BasicSafetyMessage", newPath);
    result = CheckLastError("BasicSafetyMessage", gkFuncRefGet, result);
  }
  snprintf(newPath, elcount(newPath), "%s.%s", oldPath, "wheelchairLiftInUse");
  value.wheelchairLiftInUse.isValidFlag = C2xIsTokenAvailable(packetHandle, "BasicSafetyMessage", newPath);
  if(value.wheelchairLiftInUse.isValidFlag==1)
  {
    value.wheelchairLiftInUse.value = C2xGetTokenInt64(packetHandle, "BasicSafetyMessage", newPath);
    result = CheckLastError("BasicSafetyMessage", gkFuncRefGet, result);
  }
  snprintf(newPath, elcount(newPath), "%s.%s", oldPath, "emergencyExitOpen");
  value.emergencyExitOpen.isValidFlag = C2xIsTokenAvailable(packetHandle, "BasicSafetyMessage", newPath);
  if(value.emergencyExitOpen.isValidFlag==1)
  {
    value.emergencyExitOpen.value = C2xGetTokenInt64(packetHandle, "BasicSafetyMessage", newPath);
    result = CheckLastError("BasicSafetyMessage", gkFuncRefGet, result);
  }
  snprintf(newPath, elcount(newPath), "%s.%s", oldPath, "emergencyRequestMedical");
  value.emergencyRequestMedical.isValidFlag = C2xIsTokenAvailable(packetHandle, "BasicSafetyMessage", newPath);
  if(value.emergencyRequestMedical.isValidFlag==1)
  {
    value.emergencyRequestMedical.value = C2xGetTokenInt64(packetHandle, "BasicSafetyMessage", newPath);
    result = CheckLastError("BasicSafetyMessage", gkFuncRefGet, result);
  }
  snprintf(newPath, elcount(newPath), "%s.%s", oldPath, "emergencyRequestFire");
  value.emergencyRequestFire.isValidFlag = C2xIsTokenAvailable(packetHandle, "BasicSafetyMessage", newPath);
  if(value.emergencyRequestFire.isValidFlag==1)
  {
    value.emergencyRequestFire.value = C2xGetTokenInt64(packetHandle, "BasicSafetyMessage", newPath);
    result = CheckLastError("BasicSafetyMessage", gkFuncRefGet, result);
  }
  snprintf(newPath, elcount(newPath), "%s.%s", oldPath, "emergencyRequestPolice");
  value.emergencyRequestPolice.isValidFlag = C2xIsTokenAvailable(packetHandle, "BasicSafetyMessage", newPath);
  if(value.emergencyRequestPolice.isValidFlag==1)
  {
    value.emergencyRequestPolice.value = C2xGetTokenInt64(packetHandle, "BasicSafetyMessage", newPath);
    result = CheckLastError("BasicSafetyMessage", gkFuncRefGet, result);
  }
  return result;
}

int SetBasicSafetyMessageSchoolBusJ2945Slash1CParams(LONG packetHandle, struct BasicSafetyMessageSchoolBusJ2945Slash1C value, char oldPath[])
{
  char newPath[300];
  int result;

  result = 0;

  snprintf(newPath, elcount(newPath), "%s.%s", oldPath, "flashingAmberLights");
  C2xSetTokenInt64(packetHandle, "BasicSafetyMessage", newPath, value.flashingAmberLights);
  result = CheckLastError("BasicSafetyMessage", gkFuncRefGet, result);

  snprintf(newPath, elcount(newPath), "%s.%s", oldPath, "flashingRedLights");
  C2xSetTokenInt64(packetHandle, "BasicSafetyMessage", newPath, value.flashingRedLights);
  result = CheckLastError("BasicSafetyMessage", gkFuncRefGet, result);

  snprintf(newPath, elcount(newPath), "%s.%s", oldPath, "studentsCrossingFront");
  if(value.studentsCrossingFront.isValidFlag==1)
  {
    C2xSetTokenInt64(packetHandle, "BasicSafetyMessage", newPath, value.studentsCrossingFront.value);
    result = CheckLastError("BasicSafetyMessage", gkFuncRefGet, result);
  }
  else
  {
    if( C2xIsTokenAvailable(packetHandle, "BasicSafetyMessage", newPath) )
    {
      C2xRemoveToken(packetHandle, "BasicSafetyMessage", newPath);
    }
  }

  snprintf(newPath, elcount(newPath), "%s.%s", oldPath, "studentsCrossingBehind");
  if(value.studentsCrossingBehind.isValidFlag==1)
  {
    C2xSetTokenInt64(packetHandle, "BasicSafetyMessage", newPath, value.studentsCrossingBehind.value);
    result = CheckLastError("BasicSafetyMessage", gkFuncRefGet, result);
  }
  else
  {
    if( C2xIsTokenAvailable(packetHandle, "BasicSafetyMessage", newPath) )
    {
      C2xRemoveToken(packetHandle, "BasicSafetyMessage", newPath);
    }
  }

  snprintf(newPath, elcount(newPath), "%s.%s", oldPath, "studentsLoading");
  if(value.studentsLoading.isValidFlag==1)
  {
    C2xSetTokenInt64(packetHandle, "BasicSafetyMessage", newPath, value.studentsLoading.value);
    result = CheckLastError("BasicSafetyMessage", gkFuncRefGet, result);
  }
  else
  {
    if( C2xIsTokenAvailable(packetHandle, "BasicSafetyMessage", newPath) )
    {
      C2xRemoveToken(packetHandle, "BasicSafetyMessage", newPath);
    }
  }

  snprintf(newPath, elcount(newPath), "%s.%s", oldPath, "studentsUnloading");
  if(value.studentsUnloading.isValidFlag==1)
  {
    C2xSetTokenInt64(packetHandle, "BasicSafetyMessage", newPath, value.studentsUnloading.value);
    result = CheckLastError("BasicSafetyMessage", gkFuncRefGet, result);
  }
  else
  {
    if( C2xIsTokenAvailable(packetHandle, "BasicSafetyMessage", newPath) )
    {
      C2xRemoveToken(packetHandle, "BasicSafetyMessage", newPath);
    }
  }

  snprintf(newPath, elcount(newPath), "%s.%s", oldPath, "wheelchairLiftInUse");
  if(value.wheelchairLiftInUse.isValidFlag==1)
  {
    C2xSetTokenInt64(packetHandle, "BasicSafetyMessage", newPath, value.wheelchairLiftInUse.value);
    result = CheckLastError("BasicSafetyMessage", gkFuncRefGet, result);
  }
  else
  {
    if( C2xIsTokenAvailable(packetHandle, "BasicSafetyMessage", newPath) )
    {
      C2xRemoveToken(packetHandle, "BasicSafetyMessage", newPath);
    }
  }

  snprintf(newPath, elcount(newPath), "%s.%s", oldPath, "emergencyExitOpen");
  if(value.emergencyExitOpen.isValidFlag==1)
  {
    C2xSetTokenInt64(packetHandle, "BasicSafetyMessage", newPath, value.emergencyExitOpen.value);
    result = CheckLastError("BasicSafetyMessage", gkFuncRefGet, result);
  }
  else
  {
    if( C2xIsTokenAvailable(packetHandle, "BasicSafetyMessage", newPath) )
    {
      C2xRemoveToken(packetHandle, "BasicSafetyMessage", newPath);
    }
  }

  snprintf(newPath, elcount(newPath), "%s.%s", oldPath, "emergencyRequestMedical");
  if(value.emergencyRequestMedical.isValidFlag==1)
  {
    C2xSetTokenInt64(packetHandle, "BasicSafetyMessage", newPath, value.emergencyRequestMedical.value);
    result = CheckLastError("BasicSafetyMessage", gkFuncRefGet, result);
  }
  else
  {
    if( C2xIsTokenAvailable(packetHandle, "BasicSafetyMessage", newPath) )
    {
      C2xRemoveToken(packetHandle, "BasicSafetyMessage", newPath);
    }
  }

  snprintf(newPath, elcount(newPath), "%s.%s", oldPath, "emergencyRequestFire");
  if(value.emergencyRequestFire.isValidFlag==1)
  {
    C2xSetTokenInt64(packetHandle, "BasicSafetyMessage", newPath, value.emergencyRequestFire.value);
    result = CheckLastError("BasicSafetyMessage", gkFuncRefGet, result);
  }
  else
  {
    if( C2xIsTokenAvailable(packetHandle, "BasicSafetyMessage", newPath) )
    {
      C2xRemoveToken(packetHandle, "BasicSafetyMessage", newPath);
    }
  }

  snprintf(newPath, elcount(newPath), "%s.%s", oldPath, "emergencyRequestPolice");
  if(value.emergencyRequestPolice.isValidFlag==1)
  {
    C2xSetTokenInt64(packetHandle, "BasicSafetyMessage", newPath, value.emergencyRequestPolice.value);
    result = CheckLastError("BasicSafetyMessage", gkFuncRefGet, result);
  }
  else
  {
    if( C2xIsTokenAvailable(packetHandle, "BasicSafetyMessage", newPath) )
    {
      C2xRemoveToken(packetHandle, "BasicSafetyMessage", newPath);
    }
  }

  return result;
}

int GetBasicSafetyMessageSupplementalVehicleExtensionsParams(LONG packetHandle, struct BasicSafetyMessageSupplementalVehicleExtensions value, char oldPath[])
{
  char newPath[300];
  int result;

  result = 0;

  snprintf(newPath, elcount(newPath), "%s.%s", oldPath, "classification");
  value.classification.isValidFlag = C2xIsTokenAvailable(packetHandle, "BasicSafetyMessage", newPath);
  if(value.classification.isValidFlag==1)
  {
    value.classification.value = C2xGetTokenInt(packetHandle, "BasicSafetyMessage", newPath);
    result = CheckLastError("BasicSafetyMessage", gkFuncRefGet, result);
  }
  snprintf(newPath, elcount(newPath), "%s.%s", oldPath, "classDetails");
  value.classDetails.isValidFlag = C2xIsTokenAvailable(packetHandle, "BasicSafetyMessage", newPath);
  if(value.classDetails.isValidFlag==1)
  {
    GetBasicSafetyMessageVehicleClassificationParams(packetHandle, value.classDetails, newPath);
    result = CheckLastError("BasicSafetyMessage", gkFuncRefGet, result);
  }
  snprintf(newPath, elcount(newPath), "%s.%s", oldPath, "vehicleData");
  value.vehicleData.isValidFlag = C2xIsTokenAvailable(packetHandle, "BasicSafetyMessage", newPath);
  if(value.vehicleData.isValidFlag==1)
  {
    GetBasicSafetyMessageVehicleDataParams(packetHandle, value.vehicleData, newPath);
    result = CheckLastError("BasicSafetyMessage", gkFuncRefGet, result);
  }
  snprintf(newPath, elcount(newPath), "%s.%s", oldPath, "doNotUse1");
  value.doNotUse1.isValidFlag = C2xIsTokenAvailable(packetHandle, "BasicSafetyMessage", newPath);
  if(value.doNotUse1.isValidFlag==1)
  {
    GetBasicSafetyMessageWeatherReportParams(packetHandle, value.doNotUse1, newPath);
    result = CheckLastError("BasicSafetyMessage", gkFuncRefGet, result);
  }
  snprintf(newPath, elcount(newPath), "%s.%s", oldPath, "doNotUse2");
  value.doNotUse2.isValidFlag = C2xIsTokenAvailable(packetHandle, "BasicSafetyMessage", newPath);
  if(value.doNotUse2.isValidFlag==1)
  {
    GetBasicSafetyMessageWeatherProbeParams(packetHandle, value.doNotUse2, newPath);
    result = CheckLastError("BasicSafetyMessage", gkFuncRefGet, result);
  }
  snprintf(newPath, elcount(newPath), "%s.%s", oldPath, "doNotUse3");
  value.doNotUse3.isValidFlag = C2xIsTokenAvailable(packetHandle, "BasicSafetyMessage", newPath);
  if(value.doNotUse3.isValidFlag==1)
  {
    GetBasicSafetyMessageObstacleDetectionParams(packetHandle, value.doNotUse3, newPath);
    result = CheckLastError("BasicSafetyMessage", gkFuncRefGet, result);
  }
  snprintf(newPath, elcount(newPath), "%s.%s", oldPath, "status");
  value.status.isValidFlag = C2xIsTokenAvailable(packetHandle, "BasicSafetyMessage", newPath);
  if(value.status.isValidFlag==1)
  {
    GetBasicSafetyMessageDisabledVehicleParams(packetHandle, value.status, newPath);
    result = CheckLastError("BasicSafetyMessage", gkFuncRefGet, result);
  }
  snprintf(newPath, elcount(newPath), "%s.%s", oldPath, "doNotUse4");
  value.doNotUse4.isValidFlag = C2xIsTokenAvailable(packetHandle, "BasicSafetyMessage", newPath);
  if(value.doNotUse4.isValidFlag==1)
  {
    GetBasicSafetyMessageSpeedProfileParams(packetHandle, value.doNotUse4, newPath);
    result = CheckLastError("BasicSafetyMessage", gkFuncRefGet, result);
  }
  snprintf(newPath, elcount(newPath), "%s.%s", oldPath, "doNotUse5");
  value.doNotUse5.isValidFlag = C2xIsTokenAvailable(packetHandle, "BasicSafetyMessage", newPath);
  if(value.doNotUse5.isValidFlag==1)
  {
    GetBasicSafetyMessageRTCMPackageParams(packetHandle, value.doNotUse5, newPath);
    result = CheckLastError("BasicSafetyMessage", gkFuncRefGet, result);
  }
  snprintf(newPath, elcount(newPath), "%s.%s", oldPath, "regional");
  value.regional.isValidFlag = C2xIsTokenAvailable(packetHandle, "BasicSafetyMessage", newPath);
  if(value.regional.isValidFlag==1)
  {
    GetBasicSafetyMessageSupplementalVehicleExtensions_regionalParams(packetHandle, value.regional, newPath);
    result = CheckLastError("BasicSafetyMessage", gkFuncRefGet, result);
  }
  snprintf(newPath, elcount(newPath), "%s.%s", oldPath, "fhwaVehicleClass");
  value.fhwaVehicleClass = C2xGetTokenInt(packetHandle, "BasicSafetyMessage", newPath);
  result = CheckLastError("BasicSafetyMessage", gkFuncRefGet, result);

  snprintf(newPath, elcount(newPath), "%s.%s", oldPath, "trailers");
  value.trailers.isValidFlag = C2xIsTokenAvailable(packetHandle, "BasicSafetyMessage", newPath);
  if(value.trailers.isValidFlag==1)
  {
    GetBasicSafetyMessageTrailersJ2945Slash1BParams(packetHandle, value.trailers, newPath);
    result = CheckLastError("BasicSafetyMessage", gkFuncRefGet, result);
  }
  snprintf(newPath, elcount(newPath), "%s.%s", oldPath, "schoolBus");
  value.schoolBus.isValidFlag = C2xIsTokenAvailable(packetHandle, "BasicSafetyMessage", newPath);
  if(value.schoolBus.isValidFlag==1)
  {
    GetBasicSafetyMessageSchoolBusJ2945Slash1CParams(packetHandle, value.schoolBus, newPath);
    result = CheckLastError("BasicSafetyMessage", gkFuncRefGet, result);
  }
  return result;
}

int SetBasicSafetyMessageSupplementalVehicleExtensionsParams(LONG packetHandle, struct BasicSafetyMessageSupplementalVehicleExtensions value, char oldPath[])
{
  char newPath[300];
  int result;

  result = 0;

  snprintf(newPath, elcount(newPath), "%s.%s", oldPath, "classification");
  if(value.classification.isValidFlag==1)
  {
    C2xSetTokenInt(packetHandle, "BasicSafetyMessage", newPath, value.classification.value);
    result = CheckLastError("BasicSafetyMessage", gkFuncRefGet, result);
  }
  else
  {
    if( C2xIsTokenAvailable(packetHandle, "BasicSafetyMessage", newPath) )
    {
      C2xRemoveToken(packetHandle, "BasicSafetyMessage", newPath);
    }
  }

  snprintf(newPath, elcount(newPath), "%s.%s", oldPath, "classDetails");
  if(value.classDetails.isValidFlag==1)
  {
    SetBasicSafetyMessageVehicleClassificationParams(packetHandle, value.classDetails, newPath);
    result = CheckLastError("BasicSafetyMessage", gkFuncRefGet, result);
  }
  else
  {
    if( C2xIsTokenAvailable(packetHandle, "BasicSafetyMessage", newPath) )
    {
      C2xRemoveToken(packetHandle, "BasicSafetyMessage", newPath);
    }
  }

  snprintf(newPath, elcount(newPath), "%s.%s", oldPath, "vehicleData");
  if(value.vehicleData.isValidFlag==1)
  {
    SetBasicSafetyMessageVehicleDataParams(packetHandle, value.vehicleData, newPath);
    result = CheckLastError("BasicSafetyMessage", gkFuncRefGet, result);
  }
  else
  {
    if( C2xIsTokenAvailable(packetHandle, "BasicSafetyMessage", newPath) )
    {
      C2xRemoveToken(packetHandle, "BasicSafetyMessage", newPath);
    }
  }

  snprintf(newPath, elcount(newPath), "%s.%s", oldPath, "doNotUse1");
  if(value.doNotUse1.isValidFlag==1)
  {
    SetBasicSafetyMessageWeatherReportParams(packetHandle, value.doNotUse1, newPath);
    result = CheckLastError("BasicSafetyMessage", gkFuncRefGet, result);
  }
  else
  {
    if( C2xIsTokenAvailable(packetHandle, "BasicSafetyMessage", newPath) )
    {
      C2xRemoveToken(packetHandle, "BasicSafetyMessage", newPath);
    }
  }

  snprintf(newPath, elcount(newPath), "%s.%s", oldPath, "doNotUse2");
  if(value.doNotUse2.isValidFlag==1)
  {
    SetBasicSafetyMessageWeatherProbeParams(packetHandle, value.doNotUse2, newPath);
    result = CheckLastError("BasicSafetyMessage", gkFuncRefGet, result);
  }
  else
  {
    if( C2xIsTokenAvailable(packetHandle, "BasicSafetyMessage", newPath) )
    {
      C2xRemoveToken(packetHandle, "BasicSafetyMessage", newPath);
    }
  }

  snprintf(newPath, elcount(newPath), "%s.%s", oldPath, "doNotUse3");
  if(value.doNotUse3.isValidFlag==1)
  {
    SetBasicSafetyMessageObstacleDetectionParams(packetHandle, value.doNotUse3, newPath);
    result = CheckLastError("BasicSafetyMessage", gkFuncRefGet, result);
  }
  else
  {
    if( C2xIsTokenAvailable(packetHandle, "BasicSafetyMessage", newPath) )
    {
      C2xRemoveToken(packetHandle, "BasicSafetyMessage", newPath);
    }
  }

  snprintf(newPath, elcount(newPath), "%s.%s", oldPath, "status");
  if(value.status.isValidFlag==1)
  {
    SetBasicSafetyMessageDisabledVehicleParams(packetHandle, value.status, newPath);
    result = CheckLastError("BasicSafetyMessage", gkFuncRefGet, result);
  }
  else
  {
    if( C2xIsTokenAvailable(packetHandle, "BasicSafetyMessage", newPath) )
    {
      C2xRemoveToken(packetHandle, "BasicSafetyMessage", newPath);
    }
  }

  snprintf(newPath, elcount(newPath), "%s.%s", oldPath, "doNotUse4");
  if(value.doNotUse4.isValidFlag==1)
  {
    SetBasicSafetyMessageSpeedProfileParams(packetHandle, value.doNotUse4, newPath);
    result = CheckLastError("BasicSafetyMessage", gkFuncRefGet, result);
  }
  else
  {
    if( C2xIsTokenAvailable(packetHandle, "BasicSafetyMessage", newPath) )
    {
      C2xRemoveToken(packetHandle, "BasicSafetyMessage", newPath);
    }
  }

  snprintf(newPath, elcount(newPath), "%s.%s", oldPath, "doNotUse5");
  if(value.doNotUse5.isValidFlag==1)
  {
    SetBasicSafetyMessageRTCMPackageParams(packetHandle, value.doNotUse5, newPath);
    result = CheckLastError("BasicSafetyMessage", gkFuncRefGet, result);
  }
  else
  {
    if( C2xIsTokenAvailable(packetHandle, "BasicSafetyMessage", newPath) )
    {
      C2xRemoveToken(packetHandle, "BasicSafetyMessage", newPath);
    }
  }

  snprintf(newPath, elcount(newPath), "%s.%s", oldPath, "regional");
  if(value.regional.isValidFlag==1)
  {
    SetBasicSafetyMessageSupplementalVehicleExtensions_regionalParams(packetHandle, value.regional, newPath);
    result = CheckLastError("BasicSafetyMessage", gkFuncRefGet, result);
  }
  else
  {
    if( C2xIsTokenAvailable(packetHandle, "BasicSafetyMessage", newPath) )
    {
      C2xRemoveToken(packetHandle, "BasicSafetyMessage", newPath);
    }
  }

  snprintf(newPath, elcount(newPath), "%s.%s", oldPath, "fhwaVehicleClass");
  if (value.fhwaVehicleClass < 1)
  {
    C2xSetTokenInt(packetHandle, "BasicSafetyMessage", newPath, 1);
  }
  else if (value.fhwaVehicleClass > 13)
  {
    C2xSetTokenInt(packetHandle, "BasicSafetyMessage", newPath, 13);
  }
  else
  {
    C2xSetTokenInt(packetHandle, "BasicSafetyMessage", newPath, value.fhwaVehicleClass);
  }
  result = CheckLastError("BasicSafetyMessage", gkFuncRefGet, result);

  snprintf(newPath, elcount(newPath), "%s.%s", oldPath, "trailers");
  if(value.trailers.isValidFlag==1)
  {
    SetBasicSafetyMessageTrailersJ2945Slash1BParams(packetHandle, value.trailers, newPath);
    result = CheckLastError("BasicSafetyMessage", gkFuncRefGet, result);
  }
  else
  {
    if( C2xIsTokenAvailable(packetHandle, "BasicSafetyMessage", newPath) )
    {
      C2xRemoveToken(packetHandle, "BasicSafetyMessage", newPath);
    }
  }

  snprintf(newPath, elcount(newPath), "%s.%s", oldPath, "schoolBus");
  if(value.schoolBus.isValidFlag==1)
  {
    SetBasicSafetyMessageSchoolBusJ2945Slash1CParams(packetHandle, value.schoolBus, newPath);
    result = CheckLastError("BasicSafetyMessage", gkFuncRefGet, result);
  }
  else
  {
    if( C2xIsTokenAvailable(packetHandle, "BasicSafetyMessage", newPath) )
    {
      C2xRemoveToken(packetHandle, "BasicSafetyMessage", newPath);
    }
  }

  return result;
}

int GetBasicSafetyMessagePartIIcontent_tableParams(LONG packetHandle, WORD tableKey, struct BasicSafetyMessagePartIIcontent_table value, char oldPath[])
{
  char newPath[300];
  int result;

  result = 0;

  switch(tableKey)
  {
    case 0:
    {
      snprintf(newPath, elcount(newPath), "%s.%s", oldPath, "vehicleSafetyExt");
      GetBasicSafetyMessageVehicleSafetyExtensionsParams(packetHandle, value.vehicleSafetyExt, newPath);
      result = CheckLastError("BasicSafetyMessage", gkFuncRefGet, result);
    }
    break;
    case 1:
    {
      snprintf(newPath, elcount(newPath), "%s.%s", oldPath, "specialVehicleExt");
      GetBasicSafetyMessageSpecialVehicleExtensionsParams(packetHandle, value.specialVehicleExt, newPath);
      result = CheckLastError("BasicSafetyMessage", gkFuncRefGet, result);
    }
    break;
    case 2:
    {
      snprintf(newPath, elcount(newPath), "%s.%s", oldPath, "supplementalVehicleExt");
      GetBasicSafetyMessageSupplementalVehicleExtensionsParams(packetHandle, value.supplementalVehicleExt, newPath);
      result = CheckLastError("BasicSafetyMessage", gkFuncRefGet, result);
    }
    break;
  }
  return result;
}

int SetBasicSafetyMessagePartIIcontent_tableParams(LONG packetHandle, WORD tableKey, struct BasicSafetyMessagePartIIcontent_table value, char oldPath[])
{
  char newPath[300];
  int result;

  result = 0;

  switch(tableKey)
  {
    case 0:
    {
      snprintf(newPath, elcount(newPath), "%s.%s", oldPath, "vehicleSafetyExt");
      SetBasicSafetyMessageVehicleSafetyExtensionsParams(packetHandle, value.vehicleSafetyExt, newPath);
      result = CheckLastError("BasicSafetyMessage", gkFuncRefGet, result);
    }
    break;
    case 1:
    {
      snprintf(newPath, elcount(newPath), "%s.%s", oldPath, "specialVehicleExt");
      SetBasicSafetyMessageSpecialVehicleExtensionsParams(packetHandle, value.specialVehicleExt, newPath);
      result = CheckLastError("BasicSafetyMessage", gkFuncRefGet, result);
    }
    break;
    case 2:
    {
      snprintf(newPath, elcount(newPath), "%s.%s", oldPath, "supplementalVehicleExt");
      SetBasicSafetyMessageSupplementalVehicleExtensionsParams(packetHandle, value.supplementalVehicleExt, newPath);
      result = CheckLastError("BasicSafetyMessage", gkFuncRefGet, result);
    }
    break;
  }
  return result;
}

int GetBasicSafetyMessagePartIIcontentParams(LONG packetHandle, struct BasicSafetyMessagePartIIcontent value, char oldPath[])
{
  char newPath[300];
  int result;

  result = 0;

  snprintf(newPath, elcount(newPath), "%s.%s", oldPath, "partII_Id");
  value.partII_Id = C2xGetTokenInt(packetHandle, "BasicSafetyMessage", newPath);
  result = CheckLastError("BasicSafetyMessage", gkFuncRefGet, result);

  snprintf(newPath, elcount(newPath), "%s.%s", oldPath, "partII_Value");
  GetBasicSafetyMessagePartIIcontent_tableParams(packetHandle, value.partII_Id, value.partII_Value, newPath);
  result = CheckLastError("BasicSafetyMessage", gkFuncRefGet, result);

  return result;
}

int SetBasicSafetyMessagePartIIcontentParams(LONG packetHandle, struct BasicSafetyMessagePartIIcontent value, char oldPath[])
{
  char newPath[300];
  int result;

  result = 0;


  snprintf(newPath, elcount(newPath), "%s.%s", oldPath, "partII_Value");
  SetBasicSafetyMessagePartIIcontent_tableParams(packetHandle, value.partII_Id, value.partII_Value, newPath);
  result = CheckLastError("BasicSafetyMessage", gkFuncRefGet, result);

  return result;
}

int GetBasicSafetyMessageBasicSafetyMessage_partIIParams(LONG packetHandle, struct BasicSafetyMessageBasicSafetyMessage_partII value, char oldPath[])
{
  char newPath[300]; 
  int i;
  int result;

  result = 0;

  value.length = C2xGetTokenInt(packetHandle, "BasicSafetyMessage", oldPath);
  if((result = CheckLastError("BasicSafetyMessage", gkFuncRefGet, result))==0)
  {
    for(i=0; i<value.length; i++)
    {
      snprintf(newPath, elcount(newPath), "%s[%d]", oldPath, i);
      GetBasicSafetyMessagePartIIcontentParams(packetHandle, value.arrayValue[i], newPath);
      result = CheckLastError("BasicSafetyMessage", gkFuncRefGet, result);
    }
  }
  return result;
}

int SetBasicSafetyMessageBasicSafetyMessage_partIIParams(LONG packetHandle, struct BasicSafetyMessageBasicSafetyMessage_partII value, char oldPath[])
{
  char newPath[300]; 
  int i;
  int result;

  result = 0;

  C2xRemoveToken(packetHandle, "BasicSafetyMessage", oldPath);
  for(i=0; i<value.length; i++)
  {
    snprintf(newPath, elcount(newPath), "%s[%d]", oldPath, i);
    SetBasicSafetyMessagePartIIcontentParams(packetHandle, value.arrayValue[i], newPath);
    result = CheckLastError("BasicSafetyMessage", gkFuncRefGet, result);
  }
  return result;
}

int GetBasicSafetyMessageRegionalExtension_Reg_BasicSafetyMessageParams(LONG packetHandle, struct BasicSafetyMessageRegionalExtension_Reg_BasicSafetyMessage value, char oldPath[])
{
  char newPath[300];
  int result;

  result = 0;

  snprintf(newPath, elcount(newPath), "%s.%s", oldPath, "regionId");
  value.regionId = C2xGetTokenInt(packetHandle, "BasicSafetyMessage", newPath);
  result = CheckLastError("BasicSafetyMessage", gkFuncRefGet, result);

  return result;
}

int SetBasicSafetyMessageRegionalExtension_Reg_BasicSafetyMessageParams(LONG packetHandle, struct BasicSafetyMessageRegionalExtension_Reg_BasicSafetyMessage value, char oldPath[])
{
  char newPath[300];
  int result;

  result = 0;


  return result;
}

int GetBasicSafetyMessageBasicSafetyMessage_regionalParams(LONG packetHandle, struct BasicSafetyMessageBasicSafetyMessage_regional value, char oldPath[])
{
  char newPath[300]; 
  int i;
  int result;

  result = 0;

  value.length = C2xGetTokenInt(packetHandle, "BasicSafetyMessage", oldPath);
  if((result = CheckLastError("BasicSafetyMessage", gkFuncRefGet, result))==0)
  {
    for(i=0; i<value.length; i++)
    {
      snprintf(newPath, elcount(newPath), "%s[%d]", oldPath, i);
      GetBasicSafetyMessageRegionalExtension_Reg_BasicSafetyMessageParams(packetHandle, value.arrayValue[i], newPath);
      result = CheckLastError("BasicSafetyMessage", gkFuncRefGet, result);
    }
  }
  return result;
}

int SetBasicSafetyMessageBasicSafetyMessage_regionalParams(LONG packetHandle, struct BasicSafetyMessageBasicSafetyMessage_regional value, char oldPath[])
{
  char newPath[300]; 
  int i;
  int result;

  result = 0;

  C2xRemoveToken(packetHandle, "BasicSafetyMessage", oldPath);
  for(i=0; i<value.length; i++)
  {
    snprintf(newPath, elcount(newPath), "%s[%d]", oldPath, i);
    SetBasicSafetyMessageRegionalExtension_Reg_BasicSafetyMessageParams(packetHandle, value.arrayValue[i], newPath);
    result = CheckLastError("BasicSafetyMessage", gkFuncRefGet, result);
  }
  return result;
}

int GetBasicSafetyMessage_BasicSafetyMessageParams(LONG packetHandle, struct BasicSafetyMessage_BasicSafetyMessage value, char oldPath[])
{
  char newPath[300];
  int result;

  result = 0;

  snprintf(newPath, elcount(newPath), "%s.%s", oldPath, "coreData");
  GetBasicSafetyMessageBSMcoreDataParams(packetHandle, value.coreData, newPath);
  result = CheckLastError("BasicSafetyMessage", gkFuncRefGet, result);

  snprintf(newPath, elcount(newPath), "%s.%s", oldPath, "partII");
  value.partII.isValidFlag = C2xIsTokenAvailable(packetHandle, "BasicSafetyMessage", newPath);
  if(value.partII.isValidFlag==1)
  {
    GetBasicSafetyMessageBasicSafetyMessage_partIIParams(packetHandle, value.partII, newPath);
    result = CheckLastError("BasicSafetyMessage", gkFuncRefGet, result);
  }
  snprintf(newPath, elcount(newPath), "%s.%s", oldPath, "regional");
  value.regional.isValidFlag = C2xIsTokenAvailable(packetHandle, "BasicSafetyMessage", newPath);
  if(value.regional.isValidFlag==1)
  {
    GetBasicSafetyMessageBasicSafetyMessage_regionalParams(packetHandle, value.regional, newPath);
    result = CheckLastError("BasicSafetyMessage", gkFuncRefGet, result);
  }
  return result;
}

int SetBasicSafetyMessage_BasicSafetyMessageParams(LONG packetHandle, struct BasicSafetyMessage_BasicSafetyMessage value, char oldPath[])
{
  char newPath[300];
  int result;

  result = 0;

  snprintf(newPath, elcount(newPath), "%s.%s", oldPath, "coreData");
  SetBasicSafetyMessageBSMcoreDataParams(packetHandle, value.coreData, newPath);
  result = CheckLastError("BasicSafetyMessage", gkFuncRefGet, result);

  snprintf(newPath, elcount(newPath), "%s.%s", oldPath, "partII");
  if(value.partII.isValidFlag==1)
  {
    SetBasicSafetyMessageBasicSafetyMessage_partIIParams(packetHandle, value.partII, newPath);
    result = CheckLastError("BasicSafetyMessage", gkFuncRefGet, result);
  }
  else
  {
    if( C2xIsTokenAvailable(packetHandle, "BasicSafetyMessage", newPath) )
    {
      C2xRemoveToken(packetHandle, "BasicSafetyMessage", newPath);
    }
  }

  snprintf(newPath, elcount(newPath), "%s.%s", oldPath, "regional");
  if(value.regional.isValidFlag==1)
  {
    SetBasicSafetyMessageBasicSafetyMessage_regionalParams(packetHandle, value.regional, newPath);
    result = CheckLastError("BasicSafetyMessage", gkFuncRefGet, result);
  }
  else
  {
    if( C2xIsTokenAvailable(packetHandle, "BasicSafetyMessage", newPath) )
    {
      C2xRemoveToken(packetHandle, "BasicSafetyMessage", newPath);
    }
  }

  return result;
}

int GetBasicSafetyMessageMESSAGE_ID_AND_TYPEParams(LONG packetHandle, WORD tableKey, struct BasicSafetyMessageMESSAGE_ID_AND_TYPE value, char oldPath[])
{
  char newPath[300];
  int result;

  result = 0;

  switch(tableKey)
  {
    case 20:
    {
      snprintf(newPath, elcount(newPath), "%s.%s", oldPath, "basicSafetyMessage");
      GetBasicSafetyMessage_BasicSafetyMessageParams(packetHandle, value.basicSafetyMessage, newPath);
      result = CheckLastError("BasicSafetyMessage", gkFuncRefGet, result);
    }
    break;
  }
  return result;
}

int SetBasicSafetyMessageMESSAGE_ID_AND_TYPEParams(LONG packetHandle, WORD tableKey, struct BasicSafetyMessageMESSAGE_ID_AND_TYPE value, char oldPath[])
{
  char newPath[300];
  int result;

  result = 0;

  switch(tableKey)
  {
    case 20:
    {
      snprintf(newPath, elcount(newPath), "%s.%s", oldPath, "basicSafetyMessage");
      SetBasicSafetyMessage_BasicSafetyMessageParams(packetHandle, value.basicSafetyMessage, newPath);
      result = CheckLastError("BasicSafetyMessage", gkFuncRefGet, result);
    }
    break;
  }
  return result;
}

int API_GetBasicSafetyMessageParams(LONG packetHandle, struct BasicSafetyMessage value)
{
  int result;
  result = 0;

  value.messageId = C2xGetTokenInt(packetHandle, "BasicSafetyMessage", "messageId");
  result = CheckLastError("BasicSafetyMessage", gkFuncRefGet, result);

  GetBasicSafetyMessageMESSAGE_ID_AND_TYPEParams(packetHandle, value.messageId, value.value, "value");
  result = CheckLastError("BasicSafetyMessage", gkFuncRefGet, result);

  return result;
}

int API_SetBasicSafetyMessageParams(LONG packetHandle, struct BasicSafetyMessage value)
{
  int result;
  result = 0;

  value.messageId = 20;

  SetBasicSafetyMessageMESSAGE_ID_AND_TYPEParams(packetHandle, value.messageId, value.value, "value");
  result = CheckLastError("BasicSafetyMessage", gkFuncRefGet, result);

  return result;
}

