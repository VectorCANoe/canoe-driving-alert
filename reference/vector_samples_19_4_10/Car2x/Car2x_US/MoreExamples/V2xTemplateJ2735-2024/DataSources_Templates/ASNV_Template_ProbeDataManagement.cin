/*@!Encoding:1252*/
/*
//  (c) Vector Informatik GmbH. All rights reserved.
//
//  This file contains definitions of structs and methods that may be used
//  to set and get the values of an ASN.1 defined packet's payload.
//
//  //This example demonstrates how to set a packet's payload:
//  LONG packetHandle;
//  struct ProbeDataManagement payload;
//  //you need to set the values of the variable "payload" yourself
//  packetHandle = API_InitProbeDataManagementPacket();
//  if (packetHandle!=0) {
//    if (API_SetProbeDataManagementParams(packetHandle, payload)==0) {
//      if (C2xCompletePacket(packetHandle)==0) {
//        C2xOutputPacket(packetHandle);
//      }
//    }
//  }
//                                                                             */
includes
{
  #include "ASNV_Template_BaseDatatypes.cin"  // If warning "Duplicate #include, ignoring this include" appears, please remove the ASNV_Template_BaseDatatypes.cin include from your other *.cin files in the project.
}
variables
{
    struct ProbeDataManagementSample {
        INT isValidFlag;   // necessary if this struct is used as an optional field of a SEQUENCE
        BYTE sampleStart;  // INTEGER, 0..255;
        BYTE sampleEnd;  // INTEGER, 0..255;
    };
    
    struct ProbeDataManagementCommon_HeadingSlice {
        INT isValidFlag;   // necessary if this struct is used as an optional field of a SEQUENCE
        CHAR string[17];
        INT  stringLength;
    };
    
    struct ProbeDataManagementProbeDataManagement_term {
        INT isValidFlag;   // necessary if this struct is used as an optional field of a SEQUENCE
        INT choice;
        WORD termtime;  // INTEGER, 1..1800;
        WORD termDistance;  // INTEGER, 1..30000;
    };
    
    struct ProbeDataManagementSnapshotTime {
        INT isValidFlag;   // necessary if this struct is used as an optional field of a SEQUENCE
        BYTE speed1;  // INTEGER, 0..31;
        BYTE time1;  // INTEGER, 0..61;
        BYTE speed2;  // INTEGER, 0..31;
        BYTE time2;  // INTEGER, 0..61;
    };
    
    struct ProbeDataManagementSnapshotDistance {
        INT isValidFlag;   // necessary if this struct is used as an optional field of a SEQUENCE
        WORD distance1;  // INTEGER, 0..1023;
        BYTE speed1;  // INTEGER, 0..31;
        WORD distance2;  // INTEGER, 0..1023;
        BYTE speed2;  // INTEGER, 0..31;
    };
    
    struct ProbeDataManagementProbeDataManagement_snapshot {
        INT isValidFlag;   // necessary if this struct is used as an optional field of a SEQUENCE
        INT choice;
        struct ProbeDataManagementSnapshotTime snapshotTime;  // SEQUENCE;
        struct ProbeDataManagementSnapshotDistance snapshotDistance;  // SEQUENCE;
    };
    
    struct ProbeDataManagementVehicleStatusRequest {
        INT isValidFlag;   // necessary if this struct is used as an optional field of a SEQUENCE
        INT dataType;  // ENUMERATED, unknown(0), lights(1), wipers(2), brakes(3), stab(4), trac(5), antiLockBrake(6), sunS(7), rainS(8), airTemp(9), steering(10), vertAccelThres(11), vertAccel(12), hozAccelLong(13), hozAccelLat(14), hozAccelCon(15), accel4way(16), confidenceSet(17), obDist(18), obDirect(19), yaw(20), yawRateCon(21), dateTime(22), fullPos(23), position2D(24), position3D(25), vehicle(26), speedHeadC(27), speedC(28);
        struct OPT_BYTE_ASN subType;  // INTEGER, OPTIONAL, 1..15;
        struct OPT_INT_ASN sendOnLessThenValue;  // INTEGER, OPTIONAL, -32767..32767;
        struct OPT_INT_ASN sendOnMoreThenValue;  // INTEGER, OPTIONAL, -32767..32767;
        struct OPT_BOOL_ASN sendAll;  // BOOLEAN, OPTIONAL;
    };
    
    struct ProbeDataManagementVehicleStatusRequestList {
        INT isValidFlag;   // necessary if this struct is used as an optional field of a SEQUENCE
        INT length;
        struct ProbeDataManagementVehicleStatusRequest arrayValue[32];  // SEQUENCE;
    };
    
    struct ProbeDataManagementCommon_RegionalExtension_Reg_ProbeDataManagement_table {
    };
    
    struct ProbeDataManagementCommon_RegionalExtension_Reg_ProbeDataManagement {
        INT isValidFlag;   // necessary if this struct is used as an optional field of a SEQUENCE
        BYTE regionId;  // INTEGER, 0..255, noRegion(0), addGrpA(1), addGrpB(2), addGrpC(3), addGrpD(4);
        struct ProbeDataManagementCommon_RegionalExtension_Reg_ProbeDataManagement_table regExtvalue;  // TABLE;
    };
    
    struct ProbeDataManagementProbeDataManagement_regional {
        INT isValidFlag;   // necessary if this struct is used as an optional field of a SEQUENCE
        INT length;
        struct ProbeDataManagementCommon_RegionalExtension_Reg_ProbeDataManagement arrayValue[4];  // SEQUENCE;
    };
    
    struct ProbeDataManagement_ProbeDataManagement {
        INT isValidFlag;   // necessary if this struct is used as an optional field of a SEQUENCE
        struct OPT_DWORD_ASN timeStamp;  // INTEGER, OPTIONAL, 0..527040;
        struct ProbeDataManagementSample sample;  // SEQUENCE;
        struct ProbeDataManagementCommon_HeadingSlice directions;  // BITSTRING;
        struct ProbeDataManagementProbeDataManagement_term term;  // CHOICE;
        struct ProbeDataManagementProbeDataManagement_snapshot snapshot;  // CHOICE;
        BYTE txInterval;  // INTEGER, 0..61;
        struct ProbeDataManagementVehicleStatusRequestList dataElements;  // SEQUENCEOF, OPTIONAL;
        struct ProbeDataManagementProbeDataManagement_regional regional;  // SEQUENCEOF, OPTIONAL;
    };
    
    struct ProbeDataManagementMESSAGE_ID_AND_TYPE {
        struct ProbeDataManagement_ProbeDataManagement probeDataManagement;  // SEQUENCE;
    };
    
    struct ProbeDataManagement {
        INT isValidFlag;   // necessary if this struct is used as an optional field of a SEQUENCE
        WORD messageId;  // INTEGER, 0..32767, mapData(18), signalPhaseAndTimingMessage(19), basicSafetyMessage(20), commonSafetyRequest(21), emergencyVehicleAlert(22), intersectionCollision(23), nmeaCorrections(24), probeDataManagement(25), probeVehicleData(26), roadSideAlert(27), rtcmCorrections(28), signalRequestMessage(29), signalStatusMessage(30), travelerInformation(31), personalSafetyMessage(32), roadSafetyMessage(33), roadWeatherMessage(34), probeDataConfigMessage(35), probeDataReportMessage(36), tollAdvertisementMessage(37), tollUsageMessage(38), tollUsageAckMessage(39), cooperativeControlMessage(40), sensorDataSharingMessage(41), maneuverSharingAndCoordinatingMessage(42), roadGeometryAndAttributes(43), personalSafetyMessage2(44), trafficSignalPhaseAndTiming(45), signalControlAndPrioritizationRequest(46), signalControlAndPrioritizationStatus(47), roadUserChargingConfigMessage(48), roadUserChargingReportMessage(49), trafficLightStatusMessage(50);
        struct ProbeDataManagementMESSAGE_ID_AND_TYPE value;  // TABLE;
    };
    
}

/*
// init function to create a simple packet handle
*/ 
LONG API_InitProbeDataManagementPacket()
{
  return C2xInitPacket("ProbeDataManagement"); 
}

/*
// init function to create a simple packet handle and
// initialize the struct with valid data
*/ 
LONG API_InitProbeDataManagementPacket(struct ProbeDataManagement msgStruct)
{
  long pktHandle;

  pktHandle = API_InitProbeDataManagementPacket();

  if (pktHandle != 0)
  {
    // create valid message and application data
    if (C2xCompletePacket(pktHandle) == 0) 
    {
      API_GetProbeDataManagementParams(pktHandle, msgStruct);
    }
  }
  return pktHandle;
}

/*
// init function to create a packet with security layer and
// initialize the struct with valid data
*/ 
LONG API_InitProbeDataManagementPacket(struct ProbeDataManagement msgStruct, char packetTypeDesignator[], char certificateName[])
{
  long pktHandle, certHdl;

  // initialize the packet
  pktHandle = C2xInitPacket("ProbeDataManagement", packetTypeDesignator);

  if (pktHandle != 0)
  {
    certHdl = C2xSecCertificateGetHandle(certificateName);  // get the certificate handle for the cert with name "certificateName"
    if (certHdl != 0) 
    {
      C2xSecPacketSetSignerHandle(pktHandle, certHdl); // set the certHdl to the packet
    }

    // create valid message and application data
    if (C2xCompletePacket(pktHandle) == 0) 
    {
      // copy application data to the application structure
      API_GetProbeDataManagementParams(pktHandle, msgStruct);
    }
  }
  return pktHandle;
}
    

int GetProbeDataManagementSampleParams(LONG packetHandle, struct ProbeDataManagementSample value, char oldPath[])
{
  char newPath[300];
  int result;

  result = 0;

  snprintf(newPath, elcount(newPath), "%s.%s", oldPath, "sampleStart");
  value.sampleStart = C2xGetTokenInt(packetHandle, "ProbeDataManagement", newPath);
  result = CheckLastError("ProbeDataManagement", gkFuncRefGet, result);

  snprintf(newPath, elcount(newPath), "%s.%s", oldPath, "sampleEnd");
  value.sampleEnd = C2xGetTokenInt(packetHandle, "ProbeDataManagement", newPath);
  result = CheckLastError("ProbeDataManagement", gkFuncRefGet, result);

  return result;
}

int SetProbeDataManagementSampleParams(LONG packetHandle, struct ProbeDataManagementSample value, char oldPath[])
{
  char newPath[300];
  int result;

  result = 0;

  snprintf(newPath, elcount(newPath), "%s.%s", oldPath, "sampleStart");
  C2xSetTokenInt(packetHandle, "ProbeDataManagement", newPath, value.sampleStart);
  result = CheckLastError("ProbeDataManagement", gkFuncRefGet, result);

  snprintf(newPath, elcount(newPath), "%s.%s", oldPath, "sampleEnd");
  C2xSetTokenInt(packetHandle, "ProbeDataManagement", newPath, value.sampleEnd);
  result = CheckLastError("ProbeDataManagement", gkFuncRefGet, result);

  return result;
}

int GetProbeDataManagementProbeDataManagement_termParams(LONG packetHandle, struct ProbeDataManagementProbeDataManagement_term value, char oldPath[])
{
  char newPath[300];
  int result;

  result = 0;

  value.choice = C2xGetTokenInt(packetHandle, "ProbeDataManagement", oldPath);

  switch(value.choice)
  {
    case 0:
    {
      snprintf(newPath, elcount(newPath), "%s.%s", oldPath, "termtime");
      value.termtime = C2xGetTokenInt(packetHandle, "ProbeDataManagement", newPath);
      result = CheckLastError("ProbeDataManagement", gkFuncRefGet, result);
    }
    break;
    case 1:
    {
      snprintf(newPath, elcount(newPath), "%s.%s", oldPath, "termDistance");
      value.termDistance = C2xGetTokenInt(packetHandle, "ProbeDataManagement", newPath);
      result = CheckLastError("ProbeDataManagement", gkFuncRefGet, result);
    }
    break;
  }
  return result;
}

int SetProbeDataManagementProbeDataManagement_termParams(LONG packetHandle, struct ProbeDataManagementProbeDataManagement_term value, char oldPath[])
{
  char newPath[300];
  int result;

  result = 0;

  switch(value.choice)
  {
    case 0:
    {
      snprintf(newPath, elcount(newPath), "%s.%s", oldPath, "termtime");
      C2xSetTokenInt(packetHandle, "ProbeDataManagement", newPath, value.termtime);
      result = CheckLastError("ProbeDataManagement", gkFuncRefGet, result);
    }
    break;
    case 1:
    {
      snprintf(newPath, elcount(newPath), "%s.%s", oldPath, "termDistance");
      C2xSetTokenInt(packetHandle, "ProbeDataManagement", newPath, value.termDistance);
      result = CheckLastError("ProbeDataManagement", gkFuncRefGet, result);
    }
    break;
  }
  return result;
}

int GetProbeDataManagementSnapshotTimeParams(LONG packetHandle, struct ProbeDataManagementSnapshotTime value, char oldPath[])
{
  char newPath[300];
  int result;

  result = 0;

  snprintf(newPath, elcount(newPath), "%s.%s", oldPath, "speed1");
  value.speed1 = C2xGetTokenInt(packetHandle, "ProbeDataManagement", newPath);
  result = CheckLastError("ProbeDataManagement", gkFuncRefGet, result);

  snprintf(newPath, elcount(newPath), "%s.%s", oldPath, "time1");
  value.time1 = C2xGetTokenInt(packetHandle, "ProbeDataManagement", newPath);
  result = CheckLastError("ProbeDataManagement", gkFuncRefGet, result);

  snprintf(newPath, elcount(newPath), "%s.%s", oldPath, "speed2");
  value.speed2 = C2xGetTokenInt(packetHandle, "ProbeDataManagement", newPath);
  result = CheckLastError("ProbeDataManagement", gkFuncRefGet, result);

  snprintf(newPath, elcount(newPath), "%s.%s", oldPath, "time2");
  value.time2 = C2xGetTokenInt(packetHandle, "ProbeDataManagement", newPath);
  result = CheckLastError("ProbeDataManagement", gkFuncRefGet, result);

  return result;
}

int SetProbeDataManagementSnapshotTimeParams(LONG packetHandle, struct ProbeDataManagementSnapshotTime value, char oldPath[])
{
  char newPath[300];
  int result;

  result = 0;

  snprintf(newPath, elcount(newPath), "%s.%s", oldPath, "speed1");
  C2xSetTokenInt(packetHandle, "ProbeDataManagement", newPath, value.speed1);
  result = CheckLastError("ProbeDataManagement", gkFuncRefGet, result);

  snprintf(newPath, elcount(newPath), "%s.%s", oldPath, "time1");
  C2xSetTokenInt(packetHandle, "ProbeDataManagement", newPath, value.time1);
  result = CheckLastError("ProbeDataManagement", gkFuncRefGet, result);

  snprintf(newPath, elcount(newPath), "%s.%s", oldPath, "speed2");
  C2xSetTokenInt(packetHandle, "ProbeDataManagement", newPath, value.speed2);
  result = CheckLastError("ProbeDataManagement", gkFuncRefGet, result);

  snprintf(newPath, elcount(newPath), "%s.%s", oldPath, "time2");
  C2xSetTokenInt(packetHandle, "ProbeDataManagement", newPath, value.time2);
  result = CheckLastError("ProbeDataManagement", gkFuncRefGet, result);

  return result;
}

int GetProbeDataManagementSnapshotDistanceParams(LONG packetHandle, struct ProbeDataManagementSnapshotDistance value, char oldPath[])
{
  char newPath[300];
  int result;

  result = 0;

  snprintf(newPath, elcount(newPath), "%s.%s", oldPath, "distance1");
  value.distance1 = C2xGetTokenInt(packetHandle, "ProbeDataManagement", newPath);
  result = CheckLastError("ProbeDataManagement", gkFuncRefGet, result);

  snprintf(newPath, elcount(newPath), "%s.%s", oldPath, "speed1");
  value.speed1 = C2xGetTokenInt(packetHandle, "ProbeDataManagement", newPath);
  result = CheckLastError("ProbeDataManagement", gkFuncRefGet, result);

  snprintf(newPath, elcount(newPath), "%s.%s", oldPath, "distance2");
  value.distance2 = C2xGetTokenInt(packetHandle, "ProbeDataManagement", newPath);
  result = CheckLastError("ProbeDataManagement", gkFuncRefGet, result);

  snprintf(newPath, elcount(newPath), "%s.%s", oldPath, "speed2");
  value.speed2 = C2xGetTokenInt(packetHandle, "ProbeDataManagement", newPath);
  result = CheckLastError("ProbeDataManagement", gkFuncRefGet, result);

  return result;
}

int SetProbeDataManagementSnapshotDistanceParams(LONG packetHandle, struct ProbeDataManagementSnapshotDistance value, char oldPath[])
{
  char newPath[300];
  int result;

  result = 0;

  snprintf(newPath, elcount(newPath), "%s.%s", oldPath, "distance1");
  C2xSetTokenInt(packetHandle, "ProbeDataManagement", newPath, value.distance1);
  result = CheckLastError("ProbeDataManagement", gkFuncRefGet, result);

  snprintf(newPath, elcount(newPath), "%s.%s", oldPath, "speed1");
  C2xSetTokenInt(packetHandle, "ProbeDataManagement", newPath, value.speed1);
  result = CheckLastError("ProbeDataManagement", gkFuncRefGet, result);

  snprintf(newPath, elcount(newPath), "%s.%s", oldPath, "distance2");
  C2xSetTokenInt(packetHandle, "ProbeDataManagement", newPath, value.distance2);
  result = CheckLastError("ProbeDataManagement", gkFuncRefGet, result);

  snprintf(newPath, elcount(newPath), "%s.%s", oldPath, "speed2");
  C2xSetTokenInt(packetHandle, "ProbeDataManagement", newPath, value.speed2);
  result = CheckLastError("ProbeDataManagement", gkFuncRefGet, result);

  return result;
}

int GetProbeDataManagementProbeDataManagement_snapshotParams(LONG packetHandle, struct ProbeDataManagementProbeDataManagement_snapshot value, char oldPath[])
{
  char newPath[300];
  int result;

  result = 0;

  value.choice = C2xGetTokenInt(packetHandle, "ProbeDataManagement", oldPath);

  switch(value.choice)
  {
    case 0:
    {
      snprintf(newPath, elcount(newPath), "%s.%s", oldPath, "snapshotTime");
      GetProbeDataManagementSnapshotTimeParams(packetHandle, value.snapshotTime, newPath);
      result = CheckLastError("ProbeDataManagement", gkFuncRefGet, result);
    }
    break;
    case 1:
    {
      snprintf(newPath, elcount(newPath), "%s.%s", oldPath, "snapshotDistance");
      GetProbeDataManagementSnapshotDistanceParams(packetHandle, value.snapshotDistance, newPath);
      result = CheckLastError("ProbeDataManagement", gkFuncRefGet, result);
    }
    break;
  }
  return result;
}

int SetProbeDataManagementProbeDataManagement_snapshotParams(LONG packetHandle, struct ProbeDataManagementProbeDataManagement_snapshot value, char oldPath[])
{
  char newPath[300];
  int result;

  result = 0;

  switch(value.choice)
  {
    case 0:
    {
      snprintf(newPath, elcount(newPath), "%s.%s", oldPath, "snapshotTime");
      SetProbeDataManagementSnapshotTimeParams(packetHandle, value.snapshotTime, newPath);
      result = CheckLastError("ProbeDataManagement", gkFuncRefGet, result);
    }
    break;
    case 1:
    {
      snprintf(newPath, elcount(newPath), "%s.%s", oldPath, "snapshotDistance");
      SetProbeDataManagementSnapshotDistanceParams(packetHandle, value.snapshotDistance, newPath);
      result = CheckLastError("ProbeDataManagement", gkFuncRefGet, result);
    }
    break;
  }
  return result;
}

int GetProbeDataManagementVehicleStatusRequestParams(LONG packetHandle, struct ProbeDataManagementVehicleStatusRequest value, char oldPath[])
{
  char newPath[300];
  int result;

  result = 0;

  snprintf(newPath, elcount(newPath), "%s.%s", oldPath, "dataType");
  value.dataType = C2xGetTokenInt(packetHandle, "ProbeDataManagement", newPath);
  result = CheckLastError("ProbeDataManagement", gkFuncRefGet, result);

  snprintf(newPath, elcount(newPath), "%s.%s", oldPath, "subType");
  value.subType.isValidFlag = C2xIsTokenAvailable(packetHandle, "ProbeDataManagement", newPath);
  if(value.subType.isValidFlag==1)
  {
    value.subType.value = C2xGetTokenInt(packetHandle, "ProbeDataManagement", newPath);
    result = CheckLastError("ProbeDataManagement", gkFuncRefGet, result);
  }
  snprintf(newPath, elcount(newPath), "%s.%s", oldPath, "sendOnLessThenValue");
  value.sendOnLessThenValue.isValidFlag = C2xIsTokenAvailable(packetHandle, "ProbeDataManagement", newPath);
  if(value.sendOnLessThenValue.isValidFlag==1)
  {
    value.sendOnLessThenValue.value = C2xGetTokenInt(packetHandle, "ProbeDataManagement", newPath);
    result = CheckLastError("ProbeDataManagement", gkFuncRefGet, result);
  }
  snprintf(newPath, elcount(newPath), "%s.%s", oldPath, "sendOnMoreThenValue");
  value.sendOnMoreThenValue.isValidFlag = C2xIsTokenAvailable(packetHandle, "ProbeDataManagement", newPath);
  if(value.sendOnMoreThenValue.isValidFlag==1)
  {
    value.sendOnMoreThenValue.value = C2xGetTokenInt(packetHandle, "ProbeDataManagement", newPath);
    result = CheckLastError("ProbeDataManagement", gkFuncRefGet, result);
  }
  snprintf(newPath, elcount(newPath), "%s.%s", oldPath, "sendAll");
  value.sendAll.isValidFlag = C2xIsTokenAvailable(packetHandle, "ProbeDataManagement", newPath);
  if(value.sendAll.isValidFlag==1)
  {
    value.sendAll.value = C2xGetTokenInt64(packetHandle, "ProbeDataManagement", newPath);
    result = CheckLastError("ProbeDataManagement", gkFuncRefGet, result);
  }
  return result;
}

int SetProbeDataManagementVehicleStatusRequestParams(LONG packetHandle, struct ProbeDataManagementVehicleStatusRequest value, char oldPath[])
{
  char newPath[300];
  int result;

  result = 0;

  snprintf(newPath, elcount(newPath), "%s.%s", oldPath, "dataType");
  C2xSetTokenInt(packetHandle, "ProbeDataManagement", newPath, value.dataType);
  result = CheckLastError("ProbeDataManagement", gkFuncRefGet, result);

  snprintf(newPath, elcount(newPath), "%s.%s", oldPath, "subType");
  if(value.subType.isValidFlag==1)
  {
    if (value.subType.value < 1)
    {
        C2xSetTokenInt(packetHandle, "ProbeDataManagement", newPath, 1);
    }
    else if (value.subType.value > 15)
    {
        C2xSetTokenInt(packetHandle, "ProbeDataManagement", newPath, 15);
    }
    else
    {
        C2xSetTokenInt(packetHandle, "ProbeDataManagement", newPath, value.subType.value);
    }
    result = CheckLastError("ProbeDataManagement", gkFuncRefGet, result);
  }
  else
  {
    if( C2xIsTokenAvailable(packetHandle, "ProbeDataManagement", newPath) )
    {
      C2xRemoveToken(packetHandle, "ProbeDataManagement", newPath);
    }
  }

  snprintf(newPath, elcount(newPath), "%s.%s", oldPath, "sendOnLessThenValue");
  if(value.sendOnLessThenValue.isValidFlag==1)
  {
    C2xSetTokenInt(packetHandle, "ProbeDataManagement", newPath, value.sendOnLessThenValue.value);
    result = CheckLastError("ProbeDataManagement", gkFuncRefGet, result);
  }
  else
  {
    if( C2xIsTokenAvailable(packetHandle, "ProbeDataManagement", newPath) )
    {
      C2xRemoveToken(packetHandle, "ProbeDataManagement", newPath);
    }
  }

  snprintf(newPath, elcount(newPath), "%s.%s", oldPath, "sendOnMoreThenValue");
  if(value.sendOnMoreThenValue.isValidFlag==1)
  {
    C2xSetTokenInt(packetHandle, "ProbeDataManagement", newPath, value.sendOnMoreThenValue.value);
    result = CheckLastError("ProbeDataManagement", gkFuncRefGet, result);
  }
  else
  {
    if( C2xIsTokenAvailable(packetHandle, "ProbeDataManagement", newPath) )
    {
      C2xRemoveToken(packetHandle, "ProbeDataManagement", newPath);
    }
  }

  snprintf(newPath, elcount(newPath), "%s.%s", oldPath, "sendAll");
  if(value.sendAll.isValidFlag==1)
  {
    C2xSetTokenInt64(packetHandle, "ProbeDataManagement", newPath, value.sendAll.value);
    result = CheckLastError("ProbeDataManagement", gkFuncRefGet, result);
  }
  else
  {
    if( C2xIsTokenAvailable(packetHandle, "ProbeDataManagement", newPath) )
    {
      C2xRemoveToken(packetHandle, "ProbeDataManagement", newPath);
    }
  }

  return result;
}

int GetProbeDataManagementVehicleStatusRequestListParams(LONG packetHandle, struct ProbeDataManagementVehicleStatusRequestList value, char oldPath[])
{
  char newPath[300]; 
  int i;
  int result;

  result = 0;

  value.length = C2xGetTokenInt(packetHandle, "ProbeDataManagement", oldPath);
  if((result = CheckLastError("ProbeDataManagement", gkFuncRefGet, result))==0)
  {
    for(i=0; i<value.length; i++)
    {
      snprintf(newPath, elcount(newPath), "%s[%d]", oldPath, i);
      GetProbeDataManagementVehicleStatusRequestParams(packetHandle, value.arrayValue[i], newPath);
      result = CheckLastError("ProbeDataManagement", gkFuncRefGet, result);
    }
  }
  return result;
}

int SetProbeDataManagementVehicleStatusRequestListParams(LONG packetHandle, struct ProbeDataManagementVehicleStatusRequestList value, char oldPath[])
{
  char newPath[300]; 
  int i;
  int result;

  result = 0;

  C2xRemoveToken(packetHandle, "ProbeDataManagement", oldPath);
  for(i=0; i<value.length; i++)
  {
    snprintf(newPath, elcount(newPath), "%s[%d]", oldPath, i);
    SetProbeDataManagementVehicleStatusRequestParams(packetHandle, value.arrayValue[i], newPath);
    result = CheckLastError("ProbeDataManagement", gkFuncRefGet, result);
  }
  return result;
}

int GetProbeDataManagementCommon_RegionalExtension_Reg_ProbeDataManagementParams(LONG packetHandle, struct ProbeDataManagementCommon_RegionalExtension_Reg_ProbeDataManagement value, char oldPath[])
{
  char newPath[300];
  int result;

  result = 0;

  snprintf(newPath, elcount(newPath), "%s.%s", oldPath, "regionId");
  value.regionId = C2xGetTokenInt(packetHandle, "ProbeDataManagement", newPath);
  result = CheckLastError("ProbeDataManagement", gkFuncRefGet, result);

  return result;
}

int SetProbeDataManagementCommon_RegionalExtension_Reg_ProbeDataManagementParams(LONG packetHandle, struct ProbeDataManagementCommon_RegionalExtension_Reg_ProbeDataManagement value, char oldPath[])
{
  char newPath[300];
  int result;

  result = 0;


  return result;
}

int GetProbeDataManagementProbeDataManagement_regionalParams(LONG packetHandle, struct ProbeDataManagementProbeDataManagement_regional value, char oldPath[])
{
  char newPath[300]; 
  int i;
  int result;

  result = 0;

  value.length = C2xGetTokenInt(packetHandle, "ProbeDataManagement", oldPath);
  if((result = CheckLastError("ProbeDataManagement", gkFuncRefGet, result))==0)
  {
    for(i=0; i<value.length; i++)
    {
      snprintf(newPath, elcount(newPath), "%s[%d]", oldPath, i);
      GetProbeDataManagementCommon_RegionalExtension_Reg_ProbeDataManagementParams(packetHandle, value.arrayValue[i], newPath);
      result = CheckLastError("ProbeDataManagement", gkFuncRefGet, result);
    }
  }
  return result;
}

int SetProbeDataManagementProbeDataManagement_regionalParams(LONG packetHandle, struct ProbeDataManagementProbeDataManagement_regional value, char oldPath[])
{
  char newPath[300]; 
  int i;
  int result;

  result = 0;

  C2xRemoveToken(packetHandle, "ProbeDataManagement", oldPath);
  for(i=0; i<value.length; i++)
  {
    snprintf(newPath, elcount(newPath), "%s[%d]", oldPath, i);
    SetProbeDataManagementCommon_RegionalExtension_Reg_ProbeDataManagementParams(packetHandle, value.arrayValue[i], newPath);
    result = CheckLastError("ProbeDataManagement", gkFuncRefGet, result);
  }
  return result;
}

int GetProbeDataManagement_ProbeDataManagementParams(LONG packetHandle, struct ProbeDataManagement_ProbeDataManagement value, char oldPath[])
{
  char newPath[300]; 
  int j; 
  int k;
  int result;

  result = 0;

  snprintf(newPath, elcount(newPath), "%s.%s", oldPath, "timeStamp");
  value.timeStamp.isValidFlag = C2xIsTokenAvailable(packetHandle, "ProbeDataManagement", newPath);
  if(value.timeStamp.isValidFlag==1)
  {
    value.timeStamp.value = C2xGetTokenInt(packetHandle, "ProbeDataManagement", newPath);
    result = CheckLastError("ProbeDataManagement", gkFuncRefGet, result);
  }
  snprintf(newPath, elcount(newPath), "%s.%s", oldPath, "sample");
  GetProbeDataManagementSampleParams(packetHandle, value.sample, newPath);
  result = CheckLastError("ProbeDataManagement", gkFuncRefGet, result);

  snprintf(newPath, elcount(newPath), "%s.%s", oldPath, "directions");
  value.directions.isValidFlag = 1;
  value.directions.stringLength = C2xGetTokenLengthBit(packetHandle, "ProbeDataManagement", newPath);
  if ((result = CheckLastError("ProbeDataManagement", gkFuncRefGet, result))==0)
  {
    if(value.directions.stringLength > 0)
    {
      for(j=0; j<value.directions.stringLength; j++)
      {
        if(C2xGetTokenBitOfBitString(packetHandle, "ProbeDataManagement", newPath, j) == 0)
        {
          value.directions.string[j] = '0';
        }
        else if(C2xGetTokenBitOfBitString(packetHandle, "ProbeDataManagement", newPath, j) == 1)
        {
          value.directions.string[j] = '1';
        }

        if(value.directions.stringLength == 1)
        {
          value.directions.string[1] = '0';
        }
        result = CheckLastError("ProbeDataManagement", gkFuncRefGet, result);
      }
    }
    else
    {
      for(k = value.directions.stringLength+1; k > -1; k--)
      {
        if(value.directions.string[k] == '1')
        {
          value.directions.string[k] = '0';
        }
      }
    }
  }

  snprintf(newPath, elcount(newPath), "%s.%s", oldPath, "term");
  GetProbeDataManagementProbeDataManagement_termParams(packetHandle, value.term, newPath);
  result = CheckLastError("ProbeDataManagement", gkFuncRefGet, result);

  snprintf(newPath, elcount(newPath), "%s.%s", oldPath, "snapshot");
  GetProbeDataManagementProbeDataManagement_snapshotParams(packetHandle, value.snapshot, newPath);
  result = CheckLastError("ProbeDataManagement", gkFuncRefGet, result);

  snprintf(newPath, elcount(newPath), "%s.%s", oldPath, "txInterval");
  value.txInterval = C2xGetTokenInt(packetHandle, "ProbeDataManagement", newPath);
  result = CheckLastError("ProbeDataManagement", gkFuncRefGet, result);

  snprintf(newPath, elcount(newPath), "%s.%s", oldPath, "dataElements");
  value.dataElements.isValidFlag = C2xIsTokenAvailable(packetHandle, "ProbeDataManagement", newPath);
  if(value.dataElements.isValidFlag==1)
  {
    GetProbeDataManagementVehicleStatusRequestListParams(packetHandle, value.dataElements, newPath);
    result = CheckLastError("ProbeDataManagement", gkFuncRefGet, result);
  }
  snprintf(newPath, elcount(newPath), "%s.%s", oldPath, "regional");
  value.regional.isValidFlag = C2xIsTokenAvailable(packetHandle, "ProbeDataManagement", newPath);
  if(value.regional.isValidFlag==1)
  {
    GetProbeDataManagementProbeDataManagement_regionalParams(packetHandle, value.regional, newPath);
    result = CheckLastError("ProbeDataManagement", gkFuncRefGet, result);
  }
  return result;
}

int SetProbeDataManagement_ProbeDataManagementParams(LONG packetHandle, struct ProbeDataManagement_ProbeDataManagement value, char oldPath[])
{
  char newPath[300]; 
  int j;
  int result;

  result = 0;

  snprintf(newPath, elcount(newPath), "%s.%s", oldPath, "timeStamp");
  if(value.timeStamp.isValidFlag==1)
  {
    C2xSetTokenInt(packetHandle, "ProbeDataManagement", newPath, value.timeStamp.value);
    result = CheckLastError("ProbeDataManagement", gkFuncRefGet, result);
  }
  else
  {
    if( C2xIsTokenAvailable(packetHandle, "ProbeDataManagement", newPath) )
    {
      C2xRemoveToken(packetHandle, "ProbeDataManagement", newPath);
    }
  }

  snprintf(newPath, elcount(newPath), "%s.%s", oldPath, "sample");
  SetProbeDataManagementSampleParams(packetHandle, value.sample, newPath);
  result = CheckLastError("ProbeDataManagement", gkFuncRefGet, result);

  snprintf(newPath, elcount(newPath), "%s.%s", oldPath, "directions");
    for(j=0; j<value.directions.stringLength; j++)
    {
      if(value.directions.string[j] == '0')
      {
        C2xSetTokenBitOfBitString(packetHandle, "ProbeDataManagement", newPath, j, 0);
      }
      else
      {
        C2xSetTokenBitOfBitString(packetHandle, "ProbeDataManagement", newPath, j, 1);
      }
      result = CheckLastError("ProbeDataManagement", gkFuncRefGet, result);
    }

  snprintf(newPath, elcount(newPath), "%s.%s", oldPath, "term");
  SetProbeDataManagementProbeDataManagement_termParams(packetHandle, value.term, newPath);
  result = CheckLastError("ProbeDataManagement", gkFuncRefGet, result);

  snprintf(newPath, elcount(newPath), "%s.%s", oldPath, "snapshot");
  SetProbeDataManagementProbeDataManagement_snapshotParams(packetHandle, value.snapshot, newPath);
  result = CheckLastError("ProbeDataManagement", gkFuncRefGet, result);

  snprintf(newPath, elcount(newPath), "%s.%s", oldPath, "txInterval");
  C2xSetTokenInt(packetHandle, "ProbeDataManagement", newPath, value.txInterval);
  result = CheckLastError("ProbeDataManagement", gkFuncRefGet, result);

  snprintf(newPath, elcount(newPath), "%s.%s", oldPath, "dataElements");
  if(value.dataElements.isValidFlag==1)
  {
    SetProbeDataManagementVehicleStatusRequestListParams(packetHandle, value.dataElements, newPath);
    result = CheckLastError("ProbeDataManagement", gkFuncRefGet, result);
  }
  else
  {
    if( C2xIsTokenAvailable(packetHandle, "ProbeDataManagement", newPath) )
    {
      C2xRemoveToken(packetHandle, "ProbeDataManagement", newPath);
    }
  }

  snprintf(newPath, elcount(newPath), "%s.%s", oldPath, "regional");
  if(value.regional.isValidFlag==1)
  {
    SetProbeDataManagementProbeDataManagement_regionalParams(packetHandle, value.regional, newPath);
    result = CheckLastError("ProbeDataManagement", gkFuncRefGet, result);
  }
  else
  {
    if( C2xIsTokenAvailable(packetHandle, "ProbeDataManagement", newPath) )
    {
      C2xRemoveToken(packetHandle, "ProbeDataManagement", newPath);
    }
  }

  return result;
}

int GetProbeDataManagementMESSAGE_ID_AND_TYPEParams(LONG packetHandle, WORD tableKey, struct ProbeDataManagementMESSAGE_ID_AND_TYPE value, char oldPath[])
{
  char newPath[300];
  int result;

  result = 0;

  switch(tableKey)
  {
    case 25:
    {
      snprintf(newPath, elcount(newPath), "%s.%s", oldPath, "probeDataManagement");
      GetProbeDataManagement_ProbeDataManagementParams(packetHandle, value.probeDataManagement, newPath);
      result = CheckLastError("ProbeDataManagement", gkFuncRefGet, result);
    }
    break;
  }
  return result;
}

int SetProbeDataManagementMESSAGE_ID_AND_TYPEParams(LONG packetHandle, WORD tableKey, struct ProbeDataManagementMESSAGE_ID_AND_TYPE value, char oldPath[])
{
  char newPath[300];
  int result;

  result = 0;

  switch(tableKey)
  {
    case 25:
    {
      snprintf(newPath, elcount(newPath), "%s.%s", oldPath, "probeDataManagement");
      SetProbeDataManagement_ProbeDataManagementParams(packetHandle, value.probeDataManagement, newPath);
      result = CheckLastError("ProbeDataManagement", gkFuncRefGet, result);
    }
    break;
  }
  return result;
}

int API_GetProbeDataManagementParams(LONG packetHandle, struct ProbeDataManagement value)
{
  int result;
  result = 0;

  value.messageId = C2xGetTokenInt(packetHandle, "ProbeDataManagement", "messageId");
  result = CheckLastError("ProbeDataManagement", gkFuncRefGet, result);

  GetProbeDataManagementMESSAGE_ID_AND_TYPEParams(packetHandle, value.messageId, value.value, "value");
  result = CheckLastError("ProbeDataManagement", gkFuncRefGet, result);

  return result;
}

int API_SetProbeDataManagementParams(LONG packetHandle, struct ProbeDataManagement value)
{
  int result;
  result = 0;

  value.messageId = 25;

  SetProbeDataManagementMESSAGE_ID_AND_TYPEParams(packetHandle, value.messageId, value.value, "value");
  result = CheckLastError("ProbeDataManagement", gkFuncRefGet, result);

  return result;
}

