/*@!Encoding:1252*/
/*
//  (c) Vector Informatik GmbH. All rights reserved.
//
//  This file contains definitions of structs and methods that may be used
//  to set and get the values of an ASN.1 defined packet's payload.
//
//  //This example demonstrates how to set a packet's payload:
//  LONG packetHandle;
//  struct RoadUserChargingReportMessage payload;
//  //you need to set the values of the variable "payload" yourself
//  packetHandle = API_InitRoadUserChargingReportMessagePacket();
//  if (packetHandle!=0) {
//    if (API_SetRoadUserChargingReportMessageParams(packetHandle, payload)==0) {
//      if (C2xCompletePacket(packetHandle)==0) {
//        C2xOutputPacket(packetHandle);
//      }
//    }
//  }
//                                                                             */
includes
{
  #include "ASNV_Template_BaseDatatypes.cin"  // If warning "Duplicate #include, ignoring this include" appears, please remove the ASNV_Template_BaseDatatypes.cin include from your other *.cin files in the project.
}
variables
{
    struct RoadUserChargingReportMessageCommon_DDateTime {
        INT isValidFlag;   // necessary if this struct is used as an optional field of a SEQUENCE
        struct OPT_WORD_ASN year;  // INTEGER, OPTIONAL, 0..4095;
        struct OPT_BYTE_ASN month;  // INTEGER, OPTIONAL, 0..12;
        struct OPT_BYTE_ASN day;  // INTEGER, OPTIONAL, 0..31;
        struct OPT_BYTE_ASN hour;  // INTEGER, OPTIONAL, 0..31;
        struct OPT_BYTE_ASN minute;  // INTEGER, OPTIONAL, 0..60;
        struct OPT_WORD_ASN second;  // INTEGER, OPTIONAL, 0..65535;
        struct OPT_INT_ASN offset;  // INTEGER, OPTIONAL, -840..840;
    };
    
    struct RoadUserChargingReportMessageUserData_svcProvID_id {
        INT isValidFlag;   // necessary if this struct is used as an optional field of a SEQUENCE
        INT length;
        INT id;
    };
    
    struct RoadUserChargingReportMessageUserData_svcProvID {
        INT isValidFlag;   // necessary if this struct is used as an optional field of a SEQUENCE
        INT length;
        struct RoadUserChargingReportMessageUserData_svcProvID_id arrayValue[16];
    };
    
    struct RoadUserChargingReportMessageTollUsageMessage_VehicleId_vehicleIdentity {
        INT isValidFlag;   // necessary if this struct is used as an optional field of a SEQUENCE
        CHAR string[17];
        INT  stringLength;
    };
    
    struct RoadUserChargingReportMessageTollUsageMessage_VehicleId_licPlateState {
        INT isValidFlag;   // necessary if this struct is used as an optional field of a SEQUENCE
        CHAR string[3];
        INT  stringLength;
    };
    
    struct RoadUserChargingReportMessageTollUsageMessage_VehicleId_licPlateNumVeh {
        INT isValidFlag;   // necessary if this struct is used as an optional field of a SEQUENCE
        CHAR string[13];
        INT  stringLength;
    };
    
    struct RoadUserChargingReportMessageTollUsageMessage_VehicleId_licPlateNumTrailer {
        INT isValidFlag;   // necessary if this struct is used as an optional field of a SEQUENCE
        CHAR string[13];
        INT  stringLength;
    };
    
    struct RoadUserChargingReportMessageEfcDataDictionary_PersonalAccountNumber {
        INT isValidFlag;   // necessary if this struct is used as an optional field of a SEQUENCE
        CHAR string[11];
        INT  stringLength;
    };
    
    struct RoadUserChargingReportMessageEfcDataDictionary_CountryCode {
        INT isValidFlag;   // necessary if this struct is used as an optional field of a SEQUENCE
        CHAR string[11];
        INT  stringLength;
    };
    
    struct RoadUserChargingReportMessageEfcDataDictionary_Lpn_licencePlateNumber {
        INT isValidFlag;   // necessary if this struct is used as an optional field of a SEQUENCE
        CHAR string[256];
        INT  stringLength;
    };
    
    struct RoadUserChargingReportMessageEfcDataDictionary_Lpn {
        INT isValidFlag;   // necessary if this struct is used as an optional field of a SEQUENCE
        struct RoadUserChargingReportMessageEfcDataDictionary_CountryCode countryCode;  // BITSTRING;
        INT alphabetIndicator;  // ENUMERATED, latinAlphabetNo1(1), latinAlphabetNo2(2), latinAlphabetNo3(3), latinAlphabetNo4(4), latinCyrillicAlphabet(5), latinArabicAlphabet(6), latinGreekAlphabet(7), latinHebrewAlphabet(8), latinAlphabetNo5(9), latinAlphabetNo6(10), twoOctetBMP(11), fourOctetCanonical(12), reservedForUse1(13), reservedForUse2(14), reservedForUse3(15), reservedForUse4(16), reservedForUse5(17), reservedForUse6(18), reservedForUse7(19), reservedForUse8(20), reservedForUse9(21), reservedForUse10(22), reservedForUse11(23), reservedForUse12(24), reservedForUse13(25), reservedForUse14(26), reservedForUse15(27), reservedForUse16(28), reservedForUse17(29), reservedForUse18(30), reservedForUse19(31), reservedForUse20(32), reservedForUse21(33);
        struct RoadUserChargingReportMessageEfcDataDictionary_Lpn_licencePlateNumber licencePlateNumber;  // OCTETSTRING;
    };
    
    struct RoadUserChargingReportMessageEfcDataDictionary_EquipmentObuId {
        INT isValidFlag;   // necessary if this struct is used as an optional field of a SEQUENCE
        CHAR string[256];
        INT  stringLength;
    };
    
    struct RoadUserChargingReportMessageEfcDataDictionary_ObeId {
        INT isValidFlag;   // necessary if this struct is used as an optional field of a SEQUENCE
        WORD manufacturerId;  // INTEGER, 0..65535;
        struct RoadUserChargingReportMessageEfcDataDictionary_EquipmentObuId equipmentObuId;  // OCTETSTRING;
    };
    
    struct RoadUserChargingReportMessageEfcDataDictionary_EquipmentIccId {
        INT isValidFlag;   // necessary if this struct is used as an optional field of a SEQUENCE
        CHAR string[256];
        INT  stringLength;
    };
    
    struct RoadUserChargingReportMessageEfcDataDictionary_UserId {
        INT isValidFlag;   // necessary if this struct is used as an optional field of a SEQUENCE
        struct RoadUserChargingReportMessageEfcDataDictionary_PersonalAccountNumber pan;  // OCTETSTRING, OPTIONAL;
        struct OPT_DWORD_ASN contractSerialNumber;  // INTEGER, OPTIONAL, 0..4294967295;
        struct RoadUserChargingReportMessageEfcDataDictionary_Lpn licencePlateNumber;  // SEQUENCE, OPTIONAL;
        struct RoadUserChargingReportMessageEfcDataDictionary_ObeId obeId;  // SEQUENCE, OPTIONAL;
        struct RoadUserChargingReportMessageEfcDataDictionary_EquipmentIccId iccId;  // OCTETSTRING, OPTIONAL;
    };
    
    struct RoadUserChargingReportMessageTollUsageMessage_VehicleId {
        INT isValidFlag;   // necessary if this struct is used as an optional field of a SEQUENCE
        struct RoadUserChargingReportMessageTollUsageMessage_VehicleId_vehicleIdentity vehicleIdentity;  // OCTETSTRING, OPTIONAL;
        struct RoadUserChargingReportMessageTollUsageMessage_VehicleId_licPlateState licPlateState;  // IA5STRING, OPTIONAL;
        struct RoadUserChargingReportMessageTollUsageMessage_VehicleId_licPlateNumVeh licPlateNumVeh;  // IA5STRING, OPTIONAL;
        struct RoadUserChargingReportMessageTollUsageMessage_VehicleId_licPlateNumTrailer licPlateNumTrailer;  // IA5STRING, OPTIONAL;
        struct RoadUserChargingReportMessageEfcDataDictionary_UserId userId;  // SEQUENCE, OPTIONAL;
    };
    
    struct RoadUserChargingReportMessageEfcDataDictionary_NumberOfAxles {
        INT isValidFlag;   // necessary if this struct is used as an optional field of a SEQUENCE
        BYTE trailerAxles;  // INTEGER, 0..7;
        BYTE tractorAxles;  // INTEGER, 0..7;
    };
    
    struct RoadUserChargingReportMessageEfcDataDictionary_VehicleAxlesNumber {
        INT isValidFlag;   // necessary if this struct is used as an optional field of a SEQUENCE
        BYTE tyreConfiguration;  // INTEGER, 0..3, notSpecified(0), singleTyre(1), dualTyres(2), reservedForUse(3);
        struct RoadUserChargingReportMessageEfcDataDictionary_NumberOfAxles numberOfAxles;  // SEQUENCE;
    };
    
    struct RoadUserChargingReportMessageEfcDataDictionary_VehicleAxles {
        INT isValidFlag;   // necessary if this struct is used as an optional field of a SEQUENCE
        BYTE vehicleFirstAxleHeight;  // INTEGER, 0..255;
        struct RoadUserChargingReportMessageEfcDataDictionary_VehicleAxlesNumber vehicleAxlesNumber;  // SEQUENCE;
    };
    
    struct RoadUserChargingReportMessageEfcDataDictionary_VehicleDimensions {
        INT isValidFlag;   // necessary if this struct is used as an optional field of a SEQUENCE
        BYTE vehicleLengthOverall;  // INTEGER, 0..255;
        BYTE vehicleHeigthOverall;  // INTEGER, 0..255;
        BYTE vehicleWidthOverall;  // INTEGER, 0..255;
    };
    
    struct RoadUserChargingReportMessageEfcDataDictionary_EnvironmentalCharacteristics {
        INT isValidFlag;   // necessary if this struct is used as an optional field of a SEQUENCE
        BYTE euroValue;  // INTEGER, 0..15, noEntry(0), euro1(1), euro2(2), euro3(3), euro4(4), euro5(5), euro6(6), euro7(7), eev(15);
        BYTE copValue;  // INTEGER, 0..15, noEntry(0), co2class1(1), co2class2(2), co2class3(3), co2class4(4), co2class5(5), co2class6(6), co2class7(7);
    };
    
    struct RoadUserChargingReportMessageEfcDataDictionary_VehicleSpecificCharacteristics {
        INT isValidFlag;   // necessary if this struct is used as an optional field of a SEQUENCE
        struct RoadUserChargingReportMessageEfcDataDictionary_EnvironmentalCharacteristics environmentalCharacteristics;  // SEQUENCE;
        BYTE engineCharacteristics;  // INTEGER, 0..255, noEntry(0), noEngine(1), petrolUnleaded(2), petrolLeaded(3), diesel(4), lpg(5), battery(6), solar(7), hybrid(8), hydrogen(9), multiFuel(10), bivalentPetrolLpg(11), bivalentPetrolCng(12), combinedPetrolElectric(13), cng(14), lng(15), combinedDieselElectric(16), combinedHydrogenElectric(17), bivalentHydrogenPetrol(18), bivalentHydrogenPetrolElectricEngine(19), fuelCellHydrogen(20), fuelCellPetrol(21), fuelCellMethanol(22), fuelCellEthanol(23), fuelCellDiesel(24), combinedMultiFuelElectricEngine(25), combinedCngElectricEngine(26), combinedLngElectricEngine(27), petrolEthanol(28), combinedLpgElectricEngine(29), hybridPetrolExternalBattery(30), hybridDieselExternalBattery(31), hybridLpgExternalBattery(32), hybridHydrogenExternalBattery(33), hybridMultiFuelExternalBattery(34), hybridCngExternalBattery(35), hybridLngExternalBattery(36), hybridBivalentHydrogenPetrolExternalBattery(37), hydrogenCng(38), hydrogenLng(39), hybridHydrogenCngExternalBattery(40), hybridHydrogenLngExternalBattery(41), ethanol(42), hybridFuelCellHydrogen(43), hybridFuelCellHydrogenExternalBattery(44), dualFuelLngDiesel(45), electricExternal(46), biogas(47), bioDiesel(48), bioPetrol(49), bivalentPetrolBiogas(50), combinedBiogasElectricEngine(51), dualFuelCngDiesel(52), other(255);
        BYTE descriptiveCharacteristics;  // INTEGER, 0..255, noEntry(0);
        BYTE futureCharacteristics;  // INTEGER, 0..255, noEntry(0), airSuspension(1);
    };
    
    struct RoadUserChargingReportMessageEfcDataDictionary_VehicleWeightLimits {
        INT isValidFlag;   // necessary if this struct is used as an optional field of a SEQUENCE
        WORD vehicleMaxLadenWeight;  // INTEGER, 0..65535;
        WORD vehicleTrainMaximumWeight;  // INTEGER, 0..65535;
        WORD vehicleWeightUnladen;  // INTEGER, 0..65535;
    };
    
    struct RoadUserChargingReportMessageEfcDataDictionary_TrailerDetails {
        INT isValidFlag;   // necessary if this struct is used as an optional field of a SEQUENCE
        BYTE trailerType;  // INTEGER, 0..31, notPresent(0), trailer(1), semitrailer(2);
        BYTE trailerAxles;  // INTEGER, 0..7;
    };
    
    struct RoadUserChargingReportMessageEfcDataDictionary_TrailerCharacteristics {
        INT isValidFlag;   // necessary if this struct is used as an optional field of a SEQUENCE
        struct RoadUserChargingReportMessageEfcDataDictionary_TrailerDetails trailerDetails;  // SEQUENCE;
        WORD trailerMaxLadenWeight;  // INTEGER, 0..65535;
        WORD trailerWeightUnladen;  // INTEGER, 0..65535;
    };
    
    struct RoadUserChargingReportMessageEfcDataDictionary_AxleWeightLimits {
        INT isValidFlag;   // necessary if this struct is used as an optional field of a SEQUENCE
        WORD maxLadenweightOnAxle1;  // INTEGER, 0..65535;
        WORD maxLadenweightOnAxle2;  // INTEGER, 0..65535;
        WORD maxLadenweightOnAxle3;  // INTEGER, 0..65535;
        WORD maxLadenweightOnAxle4;  // INTEGER, 0..65535;
        WORD maxLadenweightOnAxle5;  // INTEGER, 0..65535;
    };
    
    struct RoadUserChargingReportMessageEfcDataDictionary_Particulate {
        INT isValidFlag;   // necessary if this struct is used as an optional field of a SEQUENCE
        BYTE unitType;  // INTEGER, 0..1, mgPerKm(0), mgPerKwh(1);
        WORD value;  // INTEGER, 0..32767;
    };
    
    struct RoadUserChargingReportMessageEfcDataDictionary_DieselEmissionValues {
        INT isValidFlag;   // necessary if this struct is used as an optional field of a SEQUENCE
        struct RoadUserChargingReportMessageEfcDataDictionary_Particulate particulate;  // SEQUENCE;
        WORD absorptionCoeff;  // INTEGER, 0..65535;
    };
    
    struct RoadUserChargingReportMessageEfcDataDictionary_DriverCharacteristics {
        INT isValidFlag;   // necessary if this struct is used as an optional field of a SEQUENCE
        BYTE driverClass;  // INTEGER, 0..255;
        BYTE tripPurpose;  // INTEGER, 0..255;
    };
    
    struct RoadUserChargingReportMessageEfcDataDictionary_EngineDetails {
        INT isValidFlag;   // necessary if this struct is used as an optional field of a SEQUENCE
        WORD engineCapacity;  // INTEGER, 0..65535;
        WORD enginePower;  // INTEGER, 0..65535;
    };
    
    struct RoadUserChargingReportMessageEfcDataDictionary_ExhaustEmissionValues {
        INT isValidFlag;   // necessary if this struct is used as an optional field of a SEQUENCE
        BYTE unitType;  // INTEGER, 0..1, mgPerKm(0), mgPerKwh(1);
        WORD emissionCo;  // INTEGER, 0..32767;
        WORD emissionHc;  // INTEGER, 0..65535;
        WORD emissionNox;  // INTEGER, 0..65535;
        WORD emissionHcNox;  // INTEGER, 0..65535;
    };
    
    struct RoadUserChargingReportMessageEfcDataDictionary_PassengerCapacity {
        INT isValidFlag;   // necessary if this struct is used as an optional field of a SEQUENCE
        BYTE numberOfSeats;  // INTEGER, 0..255;
        BYTE numberOfStandingPlaces;  // INTEGER, 0..255;
    };
    
    struct RoadUserChargingReportMessageEfcDataDictionary_SoundLevel {
        INT isValidFlag;   // necessary if this struct is used as an optional field of a SEQUENCE
        BYTE soundStationary;  // INTEGER, 0..255;
        BYTE soundDriveBy;  // INTEGER, 0..255;
    };
    
    struct RoadUserChargingReportMessageEfcDataDictionary_VehicleDescription {
        INT isValidFlag;   // necessary if this struct is used as an optional field of a SEQUENCE
        struct RoadUserChargingReportMessageEfcDataDictionary_Lpn vehicleLPNr;  // SEQUENCE, OPTIONAL;
        struct RoadUserChargingReportMessageEfcDataDictionary_VehicleAxles axles;  // SEQUENCE, OPTIONAL;
        struct OPT_BYTE_ASN class;  // INTEGER, OPTIONAL, 0..255;
        struct RoadUserChargingReportMessageEfcDataDictionary_VehicleDimensions dimensions;  // SEQUENCE, OPTIONAL;
        struct RoadUserChargingReportMessageEfcDataDictionary_VehicleSpecificCharacteristics specificCharacteristics;  // SEQUENCE, OPTIONAL;
        struct OPT_WORD_ASN ladenWeight;  // INTEGER, OPTIONAL, 0..65535;
        struct RoadUserChargingReportMessageEfcDataDictionary_VehicleWeightLimits weightLimits;  // SEQUENCE, OPTIONAL;
        struct RoadUserChargingReportMessageEfcDataDictionary_TrailerCharacteristics trailerCharacteristics;  // SEQUENCE, OPTIONAL;
        struct OPT_WORD_ASN vehicleCurrentMaxTrainWeight;  // INTEGER, OPTIONAL, 0..65535;
        struct OPT_BYTE_ASN actualNumberOfPassengers;  // INTEGER, OPTIONAL, 0..255;
        struct RoadUserChargingReportMessageEfcDataDictionary_AxleWeightLimits axleWeightLimits;  // SEQUENCE, OPTIONAL;
        struct RoadUserChargingReportMessageEfcDataDictionary_DieselEmissionValues dieselEmissionValues;  // SEQUENCE, OPTIONAL;
        struct RoadUserChargingReportMessageEfcDataDictionary_DriverCharacteristics driverCharacteristics;  // SEQUENCE, OPTIONAL;
        struct RoadUserChargingReportMessageEfcDataDictionary_EngineDetails engineDetails;  // SEQUENCE, OPTIONAL;
        struct RoadUserChargingReportMessageEfcDataDictionary_ExhaustEmissionValues exhaustEmissionValues;  // SEQUENCE, OPTIONAL;
        struct RoadUserChargingReportMessageEfcDataDictionary_PassengerCapacity passengerCapacity;  // SEQUENCE, OPTIONAL;
        struct RoadUserChargingReportMessageEfcDataDictionary_SoundLevel soundLevel;  // SEQUENCE, OPTIONAL;
    };
    
    struct RoadUserChargingReportMessageUserData {
        INT isValidFlag;   // necessary if this struct is used as an optional field of a SEQUENCE
        struct RoadUserChargingReportMessageCommon_DDateTime timeStamp;  // SEQUENCE;
        struct RoadUserChargingReportMessageUserData_svcProvID svcProvID;  // OBJECTIDENTIFIER;
        struct RoadUserChargingReportMessageTollUsageMessage_VehicleId vehicleID;  // SEQUENCE;
        INT vehicleType;  // ENUMERATED, motorcycles(1), passengerCars(2), fourTireSingleUnit(3), buses(4), twoAxleSixTireSingleUnit(5), threeAxleSingleUnit(6), fourOrMoreAxleSingleUnit(7), fourOrLessAxleSingleTrailer(8), fiveAxleTractorSemitrailer(9), sixOrMoreAxleSingleTrailer(10), fiveOrLessAxleMultiTrailer(11), sixAxleMultiTrailer(12), sevenOrMoreAxleMultiTrailer(13);
        struct RoadUserChargingReportMessageEfcDataDictionary_VehicleDescription vehicleDescription;  // SEQUENCE, OPTIONAL;
    };
    
    struct RoadUserChargingReportMessageEfcDataDictionary_PayUnit {
        INT isValidFlag;   // necessary if this struct is used as an optional field of a SEQUENCE
        CHAR string[3];
        INT  stringLength;
    };
    
    struct RoadUserChargingReportMessageEfcDataDictionary_PaymentFee {
        INT isValidFlag;   // necessary if this struct is used as an optional field of a SEQUENCE
        WORD paymentFeeAmount;  // INTEGER, 0..65535;
        struct RoadUserChargingReportMessageEfcDataDictionary_PayUnit paymentFeeUnit;  // OCTETSTRING;
    };
    
    struct RoadUserChargingReportMessageTimePeriod {
        INT isValidFlag;   // necessary if this struct is used as an optional field of a SEQUENCE
        struct RoadUserChargingReportMessageCommon_DDateTime startTime;  // SEQUENCE;
        struct RoadUserChargingReportMessageCommon_DDateTime endTime;  // SEQUENCE;
    };
    
    struct RoadUserChargingReportMessageUserFeeInfo {
        INT isValidFlag;   // necessary if this struct is used as an optional field of a SEQUENCE
        struct RoadUserChargingReportMessageEfcDataDictionary_PaymentFee fee;  // SEQUENCE;
        struct RoadUserChargingReportMessageTimePeriod timePeriod;  // SEQUENCE;
    };
    
    struct RoadUserChargingReportMessageFeeReport {
        INT isValidFlag;   // necessary if this struct is used as an optional field of a SEQUENCE
        struct RoadUserChargingReportMessageUserData userData;  // SEQUENCE;
        struct RoadUserChargingReportMessageUserFeeInfo fees;  // SEQUENCE;
    };
    
    struct RoadUserChargingReportMessageItemizedPaymentReport_svcProvID_id {
        INT isValidFlag;   // necessary if this struct is used as an optional field of a SEQUENCE
        INT length;
        INT id;
    };
    
    struct RoadUserChargingReportMessageItemizedPaymentReport_svcProvID {
        INT isValidFlag;   // necessary if this struct is used as an optional field of a SEQUENCE
        INT length;
        struct RoadUserChargingReportMessageItemizedPaymentReport_svcProvID_id arrayValue[16];
    };
    
    struct RoadUserChargingReportMessageItemizedChargerData_chargerID_id {
        INT isValidFlag;   // necessary if this struct is used as an optional field of a SEQUENCE
        INT length;
        INT id;
    };
    
    struct RoadUserChargingReportMessageItemizedChargerData_chargerID {
        INT isValidFlag;   // necessary if this struct is used as an optional field of a SEQUENCE
        INT length;
        struct RoadUserChargingReportMessageItemizedChargerData_chargerID_id arrayValue[16];
    };
    
    struct RoadUserChargingReportMessageCommon_DescriptiveName {
        INT isValidFlag;   // necessary if this struct is used as an optional field of a SEQUENCE
        CHAR string[64];
        INT  stringLength;
    };
    
    struct RoadUserChargingReportMessageTripInfo {
        INT isValidFlag;   // necessary if this struct is used as an optional field of a SEQUENCE
        struct OPT_WORD_ASN distanceTraveled;  // INTEGER, OPTIONAL, 1..65535;
        struct OPT_ENUM_ASN distanceUnits;  // ENUMERATED, OPTIONAL, centimeter(0), cm2_5(1), decimeter(2), meter(3), kilometer(4), foot(5), yard(6), mile(7);
        struct OPT_DWORD_ASN timeTraveled;  // INTEGER, OPTIONAL, 1..600000;
    };
    
    struct RoadUserChargingReportMessageItemizedChargerData {
        INT isValidFlag;   // necessary if this struct is used as an optional field of a SEQUENCE
        struct RoadUserChargingReportMessageItemizedChargerData_chargerID chargerID;  // OBJECTIDENTIFIER;
        struct RoadUserChargingReportMessageCommon_DescriptiveName chargingDescription;  // IA5STRING, OPTIONAL;
        struct OPT_BYTE_ASN configID;  // INTEGER, OPTIONAL, 0..64;
        struct RoadUserChargingReportMessageTripInfo tripInfo;  // SEQUENCE, OPTIONAL;
        struct RoadUserChargingReportMessageEfcDataDictionary_PaymentFee totalPaidToCharger;  // SEQUENCE;
    };
    
    struct RoadUserChargingReportMessageItemizedPaymentReport_chargerData {
        INT isValidFlag;   // necessary if this struct is used as an optional field of a SEQUENCE
        INT length;
        struct RoadUserChargingReportMessageItemizedChargerData arrayValue[999];  // SEQUENCE;
    };
    
    struct RoadUserChargingReportMessageItemizedPaymentReport {
        INT isValidFlag;   // necessary if this struct is used as an optional field of a SEQUENCE
        struct RoadUserChargingReportMessageCommon_DDateTime timeStamp;  // SEQUENCE;
        struct RoadUserChargingReportMessageTimePeriod timePeriod;  // SEQUENCE;
        struct RoadUserChargingReportMessageItemizedPaymentReport_svcProvID svcProvID;  // OBJECTIDENTIFIER;
        struct RoadUserChargingReportMessageItemizedPaymentReport_chargerData chargerData;  // SEQUENCEOF;
    };
    
    struct RoadUserChargingReportMessageUsageReport {
        INT isValidFlag;   // necessary if this struct is used as an optional field of a SEQUENCE
        INT choice;
        struct RoadUserChargingReportMessageFeeReport feeReport;  // SEQUENCE;
        struct RoadUserChargingReportMessageItemizedPaymentReport itemizedPaymentReport;  // SEQUENCE;
    };
    
    struct RoadUserChargingReportMessageRoadUserChargingReportMessage_serviceProviderData {
        INT isValidFlag;   // necessary if this struct is used as an optional field of a SEQUENCE
        CHAR string[1024];
        INT  stringLength;
    };
    
    struct RoadUserChargingReportMessage_RoadUserChargingReportMessage {
        INT isValidFlag;   // necessary if this struct is used as an optional field of a SEQUENCE
        struct RoadUserChargingReportMessageUsageReport usageReport;  // CHOICE;
        struct RoadUserChargingReportMessageRoadUserChargingReportMessage_serviceProviderData serviceProviderData;  // OCTETSTRING, OPTIONAL;
    };
    
    struct RoadUserChargingReportMessageMESSAGE_ID_AND_TYPE {
        struct RoadUserChargingReportMessage_RoadUserChargingReportMessage roadUserChargingReportMessage;  // SEQUENCE;
    };
    
    struct RoadUserChargingReportMessage {
        INT isValidFlag;   // necessary if this struct is used as an optional field of a SEQUENCE
        WORD messageId;  // INTEGER, 0..32767, mapData(18), signalPhaseAndTimingMessage(19), basicSafetyMessage(20), commonSafetyRequest(21), emergencyVehicleAlert(22), intersectionCollision(23), nmeaCorrections(24), probeDataManagement(25), probeVehicleData(26), roadSideAlert(27), rtcmCorrections(28), signalRequestMessage(29), signalStatusMessage(30), travelerInformation(31), personalSafetyMessage(32), roadSafetyMessage(33), roadWeatherMessage(34), probeDataConfigMessage(35), probeDataReportMessage(36), tollAdvertisementMessage(37), tollUsageMessage(38), tollUsageAckMessage(39), cooperativeControlMessage(40), sensorDataSharingMessage(41), maneuverSharingAndCoordinatingMessage(42), roadGeometryAndAttributes(43), personalSafetyMessage2(44), trafficSignalPhaseAndTiming(45), signalControlAndPrioritizationRequest(46), signalControlAndPrioritizationStatus(47), roadUserChargingConfigMessage(48), roadUserChargingReportMessage(49), trafficLightStatusMessage(50);
        struct RoadUserChargingReportMessageMESSAGE_ID_AND_TYPE value;  // TABLE;
    };
    
}

/*
// init function to create a simple packet handle
*/ 
LONG API_InitRoadUserChargingReportMessagePacket()
{
  return C2xInitPacket("RoadUserChargingReportMessage"); 
}

/*
// init function to create a simple packet handle and
// initialize the struct with valid data
*/ 
LONG API_InitRoadUserChargingReportMessagePacket(struct RoadUserChargingReportMessage msgStruct)
{
  long pktHandle;

  pktHandle = API_InitRoadUserChargingReportMessagePacket();

  if (pktHandle != 0)
  {
    // create valid message and application data
    if (C2xCompletePacket(pktHandle) == 0) 
    {
      API_GetRoadUserChargingReportMessageParams(pktHandle, msgStruct);
    }
  }
  return pktHandle;
}

/*
// init function to create a packet with security layer and
// initialize the struct with valid data
*/ 
LONG API_InitRoadUserChargingReportMessagePacket(struct RoadUserChargingReportMessage msgStruct, char packetTypeDesignator[], char certificateName[])
{
  long pktHandle, certHdl;

  // initialize the packet
  pktHandle = C2xInitPacket("RoadUserChargingReportMessage", packetTypeDesignator);

  if (pktHandle != 0)
  {
    certHdl = C2xSecCertificateGetHandle(certificateName);  // get the certificate handle for the cert with name "certificateName"
    if (certHdl != 0) 
    {
      C2xSecPacketSetSignerHandle(pktHandle, certHdl); // set the certHdl to the packet
    }

    // create valid message and application data
    if (C2xCompletePacket(pktHandle) == 0) 
    {
      // copy application data to the application structure
      API_GetRoadUserChargingReportMessageParams(pktHandle, msgStruct);
    }
  }
  return pktHandle;
}
    

int GetRoadUserChargingReportMessageCommon_DDateTimeParams(LONG packetHandle, struct RoadUserChargingReportMessageCommon_DDateTime value, char oldPath[])
{
  char newPath[300];
  int result;

  result = 0;

  snprintf(newPath, elcount(newPath), "%s.%s", oldPath, "year");
  value.year.isValidFlag = C2xIsTokenAvailable(packetHandle, "RoadUserChargingReportMessage", newPath);
  if(value.year.isValidFlag==1)
  {
    value.year.value = C2xGetTokenInt(packetHandle, "RoadUserChargingReportMessage", newPath);
    result = CheckLastError("RoadUserChargingReportMessage", gkFuncRefGet, result);
  }
  snprintf(newPath, elcount(newPath), "%s.%s", oldPath, "month");
  value.month.isValidFlag = C2xIsTokenAvailable(packetHandle, "RoadUserChargingReportMessage", newPath);
  if(value.month.isValidFlag==1)
  {
    value.month.value = C2xGetTokenInt(packetHandle, "RoadUserChargingReportMessage", newPath);
    result = CheckLastError("RoadUserChargingReportMessage", gkFuncRefGet, result);
  }
  snprintf(newPath, elcount(newPath), "%s.%s", oldPath, "day");
  value.day.isValidFlag = C2xIsTokenAvailable(packetHandle, "RoadUserChargingReportMessage", newPath);
  if(value.day.isValidFlag==1)
  {
    value.day.value = C2xGetTokenInt(packetHandle, "RoadUserChargingReportMessage", newPath);
    result = CheckLastError("RoadUserChargingReportMessage", gkFuncRefGet, result);
  }
  snprintf(newPath, elcount(newPath), "%s.%s", oldPath, "hour");
  value.hour.isValidFlag = C2xIsTokenAvailable(packetHandle, "RoadUserChargingReportMessage", newPath);
  if(value.hour.isValidFlag==1)
  {
    value.hour.value = C2xGetTokenInt(packetHandle, "RoadUserChargingReportMessage", newPath);
    result = CheckLastError("RoadUserChargingReportMessage", gkFuncRefGet, result);
  }
  snprintf(newPath, elcount(newPath), "%s.%s", oldPath, "minute");
  value.minute.isValidFlag = C2xIsTokenAvailable(packetHandle, "RoadUserChargingReportMessage", newPath);
  if(value.minute.isValidFlag==1)
  {
    value.minute.value = C2xGetTokenInt(packetHandle, "RoadUserChargingReportMessage", newPath);
    result = CheckLastError("RoadUserChargingReportMessage", gkFuncRefGet, result);
  }
  snprintf(newPath, elcount(newPath), "%s.%s", oldPath, "second");
  value.second.isValidFlag = C2xIsTokenAvailable(packetHandle, "RoadUserChargingReportMessage", newPath);
  if(value.second.isValidFlag==1)
  {
    value.second.value = C2xGetTokenInt(packetHandle, "RoadUserChargingReportMessage", newPath);
    result = CheckLastError("RoadUserChargingReportMessage", gkFuncRefGet, result);
  }
  snprintf(newPath, elcount(newPath), "%s.%s", oldPath, "offset");
  value.offset.isValidFlag = C2xIsTokenAvailable(packetHandle, "RoadUserChargingReportMessage", newPath);
  if(value.offset.isValidFlag==1)
  {
    value.offset.value = C2xGetTokenInt(packetHandle, "RoadUserChargingReportMessage", newPath);
    result = CheckLastError("RoadUserChargingReportMessage", gkFuncRefGet, result);
  }
  return result;
}

int SetRoadUserChargingReportMessageCommon_DDateTimeParams(LONG packetHandle, struct RoadUserChargingReportMessageCommon_DDateTime value, char oldPath[])
{
  char newPath[300];
  int result;

  result = 0;

  snprintf(newPath, elcount(newPath), "%s.%s", oldPath, "year");
  if(value.year.isValidFlag==1)
  {
    C2xSetTokenInt(packetHandle, "RoadUserChargingReportMessage", newPath, value.year.value);
    result = CheckLastError("RoadUserChargingReportMessage", gkFuncRefGet, result);
  }
  else
  {
    if( C2xIsTokenAvailable(packetHandle, "RoadUserChargingReportMessage", newPath) )
    {
      C2xRemoveToken(packetHandle, "RoadUserChargingReportMessage", newPath);
    }
  }

  snprintf(newPath, elcount(newPath), "%s.%s", oldPath, "month");
  if(value.month.isValidFlag==1)
  {
    C2xSetTokenInt(packetHandle, "RoadUserChargingReportMessage", newPath, value.month.value);
    result = CheckLastError("RoadUserChargingReportMessage", gkFuncRefGet, result);
  }
  else
  {
    if( C2xIsTokenAvailable(packetHandle, "RoadUserChargingReportMessage", newPath) )
    {
      C2xRemoveToken(packetHandle, "RoadUserChargingReportMessage", newPath);
    }
  }

  snprintf(newPath, elcount(newPath), "%s.%s", oldPath, "day");
  if(value.day.isValidFlag==1)
  {
    C2xSetTokenInt(packetHandle, "RoadUserChargingReportMessage", newPath, value.day.value);
    result = CheckLastError("RoadUserChargingReportMessage", gkFuncRefGet, result);
  }
  else
  {
    if( C2xIsTokenAvailable(packetHandle, "RoadUserChargingReportMessage", newPath) )
    {
      C2xRemoveToken(packetHandle, "RoadUserChargingReportMessage", newPath);
    }
  }

  snprintf(newPath, elcount(newPath), "%s.%s", oldPath, "hour");
  if(value.hour.isValidFlag==1)
  {
    C2xSetTokenInt(packetHandle, "RoadUserChargingReportMessage", newPath, value.hour.value);
    result = CheckLastError("RoadUserChargingReportMessage", gkFuncRefGet, result);
  }
  else
  {
    if( C2xIsTokenAvailable(packetHandle, "RoadUserChargingReportMessage", newPath) )
    {
      C2xRemoveToken(packetHandle, "RoadUserChargingReportMessage", newPath);
    }
  }

  snprintf(newPath, elcount(newPath), "%s.%s", oldPath, "minute");
  if(value.minute.isValidFlag==1)
  {
    C2xSetTokenInt(packetHandle, "RoadUserChargingReportMessage", newPath, value.minute.value);
    result = CheckLastError("RoadUserChargingReportMessage", gkFuncRefGet, result);
  }
  else
  {
    if( C2xIsTokenAvailable(packetHandle, "RoadUserChargingReportMessage", newPath) )
    {
      C2xRemoveToken(packetHandle, "RoadUserChargingReportMessage", newPath);
    }
  }

  snprintf(newPath, elcount(newPath), "%s.%s", oldPath, "second");
  if(value.second.isValidFlag==1)
  {
    C2xSetTokenInt(packetHandle, "RoadUserChargingReportMessage", newPath, value.second.value);
    result = CheckLastError("RoadUserChargingReportMessage", gkFuncRefGet, result);
  }
  else
  {
    if( C2xIsTokenAvailable(packetHandle, "RoadUserChargingReportMessage", newPath) )
    {
      C2xRemoveToken(packetHandle, "RoadUserChargingReportMessage", newPath);
    }
  }

  snprintf(newPath, elcount(newPath), "%s.%s", oldPath, "offset");
  if(value.offset.isValidFlag==1)
  {
    C2xSetTokenInt(packetHandle, "RoadUserChargingReportMessage", newPath, value.offset.value);
    result = CheckLastError("RoadUserChargingReportMessage", gkFuncRefGet, result);
  }
  else
  {
    if( C2xIsTokenAvailable(packetHandle, "RoadUserChargingReportMessage", newPath) )
    {
      C2xRemoveToken(packetHandle, "RoadUserChargingReportMessage", newPath);
    }
  }

  return result;
}

int GetRoadUserChargingReportMessageEfcDataDictionary_LpnParams(LONG packetHandle, struct RoadUserChargingReportMessageEfcDataDictionary_Lpn value, char oldPath[])
{
  char newPath[300]; 
  int j; 
  int k;
  int result;

  result = 0;

  snprintf(newPath, elcount(newPath), "%s.%s", oldPath, "countryCode");
  value.countryCode.isValidFlag = 1;
  value.countryCode.stringLength = C2xGetTokenLengthBit(packetHandle, "RoadUserChargingReportMessage", newPath);
  if ((result = CheckLastError("RoadUserChargingReportMessage", gkFuncRefGet, result))==0)
  {
    if(value.countryCode.stringLength > 0)
    {
      for(j=0; j<value.countryCode.stringLength; j++)
      {
        if(C2xGetTokenBitOfBitString(packetHandle, "RoadUserChargingReportMessage", newPath, j) == 0)
        {
          value.countryCode.string[j] = '0';
        }
        else if(C2xGetTokenBitOfBitString(packetHandle, "RoadUserChargingReportMessage", newPath, j) == 1)
        {
          value.countryCode.string[j] = '1';
        }

        if(value.countryCode.stringLength == 1)
        {
          value.countryCode.string[1] = '0';
        }
        result = CheckLastError("RoadUserChargingReportMessage", gkFuncRefGet, result);
      }
    }
    else
    {
      for(k = value.countryCode.stringLength+1; k > -1; k--)
      {
        if(value.countryCode.string[k] == '1')
        {
          value.countryCode.string[k] = '0';
        }
      }
    }
  }

  snprintf(newPath, elcount(newPath), "%s.%s", oldPath, "alphabetIndicator");
  value.alphabetIndicator = C2xGetTokenInt(packetHandle, "RoadUserChargingReportMessage", newPath);
  result = CheckLastError("RoadUserChargingReportMessage", gkFuncRefGet, result);

  snprintf(newPath, elcount(newPath), "%s.%s", oldPath, "licencePlateNumber");
  value.licencePlateNumber.stringLength = C2xGetTokenData(packetHandle, "RoadUserChargingReportMessage", newPath, elcount(value.licencePlateNumber.string), value.licencePlateNumber.string);
  return result;
}

int SetRoadUserChargingReportMessageEfcDataDictionary_LpnParams(LONG packetHandle, struct RoadUserChargingReportMessageEfcDataDictionary_Lpn value, char oldPath[])
{
  char newPath[300]; 
  int j;
  int result;

  result = 0;

  snprintf(newPath, elcount(newPath), "%s.%s", oldPath, "countryCode");
    for(j=0; j<value.countryCode.stringLength; j++)
    {
      if(value.countryCode.string[j] == '0')
      {
        C2xSetTokenBitOfBitString(packetHandle, "RoadUserChargingReportMessage", newPath, j, 0);
      }
      else
      {
        C2xSetTokenBitOfBitString(packetHandle, "RoadUserChargingReportMessage", newPath, j, 1);
      }
      result = CheckLastError("RoadUserChargingReportMessage", gkFuncRefGet, result);
    }

  snprintf(newPath, elcount(newPath), "%s.%s", oldPath, "alphabetIndicator");
  if (value.alphabetIndicator < 1)
  {
    C2xSetTokenInt(packetHandle, "RoadUserChargingReportMessage", newPath, 1);
  }
  else if (value.alphabetIndicator > 33)
  {
    C2xSetTokenInt(packetHandle, "RoadUserChargingReportMessage", newPath, 33);
  }
  else
  {
    C2xSetTokenInt(packetHandle, "RoadUserChargingReportMessage", newPath, value.alphabetIndicator);
  }
  result = CheckLastError("RoadUserChargingReportMessage", gkFuncRefGet, result);

  snprintf(newPath, elcount(newPath), "%s.%s", oldPath, "licencePlateNumber");
  C2xSetTokenData(packetHandle, "RoadUserChargingReportMessage", newPath, value.licencePlateNumber.stringLength, value.licencePlateNumber.string);

  return result;
}

int GetRoadUserChargingReportMessageEfcDataDictionary_ObeIdParams(LONG packetHandle, struct RoadUserChargingReportMessageEfcDataDictionary_ObeId value, char oldPath[])
{
  char newPath[300];
  int result;

  result = 0;

  snprintf(newPath, elcount(newPath), "%s.%s", oldPath, "manufacturerId");
  value.manufacturerId = C2xGetTokenInt(packetHandle, "RoadUserChargingReportMessage", newPath);
  result = CheckLastError("RoadUserChargingReportMessage", gkFuncRefGet, result);

  snprintf(newPath, elcount(newPath), "%s.%s", oldPath, "equipmentObuId");
  value.equipmentObuId.stringLength = C2xGetTokenData(packetHandle, "RoadUserChargingReportMessage", newPath, elcount(value.equipmentObuId.string), value.equipmentObuId.string);
  return result;
}

int SetRoadUserChargingReportMessageEfcDataDictionary_ObeIdParams(LONG packetHandle, struct RoadUserChargingReportMessageEfcDataDictionary_ObeId value, char oldPath[])
{
  char newPath[300];
  int result;

  result = 0;

  snprintf(newPath, elcount(newPath), "%s.%s", oldPath, "manufacturerId");
  C2xSetTokenInt(packetHandle, "RoadUserChargingReportMessage", newPath, value.manufacturerId);
  result = CheckLastError("RoadUserChargingReportMessage", gkFuncRefGet, result);

  snprintf(newPath, elcount(newPath), "%s.%s", oldPath, "equipmentObuId");
  C2xSetTokenData(packetHandle, "RoadUserChargingReportMessage", newPath, value.equipmentObuId.stringLength, value.equipmentObuId.string);

  return result;
}

int GetRoadUserChargingReportMessageEfcDataDictionary_UserIdParams(LONG packetHandle, struct RoadUserChargingReportMessageEfcDataDictionary_UserId value, char oldPath[])
{
  char newPath[300];
  char buffer[300];
  int result;

  result = 0;

  snprintf(newPath, elcount(newPath), "%s.%s", oldPath, "pan");
  value.pan.isValidFlag = C2xIsTokenAvailable(packetHandle, "RoadUserChargingReportMessage", newPath);
  if(value.pan.isValidFlag==1)
  {
    value.pan.isValidFlag = 1;
    value.pan.stringLength = C2xGetTokenData(packetHandle, "RoadUserChargingReportMessage", newPath, elcount(value.pan.string), value.pan.string);
  }
  snprintf(newPath, elcount(newPath), "%s.%s", oldPath, "contractSerialNumber");
  value.contractSerialNumber.isValidFlag = C2xIsTokenAvailable(packetHandle, "RoadUserChargingReportMessage", newPath);
  if(value.contractSerialNumber.isValidFlag==1)
  {
    value.contractSerialNumber.value = C2xGetTokenInt64(packetHandle, "RoadUserChargingReportMessage", newPath);
    result = CheckLastError("RoadUserChargingReportMessage", gkFuncRefGet, result);
  }
  snprintf(newPath, elcount(newPath), "%s.%s", oldPath, "licencePlateNumber");
  value.licencePlateNumber.isValidFlag = C2xIsTokenAvailable(packetHandle, "RoadUserChargingReportMessage", newPath);
  if(value.licencePlateNumber.isValidFlag==1)
  {
    GetRoadUserChargingReportMessageEfcDataDictionary_LpnParams(packetHandle, value.licencePlateNumber, newPath);
    result = CheckLastError("RoadUserChargingReportMessage", gkFuncRefGet, result);
  }
  snprintf(newPath, elcount(newPath), "%s.%s", oldPath, "obeId");
  value.obeId.isValidFlag = C2xIsTokenAvailable(packetHandle, "RoadUserChargingReportMessage", newPath);
  if(value.obeId.isValidFlag==1)
  {
    GetRoadUserChargingReportMessageEfcDataDictionary_ObeIdParams(packetHandle, value.obeId, newPath);
    result = CheckLastError("RoadUserChargingReportMessage", gkFuncRefGet, result);
  }
  snprintf(newPath, elcount(newPath), "%s.%s", oldPath, "iccId");
  value.iccId.isValidFlag = C2xIsTokenAvailable(packetHandle, "RoadUserChargingReportMessage", newPath);
  if(value.iccId.isValidFlag==1)
  {
    value.iccId.isValidFlag = 1;
    value.iccId.stringLength = C2xGetTokenData(packetHandle, "RoadUserChargingReportMessage", newPath, elcount(value.iccId.string), value.iccId.string);
  }
  return result;
}

int SetRoadUserChargingReportMessageEfcDataDictionary_UserIdParams(LONG packetHandle, struct RoadUserChargingReportMessageEfcDataDictionary_UserId value, char oldPath[])
{
  char newPath[300];
  char buffer[300];
  int result;

  result = 0;

  snprintf(newPath, elcount(newPath), "%s.%s", oldPath, "pan");
  if(value.pan.isValidFlag==1)
  {
    C2xSetTokenData(packetHandle, "RoadUserChargingReportMessage", newPath, value.pan.stringLength, value.pan.string);
  }
  else
  {
    if( C2xIsTokenAvailable(packetHandle, "RoadUserChargingReportMessage", newPath) )
    {
      C2xRemoveToken(packetHandle, "RoadUserChargingReportMessage", newPath);
    }
  }

  snprintf(newPath, elcount(newPath), "%s.%s", oldPath, "contractSerialNumber");
  if(value.contractSerialNumber.isValidFlag==1)
  {
    C2xSetTokenInt64(packetHandle, "RoadUserChargingReportMessage", newPath, value.contractSerialNumber.value);
    result = CheckLastError("RoadUserChargingReportMessage", gkFuncRefGet, result);
  }
  else
  {
    if( C2xIsTokenAvailable(packetHandle, "RoadUserChargingReportMessage", newPath) )
    {
      C2xRemoveToken(packetHandle, "RoadUserChargingReportMessage", newPath);
    }
  }

  snprintf(newPath, elcount(newPath), "%s.%s", oldPath, "licencePlateNumber");
  if(value.licencePlateNumber.isValidFlag==1)
  {
    SetRoadUserChargingReportMessageEfcDataDictionary_LpnParams(packetHandle, value.licencePlateNumber, newPath);
    result = CheckLastError("RoadUserChargingReportMessage", gkFuncRefGet, result);
  }
  else
  {
    if( C2xIsTokenAvailable(packetHandle, "RoadUserChargingReportMessage", newPath) )
    {
      C2xRemoveToken(packetHandle, "RoadUserChargingReportMessage", newPath);
    }
  }

  snprintf(newPath, elcount(newPath), "%s.%s", oldPath, "obeId");
  if(value.obeId.isValidFlag==1)
  {
    SetRoadUserChargingReportMessageEfcDataDictionary_ObeIdParams(packetHandle, value.obeId, newPath);
    result = CheckLastError("RoadUserChargingReportMessage", gkFuncRefGet, result);
  }
  else
  {
    if( C2xIsTokenAvailable(packetHandle, "RoadUserChargingReportMessage", newPath) )
    {
      C2xRemoveToken(packetHandle, "RoadUserChargingReportMessage", newPath);
    }
  }

  snprintf(newPath, elcount(newPath), "%s.%s", oldPath, "iccId");
  if(value.iccId.isValidFlag==1)
  {
    C2xSetTokenData(packetHandle, "RoadUserChargingReportMessage", newPath, value.iccId.stringLength, value.iccId.string);
  }
  else
  {
    if( C2xIsTokenAvailable(packetHandle, "RoadUserChargingReportMessage", newPath) )
    {
      C2xRemoveToken(packetHandle, "RoadUserChargingReportMessage", newPath);
    }
  }

  return result;
}

int GetRoadUserChargingReportMessageTollUsageMessage_VehicleIdParams(LONG packetHandle, struct RoadUserChargingReportMessageTollUsageMessage_VehicleId value, char oldPath[])
{
  char newPath[300];
  char buffer[300];
  int result;

  result = 0;

  snprintf(newPath, elcount(newPath), "%s.%s", oldPath, "vehicleIdentity");
  value.vehicleIdentity.isValidFlag = C2xIsTokenAvailable(packetHandle, "RoadUserChargingReportMessage", newPath);
  if(value.vehicleIdentity.isValidFlag==1)
  {
    value.vehicleIdentity.isValidFlag = 1;
    value.vehicleIdentity.stringLength = C2xGetTokenData(packetHandle, "RoadUserChargingReportMessage", newPath, elcount(value.vehicleIdentity.string), value.vehicleIdentity.string);
  }
  snprintf(newPath, elcount(newPath), "%s.%s", oldPath, "licPlateState");
  value.licPlateState.isValidFlag = C2xIsTokenAvailable(packetHandle, "RoadUserChargingReportMessage", newPath);
  if(value.licPlateState.isValidFlag==1)
  {
    value.licPlateState.stringLength = C2xGetTokenData(packetHandle, "RoadUserChargingReportMessage", newPath, elcount(value.licPlateState.string), value.licPlateState.string);
    result = CheckLastError("RoadUserChargingReportMessage", gkFuncRefGet, result);
  }
  snprintf(newPath, elcount(newPath), "%s.%s", oldPath, "licPlateNumVeh");
  value.licPlateNumVeh.isValidFlag = C2xIsTokenAvailable(packetHandle, "RoadUserChargingReportMessage", newPath);
  if(value.licPlateNumVeh.isValidFlag==1)
  {
    value.licPlateNumVeh.stringLength = C2xGetTokenData(packetHandle, "RoadUserChargingReportMessage", newPath, elcount(value.licPlateNumVeh.string), value.licPlateNumVeh.string);
    result = CheckLastError("RoadUserChargingReportMessage", gkFuncRefGet, result);
  }
  snprintf(newPath, elcount(newPath), "%s.%s", oldPath, "licPlateNumTrailer");
  value.licPlateNumTrailer.isValidFlag = C2xIsTokenAvailable(packetHandle, "RoadUserChargingReportMessage", newPath);
  if(value.licPlateNumTrailer.isValidFlag==1)
  {
    value.licPlateNumTrailer.stringLength = C2xGetTokenData(packetHandle, "RoadUserChargingReportMessage", newPath, elcount(value.licPlateNumTrailer.string), value.licPlateNumTrailer.string);
    result = CheckLastError("RoadUserChargingReportMessage", gkFuncRefGet, result);
  }
  snprintf(newPath, elcount(newPath), "%s.%s", oldPath, "userId");
  value.userId.isValidFlag = C2xIsTokenAvailable(packetHandle, "RoadUserChargingReportMessage", newPath);
  if(value.userId.isValidFlag==1)
  {
    GetRoadUserChargingReportMessageEfcDataDictionary_UserIdParams(packetHandle, value.userId, newPath);
    result = CheckLastError("RoadUserChargingReportMessage", gkFuncRefGet, result);
  }
  return result;
}

int SetRoadUserChargingReportMessageTollUsageMessage_VehicleIdParams(LONG packetHandle, struct RoadUserChargingReportMessageTollUsageMessage_VehicleId value, char oldPath[])
{
  char newPath[300];
  char buffer[300];
  int result;

  result = 0;

  snprintf(newPath, elcount(newPath), "%s.%s", oldPath, "vehicleIdentity");
  if(value.vehicleIdentity.isValidFlag==1)
  {
    C2xSetTokenData(packetHandle, "RoadUserChargingReportMessage", newPath, value.vehicleIdentity.stringLength, value.vehicleIdentity.string);
  }
  else
  {
    if( C2xIsTokenAvailable(packetHandle, "RoadUserChargingReportMessage", newPath) )
    {
      C2xRemoveToken(packetHandle, "RoadUserChargingReportMessage", newPath);
    }
  }

  snprintf(newPath, elcount(newPath), "%s.%s", oldPath, "licPlateState");
  if(value.licPlateState.isValidFlag==1)
  {
    C2xSetTokenData(packetHandle, "RoadUserChargingReportMessage", newPath, value.licPlateState.stringLength, value.licPlateState.string);
    result = CheckLastError("RoadUserChargingReportMessage", gkFuncRefGet, result);
  }
  else
  {
    if( C2xIsTokenAvailable(packetHandle, "RoadUserChargingReportMessage", newPath) )
    {
      C2xRemoveToken(packetHandle, "RoadUserChargingReportMessage", newPath);
    }
  }

  snprintf(newPath, elcount(newPath), "%s.%s", oldPath, "licPlateNumVeh");
  if(value.licPlateNumVeh.isValidFlag==1)
  {
    C2xSetTokenData(packetHandle, "RoadUserChargingReportMessage", newPath, value.licPlateNumVeh.stringLength, value.licPlateNumVeh.string);
    result = CheckLastError("RoadUserChargingReportMessage", gkFuncRefGet, result);
  }
  else
  {
    if( C2xIsTokenAvailable(packetHandle, "RoadUserChargingReportMessage", newPath) )
    {
      C2xRemoveToken(packetHandle, "RoadUserChargingReportMessage", newPath);
    }
  }

  snprintf(newPath, elcount(newPath), "%s.%s", oldPath, "licPlateNumTrailer");
  if(value.licPlateNumTrailer.isValidFlag==1)
  {
    C2xSetTokenData(packetHandle, "RoadUserChargingReportMessage", newPath, value.licPlateNumTrailer.stringLength, value.licPlateNumTrailer.string);
    result = CheckLastError("RoadUserChargingReportMessage", gkFuncRefGet, result);
  }
  else
  {
    if( C2xIsTokenAvailable(packetHandle, "RoadUserChargingReportMessage", newPath) )
    {
      C2xRemoveToken(packetHandle, "RoadUserChargingReportMessage", newPath);
    }
  }

  snprintf(newPath, elcount(newPath), "%s.%s", oldPath, "userId");
  if(value.userId.isValidFlag==1)
  {
    SetRoadUserChargingReportMessageEfcDataDictionary_UserIdParams(packetHandle, value.userId, newPath);
    result = CheckLastError("RoadUserChargingReportMessage", gkFuncRefGet, result);
  }
  else
  {
    if( C2xIsTokenAvailable(packetHandle, "RoadUserChargingReportMessage", newPath) )
    {
      C2xRemoveToken(packetHandle, "RoadUserChargingReportMessage", newPath);
    }
  }

  return result;
}

int GetRoadUserChargingReportMessageEfcDataDictionary_NumberOfAxlesParams(LONG packetHandle, struct RoadUserChargingReportMessageEfcDataDictionary_NumberOfAxles value, char oldPath[])
{
  char newPath[300];
  int result;

  result = 0;

  snprintf(newPath, elcount(newPath), "%s.%s", oldPath, "trailerAxles");
  value.trailerAxles = C2xGetTokenInt(packetHandle, "RoadUserChargingReportMessage", newPath);
  result = CheckLastError("RoadUserChargingReportMessage", gkFuncRefGet, result);

  snprintf(newPath, elcount(newPath), "%s.%s", oldPath, "tractorAxles");
  value.tractorAxles = C2xGetTokenInt(packetHandle, "RoadUserChargingReportMessage", newPath);
  result = CheckLastError("RoadUserChargingReportMessage", gkFuncRefGet, result);

  return result;
}

int SetRoadUserChargingReportMessageEfcDataDictionary_NumberOfAxlesParams(LONG packetHandle, struct RoadUserChargingReportMessageEfcDataDictionary_NumberOfAxles value, char oldPath[])
{
  char newPath[300];
  int result;

  result = 0;

  snprintf(newPath, elcount(newPath), "%s.%s", oldPath, "trailerAxles");
  C2xSetTokenInt(packetHandle, "RoadUserChargingReportMessage", newPath, value.trailerAxles);
  result = CheckLastError("RoadUserChargingReportMessage", gkFuncRefGet, result);

  snprintf(newPath, elcount(newPath), "%s.%s", oldPath, "tractorAxles");
  C2xSetTokenInt(packetHandle, "RoadUserChargingReportMessage", newPath, value.tractorAxles);
  result = CheckLastError("RoadUserChargingReportMessage", gkFuncRefGet, result);

  return result;
}

int GetRoadUserChargingReportMessageEfcDataDictionary_VehicleAxlesNumberParams(LONG packetHandle, struct RoadUserChargingReportMessageEfcDataDictionary_VehicleAxlesNumber value, char oldPath[])
{
  char newPath[300];
  int result;

  result = 0;

  snprintf(newPath, elcount(newPath), "%s.%s", oldPath, "tyreConfiguration");
  value.tyreConfiguration = C2xGetTokenInt(packetHandle, "RoadUserChargingReportMessage", newPath);
  result = CheckLastError("RoadUserChargingReportMessage", gkFuncRefGet, result);

  snprintf(newPath, elcount(newPath), "%s.%s", oldPath, "numberOfAxles");
  GetRoadUserChargingReportMessageEfcDataDictionary_NumberOfAxlesParams(packetHandle, value.numberOfAxles, newPath);
  result = CheckLastError("RoadUserChargingReportMessage", gkFuncRefGet, result);

  return result;
}

int SetRoadUserChargingReportMessageEfcDataDictionary_VehicleAxlesNumberParams(LONG packetHandle, struct RoadUserChargingReportMessageEfcDataDictionary_VehicleAxlesNumber value, char oldPath[])
{
  char newPath[300];
  int result;

  result = 0;

  snprintf(newPath, elcount(newPath), "%s.%s", oldPath, "tyreConfiguration");
  C2xSetTokenInt(packetHandle, "RoadUserChargingReportMessage", newPath, value.tyreConfiguration);
  result = CheckLastError("RoadUserChargingReportMessage", gkFuncRefGet, result);

  snprintf(newPath, elcount(newPath), "%s.%s", oldPath, "numberOfAxles");
  SetRoadUserChargingReportMessageEfcDataDictionary_NumberOfAxlesParams(packetHandle, value.numberOfAxles, newPath);
  result = CheckLastError("RoadUserChargingReportMessage", gkFuncRefGet, result);

  return result;
}

int GetRoadUserChargingReportMessageEfcDataDictionary_VehicleAxlesParams(LONG packetHandle, struct RoadUserChargingReportMessageEfcDataDictionary_VehicleAxles value, char oldPath[])
{
  char newPath[300];
  int result;

  result = 0;

  snprintf(newPath, elcount(newPath), "%s.%s", oldPath, "vehicleFirstAxleHeight");
  value.vehicleFirstAxleHeight = C2xGetTokenInt(packetHandle, "RoadUserChargingReportMessage", newPath);
  result = CheckLastError("RoadUserChargingReportMessage", gkFuncRefGet, result);

  snprintf(newPath, elcount(newPath), "%s.%s", oldPath, "vehicleAxlesNumber");
  GetRoadUserChargingReportMessageEfcDataDictionary_VehicleAxlesNumberParams(packetHandle, value.vehicleAxlesNumber, newPath);
  result = CheckLastError("RoadUserChargingReportMessage", gkFuncRefGet, result);

  return result;
}

int SetRoadUserChargingReportMessageEfcDataDictionary_VehicleAxlesParams(LONG packetHandle, struct RoadUserChargingReportMessageEfcDataDictionary_VehicleAxles value, char oldPath[])
{
  char newPath[300];
  int result;

  result = 0;

  snprintf(newPath, elcount(newPath), "%s.%s", oldPath, "vehicleFirstAxleHeight");
  C2xSetTokenInt(packetHandle, "RoadUserChargingReportMessage", newPath, value.vehicleFirstAxleHeight);
  result = CheckLastError("RoadUserChargingReportMessage", gkFuncRefGet, result);

  snprintf(newPath, elcount(newPath), "%s.%s", oldPath, "vehicleAxlesNumber");
  SetRoadUserChargingReportMessageEfcDataDictionary_VehicleAxlesNumberParams(packetHandle, value.vehicleAxlesNumber, newPath);
  result = CheckLastError("RoadUserChargingReportMessage", gkFuncRefGet, result);

  return result;
}

int GetRoadUserChargingReportMessageEfcDataDictionary_VehicleDimensionsParams(LONG packetHandle, struct RoadUserChargingReportMessageEfcDataDictionary_VehicleDimensions value, char oldPath[])
{
  char newPath[300];
  int result;

  result = 0;

  snprintf(newPath, elcount(newPath), "%s.%s", oldPath, "vehicleLengthOverall");
  value.vehicleLengthOverall = C2xGetTokenInt(packetHandle, "RoadUserChargingReportMessage", newPath);
  result = CheckLastError("RoadUserChargingReportMessage", gkFuncRefGet, result);

  snprintf(newPath, elcount(newPath), "%s.%s", oldPath, "vehicleHeigthOverall");
  value.vehicleHeigthOverall = C2xGetTokenInt(packetHandle, "RoadUserChargingReportMessage", newPath);
  result = CheckLastError("RoadUserChargingReportMessage", gkFuncRefGet, result);

  snprintf(newPath, elcount(newPath), "%s.%s", oldPath, "vehicleWidthOverall");
  value.vehicleWidthOverall = C2xGetTokenInt(packetHandle, "RoadUserChargingReportMessage", newPath);
  result = CheckLastError("RoadUserChargingReportMessage", gkFuncRefGet, result);

  return result;
}

int SetRoadUserChargingReportMessageEfcDataDictionary_VehicleDimensionsParams(LONG packetHandle, struct RoadUserChargingReportMessageEfcDataDictionary_VehicleDimensions value, char oldPath[])
{
  char newPath[300];
  int result;

  result = 0;

  snprintf(newPath, elcount(newPath), "%s.%s", oldPath, "vehicleLengthOverall");
  C2xSetTokenInt(packetHandle, "RoadUserChargingReportMessage", newPath, value.vehicleLengthOverall);
  result = CheckLastError("RoadUserChargingReportMessage", gkFuncRefGet, result);

  snprintf(newPath, elcount(newPath), "%s.%s", oldPath, "vehicleHeigthOverall");
  C2xSetTokenInt(packetHandle, "RoadUserChargingReportMessage", newPath, value.vehicleHeigthOverall);
  result = CheckLastError("RoadUserChargingReportMessage", gkFuncRefGet, result);

  snprintf(newPath, elcount(newPath), "%s.%s", oldPath, "vehicleWidthOverall");
  C2xSetTokenInt(packetHandle, "RoadUserChargingReportMessage", newPath, value.vehicleWidthOverall);
  result = CheckLastError("RoadUserChargingReportMessage", gkFuncRefGet, result);

  return result;
}

int GetRoadUserChargingReportMessageEfcDataDictionary_EnvironmentalCharacteristicsParams(LONG packetHandle, struct RoadUserChargingReportMessageEfcDataDictionary_EnvironmentalCharacteristics value, char oldPath[])
{
  char newPath[300];
  int result;

  result = 0;

  snprintf(newPath, elcount(newPath), "%s.%s", oldPath, "euroValue");
  value.euroValue = C2xGetTokenInt(packetHandle, "RoadUserChargingReportMessage", newPath);
  result = CheckLastError("RoadUserChargingReportMessage", gkFuncRefGet, result);

  snprintf(newPath, elcount(newPath), "%s.%s", oldPath, "copValue");
  value.copValue = C2xGetTokenInt(packetHandle, "RoadUserChargingReportMessage", newPath);
  result = CheckLastError("RoadUserChargingReportMessage", gkFuncRefGet, result);

  return result;
}

int SetRoadUserChargingReportMessageEfcDataDictionary_EnvironmentalCharacteristicsParams(LONG packetHandle, struct RoadUserChargingReportMessageEfcDataDictionary_EnvironmentalCharacteristics value, char oldPath[])
{
  char newPath[300];
  int result;

  result = 0;

  snprintf(newPath, elcount(newPath), "%s.%s", oldPath, "euroValue");
  C2xSetTokenInt(packetHandle, "RoadUserChargingReportMessage", newPath, value.euroValue);
  result = CheckLastError("RoadUserChargingReportMessage", gkFuncRefGet, result);

  snprintf(newPath, elcount(newPath), "%s.%s", oldPath, "copValue");
  C2xSetTokenInt(packetHandle, "RoadUserChargingReportMessage", newPath, value.copValue);
  result = CheckLastError("RoadUserChargingReportMessage", gkFuncRefGet, result);

  return result;
}

int GetRoadUserChargingReportMessageEfcDataDictionary_VehicleSpecificCharacteristicsParams(LONG packetHandle, struct RoadUserChargingReportMessageEfcDataDictionary_VehicleSpecificCharacteristics value, char oldPath[])
{
  char newPath[300];
  int result;

  result = 0;

  snprintf(newPath, elcount(newPath), "%s.%s", oldPath, "environmentalCharacteristics");
  GetRoadUserChargingReportMessageEfcDataDictionary_EnvironmentalCharacteristicsParams(packetHandle, value.environmentalCharacteristics, newPath);
  result = CheckLastError("RoadUserChargingReportMessage", gkFuncRefGet, result);

  snprintf(newPath, elcount(newPath), "%s.%s", oldPath, "engineCharacteristics");
  value.engineCharacteristics = C2xGetTokenInt(packetHandle, "RoadUserChargingReportMessage", newPath);
  result = CheckLastError("RoadUserChargingReportMessage", gkFuncRefGet, result);

  snprintf(newPath, elcount(newPath), "%s.%s", oldPath, "descriptiveCharacteristics");
  value.descriptiveCharacteristics = C2xGetTokenInt(packetHandle, "RoadUserChargingReportMessage", newPath);
  result = CheckLastError("RoadUserChargingReportMessage", gkFuncRefGet, result);

  snprintf(newPath, elcount(newPath), "%s.%s", oldPath, "futureCharacteristics");
  value.futureCharacteristics = C2xGetTokenInt(packetHandle, "RoadUserChargingReportMessage", newPath);
  result = CheckLastError("RoadUserChargingReportMessage", gkFuncRefGet, result);

  return result;
}

int SetRoadUserChargingReportMessageEfcDataDictionary_VehicleSpecificCharacteristicsParams(LONG packetHandle, struct RoadUserChargingReportMessageEfcDataDictionary_VehicleSpecificCharacteristics value, char oldPath[])
{
  char newPath[300];
  int result;

  result = 0;

  snprintf(newPath, elcount(newPath), "%s.%s", oldPath, "environmentalCharacteristics");
  SetRoadUserChargingReportMessageEfcDataDictionary_EnvironmentalCharacteristicsParams(packetHandle, value.environmentalCharacteristics, newPath);
  result = CheckLastError("RoadUserChargingReportMessage", gkFuncRefGet, result);

  snprintf(newPath, elcount(newPath), "%s.%s", oldPath, "engineCharacteristics");
  C2xSetTokenInt(packetHandle, "RoadUserChargingReportMessage", newPath, value.engineCharacteristics);
  result = CheckLastError("RoadUserChargingReportMessage", gkFuncRefGet, result);

  snprintf(newPath, elcount(newPath), "%s.%s", oldPath, "descriptiveCharacteristics");
  C2xSetTokenInt(packetHandle, "RoadUserChargingReportMessage", newPath, value.descriptiveCharacteristics);
  result = CheckLastError("RoadUserChargingReportMessage", gkFuncRefGet, result);

  snprintf(newPath, elcount(newPath), "%s.%s", oldPath, "futureCharacteristics");
  C2xSetTokenInt(packetHandle, "RoadUserChargingReportMessage", newPath, value.futureCharacteristics);
  result = CheckLastError("RoadUserChargingReportMessage", gkFuncRefGet, result);

  return result;
}

int GetRoadUserChargingReportMessageEfcDataDictionary_VehicleWeightLimitsParams(LONG packetHandle, struct RoadUserChargingReportMessageEfcDataDictionary_VehicleWeightLimits value, char oldPath[])
{
  char newPath[300];
  int result;

  result = 0;

  snprintf(newPath, elcount(newPath), "%s.%s", oldPath, "vehicleMaxLadenWeight");
  value.vehicleMaxLadenWeight = C2xGetTokenInt(packetHandle, "RoadUserChargingReportMessage", newPath);
  result = CheckLastError("RoadUserChargingReportMessage", gkFuncRefGet, result);

  snprintf(newPath, elcount(newPath), "%s.%s", oldPath, "vehicleTrainMaximumWeight");
  value.vehicleTrainMaximumWeight = C2xGetTokenInt(packetHandle, "RoadUserChargingReportMessage", newPath);
  result = CheckLastError("RoadUserChargingReportMessage", gkFuncRefGet, result);

  snprintf(newPath, elcount(newPath), "%s.%s", oldPath, "vehicleWeightUnladen");
  value.vehicleWeightUnladen = C2xGetTokenInt(packetHandle, "RoadUserChargingReportMessage", newPath);
  result = CheckLastError("RoadUserChargingReportMessage", gkFuncRefGet, result);

  return result;
}

int SetRoadUserChargingReportMessageEfcDataDictionary_VehicleWeightLimitsParams(LONG packetHandle, struct RoadUserChargingReportMessageEfcDataDictionary_VehicleWeightLimits value, char oldPath[])
{
  char newPath[300];
  int result;

  result = 0;

  snprintf(newPath, elcount(newPath), "%s.%s", oldPath, "vehicleMaxLadenWeight");
  C2xSetTokenInt(packetHandle, "RoadUserChargingReportMessage", newPath, value.vehicleMaxLadenWeight);
  result = CheckLastError("RoadUserChargingReportMessage", gkFuncRefGet, result);

  snprintf(newPath, elcount(newPath), "%s.%s", oldPath, "vehicleTrainMaximumWeight");
  C2xSetTokenInt(packetHandle, "RoadUserChargingReportMessage", newPath, value.vehicleTrainMaximumWeight);
  result = CheckLastError("RoadUserChargingReportMessage", gkFuncRefGet, result);

  snprintf(newPath, elcount(newPath), "%s.%s", oldPath, "vehicleWeightUnladen");
  C2xSetTokenInt(packetHandle, "RoadUserChargingReportMessage", newPath, value.vehicleWeightUnladen);
  result = CheckLastError("RoadUserChargingReportMessage", gkFuncRefGet, result);

  return result;
}

int GetRoadUserChargingReportMessageEfcDataDictionary_TrailerDetailsParams(LONG packetHandle, struct RoadUserChargingReportMessageEfcDataDictionary_TrailerDetails value, char oldPath[])
{
  char newPath[300];
  int result;

  result = 0;

  snprintf(newPath, elcount(newPath), "%s.%s", oldPath, "trailerType");
  value.trailerType = C2xGetTokenInt(packetHandle, "RoadUserChargingReportMessage", newPath);
  result = CheckLastError("RoadUserChargingReportMessage", gkFuncRefGet, result);

  snprintf(newPath, elcount(newPath), "%s.%s", oldPath, "trailerAxles");
  value.trailerAxles = C2xGetTokenInt(packetHandle, "RoadUserChargingReportMessage", newPath);
  result = CheckLastError("RoadUserChargingReportMessage", gkFuncRefGet, result);

  return result;
}

int SetRoadUserChargingReportMessageEfcDataDictionary_TrailerDetailsParams(LONG packetHandle, struct RoadUserChargingReportMessageEfcDataDictionary_TrailerDetails value, char oldPath[])
{
  char newPath[300];
  int result;

  result = 0;

  snprintf(newPath, elcount(newPath), "%s.%s", oldPath, "trailerType");
  C2xSetTokenInt(packetHandle, "RoadUserChargingReportMessage", newPath, value.trailerType);
  result = CheckLastError("RoadUserChargingReportMessage", gkFuncRefGet, result);

  snprintf(newPath, elcount(newPath), "%s.%s", oldPath, "trailerAxles");
  C2xSetTokenInt(packetHandle, "RoadUserChargingReportMessage", newPath, value.trailerAxles);
  result = CheckLastError("RoadUserChargingReportMessage", gkFuncRefGet, result);

  return result;
}

int GetRoadUserChargingReportMessageEfcDataDictionary_TrailerCharacteristicsParams(LONG packetHandle, struct RoadUserChargingReportMessageEfcDataDictionary_TrailerCharacteristics value, char oldPath[])
{
  char newPath[300];
  int result;

  result = 0;

  snprintf(newPath, elcount(newPath), "%s.%s", oldPath, "trailerDetails");
  GetRoadUserChargingReportMessageEfcDataDictionary_TrailerDetailsParams(packetHandle, value.trailerDetails, newPath);
  result = CheckLastError("RoadUserChargingReportMessage", gkFuncRefGet, result);

  snprintf(newPath, elcount(newPath), "%s.%s", oldPath, "trailerMaxLadenWeight");
  value.trailerMaxLadenWeight = C2xGetTokenInt(packetHandle, "RoadUserChargingReportMessage", newPath);
  result = CheckLastError("RoadUserChargingReportMessage", gkFuncRefGet, result);

  snprintf(newPath, elcount(newPath), "%s.%s", oldPath, "trailerWeightUnladen");
  value.trailerWeightUnladen = C2xGetTokenInt(packetHandle, "RoadUserChargingReportMessage", newPath);
  result = CheckLastError("RoadUserChargingReportMessage", gkFuncRefGet, result);

  return result;
}

int SetRoadUserChargingReportMessageEfcDataDictionary_TrailerCharacteristicsParams(LONG packetHandle, struct RoadUserChargingReportMessageEfcDataDictionary_TrailerCharacteristics value, char oldPath[])
{
  char newPath[300];
  int result;

  result = 0;

  snprintf(newPath, elcount(newPath), "%s.%s", oldPath, "trailerDetails");
  SetRoadUserChargingReportMessageEfcDataDictionary_TrailerDetailsParams(packetHandle, value.trailerDetails, newPath);
  result = CheckLastError("RoadUserChargingReportMessage", gkFuncRefGet, result);

  snprintf(newPath, elcount(newPath), "%s.%s", oldPath, "trailerMaxLadenWeight");
  C2xSetTokenInt(packetHandle, "RoadUserChargingReportMessage", newPath, value.trailerMaxLadenWeight);
  result = CheckLastError("RoadUserChargingReportMessage", gkFuncRefGet, result);

  snprintf(newPath, elcount(newPath), "%s.%s", oldPath, "trailerWeightUnladen");
  C2xSetTokenInt(packetHandle, "RoadUserChargingReportMessage", newPath, value.trailerWeightUnladen);
  result = CheckLastError("RoadUserChargingReportMessage", gkFuncRefGet, result);

  return result;
}

int GetRoadUserChargingReportMessageEfcDataDictionary_AxleWeightLimitsParams(LONG packetHandle, struct RoadUserChargingReportMessageEfcDataDictionary_AxleWeightLimits value, char oldPath[])
{
  char newPath[300];
  int result;

  result = 0;

  snprintf(newPath, elcount(newPath), "%s.%s", oldPath, "maxLadenweightOnAxle1");
  value.maxLadenweightOnAxle1 = C2xGetTokenInt(packetHandle, "RoadUserChargingReportMessage", newPath);
  result = CheckLastError("RoadUserChargingReportMessage", gkFuncRefGet, result);

  snprintf(newPath, elcount(newPath), "%s.%s", oldPath, "maxLadenweightOnAxle2");
  value.maxLadenweightOnAxle2 = C2xGetTokenInt(packetHandle, "RoadUserChargingReportMessage", newPath);
  result = CheckLastError("RoadUserChargingReportMessage", gkFuncRefGet, result);

  snprintf(newPath, elcount(newPath), "%s.%s", oldPath, "maxLadenweightOnAxle3");
  value.maxLadenweightOnAxle3 = C2xGetTokenInt(packetHandle, "RoadUserChargingReportMessage", newPath);
  result = CheckLastError("RoadUserChargingReportMessage", gkFuncRefGet, result);

  snprintf(newPath, elcount(newPath), "%s.%s", oldPath, "maxLadenweightOnAxle4");
  value.maxLadenweightOnAxle4 = C2xGetTokenInt(packetHandle, "RoadUserChargingReportMessage", newPath);
  result = CheckLastError("RoadUserChargingReportMessage", gkFuncRefGet, result);

  snprintf(newPath, elcount(newPath), "%s.%s", oldPath, "maxLadenweightOnAxle5");
  value.maxLadenweightOnAxle5 = C2xGetTokenInt(packetHandle, "RoadUserChargingReportMessage", newPath);
  result = CheckLastError("RoadUserChargingReportMessage", gkFuncRefGet, result);

  return result;
}

int SetRoadUserChargingReportMessageEfcDataDictionary_AxleWeightLimitsParams(LONG packetHandle, struct RoadUserChargingReportMessageEfcDataDictionary_AxleWeightLimits value, char oldPath[])
{
  char newPath[300];
  int result;

  result = 0;

  snprintf(newPath, elcount(newPath), "%s.%s", oldPath, "maxLadenweightOnAxle1");
  C2xSetTokenInt(packetHandle, "RoadUserChargingReportMessage", newPath, value.maxLadenweightOnAxle1);
  result = CheckLastError("RoadUserChargingReportMessage", gkFuncRefGet, result);

  snprintf(newPath, elcount(newPath), "%s.%s", oldPath, "maxLadenweightOnAxle2");
  C2xSetTokenInt(packetHandle, "RoadUserChargingReportMessage", newPath, value.maxLadenweightOnAxle2);
  result = CheckLastError("RoadUserChargingReportMessage", gkFuncRefGet, result);

  snprintf(newPath, elcount(newPath), "%s.%s", oldPath, "maxLadenweightOnAxle3");
  C2xSetTokenInt(packetHandle, "RoadUserChargingReportMessage", newPath, value.maxLadenweightOnAxle3);
  result = CheckLastError("RoadUserChargingReportMessage", gkFuncRefGet, result);

  snprintf(newPath, elcount(newPath), "%s.%s", oldPath, "maxLadenweightOnAxle4");
  C2xSetTokenInt(packetHandle, "RoadUserChargingReportMessage", newPath, value.maxLadenweightOnAxle4);
  result = CheckLastError("RoadUserChargingReportMessage", gkFuncRefGet, result);

  snprintf(newPath, elcount(newPath), "%s.%s", oldPath, "maxLadenweightOnAxle5");
  C2xSetTokenInt(packetHandle, "RoadUserChargingReportMessage", newPath, value.maxLadenweightOnAxle5);
  result = CheckLastError("RoadUserChargingReportMessage", gkFuncRefGet, result);

  return result;
}

int GetRoadUserChargingReportMessageEfcDataDictionary_ParticulateParams(LONG packetHandle, struct RoadUserChargingReportMessageEfcDataDictionary_Particulate value, char oldPath[])
{
  char newPath[300];
  int result;

  result = 0;

  snprintf(newPath, elcount(newPath), "%s.%s", oldPath, "unitType");
  value.unitType = C2xGetTokenInt(packetHandle, "RoadUserChargingReportMessage", newPath);
  result = CheckLastError("RoadUserChargingReportMessage", gkFuncRefGet, result);

  snprintf(newPath, elcount(newPath), "%s.%s", oldPath, "value");
  value.value = C2xGetTokenInt(packetHandle, "RoadUserChargingReportMessage", newPath);
  result = CheckLastError("RoadUserChargingReportMessage", gkFuncRefGet, result);

  return result;
}

int SetRoadUserChargingReportMessageEfcDataDictionary_ParticulateParams(LONG packetHandle, struct RoadUserChargingReportMessageEfcDataDictionary_Particulate value, char oldPath[])
{
  char newPath[300];
  int result;

  result = 0;

  snprintf(newPath, elcount(newPath), "%s.%s", oldPath, "unitType");
  C2xSetTokenInt(packetHandle, "RoadUserChargingReportMessage", newPath, value.unitType);
  result = CheckLastError("RoadUserChargingReportMessage", gkFuncRefGet, result);

  snprintf(newPath, elcount(newPath), "%s.%s", oldPath, "value");
  C2xSetTokenInt(packetHandle, "RoadUserChargingReportMessage", newPath, value.value);
  result = CheckLastError("RoadUserChargingReportMessage", gkFuncRefGet, result);

  return result;
}

int GetRoadUserChargingReportMessageEfcDataDictionary_DieselEmissionValuesParams(LONG packetHandle, struct RoadUserChargingReportMessageEfcDataDictionary_DieselEmissionValues value, char oldPath[])
{
  char newPath[300];
  int result;

  result = 0;

  snprintf(newPath, elcount(newPath), "%s.%s", oldPath, "particulate");
  GetRoadUserChargingReportMessageEfcDataDictionary_ParticulateParams(packetHandle, value.particulate, newPath);
  result = CheckLastError("RoadUserChargingReportMessage", gkFuncRefGet, result);

  snprintf(newPath, elcount(newPath), "%s.%s", oldPath, "absorptionCoeff");
  value.absorptionCoeff = C2xGetTokenInt(packetHandle, "RoadUserChargingReportMessage", newPath);
  result = CheckLastError("RoadUserChargingReportMessage", gkFuncRefGet, result);

  return result;
}

int SetRoadUserChargingReportMessageEfcDataDictionary_DieselEmissionValuesParams(LONG packetHandle, struct RoadUserChargingReportMessageEfcDataDictionary_DieselEmissionValues value, char oldPath[])
{
  char newPath[300];
  int result;

  result = 0;

  snprintf(newPath, elcount(newPath), "%s.%s", oldPath, "particulate");
  SetRoadUserChargingReportMessageEfcDataDictionary_ParticulateParams(packetHandle, value.particulate, newPath);
  result = CheckLastError("RoadUserChargingReportMessage", gkFuncRefGet, result);

  snprintf(newPath, elcount(newPath), "%s.%s", oldPath, "absorptionCoeff");
  C2xSetTokenInt(packetHandle, "RoadUserChargingReportMessage", newPath, value.absorptionCoeff);
  result = CheckLastError("RoadUserChargingReportMessage", gkFuncRefGet, result);

  return result;
}

int GetRoadUserChargingReportMessageEfcDataDictionary_DriverCharacteristicsParams(LONG packetHandle, struct RoadUserChargingReportMessageEfcDataDictionary_DriverCharacteristics value, char oldPath[])
{
  char newPath[300];
  int result;

  result = 0;

  snprintf(newPath, elcount(newPath), "%s.%s", oldPath, "driverClass");
  value.driverClass = C2xGetTokenInt(packetHandle, "RoadUserChargingReportMessage", newPath);
  result = CheckLastError("RoadUserChargingReportMessage", gkFuncRefGet, result);

  snprintf(newPath, elcount(newPath), "%s.%s", oldPath, "tripPurpose");
  value.tripPurpose = C2xGetTokenInt(packetHandle, "RoadUserChargingReportMessage", newPath);
  result = CheckLastError("RoadUserChargingReportMessage", gkFuncRefGet, result);

  return result;
}

int SetRoadUserChargingReportMessageEfcDataDictionary_DriverCharacteristicsParams(LONG packetHandle, struct RoadUserChargingReportMessageEfcDataDictionary_DriverCharacteristics value, char oldPath[])
{
  char newPath[300];
  int result;

  result = 0;

  snprintf(newPath, elcount(newPath), "%s.%s", oldPath, "driverClass");
  C2xSetTokenInt(packetHandle, "RoadUserChargingReportMessage", newPath, value.driverClass);
  result = CheckLastError("RoadUserChargingReportMessage", gkFuncRefGet, result);

  snprintf(newPath, elcount(newPath), "%s.%s", oldPath, "tripPurpose");
  C2xSetTokenInt(packetHandle, "RoadUserChargingReportMessage", newPath, value.tripPurpose);
  result = CheckLastError("RoadUserChargingReportMessage", gkFuncRefGet, result);

  return result;
}

int GetRoadUserChargingReportMessageEfcDataDictionary_EngineDetailsParams(LONG packetHandle, struct RoadUserChargingReportMessageEfcDataDictionary_EngineDetails value, char oldPath[])
{
  char newPath[300];
  int result;

  result = 0;

  snprintf(newPath, elcount(newPath), "%s.%s", oldPath, "engineCapacity");
  value.engineCapacity = C2xGetTokenInt(packetHandle, "RoadUserChargingReportMessage", newPath);
  result = CheckLastError("RoadUserChargingReportMessage", gkFuncRefGet, result);

  snprintf(newPath, elcount(newPath), "%s.%s", oldPath, "enginePower");
  value.enginePower = C2xGetTokenInt(packetHandle, "RoadUserChargingReportMessage", newPath);
  result = CheckLastError("RoadUserChargingReportMessage", gkFuncRefGet, result);

  return result;
}

int SetRoadUserChargingReportMessageEfcDataDictionary_EngineDetailsParams(LONG packetHandle, struct RoadUserChargingReportMessageEfcDataDictionary_EngineDetails value, char oldPath[])
{
  char newPath[300];
  int result;

  result = 0;

  snprintf(newPath, elcount(newPath), "%s.%s", oldPath, "engineCapacity");
  C2xSetTokenInt(packetHandle, "RoadUserChargingReportMessage", newPath, value.engineCapacity);
  result = CheckLastError("RoadUserChargingReportMessage", gkFuncRefGet, result);

  snprintf(newPath, elcount(newPath), "%s.%s", oldPath, "enginePower");
  C2xSetTokenInt(packetHandle, "RoadUserChargingReportMessage", newPath, value.enginePower);
  result = CheckLastError("RoadUserChargingReportMessage", gkFuncRefGet, result);

  return result;
}

int GetRoadUserChargingReportMessageEfcDataDictionary_ExhaustEmissionValuesParams(LONG packetHandle, struct RoadUserChargingReportMessageEfcDataDictionary_ExhaustEmissionValues value, char oldPath[])
{
  char newPath[300];
  int result;

  result = 0;

  snprintf(newPath, elcount(newPath), "%s.%s", oldPath, "unitType");
  value.unitType = C2xGetTokenInt(packetHandle, "RoadUserChargingReportMessage", newPath);
  result = CheckLastError("RoadUserChargingReportMessage", gkFuncRefGet, result);

  snprintf(newPath, elcount(newPath), "%s.%s", oldPath, "emissionCo");
  value.emissionCo = C2xGetTokenInt(packetHandle, "RoadUserChargingReportMessage", newPath);
  result = CheckLastError("RoadUserChargingReportMessage", gkFuncRefGet, result);

  snprintf(newPath, elcount(newPath), "%s.%s", oldPath, "emissionHc");
  value.emissionHc = C2xGetTokenInt(packetHandle, "RoadUserChargingReportMessage", newPath);
  result = CheckLastError("RoadUserChargingReportMessage", gkFuncRefGet, result);

  snprintf(newPath, elcount(newPath), "%s.%s", oldPath, "emissionNox");
  value.emissionNox = C2xGetTokenInt(packetHandle, "RoadUserChargingReportMessage", newPath);
  result = CheckLastError("RoadUserChargingReportMessage", gkFuncRefGet, result);

  snprintf(newPath, elcount(newPath), "%s.%s", oldPath, "emissionHcNox");
  value.emissionHcNox = C2xGetTokenInt(packetHandle, "RoadUserChargingReportMessage", newPath);
  result = CheckLastError("RoadUserChargingReportMessage", gkFuncRefGet, result);

  return result;
}

int SetRoadUserChargingReportMessageEfcDataDictionary_ExhaustEmissionValuesParams(LONG packetHandle, struct RoadUserChargingReportMessageEfcDataDictionary_ExhaustEmissionValues value, char oldPath[])
{
  char newPath[300];
  int result;

  result = 0;

  snprintf(newPath, elcount(newPath), "%s.%s", oldPath, "unitType");
  C2xSetTokenInt(packetHandle, "RoadUserChargingReportMessage", newPath, value.unitType);
  result = CheckLastError("RoadUserChargingReportMessage", gkFuncRefGet, result);

  snprintf(newPath, elcount(newPath), "%s.%s", oldPath, "emissionCo");
  C2xSetTokenInt(packetHandle, "RoadUserChargingReportMessage", newPath, value.emissionCo);
  result = CheckLastError("RoadUserChargingReportMessage", gkFuncRefGet, result);

  snprintf(newPath, elcount(newPath), "%s.%s", oldPath, "emissionHc");
  C2xSetTokenInt(packetHandle, "RoadUserChargingReportMessage", newPath, value.emissionHc);
  result = CheckLastError("RoadUserChargingReportMessage", gkFuncRefGet, result);

  snprintf(newPath, elcount(newPath), "%s.%s", oldPath, "emissionNox");
  C2xSetTokenInt(packetHandle, "RoadUserChargingReportMessage", newPath, value.emissionNox);
  result = CheckLastError("RoadUserChargingReportMessage", gkFuncRefGet, result);

  snprintf(newPath, elcount(newPath), "%s.%s", oldPath, "emissionHcNox");
  C2xSetTokenInt(packetHandle, "RoadUserChargingReportMessage", newPath, value.emissionHcNox);
  result = CheckLastError("RoadUserChargingReportMessage", gkFuncRefGet, result);

  return result;
}

int GetRoadUserChargingReportMessageEfcDataDictionary_PassengerCapacityParams(LONG packetHandle, struct RoadUserChargingReportMessageEfcDataDictionary_PassengerCapacity value, char oldPath[])
{
  char newPath[300];
  int result;

  result = 0;

  snprintf(newPath, elcount(newPath), "%s.%s", oldPath, "numberOfSeats");
  value.numberOfSeats = C2xGetTokenInt(packetHandle, "RoadUserChargingReportMessage", newPath);
  result = CheckLastError("RoadUserChargingReportMessage", gkFuncRefGet, result);

  snprintf(newPath, elcount(newPath), "%s.%s", oldPath, "numberOfStandingPlaces");
  value.numberOfStandingPlaces = C2xGetTokenInt(packetHandle, "RoadUserChargingReportMessage", newPath);
  result = CheckLastError("RoadUserChargingReportMessage", gkFuncRefGet, result);

  return result;
}

int SetRoadUserChargingReportMessageEfcDataDictionary_PassengerCapacityParams(LONG packetHandle, struct RoadUserChargingReportMessageEfcDataDictionary_PassengerCapacity value, char oldPath[])
{
  char newPath[300];
  int result;

  result = 0;

  snprintf(newPath, elcount(newPath), "%s.%s", oldPath, "numberOfSeats");
  C2xSetTokenInt(packetHandle, "RoadUserChargingReportMessage", newPath, value.numberOfSeats);
  result = CheckLastError("RoadUserChargingReportMessage", gkFuncRefGet, result);

  snprintf(newPath, elcount(newPath), "%s.%s", oldPath, "numberOfStandingPlaces");
  C2xSetTokenInt(packetHandle, "RoadUserChargingReportMessage", newPath, value.numberOfStandingPlaces);
  result = CheckLastError("RoadUserChargingReportMessage", gkFuncRefGet, result);

  return result;
}

int GetRoadUserChargingReportMessageEfcDataDictionary_SoundLevelParams(LONG packetHandle, struct RoadUserChargingReportMessageEfcDataDictionary_SoundLevel value, char oldPath[])
{
  char newPath[300];
  int result;

  result = 0;

  snprintf(newPath, elcount(newPath), "%s.%s", oldPath, "soundStationary");
  value.soundStationary = C2xGetTokenInt(packetHandle, "RoadUserChargingReportMessage", newPath);
  result = CheckLastError("RoadUserChargingReportMessage", gkFuncRefGet, result);

  snprintf(newPath, elcount(newPath), "%s.%s", oldPath, "soundDriveBy");
  value.soundDriveBy = C2xGetTokenInt(packetHandle, "RoadUserChargingReportMessage", newPath);
  result = CheckLastError("RoadUserChargingReportMessage", gkFuncRefGet, result);

  return result;
}

int SetRoadUserChargingReportMessageEfcDataDictionary_SoundLevelParams(LONG packetHandle, struct RoadUserChargingReportMessageEfcDataDictionary_SoundLevel value, char oldPath[])
{
  char newPath[300];
  int result;

  result = 0;

  snprintf(newPath, elcount(newPath), "%s.%s", oldPath, "soundStationary");
  C2xSetTokenInt(packetHandle, "RoadUserChargingReportMessage", newPath, value.soundStationary);
  result = CheckLastError("RoadUserChargingReportMessage", gkFuncRefGet, result);

  snprintf(newPath, elcount(newPath), "%s.%s", oldPath, "soundDriveBy");
  C2xSetTokenInt(packetHandle, "RoadUserChargingReportMessage", newPath, value.soundDriveBy);
  result = CheckLastError("RoadUserChargingReportMessage", gkFuncRefGet, result);

  return result;
}

int GetRoadUserChargingReportMessageEfcDataDictionary_VehicleDescriptionParams(LONG packetHandle, struct RoadUserChargingReportMessageEfcDataDictionary_VehicleDescription value, char oldPath[])
{
  char newPath[300];
  int result;

  result = 0;

  snprintf(newPath, elcount(newPath), "%s.%s", oldPath, "vehicleLPNr");
  value.vehicleLPNr.isValidFlag = C2xIsTokenAvailable(packetHandle, "RoadUserChargingReportMessage", newPath);
  if(value.vehicleLPNr.isValidFlag==1)
  {
    GetRoadUserChargingReportMessageEfcDataDictionary_LpnParams(packetHandle, value.vehicleLPNr, newPath);
    result = CheckLastError("RoadUserChargingReportMessage", gkFuncRefGet, result);
  }
  snprintf(newPath, elcount(newPath), "%s.%s", oldPath, "axles");
  value.axles.isValidFlag = C2xIsTokenAvailable(packetHandle, "RoadUserChargingReportMessage", newPath);
  if(value.axles.isValidFlag==1)
  {
    GetRoadUserChargingReportMessageEfcDataDictionary_VehicleAxlesParams(packetHandle, value.axles, newPath);
    result = CheckLastError("RoadUserChargingReportMessage", gkFuncRefGet, result);
  }
  snprintf(newPath, elcount(newPath), "%s.%s", oldPath, "class");
  value.class.isValidFlag = C2xIsTokenAvailable(packetHandle, "RoadUserChargingReportMessage", newPath);
  if(value.class.isValidFlag==1)
  {
    value.class.value = C2xGetTokenInt(packetHandle, "RoadUserChargingReportMessage", newPath);
    result = CheckLastError("RoadUserChargingReportMessage", gkFuncRefGet, result);
  }
  snprintf(newPath, elcount(newPath), "%s.%s", oldPath, "dimensions");
  value.dimensions.isValidFlag = C2xIsTokenAvailable(packetHandle, "RoadUserChargingReportMessage", newPath);
  if(value.dimensions.isValidFlag==1)
  {
    GetRoadUserChargingReportMessageEfcDataDictionary_VehicleDimensionsParams(packetHandle, value.dimensions, newPath);
    result = CheckLastError("RoadUserChargingReportMessage", gkFuncRefGet, result);
  }
  snprintf(newPath, elcount(newPath), "%s.%s", oldPath, "specificCharacteristics");
  value.specificCharacteristics.isValidFlag = C2xIsTokenAvailable(packetHandle, "RoadUserChargingReportMessage", newPath);
  if(value.specificCharacteristics.isValidFlag==1)
  {
    GetRoadUserChargingReportMessageEfcDataDictionary_VehicleSpecificCharacteristicsParams(packetHandle, value.specificCharacteristics, newPath);
    result = CheckLastError("RoadUserChargingReportMessage", gkFuncRefGet, result);
  }
  snprintf(newPath, elcount(newPath), "%s.%s", oldPath, "ladenWeight");
  value.ladenWeight.isValidFlag = C2xIsTokenAvailable(packetHandle, "RoadUserChargingReportMessage", newPath);
  if(value.ladenWeight.isValidFlag==1)
  {
    value.ladenWeight.value = C2xGetTokenInt(packetHandle, "RoadUserChargingReportMessage", newPath);
    result = CheckLastError("RoadUserChargingReportMessage", gkFuncRefGet, result);
  }
  snprintf(newPath, elcount(newPath), "%s.%s", oldPath, "weightLimits");
  value.weightLimits.isValidFlag = C2xIsTokenAvailable(packetHandle, "RoadUserChargingReportMessage", newPath);
  if(value.weightLimits.isValidFlag==1)
  {
    GetRoadUserChargingReportMessageEfcDataDictionary_VehicleWeightLimitsParams(packetHandle, value.weightLimits, newPath);
    result = CheckLastError("RoadUserChargingReportMessage", gkFuncRefGet, result);
  }
  snprintf(newPath, elcount(newPath), "%s.%s", oldPath, "trailerCharacteristics");
  value.trailerCharacteristics.isValidFlag = C2xIsTokenAvailable(packetHandle, "RoadUserChargingReportMessage", newPath);
  if(value.trailerCharacteristics.isValidFlag==1)
  {
    GetRoadUserChargingReportMessageEfcDataDictionary_TrailerCharacteristicsParams(packetHandle, value.trailerCharacteristics, newPath);
    result = CheckLastError("RoadUserChargingReportMessage", gkFuncRefGet, result);
  }
  snprintf(newPath, elcount(newPath), "%s.%s", oldPath, "vehicleCurrentMaxTrainWeight");
  value.vehicleCurrentMaxTrainWeight.isValidFlag = C2xIsTokenAvailable(packetHandle, "RoadUserChargingReportMessage", newPath);
  if(value.vehicleCurrentMaxTrainWeight.isValidFlag==1)
  {
    value.vehicleCurrentMaxTrainWeight.value = C2xGetTokenInt(packetHandle, "RoadUserChargingReportMessage", newPath);
    result = CheckLastError("RoadUserChargingReportMessage", gkFuncRefGet, result);
  }
  snprintf(newPath, elcount(newPath), "%s.%s", oldPath, "actualNumberOfPassengers");
  value.actualNumberOfPassengers.isValidFlag = C2xIsTokenAvailable(packetHandle, "RoadUserChargingReportMessage", newPath);
  if(value.actualNumberOfPassengers.isValidFlag==1)
  {
    value.actualNumberOfPassengers.value = C2xGetTokenInt(packetHandle, "RoadUserChargingReportMessage", newPath);
    result = CheckLastError("RoadUserChargingReportMessage", gkFuncRefGet, result);
  }
  snprintf(newPath, elcount(newPath), "%s.%s", oldPath, "axleWeightLimits");
  value.axleWeightLimits.isValidFlag = C2xIsTokenAvailable(packetHandle, "RoadUserChargingReportMessage", newPath);
  if(value.axleWeightLimits.isValidFlag==1)
  {
    GetRoadUserChargingReportMessageEfcDataDictionary_AxleWeightLimitsParams(packetHandle, value.axleWeightLimits, newPath);
    result = CheckLastError("RoadUserChargingReportMessage", gkFuncRefGet, result);
  }
  snprintf(newPath, elcount(newPath), "%s.%s", oldPath, "dieselEmissionValues");
  value.dieselEmissionValues.isValidFlag = C2xIsTokenAvailable(packetHandle, "RoadUserChargingReportMessage", newPath);
  if(value.dieselEmissionValues.isValidFlag==1)
  {
    GetRoadUserChargingReportMessageEfcDataDictionary_DieselEmissionValuesParams(packetHandle, value.dieselEmissionValues, newPath);
    result = CheckLastError("RoadUserChargingReportMessage", gkFuncRefGet, result);
  }
  snprintf(newPath, elcount(newPath), "%s.%s", oldPath, "driverCharacteristics");
  value.driverCharacteristics.isValidFlag = C2xIsTokenAvailable(packetHandle, "RoadUserChargingReportMessage", newPath);
  if(value.driverCharacteristics.isValidFlag==1)
  {
    GetRoadUserChargingReportMessageEfcDataDictionary_DriverCharacteristicsParams(packetHandle, value.driverCharacteristics, newPath);
    result = CheckLastError("RoadUserChargingReportMessage", gkFuncRefGet, result);
  }
  snprintf(newPath, elcount(newPath), "%s.%s", oldPath, "engineDetails");
  value.engineDetails.isValidFlag = C2xIsTokenAvailable(packetHandle, "RoadUserChargingReportMessage", newPath);
  if(value.engineDetails.isValidFlag==1)
  {
    GetRoadUserChargingReportMessageEfcDataDictionary_EngineDetailsParams(packetHandle, value.engineDetails, newPath);
    result = CheckLastError("RoadUserChargingReportMessage", gkFuncRefGet, result);
  }
  snprintf(newPath, elcount(newPath), "%s.%s", oldPath, "exhaustEmissionValues");
  value.exhaustEmissionValues.isValidFlag = C2xIsTokenAvailable(packetHandle, "RoadUserChargingReportMessage", newPath);
  if(value.exhaustEmissionValues.isValidFlag==1)
  {
    GetRoadUserChargingReportMessageEfcDataDictionary_ExhaustEmissionValuesParams(packetHandle, value.exhaustEmissionValues, newPath);
    result = CheckLastError("RoadUserChargingReportMessage", gkFuncRefGet, result);
  }
  snprintf(newPath, elcount(newPath), "%s.%s", oldPath, "passengerCapacity");
  value.passengerCapacity.isValidFlag = C2xIsTokenAvailable(packetHandle, "RoadUserChargingReportMessage", newPath);
  if(value.passengerCapacity.isValidFlag==1)
  {
    GetRoadUserChargingReportMessageEfcDataDictionary_PassengerCapacityParams(packetHandle, value.passengerCapacity, newPath);
    result = CheckLastError("RoadUserChargingReportMessage", gkFuncRefGet, result);
  }
  snprintf(newPath, elcount(newPath), "%s.%s", oldPath, "soundLevel");
  value.soundLevel.isValidFlag = C2xIsTokenAvailable(packetHandle, "RoadUserChargingReportMessage", newPath);
  if(value.soundLevel.isValidFlag==1)
  {
    GetRoadUserChargingReportMessageEfcDataDictionary_SoundLevelParams(packetHandle, value.soundLevel, newPath);
    result = CheckLastError("RoadUserChargingReportMessage", gkFuncRefGet, result);
  }
  return result;
}

int SetRoadUserChargingReportMessageEfcDataDictionary_VehicleDescriptionParams(LONG packetHandle, struct RoadUserChargingReportMessageEfcDataDictionary_VehicleDescription value, char oldPath[])
{
  char newPath[300];
  int result;

  result = 0;

  snprintf(newPath, elcount(newPath), "%s.%s", oldPath, "vehicleLPNr");
  if(value.vehicleLPNr.isValidFlag==1)
  {
    SetRoadUserChargingReportMessageEfcDataDictionary_LpnParams(packetHandle, value.vehicleLPNr, newPath);
    result = CheckLastError("RoadUserChargingReportMessage", gkFuncRefGet, result);
  }
  else
  {
    if( C2xIsTokenAvailable(packetHandle, "RoadUserChargingReportMessage", newPath) )
    {
      C2xRemoveToken(packetHandle, "RoadUserChargingReportMessage", newPath);
    }
  }

  snprintf(newPath, elcount(newPath), "%s.%s", oldPath, "axles");
  if(value.axles.isValidFlag==1)
  {
    SetRoadUserChargingReportMessageEfcDataDictionary_VehicleAxlesParams(packetHandle, value.axles, newPath);
    result = CheckLastError("RoadUserChargingReportMessage", gkFuncRefGet, result);
  }
  else
  {
    if( C2xIsTokenAvailable(packetHandle, "RoadUserChargingReportMessage", newPath) )
    {
      C2xRemoveToken(packetHandle, "RoadUserChargingReportMessage", newPath);
    }
  }

  snprintf(newPath, elcount(newPath), "%s.%s", oldPath, "class");
  if(value.class.isValidFlag==1)
  {
    C2xSetTokenInt(packetHandle, "RoadUserChargingReportMessage", newPath, value.class.value);
    result = CheckLastError("RoadUserChargingReportMessage", gkFuncRefGet, result);
  }
  else
  {
    if( C2xIsTokenAvailable(packetHandle, "RoadUserChargingReportMessage", newPath) )
    {
      C2xRemoveToken(packetHandle, "RoadUserChargingReportMessage", newPath);
    }
  }

  snprintf(newPath, elcount(newPath), "%s.%s", oldPath, "dimensions");
  if(value.dimensions.isValidFlag==1)
  {
    SetRoadUserChargingReportMessageEfcDataDictionary_VehicleDimensionsParams(packetHandle, value.dimensions, newPath);
    result = CheckLastError("RoadUserChargingReportMessage", gkFuncRefGet, result);
  }
  else
  {
    if( C2xIsTokenAvailable(packetHandle, "RoadUserChargingReportMessage", newPath) )
    {
      C2xRemoveToken(packetHandle, "RoadUserChargingReportMessage", newPath);
    }
  }

  snprintf(newPath, elcount(newPath), "%s.%s", oldPath, "specificCharacteristics");
  if(value.specificCharacteristics.isValidFlag==1)
  {
    SetRoadUserChargingReportMessageEfcDataDictionary_VehicleSpecificCharacteristicsParams(packetHandle, value.specificCharacteristics, newPath);
    result = CheckLastError("RoadUserChargingReportMessage", gkFuncRefGet, result);
  }
  else
  {
    if( C2xIsTokenAvailable(packetHandle, "RoadUserChargingReportMessage", newPath) )
    {
      C2xRemoveToken(packetHandle, "RoadUserChargingReportMessage", newPath);
    }
  }

  snprintf(newPath, elcount(newPath), "%s.%s", oldPath, "ladenWeight");
  if(value.ladenWeight.isValidFlag==1)
  {
    C2xSetTokenInt(packetHandle, "RoadUserChargingReportMessage", newPath, value.ladenWeight.value);
    result = CheckLastError("RoadUserChargingReportMessage", gkFuncRefGet, result);
  }
  else
  {
    if( C2xIsTokenAvailable(packetHandle, "RoadUserChargingReportMessage", newPath) )
    {
      C2xRemoveToken(packetHandle, "RoadUserChargingReportMessage", newPath);
    }
  }

  snprintf(newPath, elcount(newPath), "%s.%s", oldPath, "weightLimits");
  if(value.weightLimits.isValidFlag==1)
  {
    SetRoadUserChargingReportMessageEfcDataDictionary_VehicleWeightLimitsParams(packetHandle, value.weightLimits, newPath);
    result = CheckLastError("RoadUserChargingReportMessage", gkFuncRefGet, result);
  }
  else
  {
    if( C2xIsTokenAvailable(packetHandle, "RoadUserChargingReportMessage", newPath) )
    {
      C2xRemoveToken(packetHandle, "RoadUserChargingReportMessage", newPath);
    }
  }

  snprintf(newPath, elcount(newPath), "%s.%s", oldPath, "trailerCharacteristics");
  if(value.trailerCharacteristics.isValidFlag==1)
  {
    SetRoadUserChargingReportMessageEfcDataDictionary_TrailerCharacteristicsParams(packetHandle, value.trailerCharacteristics, newPath);
    result = CheckLastError("RoadUserChargingReportMessage", gkFuncRefGet, result);
  }
  else
  {
    if( C2xIsTokenAvailable(packetHandle, "RoadUserChargingReportMessage", newPath) )
    {
      C2xRemoveToken(packetHandle, "RoadUserChargingReportMessage", newPath);
    }
  }

  snprintf(newPath, elcount(newPath), "%s.%s", oldPath, "vehicleCurrentMaxTrainWeight");
  if(value.vehicleCurrentMaxTrainWeight.isValidFlag==1)
  {
    C2xSetTokenInt(packetHandle, "RoadUserChargingReportMessage", newPath, value.vehicleCurrentMaxTrainWeight.value);
    result = CheckLastError("RoadUserChargingReportMessage", gkFuncRefGet, result);
  }
  else
  {
    if( C2xIsTokenAvailable(packetHandle, "RoadUserChargingReportMessage", newPath) )
    {
      C2xRemoveToken(packetHandle, "RoadUserChargingReportMessage", newPath);
    }
  }

  snprintf(newPath, elcount(newPath), "%s.%s", oldPath, "actualNumberOfPassengers");
  if(value.actualNumberOfPassengers.isValidFlag==1)
  {
    C2xSetTokenInt(packetHandle, "RoadUserChargingReportMessage", newPath, value.actualNumberOfPassengers.value);
    result = CheckLastError("RoadUserChargingReportMessage", gkFuncRefGet, result);
  }
  else
  {
    if( C2xIsTokenAvailable(packetHandle, "RoadUserChargingReportMessage", newPath) )
    {
      C2xRemoveToken(packetHandle, "RoadUserChargingReportMessage", newPath);
    }
  }

  snprintf(newPath, elcount(newPath), "%s.%s", oldPath, "axleWeightLimits");
  if(value.axleWeightLimits.isValidFlag==1)
  {
    SetRoadUserChargingReportMessageEfcDataDictionary_AxleWeightLimitsParams(packetHandle, value.axleWeightLimits, newPath);
    result = CheckLastError("RoadUserChargingReportMessage", gkFuncRefGet, result);
  }
  else
  {
    if( C2xIsTokenAvailable(packetHandle, "RoadUserChargingReportMessage", newPath) )
    {
      C2xRemoveToken(packetHandle, "RoadUserChargingReportMessage", newPath);
    }
  }

  snprintf(newPath, elcount(newPath), "%s.%s", oldPath, "dieselEmissionValues");
  if(value.dieselEmissionValues.isValidFlag==1)
  {
    SetRoadUserChargingReportMessageEfcDataDictionary_DieselEmissionValuesParams(packetHandle, value.dieselEmissionValues, newPath);
    result = CheckLastError("RoadUserChargingReportMessage", gkFuncRefGet, result);
  }
  else
  {
    if( C2xIsTokenAvailable(packetHandle, "RoadUserChargingReportMessage", newPath) )
    {
      C2xRemoveToken(packetHandle, "RoadUserChargingReportMessage", newPath);
    }
  }

  snprintf(newPath, elcount(newPath), "%s.%s", oldPath, "driverCharacteristics");
  if(value.driverCharacteristics.isValidFlag==1)
  {
    SetRoadUserChargingReportMessageEfcDataDictionary_DriverCharacteristicsParams(packetHandle, value.driverCharacteristics, newPath);
    result = CheckLastError("RoadUserChargingReportMessage", gkFuncRefGet, result);
  }
  else
  {
    if( C2xIsTokenAvailable(packetHandle, "RoadUserChargingReportMessage", newPath) )
    {
      C2xRemoveToken(packetHandle, "RoadUserChargingReportMessage", newPath);
    }
  }

  snprintf(newPath, elcount(newPath), "%s.%s", oldPath, "engineDetails");
  if(value.engineDetails.isValidFlag==1)
  {
    SetRoadUserChargingReportMessageEfcDataDictionary_EngineDetailsParams(packetHandle, value.engineDetails, newPath);
    result = CheckLastError("RoadUserChargingReportMessage", gkFuncRefGet, result);
  }
  else
  {
    if( C2xIsTokenAvailable(packetHandle, "RoadUserChargingReportMessage", newPath) )
    {
      C2xRemoveToken(packetHandle, "RoadUserChargingReportMessage", newPath);
    }
  }

  snprintf(newPath, elcount(newPath), "%s.%s", oldPath, "exhaustEmissionValues");
  if(value.exhaustEmissionValues.isValidFlag==1)
  {
    SetRoadUserChargingReportMessageEfcDataDictionary_ExhaustEmissionValuesParams(packetHandle, value.exhaustEmissionValues, newPath);
    result = CheckLastError("RoadUserChargingReportMessage", gkFuncRefGet, result);
  }
  else
  {
    if( C2xIsTokenAvailable(packetHandle, "RoadUserChargingReportMessage", newPath) )
    {
      C2xRemoveToken(packetHandle, "RoadUserChargingReportMessage", newPath);
    }
  }

  snprintf(newPath, elcount(newPath), "%s.%s", oldPath, "passengerCapacity");
  if(value.passengerCapacity.isValidFlag==1)
  {
    SetRoadUserChargingReportMessageEfcDataDictionary_PassengerCapacityParams(packetHandle, value.passengerCapacity, newPath);
    result = CheckLastError("RoadUserChargingReportMessage", gkFuncRefGet, result);
  }
  else
  {
    if( C2xIsTokenAvailable(packetHandle, "RoadUserChargingReportMessage", newPath) )
    {
      C2xRemoveToken(packetHandle, "RoadUserChargingReportMessage", newPath);
    }
  }

  snprintf(newPath, elcount(newPath), "%s.%s", oldPath, "soundLevel");
  if(value.soundLevel.isValidFlag==1)
  {
    SetRoadUserChargingReportMessageEfcDataDictionary_SoundLevelParams(packetHandle, value.soundLevel, newPath);
    result = CheckLastError("RoadUserChargingReportMessage", gkFuncRefGet, result);
  }
  else
  {
    if( C2xIsTokenAvailable(packetHandle, "RoadUserChargingReportMessage", newPath) )
    {
      C2xRemoveToken(packetHandle, "RoadUserChargingReportMessage", newPath);
    }
  }

  return result;
}

int GetRoadUserChargingReportMessageUserDataParams(LONG packetHandle, struct RoadUserChargingReportMessageUserData value, char oldPath[])
{
  char newPath[300];
  int i;
  int result;

  result = 0;

  snprintf(newPath, elcount(newPath), "%s.%s", oldPath, "timeStamp");
  GetRoadUserChargingReportMessageCommon_DDateTimeParams(packetHandle, value.timeStamp, newPath);
  result = CheckLastError("RoadUserChargingReportMessage", gkFuncRefGet, result);

  snprintf(newPath, elcount(newPath), "%s.%s", oldPath, "svcProvID");
  value.svcProvID.length = C2xGetTokenInt(packetHandle, "RoadUserChargingReportMessage", newPath);
  if((result = CheckLastError("RoadUserChargingReportMessage", gkFuncRefGet, result))==0)
  {
    if(value.svcProvID.length > 0)
    {
      for(i=0; i<value.svcProvID.length; i++)
      {
        value.svcProvID.arrayValue[i].id = C2xGetTokenOidElement(packetHandle, "RoadUserChargingReportMessage", newPath, i);
      }
    }
  }
  snprintf(newPath, elcount(newPath), "%s.%s", oldPath, "vehicleID");
  GetRoadUserChargingReportMessageTollUsageMessage_VehicleIdParams(packetHandle, value.vehicleID, newPath);
  result = CheckLastError("RoadUserChargingReportMessage", gkFuncRefGet, result);

  snprintf(newPath, elcount(newPath), "%s.%s", oldPath, "vehicleType");
  value.vehicleType = C2xGetTokenInt(packetHandle, "RoadUserChargingReportMessage", newPath);
  result = CheckLastError("RoadUserChargingReportMessage", gkFuncRefGet, result);

  snprintf(newPath, elcount(newPath), "%s.%s", oldPath, "vehicleDescription");
  value.vehicleDescription.isValidFlag = C2xIsTokenAvailable(packetHandle, "RoadUserChargingReportMessage", newPath);
  if(value.vehicleDescription.isValidFlag==1)
  {
    GetRoadUserChargingReportMessageEfcDataDictionary_VehicleDescriptionParams(packetHandle, value.vehicleDescription, newPath);
    result = CheckLastError("RoadUserChargingReportMessage", gkFuncRefGet, result);
  }
  return result;
}

int SetRoadUserChargingReportMessageUserDataParams(LONG packetHandle, struct RoadUserChargingReportMessageUserData value, char oldPath[])
{
  char newPath[300];
  int i;
  int result;

  result = 0;

  snprintf(newPath, elcount(newPath), "%s.%s", oldPath, "timeStamp");
  SetRoadUserChargingReportMessageCommon_DDateTimeParams(packetHandle, value.timeStamp, newPath);
  result = CheckLastError("RoadUserChargingReportMessage", gkFuncRefGet, result);

  snprintf(newPath, elcount(newPath), "%s.%s", oldPath, "svcProvID");
  C2xRemoveToken(packetHandle, "RoadUserChargingReportMessage", newPath);
  if(value.svcProvID.length > 0)
  {
    for(i=0; i<value.svcProvID.length; i++)
    {
      C2xSetTokenOidElement(packetHandle, "RoadUserChargingReportMessage", newPath, i, value.svcProvID.arrayValue[i].id);
    }
  }
  result = CheckLastError("RoadUserChargingReportMessage", gkFuncRefGet, result);

  snprintf(newPath, elcount(newPath), "%s.%s", oldPath, "vehicleID");
  SetRoadUserChargingReportMessageTollUsageMessage_VehicleIdParams(packetHandle, value.vehicleID, newPath);
  result = CheckLastError("RoadUserChargingReportMessage", gkFuncRefGet, result);

  snprintf(newPath, elcount(newPath), "%s.%s", oldPath, "vehicleType");
  if (value.vehicleType < 1)
  {
    C2xSetTokenInt(packetHandle, "RoadUserChargingReportMessage", newPath, 1);
  }
  else if (value.vehicleType > 13)
  {
    C2xSetTokenInt(packetHandle, "RoadUserChargingReportMessage", newPath, 13);
  }
  else
  {
    C2xSetTokenInt(packetHandle, "RoadUserChargingReportMessage", newPath, value.vehicleType);
  }
  result = CheckLastError("RoadUserChargingReportMessage", gkFuncRefGet, result);

  snprintf(newPath, elcount(newPath), "%s.%s", oldPath, "vehicleDescription");
  if(value.vehicleDescription.isValidFlag==1)
  {
    SetRoadUserChargingReportMessageEfcDataDictionary_VehicleDescriptionParams(packetHandle, value.vehicleDescription, newPath);
    result = CheckLastError("RoadUserChargingReportMessage", gkFuncRefGet, result);
  }
  else
  {
    if( C2xIsTokenAvailable(packetHandle, "RoadUserChargingReportMessage", newPath) )
    {
      C2xRemoveToken(packetHandle, "RoadUserChargingReportMessage", newPath);
    }
  }

  return result;
}

int GetRoadUserChargingReportMessageEfcDataDictionary_PaymentFeeParams(LONG packetHandle, struct RoadUserChargingReportMessageEfcDataDictionary_PaymentFee value, char oldPath[])
{
  char newPath[300];
  int result;

  result = 0;

  snprintf(newPath, elcount(newPath), "%s.%s", oldPath, "paymentFeeAmount");
  value.paymentFeeAmount = C2xGetTokenInt(packetHandle, "RoadUserChargingReportMessage", newPath);
  result = CheckLastError("RoadUserChargingReportMessage", gkFuncRefGet, result);

  snprintf(newPath, elcount(newPath), "%s.%s", oldPath, "paymentFeeUnit");
  value.paymentFeeUnit.stringLength = C2xGetTokenData(packetHandle, "RoadUserChargingReportMessage", newPath, elcount(value.paymentFeeUnit.string), value.paymentFeeUnit.string);
  return result;
}

int SetRoadUserChargingReportMessageEfcDataDictionary_PaymentFeeParams(LONG packetHandle, struct RoadUserChargingReportMessageEfcDataDictionary_PaymentFee value, char oldPath[])
{
  char newPath[300];
  int result;

  result = 0;

  snprintf(newPath, elcount(newPath), "%s.%s", oldPath, "paymentFeeAmount");
  C2xSetTokenInt(packetHandle, "RoadUserChargingReportMessage", newPath, value.paymentFeeAmount);
  result = CheckLastError("RoadUserChargingReportMessage", gkFuncRefGet, result);

  snprintf(newPath, elcount(newPath), "%s.%s", oldPath, "paymentFeeUnit");
  C2xSetTokenData(packetHandle, "RoadUserChargingReportMessage", newPath, value.paymentFeeUnit.stringLength, value.paymentFeeUnit.string);

  return result;
}

int GetRoadUserChargingReportMessageTimePeriodParams(LONG packetHandle, struct RoadUserChargingReportMessageTimePeriod value, char oldPath[])
{
  char newPath[300];
  int result;

  result = 0;

  snprintf(newPath, elcount(newPath), "%s.%s", oldPath, "startTime");
  GetRoadUserChargingReportMessageCommon_DDateTimeParams(packetHandle, value.startTime, newPath);
  result = CheckLastError("RoadUserChargingReportMessage", gkFuncRefGet, result);

  snprintf(newPath, elcount(newPath), "%s.%s", oldPath, "endTime");
  GetRoadUserChargingReportMessageCommon_DDateTimeParams(packetHandle, value.endTime, newPath);
  result = CheckLastError("RoadUserChargingReportMessage", gkFuncRefGet, result);

  return result;
}

int SetRoadUserChargingReportMessageTimePeriodParams(LONG packetHandle, struct RoadUserChargingReportMessageTimePeriod value, char oldPath[])
{
  char newPath[300];
  int result;

  result = 0;

  snprintf(newPath, elcount(newPath), "%s.%s", oldPath, "startTime");
  SetRoadUserChargingReportMessageCommon_DDateTimeParams(packetHandle, value.startTime, newPath);
  result = CheckLastError("RoadUserChargingReportMessage", gkFuncRefGet, result);

  snprintf(newPath, elcount(newPath), "%s.%s", oldPath, "endTime");
  SetRoadUserChargingReportMessageCommon_DDateTimeParams(packetHandle, value.endTime, newPath);
  result = CheckLastError("RoadUserChargingReportMessage", gkFuncRefGet, result);

  return result;
}

int GetRoadUserChargingReportMessageUserFeeInfoParams(LONG packetHandle, struct RoadUserChargingReportMessageUserFeeInfo value, char oldPath[])
{
  char newPath[300];
  int result;

  result = 0;

  snprintf(newPath, elcount(newPath), "%s.%s", oldPath, "fee");
  GetRoadUserChargingReportMessageEfcDataDictionary_PaymentFeeParams(packetHandle, value.fee, newPath);
  result = CheckLastError("RoadUserChargingReportMessage", gkFuncRefGet, result);

  snprintf(newPath, elcount(newPath), "%s.%s", oldPath, "timePeriod");
  GetRoadUserChargingReportMessageTimePeriodParams(packetHandle, value.timePeriod, newPath);
  result = CheckLastError("RoadUserChargingReportMessage", gkFuncRefGet, result);

  return result;
}

int SetRoadUserChargingReportMessageUserFeeInfoParams(LONG packetHandle, struct RoadUserChargingReportMessageUserFeeInfo value, char oldPath[])
{
  char newPath[300];
  int result;

  result = 0;

  snprintf(newPath, elcount(newPath), "%s.%s", oldPath, "fee");
  SetRoadUserChargingReportMessageEfcDataDictionary_PaymentFeeParams(packetHandle, value.fee, newPath);
  result = CheckLastError("RoadUserChargingReportMessage", gkFuncRefGet, result);

  snprintf(newPath, elcount(newPath), "%s.%s", oldPath, "timePeriod");
  SetRoadUserChargingReportMessageTimePeriodParams(packetHandle, value.timePeriod, newPath);
  result = CheckLastError("RoadUserChargingReportMessage", gkFuncRefGet, result);

  return result;
}

int GetRoadUserChargingReportMessageFeeReportParams(LONG packetHandle, struct RoadUserChargingReportMessageFeeReport value, char oldPath[])
{
  char newPath[300];
  int result;

  result = 0;

  snprintf(newPath, elcount(newPath), "%s.%s", oldPath, "userData");
  GetRoadUserChargingReportMessageUserDataParams(packetHandle, value.userData, newPath);
  result = CheckLastError("RoadUserChargingReportMessage", gkFuncRefGet, result);

  snprintf(newPath, elcount(newPath), "%s.%s", oldPath, "fees");
  GetRoadUserChargingReportMessageUserFeeInfoParams(packetHandle, value.fees, newPath);
  result = CheckLastError("RoadUserChargingReportMessage", gkFuncRefGet, result);

  return result;
}

int SetRoadUserChargingReportMessageFeeReportParams(LONG packetHandle, struct RoadUserChargingReportMessageFeeReport value, char oldPath[])
{
  char newPath[300];
  int result;

  result = 0;

  snprintf(newPath, elcount(newPath), "%s.%s", oldPath, "userData");
  SetRoadUserChargingReportMessageUserDataParams(packetHandle, value.userData, newPath);
  result = CheckLastError("RoadUserChargingReportMessage", gkFuncRefGet, result);

  snprintf(newPath, elcount(newPath), "%s.%s", oldPath, "fees");
  SetRoadUserChargingReportMessageUserFeeInfoParams(packetHandle, value.fees, newPath);
  result = CheckLastError("RoadUserChargingReportMessage", gkFuncRefGet, result);

  return result;
}

int GetRoadUserChargingReportMessageTripInfoParams(LONG packetHandle, struct RoadUserChargingReportMessageTripInfo value, char oldPath[])
{
  char newPath[300];
  int result;

  result = 0;

  snprintf(newPath, elcount(newPath), "%s.%s", oldPath, "distanceTraveled");
  value.distanceTraveled.isValidFlag = C2xIsTokenAvailable(packetHandle, "RoadUserChargingReportMessage", newPath);
  if(value.distanceTraveled.isValidFlag==1)
  {
    value.distanceTraveled.value = C2xGetTokenInt(packetHandle, "RoadUserChargingReportMessage", newPath);
    result = CheckLastError("RoadUserChargingReportMessage", gkFuncRefGet, result);
  }
  snprintf(newPath, elcount(newPath), "%s.%s", oldPath, "distanceUnits");
  value.distanceUnits.isValidFlag = C2xIsTokenAvailable(packetHandle, "RoadUserChargingReportMessage", newPath);
  if(value.distanceUnits.isValidFlag==1)
  {
    value.distanceUnits.value = C2xGetTokenInt(packetHandle, "RoadUserChargingReportMessage", newPath);
    result = CheckLastError("RoadUserChargingReportMessage", gkFuncRefGet, result);
  }
  snprintf(newPath, elcount(newPath), "%s.%s", oldPath, "timeTraveled");
  value.timeTraveled.isValidFlag = C2xIsTokenAvailable(packetHandle, "RoadUserChargingReportMessage", newPath);
  if(value.timeTraveled.isValidFlag==1)
  {
    value.timeTraveled.value = C2xGetTokenInt(packetHandle, "RoadUserChargingReportMessage", newPath);
    result = CheckLastError("RoadUserChargingReportMessage", gkFuncRefGet, result);
  }
  return result;
}

int SetRoadUserChargingReportMessageTripInfoParams(LONG packetHandle, struct RoadUserChargingReportMessageTripInfo value, char oldPath[])
{
  char newPath[300];
  int result;

  result = 0;

  snprintf(newPath, elcount(newPath), "%s.%s", oldPath, "distanceTraveled");
  if(value.distanceTraveled.isValidFlag==1)
  {
    if (value.distanceTraveled.value < 1)
    {
        C2xSetTokenInt(packetHandle, "RoadUserChargingReportMessage", newPath, 1);
    }
    else if (value.distanceTraveled.value > 65535)
    {
        C2xSetTokenInt(packetHandle, "RoadUserChargingReportMessage", newPath, 65535);
    }
    else
    {
        C2xSetTokenInt(packetHandle, "RoadUserChargingReportMessage", newPath, value.distanceTraveled.value);
    }
    result = CheckLastError("RoadUserChargingReportMessage", gkFuncRefGet, result);
  }
  else
  {
    if( C2xIsTokenAvailable(packetHandle, "RoadUserChargingReportMessage", newPath) )
    {
      C2xRemoveToken(packetHandle, "RoadUserChargingReportMessage", newPath);
    }
  }

  snprintf(newPath, elcount(newPath), "%s.%s", oldPath, "distanceUnits");
  if(value.distanceUnits.isValidFlag==1)
  {
    C2xSetTokenInt(packetHandle, "RoadUserChargingReportMessage", newPath, value.distanceUnits.value);
    result = CheckLastError("RoadUserChargingReportMessage", gkFuncRefGet, result);
  }
  else
  {
    if( C2xIsTokenAvailable(packetHandle, "RoadUserChargingReportMessage", newPath) )
    {
      C2xRemoveToken(packetHandle, "RoadUserChargingReportMessage", newPath);
    }
  }

  snprintf(newPath, elcount(newPath), "%s.%s", oldPath, "timeTraveled");
  if(value.timeTraveled.isValidFlag==1)
  {
    if (value.timeTraveled.value < 1)
    {
        C2xSetTokenInt(packetHandle, "RoadUserChargingReportMessage", newPath, 1);
    }
    else if (value.timeTraveled.value > 600000)
    {
        C2xSetTokenInt(packetHandle, "RoadUserChargingReportMessage", newPath, 600000);
    }
    else
    {
        C2xSetTokenInt(packetHandle, "RoadUserChargingReportMessage", newPath, value.timeTraveled.value);
    }
    result = CheckLastError("RoadUserChargingReportMessage", gkFuncRefGet, result);
  }
  else
  {
    if( C2xIsTokenAvailable(packetHandle, "RoadUserChargingReportMessage", newPath) )
    {
      C2xRemoveToken(packetHandle, "RoadUserChargingReportMessage", newPath);
    }
  }

  return result;
}

int GetRoadUserChargingReportMessageItemizedChargerDataParams(LONG packetHandle, struct RoadUserChargingReportMessageItemizedChargerData value, char oldPath[])
{
  char newPath[300];
  int i;
  int result;

  result = 0;

  snprintf(newPath, elcount(newPath), "%s.%s", oldPath, "chargerID");
  value.chargerID.length = C2xGetTokenInt(packetHandle, "RoadUserChargingReportMessage", newPath);
  if((result = CheckLastError("RoadUserChargingReportMessage", gkFuncRefGet, result))==0)
  {
    if(value.chargerID.length > 0)
    {
      for(i=0; i<value.chargerID.length; i++)
      {
        value.chargerID.arrayValue[i].id = C2xGetTokenOidElement(packetHandle, "RoadUserChargingReportMessage", newPath, i);
      }
    }
  }
  snprintf(newPath, elcount(newPath), "%s.%s", oldPath, "chargingDescription");
  value.chargingDescription.isValidFlag = C2xIsTokenAvailable(packetHandle, "RoadUserChargingReportMessage", newPath);
  if(value.chargingDescription.isValidFlag==1)
  {
    value.chargingDescription.stringLength = C2xGetTokenData(packetHandle, "RoadUserChargingReportMessage", newPath, elcount(value.chargingDescription.string), value.chargingDescription.string);
    result = CheckLastError("RoadUserChargingReportMessage", gkFuncRefGet, result);
  }
  snprintf(newPath, elcount(newPath), "%s.%s", oldPath, "configID");
  value.configID.isValidFlag = C2xIsTokenAvailable(packetHandle, "RoadUserChargingReportMessage", newPath);
  if(value.configID.isValidFlag==1)
  {
    value.configID.value = C2xGetTokenInt(packetHandle, "RoadUserChargingReportMessage", newPath);
    result = CheckLastError("RoadUserChargingReportMessage", gkFuncRefGet, result);
  }
  snprintf(newPath, elcount(newPath), "%s.%s", oldPath, "tripInfo");
  value.tripInfo.isValidFlag = C2xIsTokenAvailable(packetHandle, "RoadUserChargingReportMessage", newPath);
  if(value.tripInfo.isValidFlag==1)
  {
    GetRoadUserChargingReportMessageTripInfoParams(packetHandle, value.tripInfo, newPath);
    result = CheckLastError("RoadUserChargingReportMessage", gkFuncRefGet, result);
  }
  snprintf(newPath, elcount(newPath), "%s.%s", oldPath, "totalPaidToCharger");
  GetRoadUserChargingReportMessageEfcDataDictionary_PaymentFeeParams(packetHandle, value.totalPaidToCharger, newPath);
  result = CheckLastError("RoadUserChargingReportMessage", gkFuncRefGet, result);

  return result;
}

int SetRoadUserChargingReportMessageItemizedChargerDataParams(LONG packetHandle, struct RoadUserChargingReportMessageItemizedChargerData value, char oldPath[])
{
  char newPath[300];
  int i;
  int result;

  result = 0;

  snprintf(newPath, elcount(newPath), "%s.%s", oldPath, "chargerID");
  C2xRemoveToken(packetHandle, "RoadUserChargingReportMessage", newPath);
  if(value.chargerID.length > 0)
  {
    for(i=0; i<value.chargerID.length; i++)
    {
      C2xSetTokenOidElement(packetHandle, "RoadUserChargingReportMessage", newPath, i, value.chargerID.arrayValue[i].id);
    }
  }
  result = CheckLastError("RoadUserChargingReportMessage", gkFuncRefGet, result);

  snprintf(newPath, elcount(newPath), "%s.%s", oldPath, "chargingDescription");
  if(value.chargingDescription.isValidFlag==1)
  {
    C2xSetTokenData(packetHandle, "RoadUserChargingReportMessage", newPath, value.chargingDescription.stringLength, value.chargingDescription.string);
    result = CheckLastError("RoadUserChargingReportMessage", gkFuncRefGet, result);
  }
  else
  {
    if( C2xIsTokenAvailable(packetHandle, "RoadUserChargingReportMessage", newPath) )
    {
      C2xRemoveToken(packetHandle, "RoadUserChargingReportMessage", newPath);
    }
  }

  snprintf(newPath, elcount(newPath), "%s.%s", oldPath, "configID");
  if(value.configID.isValidFlag==1)
  {
    C2xSetTokenInt(packetHandle, "RoadUserChargingReportMessage", newPath, value.configID.value);
    result = CheckLastError("RoadUserChargingReportMessage", gkFuncRefGet, result);
  }
  else
  {
    if( C2xIsTokenAvailable(packetHandle, "RoadUserChargingReportMessage", newPath) )
    {
      C2xRemoveToken(packetHandle, "RoadUserChargingReportMessage", newPath);
    }
  }

  snprintf(newPath, elcount(newPath), "%s.%s", oldPath, "tripInfo");
  if(value.tripInfo.isValidFlag==1)
  {
    SetRoadUserChargingReportMessageTripInfoParams(packetHandle, value.tripInfo, newPath);
    result = CheckLastError("RoadUserChargingReportMessage", gkFuncRefGet, result);
  }
  else
  {
    if( C2xIsTokenAvailable(packetHandle, "RoadUserChargingReportMessage", newPath) )
    {
      C2xRemoveToken(packetHandle, "RoadUserChargingReportMessage", newPath);
    }
  }

  snprintf(newPath, elcount(newPath), "%s.%s", oldPath, "totalPaidToCharger");
  SetRoadUserChargingReportMessageEfcDataDictionary_PaymentFeeParams(packetHandle, value.totalPaidToCharger, newPath);
  result = CheckLastError("RoadUserChargingReportMessage", gkFuncRefGet, result);

  return result;
}

int GetRoadUserChargingReportMessageItemizedPaymentReport_chargerDataParams(LONG packetHandle, struct RoadUserChargingReportMessageItemizedPaymentReport_chargerData value, char oldPath[])
{
  char newPath[300]; 
  int i;
  int result;

  result = 0;

  value.length = C2xGetTokenInt(packetHandle, "RoadUserChargingReportMessage", oldPath);
  if((result = CheckLastError("RoadUserChargingReportMessage", gkFuncRefGet, result))==0)
  {
    for(i=0; i<value.length; i++)
    {
      snprintf(newPath, elcount(newPath), "%s[%d]", oldPath, i);
      GetRoadUserChargingReportMessageItemizedChargerDataParams(packetHandle, value.arrayValue[i], newPath);
      result = CheckLastError("RoadUserChargingReportMessage", gkFuncRefGet, result);
    }
  }
  return result;
}

int SetRoadUserChargingReportMessageItemizedPaymentReport_chargerDataParams(LONG packetHandle, struct RoadUserChargingReportMessageItemizedPaymentReport_chargerData value, char oldPath[])
{
  char newPath[300]; 
  int i;
  int result;

  result = 0;

  C2xRemoveToken(packetHandle, "RoadUserChargingReportMessage", oldPath);
  for(i=0; i<value.length; i++)
  {
    snprintf(newPath, elcount(newPath), "%s[%d]", oldPath, i);
    SetRoadUserChargingReportMessageItemizedChargerDataParams(packetHandle, value.arrayValue[i], newPath);
    result = CheckLastError("RoadUserChargingReportMessage", gkFuncRefGet, result);
  }
  return result;
}

int GetRoadUserChargingReportMessageItemizedPaymentReportParams(LONG packetHandle, struct RoadUserChargingReportMessageItemizedPaymentReport value, char oldPath[])
{
  char newPath[300];
  int i;
  int result;

  result = 0;

  snprintf(newPath, elcount(newPath), "%s.%s", oldPath, "timeStamp");
  GetRoadUserChargingReportMessageCommon_DDateTimeParams(packetHandle, value.timeStamp, newPath);
  result = CheckLastError("RoadUserChargingReportMessage", gkFuncRefGet, result);

  snprintf(newPath, elcount(newPath), "%s.%s", oldPath, "timePeriod");
  GetRoadUserChargingReportMessageTimePeriodParams(packetHandle, value.timePeriod, newPath);
  result = CheckLastError("RoadUserChargingReportMessage", gkFuncRefGet, result);

  snprintf(newPath, elcount(newPath), "%s.%s", oldPath, "svcProvID");
  value.svcProvID.length = C2xGetTokenInt(packetHandle, "RoadUserChargingReportMessage", newPath);
  if((result = CheckLastError("RoadUserChargingReportMessage", gkFuncRefGet, result))==0)
  {
    if(value.svcProvID.length > 0)
    {
      for(i=0; i<value.svcProvID.length; i++)
      {
        value.svcProvID.arrayValue[i].id = C2xGetTokenOidElement(packetHandle, "RoadUserChargingReportMessage", newPath, i);
      }
    }
  }
  snprintf(newPath, elcount(newPath), "%s.%s", oldPath, "chargerData");
  GetRoadUserChargingReportMessageItemizedPaymentReport_chargerDataParams(packetHandle, value.chargerData, newPath);
  result = CheckLastError("RoadUserChargingReportMessage", gkFuncRefGet, result);

  return result;
}

int SetRoadUserChargingReportMessageItemizedPaymentReportParams(LONG packetHandle, struct RoadUserChargingReportMessageItemizedPaymentReport value, char oldPath[])
{
  char newPath[300];
  int i;
  int result;

  result = 0;

  snprintf(newPath, elcount(newPath), "%s.%s", oldPath, "timeStamp");
  SetRoadUserChargingReportMessageCommon_DDateTimeParams(packetHandle, value.timeStamp, newPath);
  result = CheckLastError("RoadUserChargingReportMessage", gkFuncRefGet, result);

  snprintf(newPath, elcount(newPath), "%s.%s", oldPath, "timePeriod");
  SetRoadUserChargingReportMessageTimePeriodParams(packetHandle, value.timePeriod, newPath);
  result = CheckLastError("RoadUserChargingReportMessage", gkFuncRefGet, result);

  snprintf(newPath, elcount(newPath), "%s.%s", oldPath, "svcProvID");
  C2xRemoveToken(packetHandle, "RoadUserChargingReportMessage", newPath);
  if(value.svcProvID.length > 0)
  {
    for(i=0; i<value.svcProvID.length; i++)
    {
      C2xSetTokenOidElement(packetHandle, "RoadUserChargingReportMessage", newPath, i, value.svcProvID.arrayValue[i].id);
    }
  }
  result = CheckLastError("RoadUserChargingReportMessage", gkFuncRefGet, result);

  snprintf(newPath, elcount(newPath), "%s.%s", oldPath, "chargerData");
  SetRoadUserChargingReportMessageItemizedPaymentReport_chargerDataParams(packetHandle, value.chargerData, newPath);
  result = CheckLastError("RoadUserChargingReportMessage", gkFuncRefGet, result);

  return result;
}

int GetRoadUserChargingReportMessageUsageReportParams(LONG packetHandle, struct RoadUserChargingReportMessageUsageReport value, char oldPath[])
{
  char newPath[300];
  int result;

  result = 0;

  value.choice = C2xGetTokenInt(packetHandle, "RoadUserChargingReportMessage", oldPath);

  switch(value.choice)
  {
    case 0:
    {
      snprintf(newPath, elcount(newPath), "%s.%s", oldPath, "feeReport");
      GetRoadUserChargingReportMessageFeeReportParams(packetHandle, value.feeReport, newPath);
      result = CheckLastError("RoadUserChargingReportMessage", gkFuncRefGet, result);
    }
    break;
    case 1:
    {
      snprintf(newPath, elcount(newPath), "%s.%s", oldPath, "itemizedPaymentReport");
      GetRoadUserChargingReportMessageItemizedPaymentReportParams(packetHandle, value.itemizedPaymentReport, newPath);
      result = CheckLastError("RoadUserChargingReportMessage", gkFuncRefGet, result);
    }
    break;
  }
  return result;
}

int SetRoadUserChargingReportMessageUsageReportParams(LONG packetHandle, struct RoadUserChargingReportMessageUsageReport value, char oldPath[])
{
  char newPath[300];
  int result;

  result = 0;

  switch(value.choice)
  {
    case 0:
    {
      snprintf(newPath, elcount(newPath), "%s.%s", oldPath, "feeReport");
      SetRoadUserChargingReportMessageFeeReportParams(packetHandle, value.feeReport, newPath);
      result = CheckLastError("RoadUserChargingReportMessage", gkFuncRefGet, result);
    }
    break;
    case 1:
    {
      snprintf(newPath, elcount(newPath), "%s.%s", oldPath, "itemizedPaymentReport");
      SetRoadUserChargingReportMessageItemizedPaymentReportParams(packetHandle, value.itemizedPaymentReport, newPath);
      result = CheckLastError("RoadUserChargingReportMessage", gkFuncRefGet, result);
    }
    break;
  }
  return result;
}

int GetRoadUserChargingReportMessage_RoadUserChargingReportMessageParams(LONG packetHandle, struct RoadUserChargingReportMessage_RoadUserChargingReportMessage value, char oldPath[])
{
  char newPath[300];
  int result;

  result = 0;

  snprintf(newPath, elcount(newPath), "%s.%s", oldPath, "usageReport");
  GetRoadUserChargingReportMessageUsageReportParams(packetHandle, value.usageReport, newPath);
  result = CheckLastError("RoadUserChargingReportMessage", gkFuncRefGet, result);

  snprintf(newPath, elcount(newPath), "%s.%s", oldPath, "serviceProviderData");
  value.serviceProviderData.isValidFlag = C2xIsTokenAvailable(packetHandle, "RoadUserChargingReportMessage", newPath);
  if(value.serviceProviderData.isValidFlag==1)
  {
    value.serviceProviderData.isValidFlag = 1;
    value.serviceProviderData.stringLength = C2xGetTokenData(packetHandle, "RoadUserChargingReportMessage", newPath, elcount(value.serviceProviderData.string), value.serviceProviderData.string);
  }
  return result;
}

int SetRoadUserChargingReportMessage_RoadUserChargingReportMessageParams(LONG packetHandle, struct RoadUserChargingReportMessage_RoadUserChargingReportMessage value, char oldPath[])
{
  char newPath[300];
  int result;

  result = 0;

  snprintf(newPath, elcount(newPath), "%s.%s", oldPath, "usageReport");
  SetRoadUserChargingReportMessageUsageReportParams(packetHandle, value.usageReport, newPath);
  result = CheckLastError("RoadUserChargingReportMessage", gkFuncRefGet, result);

  snprintf(newPath, elcount(newPath), "%s.%s", oldPath, "serviceProviderData");
  if(value.serviceProviderData.isValidFlag==1)
  {
    C2xSetTokenData(packetHandle, "RoadUserChargingReportMessage", newPath, value.serviceProviderData.stringLength, value.serviceProviderData.string);
  }
  else
  {
    if( C2xIsTokenAvailable(packetHandle, "RoadUserChargingReportMessage", newPath) )
    {
      C2xRemoveToken(packetHandle, "RoadUserChargingReportMessage", newPath);
    }
  }

  return result;
}

int GetRoadUserChargingReportMessageMESSAGE_ID_AND_TYPEParams(LONG packetHandle, WORD tableKey, struct RoadUserChargingReportMessageMESSAGE_ID_AND_TYPE value, char oldPath[])
{
  char newPath[300];
  int result;

  result = 0;

  switch(tableKey)
  {
    case 49:
    {
      snprintf(newPath, elcount(newPath), "%s.%s", oldPath, "roadUserChargingReportMessage");
      GetRoadUserChargingReportMessage_RoadUserChargingReportMessageParams(packetHandle, value.roadUserChargingReportMessage, newPath);
      result = CheckLastError("RoadUserChargingReportMessage", gkFuncRefGet, result);
    }
    break;
  }
  return result;
}

int SetRoadUserChargingReportMessageMESSAGE_ID_AND_TYPEParams(LONG packetHandle, WORD tableKey, struct RoadUserChargingReportMessageMESSAGE_ID_AND_TYPE value, char oldPath[])
{
  char newPath[300];
  int result;

  result = 0;

  switch(tableKey)
  {
    case 49:
    {
      snprintf(newPath, elcount(newPath), "%s.%s", oldPath, "roadUserChargingReportMessage");
      SetRoadUserChargingReportMessage_RoadUserChargingReportMessageParams(packetHandle, value.roadUserChargingReportMessage, newPath);
      result = CheckLastError("RoadUserChargingReportMessage", gkFuncRefGet, result);
    }
    break;
  }
  return result;
}

int API_GetRoadUserChargingReportMessageParams(LONG packetHandle, struct RoadUserChargingReportMessage value)
{
  int result;
  result = 0;

  value.messageId = C2xGetTokenInt(packetHandle, "RoadUserChargingReportMessage", "messageId");
  result = CheckLastError("RoadUserChargingReportMessage", gkFuncRefGet, result);

  GetRoadUserChargingReportMessageMESSAGE_ID_AND_TYPEParams(packetHandle, value.messageId, value.value, "value");
  result = CheckLastError("RoadUserChargingReportMessage", gkFuncRefGet, result);

  return result;
}

int API_SetRoadUserChargingReportMessageParams(LONG packetHandle, struct RoadUserChargingReportMessage value)
{
  int result;
  result = 0;

  value.messageId = 49;

  SetRoadUserChargingReportMessageMESSAGE_ID_AND_TYPEParams(packetHandle, value.messageId, value.value, "value");
  result = CheckLastError("RoadUserChargingReportMessage", gkFuncRefGet, result);

  return result;
}

