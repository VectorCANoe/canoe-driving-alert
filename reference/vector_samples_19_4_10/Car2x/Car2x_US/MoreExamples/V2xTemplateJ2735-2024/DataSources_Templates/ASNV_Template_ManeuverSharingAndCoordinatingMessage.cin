/*@!Encoding:1252*/
/*
//  (c) Vector Informatik GmbH. All rights reserved.
//
//  This file contains definitions of structs and methods that may be used
//  to set and get the values of an ASN.1 defined packet's payload.
//
//  //This example demonstrates how to set a packet's payload:
//  LONG packetHandle;
//  struct ManeuverSharingAndCoordinatingMessage payload;
//  //you need to set the values of the variable "payload" yourself
//  packetHandle = API_InitManeuverSharingAndCoordinatingMessagePacket();
//  if (packetHandle!=0) {
//    if (API_SetManeuverSharingAndCoordinatingMessageParams(packetHandle, payload)==0) {
//      if (C2xCompletePacket(packetHandle)==0) {
//        C2xOutputPacket(packetHandle);
//      }
//    }
//  }
//                                                                             */
includes
{
  #include "ASNV_Template_BaseDatatypes.cin"  // If warning "Duplicate #include, ignoring this include" appears, please remove the ASNV_Template_BaseDatatypes.cin include from your other *.cin files in the project.
}
variables
{
    struct ManeuverSharingAndCoordinatingMessageCommon_DDateTime {
        INT isValidFlag;   // necessary if this struct is used as an optional field of a SEQUENCE
        struct OPT_WORD_ASN year;  // INTEGER, OPTIONAL, 0..4095;
        struct OPT_BYTE_ASN month;  // INTEGER, OPTIONAL, 0..12;
        struct OPT_BYTE_ASN day;  // INTEGER, OPTIONAL, 0..31;
        struct OPT_BYTE_ASN hour;  // INTEGER, OPTIONAL, 0..31;
        struct OPT_BYTE_ASN minute;  // INTEGER, OPTIONAL, 0..60;
        struct OPT_WORD_ASN second;  // INTEGER, OPTIONAL, 0..65535;
        struct OPT_INT_ASN offset;  // INTEGER, OPTIONAL, -840..840;
    };
    
    struct ManeuverSharingAndCoordinatingMessageAddGrpB_LatitudeDMS2 {
        INT isValidFlag;   // necessary if this struct is used as an optional field of a SEQUENCE
        INT d;  // INTEGER, -90..90;
        BYTE m;  // INTEGER, 0..59;
        WORD s;  // INTEGER, 0..5999;
    };
    
    struct ManeuverSharingAndCoordinatingMessageAddGrpB_LongitudeDMS2 {
        INT isValidFlag;   // necessary if this struct is used as an optional field of a SEQUENCE
        INT d;  // INTEGER, -180..180;
        BYTE m;  // INTEGER, 0..59;
        WORD s;  // INTEGER, 0..5999;
    };
    
    struct ManeuverSharingAndCoordinatingMessageAddGrpB_Position3D_addGrpB {
        INT isValidFlag;   // necessary if this struct is used as an optional field of a SEQUENCE
        struct ManeuverSharingAndCoordinatingMessageAddGrpB_LatitudeDMS2 latitude;  // SEQUENCE;
        struct ManeuverSharingAndCoordinatingMessageAddGrpB_LongitudeDMS2 longitude;  // SEQUENCE;
        INT elevation;  // INTEGER, -32768..32767;
    };
    
    struct ManeuverSharingAndCoordinatingMessageAddGrpC_Altitude {
        INT isValidFlag;   // necessary if this struct is used as an optional field of a SEQUENCE
        LONG value;  // INTEGER, -100000..800001;
        INT confidence;  // ENUMERATED, alt_000_01(-0), alt_000_02(1), alt_000_05(2), alt_000_10(3), alt_000_20(4), alt_000_50(5), alt_001_00(6), alt_002_00(7), alt_005_00(8), alt_010_00(9), alt_020_00(10), alt_050_00(11), alt_100_00(12), alt_200_00(13), outOfRange(14), unavailable(15);
    };
    
    struct ManeuverSharingAndCoordinatingMessageAddGrpC_Position3D_addGrpC {
        INT isValidFlag;   // necessary if this struct is used as an optional field of a SEQUENCE
        struct ManeuverSharingAndCoordinatingMessageAddGrpC_Altitude altitude;  // SEQUENCE;
    };
    
    struct ManeuverSharingAndCoordinatingMessageCommon_RegionalExtension_Reg_Position3D_table {
        struct ManeuverSharingAndCoordinatingMessageAddGrpB_Position3D_addGrpB addGrpB;  // SEQUENCE;
        struct ManeuverSharingAndCoordinatingMessageAddGrpC_Position3D_addGrpC addGrpC;  // SEQUENCE;
    };
    
    struct ManeuverSharingAndCoordinatingMessageCommon_RegionalExtension_Reg_Position3D {
        INT isValidFlag;   // necessary if this struct is used as an optional field of a SEQUENCE
        BYTE regionId;  // INTEGER, 0..255, noRegion(0), addGrpA(1), addGrpB(2), addGrpC(3), addGrpD(4);
        struct ManeuverSharingAndCoordinatingMessageCommon_RegionalExtension_Reg_Position3D_table regExtvalue;  // TABLE;
    };
    
    struct ManeuverSharingAndCoordinatingMessageCommon_Position3D_regional {
        INT isValidFlag;   // necessary if this struct is used as an optional field of a SEQUENCE
        INT length;
        struct ManeuverSharingAndCoordinatingMessageCommon_RegionalExtension_Reg_Position3D arrayValue[4];  // SEQUENCE;
    };
    
    struct ManeuverSharingAndCoordinatingMessageCommon_Position3D {
        INT isValidFlag;   // necessary if this struct is used as an optional field of a SEQUENCE
        LONG lat;  // INTEGER, -900000000..900000001;
        LONG lon;  // INTEGER, -1799999999..1800000001;
        struct OPT_LONG_ASN elevation;  // INTEGER, OPTIONAL, -4096..61439;
        struct ManeuverSharingAndCoordinatingMessageCommon_Position3D_regional regional;  // SEQUENCEOF, OPTIONAL;
    };
    
    struct ManeuverSharingAndCoordinatingMessageCommon_PositionalAccuracy {
        INT isValidFlag;   // necessary if this struct is used as an optional field of a SEQUENCE
        BYTE semiMajor;  // INTEGER, 0..255;
        BYTE semiMinor;  // INTEGER, 0..255;
        WORD orientation;  // INTEGER, 0..65535;
    };
    
    struct ManeuverSharingAndCoordinatingMessageCommon_TemporaryID {
        INT isValidFlag;   // necessary if this struct is used as an optional field of a SEQUENCE
        CHAR string[5];
        INT  stringLength;
    };
    
    struct ManeuverSharingAndCoordinatingMessageTemporaryIDList {
        INT isValidFlag;   // necessary if this struct is used as an optional field of a SEQUENCE
        INT length;
        struct ManeuverSharingAndCoordinatingMessageCommon_TemporaryID arrayValue[32];  // OCTETSTRING;
    };
    
    struct ManeuverSharingAndCoordinatingMessageTemporaryIDPointer {
        INT isValidFlag;   // necessary if this struct is used as an optional field of a SEQUENCE
        CHAR string[33];
        INT  stringLength;
    };
    
    struct ManeuverSharingAndCoordinatingMessagePositionOffsetXYZ {
        INT isValidFlag;   // necessary if this struct is used as an optional field of a SEQUENCE
        INT offsetX;  // INTEGER, -32767..32767;
        INT offsetY;  // INTEGER, -32767..32767;
        struct OPT_INT_ASN offsetZ;  // INTEGER, OPTIONAL, -32767..32767;
    };
    
    struct ManeuverSharingAndCoordinatingMessageCommon_PositionConfidenceSet {
        INT isValidFlag;   // necessary if this struct is used as an optional field of a SEQUENCE
        INT pos;  // ENUMERATED, unavailable(0), a500m(1), a200m(2), a100m(3), a50m(4), a20m(5), a10m(6), a5m(7), a2m(8), a1m(9), a50cm(10), a20cm(11), a10cm(12), a5cm(13), a2cm(14), a1cm(15);
        INT elevation;  // ENUMERATED, unavailable(0), elev_500_00(1), elev_200_00(2), elev_100_00(3), elev_050_00(4), elev_020_00(5), elev_010_00(6), elev_005_00(7), elev_002_00(8), elev_001_00(9), elev_000_50(10), elev_000_20(11), elev_000_10(12), elev_000_05(13), elev_000_02(14), elev_000_01(15);
    };
    
    struct ManeuverSharingAndCoordinatingMessageCommon_AccelerationSet4Way {
        INT isValidFlag;   // necessary if this struct is used as an optional field of a SEQUENCE
        INT lon;  // INTEGER, -2000..2001;
        INT lat;  // INTEGER, -2000..2001;
        INT vert;  // INTEGER, -127..127;
        INT yaw;  // INTEGER, -32767..32767;
    };
    
    struct ManeuverSharingAndCoordinatingMessageCommon_VehicleSize {
        INT isValidFlag;   // necessary if this struct is used as an optional field of a SEQUENCE
        WORD width;  // INTEGER, 0..1023;
        WORD length;  // INTEGER, 0..4095;
    };
    
    struct ManeuverSharingAndCoordinatingMessageCurrentStateData {
        INT isValidFlag;   // necessary if this struct is used as an optional field of a SEQUENCE
        struct ManeuverSharingAndCoordinatingMessagePositionOffsetXYZ executantVehPos;  // SEQUENCE, OPTIONAL;
        struct ManeuverSharingAndCoordinatingMessageCommon_PositionConfidenceSet executantVehPosConfidence;  // SEQUENCE, OPTIONAL;
        WORD speed;  // INTEGER, 0..8191;
        WORD heading;  // INTEGER, 0..28800;
        struct ManeuverSharingAndCoordinatingMessageCommon_AccelerationSet4Way accel4way;  // SEQUENCE, OPTIONAL;
        struct ManeuverSharingAndCoordinatingMessageCommon_VehicleSize size;  // SEQUENCE;
    };
    
    struct ManeuverSharingAndCoordinatingMessageTRRLocationType1 {
        INT isValidFlag;   // necessary if this struct is used as an optional field of a SEQUENCE
        WORD tRRLength;  // INTEGER, 0..4095;
        struct ManeuverSharingAndCoordinatingMessagePositionOffsetXYZ frontSidePosition;  // SEQUENCE;
        INT laneOffset;  // ENUMERATED, currentLane(0), firstLeftLane(1), firstRightLane(2), secondLeftLane(3), secondRightLane(4), thirdLeftLane(5), thirdRightLane(6);
        struct OPT_WORD_ASN tRRMovement;  // INTEGER, OPTIONAL, 0..8191;
    };
    
    struct ManeuverSharingAndCoordinatingMessageSurroundingVehicleInfo {
        INT isValidFlag;   // necessary if this struct is used as an optional field of a SEQUENCE
        struct ManeuverSharingAndCoordinatingMessageCommon_TemporaryID surroundingVehicleID;  // OCTETSTRING;
        struct ManeuverSharingAndCoordinatingMessagePositionOffsetXYZ surroundingVehiclePosition;  // SEQUENCE;
        struct ManeuverSharingAndCoordinatingMessageCommon_VehicleSize surroundingVehicleSize;  // SEQUENCE;
    };
    
    struct ManeuverSharingAndCoordinatingMessageTRRLocationType2 {
        INT isValidFlag;   // necessary if this struct is used as an optional field of a SEQUENCE
        WORD safetyGap;  // INTEGER, 0..4095;
        struct ManeuverSharingAndCoordinatingMessageSurroundingVehicleInfo frontSideVehicle;  // SEQUENCE, OPTIONAL;
        struct ManeuverSharingAndCoordinatingMessageSurroundingVehicleInfo rearSideVehicle;  // SEQUENCE, OPTIONAL;
        struct OPT_WORD_ASN tRRLength;  // INTEGER, OPTIONAL, 0..4095;
        INT laneOffset;  // ENUMERATED, currentLane(0), firstLeftLane(1), firstRightLane(2), secondLeftLane(3), secondRightLane(4), thirdLeftLane(5), thirdRightLane(6);
    };
    
    struct ManeuverSharingAndCoordinatingMessageTRRLocationType3 {
        INT isValidFlag;   // necessary if this struct is used as an optional field of a SEQUENCE
        INT length;
        struct ManeuverSharingAndCoordinatingMessagePositionOffsetXYZ arrayValue[32];  // SEQUENCE;
    };
    
    struct ManeuverSharingAndCoordinatingMessageTRRLocation {
        INT isValidFlag;   // necessary if this struct is used as an optional field of a SEQUENCE
        INT choice;
        struct ManeuverSharingAndCoordinatingMessageTRRLocationType1 tRRLocationType1;  // SEQUENCE;
        struct ManeuverSharingAndCoordinatingMessageTRRLocationType2 tRRLocationType2;  // SEQUENCE;
        struct ManeuverSharingAndCoordinatingMessageTRRLocationType3 tRRLocationType3;  // SEQUENCEOF;
    };
    
    struct ManeuverSharingAndCoordinatingMessageTargetRoadResource {
        INT isValidFlag;   // necessary if this struct is used as an optional field of a SEQUENCE
        INT tRRType;  // ENUMERATED, tRRType1(0), tRRType2(1), tRRType3(2);
        struct ManeuverSharingAndCoordinatingMessageTRRLocation tRRLocation;  // CHOICE;
    };
    
    struct ManeuverSharingAndCoordinatingMessageSubManeuver {
        INT isValidFlag;   // necessary if this struct is used as an optional field of a SEQUENCE
        struct ManeuverSharingAndCoordinatingMessageCommon_TemporaryID executantVehID;  // OCTETSTRING;
        struct ManeuverSharingAndCoordinatingMessageTemporaryIDPointer affectedVehIDs;  // BITSTRING;
        struct ManeuverSharingAndCoordinatingMessageCurrentStateData currentStateData;  // SEQUENCE;
        struct ManeuverSharingAndCoordinatingMessageTargetRoadResource targetRoadResource;  // SEQUENCE, OPTIONAL;
        struct ManeuverSharingAndCoordinatingMessageCommon_DDateTime startTime;  // SEQUENCE;
        struct ManeuverSharingAndCoordinatingMessageCommon_DDateTime endTime;  // SEQUENCE;
        struct OPT_WORD_ASN minSpeed;  // INTEGER, OPTIONAL, 0..8191;
        struct OPT_WORD_ASN maxSpeed;  // INTEGER, OPTIONAL, 0..8191;
    };
    
    struct ManeuverSharingAndCoordinatingMessageSubManeuverList {
        INT isValidFlag;   // necessary if this struct is used as an optional field of a SEQUENCE
        INT length;
        struct ManeuverSharingAndCoordinatingMessageSubManeuver arrayValue[32];  // SEQUENCE;
    };
    
    struct ManeuverSharingAndCoordinatingMessageManeuver {
        INT isValidFlag;   // necessary if this struct is used as an optional field of a SEQUENCE
        struct ManeuverSharingAndCoordinatingMessageSubManeuverList subManeuverList;  // SEQUENCEOF;
    };
    
    struct ManeuverSharingAndCoordinatingMessage_ManeuverSharingAndCoordinatingMessage {
        INT isValidFlag;   // necessary if this struct is used as an optional field of a SEQUENCE
        struct ManeuverSharingAndCoordinatingMessageCommon_DDateTime mSCMTimestamp;  // SEQUENCE;
        struct ManeuverSharingAndCoordinatingMessageCommon_Position3D hVPos;  // SEQUENCE, OPTIONAL;
        struct ManeuverSharingAndCoordinatingMessageCommon_PositionalAccuracy hVPosXYConf;  // SEQUENCE, OPTIONAL;
        INT mSCMType;  // ENUMERATED, maneuverIntent(0), maneuverRequest(1), maneuverResponse(2), maneuverReservation(3), hVManeuverCancellation(4), rVManeuverCancellationRequest(5), emergencyManeuverReservation(6), maneuverExecutionStatus(7);
        struct ManeuverSharingAndCoordinatingMessageCommon_TemporaryID sourceID;  // OCTETSTRING;
        struct ManeuverSharingAndCoordinatingMessageTemporaryIDList destinationIDs;  // SEQUENCEOF, OPTIONAL;
        struct OPT_BYTE_ASN maneuverID;  // INTEGER, OPTIONAL, 0..255;
        struct ManeuverSharingAndCoordinatingMessageManeuver maneuver;  // SEQUENCE, OPTIONAL;
        struct OPT_BOOL_ASN responseFlag;  // BOOLEAN, OPTIONAL;
        struct OPT_ENUM_ASN reasonCode;  // ENUMERATED, OPTIONAL, unknown(0), unableToConform(1), unwanted(2), unableToUnderstand(3), erroneousBehaviorDetected(4), misbehaviorAttackDetected(5), rVManeuverCancellationRequestIssued(6), sessionIDConflicted(7);
        struct OPT_ENUM_ASN maneuverExecutionStatus;  // ENUMERATED, OPTIONAL, started(0), inProgress(1), completed(2), terminated(3);
    };
    
    struct ManeuverSharingAndCoordinatingMessageMESSAGE_ID_AND_TYPE {
        struct ManeuverSharingAndCoordinatingMessage_ManeuverSharingAndCoordinatingMessage maneuverSharingAndCoordinatingMessage;  // SEQUENCE;
    };
    
    struct ManeuverSharingAndCoordinatingMessage {
        INT isValidFlag;   // necessary if this struct is used as an optional field of a SEQUENCE
        WORD messageId;  // INTEGER, 0..32767, mapData(18), signalPhaseAndTimingMessage(19), basicSafetyMessage(20), commonSafetyRequest(21), emergencyVehicleAlert(22), intersectionCollision(23), nmeaCorrections(24), probeDataManagement(25), probeVehicleData(26), roadSideAlert(27), rtcmCorrections(28), signalRequestMessage(29), signalStatusMessage(30), travelerInformation(31), personalSafetyMessage(32), roadSafetyMessage(33), roadWeatherMessage(34), probeDataConfigMessage(35), probeDataReportMessage(36), tollAdvertisementMessage(37), tollUsageMessage(38), tollUsageAckMessage(39), cooperativeControlMessage(40), sensorDataSharingMessage(41), maneuverSharingAndCoordinatingMessage(42), roadGeometryAndAttributes(43), personalSafetyMessage2(44), trafficSignalPhaseAndTiming(45), signalControlAndPrioritizationRequest(46), signalControlAndPrioritizationStatus(47), roadUserChargingConfigMessage(48), roadUserChargingReportMessage(49), trafficLightStatusMessage(50);
        struct ManeuverSharingAndCoordinatingMessageMESSAGE_ID_AND_TYPE value;  // TABLE;
    };
    
}

/*
// init function to create a simple packet handle
*/ 
LONG API_InitManeuverSharingAndCoordinatingMessagePacket()
{
  return C2xInitPacket("ManeuverSharingAndCoordinatingMessage"); 
}

/*
// init function to create a simple packet handle and
// initialize the struct with valid data
*/ 
LONG API_InitManeuverSharingAndCoordinatingMessagePacket(struct ManeuverSharingAndCoordinatingMessage msgStruct)
{
  long pktHandle;

  pktHandle = API_InitManeuverSharingAndCoordinatingMessagePacket();

  if (pktHandle != 0)
  {
    // create valid message and application data
    if (C2xCompletePacket(pktHandle) == 0) 
    {
      API_GetManeuverSharingAndCoordinatingMessageParams(pktHandle, msgStruct);
    }
  }
  return pktHandle;
}

/*
// init function to create a packet with security layer and
// initialize the struct with valid data
*/ 
LONG API_InitManeuverSharingAndCoordinatingMessagePacket(struct ManeuverSharingAndCoordinatingMessage msgStruct, char packetTypeDesignator[], char certificateName[])
{
  long pktHandle, certHdl;

  // initialize the packet
  pktHandle = C2xInitPacket("ManeuverSharingAndCoordinatingMessage", packetTypeDesignator);

  if (pktHandle != 0)
  {
    certHdl = C2xSecCertificateGetHandle(certificateName);  // get the certificate handle for the cert with name "certificateName"
    if (certHdl != 0) 
    {
      C2xSecPacketSetSignerHandle(pktHandle, certHdl); // set the certHdl to the packet
    }

    // create valid message and application data
    if (C2xCompletePacket(pktHandle) == 0) 
    {
      // copy application data to the application structure
      API_GetManeuverSharingAndCoordinatingMessageParams(pktHandle, msgStruct);
    }
  }
  return pktHandle;
}
    

int GetManeuverSharingAndCoordinatingMessageCommon_DDateTimeParams(LONG packetHandle, struct ManeuverSharingAndCoordinatingMessageCommon_DDateTime value, char oldPath[])
{
  char newPath[300];
  int result;

  result = 0;

  snprintf(newPath, elcount(newPath), "%s.%s", oldPath, "year");
  value.year.isValidFlag = C2xIsTokenAvailable(packetHandle, "ManeuverSharingAndCoordinatingMessage", newPath);
  if(value.year.isValidFlag==1)
  {
    value.year.value = C2xGetTokenInt(packetHandle, "ManeuverSharingAndCoordinatingMessage", newPath);
    result = CheckLastError("ManeuverSharingAndCoordinatingMessage", gkFuncRefGet, result);
  }
  snprintf(newPath, elcount(newPath), "%s.%s", oldPath, "month");
  value.month.isValidFlag = C2xIsTokenAvailable(packetHandle, "ManeuverSharingAndCoordinatingMessage", newPath);
  if(value.month.isValidFlag==1)
  {
    value.month.value = C2xGetTokenInt(packetHandle, "ManeuverSharingAndCoordinatingMessage", newPath);
    result = CheckLastError("ManeuverSharingAndCoordinatingMessage", gkFuncRefGet, result);
  }
  snprintf(newPath, elcount(newPath), "%s.%s", oldPath, "day");
  value.day.isValidFlag = C2xIsTokenAvailable(packetHandle, "ManeuverSharingAndCoordinatingMessage", newPath);
  if(value.day.isValidFlag==1)
  {
    value.day.value = C2xGetTokenInt(packetHandle, "ManeuverSharingAndCoordinatingMessage", newPath);
    result = CheckLastError("ManeuverSharingAndCoordinatingMessage", gkFuncRefGet, result);
  }
  snprintf(newPath, elcount(newPath), "%s.%s", oldPath, "hour");
  value.hour.isValidFlag = C2xIsTokenAvailable(packetHandle, "ManeuverSharingAndCoordinatingMessage", newPath);
  if(value.hour.isValidFlag==1)
  {
    value.hour.value = C2xGetTokenInt(packetHandle, "ManeuverSharingAndCoordinatingMessage", newPath);
    result = CheckLastError("ManeuverSharingAndCoordinatingMessage", gkFuncRefGet, result);
  }
  snprintf(newPath, elcount(newPath), "%s.%s", oldPath, "minute");
  value.minute.isValidFlag = C2xIsTokenAvailable(packetHandle, "ManeuverSharingAndCoordinatingMessage", newPath);
  if(value.minute.isValidFlag==1)
  {
    value.minute.value = C2xGetTokenInt(packetHandle, "ManeuverSharingAndCoordinatingMessage", newPath);
    result = CheckLastError("ManeuverSharingAndCoordinatingMessage", gkFuncRefGet, result);
  }
  snprintf(newPath, elcount(newPath), "%s.%s", oldPath, "second");
  value.second.isValidFlag = C2xIsTokenAvailable(packetHandle, "ManeuverSharingAndCoordinatingMessage", newPath);
  if(value.second.isValidFlag==1)
  {
    value.second.value = C2xGetTokenInt(packetHandle, "ManeuverSharingAndCoordinatingMessage", newPath);
    result = CheckLastError("ManeuverSharingAndCoordinatingMessage", gkFuncRefGet, result);
  }
  snprintf(newPath, elcount(newPath), "%s.%s", oldPath, "offset");
  value.offset.isValidFlag = C2xIsTokenAvailable(packetHandle, "ManeuverSharingAndCoordinatingMessage", newPath);
  if(value.offset.isValidFlag==1)
  {
    value.offset.value = C2xGetTokenInt(packetHandle, "ManeuverSharingAndCoordinatingMessage", newPath);
    result = CheckLastError("ManeuverSharingAndCoordinatingMessage", gkFuncRefGet, result);
  }
  return result;
}

int SetManeuverSharingAndCoordinatingMessageCommon_DDateTimeParams(LONG packetHandle, struct ManeuverSharingAndCoordinatingMessageCommon_DDateTime value, char oldPath[])
{
  char newPath[300];
  int result;

  result = 0;

  snprintf(newPath, elcount(newPath), "%s.%s", oldPath, "year");
  if(value.year.isValidFlag==1)
  {
    C2xSetTokenInt(packetHandle, "ManeuverSharingAndCoordinatingMessage", newPath, value.year.value);
    result = CheckLastError("ManeuverSharingAndCoordinatingMessage", gkFuncRefGet, result);
  }
  else
  {
    if( C2xIsTokenAvailable(packetHandle, "ManeuverSharingAndCoordinatingMessage", newPath) )
    {
      C2xRemoveToken(packetHandle, "ManeuverSharingAndCoordinatingMessage", newPath);
    }
  }

  snprintf(newPath, elcount(newPath), "%s.%s", oldPath, "month");
  if(value.month.isValidFlag==1)
  {
    C2xSetTokenInt(packetHandle, "ManeuverSharingAndCoordinatingMessage", newPath, value.month.value);
    result = CheckLastError("ManeuverSharingAndCoordinatingMessage", gkFuncRefGet, result);
  }
  else
  {
    if( C2xIsTokenAvailable(packetHandle, "ManeuverSharingAndCoordinatingMessage", newPath) )
    {
      C2xRemoveToken(packetHandle, "ManeuverSharingAndCoordinatingMessage", newPath);
    }
  }

  snprintf(newPath, elcount(newPath), "%s.%s", oldPath, "day");
  if(value.day.isValidFlag==1)
  {
    C2xSetTokenInt(packetHandle, "ManeuverSharingAndCoordinatingMessage", newPath, value.day.value);
    result = CheckLastError("ManeuverSharingAndCoordinatingMessage", gkFuncRefGet, result);
  }
  else
  {
    if( C2xIsTokenAvailable(packetHandle, "ManeuverSharingAndCoordinatingMessage", newPath) )
    {
      C2xRemoveToken(packetHandle, "ManeuverSharingAndCoordinatingMessage", newPath);
    }
  }

  snprintf(newPath, elcount(newPath), "%s.%s", oldPath, "hour");
  if(value.hour.isValidFlag==1)
  {
    C2xSetTokenInt(packetHandle, "ManeuverSharingAndCoordinatingMessage", newPath, value.hour.value);
    result = CheckLastError("ManeuverSharingAndCoordinatingMessage", gkFuncRefGet, result);
  }
  else
  {
    if( C2xIsTokenAvailable(packetHandle, "ManeuverSharingAndCoordinatingMessage", newPath) )
    {
      C2xRemoveToken(packetHandle, "ManeuverSharingAndCoordinatingMessage", newPath);
    }
  }

  snprintf(newPath, elcount(newPath), "%s.%s", oldPath, "minute");
  if(value.minute.isValidFlag==1)
  {
    C2xSetTokenInt(packetHandle, "ManeuverSharingAndCoordinatingMessage", newPath, value.minute.value);
    result = CheckLastError("ManeuverSharingAndCoordinatingMessage", gkFuncRefGet, result);
  }
  else
  {
    if( C2xIsTokenAvailable(packetHandle, "ManeuverSharingAndCoordinatingMessage", newPath) )
    {
      C2xRemoveToken(packetHandle, "ManeuverSharingAndCoordinatingMessage", newPath);
    }
  }

  snprintf(newPath, elcount(newPath), "%s.%s", oldPath, "second");
  if(value.second.isValidFlag==1)
  {
    C2xSetTokenInt(packetHandle, "ManeuverSharingAndCoordinatingMessage", newPath, value.second.value);
    result = CheckLastError("ManeuverSharingAndCoordinatingMessage", gkFuncRefGet, result);
  }
  else
  {
    if( C2xIsTokenAvailable(packetHandle, "ManeuverSharingAndCoordinatingMessage", newPath) )
    {
      C2xRemoveToken(packetHandle, "ManeuverSharingAndCoordinatingMessage", newPath);
    }
  }

  snprintf(newPath, elcount(newPath), "%s.%s", oldPath, "offset");
  if(value.offset.isValidFlag==1)
  {
    C2xSetTokenInt(packetHandle, "ManeuverSharingAndCoordinatingMessage", newPath, value.offset.value);
    result = CheckLastError("ManeuverSharingAndCoordinatingMessage", gkFuncRefGet, result);
  }
  else
  {
    if( C2xIsTokenAvailable(packetHandle, "ManeuverSharingAndCoordinatingMessage", newPath) )
    {
      C2xRemoveToken(packetHandle, "ManeuverSharingAndCoordinatingMessage", newPath);
    }
  }

  return result;
}

int GetManeuverSharingAndCoordinatingMessageAddGrpB_LatitudeDMS2Params(LONG packetHandle, struct ManeuverSharingAndCoordinatingMessageAddGrpB_LatitudeDMS2 value, char oldPath[])
{
  char newPath[300];
  int result;

  result = 0;

  snprintf(newPath, elcount(newPath), "%s.%s", oldPath, "d");
  value.d = C2xGetTokenInt(packetHandle, "ManeuverSharingAndCoordinatingMessage", newPath);
  result = CheckLastError("ManeuverSharingAndCoordinatingMessage", gkFuncRefGet, result);

  snprintf(newPath, elcount(newPath), "%s.%s", oldPath, "m");
  value.m = C2xGetTokenInt(packetHandle, "ManeuverSharingAndCoordinatingMessage", newPath);
  result = CheckLastError("ManeuverSharingAndCoordinatingMessage", gkFuncRefGet, result);

  snprintf(newPath, elcount(newPath), "%s.%s", oldPath, "s");
  value.s = C2xGetTokenInt(packetHandle, "ManeuverSharingAndCoordinatingMessage", newPath);
  result = CheckLastError("ManeuverSharingAndCoordinatingMessage", gkFuncRefGet, result);

  return result;
}

int SetManeuverSharingAndCoordinatingMessageAddGrpB_LatitudeDMS2Params(LONG packetHandle, struct ManeuverSharingAndCoordinatingMessageAddGrpB_LatitudeDMS2 value, char oldPath[])
{
  char newPath[300];
  int result;

  result = 0;

  snprintf(newPath, elcount(newPath), "%s.%s", oldPath, "d");
  C2xSetTokenInt(packetHandle, "ManeuverSharingAndCoordinatingMessage", newPath, value.d);
  result = CheckLastError("ManeuverSharingAndCoordinatingMessage", gkFuncRefGet, result);

  snprintf(newPath, elcount(newPath), "%s.%s", oldPath, "m");
  C2xSetTokenInt(packetHandle, "ManeuverSharingAndCoordinatingMessage", newPath, value.m);
  result = CheckLastError("ManeuverSharingAndCoordinatingMessage", gkFuncRefGet, result);

  snprintf(newPath, elcount(newPath), "%s.%s", oldPath, "s");
  C2xSetTokenInt(packetHandle, "ManeuverSharingAndCoordinatingMessage", newPath, value.s);
  result = CheckLastError("ManeuverSharingAndCoordinatingMessage", gkFuncRefGet, result);

  return result;
}

int GetManeuverSharingAndCoordinatingMessageAddGrpB_LongitudeDMS2Params(LONG packetHandle, struct ManeuverSharingAndCoordinatingMessageAddGrpB_LongitudeDMS2 value, char oldPath[])
{
  char newPath[300];
  int result;

  result = 0;

  snprintf(newPath, elcount(newPath), "%s.%s", oldPath, "d");
  value.d = C2xGetTokenInt(packetHandle, "ManeuverSharingAndCoordinatingMessage", newPath);
  result = CheckLastError("ManeuverSharingAndCoordinatingMessage", gkFuncRefGet, result);

  snprintf(newPath, elcount(newPath), "%s.%s", oldPath, "m");
  value.m = C2xGetTokenInt(packetHandle, "ManeuverSharingAndCoordinatingMessage", newPath);
  result = CheckLastError("ManeuverSharingAndCoordinatingMessage", gkFuncRefGet, result);

  snprintf(newPath, elcount(newPath), "%s.%s", oldPath, "s");
  value.s = C2xGetTokenInt(packetHandle, "ManeuverSharingAndCoordinatingMessage", newPath);
  result = CheckLastError("ManeuverSharingAndCoordinatingMessage", gkFuncRefGet, result);

  return result;
}

int SetManeuverSharingAndCoordinatingMessageAddGrpB_LongitudeDMS2Params(LONG packetHandle, struct ManeuverSharingAndCoordinatingMessageAddGrpB_LongitudeDMS2 value, char oldPath[])
{
  char newPath[300];
  int result;

  result = 0;

  snprintf(newPath, elcount(newPath), "%s.%s", oldPath, "d");
  C2xSetTokenInt(packetHandle, "ManeuverSharingAndCoordinatingMessage", newPath, value.d);
  result = CheckLastError("ManeuverSharingAndCoordinatingMessage", gkFuncRefGet, result);

  snprintf(newPath, elcount(newPath), "%s.%s", oldPath, "m");
  C2xSetTokenInt(packetHandle, "ManeuverSharingAndCoordinatingMessage", newPath, value.m);
  result = CheckLastError("ManeuverSharingAndCoordinatingMessage", gkFuncRefGet, result);

  snprintf(newPath, elcount(newPath), "%s.%s", oldPath, "s");
  C2xSetTokenInt(packetHandle, "ManeuverSharingAndCoordinatingMessage", newPath, value.s);
  result = CheckLastError("ManeuverSharingAndCoordinatingMessage", gkFuncRefGet, result);

  return result;
}

int GetManeuverSharingAndCoordinatingMessageAddGrpB_Position3D_addGrpBParams(LONG packetHandle, struct ManeuverSharingAndCoordinatingMessageAddGrpB_Position3D_addGrpB value, char oldPath[])
{
  char newPath[300];
  int result;

  result = 0;

  snprintf(newPath, elcount(newPath), "%s.%s", oldPath, "latitude");
  GetManeuverSharingAndCoordinatingMessageAddGrpB_LatitudeDMS2Params(packetHandle, value.latitude, newPath);
  result = CheckLastError("ManeuverSharingAndCoordinatingMessage", gkFuncRefGet, result);

  snprintf(newPath, elcount(newPath), "%s.%s", oldPath, "longitude");
  GetManeuverSharingAndCoordinatingMessageAddGrpB_LongitudeDMS2Params(packetHandle, value.longitude, newPath);
  result = CheckLastError("ManeuverSharingAndCoordinatingMessage", gkFuncRefGet, result);

  snprintf(newPath, elcount(newPath), "%s.%s", oldPath, "elevation");
  value.elevation = C2xGetTokenInt(packetHandle, "ManeuverSharingAndCoordinatingMessage", newPath);
  result = CheckLastError("ManeuverSharingAndCoordinatingMessage", gkFuncRefGet, result);

  return result;
}

int SetManeuverSharingAndCoordinatingMessageAddGrpB_Position3D_addGrpBParams(LONG packetHandle, struct ManeuverSharingAndCoordinatingMessageAddGrpB_Position3D_addGrpB value, char oldPath[])
{
  char newPath[300];
  int result;

  result = 0;

  snprintf(newPath, elcount(newPath), "%s.%s", oldPath, "latitude");
  SetManeuverSharingAndCoordinatingMessageAddGrpB_LatitudeDMS2Params(packetHandle, value.latitude, newPath);
  result = CheckLastError("ManeuverSharingAndCoordinatingMessage", gkFuncRefGet, result);

  snprintf(newPath, elcount(newPath), "%s.%s", oldPath, "longitude");
  SetManeuverSharingAndCoordinatingMessageAddGrpB_LongitudeDMS2Params(packetHandle, value.longitude, newPath);
  result = CheckLastError("ManeuverSharingAndCoordinatingMessage", gkFuncRefGet, result);

  snprintf(newPath, elcount(newPath), "%s.%s", oldPath, "elevation");
  C2xSetTokenInt(packetHandle, "ManeuverSharingAndCoordinatingMessage", newPath, value.elevation);
  result = CheckLastError("ManeuverSharingAndCoordinatingMessage", gkFuncRefGet, result);

  return result;
}

int GetManeuverSharingAndCoordinatingMessageAddGrpC_AltitudeParams(LONG packetHandle, struct ManeuverSharingAndCoordinatingMessageAddGrpC_Altitude value, char oldPath[])
{
  char newPath[300];
  int result;

  result = 0;

  snprintf(newPath, elcount(newPath), "%s.%s", oldPath, "value");
  value.value = C2xGetTokenInt(packetHandle, "ManeuverSharingAndCoordinatingMessage", newPath);
  result = CheckLastError("ManeuverSharingAndCoordinatingMessage", gkFuncRefGet, result);

  snprintf(newPath, elcount(newPath), "%s.%s", oldPath, "confidence");
  value.confidence = C2xGetTokenInt(packetHandle, "ManeuverSharingAndCoordinatingMessage", newPath);
  result = CheckLastError("ManeuverSharingAndCoordinatingMessage", gkFuncRefGet, result);

  return result;
}

int SetManeuverSharingAndCoordinatingMessageAddGrpC_AltitudeParams(LONG packetHandle, struct ManeuverSharingAndCoordinatingMessageAddGrpC_Altitude value, char oldPath[])
{
  char newPath[300];
  int result;

  result = 0;

  snprintf(newPath, elcount(newPath), "%s.%s", oldPath, "value");
  C2xSetTokenInt(packetHandle, "ManeuverSharingAndCoordinatingMessage", newPath, value.value);
  result = CheckLastError("ManeuverSharingAndCoordinatingMessage", gkFuncRefGet, result);

  snprintf(newPath, elcount(newPath), "%s.%s", oldPath, "confidence");
  C2xSetTokenInt(packetHandle, "ManeuverSharingAndCoordinatingMessage", newPath, value.confidence);
  result = CheckLastError("ManeuverSharingAndCoordinatingMessage", gkFuncRefGet, result);

  return result;
}

int GetManeuverSharingAndCoordinatingMessageAddGrpC_Position3D_addGrpCParams(LONG packetHandle, struct ManeuverSharingAndCoordinatingMessageAddGrpC_Position3D_addGrpC value, char oldPath[])
{
  char newPath[300];
  int result;

  result = 0;

  snprintf(newPath, elcount(newPath), "%s.%s", oldPath, "altitude");
  GetManeuverSharingAndCoordinatingMessageAddGrpC_AltitudeParams(packetHandle, value.altitude, newPath);
  result = CheckLastError("ManeuverSharingAndCoordinatingMessage", gkFuncRefGet, result);

  return result;
}

int SetManeuverSharingAndCoordinatingMessageAddGrpC_Position3D_addGrpCParams(LONG packetHandle, struct ManeuverSharingAndCoordinatingMessageAddGrpC_Position3D_addGrpC value, char oldPath[])
{
  char newPath[300];
  int result;

  result = 0;

  snprintf(newPath, elcount(newPath), "%s.%s", oldPath, "altitude");
  SetManeuverSharingAndCoordinatingMessageAddGrpC_AltitudeParams(packetHandle, value.altitude, newPath);
  result = CheckLastError("ManeuverSharingAndCoordinatingMessage", gkFuncRefGet, result);

  return result;
}

int GetManeuverSharingAndCoordinatingMessageCommon_RegionalExtension_Reg_Position3D_tableParams(LONG packetHandle, WORD tableKey, struct ManeuverSharingAndCoordinatingMessageCommon_RegionalExtension_Reg_Position3D_table value, char oldPath[])
{
  char newPath[300];
  int result;

  result = 0;

  switch(tableKey)
  {
    case 2:
    {
      snprintf(newPath, elcount(newPath), "%s.%s", oldPath, "addGrpB");
      GetManeuverSharingAndCoordinatingMessageAddGrpB_Position3D_addGrpBParams(packetHandle, value.addGrpB, newPath);
      result = CheckLastError("ManeuverSharingAndCoordinatingMessage", gkFuncRefGet, result);
    }
    break;
    case 3:
    {
      snprintf(newPath, elcount(newPath), "%s.%s", oldPath, "addGrpC");
      GetManeuverSharingAndCoordinatingMessageAddGrpC_Position3D_addGrpCParams(packetHandle, value.addGrpC, newPath);
      result = CheckLastError("ManeuverSharingAndCoordinatingMessage", gkFuncRefGet, result);
    }
    break;
  }
  return result;
}

int SetManeuverSharingAndCoordinatingMessageCommon_RegionalExtension_Reg_Position3D_tableParams(LONG packetHandle, WORD tableKey, struct ManeuverSharingAndCoordinatingMessageCommon_RegionalExtension_Reg_Position3D_table value, char oldPath[])
{
  char newPath[300];
  int result;

  result = 0;

  switch(tableKey)
  {
    case 2:
    {
      snprintf(newPath, elcount(newPath), "%s.%s", oldPath, "addGrpB");
      SetManeuverSharingAndCoordinatingMessageAddGrpB_Position3D_addGrpBParams(packetHandle, value.addGrpB, newPath);
      result = CheckLastError("ManeuverSharingAndCoordinatingMessage", gkFuncRefGet, result);
    }
    break;
    case 3:
    {
      snprintf(newPath, elcount(newPath), "%s.%s", oldPath, "addGrpC");
      SetManeuverSharingAndCoordinatingMessageAddGrpC_Position3D_addGrpCParams(packetHandle, value.addGrpC, newPath);
      result = CheckLastError("ManeuverSharingAndCoordinatingMessage", gkFuncRefGet, result);
    }
    break;
  }
  return result;
}

int GetManeuverSharingAndCoordinatingMessageCommon_RegionalExtension_Reg_Position3DParams(LONG packetHandle, struct ManeuverSharingAndCoordinatingMessageCommon_RegionalExtension_Reg_Position3D value, char oldPath[])
{
  char newPath[300];
  int result;

  result = 0;

  snprintf(newPath, elcount(newPath), "%s.%s", oldPath, "regionId");
  value.regionId = C2xGetTokenInt(packetHandle, "ManeuverSharingAndCoordinatingMessage", newPath);
  result = CheckLastError("ManeuverSharingAndCoordinatingMessage", gkFuncRefGet, result);

  snprintf(newPath, elcount(newPath), "%s.%s", oldPath, "regExtvalue");
  GetManeuverSharingAndCoordinatingMessageCommon_RegionalExtension_Reg_Position3D_tableParams(packetHandle, value.regionId, value.regExtvalue, newPath);
  result = CheckLastError("ManeuverSharingAndCoordinatingMessage", gkFuncRefGet, result);

  return result;
}

int SetManeuverSharingAndCoordinatingMessageCommon_RegionalExtension_Reg_Position3DParams(LONG packetHandle, struct ManeuverSharingAndCoordinatingMessageCommon_RegionalExtension_Reg_Position3D value, char oldPath[])
{
  char newPath[300];
  int result;

  result = 0;


  snprintf(newPath, elcount(newPath), "%s.%s", oldPath, "regExtvalue");
  SetManeuverSharingAndCoordinatingMessageCommon_RegionalExtension_Reg_Position3D_tableParams(packetHandle, value.regionId, value.regExtvalue, newPath);
  result = CheckLastError("ManeuverSharingAndCoordinatingMessage", gkFuncRefGet, result);

  return result;
}

int GetManeuverSharingAndCoordinatingMessageCommon_Position3D_regionalParams(LONG packetHandle, struct ManeuverSharingAndCoordinatingMessageCommon_Position3D_regional value, char oldPath[])
{
  char newPath[300]; 
  int i;
  int result;

  result = 0;

  value.length = C2xGetTokenInt(packetHandle, "ManeuverSharingAndCoordinatingMessage", oldPath);
  if((result = CheckLastError("ManeuverSharingAndCoordinatingMessage", gkFuncRefGet, result))==0)
  {
    for(i=0; i<value.length; i++)
    {
      snprintf(newPath, elcount(newPath), "%s[%d]", oldPath, i);
      GetManeuverSharingAndCoordinatingMessageCommon_RegionalExtension_Reg_Position3DParams(packetHandle, value.arrayValue[i], newPath);
      result = CheckLastError("ManeuverSharingAndCoordinatingMessage", gkFuncRefGet, result);
    }
  }
  return result;
}

int SetManeuverSharingAndCoordinatingMessageCommon_Position3D_regionalParams(LONG packetHandle, struct ManeuverSharingAndCoordinatingMessageCommon_Position3D_regional value, char oldPath[])
{
  char newPath[300]; 
  int i;
  int result;

  result = 0;

  C2xRemoveToken(packetHandle, "ManeuverSharingAndCoordinatingMessage", oldPath);
  for(i=0; i<value.length; i++)
  {
    snprintf(newPath, elcount(newPath), "%s[%d]", oldPath, i);
    SetManeuverSharingAndCoordinatingMessageCommon_RegionalExtension_Reg_Position3DParams(packetHandle, value.arrayValue[i], newPath);
    result = CheckLastError("ManeuverSharingAndCoordinatingMessage", gkFuncRefGet, result);
  }
  return result;
}

int GetManeuverSharingAndCoordinatingMessageCommon_Position3DParams(LONG packetHandle, struct ManeuverSharingAndCoordinatingMessageCommon_Position3D value, char oldPath[])
{
  char newPath[300];
  int result;

  result = 0;

  snprintf(newPath, elcount(newPath), "%s.%s", oldPath, "lat");
  value.lat = C2xGetTokenInt(packetHandle, "ManeuverSharingAndCoordinatingMessage", newPath);
  result = CheckLastError("ManeuverSharingAndCoordinatingMessage", gkFuncRefGet, result);

  snprintf(newPath, elcount(newPath), "%s.%s", oldPath, "lon");
  value.lon = C2xGetTokenInt(packetHandle, "ManeuverSharingAndCoordinatingMessage", newPath);
  result = CheckLastError("ManeuverSharingAndCoordinatingMessage", gkFuncRefGet, result);

  snprintf(newPath, elcount(newPath), "%s.%s", oldPath, "elevation");
  value.elevation.isValidFlag = C2xIsTokenAvailable(packetHandle, "ManeuverSharingAndCoordinatingMessage", newPath);
  if(value.elevation.isValidFlag==1)
  {
    value.elevation.value = C2xGetTokenInt(packetHandle, "ManeuverSharingAndCoordinatingMessage", newPath);
    result = CheckLastError("ManeuverSharingAndCoordinatingMessage", gkFuncRefGet, result);
  }
  snprintf(newPath, elcount(newPath), "%s.%s", oldPath, "regional");
  value.regional.isValidFlag = C2xIsTokenAvailable(packetHandle, "ManeuverSharingAndCoordinatingMessage", newPath);
  if(value.regional.isValidFlag==1)
  {
    GetManeuverSharingAndCoordinatingMessageCommon_Position3D_regionalParams(packetHandle, value.regional, newPath);
    result = CheckLastError("ManeuverSharingAndCoordinatingMessage", gkFuncRefGet, result);
  }
  return result;
}

int SetManeuverSharingAndCoordinatingMessageCommon_Position3DParams(LONG packetHandle, struct ManeuverSharingAndCoordinatingMessageCommon_Position3D value, char oldPath[])
{
  char newPath[300];
  int result;

  result = 0;

  snprintf(newPath, elcount(newPath), "%s.%s", oldPath, "lat");
  C2xSetTokenInt(packetHandle, "ManeuverSharingAndCoordinatingMessage", newPath, value.lat);
  result = CheckLastError("ManeuverSharingAndCoordinatingMessage", gkFuncRefGet, result);

  snprintf(newPath, elcount(newPath), "%s.%s", oldPath, "lon");
  C2xSetTokenInt(packetHandle, "ManeuverSharingAndCoordinatingMessage", newPath, value.lon);
  result = CheckLastError("ManeuverSharingAndCoordinatingMessage", gkFuncRefGet, result);

  snprintf(newPath, elcount(newPath), "%s.%s", oldPath, "elevation");
  if(value.elevation.isValidFlag==1)
  {
    C2xSetTokenInt(packetHandle, "ManeuverSharingAndCoordinatingMessage", newPath, value.elevation.value);
    result = CheckLastError("ManeuverSharingAndCoordinatingMessage", gkFuncRefGet, result);
  }
  else
  {
    if( C2xIsTokenAvailable(packetHandle, "ManeuverSharingAndCoordinatingMessage", newPath) )
    {
      C2xRemoveToken(packetHandle, "ManeuverSharingAndCoordinatingMessage", newPath);
    }
  }

  snprintf(newPath, elcount(newPath), "%s.%s", oldPath, "regional");
  if(value.regional.isValidFlag==1)
  {
    SetManeuverSharingAndCoordinatingMessageCommon_Position3D_regionalParams(packetHandle, value.regional, newPath);
    result = CheckLastError("ManeuverSharingAndCoordinatingMessage", gkFuncRefGet, result);
  }
  else
  {
    if( C2xIsTokenAvailable(packetHandle, "ManeuverSharingAndCoordinatingMessage", newPath) )
    {
      C2xRemoveToken(packetHandle, "ManeuverSharingAndCoordinatingMessage", newPath);
    }
  }

  return result;
}

int GetManeuverSharingAndCoordinatingMessageCommon_PositionalAccuracyParams(LONG packetHandle, struct ManeuverSharingAndCoordinatingMessageCommon_PositionalAccuracy value, char oldPath[])
{
  char newPath[300];
  int result;

  result = 0;

  snprintf(newPath, elcount(newPath), "%s.%s", oldPath, "semiMajor");
  value.semiMajor = C2xGetTokenInt(packetHandle, "ManeuverSharingAndCoordinatingMessage", newPath);
  result = CheckLastError("ManeuverSharingAndCoordinatingMessage", gkFuncRefGet, result);

  snprintf(newPath, elcount(newPath), "%s.%s", oldPath, "semiMinor");
  value.semiMinor = C2xGetTokenInt(packetHandle, "ManeuverSharingAndCoordinatingMessage", newPath);
  result = CheckLastError("ManeuverSharingAndCoordinatingMessage", gkFuncRefGet, result);

  snprintf(newPath, elcount(newPath), "%s.%s", oldPath, "orientation");
  value.orientation = C2xGetTokenInt(packetHandle, "ManeuverSharingAndCoordinatingMessage", newPath);
  result = CheckLastError("ManeuverSharingAndCoordinatingMessage", gkFuncRefGet, result);

  return result;
}

int SetManeuverSharingAndCoordinatingMessageCommon_PositionalAccuracyParams(LONG packetHandle, struct ManeuverSharingAndCoordinatingMessageCommon_PositionalAccuracy value, char oldPath[])
{
  char newPath[300];
  int result;

  result = 0;

  snprintf(newPath, elcount(newPath), "%s.%s", oldPath, "semiMajor");
  C2xSetTokenInt(packetHandle, "ManeuverSharingAndCoordinatingMessage", newPath, value.semiMajor);
  result = CheckLastError("ManeuverSharingAndCoordinatingMessage", gkFuncRefGet, result);

  snprintf(newPath, elcount(newPath), "%s.%s", oldPath, "semiMinor");
  C2xSetTokenInt(packetHandle, "ManeuverSharingAndCoordinatingMessage", newPath, value.semiMinor);
  result = CheckLastError("ManeuverSharingAndCoordinatingMessage", gkFuncRefGet, result);

  snprintf(newPath, elcount(newPath), "%s.%s", oldPath, "orientation");
  C2xSetTokenInt(packetHandle, "ManeuverSharingAndCoordinatingMessage", newPath, value.orientation);
  result = CheckLastError("ManeuverSharingAndCoordinatingMessage", gkFuncRefGet, result);

  return result;
}

int GetManeuverSharingAndCoordinatingMessageTemporaryIDListParams(LONG packetHandle, struct ManeuverSharingAndCoordinatingMessageTemporaryIDList value, char oldPath[])
{
  char newPath[300]; 
  int i;
  char buffer[300];
  int result;

  result = 0;

  value.length = C2xGetTokenInt(packetHandle, "ManeuverSharingAndCoordinatingMessage", oldPath);
  if((result = CheckLastError("ManeuverSharingAndCoordinatingMessage", gkFuncRefGet, result))==0)
  {
    for(i=0; i<value.length; i++)
    {
      snprintf(newPath, elcount(newPath), "%s[%d]", oldPath, i);
      C2xGetTokenData(packetHandle, "ManeuverSharingAndCoordinatingMessage", newPath, elcount(buffer), buffer);
      strncpy(value.arrayValue[i].string , buffer, value.arrayValue[i].stringLength );
      result = CheckLastError("ManeuverSharingAndCoordinatingMessage", gkFuncRefGet, result);
    }
  }
  return result;
}

int SetManeuverSharingAndCoordinatingMessageTemporaryIDListParams(LONG packetHandle, struct ManeuverSharingAndCoordinatingMessageTemporaryIDList value, char oldPath[])
{
  char newPath[300]; 
  int i;
  char buffer[300];
  int result;

  result = 0;

  C2xRemoveToken(packetHandle, "ManeuverSharingAndCoordinatingMessage", oldPath);
  for(i=0; i<value.length; i++)
  {
    snprintf(newPath, elcount(newPath), "%s[%d]", oldPath, i);
    strncpy(buffer,value.arrayValue[i].string , elcount(buffer));
    C2xSetTokenData(packetHandle, "ManeuverSharingAndCoordinatingMessage", newPath, elcount(buffer), buffer);
    result = CheckLastError("ManeuverSharingAndCoordinatingMessage", gkFuncRefGet, result);
  }
  return result;
}

int GetManeuverSharingAndCoordinatingMessagePositionOffsetXYZParams(LONG packetHandle, struct ManeuverSharingAndCoordinatingMessagePositionOffsetXYZ value, char oldPath[])
{
  char newPath[300];
  int result;

  result = 0;

  snprintf(newPath, elcount(newPath), "%s.%s", oldPath, "offsetX");
  value.offsetX = C2xGetTokenInt(packetHandle, "ManeuverSharingAndCoordinatingMessage", newPath);
  result = CheckLastError("ManeuverSharingAndCoordinatingMessage", gkFuncRefGet, result);

  snprintf(newPath, elcount(newPath), "%s.%s", oldPath, "offsetY");
  value.offsetY = C2xGetTokenInt(packetHandle, "ManeuverSharingAndCoordinatingMessage", newPath);
  result = CheckLastError("ManeuverSharingAndCoordinatingMessage", gkFuncRefGet, result);

  snprintf(newPath, elcount(newPath), "%s.%s", oldPath, "offsetZ");
  value.offsetZ.isValidFlag = C2xIsTokenAvailable(packetHandle, "ManeuverSharingAndCoordinatingMessage", newPath);
  if(value.offsetZ.isValidFlag==1)
  {
    value.offsetZ.value = C2xGetTokenInt(packetHandle, "ManeuverSharingAndCoordinatingMessage", newPath);
    result = CheckLastError("ManeuverSharingAndCoordinatingMessage", gkFuncRefGet, result);
  }
  return result;
}

int SetManeuverSharingAndCoordinatingMessagePositionOffsetXYZParams(LONG packetHandle, struct ManeuverSharingAndCoordinatingMessagePositionOffsetXYZ value, char oldPath[])
{
  char newPath[300];
  int result;

  result = 0;

  snprintf(newPath, elcount(newPath), "%s.%s", oldPath, "offsetX");
  C2xSetTokenInt(packetHandle, "ManeuverSharingAndCoordinatingMessage", newPath, value.offsetX);
  result = CheckLastError("ManeuverSharingAndCoordinatingMessage", gkFuncRefGet, result);

  snprintf(newPath, elcount(newPath), "%s.%s", oldPath, "offsetY");
  C2xSetTokenInt(packetHandle, "ManeuverSharingAndCoordinatingMessage", newPath, value.offsetY);
  result = CheckLastError("ManeuverSharingAndCoordinatingMessage", gkFuncRefGet, result);

  snprintf(newPath, elcount(newPath), "%s.%s", oldPath, "offsetZ");
  if(value.offsetZ.isValidFlag==1)
  {
    C2xSetTokenInt(packetHandle, "ManeuverSharingAndCoordinatingMessage", newPath, value.offsetZ.value);
    result = CheckLastError("ManeuverSharingAndCoordinatingMessage", gkFuncRefGet, result);
  }
  else
  {
    if( C2xIsTokenAvailable(packetHandle, "ManeuverSharingAndCoordinatingMessage", newPath) )
    {
      C2xRemoveToken(packetHandle, "ManeuverSharingAndCoordinatingMessage", newPath);
    }
  }

  return result;
}

int GetManeuverSharingAndCoordinatingMessageCommon_PositionConfidenceSetParams(LONG packetHandle, struct ManeuverSharingAndCoordinatingMessageCommon_PositionConfidenceSet value, char oldPath[])
{
  char newPath[300];
  int result;

  result = 0;

  snprintf(newPath, elcount(newPath), "%s.%s", oldPath, "pos");
  value.pos = C2xGetTokenInt(packetHandle, "ManeuverSharingAndCoordinatingMessage", newPath);
  result = CheckLastError("ManeuverSharingAndCoordinatingMessage", gkFuncRefGet, result);

  snprintf(newPath, elcount(newPath), "%s.%s", oldPath, "elevation");
  value.elevation = C2xGetTokenInt(packetHandle, "ManeuverSharingAndCoordinatingMessage", newPath);
  result = CheckLastError("ManeuverSharingAndCoordinatingMessage", gkFuncRefGet, result);

  return result;
}

int SetManeuverSharingAndCoordinatingMessageCommon_PositionConfidenceSetParams(LONG packetHandle, struct ManeuverSharingAndCoordinatingMessageCommon_PositionConfidenceSet value, char oldPath[])
{
  char newPath[300];
  int result;

  result = 0;

  snprintf(newPath, elcount(newPath), "%s.%s", oldPath, "pos");
  C2xSetTokenInt(packetHandle, "ManeuverSharingAndCoordinatingMessage", newPath, value.pos);
  result = CheckLastError("ManeuverSharingAndCoordinatingMessage", gkFuncRefGet, result);

  snprintf(newPath, elcount(newPath), "%s.%s", oldPath, "elevation");
  C2xSetTokenInt(packetHandle, "ManeuverSharingAndCoordinatingMessage", newPath, value.elevation);
  result = CheckLastError("ManeuverSharingAndCoordinatingMessage", gkFuncRefGet, result);

  return result;
}

int GetManeuverSharingAndCoordinatingMessageCommon_AccelerationSet4WayParams(LONG packetHandle, struct ManeuverSharingAndCoordinatingMessageCommon_AccelerationSet4Way value, char oldPath[])
{
  char newPath[300];
  int result;

  result = 0;

  snprintf(newPath, elcount(newPath), "%s.%s", oldPath, "lon");
  value.lon = C2xGetTokenInt(packetHandle, "ManeuverSharingAndCoordinatingMessage", newPath);
  result = CheckLastError("ManeuverSharingAndCoordinatingMessage", gkFuncRefGet, result);

  snprintf(newPath, elcount(newPath), "%s.%s", oldPath, "lat");
  value.lat = C2xGetTokenInt(packetHandle, "ManeuverSharingAndCoordinatingMessage", newPath);
  result = CheckLastError("ManeuverSharingAndCoordinatingMessage", gkFuncRefGet, result);

  snprintf(newPath, elcount(newPath), "%s.%s", oldPath, "vert");
  value.vert = C2xGetTokenInt(packetHandle, "ManeuverSharingAndCoordinatingMessage", newPath);
  result = CheckLastError("ManeuverSharingAndCoordinatingMessage", gkFuncRefGet, result);

  snprintf(newPath, elcount(newPath), "%s.%s", oldPath, "yaw");
  value.yaw = C2xGetTokenInt(packetHandle, "ManeuverSharingAndCoordinatingMessage", newPath);
  result = CheckLastError("ManeuverSharingAndCoordinatingMessage", gkFuncRefGet, result);

  return result;
}

int SetManeuverSharingAndCoordinatingMessageCommon_AccelerationSet4WayParams(LONG packetHandle, struct ManeuverSharingAndCoordinatingMessageCommon_AccelerationSet4Way value, char oldPath[])
{
  char newPath[300];
  int result;

  result = 0;

  snprintf(newPath, elcount(newPath), "%s.%s", oldPath, "lon");
  C2xSetTokenInt(packetHandle, "ManeuverSharingAndCoordinatingMessage", newPath, value.lon);
  result = CheckLastError("ManeuverSharingAndCoordinatingMessage", gkFuncRefGet, result);

  snprintf(newPath, elcount(newPath), "%s.%s", oldPath, "lat");
  C2xSetTokenInt(packetHandle, "ManeuverSharingAndCoordinatingMessage", newPath, value.lat);
  result = CheckLastError("ManeuverSharingAndCoordinatingMessage", gkFuncRefGet, result);

  snprintf(newPath, elcount(newPath), "%s.%s", oldPath, "vert");
  C2xSetTokenInt(packetHandle, "ManeuverSharingAndCoordinatingMessage", newPath, value.vert);
  result = CheckLastError("ManeuverSharingAndCoordinatingMessage", gkFuncRefGet, result);

  snprintf(newPath, elcount(newPath), "%s.%s", oldPath, "yaw");
  C2xSetTokenInt(packetHandle, "ManeuverSharingAndCoordinatingMessage", newPath, value.yaw);
  result = CheckLastError("ManeuverSharingAndCoordinatingMessage", gkFuncRefGet, result);

  return result;
}

int GetManeuverSharingAndCoordinatingMessageCommon_VehicleSizeParams(LONG packetHandle, struct ManeuverSharingAndCoordinatingMessageCommon_VehicleSize value, char oldPath[])
{
  char newPath[300];
  int result;

  result = 0;

  snprintf(newPath, elcount(newPath), "%s.%s", oldPath, "width");
  value.width = C2xGetTokenInt(packetHandle, "ManeuverSharingAndCoordinatingMessage", newPath);
  result = CheckLastError("ManeuverSharingAndCoordinatingMessage", gkFuncRefGet, result);

  snprintf(newPath, elcount(newPath), "%s.%s", oldPath, "length");
  value.length = C2xGetTokenInt(packetHandle, "ManeuverSharingAndCoordinatingMessage", newPath);
  result = CheckLastError("ManeuverSharingAndCoordinatingMessage", gkFuncRefGet, result);

  return result;
}

int SetManeuverSharingAndCoordinatingMessageCommon_VehicleSizeParams(LONG packetHandle, struct ManeuverSharingAndCoordinatingMessageCommon_VehicleSize value, char oldPath[])
{
  char newPath[300];
  int result;

  result = 0;

  snprintf(newPath, elcount(newPath), "%s.%s", oldPath, "width");
  C2xSetTokenInt(packetHandle, "ManeuverSharingAndCoordinatingMessage", newPath, value.width);
  result = CheckLastError("ManeuverSharingAndCoordinatingMessage", gkFuncRefGet, result);

  snprintf(newPath, elcount(newPath), "%s.%s", oldPath, "length");
  C2xSetTokenInt(packetHandle, "ManeuverSharingAndCoordinatingMessage", newPath, value.length);
  result = CheckLastError("ManeuverSharingAndCoordinatingMessage", gkFuncRefGet, result);

  return result;
}

int GetManeuverSharingAndCoordinatingMessageCurrentStateDataParams(LONG packetHandle, struct ManeuverSharingAndCoordinatingMessageCurrentStateData value, char oldPath[])
{
  char newPath[300];
  int result;

  result = 0;

  snprintf(newPath, elcount(newPath), "%s.%s", oldPath, "executantVehPos");
  value.executantVehPos.isValidFlag = C2xIsTokenAvailable(packetHandle, "ManeuverSharingAndCoordinatingMessage", newPath);
  if(value.executantVehPos.isValidFlag==1)
  {
    GetManeuverSharingAndCoordinatingMessagePositionOffsetXYZParams(packetHandle, value.executantVehPos, newPath);
    result = CheckLastError("ManeuverSharingAndCoordinatingMessage", gkFuncRefGet, result);
  }
  snprintf(newPath, elcount(newPath), "%s.%s", oldPath, "executantVehPosConfidence");
  value.executantVehPosConfidence.isValidFlag = C2xIsTokenAvailable(packetHandle, "ManeuverSharingAndCoordinatingMessage", newPath);
  if(value.executantVehPosConfidence.isValidFlag==1)
  {
    GetManeuverSharingAndCoordinatingMessageCommon_PositionConfidenceSetParams(packetHandle, value.executantVehPosConfidence, newPath);
    result = CheckLastError("ManeuverSharingAndCoordinatingMessage", gkFuncRefGet, result);
  }
  snprintf(newPath, elcount(newPath), "%s.%s", oldPath, "speed");
  value.speed = C2xGetTokenInt(packetHandle, "ManeuverSharingAndCoordinatingMessage", newPath);
  result = CheckLastError("ManeuverSharingAndCoordinatingMessage", gkFuncRefGet, result);

  snprintf(newPath, elcount(newPath), "%s.%s", oldPath, "heading");
  value.heading = C2xGetTokenInt(packetHandle, "ManeuverSharingAndCoordinatingMessage", newPath);
  result = CheckLastError("ManeuverSharingAndCoordinatingMessage", gkFuncRefGet, result);

  snprintf(newPath, elcount(newPath), "%s.%s", oldPath, "accel4way");
  value.accel4way.isValidFlag = C2xIsTokenAvailable(packetHandle, "ManeuverSharingAndCoordinatingMessage", newPath);
  if(value.accel4way.isValidFlag==1)
  {
    GetManeuverSharingAndCoordinatingMessageCommon_AccelerationSet4WayParams(packetHandle, value.accel4way, newPath);
    result = CheckLastError("ManeuverSharingAndCoordinatingMessage", gkFuncRefGet, result);
  }
  snprintf(newPath, elcount(newPath), "%s.%s", oldPath, "size");
  GetManeuverSharingAndCoordinatingMessageCommon_VehicleSizeParams(packetHandle, value.size, newPath);
  result = CheckLastError("ManeuverSharingAndCoordinatingMessage", gkFuncRefGet, result);

  return result;
}

int SetManeuverSharingAndCoordinatingMessageCurrentStateDataParams(LONG packetHandle, struct ManeuverSharingAndCoordinatingMessageCurrentStateData value, char oldPath[])
{
  char newPath[300];
  int result;

  result = 0;

  snprintf(newPath, elcount(newPath), "%s.%s", oldPath, "executantVehPos");
  if(value.executantVehPos.isValidFlag==1)
  {
    SetManeuverSharingAndCoordinatingMessagePositionOffsetXYZParams(packetHandle, value.executantVehPos, newPath);
    result = CheckLastError("ManeuverSharingAndCoordinatingMessage", gkFuncRefGet, result);
  }
  else
  {
    if( C2xIsTokenAvailable(packetHandle, "ManeuverSharingAndCoordinatingMessage", newPath) )
    {
      C2xRemoveToken(packetHandle, "ManeuverSharingAndCoordinatingMessage", newPath);
    }
  }

  snprintf(newPath, elcount(newPath), "%s.%s", oldPath, "executantVehPosConfidence");
  if(value.executantVehPosConfidence.isValidFlag==1)
  {
    SetManeuverSharingAndCoordinatingMessageCommon_PositionConfidenceSetParams(packetHandle, value.executantVehPosConfidence, newPath);
    result = CheckLastError("ManeuverSharingAndCoordinatingMessage", gkFuncRefGet, result);
  }
  else
  {
    if( C2xIsTokenAvailable(packetHandle, "ManeuverSharingAndCoordinatingMessage", newPath) )
    {
      C2xRemoveToken(packetHandle, "ManeuverSharingAndCoordinatingMessage", newPath);
    }
  }

  snprintf(newPath, elcount(newPath), "%s.%s", oldPath, "speed");
  C2xSetTokenInt(packetHandle, "ManeuverSharingAndCoordinatingMessage", newPath, value.speed);
  result = CheckLastError("ManeuverSharingAndCoordinatingMessage", gkFuncRefGet, result);

  snprintf(newPath, elcount(newPath), "%s.%s", oldPath, "heading");
  C2xSetTokenInt(packetHandle, "ManeuverSharingAndCoordinatingMessage", newPath, value.heading);
  result = CheckLastError("ManeuverSharingAndCoordinatingMessage", gkFuncRefGet, result);

  snprintf(newPath, elcount(newPath), "%s.%s", oldPath, "accel4way");
  if(value.accel4way.isValidFlag==1)
  {
    SetManeuverSharingAndCoordinatingMessageCommon_AccelerationSet4WayParams(packetHandle, value.accel4way, newPath);
    result = CheckLastError("ManeuverSharingAndCoordinatingMessage", gkFuncRefGet, result);
  }
  else
  {
    if( C2xIsTokenAvailable(packetHandle, "ManeuverSharingAndCoordinatingMessage", newPath) )
    {
      C2xRemoveToken(packetHandle, "ManeuverSharingAndCoordinatingMessage", newPath);
    }
  }

  snprintf(newPath, elcount(newPath), "%s.%s", oldPath, "size");
  SetManeuverSharingAndCoordinatingMessageCommon_VehicleSizeParams(packetHandle, value.size, newPath);
  result = CheckLastError("ManeuverSharingAndCoordinatingMessage", gkFuncRefGet, result);

  return result;
}

int GetManeuverSharingAndCoordinatingMessageTRRLocationType1Params(LONG packetHandle, struct ManeuverSharingAndCoordinatingMessageTRRLocationType1 value, char oldPath[])
{
  char newPath[300];
  int result;

  result = 0;

  snprintf(newPath, elcount(newPath), "%s.%s", oldPath, "tRRLength");
  value.tRRLength = C2xGetTokenInt(packetHandle, "ManeuverSharingAndCoordinatingMessage", newPath);
  result = CheckLastError("ManeuverSharingAndCoordinatingMessage", gkFuncRefGet, result);

  snprintf(newPath, elcount(newPath), "%s.%s", oldPath, "frontSidePosition");
  GetManeuverSharingAndCoordinatingMessagePositionOffsetXYZParams(packetHandle, value.frontSidePosition, newPath);
  result = CheckLastError("ManeuverSharingAndCoordinatingMessage", gkFuncRefGet, result);

  snprintf(newPath, elcount(newPath), "%s.%s", oldPath, "laneOffset");
  value.laneOffset = C2xGetTokenInt(packetHandle, "ManeuverSharingAndCoordinatingMessage", newPath);
  result = CheckLastError("ManeuverSharingAndCoordinatingMessage", gkFuncRefGet, result);

  snprintf(newPath, elcount(newPath), "%s.%s", oldPath, "tRRMovement");
  value.tRRMovement.isValidFlag = C2xIsTokenAvailable(packetHandle, "ManeuverSharingAndCoordinatingMessage", newPath);
  if(value.tRRMovement.isValidFlag==1)
  {
    value.tRRMovement.value = C2xGetTokenInt(packetHandle, "ManeuverSharingAndCoordinatingMessage", newPath);
    result = CheckLastError("ManeuverSharingAndCoordinatingMessage", gkFuncRefGet, result);
  }
  return result;
}

int SetManeuverSharingAndCoordinatingMessageTRRLocationType1Params(LONG packetHandle, struct ManeuverSharingAndCoordinatingMessageTRRLocationType1 value, char oldPath[])
{
  char newPath[300];
  int result;

  result = 0;

  snprintf(newPath, elcount(newPath), "%s.%s", oldPath, "tRRLength");
  C2xSetTokenInt(packetHandle, "ManeuverSharingAndCoordinatingMessage", newPath, value.tRRLength);
  result = CheckLastError("ManeuverSharingAndCoordinatingMessage", gkFuncRefGet, result);

  snprintf(newPath, elcount(newPath), "%s.%s", oldPath, "frontSidePosition");
  SetManeuverSharingAndCoordinatingMessagePositionOffsetXYZParams(packetHandle, value.frontSidePosition, newPath);
  result = CheckLastError("ManeuverSharingAndCoordinatingMessage", gkFuncRefGet, result);

  snprintf(newPath, elcount(newPath), "%s.%s", oldPath, "laneOffset");
  C2xSetTokenInt(packetHandle, "ManeuverSharingAndCoordinatingMessage", newPath, value.laneOffset);
  result = CheckLastError("ManeuverSharingAndCoordinatingMessage", gkFuncRefGet, result);

  snprintf(newPath, elcount(newPath), "%s.%s", oldPath, "tRRMovement");
  if(value.tRRMovement.isValidFlag==1)
  {
    C2xSetTokenInt(packetHandle, "ManeuverSharingAndCoordinatingMessage", newPath, value.tRRMovement.value);
    result = CheckLastError("ManeuverSharingAndCoordinatingMessage", gkFuncRefGet, result);
  }
  else
  {
    if( C2xIsTokenAvailable(packetHandle, "ManeuverSharingAndCoordinatingMessage", newPath) )
    {
      C2xRemoveToken(packetHandle, "ManeuverSharingAndCoordinatingMessage", newPath);
    }
  }

  return result;
}

int GetManeuverSharingAndCoordinatingMessageSurroundingVehicleInfoParams(LONG packetHandle, struct ManeuverSharingAndCoordinatingMessageSurroundingVehicleInfo value, char oldPath[])
{
  char newPath[300];
  char buffer[300];
  int result;

  result = 0;

  snprintf(newPath, elcount(newPath), "%s.%s", oldPath, "surroundingVehicleID");
  value.surroundingVehicleID.stringLength = C2xGetTokenData(packetHandle, "ManeuverSharingAndCoordinatingMessage", newPath, elcount(value.surroundingVehicleID.string), value.surroundingVehicleID.string);
  snprintf(newPath, elcount(newPath), "%s.%s", oldPath, "surroundingVehiclePosition");
  GetManeuverSharingAndCoordinatingMessagePositionOffsetXYZParams(packetHandle, value.surroundingVehiclePosition, newPath);
  result = CheckLastError("ManeuverSharingAndCoordinatingMessage", gkFuncRefGet, result);

  snprintf(newPath, elcount(newPath), "%s.%s", oldPath, "surroundingVehicleSize");
  GetManeuverSharingAndCoordinatingMessageCommon_VehicleSizeParams(packetHandle, value.surroundingVehicleSize, newPath);
  result = CheckLastError("ManeuverSharingAndCoordinatingMessage", gkFuncRefGet, result);

  return result;
}

int SetManeuverSharingAndCoordinatingMessageSurroundingVehicleInfoParams(LONG packetHandle, struct ManeuverSharingAndCoordinatingMessageSurroundingVehicleInfo value, char oldPath[])
{
  char newPath[300];
  char buffer[300];
  int result;

  result = 0;

  snprintf(newPath, elcount(newPath), "%s.%s", oldPath, "surroundingVehicleID");
  C2xSetTokenData(packetHandle, "ManeuverSharingAndCoordinatingMessage", newPath, value.surroundingVehicleID.stringLength, value.surroundingVehicleID.string);

  snprintf(newPath, elcount(newPath), "%s.%s", oldPath, "surroundingVehiclePosition");
  SetManeuverSharingAndCoordinatingMessagePositionOffsetXYZParams(packetHandle, value.surroundingVehiclePosition, newPath);
  result = CheckLastError("ManeuverSharingAndCoordinatingMessage", gkFuncRefGet, result);

  snprintf(newPath, elcount(newPath), "%s.%s", oldPath, "surroundingVehicleSize");
  SetManeuverSharingAndCoordinatingMessageCommon_VehicleSizeParams(packetHandle, value.surroundingVehicleSize, newPath);
  result = CheckLastError("ManeuverSharingAndCoordinatingMessage", gkFuncRefGet, result);

  return result;
}

int GetManeuverSharingAndCoordinatingMessageTRRLocationType2Params(LONG packetHandle, struct ManeuverSharingAndCoordinatingMessageTRRLocationType2 value, char oldPath[])
{
  char newPath[300];
  int result;

  result = 0;

  snprintf(newPath, elcount(newPath), "%s.%s", oldPath, "safetyGap");
  value.safetyGap = C2xGetTokenInt(packetHandle, "ManeuverSharingAndCoordinatingMessage", newPath);
  result = CheckLastError("ManeuverSharingAndCoordinatingMessage", gkFuncRefGet, result);

  snprintf(newPath, elcount(newPath), "%s.%s", oldPath, "frontSideVehicle");
  value.frontSideVehicle.isValidFlag = C2xIsTokenAvailable(packetHandle, "ManeuverSharingAndCoordinatingMessage", newPath);
  if(value.frontSideVehicle.isValidFlag==1)
  {
    GetManeuverSharingAndCoordinatingMessageSurroundingVehicleInfoParams(packetHandle, value.frontSideVehicle, newPath);
    result = CheckLastError("ManeuverSharingAndCoordinatingMessage", gkFuncRefGet, result);
  }
  snprintf(newPath, elcount(newPath), "%s.%s", oldPath, "rearSideVehicle");
  value.rearSideVehicle.isValidFlag = C2xIsTokenAvailable(packetHandle, "ManeuverSharingAndCoordinatingMessage", newPath);
  if(value.rearSideVehicle.isValidFlag==1)
  {
    GetManeuverSharingAndCoordinatingMessageSurroundingVehicleInfoParams(packetHandle, value.rearSideVehicle, newPath);
    result = CheckLastError("ManeuverSharingAndCoordinatingMessage", gkFuncRefGet, result);
  }
  snprintf(newPath, elcount(newPath), "%s.%s", oldPath, "tRRLength");
  value.tRRLength.isValidFlag = C2xIsTokenAvailable(packetHandle, "ManeuverSharingAndCoordinatingMessage", newPath);
  if(value.tRRLength.isValidFlag==1)
  {
    value.tRRLength.value = C2xGetTokenInt(packetHandle, "ManeuverSharingAndCoordinatingMessage", newPath);
    result = CheckLastError("ManeuverSharingAndCoordinatingMessage", gkFuncRefGet, result);
  }
  snprintf(newPath, elcount(newPath), "%s.%s", oldPath, "laneOffset");
  value.laneOffset = C2xGetTokenInt(packetHandle, "ManeuverSharingAndCoordinatingMessage", newPath);
  result = CheckLastError("ManeuverSharingAndCoordinatingMessage", gkFuncRefGet, result);

  return result;
}

int SetManeuverSharingAndCoordinatingMessageTRRLocationType2Params(LONG packetHandle, struct ManeuverSharingAndCoordinatingMessageTRRLocationType2 value, char oldPath[])
{
  char newPath[300];
  int result;

  result = 0;

  snprintf(newPath, elcount(newPath), "%s.%s", oldPath, "safetyGap");
  C2xSetTokenInt(packetHandle, "ManeuverSharingAndCoordinatingMessage", newPath, value.safetyGap);
  result = CheckLastError("ManeuverSharingAndCoordinatingMessage", gkFuncRefGet, result);

  snprintf(newPath, elcount(newPath), "%s.%s", oldPath, "frontSideVehicle");
  if(value.frontSideVehicle.isValidFlag==1)
  {
    SetManeuverSharingAndCoordinatingMessageSurroundingVehicleInfoParams(packetHandle, value.frontSideVehicle, newPath);
    result = CheckLastError("ManeuverSharingAndCoordinatingMessage", gkFuncRefGet, result);
  }
  else
  {
    if( C2xIsTokenAvailable(packetHandle, "ManeuverSharingAndCoordinatingMessage", newPath) )
    {
      C2xRemoveToken(packetHandle, "ManeuverSharingAndCoordinatingMessage", newPath);
    }
  }

  snprintf(newPath, elcount(newPath), "%s.%s", oldPath, "rearSideVehicle");
  if(value.rearSideVehicle.isValidFlag==1)
  {
    SetManeuverSharingAndCoordinatingMessageSurroundingVehicleInfoParams(packetHandle, value.rearSideVehicle, newPath);
    result = CheckLastError("ManeuverSharingAndCoordinatingMessage", gkFuncRefGet, result);
  }
  else
  {
    if( C2xIsTokenAvailable(packetHandle, "ManeuverSharingAndCoordinatingMessage", newPath) )
    {
      C2xRemoveToken(packetHandle, "ManeuverSharingAndCoordinatingMessage", newPath);
    }
  }

  snprintf(newPath, elcount(newPath), "%s.%s", oldPath, "tRRLength");
  if(value.tRRLength.isValidFlag==1)
  {
    C2xSetTokenInt(packetHandle, "ManeuverSharingAndCoordinatingMessage", newPath, value.tRRLength.value);
    result = CheckLastError("ManeuverSharingAndCoordinatingMessage", gkFuncRefGet, result);
  }
  else
  {
    if( C2xIsTokenAvailable(packetHandle, "ManeuverSharingAndCoordinatingMessage", newPath) )
    {
      C2xRemoveToken(packetHandle, "ManeuverSharingAndCoordinatingMessage", newPath);
    }
  }

  snprintf(newPath, elcount(newPath), "%s.%s", oldPath, "laneOffset");
  C2xSetTokenInt(packetHandle, "ManeuverSharingAndCoordinatingMessage", newPath, value.laneOffset);
  result = CheckLastError("ManeuverSharingAndCoordinatingMessage", gkFuncRefGet, result);

  return result;
}

int GetManeuverSharingAndCoordinatingMessageTRRLocationType3Params(LONG packetHandle, struct ManeuverSharingAndCoordinatingMessageTRRLocationType3 value, char oldPath[])
{
  char newPath[300]; 
  int i;
  int result;

  result = 0;

  value.length = C2xGetTokenInt(packetHandle, "ManeuverSharingAndCoordinatingMessage", oldPath);
  if((result = CheckLastError("ManeuverSharingAndCoordinatingMessage", gkFuncRefGet, result))==0)
  {
    for(i=0; i<value.length; i++)
    {
      snprintf(newPath, elcount(newPath), "%s[%d]", oldPath, i);
      GetManeuverSharingAndCoordinatingMessagePositionOffsetXYZParams(packetHandle, value.arrayValue[i], newPath);
      result = CheckLastError("ManeuverSharingAndCoordinatingMessage", gkFuncRefGet, result);
    }
  }
  return result;
}

int SetManeuverSharingAndCoordinatingMessageTRRLocationType3Params(LONG packetHandle, struct ManeuverSharingAndCoordinatingMessageTRRLocationType3 value, char oldPath[])
{
  char newPath[300]; 
  int i;
  int result;

  result = 0;

  C2xRemoveToken(packetHandle, "ManeuverSharingAndCoordinatingMessage", oldPath);
  for(i=0; i<value.length; i++)
  {
    snprintf(newPath, elcount(newPath), "%s[%d]", oldPath, i);
    SetManeuverSharingAndCoordinatingMessagePositionOffsetXYZParams(packetHandle, value.arrayValue[i], newPath);
    result = CheckLastError("ManeuverSharingAndCoordinatingMessage", gkFuncRefGet, result);
  }
  return result;
}

int GetManeuverSharingAndCoordinatingMessageTRRLocationParams(LONG packetHandle, struct ManeuverSharingAndCoordinatingMessageTRRLocation value, char oldPath[])
{
  char newPath[300];
  int result;

  result = 0;

  value.choice = C2xGetTokenInt(packetHandle, "ManeuverSharingAndCoordinatingMessage", oldPath);

  switch(value.choice)
  {
    case 0:
    {
      snprintf(newPath, elcount(newPath), "%s.%s", oldPath, "tRRLocationType1");
      GetManeuverSharingAndCoordinatingMessageTRRLocationType1Params(packetHandle, value.tRRLocationType1, newPath);
      result = CheckLastError("ManeuverSharingAndCoordinatingMessage", gkFuncRefGet, result);
    }
    break;
    case 1:
    {
      snprintf(newPath, elcount(newPath), "%s.%s", oldPath, "tRRLocationType2");
      GetManeuverSharingAndCoordinatingMessageTRRLocationType2Params(packetHandle, value.tRRLocationType2, newPath);
      result = CheckLastError("ManeuverSharingAndCoordinatingMessage", gkFuncRefGet, result);
    }
    break;
    case 2:
    {
      snprintf(newPath, elcount(newPath), "%s.%s", oldPath, "tRRLocationType3");
      GetManeuverSharingAndCoordinatingMessageTRRLocationType3Params(packetHandle, value.tRRLocationType3, newPath);
      result = CheckLastError("ManeuverSharingAndCoordinatingMessage", gkFuncRefGet, result);
    }
    break;
  }
  return result;
}

int SetManeuverSharingAndCoordinatingMessageTRRLocationParams(LONG packetHandle, struct ManeuverSharingAndCoordinatingMessageTRRLocation value, char oldPath[])
{
  char newPath[300];
  int result;

  result = 0;

  switch(value.choice)
  {
    case 0:
    {
      snprintf(newPath, elcount(newPath), "%s.%s", oldPath, "tRRLocationType1");
      SetManeuverSharingAndCoordinatingMessageTRRLocationType1Params(packetHandle, value.tRRLocationType1, newPath);
      result = CheckLastError("ManeuverSharingAndCoordinatingMessage", gkFuncRefGet, result);
    }
    break;
    case 1:
    {
      snprintf(newPath, elcount(newPath), "%s.%s", oldPath, "tRRLocationType2");
      SetManeuverSharingAndCoordinatingMessageTRRLocationType2Params(packetHandle, value.tRRLocationType2, newPath);
      result = CheckLastError("ManeuverSharingAndCoordinatingMessage", gkFuncRefGet, result);
    }
    break;
    case 2:
    {
      snprintf(newPath, elcount(newPath), "%s.%s", oldPath, "tRRLocationType3");
      SetManeuverSharingAndCoordinatingMessageTRRLocationType3Params(packetHandle, value.tRRLocationType3, newPath);
      result = CheckLastError("ManeuverSharingAndCoordinatingMessage", gkFuncRefGet, result);
    }
    break;
  }
  return result;
}

int GetManeuverSharingAndCoordinatingMessageTargetRoadResourceParams(LONG packetHandle, struct ManeuverSharingAndCoordinatingMessageTargetRoadResource value, char oldPath[])
{
  char newPath[300];
  int result;

  result = 0;

  snprintf(newPath, elcount(newPath), "%s.%s", oldPath, "tRRType");
  value.tRRType = C2xGetTokenInt(packetHandle, "ManeuverSharingAndCoordinatingMessage", newPath);
  result = CheckLastError("ManeuverSharingAndCoordinatingMessage", gkFuncRefGet, result);

  snprintf(newPath, elcount(newPath), "%s.%s", oldPath, "tRRLocation");
  GetManeuverSharingAndCoordinatingMessageTRRLocationParams(packetHandle, value.tRRLocation, newPath);
  result = CheckLastError("ManeuverSharingAndCoordinatingMessage", gkFuncRefGet, result);

  return result;
}

int SetManeuverSharingAndCoordinatingMessageTargetRoadResourceParams(LONG packetHandle, struct ManeuverSharingAndCoordinatingMessageTargetRoadResource value, char oldPath[])
{
  char newPath[300];
  int result;

  result = 0;

  snprintf(newPath, elcount(newPath), "%s.%s", oldPath, "tRRType");
  C2xSetTokenInt(packetHandle, "ManeuverSharingAndCoordinatingMessage", newPath, value.tRRType);
  result = CheckLastError("ManeuverSharingAndCoordinatingMessage", gkFuncRefGet, result);

  snprintf(newPath, elcount(newPath), "%s.%s", oldPath, "tRRLocation");
  SetManeuverSharingAndCoordinatingMessageTRRLocationParams(packetHandle, value.tRRLocation, newPath);
  result = CheckLastError("ManeuverSharingAndCoordinatingMessage", gkFuncRefGet, result);

  return result;
}

int GetManeuverSharingAndCoordinatingMessageSubManeuverParams(LONG packetHandle, struct ManeuverSharingAndCoordinatingMessageSubManeuver value, char oldPath[])
{
  char newPath[300]; 
  int j; 
  int k;
  char buffer[300];
  int result;

  result = 0;

  snprintf(newPath, elcount(newPath), "%s.%s", oldPath, "executantVehID");
  value.executantVehID.stringLength = C2xGetTokenData(packetHandle, "ManeuverSharingAndCoordinatingMessage", newPath, elcount(value.executantVehID.string), value.executantVehID.string);
  snprintf(newPath, elcount(newPath), "%s.%s", oldPath, "affectedVehIDs");
  value.affectedVehIDs.isValidFlag = 1;
  value.affectedVehIDs.stringLength = C2xGetTokenLengthBit(packetHandle, "ManeuverSharingAndCoordinatingMessage", newPath);
  if ((result = CheckLastError("ManeuverSharingAndCoordinatingMessage", gkFuncRefGet, result))==0)
  {
    if(value.affectedVehIDs.stringLength > 0)
    {
      for(j=0; j<value.affectedVehIDs.stringLength; j++)
      {
        if(C2xGetTokenBitOfBitString(packetHandle, "ManeuverSharingAndCoordinatingMessage", newPath, j) == 0)
        {
          value.affectedVehIDs.string[j] = '0';
        }
        else if(C2xGetTokenBitOfBitString(packetHandle, "ManeuverSharingAndCoordinatingMessage", newPath, j) == 1)
        {
          value.affectedVehIDs.string[j] = '1';
        }

        if(value.affectedVehIDs.stringLength == 1)
        {
          value.affectedVehIDs.string[1] = '0';
        }
        result = CheckLastError("ManeuverSharingAndCoordinatingMessage", gkFuncRefGet, result);
      }
    }
    else
    {
      for(k = value.affectedVehIDs.stringLength+1; k > -1; k--)
      {
        if(value.affectedVehIDs.string[k] == '1')
        {
          value.affectedVehIDs.string[k] = '0';
        }
      }
    }
  }

  snprintf(newPath, elcount(newPath), "%s.%s", oldPath, "currentStateData");
  GetManeuverSharingAndCoordinatingMessageCurrentStateDataParams(packetHandle, value.currentStateData, newPath);
  result = CheckLastError("ManeuverSharingAndCoordinatingMessage", gkFuncRefGet, result);

  snprintf(newPath, elcount(newPath), "%s.%s", oldPath, "targetRoadResource");
  value.targetRoadResource.isValidFlag = C2xIsTokenAvailable(packetHandle, "ManeuverSharingAndCoordinatingMessage", newPath);
  if(value.targetRoadResource.isValidFlag==1)
  {
    GetManeuverSharingAndCoordinatingMessageTargetRoadResourceParams(packetHandle, value.targetRoadResource, newPath);
    result = CheckLastError("ManeuverSharingAndCoordinatingMessage", gkFuncRefGet, result);
  }
  snprintf(newPath, elcount(newPath), "%s.%s", oldPath, "startTime");
  GetManeuverSharingAndCoordinatingMessageCommon_DDateTimeParams(packetHandle, value.startTime, newPath);
  result = CheckLastError("ManeuverSharingAndCoordinatingMessage", gkFuncRefGet, result);

  snprintf(newPath, elcount(newPath), "%s.%s", oldPath, "endTime");
  GetManeuverSharingAndCoordinatingMessageCommon_DDateTimeParams(packetHandle, value.endTime, newPath);
  result = CheckLastError("ManeuverSharingAndCoordinatingMessage", gkFuncRefGet, result);

  snprintf(newPath, elcount(newPath), "%s.%s", oldPath, "minSpeed");
  value.minSpeed.isValidFlag = C2xIsTokenAvailable(packetHandle, "ManeuverSharingAndCoordinatingMessage", newPath);
  if(value.minSpeed.isValidFlag==1)
  {
    value.minSpeed.value = C2xGetTokenInt(packetHandle, "ManeuverSharingAndCoordinatingMessage", newPath);
    result = CheckLastError("ManeuverSharingAndCoordinatingMessage", gkFuncRefGet, result);
  }
  snprintf(newPath, elcount(newPath), "%s.%s", oldPath, "maxSpeed");
  value.maxSpeed.isValidFlag = C2xIsTokenAvailable(packetHandle, "ManeuverSharingAndCoordinatingMessage", newPath);
  if(value.maxSpeed.isValidFlag==1)
  {
    value.maxSpeed.value = C2xGetTokenInt(packetHandle, "ManeuverSharingAndCoordinatingMessage", newPath);
    result = CheckLastError("ManeuverSharingAndCoordinatingMessage", gkFuncRefGet, result);
  }
  return result;
}

int SetManeuverSharingAndCoordinatingMessageSubManeuverParams(LONG packetHandle, struct ManeuverSharingAndCoordinatingMessageSubManeuver value, char oldPath[])
{
  char newPath[300]; 
  int j;
  char buffer[300];
  int result;

  result = 0;

  snprintf(newPath, elcount(newPath), "%s.%s", oldPath, "executantVehID");
  C2xSetTokenData(packetHandle, "ManeuverSharingAndCoordinatingMessage", newPath, value.executantVehID.stringLength, value.executantVehID.string);

  snprintf(newPath, elcount(newPath), "%s.%s", oldPath, "affectedVehIDs");
    for(j=0; j<value.affectedVehIDs.stringLength; j++)
    {
      if(value.affectedVehIDs.string[j] == '0')
      {
        C2xSetTokenBitOfBitString(packetHandle, "ManeuverSharingAndCoordinatingMessage", newPath, j, 0);
      }
      else
      {
        C2xSetTokenBitOfBitString(packetHandle, "ManeuverSharingAndCoordinatingMessage", newPath, j, 1);
      }
      result = CheckLastError("ManeuverSharingAndCoordinatingMessage", gkFuncRefGet, result);
    }

  snprintf(newPath, elcount(newPath), "%s.%s", oldPath, "currentStateData");
  SetManeuverSharingAndCoordinatingMessageCurrentStateDataParams(packetHandle, value.currentStateData, newPath);
  result = CheckLastError("ManeuverSharingAndCoordinatingMessage", gkFuncRefGet, result);

  snprintf(newPath, elcount(newPath), "%s.%s", oldPath, "targetRoadResource");
  if(value.targetRoadResource.isValidFlag==1)
  {
    SetManeuverSharingAndCoordinatingMessageTargetRoadResourceParams(packetHandle, value.targetRoadResource, newPath);
    result = CheckLastError("ManeuverSharingAndCoordinatingMessage", gkFuncRefGet, result);
  }
  else
  {
    if( C2xIsTokenAvailable(packetHandle, "ManeuverSharingAndCoordinatingMessage", newPath) )
    {
      C2xRemoveToken(packetHandle, "ManeuverSharingAndCoordinatingMessage", newPath);
    }
  }

  snprintf(newPath, elcount(newPath), "%s.%s", oldPath, "startTime");
  SetManeuverSharingAndCoordinatingMessageCommon_DDateTimeParams(packetHandle, value.startTime, newPath);
  result = CheckLastError("ManeuverSharingAndCoordinatingMessage", gkFuncRefGet, result);

  snprintf(newPath, elcount(newPath), "%s.%s", oldPath, "endTime");
  SetManeuverSharingAndCoordinatingMessageCommon_DDateTimeParams(packetHandle, value.endTime, newPath);
  result = CheckLastError("ManeuverSharingAndCoordinatingMessage", gkFuncRefGet, result);

  snprintf(newPath, elcount(newPath), "%s.%s", oldPath, "minSpeed");
  if(value.minSpeed.isValidFlag==1)
  {
    C2xSetTokenInt(packetHandle, "ManeuverSharingAndCoordinatingMessage", newPath, value.minSpeed.value);
    result = CheckLastError("ManeuverSharingAndCoordinatingMessage", gkFuncRefGet, result);
  }
  else
  {
    if( C2xIsTokenAvailable(packetHandle, "ManeuverSharingAndCoordinatingMessage", newPath) )
    {
      C2xRemoveToken(packetHandle, "ManeuverSharingAndCoordinatingMessage", newPath);
    }
  }

  snprintf(newPath, elcount(newPath), "%s.%s", oldPath, "maxSpeed");
  if(value.maxSpeed.isValidFlag==1)
  {
    C2xSetTokenInt(packetHandle, "ManeuverSharingAndCoordinatingMessage", newPath, value.maxSpeed.value);
    result = CheckLastError("ManeuverSharingAndCoordinatingMessage", gkFuncRefGet, result);
  }
  else
  {
    if( C2xIsTokenAvailable(packetHandle, "ManeuverSharingAndCoordinatingMessage", newPath) )
    {
      C2xRemoveToken(packetHandle, "ManeuverSharingAndCoordinatingMessage", newPath);
    }
  }

  return result;
}

int GetManeuverSharingAndCoordinatingMessageSubManeuverListParams(LONG packetHandle, struct ManeuverSharingAndCoordinatingMessageSubManeuverList value, char oldPath[])
{
  char newPath[300]; 
  int i;
  int result;

  result = 0;

  value.length = C2xGetTokenInt(packetHandle, "ManeuverSharingAndCoordinatingMessage", oldPath);
  if((result = CheckLastError("ManeuverSharingAndCoordinatingMessage", gkFuncRefGet, result))==0)
  {
    for(i=0; i<value.length; i++)
    {
      snprintf(newPath, elcount(newPath), "%s[%d]", oldPath, i);
      GetManeuverSharingAndCoordinatingMessageSubManeuverParams(packetHandle, value.arrayValue[i], newPath);
      result = CheckLastError("ManeuverSharingAndCoordinatingMessage", gkFuncRefGet, result);
    }
  }
  return result;
}

int SetManeuverSharingAndCoordinatingMessageSubManeuverListParams(LONG packetHandle, struct ManeuverSharingAndCoordinatingMessageSubManeuverList value, char oldPath[])
{
  char newPath[300]; 
  int i;
  int result;

  result = 0;

  C2xRemoveToken(packetHandle, "ManeuverSharingAndCoordinatingMessage", oldPath);
  for(i=0; i<value.length; i++)
  {
    snprintf(newPath, elcount(newPath), "%s[%d]", oldPath, i);
    SetManeuverSharingAndCoordinatingMessageSubManeuverParams(packetHandle, value.arrayValue[i], newPath);
    result = CheckLastError("ManeuverSharingAndCoordinatingMessage", gkFuncRefGet, result);
  }
  return result;
}

int GetManeuverSharingAndCoordinatingMessageManeuverParams(LONG packetHandle, struct ManeuverSharingAndCoordinatingMessageManeuver value, char oldPath[])
{
  char newPath[300];
  int result;

  result = 0;

  snprintf(newPath, elcount(newPath), "%s.%s", oldPath, "subManeuverList");
  GetManeuverSharingAndCoordinatingMessageSubManeuverListParams(packetHandle, value.subManeuverList, newPath);
  result = CheckLastError("ManeuverSharingAndCoordinatingMessage", gkFuncRefGet, result);

  return result;
}

int SetManeuverSharingAndCoordinatingMessageManeuverParams(LONG packetHandle, struct ManeuverSharingAndCoordinatingMessageManeuver value, char oldPath[])
{
  char newPath[300];
  int result;

  result = 0;

  snprintf(newPath, elcount(newPath), "%s.%s", oldPath, "subManeuverList");
  SetManeuverSharingAndCoordinatingMessageSubManeuverListParams(packetHandle, value.subManeuverList, newPath);
  result = CheckLastError("ManeuverSharingAndCoordinatingMessage", gkFuncRefGet, result);

  return result;
}

int GetManeuverSharingAndCoordinatingMessage_ManeuverSharingAndCoordinatingMessageParams(LONG packetHandle, struct ManeuverSharingAndCoordinatingMessage_ManeuverSharingAndCoordinatingMessage value, char oldPath[])
{
  char newPath[300];
  int result;

  result = 0;

  snprintf(newPath, elcount(newPath), "%s.%s", oldPath, "mSCMTimestamp");
  GetManeuverSharingAndCoordinatingMessageCommon_DDateTimeParams(packetHandle, value.mSCMTimestamp, newPath);
  result = CheckLastError("ManeuverSharingAndCoordinatingMessage", gkFuncRefGet, result);

  snprintf(newPath, elcount(newPath), "%s.%s", oldPath, "hVPos");
  value.hVPos.isValidFlag = C2xIsTokenAvailable(packetHandle, "ManeuverSharingAndCoordinatingMessage", newPath);
  if(value.hVPos.isValidFlag==1)
  {
    GetManeuverSharingAndCoordinatingMessageCommon_Position3DParams(packetHandle, value.hVPos, newPath);
    result = CheckLastError("ManeuverSharingAndCoordinatingMessage", gkFuncRefGet, result);
  }
  snprintf(newPath, elcount(newPath), "%s.%s", oldPath, "hVPosXYConf");
  value.hVPosXYConf.isValidFlag = C2xIsTokenAvailable(packetHandle, "ManeuverSharingAndCoordinatingMessage", newPath);
  if(value.hVPosXYConf.isValidFlag==1)
  {
    GetManeuverSharingAndCoordinatingMessageCommon_PositionalAccuracyParams(packetHandle, value.hVPosXYConf, newPath);
    result = CheckLastError("ManeuverSharingAndCoordinatingMessage", gkFuncRefGet, result);
  }
  snprintf(newPath, elcount(newPath), "%s.%s", oldPath, "mSCMType");
  value.mSCMType = C2xGetTokenInt(packetHandle, "ManeuverSharingAndCoordinatingMessage", newPath);
  result = CheckLastError("ManeuverSharingAndCoordinatingMessage", gkFuncRefGet, result);

  snprintf(newPath, elcount(newPath), "%s.%s", oldPath, "sourceID");
  value.sourceID.stringLength = C2xGetTokenData(packetHandle, "ManeuverSharingAndCoordinatingMessage", newPath, elcount(value.sourceID.string), value.sourceID.string);
  snprintf(newPath, elcount(newPath), "%s.%s", oldPath, "destinationIDs");
  value.destinationIDs.isValidFlag = C2xIsTokenAvailable(packetHandle, "ManeuverSharingAndCoordinatingMessage", newPath);
  if(value.destinationIDs.isValidFlag==1)
  {
    GetManeuverSharingAndCoordinatingMessageTemporaryIDListParams(packetHandle, value.destinationIDs, newPath);
    result = CheckLastError("ManeuverSharingAndCoordinatingMessage", gkFuncRefGet, result);
  }
  snprintf(newPath, elcount(newPath), "%s.%s", oldPath, "maneuverID");
  value.maneuverID.isValidFlag = C2xIsTokenAvailable(packetHandle, "ManeuverSharingAndCoordinatingMessage", newPath);
  if(value.maneuverID.isValidFlag==1)
  {
    value.maneuverID.value = C2xGetTokenInt(packetHandle, "ManeuverSharingAndCoordinatingMessage", newPath);
    result = CheckLastError("ManeuverSharingAndCoordinatingMessage", gkFuncRefGet, result);
  }
  snprintf(newPath, elcount(newPath), "%s.%s", oldPath, "maneuver");
  value.maneuver.isValidFlag = C2xIsTokenAvailable(packetHandle, "ManeuverSharingAndCoordinatingMessage", newPath);
  if(value.maneuver.isValidFlag==1)
  {
    GetManeuverSharingAndCoordinatingMessageManeuverParams(packetHandle, value.maneuver, newPath);
    result = CheckLastError("ManeuverSharingAndCoordinatingMessage", gkFuncRefGet, result);
  }
  snprintf(newPath, elcount(newPath), "%s.%s", oldPath, "responseFlag");
  value.responseFlag.isValidFlag = C2xIsTokenAvailable(packetHandle, "ManeuverSharingAndCoordinatingMessage", newPath);
  if(value.responseFlag.isValidFlag==1)
  {
    value.responseFlag.value = C2xGetTokenInt64(packetHandle, "ManeuverSharingAndCoordinatingMessage", newPath);
    result = CheckLastError("ManeuverSharingAndCoordinatingMessage", gkFuncRefGet, result);
  }
  snprintf(newPath, elcount(newPath), "%s.%s", oldPath, "reasonCode");
  value.reasonCode.isValidFlag = C2xIsTokenAvailable(packetHandle, "ManeuverSharingAndCoordinatingMessage", newPath);
  if(value.reasonCode.isValidFlag==1)
  {
    value.reasonCode.value = C2xGetTokenInt(packetHandle, "ManeuverSharingAndCoordinatingMessage", newPath);
    result = CheckLastError("ManeuverSharingAndCoordinatingMessage", gkFuncRefGet, result);
  }
  snprintf(newPath, elcount(newPath), "%s.%s", oldPath, "maneuverExecutionStatus");
  value.maneuverExecutionStatus.isValidFlag = C2xIsTokenAvailable(packetHandle, "ManeuverSharingAndCoordinatingMessage", newPath);
  if(value.maneuverExecutionStatus.isValidFlag==1)
  {
    value.maneuverExecutionStatus.value = C2xGetTokenInt(packetHandle, "ManeuverSharingAndCoordinatingMessage", newPath);
    result = CheckLastError("ManeuverSharingAndCoordinatingMessage", gkFuncRefGet, result);
  }
  return result;
}

int SetManeuverSharingAndCoordinatingMessage_ManeuverSharingAndCoordinatingMessageParams(LONG packetHandle, struct ManeuverSharingAndCoordinatingMessage_ManeuverSharingAndCoordinatingMessage value, char oldPath[])
{
  char newPath[300];
  int result;

  result = 0;

  snprintf(newPath, elcount(newPath), "%s.%s", oldPath, "mSCMTimestamp");
  SetManeuverSharingAndCoordinatingMessageCommon_DDateTimeParams(packetHandle, value.mSCMTimestamp, newPath);
  result = CheckLastError("ManeuverSharingAndCoordinatingMessage", gkFuncRefGet, result);

  snprintf(newPath, elcount(newPath), "%s.%s", oldPath, "hVPos");
  if(value.hVPos.isValidFlag==1)
  {
    SetManeuverSharingAndCoordinatingMessageCommon_Position3DParams(packetHandle, value.hVPos, newPath);
    result = CheckLastError("ManeuverSharingAndCoordinatingMessage", gkFuncRefGet, result);
  }
  else
  {
    if( C2xIsTokenAvailable(packetHandle, "ManeuverSharingAndCoordinatingMessage", newPath) )
    {
      C2xRemoveToken(packetHandle, "ManeuverSharingAndCoordinatingMessage", newPath);
    }
  }

  snprintf(newPath, elcount(newPath), "%s.%s", oldPath, "hVPosXYConf");
  if(value.hVPosXYConf.isValidFlag==1)
  {
    SetManeuverSharingAndCoordinatingMessageCommon_PositionalAccuracyParams(packetHandle, value.hVPosXYConf, newPath);
    result = CheckLastError("ManeuverSharingAndCoordinatingMessage", gkFuncRefGet, result);
  }
  else
  {
    if( C2xIsTokenAvailable(packetHandle, "ManeuverSharingAndCoordinatingMessage", newPath) )
    {
      C2xRemoveToken(packetHandle, "ManeuverSharingAndCoordinatingMessage", newPath);
    }
  }

  snprintf(newPath, elcount(newPath), "%s.%s", oldPath, "mSCMType");
  C2xSetTokenInt(packetHandle, "ManeuverSharingAndCoordinatingMessage", newPath, value.mSCMType);
  result = CheckLastError("ManeuverSharingAndCoordinatingMessage", gkFuncRefGet, result);

  snprintf(newPath, elcount(newPath), "%s.%s", oldPath, "sourceID");
  C2xSetTokenData(packetHandle, "ManeuverSharingAndCoordinatingMessage", newPath, value.sourceID.stringLength, value.sourceID.string);

  snprintf(newPath, elcount(newPath), "%s.%s", oldPath, "destinationIDs");
  if(value.destinationIDs.isValidFlag==1)
  {
    SetManeuverSharingAndCoordinatingMessageTemporaryIDListParams(packetHandle, value.destinationIDs, newPath);
    result = CheckLastError("ManeuverSharingAndCoordinatingMessage", gkFuncRefGet, result);
  }
  else
  {
    if( C2xIsTokenAvailable(packetHandle, "ManeuverSharingAndCoordinatingMessage", newPath) )
    {
      C2xRemoveToken(packetHandle, "ManeuverSharingAndCoordinatingMessage", newPath);
    }
  }

  snprintf(newPath, elcount(newPath), "%s.%s", oldPath, "maneuverID");
  if(value.maneuverID.isValidFlag==1)
  {
    C2xSetTokenInt(packetHandle, "ManeuverSharingAndCoordinatingMessage", newPath, value.maneuverID.value);
    result = CheckLastError("ManeuverSharingAndCoordinatingMessage", gkFuncRefGet, result);
  }
  else
  {
    if( C2xIsTokenAvailable(packetHandle, "ManeuverSharingAndCoordinatingMessage", newPath) )
    {
      C2xRemoveToken(packetHandle, "ManeuverSharingAndCoordinatingMessage", newPath);
    }
  }

  snprintf(newPath, elcount(newPath), "%s.%s", oldPath, "maneuver");
  if(value.maneuver.isValidFlag==1)
  {
    SetManeuverSharingAndCoordinatingMessageManeuverParams(packetHandle, value.maneuver, newPath);
    result = CheckLastError("ManeuverSharingAndCoordinatingMessage", gkFuncRefGet, result);
  }
  else
  {
    if( C2xIsTokenAvailable(packetHandle, "ManeuverSharingAndCoordinatingMessage", newPath) )
    {
      C2xRemoveToken(packetHandle, "ManeuverSharingAndCoordinatingMessage", newPath);
    }
  }

  snprintf(newPath, elcount(newPath), "%s.%s", oldPath, "responseFlag");
  if(value.responseFlag.isValidFlag==1)
  {
    C2xSetTokenInt64(packetHandle, "ManeuverSharingAndCoordinatingMessage", newPath, value.responseFlag.value);
    result = CheckLastError("ManeuverSharingAndCoordinatingMessage", gkFuncRefGet, result);
  }
  else
  {
    if( C2xIsTokenAvailable(packetHandle, "ManeuverSharingAndCoordinatingMessage", newPath) )
    {
      C2xRemoveToken(packetHandle, "ManeuverSharingAndCoordinatingMessage", newPath);
    }
  }

  snprintf(newPath, elcount(newPath), "%s.%s", oldPath, "reasonCode");
  if(value.reasonCode.isValidFlag==1)
  {
    C2xSetTokenInt(packetHandle, "ManeuverSharingAndCoordinatingMessage", newPath, value.reasonCode.value);
    result = CheckLastError("ManeuverSharingAndCoordinatingMessage", gkFuncRefGet, result);
  }
  else
  {
    if( C2xIsTokenAvailable(packetHandle, "ManeuverSharingAndCoordinatingMessage", newPath) )
    {
      C2xRemoveToken(packetHandle, "ManeuverSharingAndCoordinatingMessage", newPath);
    }
  }

  snprintf(newPath, elcount(newPath), "%s.%s", oldPath, "maneuverExecutionStatus");
  if(value.maneuverExecutionStatus.isValidFlag==1)
  {
    C2xSetTokenInt(packetHandle, "ManeuverSharingAndCoordinatingMessage", newPath, value.maneuverExecutionStatus.value);
    result = CheckLastError("ManeuverSharingAndCoordinatingMessage", gkFuncRefGet, result);
  }
  else
  {
    if( C2xIsTokenAvailable(packetHandle, "ManeuverSharingAndCoordinatingMessage", newPath) )
    {
      C2xRemoveToken(packetHandle, "ManeuverSharingAndCoordinatingMessage", newPath);
    }
  }

  return result;
}

int GetManeuverSharingAndCoordinatingMessageMESSAGE_ID_AND_TYPEParams(LONG packetHandle, WORD tableKey, struct ManeuverSharingAndCoordinatingMessageMESSAGE_ID_AND_TYPE value, char oldPath[])
{
  char newPath[300];
  int result;

  result = 0;

  switch(tableKey)
  {
    case 42:
    {
      snprintf(newPath, elcount(newPath), "%s.%s", oldPath, "maneuverSharingAndCoordinatingMessage");
      GetManeuverSharingAndCoordinatingMessage_ManeuverSharingAndCoordinatingMessageParams(packetHandle, value.maneuverSharingAndCoordinatingMessage, newPath);
      result = CheckLastError("ManeuverSharingAndCoordinatingMessage", gkFuncRefGet, result);
    }
    break;
  }
  return result;
}

int SetManeuverSharingAndCoordinatingMessageMESSAGE_ID_AND_TYPEParams(LONG packetHandle, WORD tableKey, struct ManeuverSharingAndCoordinatingMessageMESSAGE_ID_AND_TYPE value, char oldPath[])
{
  char newPath[300];
  int result;

  result = 0;

  switch(tableKey)
  {
    case 42:
    {
      snprintf(newPath, elcount(newPath), "%s.%s", oldPath, "maneuverSharingAndCoordinatingMessage");
      SetManeuverSharingAndCoordinatingMessage_ManeuverSharingAndCoordinatingMessageParams(packetHandle, value.maneuverSharingAndCoordinatingMessage, newPath);
      result = CheckLastError("ManeuverSharingAndCoordinatingMessage", gkFuncRefGet, result);
    }
    break;
  }
  return result;
}

int API_GetManeuverSharingAndCoordinatingMessageParams(LONG packetHandle, struct ManeuverSharingAndCoordinatingMessage value)
{
  int result;
  result = 0;

  value.messageId = C2xGetTokenInt(packetHandle, "ManeuverSharingAndCoordinatingMessage", "messageId");
  result = CheckLastError("ManeuverSharingAndCoordinatingMessage", gkFuncRefGet, result);

  GetManeuverSharingAndCoordinatingMessageMESSAGE_ID_AND_TYPEParams(packetHandle, value.messageId, value.value, "value");
  result = CheckLastError("ManeuverSharingAndCoordinatingMessage", gkFuncRefGet, result);

  return result;
}

int API_SetManeuverSharingAndCoordinatingMessageParams(LONG packetHandle, struct ManeuverSharingAndCoordinatingMessage value)
{
  int result;
  result = 0;

  value.messageId = 42;

  SetManeuverSharingAndCoordinatingMessageMESSAGE_ID_AND_TYPEParams(packetHandle, value.messageId, value.value, "value");
  result = CheckLastError("ManeuverSharingAndCoordinatingMessage", gkFuncRefGet, result);

  return result;
}

