/*@!Encoding:1252*/
/*
//  (c) Vector Informatik GmbH. All rights reserved.
//
//  This file contains definitions of structs and methods that may be used
//  to set and get the values of an ASN.1 defined packet's payload.
//
//  //This example demonstrates how to set a packet's payload:
//  LONG packetHandle;
//  struct SPAT payload;
//  //you need to set the values of the variable "payload" yourself
//  packetHandle = API_InitSPATPacket();
//  if (packetHandle!=0) {
//    if (API_SetSPATParams(packetHandle, payload)==0) {
//      if (C2xCompletePacket(packetHandle)==0) {
//        C2xOutputPacket(packetHandle);
//      }
//    }
//  }
//                                                                             */
includes
{
  #include "ASNV_Template_BaseDatatypes.cin"  // If warning "Duplicate #include, ignoring this include" appears, please remove the ASNV_Template_BaseDatatypes.cin include from your other *.cin files in the project.
}
variables
{
    struct SPATCommon_DescriptiveName {
        INT isValidFlag;   // necessary if this struct is used as an optional field of a SEQUENCE
        CHAR string[64];
        INT  stringLength;
    };
    
    struct SPATCommon_IntersectionReferenceID {
        INT isValidFlag;   // necessary if this struct is used as an optional field of a SEQUENCE
        struct OPT_WORD_ASN region;  // INTEGER, OPTIONAL, 0..65535;
        WORD id;  // INTEGER, 0..65535;
    };
    
    struct SPATIntersectionStatusObject {
        INT isValidFlag;   // necessary if this struct is used as an optional field of a SEQUENCE
        CHAR string[17];
        INT  stringLength;
    };
    
    struct SPATEnabledLaneList {
        INT isValidFlag;   // necessary if this struct is used as an optional field of a SEQUENCE
        INT length;
        BYTE arrayValue[16];  // INTEGER, 0..255;
    };
    
    struct SPATTimeChangeDetails {
        INT isValidFlag;   // necessary if this struct is used as an optional field of a SEQUENCE
        struct OPT_WORD_ASN startTime;  // INTEGER, OPTIONAL, 0..36111;
        WORD minEndTime;  // INTEGER, 0..36111;
        struct OPT_WORD_ASN maxEndTime;  // INTEGER, OPTIONAL, 0..36111;
        struct OPT_WORD_ASN likelyTime;  // INTEGER, OPTIONAL, 0..36111;
        struct OPT_BYTE_ASN confidence;  // INTEGER, OPTIONAL, 0..15;
        struct OPT_WORD_ASN nextTime;  // INTEGER, OPTIONAL, 0..36111;
    };
    
    struct SPATCommon_RegionalExtension_Reg_AdvisorySpeed_table {
    };
    
    struct SPATCommon_RegionalExtension_Reg_AdvisorySpeed {
        INT isValidFlag;   // necessary if this struct is used as an optional field of a SEQUENCE
        BYTE regionId;  // INTEGER, 0..255, noRegion(0), addGrpA(1), addGrpB(2), addGrpC(3), addGrpD(4);
        struct SPATCommon_RegionalExtension_Reg_AdvisorySpeed_table regExtvalue;  // TABLE;
    };
    
    struct SPATAdvisorySpeed_regional {
        INT isValidFlag;   // necessary if this struct is used as an optional field of a SEQUENCE
        INT length;
        struct SPATCommon_RegionalExtension_Reg_AdvisorySpeed arrayValue[4];  // SEQUENCE;
    };
    
    struct SPATAdvisorySpeed {
        INT isValidFlag;   // necessary if this struct is used as an optional field of a SEQUENCE
        INT type;  // ENUMERATED, none(0), greenwave(1), ecoDrive(2), transit(3);
        struct OPT_WORD_ASN speed;  // INTEGER, OPTIONAL, 0..500;
        struct OPT_ENUM_ASN confidence;  // ENUMERATED, OPTIONAL, unavailable(0), prec100ms(1), prec10ms(2), prec5ms(3), prec1ms(4), prec0_1ms(5), prec0_05ms(6), prec0_01ms(7);
        struct OPT_WORD_ASN distance;  // INTEGER, OPTIONAL, 0..10000;
        struct OPT_BYTE_ASN class;  // INTEGER, OPTIONAL, 0..255;
        struct SPATAdvisorySpeed_regional regional;  // SEQUENCEOF, OPTIONAL;
    };
    
    struct SPATAdvisorySpeedList {
        INT isValidFlag;   // necessary if this struct is used as an optional field of a SEQUENCE
        INT length;
        struct SPATAdvisorySpeed arrayValue[16];  // SEQUENCE;
    };
    
    struct SPATAddGrpB_MovementEvent_addGrpB {
        INT isValidFlag;   // necessary if this struct is used as an optional field of a SEQUENCE
        struct OPT_WORD_ASN startTime;  // INTEGER, OPTIONAL, 0..9001;
        WORD minEndTime;  // INTEGER, 0..2402;
        struct OPT_WORD_ASN maxEndTime;  // INTEGER, OPTIONAL, 0..2402;
        struct OPT_WORD_ASN likelyTime;  // INTEGER, OPTIONAL, 0..9001;
        struct OPT_BYTE_ASN confidence;  // INTEGER, OPTIONAL, 0..15;
        struct OPT_WORD_ASN nextTime;  // INTEGER, OPTIONAL, 0..9001;
    };
    
    struct SPATCommon_RegionalExtension_Reg_MovementEvent_table {
        struct SPATAddGrpB_MovementEvent_addGrpB addGrpB;  // SEQUENCE;
    };
    
    struct SPATCommon_RegionalExtension_Reg_MovementEvent {
        INT isValidFlag;   // necessary if this struct is used as an optional field of a SEQUENCE
        BYTE regionId;  // INTEGER, 0..255, noRegion(0), addGrpA(1), addGrpB(2), addGrpC(3), addGrpD(4);
        struct SPATCommon_RegionalExtension_Reg_MovementEvent_table regExtvalue;  // TABLE;
    };
    
    struct SPATMovementEvent_regional {
        INT isValidFlag;   // necessary if this struct is used as an optional field of a SEQUENCE
        INT length;
        struct SPATCommon_RegionalExtension_Reg_MovementEvent arrayValue[4];  // SEQUENCE;
    };
    
    struct SPATMovementEvent {
        INT isValidFlag;   // necessary if this struct is used as an optional field of a SEQUENCE
        INT eventState;  // ENUMERATED, unavailable(0), dark(1), stop_Then_Proceed(2), stop_And_Remain(3), pre_Movement(4), permissive_Movement_Allowed(5), protected_Movement_Allowed(6), permissive_clearance(7), protected_clearance(8), caution_Conflicting_Traffic(9);
        struct SPATTimeChangeDetails timing;  // SEQUENCE, OPTIONAL;
        struct SPATAdvisorySpeedList speeds;  // SEQUENCEOF, OPTIONAL;
        struct SPATMovementEvent_regional regional;  // SEQUENCEOF, OPTIONAL;
    };
    
    struct SPATMovementEventList {
        INT isValidFlag;   // necessary if this struct is used as an optional field of a SEQUENCE
        INT length;
        struct SPATMovementEvent arrayValue[16];  // SEQUENCE;
    };
    
    struct SPATAddGrpC_VehicleToLanePosition {
        INT isValidFlag;   // necessary if this struct is used as an optional field of a SEQUENCE
        DWORD stationID;  // INTEGER, 0..4294967295;
        BYTE laneID;  // INTEGER, 0..255;
    };
    
    struct SPATAddGrpC_VehicleToLanePositionList {
        INT isValidFlag;   // necessary if this struct is used as an optional field of a SEQUENCE
        INT length;
        struct SPATAddGrpC_VehicleToLanePosition arrayValue[5];  // SEQUENCE;
    };
    
    struct SPATCommon_Node_XY_20b {
        INT isValidFlag;   // necessary if this struct is used as an optional field of a SEQUENCE
        INT x;  // INTEGER, -512..511;
        INT y;  // INTEGER, -512..511;
    };
    
    struct SPATCommon_Node_XY_22b {
        INT isValidFlag;   // necessary if this struct is used as an optional field of a SEQUENCE
        INT x;  // INTEGER, -1024..1023;
        INT y;  // INTEGER, -1024..1023;
    };
    
    struct SPATCommon_Node_XY_24b {
        INT isValidFlag;   // necessary if this struct is used as an optional field of a SEQUENCE
        INT x;  // INTEGER, -2048..2047;
        INT y;  // INTEGER, -2048..2047;
    };
    
    struct SPATCommon_Node_XY_26b {
        INT isValidFlag;   // necessary if this struct is used as an optional field of a SEQUENCE
        INT x;  // INTEGER, -4096..4095;
        INT y;  // INTEGER, -4096..4095;
    };
    
    struct SPATCommon_Node_XY_28b {
        INT isValidFlag;   // necessary if this struct is used as an optional field of a SEQUENCE
        INT x;  // INTEGER, -8192..8191;
        INT y;  // INTEGER, -8192..8191;
    };
    
    struct SPATCommon_Node_XY_32b {
        INT isValidFlag;   // necessary if this struct is used as an optional field of a SEQUENCE
        INT x;  // INTEGER, -32768..32767;
        INT y;  // INTEGER, -32768..32767;
    };
    
    struct SPATCommon_Node_LLmD_64b {
        INT isValidFlag;   // necessary if this struct is used as an optional field of a SEQUENCE
        LONG lon;  // INTEGER, -1799999999..1800000001;
        LONG lat;  // INTEGER, -900000000..900000001;
    };
    
    struct SPATAddGrpB_Node_LLdms_48b {
        INT isValidFlag;   // necessary if this struct is used as an optional field of a SEQUENCE
        LONG lon;  // INTEGER, -64800000..64800000;
        LONG lat;  // INTEGER, -32400000..32400000;
    };
    
    struct SPATAddGrpB_LongitudeDMS2 {
        INT isValidFlag;   // necessary if this struct is used as an optional field of a SEQUENCE
        INT d;  // INTEGER, -180..180;
        BYTE m;  // INTEGER, 0..59;
        WORD s;  // INTEGER, 0..5999;
    };
    
    struct SPATAddGrpB_LatitudeDMS2 {
        INT isValidFlag;   // necessary if this struct is used as an optional field of a SEQUENCE
        INT d;  // INTEGER, -90..90;
        BYTE m;  // INTEGER, 0..59;
        WORD s;  // INTEGER, 0..5999;
    };
    
    struct SPATAddGrpB_Node_LLdms_80b {
        INT isValidFlag;   // necessary if this struct is used as an optional field of a SEQUENCE
        struct SPATAddGrpB_LongitudeDMS2 lon;  // SEQUENCE;
        struct SPATAddGrpB_LatitudeDMS2 lat;  // SEQUENCE;
    };
    
    struct SPATAddGrpB_NodeOffsetPointXY_addGrpB {
        INT isValidFlag;   // necessary if this struct is used as an optional field of a SEQUENCE
        INT choice;
        struct SPATAddGrpB_Node_LLdms_48b posA;  // SEQUENCE;
        struct SPATAddGrpB_Node_LLdms_80b posB;  // SEQUENCE;
    };
    
    struct SPATCommon_RegionalExtension_Reg_NodeOffsetPointXY_table {
        struct SPATAddGrpB_NodeOffsetPointXY_addGrpB addGrpB;  // CHOICE;
    };
    
    struct SPATCommon_RegionalExtension_Reg_NodeOffsetPointXY {
        INT isValidFlag;   // necessary if this struct is used as an optional field of a SEQUENCE
        BYTE regionId;  // INTEGER, 0..255, noRegion(0), addGrpA(1), addGrpB(2), addGrpC(3), addGrpD(4);
        struct SPATCommon_RegionalExtension_Reg_NodeOffsetPointXY_table regExtvalue;  // TABLE;
    };
    
    struct SPATCommon_NodeOffsetPointXY {
        INT isValidFlag;   // necessary if this struct is used as an optional field of a SEQUENCE
        INT choice;
        struct SPATCommon_Node_XY_20b node_XY1;  // SEQUENCE;
        struct SPATCommon_Node_XY_22b node_XY2;  // SEQUENCE;
        struct SPATCommon_Node_XY_24b node_XY3;  // SEQUENCE;
        struct SPATCommon_Node_XY_26b node_XY4;  // SEQUENCE;
        struct SPATCommon_Node_XY_28b node_XY5;  // SEQUENCE;
        struct SPATCommon_Node_XY_32b node_XY6;  // SEQUENCE;
        struct SPATCommon_Node_LLmD_64b node_LatLon;  // SEQUENCE;
        struct SPATCommon_RegionalExtension_Reg_NodeOffsetPointXY regional;  // SEQUENCE;
    };
    
    struct SPATAddGrpC_ConnectionManeuverAssist_addGrpC {
        INT isValidFlag;   // necessary if this struct is used as an optional field of a SEQUENCE
        struct SPATAddGrpC_VehicleToLanePositionList vehicleToLanePositions;  // SEQUENCEOF;
        struct SPATCommon_NodeOffsetPointXY rsuDistanceFromAnchor;  // CHOICE, OPTIONAL;
    };
    
    struct SPATCommon_RegionalExtension_Reg_ConnectionManeuverAssist_table {
        struct SPATAddGrpC_ConnectionManeuverAssist_addGrpC addGrpC;  // SEQUENCE;
    };
    
    struct SPATCommon_RegionalExtension_Reg_ConnectionManeuverAssist {
        INT isValidFlag;   // necessary if this struct is used as an optional field of a SEQUENCE
        BYTE regionId;  // INTEGER, 0..255, noRegion(0), addGrpA(1), addGrpB(2), addGrpC(3), addGrpD(4);
        struct SPATCommon_RegionalExtension_Reg_ConnectionManeuverAssist_table regExtvalue;  // TABLE;
    };
    
    struct SPATConnectionManeuverAssist_regional {
        INT isValidFlag;   // necessary if this struct is used as an optional field of a SEQUENCE
        INT length;
        struct SPATCommon_RegionalExtension_Reg_ConnectionManeuverAssist arrayValue[4];  // SEQUENCE;
    };
    
    struct SPATConnectionManeuverAssist {
        INT isValidFlag;   // necessary if this struct is used as an optional field of a SEQUENCE
        BYTE connectionID;  // INTEGER, 0..255;
        struct OPT_WORD_ASN queueLength;  // INTEGER, OPTIONAL, 0..10000;
        struct OPT_WORD_ASN availableStorageLength;  // INTEGER, OPTIONAL, 0..10000;
        struct OPT_BOOL_ASN waitOnStop;  // BOOLEAN, OPTIONAL;
        struct OPT_BOOL_ASN pedBicycleDetect;  // BOOLEAN, OPTIONAL;
        struct SPATConnectionManeuverAssist_regional regional;  // SEQUENCEOF, OPTIONAL;
    };
    
    struct SPATManeuverAssistList {
        INT isValidFlag;   // necessary if this struct is used as an optional field of a SEQUENCE
        INT length;
        struct SPATConnectionManeuverAssist arrayValue[16];  // SEQUENCE;
    };
    
    struct SPATCommon_RegionalExtension_Reg_MovementState_table {
    };
    
    struct SPATCommon_RegionalExtension_Reg_MovementState {
        INT isValidFlag;   // necessary if this struct is used as an optional field of a SEQUENCE
        BYTE regionId;  // INTEGER, 0..255, noRegion(0), addGrpA(1), addGrpB(2), addGrpC(3), addGrpD(4);
        struct SPATCommon_RegionalExtension_Reg_MovementState_table regExtvalue;  // TABLE;
    };
    
    struct SPATMovementState_regional {
        INT isValidFlag;   // necessary if this struct is used as an optional field of a SEQUENCE
        INT length;
        struct SPATCommon_RegionalExtension_Reg_MovementState arrayValue[4];  // SEQUENCE;
    };
    
    struct SPATMovementState {
        INT isValidFlag;   // necessary if this struct is used as an optional field of a SEQUENCE
        struct SPATCommon_DescriptiveName movementName;  // IA5STRING, OPTIONAL;
        BYTE signalGroup;  // INTEGER, 0..255;
        struct SPATMovementEventList state_time_speed;  // SEQUENCEOF;
        struct SPATManeuverAssistList maneuverAssistList;  // SEQUENCEOF, OPTIONAL;
        struct SPATMovementState_regional regional;  // SEQUENCEOF, OPTIONAL;
    };
    
    struct SPATMovementList {
        INT isValidFlag;   // necessary if this struct is used as an optional field of a SEQUENCE
        INT length;
        struct SPATMovementState arrayValue[255];  // SEQUENCE;
    };
    
    struct SPATAddGrpC_PrioritizationResponse {
        INT isValidFlag;   // necessary if this struct is used as an optional field of a SEQUENCE
        DWORD stationID;  // INTEGER, 0..4294967295;
        INT priorState;  // ENUMERATED, unknown(0), requested(1), processing(2), watchOtherTraffic(3), granted(4), rejected(5), maxPresence(6), reserviceLocked(7);
        BYTE signalGroup;  // INTEGER, 0..255;
    };
    
    struct SPATAddGrpC_PrioritizationResponseList {
        INT isValidFlag;   // necessary if this struct is used as an optional field of a SEQUENCE
        INT length;
        struct SPATAddGrpC_PrioritizationResponse arrayValue[10];  // SEQUENCE;
    };
    
    struct SPATAddGrpC_IntersectionState_addGrpC {
        INT isValidFlag;   // necessary if this struct is used as an optional field of a SEQUENCE
        struct SPATAddGrpC_PrioritizationResponseList activePrioritizations;  // SEQUENCEOF, OPTIONAL;
    };
    
    struct SPATCommon_RegionalExtension_Reg_IntersectionState_table {
        struct SPATAddGrpC_IntersectionState_addGrpC addGrpC;  // SEQUENCE;
    };
    
    struct SPATCommon_RegionalExtension_Reg_IntersectionState {
        INT isValidFlag;   // necessary if this struct is used as an optional field of a SEQUENCE
        BYTE regionId;  // INTEGER, 0..255, noRegion(0), addGrpA(1), addGrpB(2), addGrpC(3), addGrpD(4);
        struct SPATCommon_RegionalExtension_Reg_IntersectionState_table regExtvalue;  // TABLE;
    };
    
    struct SPATIntersectionState_regional {
        INT isValidFlag;   // necessary if this struct is used as an optional field of a SEQUENCE
        INT length;
        struct SPATCommon_RegionalExtension_Reg_IntersectionState arrayValue[4];  // SEQUENCE;
    };
    
    struct SPATCommon_FullRoadAuthorityID_id {
        INT isValidFlag;   // necessary if this struct is used as an optional field of a SEQUENCE
        INT length;
        INT id;
    };
    
    struct SPATCommon_FullRoadAuthorityID {
        INT isValidFlag;   // necessary if this struct is used as an optional field of a SEQUENCE
        INT length;
        struct SPATCommon_FullRoadAuthorityID_id arrayValue[16];
    };
    
    struct SPATCommon_RelativeRoadAuthorityID_id {
        INT isValidFlag;   // necessary if this struct is used as an optional field of a SEQUENCE
        INT length;
        INT id;
    };
    
    struct SPATCommon_RelativeRoadAuthorityID {
        INT isValidFlag;   // necessary if this struct is used as an optional field of a SEQUENCE
        INT length;
        struct SPATCommon_RelativeRoadAuthorityID_id arrayValue[16];
    };
    
    struct SPATCommon_RoadAuthorityID {
        INT isValidFlag;   // necessary if this struct is used as an optional field of a SEQUENCE
        INT choice;
        struct SPATCommon_FullRoadAuthorityID fullRdAuthID;  // OBJECTIDENTIFIER;
        struct SPATCommon_RelativeRoadAuthorityID relRdAuthID;  // RELATIVEOID;
    };
    
    struct SPATIntersectionState {
        INT isValidFlag;   // necessary if this struct is used as an optional field of a SEQUENCE
        struct SPATCommon_DescriptiveName name;  // IA5STRING, OPTIONAL;
        struct SPATCommon_IntersectionReferenceID id;  // SEQUENCE;
        BYTE revision;  // INTEGER, 0..127;
        struct SPATIntersectionStatusObject status;  // BITSTRING;
        struct OPT_DWORD_ASN moy;  // INTEGER, OPTIONAL, 0..527040;
        struct OPT_WORD_ASN timeStamp;  // INTEGER, OPTIONAL, 0..65535;
        struct SPATEnabledLaneList enabledLanes;  // SEQUENCEOF, OPTIONAL;
        struct SPATMovementList states;  // SEQUENCEOF;
        struct SPATManeuverAssistList maneuverAssistList;  // SEQUENCEOF, OPTIONAL;
        struct SPATIntersectionState_regional regional;  // SEQUENCEOF, OPTIONAL;
        struct SPATCommon_RoadAuthorityID roadAuthorityID;  // CHOICE, OPTIONAL;
    };
    
    struct SPATIntersectionStateList {
        INT isValidFlag;   // necessary if this struct is used as an optional field of a SEQUENCE
        INT length;
        struct SPATIntersectionState arrayValue[32];  // SEQUENCE;
    };
    
    struct SPATCommon_RegionalExtension_Reg_SPAT_table {
    };
    
    struct SPATCommon_RegionalExtension_Reg_SPAT {
        INT isValidFlag;   // necessary if this struct is used as an optional field of a SEQUENCE
        BYTE regionId;  // INTEGER, 0..255, noRegion(0), addGrpA(1), addGrpB(2), addGrpC(3), addGrpD(4);
        struct SPATCommon_RegionalExtension_Reg_SPAT_table regExtvalue;  // TABLE;
    };
    
    struct SPATSPAT_regional {
        INT isValidFlag;   // necessary if this struct is used as an optional field of a SEQUENCE
        INT length;
        struct SPATCommon_RegionalExtension_Reg_SPAT arrayValue[4];  // SEQUENCE;
    };
    
    struct SPAT_SPAT {
        INT isValidFlag;   // necessary if this struct is used as an optional field of a SEQUENCE
        struct OPT_DWORD_ASN timeStamp;  // INTEGER, OPTIONAL, 0..527040;
        struct SPATCommon_DescriptiveName name;  // IA5STRING, OPTIONAL;
        struct SPATIntersectionStateList intersections;  // SEQUENCEOF;
        struct SPATSPAT_regional regional;  // SEQUENCEOF, OPTIONAL;
    };
    
    struct SPATMESSAGE_ID_AND_TYPE {
        struct SPAT_SPAT signalPhaseAndTimingMessage;  // SEQUENCE;
    };
    
    struct SPAT {
        INT isValidFlag;   // necessary if this struct is used as an optional field of a SEQUENCE
        WORD messageId;  // INTEGER, 0..32767, mapData(18), signalPhaseAndTimingMessage(19), basicSafetyMessage(20), commonSafetyRequest(21), emergencyVehicleAlert(22), intersectionCollision(23), nmeaCorrections(24), probeDataManagement(25), probeVehicleData(26), roadSideAlert(27), rtcmCorrections(28), signalRequestMessage(29), signalStatusMessage(30), travelerInformation(31), personalSafetyMessage(32), roadSafetyMessage(33), roadWeatherMessage(34), probeDataConfigMessage(35), probeDataReportMessage(36), tollAdvertisementMessage(37), tollUsageMessage(38), tollUsageAckMessage(39), cooperativeControlMessage(40), sensorDataSharingMessage(41), maneuverSharingAndCoordinatingMessage(42), roadGeometryAndAttributes(43), personalSafetyMessage2(44), trafficSignalPhaseAndTiming(45), signalControlAndPrioritizationRequest(46), signalControlAndPrioritizationStatus(47), roadUserChargingConfigMessage(48), roadUserChargingReportMessage(49), trafficLightStatusMessage(50);
        struct SPATMESSAGE_ID_AND_TYPE value;  // TABLE;
    };
    
}

/*
// init function to create a simple packet handle
*/ 
LONG API_InitSPATPacket()
{
  return C2xInitPacket("SPAT"); 
}

/*
// init function to create a simple packet handle and
// initialize the struct with valid data
*/ 
LONG API_InitSPATPacket(struct SPAT msgStruct)
{
  long pktHandle;

  pktHandle = API_InitSPATPacket();

  if (pktHandle != 0)
  {
    // create valid message and application data
    if (C2xCompletePacket(pktHandle) == 0) 
    {
      API_GetSPATParams(pktHandle, msgStruct);
    }
  }
  return pktHandle;
}

/*
// init function to create a packet with security layer and
// initialize the struct with valid data
*/ 
LONG API_InitSPATPacket(struct SPAT msgStruct, char packetTypeDesignator[], char certificateName[])
{
  long pktHandle, certHdl;

  // initialize the packet
  pktHandle = C2xInitPacket("SPAT", packetTypeDesignator);

  if (pktHandle != 0)
  {
    certHdl = C2xSecCertificateGetHandle(certificateName);  // get the certificate handle for the cert with name "certificateName"
    if (certHdl != 0) 
    {
      C2xSecPacketSetSignerHandle(pktHandle, certHdl); // set the certHdl to the packet
    }

    // create valid message and application data
    if (C2xCompletePacket(pktHandle) == 0) 
    {
      // copy application data to the application structure
      API_GetSPATParams(pktHandle, msgStruct);
    }
  }
  return pktHandle;
}
    

int GetSPATCommon_IntersectionReferenceIDParams(LONG packetHandle, struct SPATCommon_IntersectionReferenceID value, char oldPath[])
{
  char newPath[300];
  int result;

  result = 0;

  snprintf(newPath, elcount(newPath), "%s.%s", oldPath, "region");
  value.region.isValidFlag = C2xIsTokenAvailable(packetHandle, "SPAT", newPath);
  if(value.region.isValidFlag==1)
  {
    value.region.value = C2xGetTokenInt(packetHandle, "SPAT", newPath);
    result = CheckLastError("SPAT", gkFuncRefGet, result);
  }
  snprintf(newPath, elcount(newPath), "%s.%s", oldPath, "id");
  value.id = C2xGetTokenInt(packetHandle, "SPAT", newPath);
  result = CheckLastError("SPAT", gkFuncRefGet, result);

  return result;
}

int SetSPATCommon_IntersectionReferenceIDParams(LONG packetHandle, struct SPATCommon_IntersectionReferenceID value, char oldPath[])
{
  char newPath[300];
  int result;

  result = 0;

  snprintf(newPath, elcount(newPath), "%s.%s", oldPath, "region");
  if(value.region.isValidFlag==1)
  {
    C2xSetTokenInt(packetHandle, "SPAT", newPath, value.region.value);
    result = CheckLastError("SPAT", gkFuncRefGet, result);
  }
  else
  {
    if( C2xIsTokenAvailable(packetHandle, "SPAT", newPath) )
    {
      C2xRemoveToken(packetHandle, "SPAT", newPath);
    }
  }

  snprintf(newPath, elcount(newPath), "%s.%s", oldPath, "id");
  C2xSetTokenInt(packetHandle, "SPAT", newPath, value.id);
  result = CheckLastError("SPAT", gkFuncRefGet, result);

  return result;
}

int GetSPATEnabledLaneListParams(LONG packetHandle, struct SPATEnabledLaneList value, char oldPath[])
{
  char newPath[300]; 
  int i;
  int result;

  result = 0;

  value.length = C2xGetTokenInt(packetHandle, "SPAT", oldPath);
  if((result = CheckLastError("SPAT", gkFuncRefGet, result))==0)
  {
    for(i=0; i<value.length; i++)
    {
      snprintf(newPath, elcount(newPath), "%s[%d]", oldPath, i);
      value.arrayValue[i] = C2xGetTokenInt64(packetHandle, "SPAT", newPath);
      result = CheckLastError("SPAT", gkFuncRefGet, result);
    }
  }
  return result;
}

int SetSPATEnabledLaneListParams(LONG packetHandle, struct SPATEnabledLaneList value, char oldPath[])
{
  char newPath[300]; 
  int i;
  int result;

  result = 0;

  C2xRemoveToken(packetHandle, "SPAT", oldPath);
  for(i=0; i<value.length; i++)
  {
    snprintf(newPath, elcount(newPath), "%s[%d]", oldPath, i);
    C2xSetTokenInt64(packetHandle, "SPAT", newPath, value.arrayValue[i]);
    result = CheckLastError("SPAT", gkFuncRefGet, result);
  }
  return result;
}

int GetSPATTimeChangeDetailsParams(LONG packetHandle, struct SPATTimeChangeDetails value, char oldPath[])
{
  char newPath[300];
  int result;

  result = 0;

  snprintf(newPath, elcount(newPath), "%s.%s", oldPath, "startTime");
  value.startTime.isValidFlag = C2xIsTokenAvailable(packetHandle, "SPAT", newPath);
  if(value.startTime.isValidFlag==1)
  {
    value.startTime.value = C2xGetTokenInt(packetHandle, "SPAT", newPath);
    result = CheckLastError("SPAT", gkFuncRefGet, result);
  }
  snprintf(newPath, elcount(newPath), "%s.%s", oldPath, "minEndTime");
  value.minEndTime = C2xGetTokenInt(packetHandle, "SPAT", newPath);
  result = CheckLastError("SPAT", gkFuncRefGet, result);

  snprintf(newPath, elcount(newPath), "%s.%s", oldPath, "maxEndTime");
  value.maxEndTime.isValidFlag = C2xIsTokenAvailable(packetHandle, "SPAT", newPath);
  if(value.maxEndTime.isValidFlag==1)
  {
    value.maxEndTime.value = C2xGetTokenInt(packetHandle, "SPAT", newPath);
    result = CheckLastError("SPAT", gkFuncRefGet, result);
  }
  snprintf(newPath, elcount(newPath), "%s.%s", oldPath, "likelyTime");
  value.likelyTime.isValidFlag = C2xIsTokenAvailable(packetHandle, "SPAT", newPath);
  if(value.likelyTime.isValidFlag==1)
  {
    value.likelyTime.value = C2xGetTokenInt(packetHandle, "SPAT", newPath);
    result = CheckLastError("SPAT", gkFuncRefGet, result);
  }
  snprintf(newPath, elcount(newPath), "%s.%s", oldPath, "confidence");
  value.confidence.isValidFlag = C2xIsTokenAvailable(packetHandle, "SPAT", newPath);
  if(value.confidence.isValidFlag==1)
  {
    value.confidence.value = C2xGetTokenInt(packetHandle, "SPAT", newPath);
    result = CheckLastError("SPAT", gkFuncRefGet, result);
  }
  snprintf(newPath, elcount(newPath), "%s.%s", oldPath, "nextTime");
  value.nextTime.isValidFlag = C2xIsTokenAvailable(packetHandle, "SPAT", newPath);
  if(value.nextTime.isValidFlag==1)
  {
    value.nextTime.value = C2xGetTokenInt(packetHandle, "SPAT", newPath);
    result = CheckLastError("SPAT", gkFuncRefGet, result);
  }
  return result;
}

int SetSPATTimeChangeDetailsParams(LONG packetHandle, struct SPATTimeChangeDetails value, char oldPath[])
{
  char newPath[300];
  int result;

  result = 0;

  snprintf(newPath, elcount(newPath), "%s.%s", oldPath, "startTime");
  if(value.startTime.isValidFlag==1)
  {
    C2xSetTokenInt(packetHandle, "SPAT", newPath, value.startTime.value);
    result = CheckLastError("SPAT", gkFuncRefGet, result);
  }
  else
  {
    if( C2xIsTokenAvailable(packetHandle, "SPAT", newPath) )
    {
      C2xRemoveToken(packetHandle, "SPAT", newPath);
    }
  }

  snprintf(newPath, elcount(newPath), "%s.%s", oldPath, "minEndTime");
  C2xSetTokenInt(packetHandle, "SPAT", newPath, value.minEndTime);
  result = CheckLastError("SPAT", gkFuncRefGet, result);

  snprintf(newPath, elcount(newPath), "%s.%s", oldPath, "maxEndTime");
  if(value.maxEndTime.isValidFlag==1)
  {
    C2xSetTokenInt(packetHandle, "SPAT", newPath, value.maxEndTime.value);
    result = CheckLastError("SPAT", gkFuncRefGet, result);
  }
  else
  {
    if( C2xIsTokenAvailable(packetHandle, "SPAT", newPath) )
    {
      C2xRemoveToken(packetHandle, "SPAT", newPath);
    }
  }

  snprintf(newPath, elcount(newPath), "%s.%s", oldPath, "likelyTime");
  if(value.likelyTime.isValidFlag==1)
  {
    C2xSetTokenInt(packetHandle, "SPAT", newPath, value.likelyTime.value);
    result = CheckLastError("SPAT", gkFuncRefGet, result);
  }
  else
  {
    if( C2xIsTokenAvailable(packetHandle, "SPAT", newPath) )
    {
      C2xRemoveToken(packetHandle, "SPAT", newPath);
    }
  }

  snprintf(newPath, elcount(newPath), "%s.%s", oldPath, "confidence");
  if(value.confidence.isValidFlag==1)
  {
    C2xSetTokenInt(packetHandle, "SPAT", newPath, value.confidence.value);
    result = CheckLastError("SPAT", gkFuncRefGet, result);
  }
  else
  {
    if( C2xIsTokenAvailable(packetHandle, "SPAT", newPath) )
    {
      C2xRemoveToken(packetHandle, "SPAT", newPath);
    }
  }

  snprintf(newPath, elcount(newPath), "%s.%s", oldPath, "nextTime");
  if(value.nextTime.isValidFlag==1)
  {
    C2xSetTokenInt(packetHandle, "SPAT", newPath, value.nextTime.value);
    result = CheckLastError("SPAT", gkFuncRefGet, result);
  }
  else
  {
    if( C2xIsTokenAvailable(packetHandle, "SPAT", newPath) )
    {
      C2xRemoveToken(packetHandle, "SPAT", newPath);
    }
  }

  return result;
}

int GetSPATCommon_RegionalExtension_Reg_AdvisorySpeedParams(LONG packetHandle, struct SPATCommon_RegionalExtension_Reg_AdvisorySpeed value, char oldPath[])
{
  char newPath[300];
  int result;

  result = 0;

  snprintf(newPath, elcount(newPath), "%s.%s", oldPath, "regionId");
  value.regionId = C2xGetTokenInt(packetHandle, "SPAT", newPath);
  result = CheckLastError("SPAT", gkFuncRefGet, result);

  return result;
}

int SetSPATCommon_RegionalExtension_Reg_AdvisorySpeedParams(LONG packetHandle, struct SPATCommon_RegionalExtension_Reg_AdvisorySpeed value, char oldPath[])
{
  char newPath[300];
  int result;

  result = 0;


  return result;
}

int GetSPATAdvisorySpeed_regionalParams(LONG packetHandle, struct SPATAdvisorySpeed_regional value, char oldPath[])
{
  char newPath[300]; 
  int i;
  int result;

  result = 0;

  value.length = C2xGetTokenInt(packetHandle, "SPAT", oldPath);
  if((result = CheckLastError("SPAT", gkFuncRefGet, result))==0)
  {
    for(i=0; i<value.length; i++)
    {
      snprintf(newPath, elcount(newPath), "%s[%d]", oldPath, i);
      GetSPATCommon_RegionalExtension_Reg_AdvisorySpeedParams(packetHandle, value.arrayValue[i], newPath);
      result = CheckLastError("SPAT", gkFuncRefGet, result);
    }
  }
  return result;
}

int SetSPATAdvisorySpeed_regionalParams(LONG packetHandle, struct SPATAdvisorySpeed_regional value, char oldPath[])
{
  char newPath[300]; 
  int i;
  int result;

  result = 0;

  C2xRemoveToken(packetHandle, "SPAT", oldPath);
  for(i=0; i<value.length; i++)
  {
    snprintf(newPath, elcount(newPath), "%s[%d]", oldPath, i);
    SetSPATCommon_RegionalExtension_Reg_AdvisorySpeedParams(packetHandle, value.arrayValue[i], newPath);
    result = CheckLastError("SPAT", gkFuncRefGet, result);
  }
  return result;
}

int GetSPATAdvisorySpeedParams(LONG packetHandle, struct SPATAdvisorySpeed value, char oldPath[])
{
  char newPath[300];
  int result;

  result = 0;

  snprintf(newPath, elcount(newPath), "%s.%s", oldPath, "type");
  value.type = C2xGetTokenInt(packetHandle, "SPAT", newPath);
  result = CheckLastError("SPAT", gkFuncRefGet, result);

  snprintf(newPath, elcount(newPath), "%s.%s", oldPath, "speed");
  value.speed.isValidFlag = C2xIsTokenAvailable(packetHandle, "SPAT", newPath);
  if(value.speed.isValidFlag==1)
  {
    value.speed.value = C2xGetTokenInt(packetHandle, "SPAT", newPath);
    result = CheckLastError("SPAT", gkFuncRefGet, result);
  }
  snprintf(newPath, elcount(newPath), "%s.%s", oldPath, "confidence");
  value.confidence.isValidFlag = C2xIsTokenAvailable(packetHandle, "SPAT", newPath);
  if(value.confidence.isValidFlag==1)
  {
    value.confidence.value = C2xGetTokenInt(packetHandle, "SPAT", newPath);
    result = CheckLastError("SPAT", gkFuncRefGet, result);
  }
  snprintf(newPath, elcount(newPath), "%s.%s", oldPath, "distance");
  value.distance.isValidFlag = C2xIsTokenAvailable(packetHandle, "SPAT", newPath);
  if(value.distance.isValidFlag==1)
  {
    value.distance.value = C2xGetTokenInt(packetHandle, "SPAT", newPath);
    result = CheckLastError("SPAT", gkFuncRefGet, result);
  }
  snprintf(newPath, elcount(newPath), "%s.%s", oldPath, "class");
  value.class.isValidFlag = C2xIsTokenAvailable(packetHandle, "SPAT", newPath);
  if(value.class.isValidFlag==1)
  {
    value.class.value = C2xGetTokenInt(packetHandle, "SPAT", newPath);
    result = CheckLastError("SPAT", gkFuncRefGet, result);
  }
  snprintf(newPath, elcount(newPath), "%s.%s", oldPath, "regional");
  value.regional.isValidFlag = C2xIsTokenAvailable(packetHandle, "SPAT", newPath);
  if(value.regional.isValidFlag==1)
  {
    GetSPATAdvisorySpeed_regionalParams(packetHandle, value.regional, newPath);
    result = CheckLastError("SPAT", gkFuncRefGet, result);
  }
  return result;
}

int SetSPATAdvisorySpeedParams(LONG packetHandle, struct SPATAdvisorySpeed value, char oldPath[])
{
  char newPath[300];
  int result;

  result = 0;

  snprintf(newPath, elcount(newPath), "%s.%s", oldPath, "type");
  C2xSetTokenInt(packetHandle, "SPAT", newPath, value.type);
  result = CheckLastError("SPAT", gkFuncRefGet, result);

  snprintf(newPath, elcount(newPath), "%s.%s", oldPath, "speed");
  if(value.speed.isValidFlag==1)
  {
    C2xSetTokenInt(packetHandle, "SPAT", newPath, value.speed.value);
    result = CheckLastError("SPAT", gkFuncRefGet, result);
  }
  else
  {
    if( C2xIsTokenAvailable(packetHandle, "SPAT", newPath) )
    {
      C2xRemoveToken(packetHandle, "SPAT", newPath);
    }
  }

  snprintf(newPath, elcount(newPath), "%s.%s", oldPath, "confidence");
  if(value.confidence.isValidFlag==1)
  {
    C2xSetTokenInt(packetHandle, "SPAT", newPath, value.confidence.value);
    result = CheckLastError("SPAT", gkFuncRefGet, result);
  }
  else
  {
    if( C2xIsTokenAvailable(packetHandle, "SPAT", newPath) )
    {
      C2xRemoveToken(packetHandle, "SPAT", newPath);
    }
  }

  snprintf(newPath, elcount(newPath), "%s.%s", oldPath, "distance");
  if(value.distance.isValidFlag==1)
  {
    C2xSetTokenInt(packetHandle, "SPAT", newPath, value.distance.value);
    result = CheckLastError("SPAT", gkFuncRefGet, result);
  }
  else
  {
    if( C2xIsTokenAvailable(packetHandle, "SPAT", newPath) )
    {
      C2xRemoveToken(packetHandle, "SPAT", newPath);
    }
  }

  snprintf(newPath, elcount(newPath), "%s.%s", oldPath, "class");
  if(value.class.isValidFlag==1)
  {
    C2xSetTokenInt(packetHandle, "SPAT", newPath, value.class.value);
    result = CheckLastError("SPAT", gkFuncRefGet, result);
  }
  else
  {
    if( C2xIsTokenAvailable(packetHandle, "SPAT", newPath) )
    {
      C2xRemoveToken(packetHandle, "SPAT", newPath);
    }
  }

  snprintf(newPath, elcount(newPath), "%s.%s", oldPath, "regional");
  if(value.regional.isValidFlag==1)
  {
    SetSPATAdvisorySpeed_regionalParams(packetHandle, value.regional, newPath);
    result = CheckLastError("SPAT", gkFuncRefGet, result);
  }
  else
  {
    if( C2xIsTokenAvailable(packetHandle, "SPAT", newPath) )
    {
      C2xRemoveToken(packetHandle, "SPAT", newPath);
    }
  }

  return result;
}

int GetSPATAdvisorySpeedListParams(LONG packetHandle, struct SPATAdvisorySpeedList value, char oldPath[])
{
  char newPath[300]; 
  int i;
  int result;

  result = 0;

  value.length = C2xGetTokenInt(packetHandle, "SPAT", oldPath);
  if((result = CheckLastError("SPAT", gkFuncRefGet, result))==0)
  {
    for(i=0; i<value.length; i++)
    {
      snprintf(newPath, elcount(newPath), "%s[%d]", oldPath, i);
      GetSPATAdvisorySpeedParams(packetHandle, value.arrayValue[i], newPath);
      result = CheckLastError("SPAT", gkFuncRefGet, result);
    }
  }
  return result;
}

int SetSPATAdvisorySpeedListParams(LONG packetHandle, struct SPATAdvisorySpeedList value, char oldPath[])
{
  char newPath[300]; 
  int i;
  int result;

  result = 0;

  C2xRemoveToken(packetHandle, "SPAT", oldPath);
  for(i=0; i<value.length; i++)
  {
    snprintf(newPath, elcount(newPath), "%s[%d]", oldPath, i);
    SetSPATAdvisorySpeedParams(packetHandle, value.arrayValue[i], newPath);
    result = CheckLastError("SPAT", gkFuncRefGet, result);
  }
  return result;
}

int GetSPATAddGrpB_MovementEvent_addGrpBParams(LONG packetHandle, struct SPATAddGrpB_MovementEvent_addGrpB value, char oldPath[])
{
  char newPath[300];
  int result;

  result = 0;

  snprintf(newPath, elcount(newPath), "%s.%s", oldPath, "startTime");
  value.startTime.isValidFlag = C2xIsTokenAvailable(packetHandle, "SPAT", newPath);
  if(value.startTime.isValidFlag==1)
  {
    value.startTime.value = C2xGetTokenInt(packetHandle, "SPAT", newPath);
    result = CheckLastError("SPAT", gkFuncRefGet, result);
  }
  snprintf(newPath, elcount(newPath), "%s.%s", oldPath, "minEndTime");
  value.minEndTime = C2xGetTokenInt(packetHandle, "SPAT", newPath);
  result = CheckLastError("SPAT", gkFuncRefGet, result);

  snprintf(newPath, elcount(newPath), "%s.%s", oldPath, "maxEndTime");
  value.maxEndTime.isValidFlag = C2xIsTokenAvailable(packetHandle, "SPAT", newPath);
  if(value.maxEndTime.isValidFlag==1)
  {
    value.maxEndTime.value = C2xGetTokenInt(packetHandle, "SPAT", newPath);
    result = CheckLastError("SPAT", gkFuncRefGet, result);
  }
  snprintf(newPath, elcount(newPath), "%s.%s", oldPath, "likelyTime");
  value.likelyTime.isValidFlag = C2xIsTokenAvailable(packetHandle, "SPAT", newPath);
  if(value.likelyTime.isValidFlag==1)
  {
    value.likelyTime.value = C2xGetTokenInt(packetHandle, "SPAT", newPath);
    result = CheckLastError("SPAT", gkFuncRefGet, result);
  }
  snprintf(newPath, elcount(newPath), "%s.%s", oldPath, "confidence");
  value.confidence.isValidFlag = C2xIsTokenAvailable(packetHandle, "SPAT", newPath);
  if(value.confidence.isValidFlag==1)
  {
    value.confidence.value = C2xGetTokenInt(packetHandle, "SPAT", newPath);
    result = CheckLastError("SPAT", gkFuncRefGet, result);
  }
  snprintf(newPath, elcount(newPath), "%s.%s", oldPath, "nextTime");
  value.nextTime.isValidFlag = C2xIsTokenAvailable(packetHandle, "SPAT", newPath);
  if(value.nextTime.isValidFlag==1)
  {
    value.nextTime.value = C2xGetTokenInt(packetHandle, "SPAT", newPath);
    result = CheckLastError("SPAT", gkFuncRefGet, result);
  }
  return result;
}

int SetSPATAddGrpB_MovementEvent_addGrpBParams(LONG packetHandle, struct SPATAddGrpB_MovementEvent_addGrpB value, char oldPath[])
{
  char newPath[300];
  int result;

  result = 0;

  snprintf(newPath, elcount(newPath), "%s.%s", oldPath, "startTime");
  if(value.startTime.isValidFlag==1)
  {
    C2xSetTokenInt(packetHandle, "SPAT", newPath, value.startTime.value);
    result = CheckLastError("SPAT", gkFuncRefGet, result);
  }
  else
  {
    if( C2xIsTokenAvailable(packetHandle, "SPAT", newPath) )
    {
      C2xRemoveToken(packetHandle, "SPAT", newPath);
    }
  }

  snprintf(newPath, elcount(newPath), "%s.%s", oldPath, "minEndTime");
  C2xSetTokenInt(packetHandle, "SPAT", newPath, value.minEndTime);
  result = CheckLastError("SPAT", gkFuncRefGet, result);

  snprintf(newPath, elcount(newPath), "%s.%s", oldPath, "maxEndTime");
  if(value.maxEndTime.isValidFlag==1)
  {
    C2xSetTokenInt(packetHandle, "SPAT", newPath, value.maxEndTime.value);
    result = CheckLastError("SPAT", gkFuncRefGet, result);
  }
  else
  {
    if( C2xIsTokenAvailable(packetHandle, "SPAT", newPath) )
    {
      C2xRemoveToken(packetHandle, "SPAT", newPath);
    }
  }

  snprintf(newPath, elcount(newPath), "%s.%s", oldPath, "likelyTime");
  if(value.likelyTime.isValidFlag==1)
  {
    C2xSetTokenInt(packetHandle, "SPAT", newPath, value.likelyTime.value);
    result = CheckLastError("SPAT", gkFuncRefGet, result);
  }
  else
  {
    if( C2xIsTokenAvailable(packetHandle, "SPAT", newPath) )
    {
      C2xRemoveToken(packetHandle, "SPAT", newPath);
    }
  }

  snprintf(newPath, elcount(newPath), "%s.%s", oldPath, "confidence");
  if(value.confidence.isValidFlag==1)
  {
    C2xSetTokenInt(packetHandle, "SPAT", newPath, value.confidence.value);
    result = CheckLastError("SPAT", gkFuncRefGet, result);
  }
  else
  {
    if( C2xIsTokenAvailable(packetHandle, "SPAT", newPath) )
    {
      C2xRemoveToken(packetHandle, "SPAT", newPath);
    }
  }

  snprintf(newPath, elcount(newPath), "%s.%s", oldPath, "nextTime");
  if(value.nextTime.isValidFlag==1)
  {
    C2xSetTokenInt(packetHandle, "SPAT", newPath, value.nextTime.value);
    result = CheckLastError("SPAT", gkFuncRefGet, result);
  }
  else
  {
    if( C2xIsTokenAvailable(packetHandle, "SPAT", newPath) )
    {
      C2xRemoveToken(packetHandle, "SPAT", newPath);
    }
  }

  return result;
}

int GetSPATCommon_RegionalExtension_Reg_MovementEvent_tableParams(LONG packetHandle, WORD tableKey, struct SPATCommon_RegionalExtension_Reg_MovementEvent_table value, char oldPath[])
{
  char newPath[300];
  int result;

  result = 0;

  switch(tableKey)
  {
    case 2:
    {
      snprintf(newPath, elcount(newPath), "%s.%s", oldPath, "addGrpB");
      GetSPATAddGrpB_MovementEvent_addGrpBParams(packetHandle, value.addGrpB, newPath);
      result = CheckLastError("SPAT", gkFuncRefGet, result);
    }
    break;
  }
  return result;
}

int SetSPATCommon_RegionalExtension_Reg_MovementEvent_tableParams(LONG packetHandle, WORD tableKey, struct SPATCommon_RegionalExtension_Reg_MovementEvent_table value, char oldPath[])
{
  char newPath[300];
  int result;

  result = 0;

  switch(tableKey)
  {
    case 2:
    {
      snprintf(newPath, elcount(newPath), "%s.%s", oldPath, "addGrpB");
      SetSPATAddGrpB_MovementEvent_addGrpBParams(packetHandle, value.addGrpB, newPath);
      result = CheckLastError("SPAT", gkFuncRefGet, result);
    }
    break;
  }
  return result;
}

int GetSPATCommon_RegionalExtension_Reg_MovementEventParams(LONG packetHandle, struct SPATCommon_RegionalExtension_Reg_MovementEvent value, char oldPath[])
{
  char newPath[300];
  int result;

  result = 0;

  snprintf(newPath, elcount(newPath), "%s.%s", oldPath, "regionId");
  value.regionId = C2xGetTokenInt(packetHandle, "SPAT", newPath);
  result = CheckLastError("SPAT", gkFuncRefGet, result);

  snprintf(newPath, elcount(newPath), "%s.%s", oldPath, "regExtvalue");
  GetSPATCommon_RegionalExtension_Reg_MovementEvent_tableParams(packetHandle, value.regionId, value.regExtvalue, newPath);
  result = CheckLastError("SPAT", gkFuncRefGet, result);

  return result;
}

int SetSPATCommon_RegionalExtension_Reg_MovementEventParams(LONG packetHandle, struct SPATCommon_RegionalExtension_Reg_MovementEvent value, char oldPath[])
{
  char newPath[300];
  int result;

  result = 0;


  snprintf(newPath, elcount(newPath), "%s.%s", oldPath, "regExtvalue");
  SetSPATCommon_RegionalExtension_Reg_MovementEvent_tableParams(packetHandle, value.regionId, value.regExtvalue, newPath);
  result = CheckLastError("SPAT", gkFuncRefGet, result);

  return result;
}

int GetSPATMovementEvent_regionalParams(LONG packetHandle, struct SPATMovementEvent_regional value, char oldPath[])
{
  char newPath[300]; 
  int i;
  int result;

  result = 0;

  value.length = C2xGetTokenInt(packetHandle, "SPAT", oldPath);
  if((result = CheckLastError("SPAT", gkFuncRefGet, result))==0)
  {
    for(i=0; i<value.length; i++)
    {
      snprintf(newPath, elcount(newPath), "%s[%d]", oldPath, i);
      GetSPATCommon_RegionalExtension_Reg_MovementEventParams(packetHandle, value.arrayValue[i], newPath);
      result = CheckLastError("SPAT", gkFuncRefGet, result);
    }
  }
  return result;
}

int SetSPATMovementEvent_regionalParams(LONG packetHandle, struct SPATMovementEvent_regional value, char oldPath[])
{
  char newPath[300]; 
  int i;
  int result;

  result = 0;

  C2xRemoveToken(packetHandle, "SPAT", oldPath);
  for(i=0; i<value.length; i++)
  {
    snprintf(newPath, elcount(newPath), "%s[%d]", oldPath, i);
    SetSPATCommon_RegionalExtension_Reg_MovementEventParams(packetHandle, value.arrayValue[i], newPath);
    result = CheckLastError("SPAT", gkFuncRefGet, result);
  }
  return result;
}

int GetSPATMovementEventParams(LONG packetHandle, struct SPATMovementEvent value, char oldPath[])
{
  char newPath[300];
  int result;

  result = 0;

  snprintf(newPath, elcount(newPath), "%s.%s", oldPath, "eventState");
  value.eventState = C2xGetTokenInt(packetHandle, "SPAT", newPath);
  result = CheckLastError("SPAT", gkFuncRefGet, result);

  snprintf(newPath, elcount(newPath), "%s.%s", oldPath, "timing");
  value.timing.isValidFlag = C2xIsTokenAvailable(packetHandle, "SPAT", newPath);
  if(value.timing.isValidFlag==1)
  {
    GetSPATTimeChangeDetailsParams(packetHandle, value.timing, newPath);
    result = CheckLastError("SPAT", gkFuncRefGet, result);
  }
  snprintf(newPath, elcount(newPath), "%s.%s", oldPath, "speeds");
  value.speeds.isValidFlag = C2xIsTokenAvailable(packetHandle, "SPAT", newPath);
  if(value.speeds.isValidFlag==1)
  {
    GetSPATAdvisorySpeedListParams(packetHandle, value.speeds, newPath);
    result = CheckLastError("SPAT", gkFuncRefGet, result);
  }
  snprintf(newPath, elcount(newPath), "%s.%s", oldPath, "regional");
  value.regional.isValidFlag = C2xIsTokenAvailable(packetHandle, "SPAT", newPath);
  if(value.regional.isValidFlag==1)
  {
    GetSPATMovementEvent_regionalParams(packetHandle, value.regional, newPath);
    result = CheckLastError("SPAT", gkFuncRefGet, result);
  }
  return result;
}

int SetSPATMovementEventParams(LONG packetHandle, struct SPATMovementEvent value, char oldPath[])
{
  char newPath[300];
  int result;

  result = 0;

  snprintf(newPath, elcount(newPath), "%s.%s", oldPath, "eventState");
  C2xSetTokenInt(packetHandle, "SPAT", newPath, value.eventState);
  result = CheckLastError("SPAT", gkFuncRefGet, result);

  snprintf(newPath, elcount(newPath), "%s.%s", oldPath, "timing");
  if(value.timing.isValidFlag==1)
  {
    SetSPATTimeChangeDetailsParams(packetHandle, value.timing, newPath);
    result = CheckLastError("SPAT", gkFuncRefGet, result);
  }
  else
  {
    if( C2xIsTokenAvailable(packetHandle, "SPAT", newPath) )
    {
      C2xRemoveToken(packetHandle, "SPAT", newPath);
    }
  }

  snprintf(newPath, elcount(newPath), "%s.%s", oldPath, "speeds");
  if(value.speeds.isValidFlag==1)
  {
    SetSPATAdvisorySpeedListParams(packetHandle, value.speeds, newPath);
    result = CheckLastError("SPAT", gkFuncRefGet, result);
  }
  else
  {
    if( C2xIsTokenAvailable(packetHandle, "SPAT", newPath) )
    {
      C2xRemoveToken(packetHandle, "SPAT", newPath);
    }
  }

  snprintf(newPath, elcount(newPath), "%s.%s", oldPath, "regional");
  if(value.regional.isValidFlag==1)
  {
    SetSPATMovementEvent_regionalParams(packetHandle, value.regional, newPath);
    result = CheckLastError("SPAT", gkFuncRefGet, result);
  }
  else
  {
    if( C2xIsTokenAvailable(packetHandle, "SPAT", newPath) )
    {
      C2xRemoveToken(packetHandle, "SPAT", newPath);
    }
  }

  return result;
}

int GetSPATMovementEventListParams(LONG packetHandle, struct SPATMovementEventList value, char oldPath[])
{
  char newPath[300]; 
  int i;
  int result;

  result = 0;

  value.length = C2xGetTokenInt(packetHandle, "SPAT", oldPath);
  if((result = CheckLastError("SPAT", gkFuncRefGet, result))==0)
  {
    for(i=0; i<value.length; i++)
    {
      snprintf(newPath, elcount(newPath), "%s[%d]", oldPath, i);
      GetSPATMovementEventParams(packetHandle, value.arrayValue[i], newPath);
      result = CheckLastError("SPAT", gkFuncRefGet, result);
    }
  }
  return result;
}

int SetSPATMovementEventListParams(LONG packetHandle, struct SPATMovementEventList value, char oldPath[])
{
  char newPath[300]; 
  int i;
  int result;

  result = 0;

  C2xRemoveToken(packetHandle, "SPAT", oldPath);
  for(i=0; i<value.length; i++)
  {
    snprintf(newPath, elcount(newPath), "%s[%d]", oldPath, i);
    SetSPATMovementEventParams(packetHandle, value.arrayValue[i], newPath);
    result = CheckLastError("SPAT", gkFuncRefGet, result);
  }
  return result;
}

int GetSPATAddGrpC_VehicleToLanePositionParams(LONG packetHandle, struct SPATAddGrpC_VehicleToLanePosition value, char oldPath[])
{
  char newPath[300];
  int result;

  result = 0;

  snprintf(newPath, elcount(newPath), "%s.%s", oldPath, "stationID");
  value.stationID = C2xGetTokenInt64(packetHandle, "SPAT", newPath);
  result = CheckLastError("SPAT", gkFuncRefGet, result);

  snprintf(newPath, elcount(newPath), "%s.%s", oldPath, "laneID");
  value.laneID = C2xGetTokenInt(packetHandle, "SPAT", newPath);
  result = CheckLastError("SPAT", gkFuncRefGet, result);

  return result;
}

int SetSPATAddGrpC_VehicleToLanePositionParams(LONG packetHandle, struct SPATAddGrpC_VehicleToLanePosition value, char oldPath[])
{
  char newPath[300];
  int result;

  result = 0;

  snprintf(newPath, elcount(newPath), "%s.%s", oldPath, "stationID");
  C2xSetTokenInt64(packetHandle, "SPAT", newPath, value.stationID);
  result = CheckLastError("SPAT", gkFuncRefGet, result);

  snprintf(newPath, elcount(newPath), "%s.%s", oldPath, "laneID");
  C2xSetTokenInt(packetHandle, "SPAT", newPath, value.laneID);
  result = CheckLastError("SPAT", gkFuncRefGet, result);

  return result;
}

int GetSPATAddGrpC_VehicleToLanePositionListParams(LONG packetHandle, struct SPATAddGrpC_VehicleToLanePositionList value, char oldPath[])
{
  char newPath[300]; 
  int i;
  int result;

  result = 0;

  value.length = C2xGetTokenInt(packetHandle, "SPAT", oldPath);
  if((result = CheckLastError("SPAT", gkFuncRefGet, result))==0)
  {
    for(i=0; i<value.length; i++)
    {
      snprintf(newPath, elcount(newPath), "%s[%d]", oldPath, i);
      GetSPATAddGrpC_VehicleToLanePositionParams(packetHandle, value.arrayValue[i], newPath);
      result = CheckLastError("SPAT", gkFuncRefGet, result);
    }
  }
  return result;
}

int SetSPATAddGrpC_VehicleToLanePositionListParams(LONG packetHandle, struct SPATAddGrpC_VehicleToLanePositionList value, char oldPath[])
{
  char newPath[300]; 
  int i;
  int result;

  result = 0;

  C2xRemoveToken(packetHandle, "SPAT", oldPath);
  for(i=0; i<value.length; i++)
  {
    snprintf(newPath, elcount(newPath), "%s[%d]", oldPath, i);
    SetSPATAddGrpC_VehicleToLanePositionParams(packetHandle, value.arrayValue[i], newPath);
    result = CheckLastError("SPAT", gkFuncRefGet, result);
  }
  return result;
}

int GetSPATCommon_Node_XY_20bParams(LONG packetHandle, struct SPATCommon_Node_XY_20b value, char oldPath[])
{
  char newPath[300];
  int result;

  result = 0;

  snprintf(newPath, elcount(newPath), "%s.%s", oldPath, "x");
  value.x = C2xGetTokenInt(packetHandle, "SPAT", newPath);
  result = CheckLastError("SPAT", gkFuncRefGet, result);

  snprintf(newPath, elcount(newPath), "%s.%s", oldPath, "y");
  value.y = C2xGetTokenInt(packetHandle, "SPAT", newPath);
  result = CheckLastError("SPAT", gkFuncRefGet, result);

  return result;
}

int SetSPATCommon_Node_XY_20bParams(LONG packetHandle, struct SPATCommon_Node_XY_20b value, char oldPath[])
{
  char newPath[300];
  int result;

  result = 0;

  snprintf(newPath, elcount(newPath), "%s.%s", oldPath, "x");
  C2xSetTokenInt(packetHandle, "SPAT", newPath, value.x);
  result = CheckLastError("SPAT", gkFuncRefGet, result);

  snprintf(newPath, elcount(newPath), "%s.%s", oldPath, "y");
  C2xSetTokenInt(packetHandle, "SPAT", newPath, value.y);
  result = CheckLastError("SPAT", gkFuncRefGet, result);

  return result;
}

int GetSPATCommon_Node_XY_22bParams(LONG packetHandle, struct SPATCommon_Node_XY_22b value, char oldPath[])
{
  char newPath[300];
  int result;

  result = 0;

  snprintf(newPath, elcount(newPath), "%s.%s", oldPath, "x");
  value.x = C2xGetTokenInt(packetHandle, "SPAT", newPath);
  result = CheckLastError("SPAT", gkFuncRefGet, result);

  snprintf(newPath, elcount(newPath), "%s.%s", oldPath, "y");
  value.y = C2xGetTokenInt(packetHandle, "SPAT", newPath);
  result = CheckLastError("SPAT", gkFuncRefGet, result);

  return result;
}

int SetSPATCommon_Node_XY_22bParams(LONG packetHandle, struct SPATCommon_Node_XY_22b value, char oldPath[])
{
  char newPath[300];
  int result;

  result = 0;

  snprintf(newPath, elcount(newPath), "%s.%s", oldPath, "x");
  C2xSetTokenInt(packetHandle, "SPAT", newPath, value.x);
  result = CheckLastError("SPAT", gkFuncRefGet, result);

  snprintf(newPath, elcount(newPath), "%s.%s", oldPath, "y");
  C2xSetTokenInt(packetHandle, "SPAT", newPath, value.y);
  result = CheckLastError("SPAT", gkFuncRefGet, result);

  return result;
}

int GetSPATCommon_Node_XY_24bParams(LONG packetHandle, struct SPATCommon_Node_XY_24b value, char oldPath[])
{
  char newPath[300];
  int result;

  result = 0;

  snprintf(newPath, elcount(newPath), "%s.%s", oldPath, "x");
  value.x = C2xGetTokenInt(packetHandle, "SPAT", newPath);
  result = CheckLastError("SPAT", gkFuncRefGet, result);

  snprintf(newPath, elcount(newPath), "%s.%s", oldPath, "y");
  value.y = C2xGetTokenInt(packetHandle, "SPAT", newPath);
  result = CheckLastError("SPAT", gkFuncRefGet, result);

  return result;
}

int SetSPATCommon_Node_XY_24bParams(LONG packetHandle, struct SPATCommon_Node_XY_24b value, char oldPath[])
{
  char newPath[300];
  int result;

  result = 0;

  snprintf(newPath, elcount(newPath), "%s.%s", oldPath, "x");
  C2xSetTokenInt(packetHandle, "SPAT", newPath, value.x);
  result = CheckLastError("SPAT", gkFuncRefGet, result);

  snprintf(newPath, elcount(newPath), "%s.%s", oldPath, "y");
  C2xSetTokenInt(packetHandle, "SPAT", newPath, value.y);
  result = CheckLastError("SPAT", gkFuncRefGet, result);

  return result;
}

int GetSPATCommon_Node_XY_26bParams(LONG packetHandle, struct SPATCommon_Node_XY_26b value, char oldPath[])
{
  char newPath[300];
  int result;

  result = 0;

  snprintf(newPath, elcount(newPath), "%s.%s", oldPath, "x");
  value.x = C2xGetTokenInt(packetHandle, "SPAT", newPath);
  result = CheckLastError("SPAT", gkFuncRefGet, result);

  snprintf(newPath, elcount(newPath), "%s.%s", oldPath, "y");
  value.y = C2xGetTokenInt(packetHandle, "SPAT", newPath);
  result = CheckLastError("SPAT", gkFuncRefGet, result);

  return result;
}

int SetSPATCommon_Node_XY_26bParams(LONG packetHandle, struct SPATCommon_Node_XY_26b value, char oldPath[])
{
  char newPath[300];
  int result;

  result = 0;

  snprintf(newPath, elcount(newPath), "%s.%s", oldPath, "x");
  C2xSetTokenInt(packetHandle, "SPAT", newPath, value.x);
  result = CheckLastError("SPAT", gkFuncRefGet, result);

  snprintf(newPath, elcount(newPath), "%s.%s", oldPath, "y");
  C2xSetTokenInt(packetHandle, "SPAT", newPath, value.y);
  result = CheckLastError("SPAT", gkFuncRefGet, result);

  return result;
}

int GetSPATCommon_Node_XY_28bParams(LONG packetHandle, struct SPATCommon_Node_XY_28b value, char oldPath[])
{
  char newPath[300];
  int result;

  result = 0;

  snprintf(newPath, elcount(newPath), "%s.%s", oldPath, "x");
  value.x = C2xGetTokenInt(packetHandle, "SPAT", newPath);
  result = CheckLastError("SPAT", gkFuncRefGet, result);

  snprintf(newPath, elcount(newPath), "%s.%s", oldPath, "y");
  value.y = C2xGetTokenInt(packetHandle, "SPAT", newPath);
  result = CheckLastError("SPAT", gkFuncRefGet, result);

  return result;
}

int SetSPATCommon_Node_XY_28bParams(LONG packetHandle, struct SPATCommon_Node_XY_28b value, char oldPath[])
{
  char newPath[300];
  int result;

  result = 0;

  snprintf(newPath, elcount(newPath), "%s.%s", oldPath, "x");
  C2xSetTokenInt(packetHandle, "SPAT", newPath, value.x);
  result = CheckLastError("SPAT", gkFuncRefGet, result);

  snprintf(newPath, elcount(newPath), "%s.%s", oldPath, "y");
  C2xSetTokenInt(packetHandle, "SPAT", newPath, value.y);
  result = CheckLastError("SPAT", gkFuncRefGet, result);

  return result;
}

int GetSPATCommon_Node_XY_32bParams(LONG packetHandle, struct SPATCommon_Node_XY_32b value, char oldPath[])
{
  char newPath[300];
  int result;

  result = 0;

  snprintf(newPath, elcount(newPath), "%s.%s", oldPath, "x");
  value.x = C2xGetTokenInt(packetHandle, "SPAT", newPath);
  result = CheckLastError("SPAT", gkFuncRefGet, result);

  snprintf(newPath, elcount(newPath), "%s.%s", oldPath, "y");
  value.y = C2xGetTokenInt(packetHandle, "SPAT", newPath);
  result = CheckLastError("SPAT", gkFuncRefGet, result);

  return result;
}

int SetSPATCommon_Node_XY_32bParams(LONG packetHandle, struct SPATCommon_Node_XY_32b value, char oldPath[])
{
  char newPath[300];
  int result;

  result = 0;

  snprintf(newPath, elcount(newPath), "%s.%s", oldPath, "x");
  C2xSetTokenInt(packetHandle, "SPAT", newPath, value.x);
  result = CheckLastError("SPAT", gkFuncRefGet, result);

  snprintf(newPath, elcount(newPath), "%s.%s", oldPath, "y");
  C2xSetTokenInt(packetHandle, "SPAT", newPath, value.y);
  result = CheckLastError("SPAT", gkFuncRefGet, result);

  return result;
}

int GetSPATCommon_Node_LLmD_64bParams(LONG packetHandle, struct SPATCommon_Node_LLmD_64b value, char oldPath[])
{
  char newPath[300];
  int result;

  result = 0;

  snprintf(newPath, elcount(newPath), "%s.%s", oldPath, "lon");
  value.lon = C2xGetTokenInt(packetHandle, "SPAT", newPath);
  result = CheckLastError("SPAT", gkFuncRefGet, result);

  snprintf(newPath, elcount(newPath), "%s.%s", oldPath, "lat");
  value.lat = C2xGetTokenInt(packetHandle, "SPAT", newPath);
  result = CheckLastError("SPAT", gkFuncRefGet, result);

  return result;
}

int SetSPATCommon_Node_LLmD_64bParams(LONG packetHandle, struct SPATCommon_Node_LLmD_64b value, char oldPath[])
{
  char newPath[300];
  int result;

  result = 0;

  snprintf(newPath, elcount(newPath), "%s.%s", oldPath, "lon");
  C2xSetTokenInt(packetHandle, "SPAT", newPath, value.lon);
  result = CheckLastError("SPAT", gkFuncRefGet, result);

  snprintf(newPath, elcount(newPath), "%s.%s", oldPath, "lat");
  C2xSetTokenInt(packetHandle, "SPAT", newPath, value.lat);
  result = CheckLastError("SPAT", gkFuncRefGet, result);

  return result;
}

int GetSPATAddGrpB_Node_LLdms_48bParams(LONG packetHandle, struct SPATAddGrpB_Node_LLdms_48b value, char oldPath[])
{
  char newPath[300];
  int result;

  result = 0;

  snprintf(newPath, elcount(newPath), "%s.%s", oldPath, "lon");
  value.lon = C2xGetTokenInt(packetHandle, "SPAT", newPath);
  result = CheckLastError("SPAT", gkFuncRefGet, result);

  snprintf(newPath, elcount(newPath), "%s.%s", oldPath, "lat");
  value.lat = C2xGetTokenInt(packetHandle, "SPAT", newPath);
  result = CheckLastError("SPAT", gkFuncRefGet, result);

  return result;
}

int SetSPATAddGrpB_Node_LLdms_48bParams(LONG packetHandle, struct SPATAddGrpB_Node_LLdms_48b value, char oldPath[])
{
  char newPath[300];
  int result;

  result = 0;

  snprintf(newPath, elcount(newPath), "%s.%s", oldPath, "lon");
  C2xSetTokenInt(packetHandle, "SPAT", newPath, value.lon);
  result = CheckLastError("SPAT", gkFuncRefGet, result);

  snprintf(newPath, elcount(newPath), "%s.%s", oldPath, "lat");
  C2xSetTokenInt(packetHandle, "SPAT", newPath, value.lat);
  result = CheckLastError("SPAT", gkFuncRefGet, result);

  return result;
}

int GetSPATAddGrpB_LongitudeDMS2Params(LONG packetHandle, struct SPATAddGrpB_LongitudeDMS2 value, char oldPath[])
{
  char newPath[300];
  int result;

  result = 0;

  snprintf(newPath, elcount(newPath), "%s.%s", oldPath, "d");
  value.d = C2xGetTokenInt(packetHandle, "SPAT", newPath);
  result = CheckLastError("SPAT", gkFuncRefGet, result);

  snprintf(newPath, elcount(newPath), "%s.%s", oldPath, "m");
  value.m = C2xGetTokenInt(packetHandle, "SPAT", newPath);
  result = CheckLastError("SPAT", gkFuncRefGet, result);

  snprintf(newPath, elcount(newPath), "%s.%s", oldPath, "s");
  value.s = C2xGetTokenInt(packetHandle, "SPAT", newPath);
  result = CheckLastError("SPAT", gkFuncRefGet, result);

  return result;
}

int SetSPATAddGrpB_LongitudeDMS2Params(LONG packetHandle, struct SPATAddGrpB_LongitudeDMS2 value, char oldPath[])
{
  char newPath[300];
  int result;

  result = 0;

  snprintf(newPath, elcount(newPath), "%s.%s", oldPath, "d");
  C2xSetTokenInt(packetHandle, "SPAT", newPath, value.d);
  result = CheckLastError("SPAT", gkFuncRefGet, result);

  snprintf(newPath, elcount(newPath), "%s.%s", oldPath, "m");
  C2xSetTokenInt(packetHandle, "SPAT", newPath, value.m);
  result = CheckLastError("SPAT", gkFuncRefGet, result);

  snprintf(newPath, elcount(newPath), "%s.%s", oldPath, "s");
  C2xSetTokenInt(packetHandle, "SPAT", newPath, value.s);
  result = CheckLastError("SPAT", gkFuncRefGet, result);

  return result;
}

int GetSPATAddGrpB_LatitudeDMS2Params(LONG packetHandle, struct SPATAddGrpB_LatitudeDMS2 value, char oldPath[])
{
  char newPath[300];
  int result;

  result = 0;

  snprintf(newPath, elcount(newPath), "%s.%s", oldPath, "d");
  value.d = C2xGetTokenInt(packetHandle, "SPAT", newPath);
  result = CheckLastError("SPAT", gkFuncRefGet, result);

  snprintf(newPath, elcount(newPath), "%s.%s", oldPath, "m");
  value.m = C2xGetTokenInt(packetHandle, "SPAT", newPath);
  result = CheckLastError("SPAT", gkFuncRefGet, result);

  snprintf(newPath, elcount(newPath), "%s.%s", oldPath, "s");
  value.s = C2xGetTokenInt(packetHandle, "SPAT", newPath);
  result = CheckLastError("SPAT", gkFuncRefGet, result);

  return result;
}

int SetSPATAddGrpB_LatitudeDMS2Params(LONG packetHandle, struct SPATAddGrpB_LatitudeDMS2 value, char oldPath[])
{
  char newPath[300];
  int result;

  result = 0;

  snprintf(newPath, elcount(newPath), "%s.%s", oldPath, "d");
  C2xSetTokenInt(packetHandle, "SPAT", newPath, value.d);
  result = CheckLastError("SPAT", gkFuncRefGet, result);

  snprintf(newPath, elcount(newPath), "%s.%s", oldPath, "m");
  C2xSetTokenInt(packetHandle, "SPAT", newPath, value.m);
  result = CheckLastError("SPAT", gkFuncRefGet, result);

  snprintf(newPath, elcount(newPath), "%s.%s", oldPath, "s");
  C2xSetTokenInt(packetHandle, "SPAT", newPath, value.s);
  result = CheckLastError("SPAT", gkFuncRefGet, result);

  return result;
}

int GetSPATAddGrpB_Node_LLdms_80bParams(LONG packetHandle, struct SPATAddGrpB_Node_LLdms_80b value, char oldPath[])
{
  char newPath[300];
  int result;

  result = 0;

  snprintf(newPath, elcount(newPath), "%s.%s", oldPath, "lon");
  GetSPATAddGrpB_LongitudeDMS2Params(packetHandle, value.lon, newPath);
  result = CheckLastError("SPAT", gkFuncRefGet, result);

  snprintf(newPath, elcount(newPath), "%s.%s", oldPath, "lat");
  GetSPATAddGrpB_LatitudeDMS2Params(packetHandle, value.lat, newPath);
  result = CheckLastError("SPAT", gkFuncRefGet, result);

  return result;
}

int SetSPATAddGrpB_Node_LLdms_80bParams(LONG packetHandle, struct SPATAddGrpB_Node_LLdms_80b value, char oldPath[])
{
  char newPath[300];
  int result;

  result = 0;

  snprintf(newPath, elcount(newPath), "%s.%s", oldPath, "lon");
  SetSPATAddGrpB_LongitudeDMS2Params(packetHandle, value.lon, newPath);
  result = CheckLastError("SPAT", gkFuncRefGet, result);

  snprintf(newPath, elcount(newPath), "%s.%s", oldPath, "lat");
  SetSPATAddGrpB_LatitudeDMS2Params(packetHandle, value.lat, newPath);
  result = CheckLastError("SPAT", gkFuncRefGet, result);

  return result;
}

int GetSPATAddGrpB_NodeOffsetPointXY_addGrpBParams(LONG packetHandle, struct SPATAddGrpB_NodeOffsetPointXY_addGrpB value, char oldPath[])
{
  char newPath[300];
  int result;

  result = 0;

  value.choice = C2xGetTokenInt(packetHandle, "SPAT", oldPath);

  switch(value.choice)
  {
    case 0:
    {
      snprintf(newPath, elcount(newPath), "%s.%s", oldPath, "posA");
      GetSPATAddGrpB_Node_LLdms_48bParams(packetHandle, value.posA, newPath);
      result = CheckLastError("SPAT", gkFuncRefGet, result);
    }
    break;
    case 1:
    {
      snprintf(newPath, elcount(newPath), "%s.%s", oldPath, "posB");
      GetSPATAddGrpB_Node_LLdms_80bParams(packetHandle, value.posB, newPath);
      result = CheckLastError("SPAT", gkFuncRefGet, result);
    }
    break;
  }
  return result;
}

int SetSPATAddGrpB_NodeOffsetPointXY_addGrpBParams(LONG packetHandle, struct SPATAddGrpB_NodeOffsetPointXY_addGrpB value, char oldPath[])
{
  char newPath[300];
  int result;

  result = 0;

  switch(value.choice)
  {
    case 0:
    {
      snprintf(newPath, elcount(newPath), "%s.%s", oldPath, "posA");
      SetSPATAddGrpB_Node_LLdms_48bParams(packetHandle, value.posA, newPath);
      result = CheckLastError("SPAT", gkFuncRefGet, result);
    }
    break;
    case 1:
    {
      snprintf(newPath, elcount(newPath), "%s.%s", oldPath, "posB");
      SetSPATAddGrpB_Node_LLdms_80bParams(packetHandle, value.posB, newPath);
      result = CheckLastError("SPAT", gkFuncRefGet, result);
    }
    break;
  }
  return result;
}

int GetSPATCommon_RegionalExtension_Reg_NodeOffsetPointXY_tableParams(LONG packetHandle, WORD tableKey, struct SPATCommon_RegionalExtension_Reg_NodeOffsetPointXY_table value, char oldPath[])
{
  char newPath[300];
  int result;

  result = 0;

  switch(tableKey)
  {
    case 2:
    {
      snprintf(newPath, elcount(newPath), "%s.%s", oldPath, "addGrpB");
      GetSPATAddGrpB_NodeOffsetPointXY_addGrpBParams(packetHandle, value.addGrpB, newPath);
      result = CheckLastError("SPAT", gkFuncRefGet, result);
    }
    break;
  }
  return result;
}

int SetSPATCommon_RegionalExtension_Reg_NodeOffsetPointXY_tableParams(LONG packetHandle, WORD tableKey, struct SPATCommon_RegionalExtension_Reg_NodeOffsetPointXY_table value, char oldPath[])
{
  char newPath[300];
  int result;

  result = 0;

  switch(tableKey)
  {
    case 2:
    {
      snprintf(newPath, elcount(newPath), "%s.%s", oldPath, "addGrpB");
      SetSPATAddGrpB_NodeOffsetPointXY_addGrpBParams(packetHandle, value.addGrpB, newPath);
      result = CheckLastError("SPAT", gkFuncRefGet, result);
    }
    break;
  }
  return result;
}

int GetSPATCommon_RegionalExtension_Reg_NodeOffsetPointXYParams(LONG packetHandle, struct SPATCommon_RegionalExtension_Reg_NodeOffsetPointXY value, char oldPath[])
{
  char newPath[300];
  int result;

  result = 0;

  snprintf(newPath, elcount(newPath), "%s.%s", oldPath, "regionId");
  value.regionId = C2xGetTokenInt(packetHandle, "SPAT", newPath);
  result = CheckLastError("SPAT", gkFuncRefGet, result);

  snprintf(newPath, elcount(newPath), "%s.%s", oldPath, "regExtvalue");
  GetSPATCommon_RegionalExtension_Reg_NodeOffsetPointXY_tableParams(packetHandle, value.regionId, value.regExtvalue, newPath);
  result = CheckLastError("SPAT", gkFuncRefGet, result);

  return result;
}

int SetSPATCommon_RegionalExtension_Reg_NodeOffsetPointXYParams(LONG packetHandle, struct SPATCommon_RegionalExtension_Reg_NodeOffsetPointXY value, char oldPath[])
{
  char newPath[300];
  int result;

  result = 0;


  snprintf(newPath, elcount(newPath), "%s.%s", oldPath, "regExtvalue");
  SetSPATCommon_RegionalExtension_Reg_NodeOffsetPointXY_tableParams(packetHandle, value.regionId, value.regExtvalue, newPath);
  result = CheckLastError("SPAT", gkFuncRefGet, result);

  return result;
}

int GetSPATCommon_NodeOffsetPointXYParams(LONG packetHandle, struct SPATCommon_NodeOffsetPointXY value, char oldPath[])
{
  char newPath[300];
  int result;

  result = 0;

  value.choice = C2xGetTokenInt(packetHandle, "SPAT", oldPath);

  switch(value.choice)
  {
    case 0:
    {
      snprintf(newPath, elcount(newPath), "%s.%s", oldPath, "node_XY1");
      GetSPATCommon_Node_XY_20bParams(packetHandle, value.node_XY1, newPath);
      result = CheckLastError("SPAT", gkFuncRefGet, result);
    }
    break;
    case 1:
    {
      snprintf(newPath, elcount(newPath), "%s.%s", oldPath, "node_XY2");
      GetSPATCommon_Node_XY_22bParams(packetHandle, value.node_XY2, newPath);
      result = CheckLastError("SPAT", gkFuncRefGet, result);
    }
    break;
    case 2:
    {
      snprintf(newPath, elcount(newPath), "%s.%s", oldPath, "node_XY3");
      GetSPATCommon_Node_XY_24bParams(packetHandle, value.node_XY3, newPath);
      result = CheckLastError("SPAT", gkFuncRefGet, result);
    }
    break;
    case 3:
    {
      snprintf(newPath, elcount(newPath), "%s.%s", oldPath, "node_XY4");
      GetSPATCommon_Node_XY_26bParams(packetHandle, value.node_XY4, newPath);
      result = CheckLastError("SPAT", gkFuncRefGet, result);
    }
    break;
    case 4:
    {
      snprintf(newPath, elcount(newPath), "%s.%s", oldPath, "node_XY5");
      GetSPATCommon_Node_XY_28bParams(packetHandle, value.node_XY5, newPath);
      result = CheckLastError("SPAT", gkFuncRefGet, result);
    }
    break;
    case 5:
    {
      snprintf(newPath, elcount(newPath), "%s.%s", oldPath, "node_XY6");
      GetSPATCommon_Node_XY_32bParams(packetHandle, value.node_XY6, newPath);
      result = CheckLastError("SPAT", gkFuncRefGet, result);
    }
    break;
    case 6:
    {
      snprintf(newPath, elcount(newPath), "%s.%s", oldPath, "node_LatLon");
      GetSPATCommon_Node_LLmD_64bParams(packetHandle, value.node_LatLon, newPath);
      result = CheckLastError("SPAT", gkFuncRefGet, result);
    }
    break;
    case 7:
    {
      snprintf(newPath, elcount(newPath), "%s.%s", oldPath, "regional");
      GetSPATCommon_RegionalExtension_Reg_NodeOffsetPointXYParams(packetHandle, value.regional, newPath);
      result = CheckLastError("SPAT", gkFuncRefGet, result);
    }
    break;
  }
  return result;
}

int SetSPATCommon_NodeOffsetPointXYParams(LONG packetHandle, struct SPATCommon_NodeOffsetPointXY value, char oldPath[])
{
  char newPath[300];
  int result;

  result = 0;

  switch(value.choice)
  {
    case 0:
    {
      snprintf(newPath, elcount(newPath), "%s.%s", oldPath, "node_XY1");
      SetSPATCommon_Node_XY_20bParams(packetHandle, value.node_XY1, newPath);
      result = CheckLastError("SPAT", gkFuncRefGet, result);
    }
    break;
    case 1:
    {
      snprintf(newPath, elcount(newPath), "%s.%s", oldPath, "node_XY2");
      SetSPATCommon_Node_XY_22bParams(packetHandle, value.node_XY2, newPath);
      result = CheckLastError("SPAT", gkFuncRefGet, result);
    }
    break;
    case 2:
    {
      snprintf(newPath, elcount(newPath), "%s.%s", oldPath, "node_XY3");
      SetSPATCommon_Node_XY_24bParams(packetHandle, value.node_XY3, newPath);
      result = CheckLastError("SPAT", gkFuncRefGet, result);
    }
    break;
    case 3:
    {
      snprintf(newPath, elcount(newPath), "%s.%s", oldPath, "node_XY4");
      SetSPATCommon_Node_XY_26bParams(packetHandle, value.node_XY4, newPath);
      result = CheckLastError("SPAT", gkFuncRefGet, result);
    }
    break;
    case 4:
    {
      snprintf(newPath, elcount(newPath), "%s.%s", oldPath, "node_XY5");
      SetSPATCommon_Node_XY_28bParams(packetHandle, value.node_XY5, newPath);
      result = CheckLastError("SPAT", gkFuncRefGet, result);
    }
    break;
    case 5:
    {
      snprintf(newPath, elcount(newPath), "%s.%s", oldPath, "node_XY6");
      SetSPATCommon_Node_XY_32bParams(packetHandle, value.node_XY6, newPath);
      result = CheckLastError("SPAT", gkFuncRefGet, result);
    }
    break;
    case 6:
    {
      snprintf(newPath, elcount(newPath), "%s.%s", oldPath, "node_LatLon");
      SetSPATCommon_Node_LLmD_64bParams(packetHandle, value.node_LatLon, newPath);
      result = CheckLastError("SPAT", gkFuncRefGet, result);
    }
    break;
    case 7:
    {
      snprintf(newPath, elcount(newPath), "%s.%s", oldPath, "regional");
      SetSPATCommon_RegionalExtension_Reg_NodeOffsetPointXYParams(packetHandle, value.regional, newPath);
      result = CheckLastError("SPAT", gkFuncRefGet, result);
    }
    break;
  }
  return result;
}

int GetSPATAddGrpC_ConnectionManeuverAssist_addGrpCParams(LONG packetHandle, struct SPATAddGrpC_ConnectionManeuverAssist_addGrpC value, char oldPath[])
{
  char newPath[300];
  int result;

  result = 0;

  snprintf(newPath, elcount(newPath), "%s.%s", oldPath, "vehicleToLanePositions");
  GetSPATAddGrpC_VehicleToLanePositionListParams(packetHandle, value.vehicleToLanePositions, newPath);
  result = CheckLastError("SPAT", gkFuncRefGet, result);

  snprintf(newPath, elcount(newPath), "%s.%s", oldPath, "rsuDistanceFromAnchor");
  value.rsuDistanceFromAnchor.isValidFlag = C2xIsTokenAvailable(packetHandle, "SPAT", newPath);
  if(value.rsuDistanceFromAnchor.isValidFlag==1)
  {
    GetSPATCommon_NodeOffsetPointXYParams(packetHandle, value.rsuDistanceFromAnchor, newPath);
    result = CheckLastError("SPAT", gkFuncRefGet, result);
  }
  return result;
}

int SetSPATAddGrpC_ConnectionManeuverAssist_addGrpCParams(LONG packetHandle, struct SPATAddGrpC_ConnectionManeuverAssist_addGrpC value, char oldPath[])
{
  char newPath[300];
  int result;

  result = 0;

  snprintf(newPath, elcount(newPath), "%s.%s", oldPath, "vehicleToLanePositions");
  SetSPATAddGrpC_VehicleToLanePositionListParams(packetHandle, value.vehicleToLanePositions, newPath);
  result = CheckLastError("SPAT", gkFuncRefGet, result);

  snprintf(newPath, elcount(newPath), "%s.%s", oldPath, "rsuDistanceFromAnchor");
  if(value.rsuDistanceFromAnchor.isValidFlag==1)
  {
    SetSPATCommon_NodeOffsetPointXYParams(packetHandle, value.rsuDistanceFromAnchor, newPath);
    result = CheckLastError("SPAT", gkFuncRefGet, result);
  }
  else
  {
    if( C2xIsTokenAvailable(packetHandle, "SPAT", newPath) )
    {
      C2xRemoveToken(packetHandle, "SPAT", newPath);
    }
  }

  return result;
}

int GetSPATCommon_RegionalExtension_Reg_ConnectionManeuverAssist_tableParams(LONG packetHandle, WORD tableKey, struct SPATCommon_RegionalExtension_Reg_ConnectionManeuverAssist_table value, char oldPath[])
{
  char newPath[300];
  int result;

  result = 0;

  switch(tableKey)
  {
    case 3:
    {
      snprintf(newPath, elcount(newPath), "%s.%s", oldPath, "addGrpC");
      GetSPATAddGrpC_ConnectionManeuverAssist_addGrpCParams(packetHandle, value.addGrpC, newPath);
      result = CheckLastError("SPAT", gkFuncRefGet, result);
    }
    break;
  }
  return result;
}

int SetSPATCommon_RegionalExtension_Reg_ConnectionManeuverAssist_tableParams(LONG packetHandle, WORD tableKey, struct SPATCommon_RegionalExtension_Reg_ConnectionManeuverAssist_table value, char oldPath[])
{
  char newPath[300];
  int result;

  result = 0;

  switch(tableKey)
  {
    case 3:
    {
      snprintf(newPath, elcount(newPath), "%s.%s", oldPath, "addGrpC");
      SetSPATAddGrpC_ConnectionManeuverAssist_addGrpCParams(packetHandle, value.addGrpC, newPath);
      result = CheckLastError("SPAT", gkFuncRefGet, result);
    }
    break;
  }
  return result;
}

int GetSPATCommon_RegionalExtension_Reg_ConnectionManeuverAssistParams(LONG packetHandle, struct SPATCommon_RegionalExtension_Reg_ConnectionManeuverAssist value, char oldPath[])
{
  char newPath[300];
  int result;

  result = 0;

  snprintf(newPath, elcount(newPath), "%s.%s", oldPath, "regionId");
  value.regionId = C2xGetTokenInt(packetHandle, "SPAT", newPath);
  result = CheckLastError("SPAT", gkFuncRefGet, result);

  snprintf(newPath, elcount(newPath), "%s.%s", oldPath, "regExtvalue");
  GetSPATCommon_RegionalExtension_Reg_ConnectionManeuverAssist_tableParams(packetHandle, value.regionId, value.regExtvalue, newPath);
  result = CheckLastError("SPAT", gkFuncRefGet, result);

  return result;
}

int SetSPATCommon_RegionalExtension_Reg_ConnectionManeuverAssistParams(LONG packetHandle, struct SPATCommon_RegionalExtension_Reg_ConnectionManeuverAssist value, char oldPath[])
{
  char newPath[300];
  int result;

  result = 0;


  snprintf(newPath, elcount(newPath), "%s.%s", oldPath, "regExtvalue");
  SetSPATCommon_RegionalExtension_Reg_ConnectionManeuverAssist_tableParams(packetHandle, value.regionId, value.regExtvalue, newPath);
  result = CheckLastError("SPAT", gkFuncRefGet, result);

  return result;
}

int GetSPATConnectionManeuverAssist_regionalParams(LONG packetHandle, struct SPATConnectionManeuverAssist_regional value, char oldPath[])
{
  char newPath[300]; 
  int i;
  int result;

  result = 0;

  value.length = C2xGetTokenInt(packetHandle, "SPAT", oldPath);
  if((result = CheckLastError("SPAT", gkFuncRefGet, result))==0)
  {
    for(i=0; i<value.length; i++)
    {
      snprintf(newPath, elcount(newPath), "%s[%d]", oldPath, i);
      GetSPATCommon_RegionalExtension_Reg_ConnectionManeuverAssistParams(packetHandle, value.arrayValue[i], newPath);
      result = CheckLastError("SPAT", gkFuncRefGet, result);
    }
  }
  return result;
}

int SetSPATConnectionManeuverAssist_regionalParams(LONG packetHandle, struct SPATConnectionManeuverAssist_regional value, char oldPath[])
{
  char newPath[300]; 
  int i;
  int result;

  result = 0;

  C2xRemoveToken(packetHandle, "SPAT", oldPath);
  for(i=0; i<value.length; i++)
  {
    snprintf(newPath, elcount(newPath), "%s[%d]", oldPath, i);
    SetSPATCommon_RegionalExtension_Reg_ConnectionManeuverAssistParams(packetHandle, value.arrayValue[i], newPath);
    result = CheckLastError("SPAT", gkFuncRefGet, result);
  }
  return result;
}

int GetSPATConnectionManeuverAssistParams(LONG packetHandle, struct SPATConnectionManeuverAssist value, char oldPath[])
{
  char newPath[300];
  int result;

  result = 0;

  snprintf(newPath, elcount(newPath), "%s.%s", oldPath, "connectionID");
  value.connectionID = C2xGetTokenInt(packetHandle, "SPAT", newPath);
  result = CheckLastError("SPAT", gkFuncRefGet, result);

  snprintf(newPath, elcount(newPath), "%s.%s", oldPath, "queueLength");
  value.queueLength.isValidFlag = C2xIsTokenAvailable(packetHandle, "SPAT", newPath);
  if(value.queueLength.isValidFlag==1)
  {
    value.queueLength.value = C2xGetTokenInt(packetHandle, "SPAT", newPath);
    result = CheckLastError("SPAT", gkFuncRefGet, result);
  }
  snprintf(newPath, elcount(newPath), "%s.%s", oldPath, "availableStorageLength");
  value.availableStorageLength.isValidFlag = C2xIsTokenAvailable(packetHandle, "SPAT", newPath);
  if(value.availableStorageLength.isValidFlag==1)
  {
    value.availableStorageLength.value = C2xGetTokenInt(packetHandle, "SPAT", newPath);
    result = CheckLastError("SPAT", gkFuncRefGet, result);
  }
  snprintf(newPath, elcount(newPath), "%s.%s", oldPath, "waitOnStop");
  value.waitOnStop.isValidFlag = C2xIsTokenAvailable(packetHandle, "SPAT", newPath);
  if(value.waitOnStop.isValidFlag==1)
  {
    value.waitOnStop.value = C2xGetTokenInt64(packetHandle, "SPAT", newPath);
    result = CheckLastError("SPAT", gkFuncRefGet, result);
  }
  snprintf(newPath, elcount(newPath), "%s.%s", oldPath, "pedBicycleDetect");
  value.pedBicycleDetect.isValidFlag = C2xIsTokenAvailable(packetHandle, "SPAT", newPath);
  if(value.pedBicycleDetect.isValidFlag==1)
  {
    value.pedBicycleDetect.value = C2xGetTokenInt64(packetHandle, "SPAT", newPath);
    result = CheckLastError("SPAT", gkFuncRefGet, result);
  }
  snprintf(newPath, elcount(newPath), "%s.%s", oldPath, "regional");
  value.regional.isValidFlag = C2xIsTokenAvailable(packetHandle, "SPAT", newPath);
  if(value.regional.isValidFlag==1)
  {
    GetSPATConnectionManeuverAssist_regionalParams(packetHandle, value.regional, newPath);
    result = CheckLastError("SPAT", gkFuncRefGet, result);
  }
  return result;
}

int SetSPATConnectionManeuverAssistParams(LONG packetHandle, struct SPATConnectionManeuverAssist value, char oldPath[])
{
  char newPath[300];
  int result;

  result = 0;

  snprintf(newPath, elcount(newPath), "%s.%s", oldPath, "connectionID");
  C2xSetTokenInt(packetHandle, "SPAT", newPath, value.connectionID);
  result = CheckLastError("SPAT", gkFuncRefGet, result);

  snprintf(newPath, elcount(newPath), "%s.%s", oldPath, "queueLength");
  if(value.queueLength.isValidFlag==1)
  {
    C2xSetTokenInt(packetHandle, "SPAT", newPath, value.queueLength.value);
    result = CheckLastError("SPAT", gkFuncRefGet, result);
  }
  else
  {
    if( C2xIsTokenAvailable(packetHandle, "SPAT", newPath) )
    {
      C2xRemoveToken(packetHandle, "SPAT", newPath);
    }
  }

  snprintf(newPath, elcount(newPath), "%s.%s", oldPath, "availableStorageLength");
  if(value.availableStorageLength.isValidFlag==1)
  {
    C2xSetTokenInt(packetHandle, "SPAT", newPath, value.availableStorageLength.value);
    result = CheckLastError("SPAT", gkFuncRefGet, result);
  }
  else
  {
    if( C2xIsTokenAvailable(packetHandle, "SPAT", newPath) )
    {
      C2xRemoveToken(packetHandle, "SPAT", newPath);
    }
  }

  snprintf(newPath, elcount(newPath), "%s.%s", oldPath, "waitOnStop");
  if(value.waitOnStop.isValidFlag==1)
  {
    C2xSetTokenInt64(packetHandle, "SPAT", newPath, value.waitOnStop.value);
    result = CheckLastError("SPAT", gkFuncRefGet, result);
  }
  else
  {
    if( C2xIsTokenAvailable(packetHandle, "SPAT", newPath) )
    {
      C2xRemoveToken(packetHandle, "SPAT", newPath);
    }
  }

  snprintf(newPath, elcount(newPath), "%s.%s", oldPath, "pedBicycleDetect");
  if(value.pedBicycleDetect.isValidFlag==1)
  {
    C2xSetTokenInt64(packetHandle, "SPAT", newPath, value.pedBicycleDetect.value);
    result = CheckLastError("SPAT", gkFuncRefGet, result);
  }
  else
  {
    if( C2xIsTokenAvailable(packetHandle, "SPAT", newPath) )
    {
      C2xRemoveToken(packetHandle, "SPAT", newPath);
    }
  }

  snprintf(newPath, elcount(newPath), "%s.%s", oldPath, "regional");
  if(value.regional.isValidFlag==1)
  {
    SetSPATConnectionManeuverAssist_regionalParams(packetHandle, value.regional, newPath);
    result = CheckLastError("SPAT", gkFuncRefGet, result);
  }
  else
  {
    if( C2xIsTokenAvailable(packetHandle, "SPAT", newPath) )
    {
      C2xRemoveToken(packetHandle, "SPAT", newPath);
    }
  }

  return result;
}

int GetSPATManeuverAssistListParams(LONG packetHandle, struct SPATManeuverAssistList value, char oldPath[])
{
  char newPath[300]; 
  int i;
  int result;

  result = 0;

  value.length = C2xGetTokenInt(packetHandle, "SPAT", oldPath);
  if((result = CheckLastError("SPAT", gkFuncRefGet, result))==0)
  {
    for(i=0; i<value.length; i++)
    {
      snprintf(newPath, elcount(newPath), "%s[%d]", oldPath, i);
      GetSPATConnectionManeuverAssistParams(packetHandle, value.arrayValue[i], newPath);
      result = CheckLastError("SPAT", gkFuncRefGet, result);
    }
  }
  return result;
}

int SetSPATManeuverAssistListParams(LONG packetHandle, struct SPATManeuverAssistList value, char oldPath[])
{
  char newPath[300]; 
  int i;
  int result;

  result = 0;

  C2xRemoveToken(packetHandle, "SPAT", oldPath);
  for(i=0; i<value.length; i++)
  {
    snprintf(newPath, elcount(newPath), "%s[%d]", oldPath, i);
    SetSPATConnectionManeuverAssistParams(packetHandle, value.arrayValue[i], newPath);
    result = CheckLastError("SPAT", gkFuncRefGet, result);
  }
  return result;
}

int GetSPATCommon_RegionalExtension_Reg_MovementStateParams(LONG packetHandle, struct SPATCommon_RegionalExtension_Reg_MovementState value, char oldPath[])
{
  char newPath[300];
  int result;

  result = 0;

  snprintf(newPath, elcount(newPath), "%s.%s", oldPath, "regionId");
  value.regionId = C2xGetTokenInt(packetHandle, "SPAT", newPath);
  result = CheckLastError("SPAT", gkFuncRefGet, result);

  return result;
}

int SetSPATCommon_RegionalExtension_Reg_MovementStateParams(LONG packetHandle, struct SPATCommon_RegionalExtension_Reg_MovementState value, char oldPath[])
{
  char newPath[300];
  int result;

  result = 0;


  return result;
}

int GetSPATMovementState_regionalParams(LONG packetHandle, struct SPATMovementState_regional value, char oldPath[])
{
  char newPath[300]; 
  int i;
  int result;

  result = 0;

  value.length = C2xGetTokenInt(packetHandle, "SPAT", oldPath);
  if((result = CheckLastError("SPAT", gkFuncRefGet, result))==0)
  {
    for(i=0; i<value.length; i++)
    {
      snprintf(newPath, elcount(newPath), "%s[%d]", oldPath, i);
      GetSPATCommon_RegionalExtension_Reg_MovementStateParams(packetHandle, value.arrayValue[i], newPath);
      result = CheckLastError("SPAT", gkFuncRefGet, result);
    }
  }
  return result;
}

int SetSPATMovementState_regionalParams(LONG packetHandle, struct SPATMovementState_regional value, char oldPath[])
{
  char newPath[300]; 
  int i;
  int result;

  result = 0;

  C2xRemoveToken(packetHandle, "SPAT", oldPath);
  for(i=0; i<value.length; i++)
  {
    snprintf(newPath, elcount(newPath), "%s[%d]", oldPath, i);
    SetSPATCommon_RegionalExtension_Reg_MovementStateParams(packetHandle, value.arrayValue[i], newPath);
    result = CheckLastError("SPAT", gkFuncRefGet, result);
  }
  return result;
}

int GetSPATMovementStateParams(LONG packetHandle, struct SPATMovementState value, char oldPath[])
{
  char newPath[300];
  int result;

  result = 0;

  snprintf(newPath, elcount(newPath), "%s.%s", oldPath, "movementName");
  value.movementName.isValidFlag = C2xIsTokenAvailable(packetHandle, "SPAT", newPath);
  if(value.movementName.isValidFlag==1)
  {
    value.movementName.stringLength = C2xGetTokenData(packetHandle, "SPAT", newPath, elcount(value.movementName.string), value.movementName.string);
    result = CheckLastError("SPAT", gkFuncRefGet, result);
  }
  snprintf(newPath, elcount(newPath), "%s.%s", oldPath, "signalGroup");
  value.signalGroup = C2xGetTokenInt(packetHandle, "SPAT", newPath);
  result = CheckLastError("SPAT", gkFuncRefGet, result);

  snprintf(newPath, elcount(newPath), "%s.%s", oldPath, "state_time_speed");
  GetSPATMovementEventListParams(packetHandle, value.state_time_speed, newPath);
  result = CheckLastError("SPAT", gkFuncRefGet, result);

  snprintf(newPath, elcount(newPath), "%s.%s", oldPath, "maneuverAssistList");
  value.maneuverAssistList.isValidFlag = C2xIsTokenAvailable(packetHandle, "SPAT", newPath);
  if(value.maneuverAssistList.isValidFlag==1)
  {
    GetSPATManeuverAssistListParams(packetHandle, value.maneuverAssistList, newPath);
    result = CheckLastError("SPAT", gkFuncRefGet, result);
  }
  snprintf(newPath, elcount(newPath), "%s.%s", oldPath, "regional");
  value.regional.isValidFlag = C2xIsTokenAvailable(packetHandle, "SPAT", newPath);
  if(value.regional.isValidFlag==1)
  {
    GetSPATMovementState_regionalParams(packetHandle, value.regional, newPath);
    result = CheckLastError("SPAT", gkFuncRefGet, result);
  }
  return result;
}

int SetSPATMovementStateParams(LONG packetHandle, struct SPATMovementState value, char oldPath[])
{
  char newPath[300];
  int result;

  result = 0;

  snprintf(newPath, elcount(newPath), "%s.%s", oldPath, "movementName");
  if(value.movementName.isValidFlag==1)
  {
    C2xSetTokenData(packetHandle, "SPAT", newPath, value.movementName.stringLength, value.movementName.string);
    result = CheckLastError("SPAT", gkFuncRefGet, result);
  }
  else
  {
    if( C2xIsTokenAvailable(packetHandle, "SPAT", newPath) )
    {
      C2xRemoveToken(packetHandle, "SPAT", newPath);
    }
  }

  snprintf(newPath, elcount(newPath), "%s.%s", oldPath, "signalGroup");
  C2xSetTokenInt(packetHandle, "SPAT", newPath, value.signalGroup);
  result = CheckLastError("SPAT", gkFuncRefGet, result);

  snprintf(newPath, elcount(newPath), "%s.%s", oldPath, "state_time_speed");
  SetSPATMovementEventListParams(packetHandle, value.state_time_speed, newPath);
  result = CheckLastError("SPAT", gkFuncRefGet, result);

  snprintf(newPath, elcount(newPath), "%s.%s", oldPath, "maneuverAssistList");
  if(value.maneuverAssistList.isValidFlag==1)
  {
    SetSPATManeuverAssistListParams(packetHandle, value.maneuverAssistList, newPath);
    result = CheckLastError("SPAT", gkFuncRefGet, result);
  }
  else
  {
    if( C2xIsTokenAvailable(packetHandle, "SPAT", newPath) )
    {
      C2xRemoveToken(packetHandle, "SPAT", newPath);
    }
  }

  snprintf(newPath, elcount(newPath), "%s.%s", oldPath, "regional");
  if(value.regional.isValidFlag==1)
  {
    SetSPATMovementState_regionalParams(packetHandle, value.regional, newPath);
    result = CheckLastError("SPAT", gkFuncRefGet, result);
  }
  else
  {
    if( C2xIsTokenAvailable(packetHandle, "SPAT", newPath) )
    {
      C2xRemoveToken(packetHandle, "SPAT", newPath);
    }
  }

  return result;
}

int GetSPATMovementListParams(LONG packetHandle, struct SPATMovementList value, char oldPath[])
{
  char newPath[300]; 
  int i;
  int result;

  result = 0;

  value.length = C2xGetTokenInt(packetHandle, "SPAT", oldPath);
  if((result = CheckLastError("SPAT", gkFuncRefGet, result))==0)
  {
    for(i=0; i<value.length; i++)
    {
      snprintf(newPath, elcount(newPath), "%s[%d]", oldPath, i);
      GetSPATMovementStateParams(packetHandle, value.arrayValue[i], newPath);
      result = CheckLastError("SPAT", gkFuncRefGet, result);
    }
  }
  return result;
}

int SetSPATMovementListParams(LONG packetHandle, struct SPATMovementList value, char oldPath[])
{
  char newPath[300]; 
  int i;
  int result;

  result = 0;

  C2xRemoveToken(packetHandle, "SPAT", oldPath);
  for(i=0; i<value.length; i++)
  {
    snprintf(newPath, elcount(newPath), "%s[%d]", oldPath, i);
    SetSPATMovementStateParams(packetHandle, value.arrayValue[i], newPath);
    result = CheckLastError("SPAT", gkFuncRefGet, result);
  }
  return result;
}

int GetSPATAddGrpC_PrioritizationResponseParams(LONG packetHandle, struct SPATAddGrpC_PrioritizationResponse value, char oldPath[])
{
  char newPath[300];
  int result;

  result = 0;

  snprintf(newPath, elcount(newPath), "%s.%s", oldPath, "stationID");
  value.stationID = C2xGetTokenInt64(packetHandle, "SPAT", newPath);
  result = CheckLastError("SPAT", gkFuncRefGet, result);

  snprintf(newPath, elcount(newPath), "%s.%s", oldPath, "priorState");
  value.priorState = C2xGetTokenInt(packetHandle, "SPAT", newPath);
  result = CheckLastError("SPAT", gkFuncRefGet, result);

  snprintf(newPath, elcount(newPath), "%s.%s", oldPath, "signalGroup");
  value.signalGroup = C2xGetTokenInt(packetHandle, "SPAT", newPath);
  result = CheckLastError("SPAT", gkFuncRefGet, result);

  return result;
}

int SetSPATAddGrpC_PrioritizationResponseParams(LONG packetHandle, struct SPATAddGrpC_PrioritizationResponse value, char oldPath[])
{
  char newPath[300];
  int result;

  result = 0;

  snprintf(newPath, elcount(newPath), "%s.%s", oldPath, "stationID");
  C2xSetTokenInt64(packetHandle, "SPAT", newPath, value.stationID);
  result = CheckLastError("SPAT", gkFuncRefGet, result);

  snprintf(newPath, elcount(newPath), "%s.%s", oldPath, "priorState");
  C2xSetTokenInt(packetHandle, "SPAT", newPath, value.priorState);
  result = CheckLastError("SPAT", gkFuncRefGet, result);

  snprintf(newPath, elcount(newPath), "%s.%s", oldPath, "signalGroup");
  C2xSetTokenInt(packetHandle, "SPAT", newPath, value.signalGroup);
  result = CheckLastError("SPAT", gkFuncRefGet, result);

  return result;
}

int GetSPATAddGrpC_PrioritizationResponseListParams(LONG packetHandle, struct SPATAddGrpC_PrioritizationResponseList value, char oldPath[])
{
  char newPath[300]; 
  int i;
  int result;

  result = 0;

  value.length = C2xGetTokenInt(packetHandle, "SPAT", oldPath);
  if((result = CheckLastError("SPAT", gkFuncRefGet, result))==0)
  {
    for(i=0; i<value.length; i++)
    {
      snprintf(newPath, elcount(newPath), "%s[%d]", oldPath, i);
      GetSPATAddGrpC_PrioritizationResponseParams(packetHandle, value.arrayValue[i], newPath);
      result = CheckLastError("SPAT", gkFuncRefGet, result);
    }
  }
  return result;
}

int SetSPATAddGrpC_PrioritizationResponseListParams(LONG packetHandle, struct SPATAddGrpC_PrioritizationResponseList value, char oldPath[])
{
  char newPath[300]; 
  int i;
  int result;

  result = 0;

  C2xRemoveToken(packetHandle, "SPAT", oldPath);
  for(i=0; i<value.length; i++)
  {
    snprintf(newPath, elcount(newPath), "%s[%d]", oldPath, i);
    SetSPATAddGrpC_PrioritizationResponseParams(packetHandle, value.arrayValue[i], newPath);
    result = CheckLastError("SPAT", gkFuncRefGet, result);
  }
  return result;
}

int GetSPATAddGrpC_IntersectionState_addGrpCParams(LONG packetHandle, struct SPATAddGrpC_IntersectionState_addGrpC value, char oldPath[])
{
  char newPath[300];
  int result;

  result = 0;

  snprintf(newPath, elcount(newPath), "%s.%s", oldPath, "activePrioritizations");
  value.activePrioritizations.isValidFlag = C2xIsTokenAvailable(packetHandle, "SPAT", newPath);
  if(value.activePrioritizations.isValidFlag==1)
  {
    GetSPATAddGrpC_PrioritizationResponseListParams(packetHandle, value.activePrioritizations, newPath);
    result = CheckLastError("SPAT", gkFuncRefGet, result);
  }
  return result;
}

int SetSPATAddGrpC_IntersectionState_addGrpCParams(LONG packetHandle, struct SPATAddGrpC_IntersectionState_addGrpC value, char oldPath[])
{
  char newPath[300];
  int result;

  result = 0;

  snprintf(newPath, elcount(newPath), "%s.%s", oldPath, "activePrioritizations");
  if(value.activePrioritizations.isValidFlag==1)
  {
    SetSPATAddGrpC_PrioritizationResponseListParams(packetHandle, value.activePrioritizations, newPath);
    result = CheckLastError("SPAT", gkFuncRefGet, result);
  }
  else
  {
    if( C2xIsTokenAvailable(packetHandle, "SPAT", newPath) )
    {
      C2xRemoveToken(packetHandle, "SPAT", newPath);
    }
  }

  return result;
}

int GetSPATCommon_RegionalExtension_Reg_IntersectionState_tableParams(LONG packetHandle, WORD tableKey, struct SPATCommon_RegionalExtension_Reg_IntersectionState_table value, char oldPath[])
{
  char newPath[300];
  int result;

  result = 0;

  switch(tableKey)
  {
    case 3:
    {
      snprintf(newPath, elcount(newPath), "%s.%s", oldPath, "addGrpC");
      GetSPATAddGrpC_IntersectionState_addGrpCParams(packetHandle, value.addGrpC, newPath);
      result = CheckLastError("SPAT", gkFuncRefGet, result);
    }
    break;
  }
  return result;
}

int SetSPATCommon_RegionalExtension_Reg_IntersectionState_tableParams(LONG packetHandle, WORD tableKey, struct SPATCommon_RegionalExtension_Reg_IntersectionState_table value, char oldPath[])
{
  char newPath[300];
  int result;

  result = 0;

  switch(tableKey)
  {
    case 3:
    {
      snprintf(newPath, elcount(newPath), "%s.%s", oldPath, "addGrpC");
      SetSPATAddGrpC_IntersectionState_addGrpCParams(packetHandle, value.addGrpC, newPath);
      result = CheckLastError("SPAT", gkFuncRefGet, result);
    }
    break;
  }
  return result;
}

int GetSPATCommon_RegionalExtension_Reg_IntersectionStateParams(LONG packetHandle, struct SPATCommon_RegionalExtension_Reg_IntersectionState value, char oldPath[])
{
  char newPath[300];
  int result;

  result = 0;

  snprintf(newPath, elcount(newPath), "%s.%s", oldPath, "regionId");
  value.regionId = C2xGetTokenInt(packetHandle, "SPAT", newPath);
  result = CheckLastError("SPAT", gkFuncRefGet, result);

  snprintf(newPath, elcount(newPath), "%s.%s", oldPath, "regExtvalue");
  GetSPATCommon_RegionalExtension_Reg_IntersectionState_tableParams(packetHandle, value.regionId, value.regExtvalue, newPath);
  result = CheckLastError("SPAT", gkFuncRefGet, result);

  return result;
}

int SetSPATCommon_RegionalExtension_Reg_IntersectionStateParams(LONG packetHandle, struct SPATCommon_RegionalExtension_Reg_IntersectionState value, char oldPath[])
{
  char newPath[300];
  int result;

  result = 0;


  snprintf(newPath, elcount(newPath), "%s.%s", oldPath, "regExtvalue");
  SetSPATCommon_RegionalExtension_Reg_IntersectionState_tableParams(packetHandle, value.regionId, value.regExtvalue, newPath);
  result = CheckLastError("SPAT", gkFuncRefGet, result);

  return result;
}

int GetSPATIntersectionState_regionalParams(LONG packetHandle, struct SPATIntersectionState_regional value, char oldPath[])
{
  char newPath[300]; 
  int i;
  int result;

  result = 0;

  value.length = C2xGetTokenInt(packetHandle, "SPAT", oldPath);
  if((result = CheckLastError("SPAT", gkFuncRefGet, result))==0)
  {
    for(i=0; i<value.length; i++)
    {
      snprintf(newPath, elcount(newPath), "%s[%d]", oldPath, i);
      GetSPATCommon_RegionalExtension_Reg_IntersectionStateParams(packetHandle, value.arrayValue[i], newPath);
      result = CheckLastError("SPAT", gkFuncRefGet, result);
    }
  }
  return result;
}

int SetSPATIntersectionState_regionalParams(LONG packetHandle, struct SPATIntersectionState_regional value, char oldPath[])
{
  char newPath[300]; 
  int i;
  int result;

  result = 0;

  C2xRemoveToken(packetHandle, "SPAT", oldPath);
  for(i=0; i<value.length; i++)
  {
    snprintf(newPath, elcount(newPath), "%s[%d]", oldPath, i);
    SetSPATCommon_RegionalExtension_Reg_IntersectionStateParams(packetHandle, value.arrayValue[i], newPath);
    result = CheckLastError("SPAT", gkFuncRefGet, result);
  }
  return result;
}

int GetSPATCommon_RoadAuthorityIDParams(LONG packetHandle, struct SPATCommon_RoadAuthorityID value, char oldPath[])
{
  char newPath[300];
  int i;
  int result;

  result = 0;

  value.choice = C2xGetTokenInt(packetHandle, "SPAT", oldPath);

  switch(value.choice)
  {
    case 0:
    {
      snprintf(newPath, elcount(newPath), "%s.%s", oldPath, "fullRdAuthID");
      value.fullRdAuthID.length = C2xGetTokenInt(packetHandle, "SPAT", newPath);
      if((result = CheckLastError("SPAT", gkFuncRefGet, result))==0)
      {
        if(value.fullRdAuthID.length > 0)
        {
          for(i=0; i<value.fullRdAuthID.length; i++)
          {
            value.fullRdAuthID.arrayValue[i].id = C2xGetTokenOidElement(packetHandle, "SPAT", newPath, i);
          }
        }
      }
    }
    break;
    case 1:
    {
      snprintf(newPath, elcount(newPath), "%s.%s", oldPath, "relRdAuthID");
      value.relRdAuthID.length = C2xGetTokenInt(packetHandle, "SPAT", newPath);
      if((result = CheckLastError("SPAT", gkFuncRefGet, result))==0)
      {
        if(value.relRdAuthID.length > 0)
        {
          for(i=0; i<value.relRdAuthID.length; i++)
          {
            value.relRdAuthID.arrayValue[i].id = C2xGetTokenOidElement(packetHandle, "SPAT", newPath, i);
          }
        }
      }
    }
    break;
  }
  return result;
}

int SetSPATCommon_RoadAuthorityIDParams(LONG packetHandle, struct SPATCommon_RoadAuthorityID value, char oldPath[])
{
  char newPath[300];
  int i;
  int result;

  result = 0;

  switch(value.choice)
  {
    case 0:
    {
      snprintf(newPath, elcount(newPath), "%s.%s", oldPath, "fullRdAuthID");
      C2xRemoveToken(packetHandle, "SPAT", newPath);
      if(value.fullRdAuthID.length > 0)
      {
        for(i=0; i<value.fullRdAuthID.length; i++)
        {
          C2xSetTokenOidElement(packetHandle, "SPAT", newPath, i, value.fullRdAuthID.arrayValue[i].id);
        }
      }
      result = CheckLastError("SPAT", gkFuncRefGet, result);
    }
    break;
    case 1:
    {
      snprintf(newPath, elcount(newPath), "%s.%s", oldPath, "relRdAuthID");
      C2xRemoveToken(packetHandle, "SPAT", newPath);
      if(value.relRdAuthID.length > 0)
      {
        for(i=0; i<value.relRdAuthID.length; i++)
        {
          C2xSetTokenOidElement(packetHandle, "SPAT", newPath, i, value.relRdAuthID.arrayValue[i].id);
        }
      }
      result = CheckLastError("SPAT", gkFuncRefGet, result);
    }
    break;
  }
  return result;
}

int GetSPATIntersectionStateParams(LONG packetHandle, struct SPATIntersectionState value, char oldPath[])
{
  char newPath[300]; 
  int j; 
  int k;
  int result;

  result = 0;

  snprintf(newPath, elcount(newPath), "%s.%s", oldPath, "name");
  value.name.isValidFlag = C2xIsTokenAvailable(packetHandle, "SPAT", newPath);
  if(value.name.isValidFlag==1)
  {
    value.name.stringLength = C2xGetTokenData(packetHandle, "SPAT", newPath, elcount(value.name.string), value.name.string);
    result = CheckLastError("SPAT", gkFuncRefGet, result);
  }
  snprintf(newPath, elcount(newPath), "%s.%s", oldPath, "id");
  GetSPATCommon_IntersectionReferenceIDParams(packetHandle, value.id, newPath);
  result = CheckLastError("SPAT", gkFuncRefGet, result);

  snprintf(newPath, elcount(newPath), "%s.%s", oldPath, "revision");
  value.revision = C2xGetTokenInt(packetHandle, "SPAT", newPath);
  result = CheckLastError("SPAT", gkFuncRefGet, result);

  snprintf(newPath, elcount(newPath), "%s.%s", oldPath, "status");
  value.status.isValidFlag = 1;
  value.status.stringLength = C2xGetTokenLengthBit(packetHandle, "SPAT", newPath);
  if ((result = CheckLastError("SPAT", gkFuncRefGet, result))==0)
  {
    if(value.status.stringLength > 0)
    {
      for(j=0; j<value.status.stringLength; j++)
      {
        if(C2xGetTokenBitOfBitString(packetHandle, "SPAT", newPath, j) == 0)
        {
          value.status.string[j] = '0';
        }
        else if(C2xGetTokenBitOfBitString(packetHandle, "SPAT", newPath, j) == 1)
        {
          value.status.string[j] = '1';
        }

        if(value.status.stringLength == 1)
        {
          value.status.string[1] = '0';
        }
        result = CheckLastError("SPAT", gkFuncRefGet, result);
      }
    }
    else
    {
      for(k = value.status.stringLength+1; k > -1; k--)
      {
        if(value.status.string[k] == '1')
        {
          value.status.string[k] = '0';
        }
      }
    }
  }

  snprintf(newPath, elcount(newPath), "%s.%s", oldPath, "moy");
  value.moy.isValidFlag = C2xIsTokenAvailable(packetHandle, "SPAT", newPath);
  if(value.moy.isValidFlag==1)
  {
    value.moy.value = C2xGetTokenInt(packetHandle, "SPAT", newPath);
    result = CheckLastError("SPAT", gkFuncRefGet, result);
  }
  snprintf(newPath, elcount(newPath), "%s.%s", oldPath, "timeStamp");
  value.timeStamp.isValidFlag = C2xIsTokenAvailable(packetHandle, "SPAT", newPath);
  if(value.timeStamp.isValidFlag==1)
  {
    value.timeStamp.value = C2xGetTokenInt(packetHandle, "SPAT", newPath);
    result = CheckLastError("SPAT", gkFuncRefGet, result);
  }
  snprintf(newPath, elcount(newPath), "%s.%s", oldPath, "enabledLanes");
  value.enabledLanes.isValidFlag = C2xIsTokenAvailable(packetHandle, "SPAT", newPath);
  if(value.enabledLanes.isValidFlag==1)
  {
    GetSPATEnabledLaneListParams(packetHandle, value.enabledLanes, newPath);
    result = CheckLastError("SPAT", gkFuncRefGet, result);
  }
  snprintf(newPath, elcount(newPath), "%s.%s", oldPath, "states");
  GetSPATMovementListParams(packetHandle, value.states, newPath);
  result = CheckLastError("SPAT", gkFuncRefGet, result);

  snprintf(newPath, elcount(newPath), "%s.%s", oldPath, "maneuverAssistList");
  value.maneuverAssistList.isValidFlag = C2xIsTokenAvailable(packetHandle, "SPAT", newPath);
  if(value.maneuverAssistList.isValidFlag==1)
  {
    GetSPATManeuverAssistListParams(packetHandle, value.maneuverAssistList, newPath);
    result = CheckLastError("SPAT", gkFuncRefGet, result);
  }
  snprintf(newPath, elcount(newPath), "%s.%s", oldPath, "regional");
  value.regional.isValidFlag = C2xIsTokenAvailable(packetHandle, "SPAT", newPath);
  if(value.regional.isValidFlag==1)
  {
    GetSPATIntersectionState_regionalParams(packetHandle, value.regional, newPath);
    result = CheckLastError("SPAT", gkFuncRefGet, result);
  }
  snprintf(newPath, elcount(newPath), "%s.%s", oldPath, "roadAuthorityID");
  value.roadAuthorityID.isValidFlag = C2xIsTokenAvailable(packetHandle, "SPAT", newPath);
  if(value.roadAuthorityID.isValidFlag==1)
  {
    GetSPATCommon_RoadAuthorityIDParams(packetHandle, value.roadAuthorityID, newPath);
    result = CheckLastError("SPAT", gkFuncRefGet, result);
  }
  return result;
}

int SetSPATIntersectionStateParams(LONG packetHandle, struct SPATIntersectionState value, char oldPath[])
{
  char newPath[300]; 
  int j;
  int result;

  result = 0;

  snprintf(newPath, elcount(newPath), "%s.%s", oldPath, "name");
  if(value.name.isValidFlag==1)
  {
    C2xSetTokenData(packetHandle, "SPAT", newPath, value.name.stringLength, value.name.string);
    result = CheckLastError("SPAT", gkFuncRefGet, result);
  }
  else
  {
    if( C2xIsTokenAvailable(packetHandle, "SPAT", newPath) )
    {
      C2xRemoveToken(packetHandle, "SPAT", newPath);
    }
  }

  snprintf(newPath, elcount(newPath), "%s.%s", oldPath, "id");
  SetSPATCommon_IntersectionReferenceIDParams(packetHandle, value.id, newPath);
  result = CheckLastError("SPAT", gkFuncRefGet, result);

  snprintf(newPath, elcount(newPath), "%s.%s", oldPath, "revision");
  C2xSetTokenInt(packetHandle, "SPAT", newPath, value.revision);
  result = CheckLastError("SPAT", gkFuncRefGet, result);

  snprintf(newPath, elcount(newPath), "%s.%s", oldPath, "status");
    for(j=0; j<value.status.stringLength; j++)
    {
      if(value.status.string[j] == '0')
      {
        C2xSetTokenBitOfBitString(packetHandle, "SPAT", newPath, j, 0);
      }
      else
      {
        C2xSetTokenBitOfBitString(packetHandle, "SPAT", newPath, j, 1);
      }
      result = CheckLastError("SPAT", gkFuncRefGet, result);
    }

  snprintf(newPath, elcount(newPath), "%s.%s", oldPath, "moy");
  if(value.moy.isValidFlag==1)
  {
    C2xSetTokenInt(packetHandle, "SPAT", newPath, value.moy.value);
    result = CheckLastError("SPAT", gkFuncRefGet, result);
  }
  else
  {
    if( C2xIsTokenAvailable(packetHandle, "SPAT", newPath) )
    {
      C2xRemoveToken(packetHandle, "SPAT", newPath);
    }
  }

  snprintf(newPath, elcount(newPath), "%s.%s", oldPath, "timeStamp");
  if(value.timeStamp.isValidFlag==1)
  {
    C2xSetTokenInt(packetHandle, "SPAT", newPath, value.timeStamp.value);
    result = CheckLastError("SPAT", gkFuncRefGet, result);
  }
  else
  {
    if( C2xIsTokenAvailable(packetHandle, "SPAT", newPath) )
    {
      C2xRemoveToken(packetHandle, "SPAT", newPath);
    }
  }

  snprintf(newPath, elcount(newPath), "%s.%s", oldPath, "enabledLanes");
  if(value.enabledLanes.isValidFlag==1)
  {
    SetSPATEnabledLaneListParams(packetHandle, value.enabledLanes, newPath);
    result = CheckLastError("SPAT", gkFuncRefGet, result);
  }
  else
  {
    if( C2xIsTokenAvailable(packetHandle, "SPAT", newPath) )
    {
      C2xRemoveToken(packetHandle, "SPAT", newPath);
    }
  }

  snprintf(newPath, elcount(newPath), "%s.%s", oldPath, "states");
  SetSPATMovementListParams(packetHandle, value.states, newPath);
  result = CheckLastError("SPAT", gkFuncRefGet, result);

  snprintf(newPath, elcount(newPath), "%s.%s", oldPath, "maneuverAssistList");
  if(value.maneuverAssistList.isValidFlag==1)
  {
    SetSPATManeuverAssistListParams(packetHandle, value.maneuverAssistList, newPath);
    result = CheckLastError("SPAT", gkFuncRefGet, result);
  }
  else
  {
    if( C2xIsTokenAvailable(packetHandle, "SPAT", newPath) )
    {
      C2xRemoveToken(packetHandle, "SPAT", newPath);
    }
  }

  snprintf(newPath, elcount(newPath), "%s.%s", oldPath, "regional");
  if(value.regional.isValidFlag==1)
  {
    SetSPATIntersectionState_regionalParams(packetHandle, value.regional, newPath);
    result = CheckLastError("SPAT", gkFuncRefGet, result);
  }
  else
  {
    if( C2xIsTokenAvailable(packetHandle, "SPAT", newPath) )
    {
      C2xRemoveToken(packetHandle, "SPAT", newPath);
    }
  }

  snprintf(newPath, elcount(newPath), "%s.%s", oldPath, "roadAuthorityID");
  if(value.roadAuthorityID.isValidFlag==1)
  {
    SetSPATCommon_RoadAuthorityIDParams(packetHandle, value.roadAuthorityID, newPath);
    result = CheckLastError("SPAT", gkFuncRefGet, result);
  }
  else
  {
    if( C2xIsTokenAvailable(packetHandle, "SPAT", newPath) )
    {
      C2xRemoveToken(packetHandle, "SPAT", newPath);
    }
  }

  return result;
}

int GetSPATIntersectionStateListParams(LONG packetHandle, struct SPATIntersectionStateList value, char oldPath[])
{
  char newPath[300]; 
  int i;
  int result;

  result = 0;

  value.length = C2xGetTokenInt(packetHandle, "SPAT", oldPath);
  if((result = CheckLastError("SPAT", gkFuncRefGet, result))==0)
  {
    for(i=0; i<value.length; i++)
    {
      snprintf(newPath, elcount(newPath), "%s[%d]", oldPath, i);
      GetSPATIntersectionStateParams(packetHandle, value.arrayValue[i], newPath);
      result = CheckLastError("SPAT", gkFuncRefGet, result);
    }
  }
  return result;
}

int SetSPATIntersectionStateListParams(LONG packetHandle, struct SPATIntersectionStateList value, char oldPath[])
{
  char newPath[300]; 
  int i;
  int result;

  result = 0;

  C2xRemoveToken(packetHandle, "SPAT", oldPath);
  for(i=0; i<value.length; i++)
  {
    snprintf(newPath, elcount(newPath), "%s[%d]", oldPath, i);
    SetSPATIntersectionStateParams(packetHandle, value.arrayValue[i], newPath);
    result = CheckLastError("SPAT", gkFuncRefGet, result);
  }
  return result;
}

int GetSPATCommon_RegionalExtension_Reg_SPATParams(LONG packetHandle, struct SPATCommon_RegionalExtension_Reg_SPAT value, char oldPath[])
{
  char newPath[300];
  int result;

  result = 0;

  snprintf(newPath, elcount(newPath), "%s.%s", oldPath, "regionId");
  value.regionId = C2xGetTokenInt(packetHandle, "SPAT", newPath);
  result = CheckLastError("SPAT", gkFuncRefGet, result);

  return result;
}

int SetSPATCommon_RegionalExtension_Reg_SPATParams(LONG packetHandle, struct SPATCommon_RegionalExtension_Reg_SPAT value, char oldPath[])
{
  char newPath[300];
  int result;

  result = 0;


  return result;
}

int GetSPATSPAT_regionalParams(LONG packetHandle, struct SPATSPAT_regional value, char oldPath[])
{
  char newPath[300]; 
  int i;
  int result;

  result = 0;

  value.length = C2xGetTokenInt(packetHandle, "SPAT", oldPath);
  if((result = CheckLastError("SPAT", gkFuncRefGet, result))==0)
  {
    for(i=0; i<value.length; i++)
    {
      snprintf(newPath, elcount(newPath), "%s[%d]", oldPath, i);
      GetSPATCommon_RegionalExtension_Reg_SPATParams(packetHandle, value.arrayValue[i], newPath);
      result = CheckLastError("SPAT", gkFuncRefGet, result);
    }
  }
  return result;
}

int SetSPATSPAT_regionalParams(LONG packetHandle, struct SPATSPAT_regional value, char oldPath[])
{
  char newPath[300]; 
  int i;
  int result;

  result = 0;

  C2xRemoveToken(packetHandle, "SPAT", oldPath);
  for(i=0; i<value.length; i++)
  {
    snprintf(newPath, elcount(newPath), "%s[%d]", oldPath, i);
    SetSPATCommon_RegionalExtension_Reg_SPATParams(packetHandle, value.arrayValue[i], newPath);
    result = CheckLastError("SPAT", gkFuncRefGet, result);
  }
  return result;
}

int GetSPAT_SPATParams(LONG packetHandle, struct SPAT_SPAT value, char oldPath[])
{
  char newPath[300];
  int result;

  result = 0;

  snprintf(newPath, elcount(newPath), "%s.%s", oldPath, "timeStamp");
  value.timeStamp.isValidFlag = C2xIsTokenAvailable(packetHandle, "SPAT", newPath);
  if(value.timeStamp.isValidFlag==1)
  {
    value.timeStamp.value = C2xGetTokenInt(packetHandle, "SPAT", newPath);
    result = CheckLastError("SPAT", gkFuncRefGet, result);
  }
  snprintf(newPath, elcount(newPath), "%s.%s", oldPath, "name");
  value.name.isValidFlag = C2xIsTokenAvailable(packetHandle, "SPAT", newPath);
  if(value.name.isValidFlag==1)
  {
    value.name.stringLength = C2xGetTokenData(packetHandle, "SPAT", newPath, elcount(value.name.string), value.name.string);
    result = CheckLastError("SPAT", gkFuncRefGet, result);
  }
  snprintf(newPath, elcount(newPath), "%s.%s", oldPath, "intersections");
  GetSPATIntersectionStateListParams(packetHandle, value.intersections, newPath);
  result = CheckLastError("SPAT", gkFuncRefGet, result);

  snprintf(newPath, elcount(newPath), "%s.%s", oldPath, "regional");
  value.regional.isValidFlag = C2xIsTokenAvailable(packetHandle, "SPAT", newPath);
  if(value.regional.isValidFlag==1)
  {
    GetSPATSPAT_regionalParams(packetHandle, value.regional, newPath);
    result = CheckLastError("SPAT", gkFuncRefGet, result);
  }
  return result;
}

int SetSPAT_SPATParams(LONG packetHandle, struct SPAT_SPAT value, char oldPath[])
{
  char newPath[300];
  int result;

  result = 0;

  snprintf(newPath, elcount(newPath), "%s.%s", oldPath, "timeStamp");
  if(value.timeStamp.isValidFlag==1)
  {
    C2xSetTokenInt(packetHandle, "SPAT", newPath, value.timeStamp.value);
    result = CheckLastError("SPAT", gkFuncRefGet, result);
  }
  else
  {
    if( C2xIsTokenAvailable(packetHandle, "SPAT", newPath) )
    {
      C2xRemoveToken(packetHandle, "SPAT", newPath);
    }
  }

  snprintf(newPath, elcount(newPath), "%s.%s", oldPath, "name");
  if(value.name.isValidFlag==1)
  {
    C2xSetTokenData(packetHandle, "SPAT", newPath, value.name.stringLength, value.name.string);
    result = CheckLastError("SPAT", gkFuncRefGet, result);
  }
  else
  {
    if( C2xIsTokenAvailable(packetHandle, "SPAT", newPath) )
    {
      C2xRemoveToken(packetHandle, "SPAT", newPath);
    }
  }

  snprintf(newPath, elcount(newPath), "%s.%s", oldPath, "intersections");
  SetSPATIntersectionStateListParams(packetHandle, value.intersections, newPath);
  result = CheckLastError("SPAT", gkFuncRefGet, result);

  snprintf(newPath, elcount(newPath), "%s.%s", oldPath, "regional");
  if(value.regional.isValidFlag==1)
  {
    SetSPATSPAT_regionalParams(packetHandle, value.regional, newPath);
    result = CheckLastError("SPAT", gkFuncRefGet, result);
  }
  else
  {
    if( C2xIsTokenAvailable(packetHandle, "SPAT", newPath) )
    {
      C2xRemoveToken(packetHandle, "SPAT", newPath);
    }
  }

  return result;
}

int GetSPATMESSAGE_ID_AND_TYPEParams(LONG packetHandle, WORD tableKey, struct SPATMESSAGE_ID_AND_TYPE value, char oldPath[])
{
  char newPath[300];
  int result;

  result = 0;

  switch(tableKey)
  {
    case 19:
    {
      snprintf(newPath, elcount(newPath), "%s.%s", oldPath, "signalPhaseAndTimingMessage");
      GetSPAT_SPATParams(packetHandle, value.signalPhaseAndTimingMessage, newPath);
      result = CheckLastError("SPAT", gkFuncRefGet, result);
    }
    break;
  }
  return result;
}

int SetSPATMESSAGE_ID_AND_TYPEParams(LONG packetHandle, WORD tableKey, struct SPATMESSAGE_ID_AND_TYPE value, char oldPath[])
{
  char newPath[300];
  int result;

  result = 0;

  switch(tableKey)
  {
    case 19:
    {
      snprintf(newPath, elcount(newPath), "%s.%s", oldPath, "signalPhaseAndTimingMessage");
      SetSPAT_SPATParams(packetHandle, value.signalPhaseAndTimingMessage, newPath);
      result = CheckLastError("SPAT", gkFuncRefGet, result);
    }
    break;
  }
  return result;
}

int API_GetSPATParams(LONG packetHandle, struct SPAT value)
{
  int result;
  result = 0;

  value.messageId = C2xGetTokenInt(packetHandle, "SPAT", "messageId");
  result = CheckLastError("SPAT", gkFuncRefGet, result);

  GetSPATMESSAGE_ID_AND_TYPEParams(packetHandle, value.messageId, value.value, "value");
  result = CheckLastError("SPAT", gkFuncRefGet, result);

  return result;
}

int API_SetSPATParams(LONG packetHandle, struct SPAT value)
{
  int result;
  result = 0;

  value.messageId = 19;

  SetSPATMESSAGE_ID_AND_TYPEParams(packetHandle, value.messageId, value.value, "value");
  result = CheckLastError("SPAT", gkFuncRefGet, result);

  return result;
}

