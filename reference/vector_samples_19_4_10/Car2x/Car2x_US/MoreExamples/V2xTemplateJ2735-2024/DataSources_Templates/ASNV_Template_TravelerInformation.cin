/*@!Encoding:1252*/
/*
//  (c) Vector Informatik GmbH. All rights reserved.
//
//  This file contains definitions of structs and methods that may be used
//  to set and get the values of an ASN.1 defined packet's payload.
//
//  //This example demonstrates how to set a packet's payload:
//  LONG packetHandle;
//  struct TravelerInformation payload;
//  //you need to set the values of the variable "payload" yourself
//  packetHandle = API_InitTravelerInformationPacket();
//  if (packetHandle!=0) {
//    if (API_SetTravelerInformationParams(packetHandle, payload)==0) {
//      if (C2xCompletePacket(packetHandle)==0) {
//        C2xOutputPacket(packetHandle);
//      }
//    }
//  }
//                                                                             */
includes
{
  #include "ASNV_Template_BaseDatatypes.cin"  // If warning "Duplicate #include, ignoring this include" appears, please remove the ASNV_Template_BaseDatatypes.cin include from your other *.cin files in the project.
}
variables
{
    struct TravelerInformationUniqueMSGID {
        INT isValidFlag;   // necessary if this struct is used as an optional field of a SEQUENCE
        CHAR string[10];
        INT  stringLength;
    };
    
    struct TravelerInformationURL_Base {
        INT isValidFlag;   // necessary if this struct is used as an optional field of a SEQUENCE
        CHAR string[46];
        INT  stringLength;
    };
    
    struct TravelerInformationCommon_FurtherInfoID {
        INT isValidFlag;   // necessary if this struct is used as an optional field of a SEQUENCE
        CHAR string[3];
        INT  stringLength;
    };
    
    struct TravelerInformationAddGrpB_LatitudeDMS2 {
        INT isValidFlag;   // necessary if this struct is used as an optional field of a SEQUENCE
        INT d;  // INTEGER, -90..90;
        BYTE m;  // INTEGER, 0..59;
        WORD s;  // INTEGER, 0..5999;
    };
    
    struct TravelerInformationAddGrpB_LongitudeDMS2 {
        INT isValidFlag;   // necessary if this struct is used as an optional field of a SEQUENCE
        INT d;  // INTEGER, -180..180;
        BYTE m;  // INTEGER, 0..59;
        WORD s;  // INTEGER, 0..5999;
    };
    
    struct TravelerInformationAddGrpB_Position3D_addGrpB {
        INT isValidFlag;   // necessary if this struct is used as an optional field of a SEQUENCE
        struct TravelerInformationAddGrpB_LatitudeDMS2 latitude;  // SEQUENCE;
        struct TravelerInformationAddGrpB_LongitudeDMS2 longitude;  // SEQUENCE;
        INT elevation;  // INTEGER, -32768..32767;
    };
    
    struct TravelerInformationAddGrpC_Altitude {
        INT isValidFlag;   // necessary if this struct is used as an optional field of a SEQUENCE
        LONG value;  // INTEGER, -100000..800001;
        INT confidence;  // ENUMERATED, alt_000_01(-0), alt_000_02(1), alt_000_05(2), alt_000_10(3), alt_000_20(4), alt_000_50(5), alt_001_00(6), alt_002_00(7), alt_005_00(8), alt_010_00(9), alt_020_00(10), alt_050_00(11), alt_100_00(12), alt_200_00(13), outOfRange(14), unavailable(15);
    };
    
    struct TravelerInformationAddGrpC_Position3D_addGrpC {
        INT isValidFlag;   // necessary if this struct is used as an optional field of a SEQUENCE
        struct TravelerInformationAddGrpC_Altitude altitude;  // SEQUENCE;
    };
    
    struct TravelerInformationCommon_RegionalExtension_Reg_Position3D_table {
        struct TravelerInformationAddGrpB_Position3D_addGrpB addGrpB;  // SEQUENCE;
        struct TravelerInformationAddGrpC_Position3D_addGrpC addGrpC;  // SEQUENCE;
    };
    
    struct TravelerInformationCommon_RegionalExtension_Reg_Position3D {
        INT isValidFlag;   // necessary if this struct is used as an optional field of a SEQUENCE
        BYTE regionId;  // INTEGER, 0..255, noRegion(0), addGrpA(1), addGrpB(2), addGrpC(3), addGrpD(4);
        struct TravelerInformationCommon_RegionalExtension_Reg_Position3D_table regExtvalue;  // TABLE;
    };
    
    struct TravelerInformationCommon_Position3D_regional {
        INT isValidFlag;   // necessary if this struct is used as an optional field of a SEQUENCE
        INT length;
        struct TravelerInformationCommon_RegionalExtension_Reg_Position3D arrayValue[4];  // SEQUENCE;
    };
    
    struct TravelerInformationCommon_Position3D {
        INT isValidFlag;   // necessary if this struct is used as an optional field of a SEQUENCE
        LONG lat;  // INTEGER, -900000000..900000001;
        LONG lon;  // INTEGER, -1799999999..1800000001;
        struct OPT_LONG_ASN elevation;  // INTEGER, OPTIONAL, -4096..61439;
        struct TravelerInformationCommon_Position3D_regional regional;  // SEQUENCEOF, OPTIONAL;
    };
    
    struct TravelerInformationCommon_HeadingSlice {
        INT isValidFlag;   // necessary if this struct is used as an optional field of a SEQUENCE
        CHAR string[17];
        INT  stringLength;
    };
    
    struct TravelerInformationMsgCRC {
        INT isValidFlag;   // necessary if this struct is used as an optional field of a SEQUENCE
        CHAR string[3];
        INT  stringLength;
    };
    
    struct TravelerInformationRoadSignID {
        INT isValidFlag;   // necessary if this struct is used as an optional field of a SEQUENCE
        struct TravelerInformationCommon_Position3D position;  // SEQUENCE;
        struct TravelerInformationCommon_HeadingSlice viewAngle;  // BITSTRING;
        struct OPT_ENUM_ASN mutcdCode;  // ENUMERATED, OPTIONAL, none(0), regulatory(1), warning(2), maintenance(3), motoristService(4), guide(5), rec(6);
        struct TravelerInformationMsgCRC crc;  // OCTETSTRING, OPTIONAL;
    };
    
    struct TravelerInformationTravelerDataFrame_msgId {
        INT isValidFlag;   // necessary if this struct is used as an optional field of a SEQUENCE
        INT choice;
        struct TravelerInformationCommon_FurtherInfoID furtherInfoID;  // OCTETSTRING;
        struct TravelerInformationRoadSignID roadSignID;  // SEQUENCE;
    };
    
    struct TravelerInformationCommon_DescriptiveName {
        INT isValidFlag;   // necessary if this struct is used as an optional field of a SEQUENCE
        CHAR string[64];
        INT  stringLength;
    };
    
    struct TravelerInformationCommon_RoadSegmentReferenceID {
        INT isValidFlag;   // necessary if this struct is used as an optional field of a SEQUENCE
        struct OPT_WORD_ASN region;  // INTEGER, OPTIONAL, 0..65535;
        WORD id;  // INTEGER, 0..65535;
    };
    
    struct TravelerInformationCommon_Node_XY_20b {
        INT isValidFlag;   // necessary if this struct is used as an optional field of a SEQUENCE
        INT x;  // INTEGER, -512..511;
        INT y;  // INTEGER, -512..511;
    };
    
    struct TravelerInformationCommon_Node_XY_22b {
        INT isValidFlag;   // necessary if this struct is used as an optional field of a SEQUENCE
        INT x;  // INTEGER, -1024..1023;
        INT y;  // INTEGER, -1024..1023;
    };
    
    struct TravelerInformationCommon_Node_XY_24b {
        INT isValidFlag;   // necessary if this struct is used as an optional field of a SEQUENCE
        INT x;  // INTEGER, -2048..2047;
        INT y;  // INTEGER, -2048..2047;
    };
    
    struct TravelerInformationCommon_Node_XY_26b {
        INT isValidFlag;   // necessary if this struct is used as an optional field of a SEQUENCE
        INT x;  // INTEGER, -4096..4095;
        INT y;  // INTEGER, -4096..4095;
    };
    
    struct TravelerInformationCommon_Node_XY_28b {
        INT isValidFlag;   // necessary if this struct is used as an optional field of a SEQUENCE
        INT x;  // INTEGER, -8192..8191;
        INT y;  // INTEGER, -8192..8191;
    };
    
    struct TravelerInformationCommon_Node_XY_32b {
        INT isValidFlag;   // necessary if this struct is used as an optional field of a SEQUENCE
        INT x;  // INTEGER, -32768..32767;
        INT y;  // INTEGER, -32768..32767;
    };
    
    struct TravelerInformationCommon_Node_LLmD_64b {
        INT isValidFlag;   // necessary if this struct is used as an optional field of a SEQUENCE
        LONG lon;  // INTEGER, -1799999999..1800000001;
        LONG lat;  // INTEGER, -900000000..900000001;
    };
    
    struct TravelerInformationAddGrpB_Node_LLdms_48b {
        INT isValidFlag;   // necessary if this struct is used as an optional field of a SEQUENCE
        LONG lon;  // INTEGER, -64800000..64800000;
        LONG lat;  // INTEGER, -32400000..32400000;
    };
    
    struct TravelerInformationAddGrpB_Node_LLdms_80b {
        INT isValidFlag;   // necessary if this struct is used as an optional field of a SEQUENCE
        struct TravelerInformationAddGrpB_LongitudeDMS2 lon;  // SEQUENCE;
        struct TravelerInformationAddGrpB_LatitudeDMS2 lat;  // SEQUENCE;
    };
    
    struct TravelerInformationAddGrpB_NodeOffsetPointXY_addGrpB {
        INT isValidFlag;   // necessary if this struct is used as an optional field of a SEQUENCE
        INT choice;
        struct TravelerInformationAddGrpB_Node_LLdms_48b posA;  // SEQUENCE;
        struct TravelerInformationAddGrpB_Node_LLdms_80b posB;  // SEQUENCE;
    };
    
    struct TravelerInformationCommon_RegionalExtension_Reg_NodeOffsetPointXY_table {
        struct TravelerInformationAddGrpB_NodeOffsetPointXY_addGrpB addGrpB;  // CHOICE;
    };
    
    struct TravelerInformationCommon_RegionalExtension_Reg_NodeOffsetPointXY {
        INT isValidFlag;   // necessary if this struct is used as an optional field of a SEQUENCE
        BYTE regionId;  // INTEGER, 0..255, noRegion(0), addGrpA(1), addGrpB(2), addGrpC(3), addGrpD(4);
        struct TravelerInformationCommon_RegionalExtension_Reg_NodeOffsetPointXY_table regExtvalue;  // TABLE;
    };
    
    struct TravelerInformationCommon_NodeOffsetPointXY {
        INT isValidFlag;   // necessary if this struct is used as an optional field of a SEQUENCE
        INT choice;
        struct TravelerInformationCommon_Node_XY_20b node_XY1;  // SEQUENCE;
        struct TravelerInformationCommon_Node_XY_22b node_XY2;  // SEQUENCE;
        struct TravelerInformationCommon_Node_XY_24b node_XY3;  // SEQUENCE;
        struct TravelerInformationCommon_Node_XY_26b node_XY4;  // SEQUENCE;
        struct TravelerInformationCommon_Node_XY_28b node_XY5;  // SEQUENCE;
        struct TravelerInformationCommon_Node_XY_32b node_XY6;  // SEQUENCE;
        struct TravelerInformationCommon_Node_LLmD_64b node_LatLon;  // SEQUENCE;
        struct TravelerInformationCommon_RegionalExtension_Reg_NodeOffsetPointXY regional;  // SEQUENCE;
    };
    
    struct TravelerInformationCommon_NodeAttributeXYList {
        INT isValidFlag;   // necessary if this struct is used as an optional field of a SEQUENCE
        INT length;
        INT arrayValue[8];  // ENUMERATED, reserved(-0), stopLine(1), roundedCapStyleA(2), roundedCapStyleB(3), mergePoint(4), divergePoint(5), downstreamStopLine(6), downstreamStartNode(7), closedToTraffic(8), safeIsland(9), curbPresentAtStepOff(10), hydrantPresent(11);
    };
    
    struct TravelerInformationCommon_SegmentAttributeXYList {
        INT isValidFlag;   // necessary if this struct is used as an optional field of a SEQUENCE
        INT length;
        INT arrayValue[8];  // ENUMERATED, reserved(-0), doNotBlock(1), whiteLine(2), mergingLaneLeft(3), mergingLaneRight(4), curbOnLeft(5), curbOnRight(6), loadingzoneOnLeft(7), loadingzoneOnRight(8), turnOutPointOnLeft(9), turnOutPointOnRight(10), adjacentParkingOnLeft(11), adjacentParkingOnRight(12), adjacentBikeLaneOnLeft(13), adjacentBikeLaneOnRight(14), sharedBikeLane(15), bikeBoxInFront(16), transitStopOnLeft(17), transitStopOnRight(18), transitStopInLane(19), sharedWithTrackedVehicle(20), safeIsland(21), lowCurbsPresent(22), rumbleStripPresent(23), audibleSignalingPresent(24), adaptiveTimingPresent(25), rfSignalRequestPresent(26), partialCurbIntrusion(27), taperToLeft(28), taperToRight(29), taperToCenterLine(30), parallelParking(31), headInParking(32), freeParking(33), timeRestrictionsOnParking(34), costToPark(35), midBlockCurbPresent(36), unEvenPavementPresent(37);
    };
    
    struct TravelerInformationCommon_RegulatorySpeedLimit {
        INT isValidFlag;   // necessary if this struct is used as an optional field of a SEQUENCE
        INT type;  // ENUMERATED, unknown(-0), maxSpeedInSchoolZone(1), maxSpeedInSchoolZoneWhenChildrenArePresent(2), maxSpeedInConstructionZone(3), vehicleMinSpeed(4), vehicleMaxSpeed(5), vehicleNightMaxSpeed(6), truckMinSpeed(7), truckMaxSpeed(8), truckNightMaxSpeed(9), vehiclesWithTrailersMinSpeed(10), vehiclesWithTrailersMaxSpeed(11), vehiclesWithTrailersNightMaxSpeed(12);
        WORD speed;  // INTEGER, 0..8191;
    };
    
    struct TravelerInformationCommon_SpeedLimitList {
        INT isValidFlag;   // necessary if this struct is used as an optional field of a SEQUENCE
        INT length;
        struct TravelerInformationCommon_RegulatorySpeedLimit arrayValue[9];  // SEQUENCE;
    };
    
    struct TravelerInformationAddGrpB_LaneDataAttribute_addGrpB {
        INT isValidFlag;   // necessary if this struct is used as an optional field of a SEQUENCE
    };
    
    struct TravelerInformationCommon_RegionalExtension_Reg_LaneDataAttribute_table {
        struct TravelerInformationAddGrpB_LaneDataAttribute_addGrpB addGrpB;  // SEQUENCE;
    };
    
    struct TravelerInformationCommon_RegionalExtension_Reg_LaneDataAttribute {
        INT isValidFlag;   // necessary if this struct is used as an optional field of a SEQUENCE
        BYTE regionId;  // INTEGER, 0..255, noRegion(0), addGrpA(1), addGrpB(2), addGrpC(3), addGrpD(4);
        struct TravelerInformationCommon_RegionalExtension_Reg_LaneDataAttribute_table regExtvalue;  // TABLE;
    };
    
    struct TravelerInformationCommon_LaneDataAttribute_regional {
        INT isValidFlag;   // necessary if this struct is used as an optional field of a SEQUENCE
        INT length;
        struct TravelerInformationCommon_RegionalExtension_Reg_LaneDataAttribute arrayValue[4];  // SEQUENCE;
    };
    
    struct TravelerInformationCommon_LaneDataAttribute {
        INT isValidFlag;   // necessary if this struct is used as an optional field of a SEQUENCE
        INT choice;
        INT pathEndPointAngle;  // INTEGER, -150..150;
        INT laneCrownPointCenter;  // INTEGER, -128..127;
        INT laneCrownPointLeft;  // INTEGER, -128..127;
        INT laneCrownPointRight;  // INTEGER, -128..127;
        INT laneAngle;  // INTEGER, -180..180;
        struct TravelerInformationCommon_SpeedLimitList speedLimits;  // SEQUENCEOF;
        struct TravelerInformationCommon_LaneDataAttribute_regional regional;  // SEQUENCEOF;
    };
    
    struct TravelerInformationCommon_LaneDataAttributeList {
        INT isValidFlag;   // necessary if this struct is used as an optional field of a SEQUENCE
        INT length;
        struct TravelerInformationCommon_LaneDataAttribute arrayValue[8];  // CHOICE;
    };
    
    struct TravelerInformationCommon_RegionalExtension_Reg_NodeAttributeSetXY_table {
    };
    
    struct TravelerInformationCommon_RegionalExtension_Reg_NodeAttributeSetXY {
        INT isValidFlag;   // necessary if this struct is used as an optional field of a SEQUENCE
        BYTE regionId;  // INTEGER, 0..255, noRegion(0), addGrpA(1), addGrpB(2), addGrpC(3), addGrpD(4);
        struct TravelerInformationCommon_RegionalExtension_Reg_NodeAttributeSetXY_table regExtvalue;  // TABLE;
    };
    
    struct TravelerInformationCommon_NodeAttributeSetXY_regional {
        INT isValidFlag;   // necessary if this struct is used as an optional field of a SEQUENCE
        INT length;
        struct TravelerInformationCommon_RegionalExtension_Reg_NodeAttributeSetXY arrayValue[4];  // SEQUENCE;
    };
    
    struct TravelerInformationCommon_NodeAttributeSetXY {
        INT isValidFlag;   // necessary if this struct is used as an optional field of a SEQUENCE
        struct TravelerInformationCommon_NodeAttributeXYList localNode;  // SEQUENCEOF, OPTIONAL;
        struct TravelerInformationCommon_SegmentAttributeXYList disabled;  // SEQUENCEOF, OPTIONAL;
        struct TravelerInformationCommon_SegmentAttributeXYList enabled;  // SEQUENCEOF, OPTIONAL;
        struct TravelerInformationCommon_LaneDataAttributeList data;  // SEQUENCEOF, OPTIONAL;
        struct OPT_INT_ASN dWidth;  // INTEGER, OPTIONAL, -512..511;
        struct OPT_INT_ASN dElevation;  // INTEGER, OPTIONAL, -512..511;
        struct TravelerInformationCommon_NodeAttributeSetXY_regional regional;  // SEQUENCEOF, OPTIONAL;
    };
    
    struct TravelerInformationCommon_NodeXY {
        INT isValidFlag;   // necessary if this struct is used as an optional field of a SEQUENCE
        struct TravelerInformationCommon_NodeOffsetPointXY delta;  // CHOICE;
        struct TravelerInformationCommon_NodeAttributeSetXY attributes;  // SEQUENCE, OPTIONAL;
    };
    
    struct TravelerInformationCommon_NodeSetXY {
        INT isValidFlag;   // necessary if this struct is used as an optional field of a SEQUENCE
        INT length;
        struct TravelerInformationCommon_NodeXY arrayValue[63];  // SEQUENCE;
    };
    
    struct TravelerInformationCommon_ComputedLane_offsetXaxis {
        INT isValidFlag;   // necessary if this struct is used as an optional field of a SEQUENCE
        INT choice;
        INT small;  // INTEGER, -2047..2047;
        INT large;  // INTEGER, -32767..32767;
    };
    
    struct TravelerInformationCommon_ComputedLane_offsetYaxis {
        INT isValidFlag;   // necessary if this struct is used as an optional field of a SEQUENCE
        INT choice;
        INT small;  // INTEGER, -2047..2047;
        INT large;  // INTEGER, -32767..32767;
    };
    
    struct TravelerInformationCommon_RegionalExtension_Reg_ComputedLane_table {
    };
    
    struct TravelerInformationCommon_RegionalExtension_Reg_ComputedLane {
        INT isValidFlag;   // necessary if this struct is used as an optional field of a SEQUENCE
        BYTE regionId;  // INTEGER, 0..255, noRegion(0), addGrpA(1), addGrpB(2), addGrpC(3), addGrpD(4);
        struct TravelerInformationCommon_RegionalExtension_Reg_ComputedLane_table regExtvalue;  // TABLE;
    };
    
    struct TravelerInformationCommon_ComputedLane_regional {
        INT isValidFlag;   // necessary if this struct is used as an optional field of a SEQUENCE
        INT length;
        struct TravelerInformationCommon_RegionalExtension_Reg_ComputedLane arrayValue[4];  // SEQUENCE;
    };
    
    struct TravelerInformationCommon_ComputedLane {
        INT isValidFlag;   // necessary if this struct is used as an optional field of a SEQUENCE
        BYTE referenceLaneId;  // INTEGER, 0..255;
        struct TravelerInformationCommon_ComputedLane_offsetXaxis offsetXaxis;  // CHOICE;
        struct TravelerInformationCommon_ComputedLane_offsetYaxis offsetYaxis;  // CHOICE;
        struct OPT_WORD_ASN rotateXY;  // INTEGER, OPTIONAL, 0..28800;
        struct OPT_INT_ASN scaleXaxis;  // INTEGER, OPTIONAL, -2048..2047;
        struct OPT_INT_ASN scaleYaxis;  // INTEGER, OPTIONAL, -2048..2047;
        struct TravelerInformationCommon_ComputedLane_regional regional;  // SEQUENCEOF, OPTIONAL;
    };
    
    struct TravelerInformationCommon_NodeListXY {
        INT isValidFlag;   // necessary if this struct is used as an optional field of a SEQUENCE
        INT choice;
        struct TravelerInformationCommon_NodeSetXY nodes;  // SEQUENCEOF;
        struct TravelerInformationCommon_ComputedLane computed;  // SEQUENCE;
    };
    
    struct TravelerInformationNode_LL_24B {
        INT isValidFlag;   // necessary if this struct is used as an optional field of a SEQUENCE
        INT lon;  // INTEGER, -2048..2047;
        INT lat;  // INTEGER, -2048..2047;
    };
    
    struct TravelerInformationNode_LL_28B {
        INT isValidFlag;   // necessary if this struct is used as an optional field of a SEQUENCE
        INT lon;  // INTEGER, -8192..8191;
        INT lat;  // INTEGER, -8192..8191;
    };
    
    struct TravelerInformationNode_LL_32B {
        INT isValidFlag;   // necessary if this struct is used as an optional field of a SEQUENCE
        INT lon;  // INTEGER, -32768..32767;
        INT lat;  // INTEGER, -32768..32767;
    };
    
    struct TravelerInformationNode_LL_36B {
        INT isValidFlag;   // necessary if this struct is used as an optional field of a SEQUENCE
        LONG lon;  // INTEGER, -131072..131071;
        LONG lat;  // INTEGER, -131072..131071;
    };
    
    struct TravelerInformationNode_LL_44B {
        INT isValidFlag;   // necessary if this struct is used as an optional field of a SEQUENCE
        LONG lon;  // INTEGER, -2097152..2097151;
        LONG lat;  // INTEGER, -2097152..2097151;
    };
    
    struct TravelerInformationNode_LL_48B {
        INT isValidFlag;   // necessary if this struct is used as an optional field of a SEQUENCE
        LONG lon;  // INTEGER, -8388608..8388607;
        LONG lat;  // INTEGER, -8388608..8388607;
    };
    
    struct TravelerInformationCommon_RegionalExtension_Reg_NodeOffsetPointLL_table {
    };
    
    struct TravelerInformationCommon_RegionalExtension_Reg_NodeOffsetPointLL {
        INT isValidFlag;   // necessary if this struct is used as an optional field of a SEQUENCE
        BYTE regionId;  // INTEGER, 0..255, noRegion(0), addGrpA(1), addGrpB(2), addGrpC(3), addGrpD(4);
        struct TravelerInformationCommon_RegionalExtension_Reg_NodeOffsetPointLL_table regExtvalue;  // TABLE;
    };
    
    struct TravelerInformationNodeOffsetPointLL {
        INT isValidFlag;   // necessary if this struct is used as an optional field of a SEQUENCE
        INT choice;
        struct TravelerInformationNode_LL_24B node_LL1;  // SEQUENCE;
        struct TravelerInformationNode_LL_28B node_LL2;  // SEQUENCE;
        struct TravelerInformationNode_LL_32B node_LL3;  // SEQUENCE;
        struct TravelerInformationNode_LL_36B node_LL4;  // SEQUENCE;
        struct TravelerInformationNode_LL_44B node_LL5;  // SEQUENCE;
        struct TravelerInformationNode_LL_48B node_LL6;  // SEQUENCE;
        struct TravelerInformationCommon_Node_LLmD_64b node_LatLon;  // SEQUENCE;
        struct TravelerInformationCommon_RegionalExtension_Reg_NodeOffsetPointLL regional;  // SEQUENCE;
    };
    
    struct TravelerInformationNodeAttributeLLList {
        INT isValidFlag;   // necessary if this struct is used as an optional field of a SEQUENCE
        INT length;
        INT arrayValue[8];  // ENUMERATED, reserved(-0), stopLine(1), roundedCapStyleA(2), roundedCapStyleB(3), mergePoint(4), divergePoint(5), downstreamStopLine(6), downstreamStartNode(7), closedToTraffic(8), safeIsland(9), curbPresentAtStepOff(10), hydrantPresent(11);
    };
    
    struct TravelerInformationSegmentAttributeLLList {
        INT isValidFlag;   // necessary if this struct is used as an optional field of a SEQUENCE
        INT length;
        INT arrayValue[8];  // ENUMERATED, reserved(-0), doNotBlock(1), whiteLine(2), mergingLaneLeft(3), mergingLaneRight(4), curbOnLeft(5), curbOnRight(6), loadingzoneOnLeft(7), loadingzoneOnRight(8), turnOutPointOnLeft(9), turnOutPointOnRight(10), adjacentParkingOnLeft(11), adjacentParkingOnRight(12), adjacentBikeLaneOnLeft(13), adjacentBikeLaneOnRight(14), sharedBikeLane(15), bikeBoxInFront(16), transitStopOnLeft(17), transitStopOnRight(18), transitStopInLane(19), sharedWithTrackedVehicle(20), safeIsland(21), lowCurbsPresent(22), rumbleStripPresent(23), audibleSignalingPresent(24), adaptiveTimingPresent(25), rfSignalRequestPresent(26), partialCurbIntrusion(27), taperToLeft(28), taperToRight(29), taperToCenterLine(30), parallelParking(31), headInParking(32), freeParking(33), timeRestrictionsOnParking(34), costToPark(35), midBlockCurbPresent(36), unEvenPavementPresent(37);
    };
    
    struct TravelerInformationCommon_RegionalExtension_Reg_NodeAttributeSetLL_table {
    };
    
    struct TravelerInformationCommon_RegionalExtension_Reg_NodeAttributeSetLL {
        INT isValidFlag;   // necessary if this struct is used as an optional field of a SEQUENCE
        BYTE regionId;  // INTEGER, 0..255, noRegion(0), addGrpA(1), addGrpB(2), addGrpC(3), addGrpD(4);
        struct TravelerInformationCommon_RegionalExtension_Reg_NodeAttributeSetLL_table regExtvalue;  // TABLE;
    };
    
    struct TravelerInformationNodeAttributeSetLL_regional {
        INT isValidFlag;   // necessary if this struct is used as an optional field of a SEQUENCE
        INT length;
        struct TravelerInformationCommon_RegionalExtension_Reg_NodeAttributeSetLL arrayValue[4];  // SEQUENCE;
    };
    
    struct TravelerInformationNodeAttributeSetLL {
        INT isValidFlag;   // necessary if this struct is used as an optional field of a SEQUENCE
        struct TravelerInformationNodeAttributeLLList localNode;  // SEQUENCEOF, OPTIONAL;
        struct TravelerInformationSegmentAttributeLLList disabled;  // SEQUENCEOF, OPTIONAL;
        struct TravelerInformationSegmentAttributeLLList enabled;  // SEQUENCEOF, OPTIONAL;
        struct TravelerInformationCommon_LaneDataAttributeList data;  // SEQUENCEOF, OPTIONAL;
        struct OPT_INT_ASN dWidth;  // INTEGER, OPTIONAL, -512..511;
        struct OPT_INT_ASN dElevation;  // INTEGER, OPTIONAL, -512..511;
        struct TravelerInformationNodeAttributeSetLL_regional regional;  // SEQUENCEOF, OPTIONAL;
    };
    
    struct TravelerInformationNodeLL {
        INT isValidFlag;   // necessary if this struct is used as an optional field of a SEQUENCE
        struct TravelerInformationNodeOffsetPointLL delta;  // CHOICE;
        struct TravelerInformationNodeAttributeSetLL attributes;  // SEQUENCE, OPTIONAL;
    };
    
    struct TravelerInformationNodeSetLL {
        INT isValidFlag;   // necessary if this struct is used as an optional field of a SEQUENCE
        INT length;
        struct TravelerInformationNodeLL arrayValue[63];  // SEQUENCE;
    };
    
    struct TravelerInformationNodeListLL {
        INT isValidFlag;   // necessary if this struct is used as an optional field of a SEQUENCE
        INT choice;
        struct TravelerInformationNodeSetLL nodes;  // SEQUENCEOF;
    };
    
    struct TravelerInformationOffsetSystem_offset {
        INT isValidFlag;   // necessary if this struct is used as an optional field of a SEQUENCE
        INT choice;
        struct TravelerInformationCommon_NodeListXY xy;  // CHOICE;
        struct TravelerInformationNodeListLL ll;  // CHOICE;
    };
    
    struct TravelerInformationOffsetSystem {
        INT isValidFlag;   // necessary if this struct is used as an optional field of a SEQUENCE
        struct OPT_BYTE_ASN scale;  // INTEGER, OPTIONAL, 0..15;
        struct TravelerInformationOffsetSystem_offset offset;  // CHOICE;
    };
    
    struct TravelerInformationCircle {
        INT isValidFlag;   // necessary if this struct is used as an optional field of a SEQUENCE
        struct TravelerInformationCommon_Position3D center;  // SEQUENCE;
        WORD radius;  // INTEGER, 0..4095;
        INT units;  // ENUMERATED, centimeter(0), cm2_5(1), decimeter(2), meter(3), kilometer(4), foot(5), yard(6), mile(7);
    };
    
    struct TravelerInformationCommon_RegionalExtension_Reg_GeometricProjection_table {
    };
    
    struct TravelerInformationCommon_RegionalExtension_Reg_GeometricProjection {
        INT isValidFlag;   // necessary if this struct is used as an optional field of a SEQUENCE
        BYTE regionId;  // INTEGER, 0..255, noRegion(0), addGrpA(1), addGrpB(2), addGrpC(3), addGrpD(4);
        struct TravelerInformationCommon_RegionalExtension_Reg_GeometricProjection_table regExtvalue;  // TABLE;
    };
    
    struct TravelerInformationGeometricProjection_regional {
        INT isValidFlag;   // necessary if this struct is used as an optional field of a SEQUENCE
        INT length;
        struct TravelerInformationCommon_RegionalExtension_Reg_GeometricProjection arrayValue[4];  // SEQUENCE;
    };
    
    struct TravelerInformationGeometricProjection {
        INT isValidFlag;   // necessary if this struct is used as an optional field of a SEQUENCE
        struct TravelerInformationCommon_HeadingSlice direction;  // BITSTRING;
        struct OPT_ENUM_ASN extent;  // ENUMERATED, OPTIONAL, useInstantlyOnly(0), useFor3meters(1), useFor10meters(2), useFor50meters(3), useFor100meters(4), useFor500meters(5), useFor1000meters(6), useFor5000meters(7), useFor10000meters(8), useFor50000meters(9), useFor100000meters(10), useFor500000meters(11), useFor1000000meters(12), useFor5000000meters(13), useFor10000000meters(14), forever(15);
        struct OPT_WORD_ASN laneWidth;  // INTEGER, OPTIONAL, 0..32767;
        struct TravelerInformationCircle circle;  // SEQUENCE;
        struct TravelerInformationGeometricProjection_regional regional;  // SEQUENCEOF, OPTIONAL;
    };
    
    struct TravelerInformationShapePointSet {
        INT isValidFlag;   // necessary if this struct is used as an optional field of a SEQUENCE
        struct TravelerInformationCommon_Position3D anchor;  // SEQUENCE, OPTIONAL;
        struct OPT_WORD_ASN laneWidth;  // INTEGER, OPTIONAL, 0..32767;
        struct OPT_ENUM_ASN directionality;  // ENUMERATED, OPTIONAL, unavailable(0), forward(1), reverse(2), both(3);
        struct TravelerInformationCommon_NodeListXY nodeList;  // CHOICE;
    };
    
    struct TravelerInformationRegionOffsets {
        INT isValidFlag;   // necessary if this struct is used as an optional field of a SEQUENCE
        INT xOffset;  // INTEGER, -32768..32767;
        INT yOffset;  // INTEGER, -32768..32767;
        struct OPT_INT_ASN zOffset;  // INTEGER, OPTIONAL, -32768..32767;
    };
    
    struct TravelerInformationRegionList {
        INT isValidFlag;   // necessary if this struct is used as an optional field of a SEQUENCE
        INT length;
        struct TravelerInformationRegionOffsets arrayValue[64];  // SEQUENCE;
    };
    
    struct TravelerInformationRegionPointSet {
        INT isValidFlag;   // necessary if this struct is used as an optional field of a SEQUENCE
        struct TravelerInformationCommon_Position3D anchor;  // SEQUENCE, OPTIONAL;
        struct OPT_BYTE_ASN scale;  // INTEGER, OPTIONAL, 0..15;
        struct TravelerInformationRegionList nodeList;  // SEQUENCEOF;
    };
    
    struct TravelerInformationValidRegion_area {
        INT isValidFlag;   // necessary if this struct is used as an optional field of a SEQUENCE
        INT choice;
        struct TravelerInformationShapePointSet shapePointSet;  // SEQUENCE;
        struct TravelerInformationCircle circle;  // SEQUENCE;
        struct TravelerInformationRegionPointSet regionPointSet;  // SEQUENCE;
    };
    
    struct TravelerInformationValidRegion {
        INT isValidFlag;   // necessary if this struct is used as an optional field of a SEQUENCE
        struct TravelerInformationCommon_HeadingSlice direction;  // BITSTRING;
        struct OPT_ENUM_ASN extent;  // ENUMERATED, OPTIONAL, useInstantlyOnly(0), useFor3meters(1), useFor10meters(2), useFor50meters(3), useFor100meters(4), useFor500meters(5), useFor1000meters(6), useFor5000meters(7), useFor10000meters(8), useFor50000meters(9), useFor100000meters(10), useFor500000meters(11), useFor1000000meters(12), useFor5000000meters(13), useFor10000000meters(14), forever(15);
        struct TravelerInformationValidRegion_area area;  // CHOICE;
    };
    
    struct TravelerInformationGeographicalPath_description {
        INT isValidFlag;   // necessary if this struct is used as an optional field of a SEQUENCE
        INT choice;
        struct TravelerInformationOffsetSystem path;  // SEQUENCE;
        struct TravelerInformationGeometricProjection geometry;  // SEQUENCE;
        struct TravelerInformationValidRegion oldRegion;  // SEQUENCE;
    };
    
    struct TravelerInformationCommon_RegionalExtension_Reg_GeographicalPath_table {
    };
    
    struct TravelerInformationCommon_RegionalExtension_Reg_GeographicalPath {
        INT isValidFlag;   // necessary if this struct is used as an optional field of a SEQUENCE
        BYTE regionId;  // INTEGER, 0..255, noRegion(0), addGrpA(1), addGrpB(2), addGrpC(3), addGrpD(4);
        struct TravelerInformationCommon_RegionalExtension_Reg_GeographicalPath_table regExtvalue;  // TABLE;
    };
    
    struct TravelerInformationGeographicalPath_regional {
        INT isValidFlag;   // necessary if this struct is used as an optional field of a SEQUENCE
        INT length;
        struct TravelerInformationCommon_RegionalExtension_Reg_GeographicalPath arrayValue[4];  // SEQUENCE;
    };
    
    struct TravelerInformationGeographicalPath {
        INT isValidFlag;   // necessary if this struct is used as an optional field of a SEQUENCE
        struct TravelerInformationCommon_DescriptiveName name;  // IA5STRING, OPTIONAL;
        struct TravelerInformationCommon_RoadSegmentReferenceID id;  // SEQUENCE, OPTIONAL;
        struct TravelerInformationCommon_Position3D anchor;  // SEQUENCE, OPTIONAL;
        struct OPT_WORD_ASN laneWidth;  // INTEGER, OPTIONAL, 0..32767;
        struct OPT_ENUM_ASN directionality;  // ENUMERATED, OPTIONAL, unavailable(0), forward(1), reverse(2), both(3);
        struct OPT_BOOL_ASN closedPath;  // BOOLEAN, OPTIONAL;
        struct TravelerInformationCommon_HeadingSlice direction;  // BITSTRING, OPTIONAL;
        struct TravelerInformationGeographicalPath_description description;  // CHOICE, OPTIONAL;
        struct TravelerInformationGeographicalPath_regional regional;  // SEQUENCEOF, OPTIONAL;
    };
    
    struct TravelerInformationTravelerDataFrame_regions {
        INT isValidFlag;   // necessary if this struct is used as an optional field of a SEQUENCE
        INT length;
        struct TravelerInformationGeographicalPath arrayValue[16];  // SEQUENCE;
    };
    
    struct TravelerInformationITIS_ITIStext {
        INT isValidFlag;   // necessary if this struct is used as an optional field of a SEQUENCE
        CHAR string[501];
        INT  stringLength;
    };
    
    struct TravelerInformationITIS_ITIScodesAndText__item {
        INT isValidFlag;   // necessary if this struct is used as an optional field of a SEQUENCE
        INT choice;
        WORD itis;  // INTEGER, 0..65535;
        struct TravelerInformationITIS_ITIStext text;  // IA5STRING;
    };
    
    struct TravelerInformationITIS_ITIScodesAndText_ {
        INT isValidFlag;   // necessary if this struct is used as an optional field of a SEQUENCE
        struct TravelerInformationITIS_ITIScodesAndText__item item;  // CHOICE;
    };
    
    struct TravelerInformationITIS_ITIScodesAndText {
        INT isValidFlag;   // necessary if this struct is used as an optional field of a SEQUENCE
        INT length;
        struct TravelerInformationITIS_ITIScodesAndText_ arrayValue[100];  // SEQUENCE;
    };
    
    struct TravelerInformationITIStextPhrase {
        INT isValidFlag;   // necessary if this struct is used as an optional field of a SEQUENCE
        CHAR string[17];
        INT  stringLength;
    };
    
    struct TravelerInformationWorkZone__item {
        INT isValidFlag;   // necessary if this struct is used as an optional field of a SEQUENCE
        INT choice;
        WORD itis;  // INTEGER, 0..65535;
        struct TravelerInformationITIStextPhrase text;  // IA5STRING;
    };
    
    struct TravelerInformationWorkZone_ {
        INT isValidFlag;   // necessary if this struct is used as an optional field of a SEQUENCE
        struct TravelerInformationWorkZone__item item;  // CHOICE;
    };
    
    struct TravelerInformationWorkZone {
        INT isValidFlag;   // necessary if this struct is used as an optional field of a SEQUENCE
        INT length;
        struct TravelerInformationWorkZone_ arrayValue[16];  // SEQUENCE;
    };
    
    struct TravelerInformationGenericSignage__item {
        INT isValidFlag;   // necessary if this struct is used as an optional field of a SEQUENCE
        INT choice;
        WORD itis;  // INTEGER, 0..65535;
        struct TravelerInformationITIStextPhrase text;  // IA5STRING;
    };
    
    struct TravelerInformationGenericSignage_ {
        INT isValidFlag;   // necessary if this struct is used as an optional field of a SEQUENCE
        struct TravelerInformationGenericSignage__item item;  // CHOICE;
    };
    
    struct TravelerInformationGenericSignage {
        INT isValidFlag;   // necessary if this struct is used as an optional field of a SEQUENCE
        INT length;
        struct TravelerInformationGenericSignage_ arrayValue[16];  // SEQUENCE;
    };
    
    struct TravelerInformationSpeedLimit__item {
        INT isValidFlag;   // necessary if this struct is used as an optional field of a SEQUENCE
        INT choice;
        WORD itis;  // INTEGER, 0..65535;
        struct TravelerInformationITIStextPhrase text;  // IA5STRING;
    };
    
    struct TravelerInformationSpeedLimit_ {
        INT isValidFlag;   // necessary if this struct is used as an optional field of a SEQUENCE
        struct TravelerInformationSpeedLimit__item item;  // CHOICE;
    };
    
    struct TravelerInformationSpeedLimit {
        INT isValidFlag;   // necessary if this struct is used as an optional field of a SEQUENCE
        INT length;
        struct TravelerInformationSpeedLimit_ arrayValue[16];  // SEQUENCE;
    };
    
    struct TravelerInformationExitService__item {
        INT isValidFlag;   // necessary if this struct is used as an optional field of a SEQUENCE
        INT choice;
        WORD itis;  // INTEGER, 0..65535;
        struct TravelerInformationITIStextPhrase text;  // IA5STRING;
    };
    
    struct TravelerInformationExitService_ {
        INT isValidFlag;   // necessary if this struct is used as an optional field of a SEQUENCE
        struct TravelerInformationExitService__item item;  // CHOICE;
    };
    
    struct TravelerInformationExitService {
        INT isValidFlag;   // necessary if this struct is used as an optional field of a SEQUENCE
        INT length;
        struct TravelerInformationExitService_ arrayValue[16];  // SEQUENCE;
    };
    
    struct TravelerInformationTravelerDataFrame_content {
        INT isValidFlag;   // necessary if this struct is used as an optional field of a SEQUENCE
        INT choice;
        struct TravelerInformationITIS_ITIScodesAndText advisory;  // SEQUENCEOF;
        struct TravelerInformationWorkZone workZone;  // SEQUENCEOF;
        struct TravelerInformationGenericSignage genericSign;  // SEQUENCEOF;
        struct TravelerInformationSpeedLimit speedLimit;  // SEQUENCEOF;
        struct TravelerInformationExitService exitService;  // SEQUENCEOF;
    };
    
    struct TravelerInformationURL_Short {
        INT isValidFlag;   // necessary if this struct is used as an optional field of a SEQUENCE
        CHAR string[16];
        INT  stringLength;
    };
    
    struct TravelerInformationCommon_PortlandCement {
        INT isValidFlag;   // necessary if this struct is used as an optional field of a SEQUENCE
        INT type;  // ENUMERATED, newSharp(-0), traveled(1), trafficPolished(2);
    };
    
    struct TravelerInformationCommon_AsphaltOrTar {
        INT isValidFlag;   // necessary if this struct is used as an optional field of a SEQUENCE
        INT type;  // ENUMERATED, newSharp(-0), traveled(1), trafficPolished(2), excessTar(3);
    };
    
    struct TravelerInformationCommon_Gravel {
        INT isValidFlag;   // necessary if this struct is used as an optional field of a SEQUENCE
        INT type;  // ENUMERATED, packedOiled(-0), loose(1);
    };
    
    struct TravelerInformationCommon_Grass {
        INT isValidFlag;   // necessary if this struct is used as an optional field of a SEQUENCE
        INT type;  // ENUMERATED, lessThan30Mph(-0);
    };
    
    struct TravelerInformationCommon_Cinders {
        INT isValidFlag;   // necessary if this struct is used as an optional field of a SEQUENCE
        INT type;  // ENUMERATED, packed(-0);
    };
    
    struct TravelerInformationCommon_Rock {
        INT isValidFlag;   // necessary if this struct is used as an optional field of a SEQUENCE
        INT type;  // ENUMERATED, crushed(-0);
    };
    
    struct TravelerInformationCommon_Ice {
        INT isValidFlag;   // necessary if this struct is used as an optional field of a SEQUENCE
        INT type;  // ENUMERATED, smooth(-0);
    };
    
    struct TravelerInformationCommon_Snow {
        INT isValidFlag;   // necessary if this struct is used as an optional field of a SEQUENCE
        INT type;  // ENUMERATED, packed(-0), loose(1);
    };
    
    struct TravelerInformationCommon_DescriptionOfRoadSurface {
        INT isValidFlag;   // necessary if this struct is used as an optional field of a SEQUENCE
        INT choice;
        struct TravelerInformationCommon_PortlandCement portlandCement;  // SEQUENCE;
        struct TravelerInformationCommon_AsphaltOrTar asphaltOrTar;  // SEQUENCE;
        struct TravelerInformationCommon_Gravel gravel;  // SEQUENCE;
        struct TravelerInformationCommon_Grass grass;  // SEQUENCE;
        struct TravelerInformationCommon_Cinders cinders;  // SEQUENCE;
        struct TravelerInformationCommon_Rock rock;  // SEQUENCE;
        struct TravelerInformationCommon_Ice ice;  // SEQUENCE;
        struct TravelerInformationCommon_Snow snow;  // SEQUENCE;
    };
    
    struct TravelerInformationCommon_RoadRoughness {
        INT isValidFlag;   // necessary if this struct is used as an optional field of a SEQUENCE
        WORD meanVerticalVariation;  // INTEGER, 0..25000;
        struct OPT_WORD_ASN verticalVariationStdDev;  // INTEGER, OPTIONAL, 0..2500;
        struct OPT_WORD_ASN meanHorizontalVariation;  // INTEGER, OPTIONAL, 0..25000;
        struct OPT_WORD_ASN horizontalVariationStdDev;  // INTEGER, OPTIONAL, 0..2500;
    };
    
    struct TravelerInformationCommon_FrictionInformation {
        INT isValidFlag;   // necessary if this struct is used as an optional field of a SEQUENCE
        struct TravelerInformationCommon_DescriptionOfRoadSurface roadSurfaceDescription;  // CHOICE;
        struct OPT_ENUM_ASN dryOrWet;  // ENUMERATED, OPTIONAL, dry(-0), wet(1);
        struct TravelerInformationCommon_RoadRoughness roadRoughness;  // SEQUENCE, OPTIONAL;
    };
    
    struct TravelerInformationTravelerDataFrameNewPartIIIContent {
        INT isValidFlag;   // necessary if this struct is used as an optional field of a SEQUENCE
        INT choice;
        struct TravelerInformationCommon_FrictionInformation frictionInfo;  // SEQUENCE;
    };
    
    struct TravelerInformationTravelerDataFrame {
        INT isValidFlag;   // necessary if this struct is used as an optional field of a SEQUENCE
        BYTE doNotUse1;  // INTEGER, 0..31;
        INT frameType;  // ENUMERATED, unknown(0), advisory(1), roadSignage(2), commercialSignage(3);
        struct TravelerInformationTravelerDataFrame_msgId msgId;  // CHOICE;
        struct OPT_WORD_ASN startYear;  // INTEGER, OPTIONAL, 0..4095;
        DWORD startTime;  // INTEGER, 0..527040;
        WORD durationTime;  // INTEGER, 0..32000;
        BYTE priority;  // INTEGER, 0..7;
        BYTE doNotUse2;  // INTEGER, 0..31;
        struct TravelerInformationTravelerDataFrame_regions regions;  // SEQUENCEOF;
        BYTE doNotUse3;  // INTEGER, 0..31;
        BYTE doNotUse4;  // INTEGER, 0..31;
        struct TravelerInformationTravelerDataFrame_content content;  // CHOICE;
        struct TravelerInformationURL_Short url;  // IA5STRING, OPTIONAL;
        struct TravelerInformationTravelerDataFrameNewPartIIIContent contentNew;  // CHOICE;
    };
    
    struct TravelerInformationTravelerDataFrameList {
        INT isValidFlag;   // necessary if this struct is used as an optional field of a SEQUENCE
        INT length;
        struct TravelerInformationTravelerDataFrame arrayValue[8];  // SEQUENCE;
    };
    
    struct TravelerInformationCommon_RegionalExtension_Reg_TravelerInformation_table {
    };
    
    struct TravelerInformationCommon_RegionalExtension_Reg_TravelerInformation {
        INT isValidFlag;   // necessary if this struct is used as an optional field of a SEQUENCE
        BYTE regionId;  // INTEGER, 0..255, noRegion(0), addGrpA(1), addGrpB(2), addGrpC(3), addGrpD(4);
        struct TravelerInformationCommon_RegionalExtension_Reg_TravelerInformation_table regExtvalue;  // TABLE;
    };
    
    struct TravelerInformationTravelerInformation_regional {
        INT isValidFlag;   // necessary if this struct is used as an optional field of a SEQUENCE
        INT length;
        struct TravelerInformationCommon_RegionalExtension_Reg_TravelerInformation arrayValue[4];  // SEQUENCE;
    };
    
    struct TravelerInformation_TravelerInformation {
        INT isValidFlag;   // necessary if this struct is used as an optional field of a SEQUENCE
        BYTE msgCnt;  // INTEGER, 0..127;
        struct OPT_DWORD_ASN timeStamp;  // INTEGER, OPTIONAL, 0..527040;
        struct TravelerInformationUniqueMSGID packetID;  // OCTETSTRING, OPTIONAL;
        struct TravelerInformationURL_Base urlB;  // IA5STRING, OPTIONAL;
        struct TravelerInformationTravelerDataFrameList dataFrames;  // SEQUENCEOF;
        struct TravelerInformationTravelerInformation_regional regional;  // SEQUENCEOF, OPTIONAL;
    };
    
    struct TravelerInformationMESSAGE_ID_AND_TYPE {
        struct TravelerInformation_TravelerInformation travelerInformation;  // SEQUENCE;
    };
    
    struct TravelerInformation {
        INT isValidFlag;   // necessary if this struct is used as an optional field of a SEQUENCE
        WORD messageId;  // INTEGER, 0..32767, mapData(18), signalPhaseAndTimingMessage(19), basicSafetyMessage(20), commonSafetyRequest(21), emergencyVehicleAlert(22), intersectionCollision(23), nmeaCorrections(24), probeDataManagement(25), probeVehicleData(26), roadSideAlert(27), rtcmCorrections(28), signalRequestMessage(29), signalStatusMessage(30), travelerInformation(31), personalSafetyMessage(32), roadSafetyMessage(33), roadWeatherMessage(34), probeDataConfigMessage(35), probeDataReportMessage(36), tollAdvertisementMessage(37), tollUsageMessage(38), tollUsageAckMessage(39), cooperativeControlMessage(40), sensorDataSharingMessage(41), maneuverSharingAndCoordinatingMessage(42), roadGeometryAndAttributes(43), personalSafetyMessage2(44), trafficSignalPhaseAndTiming(45), signalControlAndPrioritizationRequest(46), signalControlAndPrioritizationStatus(47), roadUserChargingConfigMessage(48), roadUserChargingReportMessage(49), trafficLightStatusMessage(50);
        struct TravelerInformationMESSAGE_ID_AND_TYPE value;  // TABLE;
    };
    
}

/*
// init function to create a simple packet handle
*/ 
LONG API_InitTravelerInformationPacket()
{
  return C2xInitPacket("TravelerInformation"); 
}

/*
// init function to create a simple packet handle and
// initialize the struct with valid data
*/ 
LONG API_InitTravelerInformationPacket(struct TravelerInformation msgStruct)
{
  long pktHandle;

  pktHandle = API_InitTravelerInformationPacket();

  if (pktHandle != 0)
  {
    // create valid message and application data
    if (C2xCompletePacket(pktHandle) == 0) 
    {
      API_GetTravelerInformationParams(pktHandle, msgStruct);
    }
  }
  return pktHandle;
}

/*
// init function to create a packet with security layer and
// initialize the struct with valid data
*/ 
LONG API_InitTravelerInformationPacket(struct TravelerInformation msgStruct, char packetTypeDesignator[], char certificateName[])
{
  long pktHandle, certHdl;

  // initialize the packet
  pktHandle = C2xInitPacket("TravelerInformation", packetTypeDesignator);

  if (pktHandle != 0)
  {
    certHdl = C2xSecCertificateGetHandle(certificateName);  // get the certificate handle for the cert with name "certificateName"
    if (certHdl != 0) 
    {
      C2xSecPacketSetSignerHandle(pktHandle, certHdl); // set the certHdl to the packet
    }

    // create valid message and application data
    if (C2xCompletePacket(pktHandle) == 0) 
    {
      // copy application data to the application structure
      API_GetTravelerInformationParams(pktHandle, msgStruct);
    }
  }
  return pktHandle;
}
    

int GetTravelerInformationAddGrpB_LatitudeDMS2Params(LONG packetHandle, struct TravelerInformationAddGrpB_LatitudeDMS2 value, char oldPath[])
{
  char newPath[300];
  int result;

  result = 0;

  snprintf(newPath, elcount(newPath), "%s.%s", oldPath, "d");
  value.d = C2xGetTokenInt(packetHandle, "TravelerInformation", newPath);
  result = CheckLastError("TravelerInformation", gkFuncRefGet, result);

  snprintf(newPath, elcount(newPath), "%s.%s", oldPath, "m");
  value.m = C2xGetTokenInt(packetHandle, "TravelerInformation", newPath);
  result = CheckLastError("TravelerInformation", gkFuncRefGet, result);

  snprintf(newPath, elcount(newPath), "%s.%s", oldPath, "s");
  value.s = C2xGetTokenInt(packetHandle, "TravelerInformation", newPath);
  result = CheckLastError("TravelerInformation", gkFuncRefGet, result);

  return result;
}

int SetTravelerInformationAddGrpB_LatitudeDMS2Params(LONG packetHandle, struct TravelerInformationAddGrpB_LatitudeDMS2 value, char oldPath[])
{
  char newPath[300];
  int result;

  result = 0;

  snprintf(newPath, elcount(newPath), "%s.%s", oldPath, "d");
  C2xSetTokenInt(packetHandle, "TravelerInformation", newPath, value.d);
  result = CheckLastError("TravelerInformation", gkFuncRefGet, result);

  snprintf(newPath, elcount(newPath), "%s.%s", oldPath, "m");
  C2xSetTokenInt(packetHandle, "TravelerInformation", newPath, value.m);
  result = CheckLastError("TravelerInformation", gkFuncRefGet, result);

  snprintf(newPath, elcount(newPath), "%s.%s", oldPath, "s");
  C2xSetTokenInt(packetHandle, "TravelerInformation", newPath, value.s);
  result = CheckLastError("TravelerInformation", gkFuncRefGet, result);

  return result;
}

int GetTravelerInformationAddGrpB_LongitudeDMS2Params(LONG packetHandle, struct TravelerInformationAddGrpB_LongitudeDMS2 value, char oldPath[])
{
  char newPath[300];
  int result;

  result = 0;

  snprintf(newPath, elcount(newPath), "%s.%s", oldPath, "d");
  value.d = C2xGetTokenInt(packetHandle, "TravelerInformation", newPath);
  result = CheckLastError("TravelerInformation", gkFuncRefGet, result);

  snprintf(newPath, elcount(newPath), "%s.%s", oldPath, "m");
  value.m = C2xGetTokenInt(packetHandle, "TravelerInformation", newPath);
  result = CheckLastError("TravelerInformation", gkFuncRefGet, result);

  snprintf(newPath, elcount(newPath), "%s.%s", oldPath, "s");
  value.s = C2xGetTokenInt(packetHandle, "TravelerInformation", newPath);
  result = CheckLastError("TravelerInformation", gkFuncRefGet, result);

  return result;
}

int SetTravelerInformationAddGrpB_LongitudeDMS2Params(LONG packetHandle, struct TravelerInformationAddGrpB_LongitudeDMS2 value, char oldPath[])
{
  char newPath[300];
  int result;

  result = 0;

  snprintf(newPath, elcount(newPath), "%s.%s", oldPath, "d");
  C2xSetTokenInt(packetHandle, "TravelerInformation", newPath, value.d);
  result = CheckLastError("TravelerInformation", gkFuncRefGet, result);

  snprintf(newPath, elcount(newPath), "%s.%s", oldPath, "m");
  C2xSetTokenInt(packetHandle, "TravelerInformation", newPath, value.m);
  result = CheckLastError("TravelerInformation", gkFuncRefGet, result);

  snprintf(newPath, elcount(newPath), "%s.%s", oldPath, "s");
  C2xSetTokenInt(packetHandle, "TravelerInformation", newPath, value.s);
  result = CheckLastError("TravelerInformation", gkFuncRefGet, result);

  return result;
}

int GetTravelerInformationAddGrpB_Position3D_addGrpBParams(LONG packetHandle, struct TravelerInformationAddGrpB_Position3D_addGrpB value, char oldPath[])
{
  char newPath[300];
  int result;

  result = 0;

  snprintf(newPath, elcount(newPath), "%s.%s", oldPath, "latitude");
  GetTravelerInformationAddGrpB_LatitudeDMS2Params(packetHandle, value.latitude, newPath);
  result = CheckLastError("TravelerInformation", gkFuncRefGet, result);

  snprintf(newPath, elcount(newPath), "%s.%s", oldPath, "longitude");
  GetTravelerInformationAddGrpB_LongitudeDMS2Params(packetHandle, value.longitude, newPath);
  result = CheckLastError("TravelerInformation", gkFuncRefGet, result);

  snprintf(newPath, elcount(newPath), "%s.%s", oldPath, "elevation");
  value.elevation = C2xGetTokenInt(packetHandle, "TravelerInformation", newPath);
  result = CheckLastError("TravelerInformation", gkFuncRefGet, result);

  return result;
}

int SetTravelerInformationAddGrpB_Position3D_addGrpBParams(LONG packetHandle, struct TravelerInformationAddGrpB_Position3D_addGrpB value, char oldPath[])
{
  char newPath[300];
  int result;

  result = 0;

  snprintf(newPath, elcount(newPath), "%s.%s", oldPath, "latitude");
  SetTravelerInformationAddGrpB_LatitudeDMS2Params(packetHandle, value.latitude, newPath);
  result = CheckLastError("TravelerInformation", gkFuncRefGet, result);

  snprintf(newPath, elcount(newPath), "%s.%s", oldPath, "longitude");
  SetTravelerInformationAddGrpB_LongitudeDMS2Params(packetHandle, value.longitude, newPath);
  result = CheckLastError("TravelerInformation", gkFuncRefGet, result);

  snprintf(newPath, elcount(newPath), "%s.%s", oldPath, "elevation");
  C2xSetTokenInt(packetHandle, "TravelerInformation", newPath, value.elevation);
  result = CheckLastError("TravelerInformation", gkFuncRefGet, result);

  return result;
}

int GetTravelerInformationAddGrpC_AltitudeParams(LONG packetHandle, struct TravelerInformationAddGrpC_Altitude value, char oldPath[])
{
  char newPath[300];
  int result;

  result = 0;

  snprintf(newPath, elcount(newPath), "%s.%s", oldPath, "value");
  value.value = C2xGetTokenInt(packetHandle, "TravelerInformation", newPath);
  result = CheckLastError("TravelerInformation", gkFuncRefGet, result);

  snprintf(newPath, elcount(newPath), "%s.%s", oldPath, "confidence");
  value.confidence = C2xGetTokenInt(packetHandle, "TravelerInformation", newPath);
  result = CheckLastError("TravelerInformation", gkFuncRefGet, result);

  return result;
}

int SetTravelerInformationAddGrpC_AltitudeParams(LONG packetHandle, struct TravelerInformationAddGrpC_Altitude value, char oldPath[])
{
  char newPath[300];
  int result;

  result = 0;

  snprintf(newPath, elcount(newPath), "%s.%s", oldPath, "value");
  C2xSetTokenInt(packetHandle, "TravelerInformation", newPath, value.value);
  result = CheckLastError("TravelerInformation", gkFuncRefGet, result);

  snprintf(newPath, elcount(newPath), "%s.%s", oldPath, "confidence");
  C2xSetTokenInt(packetHandle, "TravelerInformation", newPath, value.confidence);
  result = CheckLastError("TravelerInformation", gkFuncRefGet, result);

  return result;
}

int GetTravelerInformationAddGrpC_Position3D_addGrpCParams(LONG packetHandle, struct TravelerInformationAddGrpC_Position3D_addGrpC value, char oldPath[])
{
  char newPath[300];
  int result;

  result = 0;

  snprintf(newPath, elcount(newPath), "%s.%s", oldPath, "altitude");
  GetTravelerInformationAddGrpC_AltitudeParams(packetHandle, value.altitude, newPath);
  result = CheckLastError("TravelerInformation", gkFuncRefGet, result);

  return result;
}

int SetTravelerInformationAddGrpC_Position3D_addGrpCParams(LONG packetHandle, struct TravelerInformationAddGrpC_Position3D_addGrpC value, char oldPath[])
{
  char newPath[300];
  int result;

  result = 0;

  snprintf(newPath, elcount(newPath), "%s.%s", oldPath, "altitude");
  SetTravelerInformationAddGrpC_AltitudeParams(packetHandle, value.altitude, newPath);
  result = CheckLastError("TravelerInformation", gkFuncRefGet, result);

  return result;
}

int GetTravelerInformationCommon_RegionalExtension_Reg_Position3D_tableParams(LONG packetHandle, WORD tableKey, struct TravelerInformationCommon_RegionalExtension_Reg_Position3D_table value, char oldPath[])
{
  char newPath[300];
  int result;

  result = 0;

  switch(tableKey)
  {
    case 2:
    {
      snprintf(newPath, elcount(newPath), "%s.%s", oldPath, "addGrpB");
      GetTravelerInformationAddGrpB_Position3D_addGrpBParams(packetHandle, value.addGrpB, newPath);
      result = CheckLastError("TravelerInformation", gkFuncRefGet, result);
    }
    break;
    case 3:
    {
      snprintf(newPath, elcount(newPath), "%s.%s", oldPath, "addGrpC");
      GetTravelerInformationAddGrpC_Position3D_addGrpCParams(packetHandle, value.addGrpC, newPath);
      result = CheckLastError("TravelerInformation", gkFuncRefGet, result);
    }
    break;
  }
  return result;
}

int SetTravelerInformationCommon_RegionalExtension_Reg_Position3D_tableParams(LONG packetHandle, WORD tableKey, struct TravelerInformationCommon_RegionalExtension_Reg_Position3D_table value, char oldPath[])
{
  char newPath[300];
  int result;

  result = 0;

  switch(tableKey)
  {
    case 2:
    {
      snprintf(newPath, elcount(newPath), "%s.%s", oldPath, "addGrpB");
      SetTravelerInformationAddGrpB_Position3D_addGrpBParams(packetHandle, value.addGrpB, newPath);
      result = CheckLastError("TravelerInformation", gkFuncRefGet, result);
    }
    break;
    case 3:
    {
      snprintf(newPath, elcount(newPath), "%s.%s", oldPath, "addGrpC");
      SetTravelerInformationAddGrpC_Position3D_addGrpCParams(packetHandle, value.addGrpC, newPath);
      result = CheckLastError("TravelerInformation", gkFuncRefGet, result);
    }
    break;
  }
  return result;
}

int GetTravelerInformationCommon_RegionalExtension_Reg_Position3DParams(LONG packetHandle, struct TravelerInformationCommon_RegionalExtension_Reg_Position3D value, char oldPath[])
{
  char newPath[300];
  int result;

  result = 0;

  snprintf(newPath, elcount(newPath), "%s.%s", oldPath, "regionId");
  value.regionId = C2xGetTokenInt(packetHandle, "TravelerInformation", newPath);
  result = CheckLastError("TravelerInformation", gkFuncRefGet, result);

  snprintf(newPath, elcount(newPath), "%s.%s", oldPath, "regExtvalue");
  GetTravelerInformationCommon_RegionalExtension_Reg_Position3D_tableParams(packetHandle, value.regionId, value.regExtvalue, newPath);
  result = CheckLastError("TravelerInformation", gkFuncRefGet, result);

  return result;
}

int SetTravelerInformationCommon_RegionalExtension_Reg_Position3DParams(LONG packetHandle, struct TravelerInformationCommon_RegionalExtension_Reg_Position3D value, char oldPath[])
{
  char newPath[300];
  int result;

  result = 0;


  snprintf(newPath, elcount(newPath), "%s.%s", oldPath, "regExtvalue");
  SetTravelerInformationCommon_RegionalExtension_Reg_Position3D_tableParams(packetHandle, value.regionId, value.regExtvalue, newPath);
  result = CheckLastError("TravelerInformation", gkFuncRefGet, result);

  return result;
}

int GetTravelerInformationCommon_Position3D_regionalParams(LONG packetHandle, struct TravelerInformationCommon_Position3D_regional value, char oldPath[])
{
  char newPath[300]; 
  int i;
  int result;

  result = 0;

  value.length = C2xGetTokenInt(packetHandle, "TravelerInformation", oldPath);
  if((result = CheckLastError("TravelerInformation", gkFuncRefGet, result))==0)
  {
    for(i=0; i<value.length; i++)
    {
      snprintf(newPath, elcount(newPath), "%s[%d]", oldPath, i);
      GetTravelerInformationCommon_RegionalExtension_Reg_Position3DParams(packetHandle, value.arrayValue[i], newPath);
      result = CheckLastError("TravelerInformation", gkFuncRefGet, result);
    }
  }
  return result;
}

int SetTravelerInformationCommon_Position3D_regionalParams(LONG packetHandle, struct TravelerInformationCommon_Position3D_regional value, char oldPath[])
{
  char newPath[300]; 
  int i;
  int result;

  result = 0;

  C2xRemoveToken(packetHandle, "TravelerInformation", oldPath);
  for(i=0; i<value.length; i++)
  {
    snprintf(newPath, elcount(newPath), "%s[%d]", oldPath, i);
    SetTravelerInformationCommon_RegionalExtension_Reg_Position3DParams(packetHandle, value.arrayValue[i], newPath);
    result = CheckLastError("TravelerInformation", gkFuncRefGet, result);
  }
  return result;
}

int GetTravelerInformationCommon_Position3DParams(LONG packetHandle, struct TravelerInformationCommon_Position3D value, char oldPath[])
{
  char newPath[300];
  int result;

  result = 0;

  snprintf(newPath, elcount(newPath), "%s.%s", oldPath, "lat");
  value.lat = C2xGetTokenInt(packetHandle, "TravelerInformation", newPath);
  result = CheckLastError("TravelerInformation", gkFuncRefGet, result);

  snprintf(newPath, elcount(newPath), "%s.%s", oldPath, "lon");
  value.lon = C2xGetTokenInt(packetHandle, "TravelerInformation", newPath);
  result = CheckLastError("TravelerInformation", gkFuncRefGet, result);

  snprintf(newPath, elcount(newPath), "%s.%s", oldPath, "elevation");
  value.elevation.isValidFlag = C2xIsTokenAvailable(packetHandle, "TravelerInformation", newPath);
  if(value.elevation.isValidFlag==1)
  {
    value.elevation.value = C2xGetTokenInt(packetHandle, "TravelerInformation", newPath);
    result = CheckLastError("TravelerInformation", gkFuncRefGet, result);
  }
  snprintf(newPath, elcount(newPath), "%s.%s", oldPath, "regional");
  value.regional.isValidFlag = C2xIsTokenAvailable(packetHandle, "TravelerInformation", newPath);
  if(value.regional.isValidFlag==1)
  {
    GetTravelerInformationCommon_Position3D_regionalParams(packetHandle, value.regional, newPath);
    result = CheckLastError("TravelerInformation", gkFuncRefGet, result);
  }
  return result;
}

int SetTravelerInformationCommon_Position3DParams(LONG packetHandle, struct TravelerInformationCommon_Position3D value, char oldPath[])
{
  char newPath[300];
  int result;

  result = 0;

  snprintf(newPath, elcount(newPath), "%s.%s", oldPath, "lat");
  C2xSetTokenInt(packetHandle, "TravelerInformation", newPath, value.lat);
  result = CheckLastError("TravelerInformation", gkFuncRefGet, result);

  snprintf(newPath, elcount(newPath), "%s.%s", oldPath, "lon");
  C2xSetTokenInt(packetHandle, "TravelerInformation", newPath, value.lon);
  result = CheckLastError("TravelerInformation", gkFuncRefGet, result);

  snprintf(newPath, elcount(newPath), "%s.%s", oldPath, "elevation");
  if(value.elevation.isValidFlag==1)
  {
    C2xSetTokenInt(packetHandle, "TravelerInformation", newPath, value.elevation.value);
    result = CheckLastError("TravelerInformation", gkFuncRefGet, result);
  }
  else
  {
    if( C2xIsTokenAvailable(packetHandle, "TravelerInformation", newPath) )
    {
      C2xRemoveToken(packetHandle, "TravelerInformation", newPath);
    }
  }

  snprintf(newPath, elcount(newPath), "%s.%s", oldPath, "regional");
  if(value.regional.isValidFlag==1)
  {
    SetTravelerInformationCommon_Position3D_regionalParams(packetHandle, value.regional, newPath);
    result = CheckLastError("TravelerInformation", gkFuncRefGet, result);
  }
  else
  {
    if( C2xIsTokenAvailable(packetHandle, "TravelerInformation", newPath) )
    {
      C2xRemoveToken(packetHandle, "TravelerInformation", newPath);
    }
  }

  return result;
}

int GetTravelerInformationRoadSignIDParams(LONG packetHandle, struct TravelerInformationRoadSignID value, char oldPath[])
{
  char newPath[300]; 
  int j; 
  int k;
  int result;

  result = 0;

  snprintf(newPath, elcount(newPath), "%s.%s", oldPath, "position");
  GetTravelerInformationCommon_Position3DParams(packetHandle, value.position, newPath);
  result = CheckLastError("TravelerInformation", gkFuncRefGet, result);

  snprintf(newPath, elcount(newPath), "%s.%s", oldPath, "viewAngle");
  value.viewAngle.isValidFlag = 1;
  value.viewAngle.stringLength = C2xGetTokenLengthBit(packetHandle, "TravelerInformation", newPath);
  if ((result = CheckLastError("TravelerInformation", gkFuncRefGet, result))==0)
  {
    if(value.viewAngle.stringLength > 0)
    {
      for(j=0; j<value.viewAngle.stringLength; j++)
      {
        if(C2xGetTokenBitOfBitString(packetHandle, "TravelerInformation", newPath, j) == 0)
        {
          value.viewAngle.string[j] = '0';
        }
        else if(C2xGetTokenBitOfBitString(packetHandle, "TravelerInformation", newPath, j) == 1)
        {
          value.viewAngle.string[j] = '1';
        }

        if(value.viewAngle.stringLength == 1)
        {
          value.viewAngle.string[1] = '0';
        }
        result = CheckLastError("TravelerInformation", gkFuncRefGet, result);
      }
    }
    else
    {
      for(k = value.viewAngle.stringLength+1; k > -1; k--)
      {
        if(value.viewAngle.string[k] == '1')
        {
          value.viewAngle.string[k] = '0';
        }
      }
    }
  }

  snprintf(newPath, elcount(newPath), "%s.%s", oldPath, "mutcdCode");
  value.mutcdCode.isValidFlag = C2xIsTokenAvailable(packetHandle, "TravelerInformation", newPath);
  if(value.mutcdCode.isValidFlag==1)
  {
    value.mutcdCode.value = C2xGetTokenInt(packetHandle, "TravelerInformation", newPath);
    result = CheckLastError("TravelerInformation", gkFuncRefGet, result);
  }
  snprintf(newPath, elcount(newPath), "%s.%s", oldPath, "crc");
  value.crc.isValidFlag = C2xIsTokenAvailable(packetHandle, "TravelerInformation", newPath);
  if(value.crc.isValidFlag==1)
  {
    value.crc.isValidFlag = 1;
    value.crc.stringLength = C2xGetTokenData(packetHandle, "TravelerInformation", newPath, elcount(value.crc.string), value.crc.string);
  }
  return result;
}

int SetTravelerInformationRoadSignIDParams(LONG packetHandle, struct TravelerInformationRoadSignID value, char oldPath[])
{
  char newPath[300]; 
  int j;
  int result;

  result = 0;

  snprintf(newPath, elcount(newPath), "%s.%s", oldPath, "position");
  SetTravelerInformationCommon_Position3DParams(packetHandle, value.position, newPath);
  result = CheckLastError("TravelerInformation", gkFuncRefGet, result);

  snprintf(newPath, elcount(newPath), "%s.%s", oldPath, "viewAngle");
    for(j=0; j<value.viewAngle.stringLength; j++)
    {
      if(value.viewAngle.string[j] == '0')
      {
        C2xSetTokenBitOfBitString(packetHandle, "TravelerInformation", newPath, j, 0);
      }
      else
      {
        C2xSetTokenBitOfBitString(packetHandle, "TravelerInformation", newPath, j, 1);
      }
      result = CheckLastError("TravelerInformation", gkFuncRefGet, result);
    }

  snprintf(newPath, elcount(newPath), "%s.%s", oldPath, "mutcdCode");
  if(value.mutcdCode.isValidFlag==1)
  {
    C2xSetTokenInt(packetHandle, "TravelerInformation", newPath, value.mutcdCode.value);
    result = CheckLastError("TravelerInformation", gkFuncRefGet, result);
  }
  else
  {
    if( C2xIsTokenAvailable(packetHandle, "TravelerInformation", newPath) )
    {
      C2xRemoveToken(packetHandle, "TravelerInformation", newPath);
    }
  }

  snprintf(newPath, elcount(newPath), "%s.%s", oldPath, "crc");
  if(value.crc.isValidFlag==1)
  {
    C2xSetTokenData(packetHandle, "TravelerInformation", newPath, value.crc.stringLength, value.crc.string);
  }
  else
  {
    if( C2xIsTokenAvailable(packetHandle, "TravelerInformation", newPath) )
    {
      C2xRemoveToken(packetHandle, "TravelerInformation", newPath);
    }
  }

  return result;
}

int GetTravelerInformationTravelerDataFrame_msgIdParams(LONG packetHandle, struct TravelerInformationTravelerDataFrame_msgId value, char oldPath[])
{
  char newPath[300];
  char buffer[300];
  int result;

  result = 0;

  value.choice = C2xGetTokenInt(packetHandle, "TravelerInformation", oldPath);

  switch(value.choice)
  {
    case 0:
    {
      snprintf(newPath, elcount(newPath), "%s.%s", oldPath, "furtherInfoID");
      value.furtherInfoID.stringLength = C2xGetTokenData(packetHandle, "TravelerInformation", newPath, elcount(value.furtherInfoID.string), value.furtherInfoID.string);
      result = CheckLastError("TravelerInformation", gkFuncRefGet, result);
    }
    break;
    case 1:
    {
      snprintf(newPath, elcount(newPath), "%s.%s", oldPath, "roadSignID");
      GetTravelerInformationRoadSignIDParams(packetHandle, value.roadSignID, newPath);
      result = CheckLastError("TravelerInformation", gkFuncRefGet, result);
    }
    break;
  }
  return result;
}

int SetTravelerInformationTravelerDataFrame_msgIdParams(LONG packetHandle, struct TravelerInformationTravelerDataFrame_msgId value, char oldPath[])
{
  char newPath[300];
  char buffer[300];
  int result;

  result = 0;

  switch(value.choice)
  {
    case 0:
    {
      snprintf(newPath, elcount(newPath), "%s.%s", oldPath, "furtherInfoID");
      C2xSetTokenData(packetHandle, "TravelerInformation", newPath, value.furtherInfoID.stringLength, value.furtherInfoID.string);
      result = CheckLastError("TravelerInformation", gkFuncRefGet, result);
    }
    break;
    case 1:
    {
      snprintf(newPath, elcount(newPath), "%s.%s", oldPath, "roadSignID");
      SetTravelerInformationRoadSignIDParams(packetHandle, value.roadSignID, newPath);
      result = CheckLastError("TravelerInformation", gkFuncRefGet, result);
    }
    break;
  }
  return result;
}

int GetTravelerInformationCommon_RoadSegmentReferenceIDParams(LONG packetHandle, struct TravelerInformationCommon_RoadSegmentReferenceID value, char oldPath[])
{
  char newPath[300];
  int result;

  result = 0;

  snprintf(newPath, elcount(newPath), "%s.%s", oldPath, "region");
  value.region.isValidFlag = C2xIsTokenAvailable(packetHandle, "TravelerInformation", newPath);
  if(value.region.isValidFlag==1)
  {
    value.region.value = C2xGetTokenInt(packetHandle, "TravelerInformation", newPath);
    result = CheckLastError("TravelerInformation", gkFuncRefGet, result);
  }
  snprintf(newPath, elcount(newPath), "%s.%s", oldPath, "id");
  value.id = C2xGetTokenInt(packetHandle, "TravelerInformation", newPath);
  result = CheckLastError("TravelerInformation", gkFuncRefGet, result);

  return result;
}

int SetTravelerInformationCommon_RoadSegmentReferenceIDParams(LONG packetHandle, struct TravelerInformationCommon_RoadSegmentReferenceID value, char oldPath[])
{
  char newPath[300];
  int result;

  result = 0;

  snprintf(newPath, elcount(newPath), "%s.%s", oldPath, "region");
  if(value.region.isValidFlag==1)
  {
    C2xSetTokenInt(packetHandle, "TravelerInformation", newPath, value.region.value);
    result = CheckLastError("TravelerInformation", gkFuncRefGet, result);
  }
  else
  {
    if( C2xIsTokenAvailable(packetHandle, "TravelerInformation", newPath) )
    {
      C2xRemoveToken(packetHandle, "TravelerInformation", newPath);
    }
  }

  snprintf(newPath, elcount(newPath), "%s.%s", oldPath, "id");
  C2xSetTokenInt(packetHandle, "TravelerInformation", newPath, value.id);
  result = CheckLastError("TravelerInformation", gkFuncRefGet, result);

  return result;
}

int GetTravelerInformationCommon_Node_XY_20bParams(LONG packetHandle, struct TravelerInformationCommon_Node_XY_20b value, char oldPath[])
{
  char newPath[300];
  int result;

  result = 0;

  snprintf(newPath, elcount(newPath), "%s.%s", oldPath, "x");
  value.x = C2xGetTokenInt(packetHandle, "TravelerInformation", newPath);
  result = CheckLastError("TravelerInformation", gkFuncRefGet, result);

  snprintf(newPath, elcount(newPath), "%s.%s", oldPath, "y");
  value.y = C2xGetTokenInt(packetHandle, "TravelerInformation", newPath);
  result = CheckLastError("TravelerInformation", gkFuncRefGet, result);

  return result;
}

int SetTravelerInformationCommon_Node_XY_20bParams(LONG packetHandle, struct TravelerInformationCommon_Node_XY_20b value, char oldPath[])
{
  char newPath[300];
  int result;

  result = 0;

  snprintf(newPath, elcount(newPath), "%s.%s", oldPath, "x");
  C2xSetTokenInt(packetHandle, "TravelerInformation", newPath, value.x);
  result = CheckLastError("TravelerInformation", gkFuncRefGet, result);

  snprintf(newPath, elcount(newPath), "%s.%s", oldPath, "y");
  C2xSetTokenInt(packetHandle, "TravelerInformation", newPath, value.y);
  result = CheckLastError("TravelerInformation", gkFuncRefGet, result);

  return result;
}

int GetTravelerInformationCommon_Node_XY_22bParams(LONG packetHandle, struct TravelerInformationCommon_Node_XY_22b value, char oldPath[])
{
  char newPath[300];
  int result;

  result = 0;

  snprintf(newPath, elcount(newPath), "%s.%s", oldPath, "x");
  value.x = C2xGetTokenInt(packetHandle, "TravelerInformation", newPath);
  result = CheckLastError("TravelerInformation", gkFuncRefGet, result);

  snprintf(newPath, elcount(newPath), "%s.%s", oldPath, "y");
  value.y = C2xGetTokenInt(packetHandle, "TravelerInformation", newPath);
  result = CheckLastError("TravelerInformation", gkFuncRefGet, result);

  return result;
}

int SetTravelerInformationCommon_Node_XY_22bParams(LONG packetHandle, struct TravelerInformationCommon_Node_XY_22b value, char oldPath[])
{
  char newPath[300];
  int result;

  result = 0;

  snprintf(newPath, elcount(newPath), "%s.%s", oldPath, "x");
  C2xSetTokenInt(packetHandle, "TravelerInformation", newPath, value.x);
  result = CheckLastError("TravelerInformation", gkFuncRefGet, result);

  snprintf(newPath, elcount(newPath), "%s.%s", oldPath, "y");
  C2xSetTokenInt(packetHandle, "TravelerInformation", newPath, value.y);
  result = CheckLastError("TravelerInformation", gkFuncRefGet, result);

  return result;
}

int GetTravelerInformationCommon_Node_XY_24bParams(LONG packetHandle, struct TravelerInformationCommon_Node_XY_24b value, char oldPath[])
{
  char newPath[300];
  int result;

  result = 0;

  snprintf(newPath, elcount(newPath), "%s.%s", oldPath, "x");
  value.x = C2xGetTokenInt(packetHandle, "TravelerInformation", newPath);
  result = CheckLastError("TravelerInformation", gkFuncRefGet, result);

  snprintf(newPath, elcount(newPath), "%s.%s", oldPath, "y");
  value.y = C2xGetTokenInt(packetHandle, "TravelerInformation", newPath);
  result = CheckLastError("TravelerInformation", gkFuncRefGet, result);

  return result;
}

int SetTravelerInformationCommon_Node_XY_24bParams(LONG packetHandle, struct TravelerInformationCommon_Node_XY_24b value, char oldPath[])
{
  char newPath[300];
  int result;

  result = 0;

  snprintf(newPath, elcount(newPath), "%s.%s", oldPath, "x");
  C2xSetTokenInt(packetHandle, "TravelerInformation", newPath, value.x);
  result = CheckLastError("TravelerInformation", gkFuncRefGet, result);

  snprintf(newPath, elcount(newPath), "%s.%s", oldPath, "y");
  C2xSetTokenInt(packetHandle, "TravelerInformation", newPath, value.y);
  result = CheckLastError("TravelerInformation", gkFuncRefGet, result);

  return result;
}

int GetTravelerInformationCommon_Node_XY_26bParams(LONG packetHandle, struct TravelerInformationCommon_Node_XY_26b value, char oldPath[])
{
  char newPath[300];
  int result;

  result = 0;

  snprintf(newPath, elcount(newPath), "%s.%s", oldPath, "x");
  value.x = C2xGetTokenInt(packetHandle, "TravelerInformation", newPath);
  result = CheckLastError("TravelerInformation", gkFuncRefGet, result);

  snprintf(newPath, elcount(newPath), "%s.%s", oldPath, "y");
  value.y = C2xGetTokenInt(packetHandle, "TravelerInformation", newPath);
  result = CheckLastError("TravelerInformation", gkFuncRefGet, result);

  return result;
}

int SetTravelerInformationCommon_Node_XY_26bParams(LONG packetHandle, struct TravelerInformationCommon_Node_XY_26b value, char oldPath[])
{
  char newPath[300];
  int result;

  result = 0;

  snprintf(newPath, elcount(newPath), "%s.%s", oldPath, "x");
  C2xSetTokenInt(packetHandle, "TravelerInformation", newPath, value.x);
  result = CheckLastError("TravelerInformation", gkFuncRefGet, result);

  snprintf(newPath, elcount(newPath), "%s.%s", oldPath, "y");
  C2xSetTokenInt(packetHandle, "TravelerInformation", newPath, value.y);
  result = CheckLastError("TravelerInformation", gkFuncRefGet, result);

  return result;
}

int GetTravelerInformationCommon_Node_XY_28bParams(LONG packetHandle, struct TravelerInformationCommon_Node_XY_28b value, char oldPath[])
{
  char newPath[300];
  int result;

  result = 0;

  snprintf(newPath, elcount(newPath), "%s.%s", oldPath, "x");
  value.x = C2xGetTokenInt(packetHandle, "TravelerInformation", newPath);
  result = CheckLastError("TravelerInformation", gkFuncRefGet, result);

  snprintf(newPath, elcount(newPath), "%s.%s", oldPath, "y");
  value.y = C2xGetTokenInt(packetHandle, "TravelerInformation", newPath);
  result = CheckLastError("TravelerInformation", gkFuncRefGet, result);

  return result;
}

int SetTravelerInformationCommon_Node_XY_28bParams(LONG packetHandle, struct TravelerInformationCommon_Node_XY_28b value, char oldPath[])
{
  char newPath[300];
  int result;

  result = 0;

  snprintf(newPath, elcount(newPath), "%s.%s", oldPath, "x");
  C2xSetTokenInt(packetHandle, "TravelerInformation", newPath, value.x);
  result = CheckLastError("TravelerInformation", gkFuncRefGet, result);

  snprintf(newPath, elcount(newPath), "%s.%s", oldPath, "y");
  C2xSetTokenInt(packetHandle, "TravelerInformation", newPath, value.y);
  result = CheckLastError("TravelerInformation", gkFuncRefGet, result);

  return result;
}

int GetTravelerInformationCommon_Node_XY_32bParams(LONG packetHandle, struct TravelerInformationCommon_Node_XY_32b value, char oldPath[])
{
  char newPath[300];
  int result;

  result = 0;

  snprintf(newPath, elcount(newPath), "%s.%s", oldPath, "x");
  value.x = C2xGetTokenInt(packetHandle, "TravelerInformation", newPath);
  result = CheckLastError("TravelerInformation", gkFuncRefGet, result);

  snprintf(newPath, elcount(newPath), "%s.%s", oldPath, "y");
  value.y = C2xGetTokenInt(packetHandle, "TravelerInformation", newPath);
  result = CheckLastError("TravelerInformation", gkFuncRefGet, result);

  return result;
}

int SetTravelerInformationCommon_Node_XY_32bParams(LONG packetHandle, struct TravelerInformationCommon_Node_XY_32b value, char oldPath[])
{
  char newPath[300];
  int result;

  result = 0;

  snprintf(newPath, elcount(newPath), "%s.%s", oldPath, "x");
  C2xSetTokenInt(packetHandle, "TravelerInformation", newPath, value.x);
  result = CheckLastError("TravelerInformation", gkFuncRefGet, result);

  snprintf(newPath, elcount(newPath), "%s.%s", oldPath, "y");
  C2xSetTokenInt(packetHandle, "TravelerInformation", newPath, value.y);
  result = CheckLastError("TravelerInformation", gkFuncRefGet, result);

  return result;
}

int GetTravelerInformationCommon_Node_LLmD_64bParams(LONG packetHandle, struct TravelerInformationCommon_Node_LLmD_64b value, char oldPath[])
{
  char newPath[300];
  int result;

  result = 0;

  snprintf(newPath, elcount(newPath), "%s.%s", oldPath, "lon");
  value.lon = C2xGetTokenInt(packetHandle, "TravelerInformation", newPath);
  result = CheckLastError("TravelerInformation", gkFuncRefGet, result);

  snprintf(newPath, elcount(newPath), "%s.%s", oldPath, "lat");
  value.lat = C2xGetTokenInt(packetHandle, "TravelerInformation", newPath);
  result = CheckLastError("TravelerInformation", gkFuncRefGet, result);

  return result;
}

int SetTravelerInformationCommon_Node_LLmD_64bParams(LONG packetHandle, struct TravelerInformationCommon_Node_LLmD_64b value, char oldPath[])
{
  char newPath[300];
  int result;

  result = 0;

  snprintf(newPath, elcount(newPath), "%s.%s", oldPath, "lon");
  C2xSetTokenInt(packetHandle, "TravelerInformation", newPath, value.lon);
  result = CheckLastError("TravelerInformation", gkFuncRefGet, result);

  snprintf(newPath, elcount(newPath), "%s.%s", oldPath, "lat");
  C2xSetTokenInt(packetHandle, "TravelerInformation", newPath, value.lat);
  result = CheckLastError("TravelerInformation", gkFuncRefGet, result);

  return result;
}

int GetTravelerInformationAddGrpB_Node_LLdms_48bParams(LONG packetHandle, struct TravelerInformationAddGrpB_Node_LLdms_48b value, char oldPath[])
{
  char newPath[300];
  int result;

  result = 0;

  snprintf(newPath, elcount(newPath), "%s.%s", oldPath, "lon");
  value.lon = C2xGetTokenInt(packetHandle, "TravelerInformation", newPath);
  result = CheckLastError("TravelerInformation", gkFuncRefGet, result);

  snprintf(newPath, elcount(newPath), "%s.%s", oldPath, "lat");
  value.lat = C2xGetTokenInt(packetHandle, "TravelerInformation", newPath);
  result = CheckLastError("TravelerInformation", gkFuncRefGet, result);

  return result;
}

int SetTravelerInformationAddGrpB_Node_LLdms_48bParams(LONG packetHandle, struct TravelerInformationAddGrpB_Node_LLdms_48b value, char oldPath[])
{
  char newPath[300];
  int result;

  result = 0;

  snprintf(newPath, elcount(newPath), "%s.%s", oldPath, "lon");
  C2xSetTokenInt(packetHandle, "TravelerInformation", newPath, value.lon);
  result = CheckLastError("TravelerInformation", gkFuncRefGet, result);

  snprintf(newPath, elcount(newPath), "%s.%s", oldPath, "lat");
  C2xSetTokenInt(packetHandle, "TravelerInformation", newPath, value.lat);
  result = CheckLastError("TravelerInformation", gkFuncRefGet, result);

  return result;
}

int GetTravelerInformationAddGrpB_Node_LLdms_80bParams(LONG packetHandle, struct TravelerInformationAddGrpB_Node_LLdms_80b value, char oldPath[])
{
  char newPath[300];
  int result;

  result = 0;

  snprintf(newPath, elcount(newPath), "%s.%s", oldPath, "lon");
  GetTravelerInformationAddGrpB_LongitudeDMS2Params(packetHandle, value.lon, newPath);
  result = CheckLastError("TravelerInformation", gkFuncRefGet, result);

  snprintf(newPath, elcount(newPath), "%s.%s", oldPath, "lat");
  GetTravelerInformationAddGrpB_LatitudeDMS2Params(packetHandle, value.lat, newPath);
  result = CheckLastError("TravelerInformation", gkFuncRefGet, result);

  return result;
}

int SetTravelerInformationAddGrpB_Node_LLdms_80bParams(LONG packetHandle, struct TravelerInformationAddGrpB_Node_LLdms_80b value, char oldPath[])
{
  char newPath[300];
  int result;

  result = 0;

  snprintf(newPath, elcount(newPath), "%s.%s", oldPath, "lon");
  SetTravelerInformationAddGrpB_LongitudeDMS2Params(packetHandle, value.lon, newPath);
  result = CheckLastError("TravelerInformation", gkFuncRefGet, result);

  snprintf(newPath, elcount(newPath), "%s.%s", oldPath, "lat");
  SetTravelerInformationAddGrpB_LatitudeDMS2Params(packetHandle, value.lat, newPath);
  result = CheckLastError("TravelerInformation", gkFuncRefGet, result);

  return result;
}

int GetTravelerInformationAddGrpB_NodeOffsetPointXY_addGrpBParams(LONG packetHandle, struct TravelerInformationAddGrpB_NodeOffsetPointXY_addGrpB value, char oldPath[])
{
  char newPath[300];
  int result;

  result = 0;

  value.choice = C2xGetTokenInt(packetHandle, "TravelerInformation", oldPath);

  switch(value.choice)
  {
    case 0:
    {
      snprintf(newPath, elcount(newPath), "%s.%s", oldPath, "posA");
      GetTravelerInformationAddGrpB_Node_LLdms_48bParams(packetHandle, value.posA, newPath);
      result = CheckLastError("TravelerInformation", gkFuncRefGet, result);
    }
    break;
    case 1:
    {
      snprintf(newPath, elcount(newPath), "%s.%s", oldPath, "posB");
      GetTravelerInformationAddGrpB_Node_LLdms_80bParams(packetHandle, value.posB, newPath);
      result = CheckLastError("TravelerInformation", gkFuncRefGet, result);
    }
    break;
  }
  return result;
}

int SetTravelerInformationAddGrpB_NodeOffsetPointXY_addGrpBParams(LONG packetHandle, struct TravelerInformationAddGrpB_NodeOffsetPointXY_addGrpB value, char oldPath[])
{
  char newPath[300];
  int result;

  result = 0;

  switch(value.choice)
  {
    case 0:
    {
      snprintf(newPath, elcount(newPath), "%s.%s", oldPath, "posA");
      SetTravelerInformationAddGrpB_Node_LLdms_48bParams(packetHandle, value.posA, newPath);
      result = CheckLastError("TravelerInformation", gkFuncRefGet, result);
    }
    break;
    case 1:
    {
      snprintf(newPath, elcount(newPath), "%s.%s", oldPath, "posB");
      SetTravelerInformationAddGrpB_Node_LLdms_80bParams(packetHandle, value.posB, newPath);
      result = CheckLastError("TravelerInformation", gkFuncRefGet, result);
    }
    break;
  }
  return result;
}

int GetTravelerInformationCommon_RegionalExtension_Reg_NodeOffsetPointXY_tableParams(LONG packetHandle, WORD tableKey, struct TravelerInformationCommon_RegionalExtension_Reg_NodeOffsetPointXY_table value, char oldPath[])
{
  char newPath[300];
  int result;

  result = 0;

  switch(tableKey)
  {
    case 2:
    {
      snprintf(newPath, elcount(newPath), "%s.%s", oldPath, "addGrpB");
      GetTravelerInformationAddGrpB_NodeOffsetPointXY_addGrpBParams(packetHandle, value.addGrpB, newPath);
      result = CheckLastError("TravelerInformation", gkFuncRefGet, result);
    }
    break;
  }
  return result;
}

int SetTravelerInformationCommon_RegionalExtension_Reg_NodeOffsetPointXY_tableParams(LONG packetHandle, WORD tableKey, struct TravelerInformationCommon_RegionalExtension_Reg_NodeOffsetPointXY_table value, char oldPath[])
{
  char newPath[300];
  int result;

  result = 0;

  switch(tableKey)
  {
    case 2:
    {
      snprintf(newPath, elcount(newPath), "%s.%s", oldPath, "addGrpB");
      SetTravelerInformationAddGrpB_NodeOffsetPointXY_addGrpBParams(packetHandle, value.addGrpB, newPath);
      result = CheckLastError("TravelerInformation", gkFuncRefGet, result);
    }
    break;
  }
  return result;
}

int GetTravelerInformationCommon_RegionalExtension_Reg_NodeOffsetPointXYParams(LONG packetHandle, struct TravelerInformationCommon_RegionalExtension_Reg_NodeOffsetPointXY value, char oldPath[])
{
  char newPath[300];
  int result;

  result = 0;

  snprintf(newPath, elcount(newPath), "%s.%s", oldPath, "regionId");
  value.regionId = C2xGetTokenInt(packetHandle, "TravelerInformation", newPath);
  result = CheckLastError("TravelerInformation", gkFuncRefGet, result);

  snprintf(newPath, elcount(newPath), "%s.%s", oldPath, "regExtvalue");
  GetTravelerInformationCommon_RegionalExtension_Reg_NodeOffsetPointXY_tableParams(packetHandle, value.regionId, value.regExtvalue, newPath);
  result = CheckLastError("TravelerInformation", gkFuncRefGet, result);

  return result;
}

int SetTravelerInformationCommon_RegionalExtension_Reg_NodeOffsetPointXYParams(LONG packetHandle, struct TravelerInformationCommon_RegionalExtension_Reg_NodeOffsetPointXY value, char oldPath[])
{
  char newPath[300];
  int result;

  result = 0;


  snprintf(newPath, elcount(newPath), "%s.%s", oldPath, "regExtvalue");
  SetTravelerInformationCommon_RegionalExtension_Reg_NodeOffsetPointXY_tableParams(packetHandle, value.regionId, value.regExtvalue, newPath);
  result = CheckLastError("TravelerInformation", gkFuncRefGet, result);

  return result;
}

int GetTravelerInformationCommon_NodeOffsetPointXYParams(LONG packetHandle, struct TravelerInformationCommon_NodeOffsetPointXY value, char oldPath[])
{
  char newPath[300];
  int result;

  result = 0;

  value.choice = C2xGetTokenInt(packetHandle, "TravelerInformation", oldPath);

  switch(value.choice)
  {
    case 0:
    {
      snprintf(newPath, elcount(newPath), "%s.%s", oldPath, "node_XY1");
      GetTravelerInformationCommon_Node_XY_20bParams(packetHandle, value.node_XY1, newPath);
      result = CheckLastError("TravelerInformation", gkFuncRefGet, result);
    }
    break;
    case 1:
    {
      snprintf(newPath, elcount(newPath), "%s.%s", oldPath, "node_XY2");
      GetTravelerInformationCommon_Node_XY_22bParams(packetHandle, value.node_XY2, newPath);
      result = CheckLastError("TravelerInformation", gkFuncRefGet, result);
    }
    break;
    case 2:
    {
      snprintf(newPath, elcount(newPath), "%s.%s", oldPath, "node_XY3");
      GetTravelerInformationCommon_Node_XY_24bParams(packetHandle, value.node_XY3, newPath);
      result = CheckLastError("TravelerInformation", gkFuncRefGet, result);
    }
    break;
    case 3:
    {
      snprintf(newPath, elcount(newPath), "%s.%s", oldPath, "node_XY4");
      GetTravelerInformationCommon_Node_XY_26bParams(packetHandle, value.node_XY4, newPath);
      result = CheckLastError("TravelerInformation", gkFuncRefGet, result);
    }
    break;
    case 4:
    {
      snprintf(newPath, elcount(newPath), "%s.%s", oldPath, "node_XY5");
      GetTravelerInformationCommon_Node_XY_28bParams(packetHandle, value.node_XY5, newPath);
      result = CheckLastError("TravelerInformation", gkFuncRefGet, result);
    }
    break;
    case 5:
    {
      snprintf(newPath, elcount(newPath), "%s.%s", oldPath, "node_XY6");
      GetTravelerInformationCommon_Node_XY_32bParams(packetHandle, value.node_XY6, newPath);
      result = CheckLastError("TravelerInformation", gkFuncRefGet, result);
    }
    break;
    case 6:
    {
      snprintf(newPath, elcount(newPath), "%s.%s", oldPath, "node_LatLon");
      GetTravelerInformationCommon_Node_LLmD_64bParams(packetHandle, value.node_LatLon, newPath);
      result = CheckLastError("TravelerInformation", gkFuncRefGet, result);
    }
    break;
    case 7:
    {
      snprintf(newPath, elcount(newPath), "%s.%s", oldPath, "regional");
      GetTravelerInformationCommon_RegionalExtension_Reg_NodeOffsetPointXYParams(packetHandle, value.regional, newPath);
      result = CheckLastError("TravelerInformation", gkFuncRefGet, result);
    }
    break;
  }
  return result;
}

int SetTravelerInformationCommon_NodeOffsetPointXYParams(LONG packetHandle, struct TravelerInformationCommon_NodeOffsetPointXY value, char oldPath[])
{
  char newPath[300];
  int result;

  result = 0;

  switch(value.choice)
  {
    case 0:
    {
      snprintf(newPath, elcount(newPath), "%s.%s", oldPath, "node_XY1");
      SetTravelerInformationCommon_Node_XY_20bParams(packetHandle, value.node_XY1, newPath);
      result = CheckLastError("TravelerInformation", gkFuncRefGet, result);
    }
    break;
    case 1:
    {
      snprintf(newPath, elcount(newPath), "%s.%s", oldPath, "node_XY2");
      SetTravelerInformationCommon_Node_XY_22bParams(packetHandle, value.node_XY2, newPath);
      result = CheckLastError("TravelerInformation", gkFuncRefGet, result);
    }
    break;
    case 2:
    {
      snprintf(newPath, elcount(newPath), "%s.%s", oldPath, "node_XY3");
      SetTravelerInformationCommon_Node_XY_24bParams(packetHandle, value.node_XY3, newPath);
      result = CheckLastError("TravelerInformation", gkFuncRefGet, result);
    }
    break;
    case 3:
    {
      snprintf(newPath, elcount(newPath), "%s.%s", oldPath, "node_XY4");
      SetTravelerInformationCommon_Node_XY_26bParams(packetHandle, value.node_XY4, newPath);
      result = CheckLastError("TravelerInformation", gkFuncRefGet, result);
    }
    break;
    case 4:
    {
      snprintf(newPath, elcount(newPath), "%s.%s", oldPath, "node_XY5");
      SetTravelerInformationCommon_Node_XY_28bParams(packetHandle, value.node_XY5, newPath);
      result = CheckLastError("TravelerInformation", gkFuncRefGet, result);
    }
    break;
    case 5:
    {
      snprintf(newPath, elcount(newPath), "%s.%s", oldPath, "node_XY6");
      SetTravelerInformationCommon_Node_XY_32bParams(packetHandle, value.node_XY6, newPath);
      result = CheckLastError("TravelerInformation", gkFuncRefGet, result);
    }
    break;
    case 6:
    {
      snprintf(newPath, elcount(newPath), "%s.%s", oldPath, "node_LatLon");
      SetTravelerInformationCommon_Node_LLmD_64bParams(packetHandle, value.node_LatLon, newPath);
      result = CheckLastError("TravelerInformation", gkFuncRefGet, result);
    }
    break;
    case 7:
    {
      snprintf(newPath, elcount(newPath), "%s.%s", oldPath, "regional");
      SetTravelerInformationCommon_RegionalExtension_Reg_NodeOffsetPointXYParams(packetHandle, value.regional, newPath);
      result = CheckLastError("TravelerInformation", gkFuncRefGet, result);
    }
    break;
  }
  return result;
}

int GetTravelerInformationCommon_NodeAttributeXYListParams(LONG packetHandle, struct TravelerInformationCommon_NodeAttributeXYList value, char oldPath[])
{
  char newPath[300]; 
  int i;
  int result;

  result = 0;

  value.length = C2xGetTokenInt(packetHandle, "TravelerInformation", oldPath);
  if((result = CheckLastError("TravelerInformation", gkFuncRefGet, result))==0)
  {
    for(i=0; i<value.length; i++)
    {
      snprintf(newPath, elcount(newPath), "%s[%d]", oldPath, i);
      value.arrayValue[i] = C2xGetTokenInt64(packetHandle, "TravelerInformation", newPath);
      result = CheckLastError("TravelerInformation", gkFuncRefGet, result);
    }
  }
  return result;
}

int SetTravelerInformationCommon_NodeAttributeXYListParams(LONG packetHandle, struct TravelerInformationCommon_NodeAttributeXYList value, char oldPath[])
{
  char newPath[300]; 
  int i;
  int result;

  result = 0;

  C2xRemoveToken(packetHandle, "TravelerInformation", oldPath);
  for(i=0; i<value.length; i++)
  {
    snprintf(newPath, elcount(newPath), "%s[%d]", oldPath, i);
    C2xSetTokenInt64(packetHandle, "TravelerInformation", newPath, value.arrayValue[i]);
    result = CheckLastError("TravelerInformation", gkFuncRefGet, result);
  }
  return result;
}

int GetTravelerInformationCommon_SegmentAttributeXYListParams(LONG packetHandle, struct TravelerInformationCommon_SegmentAttributeXYList value, char oldPath[])
{
  char newPath[300]; 
  int i;
  int result;

  result = 0;

  value.length = C2xGetTokenInt(packetHandle, "TravelerInformation", oldPath);
  if((result = CheckLastError("TravelerInformation", gkFuncRefGet, result))==0)
  {
    for(i=0; i<value.length; i++)
    {
      snprintf(newPath, elcount(newPath), "%s[%d]", oldPath, i);
      value.arrayValue[i] = C2xGetTokenInt64(packetHandle, "TravelerInformation", newPath);
      result = CheckLastError("TravelerInformation", gkFuncRefGet, result);
    }
  }
  return result;
}

int SetTravelerInformationCommon_SegmentAttributeXYListParams(LONG packetHandle, struct TravelerInformationCommon_SegmentAttributeXYList value, char oldPath[])
{
  char newPath[300]; 
  int i;
  int result;

  result = 0;

  C2xRemoveToken(packetHandle, "TravelerInformation", oldPath);
  for(i=0; i<value.length; i++)
  {
    snprintf(newPath, elcount(newPath), "%s[%d]", oldPath, i);
    C2xSetTokenInt64(packetHandle, "TravelerInformation", newPath, value.arrayValue[i]);
    result = CheckLastError("TravelerInformation", gkFuncRefGet, result);
  }
  return result;
}

int GetTravelerInformationCommon_RegulatorySpeedLimitParams(LONG packetHandle, struct TravelerInformationCommon_RegulatorySpeedLimit value, char oldPath[])
{
  char newPath[300];
  int result;

  result = 0;

  snprintf(newPath, elcount(newPath), "%s.%s", oldPath, "type");
  value.type = C2xGetTokenInt(packetHandle, "TravelerInformation", newPath);
  result = CheckLastError("TravelerInformation", gkFuncRefGet, result);

  snprintf(newPath, elcount(newPath), "%s.%s", oldPath, "speed");
  value.speed = C2xGetTokenInt(packetHandle, "TravelerInformation", newPath);
  result = CheckLastError("TravelerInformation", gkFuncRefGet, result);

  return result;
}

int SetTravelerInformationCommon_RegulatorySpeedLimitParams(LONG packetHandle, struct TravelerInformationCommon_RegulatorySpeedLimit value, char oldPath[])
{
  char newPath[300];
  int result;

  result = 0;

  snprintf(newPath, elcount(newPath), "%s.%s", oldPath, "type");
  C2xSetTokenInt(packetHandle, "TravelerInformation", newPath, value.type);
  result = CheckLastError("TravelerInformation", gkFuncRefGet, result);

  snprintf(newPath, elcount(newPath), "%s.%s", oldPath, "speed");
  C2xSetTokenInt(packetHandle, "TravelerInformation", newPath, value.speed);
  result = CheckLastError("TravelerInformation", gkFuncRefGet, result);

  return result;
}

int GetTravelerInformationCommon_SpeedLimitListParams(LONG packetHandle, struct TravelerInformationCommon_SpeedLimitList value, char oldPath[])
{
  char newPath[300]; 
  int i;
  int result;

  result = 0;

  value.length = C2xGetTokenInt(packetHandle, "TravelerInformation", oldPath);
  if((result = CheckLastError("TravelerInformation", gkFuncRefGet, result))==0)
  {
    for(i=0; i<value.length; i++)
    {
      snprintf(newPath, elcount(newPath), "%s[%d]", oldPath, i);
      GetTravelerInformationCommon_RegulatorySpeedLimitParams(packetHandle, value.arrayValue[i], newPath);
      result = CheckLastError("TravelerInformation", gkFuncRefGet, result);
    }
  }
  return result;
}

int SetTravelerInformationCommon_SpeedLimitListParams(LONG packetHandle, struct TravelerInformationCommon_SpeedLimitList value, char oldPath[])
{
  char newPath[300]; 
  int i;
  int result;

  result = 0;

  C2xRemoveToken(packetHandle, "TravelerInformation", oldPath);
  for(i=0; i<value.length; i++)
  {
    snprintf(newPath, elcount(newPath), "%s[%d]", oldPath, i);
    SetTravelerInformationCommon_RegulatorySpeedLimitParams(packetHandle, value.arrayValue[i], newPath);
    result = CheckLastError("TravelerInformation", gkFuncRefGet, result);
  }
  return result;
}

int GetTravelerInformationCommon_RegionalExtension_Reg_LaneDataAttributeParams(LONG packetHandle, struct TravelerInformationCommon_RegionalExtension_Reg_LaneDataAttribute value, char oldPath[])
{
  char newPath[300];
  int result;

  result = 0;

  snprintf(newPath, elcount(newPath), "%s.%s", oldPath, "regionId");
  value.regionId = C2xGetTokenInt(packetHandle, "TravelerInformation", newPath);
  result = CheckLastError("TravelerInformation", gkFuncRefGet, result);

  return result;
}

int SetTravelerInformationCommon_RegionalExtension_Reg_LaneDataAttributeParams(LONG packetHandle, struct TravelerInformationCommon_RegionalExtension_Reg_LaneDataAttribute value, char oldPath[])
{
  char newPath[300];
  int result;

  result = 0;


  return result;
}

int GetTravelerInformationCommon_LaneDataAttribute_regionalParams(LONG packetHandle, struct TravelerInformationCommon_LaneDataAttribute_regional value, char oldPath[])
{
  char newPath[300]; 
  int i;
  int result;

  result = 0;

  value.length = C2xGetTokenInt(packetHandle, "TravelerInformation", oldPath);
  if((result = CheckLastError("TravelerInformation", gkFuncRefGet, result))==0)
  {
    for(i=0; i<value.length; i++)
    {
      snprintf(newPath, elcount(newPath), "%s[%d]", oldPath, i);
      GetTravelerInformationCommon_RegionalExtension_Reg_LaneDataAttributeParams(packetHandle, value.arrayValue[i], newPath);
      result = CheckLastError("TravelerInformation", gkFuncRefGet, result);
    }
  }
  return result;
}

int SetTravelerInformationCommon_LaneDataAttribute_regionalParams(LONG packetHandle, struct TravelerInformationCommon_LaneDataAttribute_regional value, char oldPath[])
{
  char newPath[300]; 
  int i;
  int result;

  result = 0;

  C2xRemoveToken(packetHandle, "TravelerInformation", oldPath);
  for(i=0; i<value.length; i++)
  {
    snprintf(newPath, elcount(newPath), "%s[%d]", oldPath, i);
    SetTravelerInformationCommon_RegionalExtension_Reg_LaneDataAttributeParams(packetHandle, value.arrayValue[i], newPath);
    result = CheckLastError("TravelerInformation", gkFuncRefGet, result);
  }
  return result;
}

int GetTravelerInformationCommon_LaneDataAttributeParams(LONG packetHandle, struct TravelerInformationCommon_LaneDataAttribute value, char oldPath[])
{
  char newPath[300];
  int result;

  result = 0;

  value.choice = C2xGetTokenInt(packetHandle, "TravelerInformation", oldPath);

  switch(value.choice)
  {
    case 0:
    {
      snprintf(newPath, elcount(newPath), "%s.%s", oldPath, "pathEndPointAngle");
      value.pathEndPointAngle = C2xGetTokenInt(packetHandle, "TravelerInformation", newPath);
      result = CheckLastError("TravelerInformation", gkFuncRefGet, result);
    }
    break;
    case 1:
    {
      snprintf(newPath, elcount(newPath), "%s.%s", oldPath, "laneCrownPointCenter");
      value.laneCrownPointCenter = C2xGetTokenInt(packetHandle, "TravelerInformation", newPath);
      result = CheckLastError("TravelerInformation", gkFuncRefGet, result);
    }
    break;
    case 2:
    {
      snprintf(newPath, elcount(newPath), "%s.%s", oldPath, "laneCrownPointLeft");
      value.laneCrownPointLeft = C2xGetTokenInt(packetHandle, "TravelerInformation", newPath);
      result = CheckLastError("TravelerInformation", gkFuncRefGet, result);
    }
    break;
    case 3:
    {
      snprintf(newPath, elcount(newPath), "%s.%s", oldPath, "laneCrownPointRight");
      value.laneCrownPointRight = C2xGetTokenInt(packetHandle, "TravelerInformation", newPath);
      result = CheckLastError("TravelerInformation", gkFuncRefGet, result);
    }
    break;
    case 4:
    {
      snprintf(newPath, elcount(newPath), "%s.%s", oldPath, "laneAngle");
      value.laneAngle = C2xGetTokenInt(packetHandle, "TravelerInformation", newPath);
      result = CheckLastError("TravelerInformation", gkFuncRefGet, result);
    }
    break;
    case 5:
    {
      snprintf(newPath, elcount(newPath), "%s.%s", oldPath, "speedLimits");
      GetTravelerInformationCommon_SpeedLimitListParams(packetHandle, value.speedLimits, newPath);
      result = CheckLastError("TravelerInformation", gkFuncRefGet, result);
    }
    break;
    case 6:
    {
      snprintf(newPath, elcount(newPath), "%s.%s", oldPath, "regional");
      GetTravelerInformationCommon_LaneDataAttribute_regionalParams(packetHandle, value.regional, newPath);
      result = CheckLastError("TravelerInformation", gkFuncRefGet, result);
    }
    break;
  }
  return result;
}

int SetTravelerInformationCommon_LaneDataAttributeParams(LONG packetHandle, struct TravelerInformationCommon_LaneDataAttribute value, char oldPath[])
{
  char newPath[300];
  int result;

  result = 0;

  switch(value.choice)
  {
    case 0:
    {
      snprintf(newPath, elcount(newPath), "%s.%s", oldPath, "pathEndPointAngle");
      C2xSetTokenInt(packetHandle, "TravelerInformation", newPath, value.pathEndPointAngle);
      result = CheckLastError("TravelerInformation", gkFuncRefGet, result);
    }
    break;
    case 1:
    {
      snprintf(newPath, elcount(newPath), "%s.%s", oldPath, "laneCrownPointCenter");
      C2xSetTokenInt(packetHandle, "TravelerInformation", newPath, value.laneCrownPointCenter);
      result = CheckLastError("TravelerInformation", gkFuncRefGet, result);
    }
    break;
    case 2:
    {
      snprintf(newPath, elcount(newPath), "%s.%s", oldPath, "laneCrownPointLeft");
      C2xSetTokenInt(packetHandle, "TravelerInformation", newPath, value.laneCrownPointLeft);
      result = CheckLastError("TravelerInformation", gkFuncRefGet, result);
    }
    break;
    case 3:
    {
      snprintf(newPath, elcount(newPath), "%s.%s", oldPath, "laneCrownPointRight");
      C2xSetTokenInt(packetHandle, "TravelerInformation", newPath, value.laneCrownPointRight);
      result = CheckLastError("TravelerInformation", gkFuncRefGet, result);
    }
    break;
    case 4:
    {
      snprintf(newPath, elcount(newPath), "%s.%s", oldPath, "laneAngle");
      C2xSetTokenInt(packetHandle, "TravelerInformation", newPath, value.laneAngle);
      result = CheckLastError("TravelerInformation", gkFuncRefGet, result);
    }
    break;
    case 5:
    {
      snprintf(newPath, elcount(newPath), "%s.%s", oldPath, "speedLimits");
      SetTravelerInformationCommon_SpeedLimitListParams(packetHandle, value.speedLimits, newPath);
      result = CheckLastError("TravelerInformation", gkFuncRefGet, result);
    }
    break;
    case 6:
    {
      snprintf(newPath, elcount(newPath), "%s.%s", oldPath, "regional");
      SetTravelerInformationCommon_LaneDataAttribute_regionalParams(packetHandle, value.regional, newPath);
      result = CheckLastError("TravelerInformation", gkFuncRefGet, result);
    }
    break;
  }
  return result;
}

int GetTravelerInformationCommon_LaneDataAttributeListParams(LONG packetHandle, struct TravelerInformationCommon_LaneDataAttributeList value, char oldPath[])
{
  char newPath[300]; 
  int i;
  int result;

  result = 0;

  value.length = C2xGetTokenInt(packetHandle, "TravelerInformation", oldPath);
  if((result = CheckLastError("TravelerInformation", gkFuncRefGet, result))==0)
  {
    for(i=0; i<value.length; i++)
    {
      snprintf(newPath, elcount(newPath), "%s[%d]", oldPath, i);
      GetTravelerInformationCommon_LaneDataAttributeParams(packetHandle, value.arrayValue[i], newPath);
      result = CheckLastError("TravelerInformation", gkFuncRefGet, result);
    }
  }
  return result;
}

int SetTravelerInformationCommon_LaneDataAttributeListParams(LONG packetHandle, struct TravelerInformationCommon_LaneDataAttributeList value, char oldPath[])
{
  char newPath[300]; 
  int i;
  int result;

  result = 0;

  C2xRemoveToken(packetHandle, "TravelerInformation", oldPath);
  for(i=0; i<value.length; i++)
  {
    snprintf(newPath, elcount(newPath), "%s[%d]", oldPath, i);
    SetTravelerInformationCommon_LaneDataAttributeParams(packetHandle, value.arrayValue[i], newPath);
    result = CheckLastError("TravelerInformation", gkFuncRefGet, result);
  }
  return result;
}

int GetTravelerInformationCommon_RegionalExtension_Reg_NodeAttributeSetXYParams(LONG packetHandle, struct TravelerInformationCommon_RegionalExtension_Reg_NodeAttributeSetXY value, char oldPath[])
{
  char newPath[300];
  int result;

  result = 0;

  snprintf(newPath, elcount(newPath), "%s.%s", oldPath, "regionId");
  value.regionId = C2xGetTokenInt(packetHandle, "TravelerInformation", newPath);
  result = CheckLastError("TravelerInformation", gkFuncRefGet, result);

  return result;
}

int SetTravelerInformationCommon_RegionalExtension_Reg_NodeAttributeSetXYParams(LONG packetHandle, struct TravelerInformationCommon_RegionalExtension_Reg_NodeAttributeSetXY value, char oldPath[])
{
  char newPath[300];
  int result;

  result = 0;


  return result;
}

int GetTravelerInformationCommon_NodeAttributeSetXY_regionalParams(LONG packetHandle, struct TravelerInformationCommon_NodeAttributeSetXY_regional value, char oldPath[])
{
  char newPath[300]; 
  int i;
  int result;

  result = 0;

  value.length = C2xGetTokenInt(packetHandle, "TravelerInformation", oldPath);
  if((result = CheckLastError("TravelerInformation", gkFuncRefGet, result))==0)
  {
    for(i=0; i<value.length; i++)
    {
      snprintf(newPath, elcount(newPath), "%s[%d]", oldPath, i);
      GetTravelerInformationCommon_RegionalExtension_Reg_NodeAttributeSetXYParams(packetHandle, value.arrayValue[i], newPath);
      result = CheckLastError("TravelerInformation", gkFuncRefGet, result);
    }
  }
  return result;
}

int SetTravelerInformationCommon_NodeAttributeSetXY_regionalParams(LONG packetHandle, struct TravelerInformationCommon_NodeAttributeSetXY_regional value, char oldPath[])
{
  char newPath[300]; 
  int i;
  int result;

  result = 0;

  C2xRemoveToken(packetHandle, "TravelerInformation", oldPath);
  for(i=0; i<value.length; i++)
  {
    snprintf(newPath, elcount(newPath), "%s[%d]", oldPath, i);
    SetTravelerInformationCommon_RegionalExtension_Reg_NodeAttributeSetXYParams(packetHandle, value.arrayValue[i], newPath);
    result = CheckLastError("TravelerInformation", gkFuncRefGet, result);
  }
  return result;
}

int GetTravelerInformationCommon_NodeAttributeSetXYParams(LONG packetHandle, struct TravelerInformationCommon_NodeAttributeSetXY value, char oldPath[])
{
  char newPath[300];
  int result;

  result = 0;

  snprintf(newPath, elcount(newPath), "%s.%s", oldPath, "localNode");
  value.localNode.isValidFlag = C2xIsTokenAvailable(packetHandle, "TravelerInformation", newPath);
  if(value.localNode.isValidFlag==1)
  {
    GetTravelerInformationCommon_NodeAttributeXYListParams(packetHandle, value.localNode, newPath);
    result = CheckLastError("TravelerInformation", gkFuncRefGet, result);
  }
  snprintf(newPath, elcount(newPath), "%s.%s", oldPath, "disabled");
  value.disabled.isValidFlag = C2xIsTokenAvailable(packetHandle, "TravelerInformation", newPath);
  if(value.disabled.isValidFlag==1)
  {
    GetTravelerInformationCommon_SegmentAttributeXYListParams(packetHandle, value.disabled, newPath);
    result = CheckLastError("TravelerInformation", gkFuncRefGet, result);
  }
  snprintf(newPath, elcount(newPath), "%s.%s", oldPath, "enabled");
  value.enabled.isValidFlag = C2xIsTokenAvailable(packetHandle, "TravelerInformation", newPath);
  if(value.enabled.isValidFlag==1)
  {
    GetTravelerInformationCommon_SegmentAttributeXYListParams(packetHandle, value.enabled, newPath);
    result = CheckLastError("TravelerInformation", gkFuncRefGet, result);
  }
  snprintf(newPath, elcount(newPath), "%s.%s", oldPath, "data");
  value.data.isValidFlag = C2xIsTokenAvailable(packetHandle, "TravelerInformation", newPath);
  if(value.data.isValidFlag==1)
  {
    GetTravelerInformationCommon_LaneDataAttributeListParams(packetHandle, value.data, newPath);
    result = CheckLastError("TravelerInformation", gkFuncRefGet, result);
  }
  snprintf(newPath, elcount(newPath), "%s.%s", oldPath, "dWidth");
  value.dWidth.isValidFlag = C2xIsTokenAvailable(packetHandle, "TravelerInformation", newPath);
  if(value.dWidth.isValidFlag==1)
  {
    value.dWidth.value = C2xGetTokenInt(packetHandle, "TravelerInformation", newPath);
    result = CheckLastError("TravelerInformation", gkFuncRefGet, result);
  }
  snprintf(newPath, elcount(newPath), "%s.%s", oldPath, "dElevation");
  value.dElevation.isValidFlag = C2xIsTokenAvailable(packetHandle, "TravelerInformation", newPath);
  if(value.dElevation.isValidFlag==1)
  {
    value.dElevation.value = C2xGetTokenInt(packetHandle, "TravelerInformation", newPath);
    result = CheckLastError("TravelerInformation", gkFuncRefGet, result);
  }
  snprintf(newPath, elcount(newPath), "%s.%s", oldPath, "regional");
  value.regional.isValidFlag = C2xIsTokenAvailable(packetHandle, "TravelerInformation", newPath);
  if(value.regional.isValidFlag==1)
  {
    GetTravelerInformationCommon_NodeAttributeSetXY_regionalParams(packetHandle, value.regional, newPath);
    result = CheckLastError("TravelerInformation", gkFuncRefGet, result);
  }
  return result;
}

int SetTravelerInformationCommon_NodeAttributeSetXYParams(LONG packetHandle, struct TravelerInformationCommon_NodeAttributeSetXY value, char oldPath[])
{
  char newPath[300];
  int result;

  result = 0;

  snprintf(newPath, elcount(newPath), "%s.%s", oldPath, "localNode");
  if(value.localNode.isValidFlag==1)
  {
    SetTravelerInformationCommon_NodeAttributeXYListParams(packetHandle, value.localNode, newPath);
    result = CheckLastError("TravelerInformation", gkFuncRefGet, result);
  }
  else
  {
    if( C2xIsTokenAvailable(packetHandle, "TravelerInformation", newPath) )
    {
      C2xRemoveToken(packetHandle, "TravelerInformation", newPath);
    }
  }

  snprintf(newPath, elcount(newPath), "%s.%s", oldPath, "disabled");
  if(value.disabled.isValidFlag==1)
  {
    SetTravelerInformationCommon_SegmentAttributeXYListParams(packetHandle, value.disabled, newPath);
    result = CheckLastError("TravelerInformation", gkFuncRefGet, result);
  }
  else
  {
    if( C2xIsTokenAvailable(packetHandle, "TravelerInformation", newPath) )
    {
      C2xRemoveToken(packetHandle, "TravelerInformation", newPath);
    }
  }

  snprintf(newPath, elcount(newPath), "%s.%s", oldPath, "enabled");
  if(value.enabled.isValidFlag==1)
  {
    SetTravelerInformationCommon_SegmentAttributeXYListParams(packetHandle, value.enabled, newPath);
    result = CheckLastError("TravelerInformation", gkFuncRefGet, result);
  }
  else
  {
    if( C2xIsTokenAvailable(packetHandle, "TravelerInformation", newPath) )
    {
      C2xRemoveToken(packetHandle, "TravelerInformation", newPath);
    }
  }

  snprintf(newPath, elcount(newPath), "%s.%s", oldPath, "data");
  if(value.data.isValidFlag==1)
  {
    SetTravelerInformationCommon_LaneDataAttributeListParams(packetHandle, value.data, newPath);
    result = CheckLastError("TravelerInformation", gkFuncRefGet, result);
  }
  else
  {
    if( C2xIsTokenAvailable(packetHandle, "TravelerInformation", newPath) )
    {
      C2xRemoveToken(packetHandle, "TravelerInformation", newPath);
    }
  }

  snprintf(newPath, elcount(newPath), "%s.%s", oldPath, "dWidth");
  if(value.dWidth.isValidFlag==1)
  {
    C2xSetTokenInt(packetHandle, "TravelerInformation", newPath, value.dWidth.value);
    result = CheckLastError("TravelerInformation", gkFuncRefGet, result);
  }
  else
  {
    if( C2xIsTokenAvailable(packetHandle, "TravelerInformation", newPath) )
    {
      C2xRemoveToken(packetHandle, "TravelerInformation", newPath);
    }
  }

  snprintf(newPath, elcount(newPath), "%s.%s", oldPath, "dElevation");
  if(value.dElevation.isValidFlag==1)
  {
    C2xSetTokenInt(packetHandle, "TravelerInformation", newPath, value.dElevation.value);
    result = CheckLastError("TravelerInformation", gkFuncRefGet, result);
  }
  else
  {
    if( C2xIsTokenAvailable(packetHandle, "TravelerInformation", newPath) )
    {
      C2xRemoveToken(packetHandle, "TravelerInformation", newPath);
    }
  }

  snprintf(newPath, elcount(newPath), "%s.%s", oldPath, "regional");
  if(value.regional.isValidFlag==1)
  {
    SetTravelerInformationCommon_NodeAttributeSetXY_regionalParams(packetHandle, value.regional, newPath);
    result = CheckLastError("TravelerInformation", gkFuncRefGet, result);
  }
  else
  {
    if( C2xIsTokenAvailable(packetHandle, "TravelerInformation", newPath) )
    {
      C2xRemoveToken(packetHandle, "TravelerInformation", newPath);
    }
  }

  return result;
}

int GetTravelerInformationCommon_NodeXYParams(LONG packetHandle, struct TravelerInformationCommon_NodeXY value, char oldPath[])
{
  char newPath[300];
  int result;

  result = 0;

  snprintf(newPath, elcount(newPath), "%s.%s", oldPath, "delta");
  GetTravelerInformationCommon_NodeOffsetPointXYParams(packetHandle, value.delta, newPath);
  result = CheckLastError("TravelerInformation", gkFuncRefGet, result);

  snprintf(newPath, elcount(newPath), "%s.%s", oldPath, "attributes");
  value.attributes.isValidFlag = C2xIsTokenAvailable(packetHandle, "TravelerInformation", newPath);
  if(value.attributes.isValidFlag==1)
  {
    GetTravelerInformationCommon_NodeAttributeSetXYParams(packetHandle, value.attributes, newPath);
    result = CheckLastError("TravelerInformation", gkFuncRefGet, result);
  }
  return result;
}

int SetTravelerInformationCommon_NodeXYParams(LONG packetHandle, struct TravelerInformationCommon_NodeXY value, char oldPath[])
{
  char newPath[300];
  int result;

  result = 0;

  snprintf(newPath, elcount(newPath), "%s.%s", oldPath, "delta");
  SetTravelerInformationCommon_NodeOffsetPointXYParams(packetHandle, value.delta, newPath);
  result = CheckLastError("TravelerInformation", gkFuncRefGet, result);

  snprintf(newPath, elcount(newPath), "%s.%s", oldPath, "attributes");
  if(value.attributes.isValidFlag==1)
  {
    SetTravelerInformationCommon_NodeAttributeSetXYParams(packetHandle, value.attributes, newPath);
    result = CheckLastError("TravelerInformation", gkFuncRefGet, result);
  }
  else
  {
    if( C2xIsTokenAvailable(packetHandle, "TravelerInformation", newPath) )
    {
      C2xRemoveToken(packetHandle, "TravelerInformation", newPath);
    }
  }

  return result;
}

int GetTravelerInformationCommon_NodeSetXYParams(LONG packetHandle, struct TravelerInformationCommon_NodeSetXY value, char oldPath[])
{
  char newPath[300]; 
  int i;
  int result;

  result = 0;

  value.length = C2xGetTokenInt(packetHandle, "TravelerInformation", oldPath);
  if((result = CheckLastError("TravelerInformation", gkFuncRefGet, result))==0)
  {
    for(i=0; i<value.length; i++)
    {
      snprintf(newPath, elcount(newPath), "%s[%d]", oldPath, i);
      GetTravelerInformationCommon_NodeXYParams(packetHandle, value.arrayValue[i], newPath);
      result = CheckLastError("TravelerInformation", gkFuncRefGet, result);
    }
  }
  return result;
}

int SetTravelerInformationCommon_NodeSetXYParams(LONG packetHandle, struct TravelerInformationCommon_NodeSetXY value, char oldPath[])
{
  char newPath[300]; 
  int i;
  int result;

  result = 0;

  C2xRemoveToken(packetHandle, "TravelerInformation", oldPath);
  for(i=0; i<value.length; i++)
  {
    snprintf(newPath, elcount(newPath), "%s[%d]", oldPath, i);
    SetTravelerInformationCommon_NodeXYParams(packetHandle, value.arrayValue[i], newPath);
    result = CheckLastError("TravelerInformation", gkFuncRefGet, result);
  }
  return result;
}

int GetTravelerInformationCommon_ComputedLane_offsetXaxisParams(LONG packetHandle, struct TravelerInformationCommon_ComputedLane_offsetXaxis value, char oldPath[])
{
  char newPath[300];
  int result;

  result = 0;

  value.choice = C2xGetTokenInt(packetHandle, "TravelerInformation", oldPath);

  switch(value.choice)
  {
    case 0:
    {
      snprintf(newPath, elcount(newPath), "%s.%s", oldPath, "small");
      value.small = C2xGetTokenInt(packetHandle, "TravelerInformation", newPath);
      result = CheckLastError("TravelerInformation", gkFuncRefGet, result);
    }
    break;
    case 1:
    {
      snprintf(newPath, elcount(newPath), "%s.%s", oldPath, "large");
      value.large = C2xGetTokenInt(packetHandle, "TravelerInformation", newPath);
      result = CheckLastError("TravelerInformation", gkFuncRefGet, result);
    }
    break;
  }
  return result;
}

int SetTravelerInformationCommon_ComputedLane_offsetXaxisParams(LONG packetHandle, struct TravelerInformationCommon_ComputedLane_offsetXaxis value, char oldPath[])
{
  char newPath[300];
  int result;

  result = 0;

  switch(value.choice)
  {
    case 0:
    {
      snprintf(newPath, elcount(newPath), "%s.%s", oldPath, "small");
      C2xSetTokenInt(packetHandle, "TravelerInformation", newPath, value.small);
      result = CheckLastError("TravelerInformation", gkFuncRefGet, result);
    }
    break;
    case 1:
    {
      snprintf(newPath, elcount(newPath), "%s.%s", oldPath, "large");
      C2xSetTokenInt(packetHandle, "TravelerInformation", newPath, value.large);
      result = CheckLastError("TravelerInformation", gkFuncRefGet, result);
    }
    break;
  }
  return result;
}

int GetTravelerInformationCommon_ComputedLane_offsetYaxisParams(LONG packetHandle, struct TravelerInformationCommon_ComputedLane_offsetYaxis value, char oldPath[])
{
  char newPath[300];
  int result;

  result = 0;

  value.choice = C2xGetTokenInt(packetHandle, "TravelerInformation", oldPath);

  switch(value.choice)
  {
    case 0:
    {
      snprintf(newPath, elcount(newPath), "%s.%s", oldPath, "small");
      value.small = C2xGetTokenInt(packetHandle, "TravelerInformation", newPath);
      result = CheckLastError("TravelerInformation", gkFuncRefGet, result);
    }
    break;
    case 1:
    {
      snprintf(newPath, elcount(newPath), "%s.%s", oldPath, "large");
      value.large = C2xGetTokenInt(packetHandle, "TravelerInformation", newPath);
      result = CheckLastError("TravelerInformation", gkFuncRefGet, result);
    }
    break;
  }
  return result;
}

int SetTravelerInformationCommon_ComputedLane_offsetYaxisParams(LONG packetHandle, struct TravelerInformationCommon_ComputedLane_offsetYaxis value, char oldPath[])
{
  char newPath[300];
  int result;

  result = 0;

  switch(value.choice)
  {
    case 0:
    {
      snprintf(newPath, elcount(newPath), "%s.%s", oldPath, "small");
      C2xSetTokenInt(packetHandle, "TravelerInformation", newPath, value.small);
      result = CheckLastError("TravelerInformation", gkFuncRefGet, result);
    }
    break;
    case 1:
    {
      snprintf(newPath, elcount(newPath), "%s.%s", oldPath, "large");
      C2xSetTokenInt(packetHandle, "TravelerInformation", newPath, value.large);
      result = CheckLastError("TravelerInformation", gkFuncRefGet, result);
    }
    break;
  }
  return result;
}

int GetTravelerInformationCommon_RegionalExtension_Reg_ComputedLaneParams(LONG packetHandle, struct TravelerInformationCommon_RegionalExtension_Reg_ComputedLane value, char oldPath[])
{
  char newPath[300];
  int result;

  result = 0;

  snprintf(newPath, elcount(newPath), "%s.%s", oldPath, "regionId");
  value.regionId = C2xGetTokenInt(packetHandle, "TravelerInformation", newPath);
  result = CheckLastError("TravelerInformation", gkFuncRefGet, result);

  return result;
}

int SetTravelerInformationCommon_RegionalExtension_Reg_ComputedLaneParams(LONG packetHandle, struct TravelerInformationCommon_RegionalExtension_Reg_ComputedLane value, char oldPath[])
{
  char newPath[300];
  int result;

  result = 0;


  return result;
}

int GetTravelerInformationCommon_ComputedLane_regionalParams(LONG packetHandle, struct TravelerInformationCommon_ComputedLane_regional value, char oldPath[])
{
  char newPath[300]; 
  int i;
  int result;

  result = 0;

  value.length = C2xGetTokenInt(packetHandle, "TravelerInformation", oldPath);
  if((result = CheckLastError("TravelerInformation", gkFuncRefGet, result))==0)
  {
    for(i=0; i<value.length; i++)
    {
      snprintf(newPath, elcount(newPath), "%s[%d]", oldPath, i);
      GetTravelerInformationCommon_RegionalExtension_Reg_ComputedLaneParams(packetHandle, value.arrayValue[i], newPath);
      result = CheckLastError("TravelerInformation", gkFuncRefGet, result);
    }
  }
  return result;
}

int SetTravelerInformationCommon_ComputedLane_regionalParams(LONG packetHandle, struct TravelerInformationCommon_ComputedLane_regional value, char oldPath[])
{
  char newPath[300]; 
  int i;
  int result;

  result = 0;

  C2xRemoveToken(packetHandle, "TravelerInformation", oldPath);
  for(i=0; i<value.length; i++)
  {
    snprintf(newPath, elcount(newPath), "%s[%d]", oldPath, i);
    SetTravelerInformationCommon_RegionalExtension_Reg_ComputedLaneParams(packetHandle, value.arrayValue[i], newPath);
    result = CheckLastError("TravelerInformation", gkFuncRefGet, result);
  }
  return result;
}

int GetTravelerInformationCommon_ComputedLaneParams(LONG packetHandle, struct TravelerInformationCommon_ComputedLane value, char oldPath[])
{
  char newPath[300];
  int result;

  result = 0;

  snprintf(newPath, elcount(newPath), "%s.%s", oldPath, "referenceLaneId");
  value.referenceLaneId = C2xGetTokenInt(packetHandle, "TravelerInformation", newPath);
  result = CheckLastError("TravelerInformation", gkFuncRefGet, result);

  snprintf(newPath, elcount(newPath), "%s.%s", oldPath, "offsetXaxis");
  GetTravelerInformationCommon_ComputedLane_offsetXaxisParams(packetHandle, value.offsetXaxis, newPath);
  result = CheckLastError("TravelerInformation", gkFuncRefGet, result);

  snprintf(newPath, elcount(newPath), "%s.%s", oldPath, "offsetYaxis");
  GetTravelerInformationCommon_ComputedLane_offsetYaxisParams(packetHandle, value.offsetYaxis, newPath);
  result = CheckLastError("TravelerInformation", gkFuncRefGet, result);

  snprintf(newPath, elcount(newPath), "%s.%s", oldPath, "rotateXY");
  value.rotateXY.isValidFlag = C2xIsTokenAvailable(packetHandle, "TravelerInformation", newPath);
  if(value.rotateXY.isValidFlag==1)
  {
    value.rotateXY.value = C2xGetTokenInt(packetHandle, "TravelerInformation", newPath);
    result = CheckLastError("TravelerInformation", gkFuncRefGet, result);
  }
  snprintf(newPath, elcount(newPath), "%s.%s", oldPath, "scaleXaxis");
  value.scaleXaxis.isValidFlag = C2xIsTokenAvailable(packetHandle, "TravelerInformation", newPath);
  if(value.scaleXaxis.isValidFlag==1)
  {
    value.scaleXaxis.value = C2xGetTokenInt(packetHandle, "TravelerInformation", newPath);
    result = CheckLastError("TravelerInformation", gkFuncRefGet, result);
  }
  snprintf(newPath, elcount(newPath), "%s.%s", oldPath, "scaleYaxis");
  value.scaleYaxis.isValidFlag = C2xIsTokenAvailable(packetHandle, "TravelerInformation", newPath);
  if(value.scaleYaxis.isValidFlag==1)
  {
    value.scaleYaxis.value = C2xGetTokenInt(packetHandle, "TravelerInformation", newPath);
    result = CheckLastError("TravelerInformation", gkFuncRefGet, result);
  }
  snprintf(newPath, elcount(newPath), "%s.%s", oldPath, "regional");
  value.regional.isValidFlag = C2xIsTokenAvailable(packetHandle, "TravelerInformation", newPath);
  if(value.regional.isValidFlag==1)
  {
    GetTravelerInformationCommon_ComputedLane_regionalParams(packetHandle, value.regional, newPath);
    result = CheckLastError("TravelerInformation", gkFuncRefGet, result);
  }
  return result;
}

int SetTravelerInformationCommon_ComputedLaneParams(LONG packetHandle, struct TravelerInformationCommon_ComputedLane value, char oldPath[])
{
  char newPath[300];
  int result;

  result = 0;

  snprintf(newPath, elcount(newPath), "%s.%s", oldPath, "referenceLaneId");
  C2xSetTokenInt(packetHandle, "TravelerInformation", newPath, value.referenceLaneId);
  result = CheckLastError("TravelerInformation", gkFuncRefGet, result);

  snprintf(newPath, elcount(newPath), "%s.%s", oldPath, "offsetXaxis");
  SetTravelerInformationCommon_ComputedLane_offsetXaxisParams(packetHandle, value.offsetXaxis, newPath);
  result = CheckLastError("TravelerInformation", gkFuncRefGet, result);

  snprintf(newPath, elcount(newPath), "%s.%s", oldPath, "offsetYaxis");
  SetTravelerInformationCommon_ComputedLane_offsetYaxisParams(packetHandle, value.offsetYaxis, newPath);
  result = CheckLastError("TravelerInformation", gkFuncRefGet, result);

  snprintf(newPath, elcount(newPath), "%s.%s", oldPath, "rotateXY");
  if(value.rotateXY.isValidFlag==1)
  {
    C2xSetTokenInt(packetHandle, "TravelerInformation", newPath, value.rotateXY.value);
    result = CheckLastError("TravelerInformation", gkFuncRefGet, result);
  }
  else
  {
    if( C2xIsTokenAvailable(packetHandle, "TravelerInformation", newPath) )
    {
      C2xRemoveToken(packetHandle, "TravelerInformation", newPath);
    }
  }

  snprintf(newPath, elcount(newPath), "%s.%s", oldPath, "scaleXaxis");
  if(value.scaleXaxis.isValidFlag==1)
  {
    C2xSetTokenInt(packetHandle, "TravelerInformation", newPath, value.scaleXaxis.value);
    result = CheckLastError("TravelerInformation", gkFuncRefGet, result);
  }
  else
  {
    if( C2xIsTokenAvailable(packetHandle, "TravelerInformation", newPath) )
    {
      C2xRemoveToken(packetHandle, "TravelerInformation", newPath);
    }
  }

  snprintf(newPath, elcount(newPath), "%s.%s", oldPath, "scaleYaxis");
  if(value.scaleYaxis.isValidFlag==1)
  {
    C2xSetTokenInt(packetHandle, "TravelerInformation", newPath, value.scaleYaxis.value);
    result = CheckLastError("TravelerInformation", gkFuncRefGet, result);
  }
  else
  {
    if( C2xIsTokenAvailable(packetHandle, "TravelerInformation", newPath) )
    {
      C2xRemoveToken(packetHandle, "TravelerInformation", newPath);
    }
  }

  snprintf(newPath, elcount(newPath), "%s.%s", oldPath, "regional");
  if(value.regional.isValidFlag==1)
  {
    SetTravelerInformationCommon_ComputedLane_regionalParams(packetHandle, value.regional, newPath);
    result = CheckLastError("TravelerInformation", gkFuncRefGet, result);
  }
  else
  {
    if( C2xIsTokenAvailable(packetHandle, "TravelerInformation", newPath) )
    {
      C2xRemoveToken(packetHandle, "TravelerInformation", newPath);
    }
  }

  return result;
}

int GetTravelerInformationCommon_NodeListXYParams(LONG packetHandle, struct TravelerInformationCommon_NodeListXY value, char oldPath[])
{
  char newPath[300];
  int result;

  result = 0;

  value.choice = C2xGetTokenInt(packetHandle, "TravelerInformation", oldPath);

  switch(value.choice)
  {
    case 0:
    {
      snprintf(newPath, elcount(newPath), "%s.%s", oldPath, "nodes");
      GetTravelerInformationCommon_NodeSetXYParams(packetHandle, value.nodes, newPath);
      result = CheckLastError("TravelerInformation", gkFuncRefGet, result);
    }
    break;
    case 1:
    {
      snprintf(newPath, elcount(newPath), "%s.%s", oldPath, "computed");
      GetTravelerInformationCommon_ComputedLaneParams(packetHandle, value.computed, newPath);
      result = CheckLastError("TravelerInformation", gkFuncRefGet, result);
    }
    break;
  }
  return result;
}

int SetTravelerInformationCommon_NodeListXYParams(LONG packetHandle, struct TravelerInformationCommon_NodeListXY value, char oldPath[])
{
  char newPath[300];
  int result;

  result = 0;

  switch(value.choice)
  {
    case 0:
    {
      snprintf(newPath, elcount(newPath), "%s.%s", oldPath, "nodes");
      SetTravelerInformationCommon_NodeSetXYParams(packetHandle, value.nodes, newPath);
      result = CheckLastError("TravelerInformation", gkFuncRefGet, result);
    }
    break;
    case 1:
    {
      snprintf(newPath, elcount(newPath), "%s.%s", oldPath, "computed");
      SetTravelerInformationCommon_ComputedLaneParams(packetHandle, value.computed, newPath);
      result = CheckLastError("TravelerInformation", gkFuncRefGet, result);
    }
    break;
  }
  return result;
}

int GetTravelerInformationNode_LL_24BParams(LONG packetHandle, struct TravelerInformationNode_LL_24B value, char oldPath[])
{
  char newPath[300];
  int result;

  result = 0;

  snprintf(newPath, elcount(newPath), "%s.%s", oldPath, "lon");
  value.lon = C2xGetTokenInt(packetHandle, "TravelerInformation", newPath);
  result = CheckLastError("TravelerInformation", gkFuncRefGet, result);

  snprintf(newPath, elcount(newPath), "%s.%s", oldPath, "lat");
  value.lat = C2xGetTokenInt(packetHandle, "TravelerInformation", newPath);
  result = CheckLastError("TravelerInformation", gkFuncRefGet, result);

  return result;
}

int SetTravelerInformationNode_LL_24BParams(LONG packetHandle, struct TravelerInformationNode_LL_24B value, char oldPath[])
{
  char newPath[300];
  int result;

  result = 0;

  snprintf(newPath, elcount(newPath), "%s.%s", oldPath, "lon");
  C2xSetTokenInt(packetHandle, "TravelerInformation", newPath, value.lon);
  result = CheckLastError("TravelerInformation", gkFuncRefGet, result);

  snprintf(newPath, elcount(newPath), "%s.%s", oldPath, "lat");
  C2xSetTokenInt(packetHandle, "TravelerInformation", newPath, value.lat);
  result = CheckLastError("TravelerInformation", gkFuncRefGet, result);

  return result;
}

int GetTravelerInformationNode_LL_28BParams(LONG packetHandle, struct TravelerInformationNode_LL_28B value, char oldPath[])
{
  char newPath[300];
  int result;

  result = 0;

  snprintf(newPath, elcount(newPath), "%s.%s", oldPath, "lon");
  value.lon = C2xGetTokenInt(packetHandle, "TravelerInformation", newPath);
  result = CheckLastError("TravelerInformation", gkFuncRefGet, result);

  snprintf(newPath, elcount(newPath), "%s.%s", oldPath, "lat");
  value.lat = C2xGetTokenInt(packetHandle, "TravelerInformation", newPath);
  result = CheckLastError("TravelerInformation", gkFuncRefGet, result);

  return result;
}

int SetTravelerInformationNode_LL_28BParams(LONG packetHandle, struct TravelerInformationNode_LL_28B value, char oldPath[])
{
  char newPath[300];
  int result;

  result = 0;

  snprintf(newPath, elcount(newPath), "%s.%s", oldPath, "lon");
  C2xSetTokenInt(packetHandle, "TravelerInformation", newPath, value.lon);
  result = CheckLastError("TravelerInformation", gkFuncRefGet, result);

  snprintf(newPath, elcount(newPath), "%s.%s", oldPath, "lat");
  C2xSetTokenInt(packetHandle, "TravelerInformation", newPath, value.lat);
  result = CheckLastError("TravelerInformation", gkFuncRefGet, result);

  return result;
}

int GetTravelerInformationNode_LL_32BParams(LONG packetHandle, struct TravelerInformationNode_LL_32B value, char oldPath[])
{
  char newPath[300];
  int result;

  result = 0;

  snprintf(newPath, elcount(newPath), "%s.%s", oldPath, "lon");
  value.lon = C2xGetTokenInt(packetHandle, "TravelerInformation", newPath);
  result = CheckLastError("TravelerInformation", gkFuncRefGet, result);

  snprintf(newPath, elcount(newPath), "%s.%s", oldPath, "lat");
  value.lat = C2xGetTokenInt(packetHandle, "TravelerInformation", newPath);
  result = CheckLastError("TravelerInformation", gkFuncRefGet, result);

  return result;
}

int SetTravelerInformationNode_LL_32BParams(LONG packetHandle, struct TravelerInformationNode_LL_32B value, char oldPath[])
{
  char newPath[300];
  int result;

  result = 0;

  snprintf(newPath, elcount(newPath), "%s.%s", oldPath, "lon");
  C2xSetTokenInt(packetHandle, "TravelerInformation", newPath, value.lon);
  result = CheckLastError("TravelerInformation", gkFuncRefGet, result);

  snprintf(newPath, elcount(newPath), "%s.%s", oldPath, "lat");
  C2xSetTokenInt(packetHandle, "TravelerInformation", newPath, value.lat);
  result = CheckLastError("TravelerInformation", gkFuncRefGet, result);

  return result;
}

int GetTravelerInformationNode_LL_36BParams(LONG packetHandle, struct TravelerInformationNode_LL_36B value, char oldPath[])
{
  char newPath[300];
  int result;

  result = 0;

  snprintf(newPath, elcount(newPath), "%s.%s", oldPath, "lon");
  value.lon = C2xGetTokenInt(packetHandle, "TravelerInformation", newPath);
  result = CheckLastError("TravelerInformation", gkFuncRefGet, result);

  snprintf(newPath, elcount(newPath), "%s.%s", oldPath, "lat");
  value.lat = C2xGetTokenInt(packetHandle, "TravelerInformation", newPath);
  result = CheckLastError("TravelerInformation", gkFuncRefGet, result);

  return result;
}

int SetTravelerInformationNode_LL_36BParams(LONG packetHandle, struct TravelerInformationNode_LL_36B value, char oldPath[])
{
  char newPath[300];
  int result;

  result = 0;

  snprintf(newPath, elcount(newPath), "%s.%s", oldPath, "lon");
  C2xSetTokenInt(packetHandle, "TravelerInformation", newPath, value.lon);
  result = CheckLastError("TravelerInformation", gkFuncRefGet, result);

  snprintf(newPath, elcount(newPath), "%s.%s", oldPath, "lat");
  C2xSetTokenInt(packetHandle, "TravelerInformation", newPath, value.lat);
  result = CheckLastError("TravelerInformation", gkFuncRefGet, result);

  return result;
}

int GetTravelerInformationNode_LL_44BParams(LONG packetHandle, struct TravelerInformationNode_LL_44B value, char oldPath[])
{
  char newPath[300];
  int result;

  result = 0;

  snprintf(newPath, elcount(newPath), "%s.%s", oldPath, "lon");
  value.lon = C2xGetTokenInt(packetHandle, "TravelerInformation", newPath);
  result = CheckLastError("TravelerInformation", gkFuncRefGet, result);

  snprintf(newPath, elcount(newPath), "%s.%s", oldPath, "lat");
  value.lat = C2xGetTokenInt(packetHandle, "TravelerInformation", newPath);
  result = CheckLastError("TravelerInformation", gkFuncRefGet, result);

  return result;
}

int SetTravelerInformationNode_LL_44BParams(LONG packetHandle, struct TravelerInformationNode_LL_44B value, char oldPath[])
{
  char newPath[300];
  int result;

  result = 0;

  snprintf(newPath, elcount(newPath), "%s.%s", oldPath, "lon");
  C2xSetTokenInt(packetHandle, "TravelerInformation", newPath, value.lon);
  result = CheckLastError("TravelerInformation", gkFuncRefGet, result);

  snprintf(newPath, elcount(newPath), "%s.%s", oldPath, "lat");
  C2xSetTokenInt(packetHandle, "TravelerInformation", newPath, value.lat);
  result = CheckLastError("TravelerInformation", gkFuncRefGet, result);

  return result;
}

int GetTravelerInformationNode_LL_48BParams(LONG packetHandle, struct TravelerInformationNode_LL_48B value, char oldPath[])
{
  char newPath[300];
  int result;

  result = 0;

  snprintf(newPath, elcount(newPath), "%s.%s", oldPath, "lon");
  value.lon = C2xGetTokenInt(packetHandle, "TravelerInformation", newPath);
  result = CheckLastError("TravelerInformation", gkFuncRefGet, result);

  snprintf(newPath, elcount(newPath), "%s.%s", oldPath, "lat");
  value.lat = C2xGetTokenInt(packetHandle, "TravelerInformation", newPath);
  result = CheckLastError("TravelerInformation", gkFuncRefGet, result);

  return result;
}

int SetTravelerInformationNode_LL_48BParams(LONG packetHandle, struct TravelerInformationNode_LL_48B value, char oldPath[])
{
  char newPath[300];
  int result;

  result = 0;

  snprintf(newPath, elcount(newPath), "%s.%s", oldPath, "lon");
  C2xSetTokenInt(packetHandle, "TravelerInformation", newPath, value.lon);
  result = CheckLastError("TravelerInformation", gkFuncRefGet, result);

  snprintf(newPath, elcount(newPath), "%s.%s", oldPath, "lat");
  C2xSetTokenInt(packetHandle, "TravelerInformation", newPath, value.lat);
  result = CheckLastError("TravelerInformation", gkFuncRefGet, result);

  return result;
}

int GetTravelerInformationCommon_RegionalExtension_Reg_NodeOffsetPointLLParams(LONG packetHandle, struct TravelerInformationCommon_RegionalExtension_Reg_NodeOffsetPointLL value, char oldPath[])
{
  char newPath[300];
  int result;

  result = 0;

  snprintf(newPath, elcount(newPath), "%s.%s", oldPath, "regionId");
  value.regionId = C2xGetTokenInt(packetHandle, "TravelerInformation", newPath);
  result = CheckLastError("TravelerInformation", gkFuncRefGet, result);

  return result;
}

int SetTravelerInformationCommon_RegionalExtension_Reg_NodeOffsetPointLLParams(LONG packetHandle, struct TravelerInformationCommon_RegionalExtension_Reg_NodeOffsetPointLL value, char oldPath[])
{
  char newPath[300];
  int result;

  result = 0;


  return result;
}

int GetTravelerInformationNodeOffsetPointLLParams(LONG packetHandle, struct TravelerInformationNodeOffsetPointLL value, char oldPath[])
{
  char newPath[300];
  int result;

  result = 0;

  value.choice = C2xGetTokenInt(packetHandle, "TravelerInformation", oldPath);

  switch(value.choice)
  {
    case 0:
    {
      snprintf(newPath, elcount(newPath), "%s.%s", oldPath, "node_LL1");
      GetTravelerInformationNode_LL_24BParams(packetHandle, value.node_LL1, newPath);
      result = CheckLastError("TravelerInformation", gkFuncRefGet, result);
    }
    break;
    case 1:
    {
      snprintf(newPath, elcount(newPath), "%s.%s", oldPath, "node_LL2");
      GetTravelerInformationNode_LL_28BParams(packetHandle, value.node_LL2, newPath);
      result = CheckLastError("TravelerInformation", gkFuncRefGet, result);
    }
    break;
    case 2:
    {
      snprintf(newPath, elcount(newPath), "%s.%s", oldPath, "node_LL3");
      GetTravelerInformationNode_LL_32BParams(packetHandle, value.node_LL3, newPath);
      result = CheckLastError("TravelerInformation", gkFuncRefGet, result);
    }
    break;
    case 3:
    {
      snprintf(newPath, elcount(newPath), "%s.%s", oldPath, "node_LL4");
      GetTravelerInformationNode_LL_36BParams(packetHandle, value.node_LL4, newPath);
      result = CheckLastError("TravelerInformation", gkFuncRefGet, result);
    }
    break;
    case 4:
    {
      snprintf(newPath, elcount(newPath), "%s.%s", oldPath, "node_LL5");
      GetTravelerInformationNode_LL_44BParams(packetHandle, value.node_LL5, newPath);
      result = CheckLastError("TravelerInformation", gkFuncRefGet, result);
    }
    break;
    case 5:
    {
      snprintf(newPath, elcount(newPath), "%s.%s", oldPath, "node_LL6");
      GetTravelerInformationNode_LL_48BParams(packetHandle, value.node_LL6, newPath);
      result = CheckLastError("TravelerInformation", gkFuncRefGet, result);
    }
    break;
    case 6:
    {
      snprintf(newPath, elcount(newPath), "%s.%s", oldPath, "node_LatLon");
      GetTravelerInformationCommon_Node_LLmD_64bParams(packetHandle, value.node_LatLon, newPath);
      result = CheckLastError("TravelerInformation", gkFuncRefGet, result);
    }
    break;
    case 7:
    {
      snprintf(newPath, elcount(newPath), "%s.%s", oldPath, "regional");
      GetTravelerInformationCommon_RegionalExtension_Reg_NodeOffsetPointLLParams(packetHandle, value.regional, newPath);
      result = CheckLastError("TravelerInformation", gkFuncRefGet, result);
    }
    break;
  }
  return result;
}

int SetTravelerInformationNodeOffsetPointLLParams(LONG packetHandle, struct TravelerInformationNodeOffsetPointLL value, char oldPath[])
{
  char newPath[300];
  int result;

  result = 0;

  switch(value.choice)
  {
    case 0:
    {
      snprintf(newPath, elcount(newPath), "%s.%s", oldPath, "node_LL1");
      SetTravelerInformationNode_LL_24BParams(packetHandle, value.node_LL1, newPath);
      result = CheckLastError("TravelerInformation", gkFuncRefGet, result);
    }
    break;
    case 1:
    {
      snprintf(newPath, elcount(newPath), "%s.%s", oldPath, "node_LL2");
      SetTravelerInformationNode_LL_28BParams(packetHandle, value.node_LL2, newPath);
      result = CheckLastError("TravelerInformation", gkFuncRefGet, result);
    }
    break;
    case 2:
    {
      snprintf(newPath, elcount(newPath), "%s.%s", oldPath, "node_LL3");
      SetTravelerInformationNode_LL_32BParams(packetHandle, value.node_LL3, newPath);
      result = CheckLastError("TravelerInformation", gkFuncRefGet, result);
    }
    break;
    case 3:
    {
      snprintf(newPath, elcount(newPath), "%s.%s", oldPath, "node_LL4");
      SetTravelerInformationNode_LL_36BParams(packetHandle, value.node_LL4, newPath);
      result = CheckLastError("TravelerInformation", gkFuncRefGet, result);
    }
    break;
    case 4:
    {
      snprintf(newPath, elcount(newPath), "%s.%s", oldPath, "node_LL5");
      SetTravelerInformationNode_LL_44BParams(packetHandle, value.node_LL5, newPath);
      result = CheckLastError("TravelerInformation", gkFuncRefGet, result);
    }
    break;
    case 5:
    {
      snprintf(newPath, elcount(newPath), "%s.%s", oldPath, "node_LL6");
      SetTravelerInformationNode_LL_48BParams(packetHandle, value.node_LL6, newPath);
      result = CheckLastError("TravelerInformation", gkFuncRefGet, result);
    }
    break;
    case 6:
    {
      snprintf(newPath, elcount(newPath), "%s.%s", oldPath, "node_LatLon");
      SetTravelerInformationCommon_Node_LLmD_64bParams(packetHandle, value.node_LatLon, newPath);
      result = CheckLastError("TravelerInformation", gkFuncRefGet, result);
    }
    break;
    case 7:
    {
      snprintf(newPath, elcount(newPath), "%s.%s", oldPath, "regional");
      SetTravelerInformationCommon_RegionalExtension_Reg_NodeOffsetPointLLParams(packetHandle, value.regional, newPath);
      result = CheckLastError("TravelerInformation", gkFuncRefGet, result);
    }
    break;
  }
  return result;
}

int GetTravelerInformationNodeAttributeLLListParams(LONG packetHandle, struct TravelerInformationNodeAttributeLLList value, char oldPath[])
{
  char newPath[300]; 
  int i;
  int result;

  result = 0;

  value.length = C2xGetTokenInt(packetHandle, "TravelerInformation", oldPath);
  if((result = CheckLastError("TravelerInformation", gkFuncRefGet, result))==0)
  {
    for(i=0; i<value.length; i++)
    {
      snprintf(newPath, elcount(newPath), "%s[%d]", oldPath, i);
      value.arrayValue[i] = C2xGetTokenInt64(packetHandle, "TravelerInformation", newPath);
      result = CheckLastError("TravelerInformation", gkFuncRefGet, result);
    }
  }
  return result;
}

int SetTravelerInformationNodeAttributeLLListParams(LONG packetHandle, struct TravelerInformationNodeAttributeLLList value, char oldPath[])
{
  char newPath[300]; 
  int i;
  int result;

  result = 0;

  C2xRemoveToken(packetHandle, "TravelerInformation", oldPath);
  for(i=0; i<value.length; i++)
  {
    snprintf(newPath, elcount(newPath), "%s[%d]", oldPath, i);
    C2xSetTokenInt64(packetHandle, "TravelerInformation", newPath, value.arrayValue[i]);
    result = CheckLastError("TravelerInformation", gkFuncRefGet, result);
  }
  return result;
}

int GetTravelerInformationSegmentAttributeLLListParams(LONG packetHandle, struct TravelerInformationSegmentAttributeLLList value, char oldPath[])
{
  char newPath[300]; 
  int i;
  int result;

  result = 0;

  value.length = C2xGetTokenInt(packetHandle, "TravelerInformation", oldPath);
  if((result = CheckLastError("TravelerInformation", gkFuncRefGet, result))==0)
  {
    for(i=0; i<value.length; i++)
    {
      snprintf(newPath, elcount(newPath), "%s[%d]", oldPath, i);
      value.arrayValue[i] = C2xGetTokenInt64(packetHandle, "TravelerInformation", newPath);
      result = CheckLastError("TravelerInformation", gkFuncRefGet, result);
    }
  }
  return result;
}

int SetTravelerInformationSegmentAttributeLLListParams(LONG packetHandle, struct TravelerInformationSegmentAttributeLLList value, char oldPath[])
{
  char newPath[300]; 
  int i;
  int result;

  result = 0;

  C2xRemoveToken(packetHandle, "TravelerInformation", oldPath);
  for(i=0; i<value.length; i++)
  {
    snprintf(newPath, elcount(newPath), "%s[%d]", oldPath, i);
    C2xSetTokenInt64(packetHandle, "TravelerInformation", newPath, value.arrayValue[i]);
    result = CheckLastError("TravelerInformation", gkFuncRefGet, result);
  }
  return result;
}

int GetTravelerInformationCommon_RegionalExtension_Reg_NodeAttributeSetLLParams(LONG packetHandle, struct TravelerInformationCommon_RegionalExtension_Reg_NodeAttributeSetLL value, char oldPath[])
{
  char newPath[300];
  int result;

  result = 0;

  snprintf(newPath, elcount(newPath), "%s.%s", oldPath, "regionId");
  value.regionId = C2xGetTokenInt(packetHandle, "TravelerInformation", newPath);
  result = CheckLastError("TravelerInformation", gkFuncRefGet, result);

  return result;
}

int SetTravelerInformationCommon_RegionalExtension_Reg_NodeAttributeSetLLParams(LONG packetHandle, struct TravelerInformationCommon_RegionalExtension_Reg_NodeAttributeSetLL value, char oldPath[])
{
  char newPath[300];
  int result;

  result = 0;


  return result;
}

int GetTravelerInformationNodeAttributeSetLL_regionalParams(LONG packetHandle, struct TravelerInformationNodeAttributeSetLL_regional value, char oldPath[])
{
  char newPath[300]; 
  int i;
  int result;

  result = 0;

  value.length = C2xGetTokenInt(packetHandle, "TravelerInformation", oldPath);
  if((result = CheckLastError("TravelerInformation", gkFuncRefGet, result))==0)
  {
    for(i=0; i<value.length; i++)
    {
      snprintf(newPath, elcount(newPath), "%s[%d]", oldPath, i);
      GetTravelerInformationCommon_RegionalExtension_Reg_NodeAttributeSetLLParams(packetHandle, value.arrayValue[i], newPath);
      result = CheckLastError("TravelerInformation", gkFuncRefGet, result);
    }
  }
  return result;
}

int SetTravelerInformationNodeAttributeSetLL_regionalParams(LONG packetHandle, struct TravelerInformationNodeAttributeSetLL_regional value, char oldPath[])
{
  char newPath[300]; 
  int i;
  int result;

  result = 0;

  C2xRemoveToken(packetHandle, "TravelerInformation", oldPath);
  for(i=0; i<value.length; i++)
  {
    snprintf(newPath, elcount(newPath), "%s[%d]", oldPath, i);
    SetTravelerInformationCommon_RegionalExtension_Reg_NodeAttributeSetLLParams(packetHandle, value.arrayValue[i], newPath);
    result = CheckLastError("TravelerInformation", gkFuncRefGet, result);
  }
  return result;
}

int GetTravelerInformationNodeAttributeSetLLParams(LONG packetHandle, struct TravelerInformationNodeAttributeSetLL value, char oldPath[])
{
  char newPath[300];
  int result;

  result = 0;

  snprintf(newPath, elcount(newPath), "%s.%s", oldPath, "localNode");
  value.localNode.isValidFlag = C2xIsTokenAvailable(packetHandle, "TravelerInformation", newPath);
  if(value.localNode.isValidFlag==1)
  {
    GetTravelerInformationNodeAttributeLLListParams(packetHandle, value.localNode, newPath);
    result = CheckLastError("TravelerInformation", gkFuncRefGet, result);
  }
  snprintf(newPath, elcount(newPath), "%s.%s", oldPath, "disabled");
  value.disabled.isValidFlag = C2xIsTokenAvailable(packetHandle, "TravelerInformation", newPath);
  if(value.disabled.isValidFlag==1)
  {
    GetTravelerInformationSegmentAttributeLLListParams(packetHandle, value.disabled, newPath);
    result = CheckLastError("TravelerInformation", gkFuncRefGet, result);
  }
  snprintf(newPath, elcount(newPath), "%s.%s", oldPath, "enabled");
  value.enabled.isValidFlag = C2xIsTokenAvailable(packetHandle, "TravelerInformation", newPath);
  if(value.enabled.isValidFlag==1)
  {
    GetTravelerInformationSegmentAttributeLLListParams(packetHandle, value.enabled, newPath);
    result = CheckLastError("TravelerInformation", gkFuncRefGet, result);
  }
  snprintf(newPath, elcount(newPath), "%s.%s", oldPath, "data");
  value.data.isValidFlag = C2xIsTokenAvailable(packetHandle, "TravelerInformation", newPath);
  if(value.data.isValidFlag==1)
  {
    GetTravelerInformationCommon_LaneDataAttributeListParams(packetHandle, value.data, newPath);
    result = CheckLastError("TravelerInformation", gkFuncRefGet, result);
  }
  snprintf(newPath, elcount(newPath), "%s.%s", oldPath, "dWidth");
  value.dWidth.isValidFlag = C2xIsTokenAvailable(packetHandle, "TravelerInformation", newPath);
  if(value.dWidth.isValidFlag==1)
  {
    value.dWidth.value = C2xGetTokenInt(packetHandle, "TravelerInformation", newPath);
    result = CheckLastError("TravelerInformation", gkFuncRefGet, result);
  }
  snprintf(newPath, elcount(newPath), "%s.%s", oldPath, "dElevation");
  value.dElevation.isValidFlag = C2xIsTokenAvailable(packetHandle, "TravelerInformation", newPath);
  if(value.dElevation.isValidFlag==1)
  {
    value.dElevation.value = C2xGetTokenInt(packetHandle, "TravelerInformation", newPath);
    result = CheckLastError("TravelerInformation", gkFuncRefGet, result);
  }
  snprintf(newPath, elcount(newPath), "%s.%s", oldPath, "regional");
  value.regional.isValidFlag = C2xIsTokenAvailable(packetHandle, "TravelerInformation", newPath);
  if(value.regional.isValidFlag==1)
  {
    GetTravelerInformationNodeAttributeSetLL_regionalParams(packetHandle, value.regional, newPath);
    result = CheckLastError("TravelerInformation", gkFuncRefGet, result);
  }
  return result;
}

int SetTravelerInformationNodeAttributeSetLLParams(LONG packetHandle, struct TravelerInformationNodeAttributeSetLL value, char oldPath[])
{
  char newPath[300];
  int result;

  result = 0;

  snprintf(newPath, elcount(newPath), "%s.%s", oldPath, "localNode");
  if(value.localNode.isValidFlag==1)
  {
    SetTravelerInformationNodeAttributeLLListParams(packetHandle, value.localNode, newPath);
    result = CheckLastError("TravelerInformation", gkFuncRefGet, result);
  }
  else
  {
    if( C2xIsTokenAvailable(packetHandle, "TravelerInformation", newPath) )
    {
      C2xRemoveToken(packetHandle, "TravelerInformation", newPath);
    }
  }

  snprintf(newPath, elcount(newPath), "%s.%s", oldPath, "disabled");
  if(value.disabled.isValidFlag==1)
  {
    SetTravelerInformationSegmentAttributeLLListParams(packetHandle, value.disabled, newPath);
    result = CheckLastError("TravelerInformation", gkFuncRefGet, result);
  }
  else
  {
    if( C2xIsTokenAvailable(packetHandle, "TravelerInformation", newPath) )
    {
      C2xRemoveToken(packetHandle, "TravelerInformation", newPath);
    }
  }

  snprintf(newPath, elcount(newPath), "%s.%s", oldPath, "enabled");
  if(value.enabled.isValidFlag==1)
  {
    SetTravelerInformationSegmentAttributeLLListParams(packetHandle, value.enabled, newPath);
    result = CheckLastError("TravelerInformation", gkFuncRefGet, result);
  }
  else
  {
    if( C2xIsTokenAvailable(packetHandle, "TravelerInformation", newPath) )
    {
      C2xRemoveToken(packetHandle, "TravelerInformation", newPath);
    }
  }

  snprintf(newPath, elcount(newPath), "%s.%s", oldPath, "data");
  if(value.data.isValidFlag==1)
  {
    SetTravelerInformationCommon_LaneDataAttributeListParams(packetHandle, value.data, newPath);
    result = CheckLastError("TravelerInformation", gkFuncRefGet, result);
  }
  else
  {
    if( C2xIsTokenAvailable(packetHandle, "TravelerInformation", newPath) )
    {
      C2xRemoveToken(packetHandle, "TravelerInformation", newPath);
    }
  }

  snprintf(newPath, elcount(newPath), "%s.%s", oldPath, "dWidth");
  if(value.dWidth.isValidFlag==1)
  {
    C2xSetTokenInt(packetHandle, "TravelerInformation", newPath, value.dWidth.value);
    result = CheckLastError("TravelerInformation", gkFuncRefGet, result);
  }
  else
  {
    if( C2xIsTokenAvailable(packetHandle, "TravelerInformation", newPath) )
    {
      C2xRemoveToken(packetHandle, "TravelerInformation", newPath);
    }
  }

  snprintf(newPath, elcount(newPath), "%s.%s", oldPath, "dElevation");
  if(value.dElevation.isValidFlag==1)
  {
    C2xSetTokenInt(packetHandle, "TravelerInformation", newPath, value.dElevation.value);
    result = CheckLastError("TravelerInformation", gkFuncRefGet, result);
  }
  else
  {
    if( C2xIsTokenAvailable(packetHandle, "TravelerInformation", newPath) )
    {
      C2xRemoveToken(packetHandle, "TravelerInformation", newPath);
    }
  }

  snprintf(newPath, elcount(newPath), "%s.%s", oldPath, "regional");
  if(value.regional.isValidFlag==1)
  {
    SetTravelerInformationNodeAttributeSetLL_regionalParams(packetHandle, value.regional, newPath);
    result = CheckLastError("TravelerInformation", gkFuncRefGet, result);
  }
  else
  {
    if( C2xIsTokenAvailable(packetHandle, "TravelerInformation", newPath) )
    {
      C2xRemoveToken(packetHandle, "TravelerInformation", newPath);
    }
  }

  return result;
}

int GetTravelerInformationNodeLLParams(LONG packetHandle, struct TravelerInformationNodeLL value, char oldPath[])
{
  char newPath[300];
  int result;

  result = 0;

  snprintf(newPath, elcount(newPath), "%s.%s", oldPath, "delta");
  GetTravelerInformationNodeOffsetPointLLParams(packetHandle, value.delta, newPath);
  result = CheckLastError("TravelerInformation", gkFuncRefGet, result);

  snprintf(newPath, elcount(newPath), "%s.%s", oldPath, "attributes");
  value.attributes.isValidFlag = C2xIsTokenAvailable(packetHandle, "TravelerInformation", newPath);
  if(value.attributes.isValidFlag==1)
  {
    GetTravelerInformationNodeAttributeSetLLParams(packetHandle, value.attributes, newPath);
    result = CheckLastError("TravelerInformation", gkFuncRefGet, result);
  }
  return result;
}

int SetTravelerInformationNodeLLParams(LONG packetHandle, struct TravelerInformationNodeLL value, char oldPath[])
{
  char newPath[300];
  int result;

  result = 0;

  snprintf(newPath, elcount(newPath), "%s.%s", oldPath, "delta");
  SetTravelerInformationNodeOffsetPointLLParams(packetHandle, value.delta, newPath);
  result = CheckLastError("TravelerInformation", gkFuncRefGet, result);

  snprintf(newPath, elcount(newPath), "%s.%s", oldPath, "attributes");
  if(value.attributes.isValidFlag==1)
  {
    SetTravelerInformationNodeAttributeSetLLParams(packetHandle, value.attributes, newPath);
    result = CheckLastError("TravelerInformation", gkFuncRefGet, result);
  }
  else
  {
    if( C2xIsTokenAvailable(packetHandle, "TravelerInformation", newPath) )
    {
      C2xRemoveToken(packetHandle, "TravelerInformation", newPath);
    }
  }

  return result;
}

int GetTravelerInformationNodeSetLLParams(LONG packetHandle, struct TravelerInformationNodeSetLL value, char oldPath[])
{
  char newPath[300]; 
  int i;
  int result;

  result = 0;

  value.length = C2xGetTokenInt(packetHandle, "TravelerInformation", oldPath);
  if((result = CheckLastError("TravelerInformation", gkFuncRefGet, result))==0)
  {
    for(i=0; i<value.length; i++)
    {
      snprintf(newPath, elcount(newPath), "%s[%d]", oldPath, i);
      GetTravelerInformationNodeLLParams(packetHandle, value.arrayValue[i], newPath);
      result = CheckLastError("TravelerInformation", gkFuncRefGet, result);
    }
  }
  return result;
}

int SetTravelerInformationNodeSetLLParams(LONG packetHandle, struct TravelerInformationNodeSetLL value, char oldPath[])
{
  char newPath[300]; 
  int i;
  int result;

  result = 0;

  C2xRemoveToken(packetHandle, "TravelerInformation", oldPath);
  for(i=0; i<value.length; i++)
  {
    snprintf(newPath, elcount(newPath), "%s[%d]", oldPath, i);
    SetTravelerInformationNodeLLParams(packetHandle, value.arrayValue[i], newPath);
    result = CheckLastError("TravelerInformation", gkFuncRefGet, result);
  }
  return result;
}

int GetTravelerInformationNodeListLLParams(LONG packetHandle, struct TravelerInformationNodeListLL value, char oldPath[])
{
  char newPath[300];
  int result;

  result = 0;

  value.choice = C2xGetTokenInt(packetHandle, "TravelerInformation", oldPath);

  switch(value.choice)
  {
    case 0:
    {
      snprintf(newPath, elcount(newPath), "%s.%s", oldPath, "nodes");
      GetTravelerInformationNodeSetLLParams(packetHandle, value.nodes, newPath);
      result = CheckLastError("TravelerInformation", gkFuncRefGet, result);
    }
    break;
  }
  return result;
}

int SetTravelerInformationNodeListLLParams(LONG packetHandle, struct TravelerInformationNodeListLL value, char oldPath[])
{
  char newPath[300];
  int result;

  result = 0;

  switch(value.choice)
  {
    case 0:
    {
      snprintf(newPath, elcount(newPath), "%s.%s", oldPath, "nodes");
      SetTravelerInformationNodeSetLLParams(packetHandle, value.nodes, newPath);
      result = CheckLastError("TravelerInformation", gkFuncRefGet, result);
    }
    break;
  }
  return result;
}

int GetTravelerInformationOffsetSystem_offsetParams(LONG packetHandle, struct TravelerInformationOffsetSystem_offset value, char oldPath[])
{
  char newPath[300];
  int result;

  result = 0;

  value.choice = C2xGetTokenInt(packetHandle, "TravelerInformation", oldPath);

  switch(value.choice)
  {
    case 0:
    {
      snprintf(newPath, elcount(newPath), "%s.%s", oldPath, "xy");
      GetTravelerInformationCommon_NodeListXYParams(packetHandle, value.xy, newPath);
      result = CheckLastError("TravelerInformation", gkFuncRefGet, result);
    }
    break;
    case 1:
    {
      snprintf(newPath, elcount(newPath), "%s.%s", oldPath, "ll");
      GetTravelerInformationNodeListLLParams(packetHandle, value.ll, newPath);
      result = CheckLastError("TravelerInformation", gkFuncRefGet, result);
    }
    break;
  }
  return result;
}

int SetTravelerInformationOffsetSystem_offsetParams(LONG packetHandle, struct TravelerInformationOffsetSystem_offset value, char oldPath[])
{
  char newPath[300];
  int result;

  result = 0;

  switch(value.choice)
  {
    case 0:
    {
      snprintf(newPath, elcount(newPath), "%s.%s", oldPath, "xy");
      SetTravelerInformationCommon_NodeListXYParams(packetHandle, value.xy, newPath);
      result = CheckLastError("TravelerInformation", gkFuncRefGet, result);
    }
    break;
    case 1:
    {
      snprintf(newPath, elcount(newPath), "%s.%s", oldPath, "ll");
      SetTravelerInformationNodeListLLParams(packetHandle, value.ll, newPath);
      result = CheckLastError("TravelerInformation", gkFuncRefGet, result);
    }
    break;
  }
  return result;
}

int GetTravelerInformationOffsetSystemParams(LONG packetHandle, struct TravelerInformationOffsetSystem value, char oldPath[])
{
  char newPath[300];
  int result;

  result = 0;

  snprintf(newPath, elcount(newPath), "%s.%s", oldPath, "scale");
  value.scale.isValidFlag = C2xIsTokenAvailable(packetHandle, "TravelerInformation", newPath);
  if(value.scale.isValidFlag==1)
  {
    value.scale.value = C2xGetTokenInt(packetHandle, "TravelerInformation", newPath);
    result = CheckLastError("TravelerInformation", gkFuncRefGet, result);
  }
  snprintf(newPath, elcount(newPath), "%s.%s", oldPath, "offset");
  GetTravelerInformationOffsetSystem_offsetParams(packetHandle, value.offset, newPath);
  result = CheckLastError("TravelerInformation", gkFuncRefGet, result);

  return result;
}

int SetTravelerInformationOffsetSystemParams(LONG packetHandle, struct TravelerInformationOffsetSystem value, char oldPath[])
{
  char newPath[300];
  int result;

  result = 0;

  snprintf(newPath, elcount(newPath), "%s.%s", oldPath, "scale");
  if(value.scale.isValidFlag==1)
  {
    C2xSetTokenInt(packetHandle, "TravelerInformation", newPath, value.scale.value);
    result = CheckLastError("TravelerInformation", gkFuncRefGet, result);
  }
  else
  {
    if( C2xIsTokenAvailable(packetHandle, "TravelerInformation", newPath) )
    {
      C2xRemoveToken(packetHandle, "TravelerInformation", newPath);
    }
  }

  snprintf(newPath, elcount(newPath), "%s.%s", oldPath, "offset");
  SetTravelerInformationOffsetSystem_offsetParams(packetHandle, value.offset, newPath);
  result = CheckLastError("TravelerInformation", gkFuncRefGet, result);

  return result;
}

int GetTravelerInformationCircleParams(LONG packetHandle, struct TravelerInformationCircle value, char oldPath[])
{
  char newPath[300];
  int result;

  result = 0;

  snprintf(newPath, elcount(newPath), "%s.%s", oldPath, "center");
  GetTravelerInformationCommon_Position3DParams(packetHandle, value.center, newPath);
  result = CheckLastError("TravelerInformation", gkFuncRefGet, result);

  snprintf(newPath, elcount(newPath), "%s.%s", oldPath, "radius");
  value.radius = C2xGetTokenInt(packetHandle, "TravelerInformation", newPath);
  result = CheckLastError("TravelerInformation", gkFuncRefGet, result);

  snprintf(newPath, elcount(newPath), "%s.%s", oldPath, "units");
  value.units = C2xGetTokenInt(packetHandle, "TravelerInformation", newPath);
  result = CheckLastError("TravelerInformation", gkFuncRefGet, result);

  return result;
}

int SetTravelerInformationCircleParams(LONG packetHandle, struct TravelerInformationCircle value, char oldPath[])
{
  char newPath[300];
  int result;

  result = 0;

  snprintf(newPath, elcount(newPath), "%s.%s", oldPath, "center");
  SetTravelerInformationCommon_Position3DParams(packetHandle, value.center, newPath);
  result = CheckLastError("TravelerInformation", gkFuncRefGet, result);

  snprintf(newPath, elcount(newPath), "%s.%s", oldPath, "radius");
  C2xSetTokenInt(packetHandle, "TravelerInformation", newPath, value.radius);
  result = CheckLastError("TravelerInformation", gkFuncRefGet, result);

  snprintf(newPath, elcount(newPath), "%s.%s", oldPath, "units");
  C2xSetTokenInt(packetHandle, "TravelerInformation", newPath, value.units);
  result = CheckLastError("TravelerInformation", gkFuncRefGet, result);

  return result;
}

int GetTravelerInformationCommon_RegionalExtension_Reg_GeometricProjectionParams(LONG packetHandle, struct TravelerInformationCommon_RegionalExtension_Reg_GeometricProjection value, char oldPath[])
{
  char newPath[300];
  int result;

  result = 0;

  snprintf(newPath, elcount(newPath), "%s.%s", oldPath, "regionId");
  value.regionId = C2xGetTokenInt(packetHandle, "TravelerInformation", newPath);
  result = CheckLastError("TravelerInformation", gkFuncRefGet, result);

  return result;
}

int SetTravelerInformationCommon_RegionalExtension_Reg_GeometricProjectionParams(LONG packetHandle, struct TravelerInformationCommon_RegionalExtension_Reg_GeometricProjection value, char oldPath[])
{
  char newPath[300];
  int result;

  result = 0;


  return result;
}

int GetTravelerInformationGeometricProjection_regionalParams(LONG packetHandle, struct TravelerInformationGeometricProjection_regional value, char oldPath[])
{
  char newPath[300]; 
  int i;
  int result;

  result = 0;

  value.length = C2xGetTokenInt(packetHandle, "TravelerInformation", oldPath);
  if((result = CheckLastError("TravelerInformation", gkFuncRefGet, result))==0)
  {
    for(i=0; i<value.length; i++)
    {
      snprintf(newPath, elcount(newPath), "%s[%d]", oldPath, i);
      GetTravelerInformationCommon_RegionalExtension_Reg_GeometricProjectionParams(packetHandle, value.arrayValue[i], newPath);
      result = CheckLastError("TravelerInformation", gkFuncRefGet, result);
    }
  }
  return result;
}

int SetTravelerInformationGeometricProjection_regionalParams(LONG packetHandle, struct TravelerInformationGeometricProjection_regional value, char oldPath[])
{
  char newPath[300]; 
  int i;
  int result;

  result = 0;

  C2xRemoveToken(packetHandle, "TravelerInformation", oldPath);
  for(i=0; i<value.length; i++)
  {
    snprintf(newPath, elcount(newPath), "%s[%d]", oldPath, i);
    SetTravelerInformationCommon_RegionalExtension_Reg_GeometricProjectionParams(packetHandle, value.arrayValue[i], newPath);
    result = CheckLastError("TravelerInformation", gkFuncRefGet, result);
  }
  return result;
}

int GetTravelerInformationGeometricProjectionParams(LONG packetHandle, struct TravelerInformationGeometricProjection value, char oldPath[])
{
  char newPath[300]; 
  int j; 
  int k;
  int result;

  result = 0;

  snprintf(newPath, elcount(newPath), "%s.%s", oldPath, "direction");
  value.direction.isValidFlag = 1;
  value.direction.stringLength = C2xGetTokenLengthBit(packetHandle, "TravelerInformation", newPath);
  if ((result = CheckLastError("TravelerInformation", gkFuncRefGet, result))==0)
  {
    if(value.direction.stringLength > 0)
    {
      for(j=0; j<value.direction.stringLength; j++)
      {
        if(C2xGetTokenBitOfBitString(packetHandle, "TravelerInformation", newPath, j) == 0)
        {
          value.direction.string[j] = '0';
        }
        else if(C2xGetTokenBitOfBitString(packetHandle, "TravelerInformation", newPath, j) == 1)
        {
          value.direction.string[j] = '1';
        }

        if(value.direction.stringLength == 1)
        {
          value.direction.string[1] = '0';
        }
        result = CheckLastError("TravelerInformation", gkFuncRefGet, result);
      }
    }
    else
    {
      for(k = value.direction.stringLength+1; k > -1; k--)
      {
        if(value.direction.string[k] == '1')
        {
          value.direction.string[k] = '0';
        }
      }
    }
  }

  snprintf(newPath, elcount(newPath), "%s.%s", oldPath, "extent");
  value.extent.isValidFlag = C2xIsTokenAvailable(packetHandle, "TravelerInformation", newPath);
  if(value.extent.isValidFlag==1)
  {
    value.extent.value = C2xGetTokenInt(packetHandle, "TravelerInformation", newPath);
    result = CheckLastError("TravelerInformation", gkFuncRefGet, result);
  }
  snprintf(newPath, elcount(newPath), "%s.%s", oldPath, "laneWidth");
  value.laneWidth.isValidFlag = C2xIsTokenAvailable(packetHandle, "TravelerInformation", newPath);
  if(value.laneWidth.isValidFlag==1)
  {
    value.laneWidth.value = C2xGetTokenInt(packetHandle, "TravelerInformation", newPath);
    result = CheckLastError("TravelerInformation", gkFuncRefGet, result);
  }
  snprintf(newPath, elcount(newPath), "%s.%s", oldPath, "circle");
  GetTravelerInformationCircleParams(packetHandle, value.circle, newPath);
  result = CheckLastError("TravelerInformation", gkFuncRefGet, result);

  snprintf(newPath, elcount(newPath), "%s.%s", oldPath, "regional");
  value.regional.isValidFlag = C2xIsTokenAvailable(packetHandle, "TravelerInformation", newPath);
  if(value.regional.isValidFlag==1)
  {
    GetTravelerInformationGeometricProjection_regionalParams(packetHandle, value.regional, newPath);
    result = CheckLastError("TravelerInformation", gkFuncRefGet, result);
  }
  return result;
}

int SetTravelerInformationGeometricProjectionParams(LONG packetHandle, struct TravelerInformationGeometricProjection value, char oldPath[])
{
  char newPath[300]; 
  int j;
  int result;

  result = 0;

  snprintf(newPath, elcount(newPath), "%s.%s", oldPath, "direction");
    for(j=0; j<value.direction.stringLength; j++)
    {
      if(value.direction.string[j] == '0')
      {
        C2xSetTokenBitOfBitString(packetHandle, "TravelerInformation", newPath, j, 0);
      }
      else
      {
        C2xSetTokenBitOfBitString(packetHandle, "TravelerInformation", newPath, j, 1);
      }
      result = CheckLastError("TravelerInformation", gkFuncRefGet, result);
    }

  snprintf(newPath, elcount(newPath), "%s.%s", oldPath, "extent");
  if(value.extent.isValidFlag==1)
  {
    C2xSetTokenInt(packetHandle, "TravelerInformation", newPath, value.extent.value);
    result = CheckLastError("TravelerInformation", gkFuncRefGet, result);
  }
  else
  {
    if( C2xIsTokenAvailable(packetHandle, "TravelerInformation", newPath) )
    {
      C2xRemoveToken(packetHandle, "TravelerInformation", newPath);
    }
  }

  snprintf(newPath, elcount(newPath), "%s.%s", oldPath, "laneWidth");
  if(value.laneWidth.isValidFlag==1)
  {
    C2xSetTokenInt(packetHandle, "TravelerInformation", newPath, value.laneWidth.value);
    result = CheckLastError("TravelerInformation", gkFuncRefGet, result);
  }
  else
  {
    if( C2xIsTokenAvailable(packetHandle, "TravelerInformation", newPath) )
    {
      C2xRemoveToken(packetHandle, "TravelerInformation", newPath);
    }
  }

  snprintf(newPath, elcount(newPath), "%s.%s", oldPath, "circle");
  SetTravelerInformationCircleParams(packetHandle, value.circle, newPath);
  result = CheckLastError("TravelerInformation", gkFuncRefGet, result);

  snprintf(newPath, elcount(newPath), "%s.%s", oldPath, "regional");
  if(value.regional.isValidFlag==1)
  {
    SetTravelerInformationGeometricProjection_regionalParams(packetHandle, value.regional, newPath);
    result = CheckLastError("TravelerInformation", gkFuncRefGet, result);
  }
  else
  {
    if( C2xIsTokenAvailable(packetHandle, "TravelerInformation", newPath) )
    {
      C2xRemoveToken(packetHandle, "TravelerInformation", newPath);
    }
  }

  return result;
}

int GetTravelerInformationShapePointSetParams(LONG packetHandle, struct TravelerInformationShapePointSet value, char oldPath[])
{
  char newPath[300];
  int result;

  result = 0;

  snprintf(newPath, elcount(newPath), "%s.%s", oldPath, "anchor");
  value.anchor.isValidFlag = C2xIsTokenAvailable(packetHandle, "TravelerInformation", newPath);
  if(value.anchor.isValidFlag==1)
  {
    GetTravelerInformationCommon_Position3DParams(packetHandle, value.anchor, newPath);
    result = CheckLastError("TravelerInformation", gkFuncRefGet, result);
  }
  snprintf(newPath, elcount(newPath), "%s.%s", oldPath, "laneWidth");
  value.laneWidth.isValidFlag = C2xIsTokenAvailable(packetHandle, "TravelerInformation", newPath);
  if(value.laneWidth.isValidFlag==1)
  {
    value.laneWidth.value = C2xGetTokenInt(packetHandle, "TravelerInformation", newPath);
    result = CheckLastError("TravelerInformation", gkFuncRefGet, result);
  }
  snprintf(newPath, elcount(newPath), "%s.%s", oldPath, "directionality");
  value.directionality.isValidFlag = C2xIsTokenAvailable(packetHandle, "TravelerInformation", newPath);
  if(value.directionality.isValidFlag==1)
  {
    value.directionality.value = C2xGetTokenInt(packetHandle, "TravelerInformation", newPath);
    result = CheckLastError("TravelerInformation", gkFuncRefGet, result);
  }
  snprintf(newPath, elcount(newPath), "%s.%s", oldPath, "nodeList");
  GetTravelerInformationCommon_NodeListXYParams(packetHandle, value.nodeList, newPath);
  result = CheckLastError("TravelerInformation", gkFuncRefGet, result);

  return result;
}

int SetTravelerInformationShapePointSetParams(LONG packetHandle, struct TravelerInformationShapePointSet value, char oldPath[])
{
  char newPath[300];
  int result;

  result = 0;

  snprintf(newPath, elcount(newPath), "%s.%s", oldPath, "anchor");
  if(value.anchor.isValidFlag==1)
  {
    SetTravelerInformationCommon_Position3DParams(packetHandle, value.anchor, newPath);
    result = CheckLastError("TravelerInformation", gkFuncRefGet, result);
  }
  else
  {
    if( C2xIsTokenAvailable(packetHandle, "TravelerInformation", newPath) )
    {
      C2xRemoveToken(packetHandle, "TravelerInformation", newPath);
    }
  }

  snprintf(newPath, elcount(newPath), "%s.%s", oldPath, "laneWidth");
  if(value.laneWidth.isValidFlag==1)
  {
    C2xSetTokenInt(packetHandle, "TravelerInformation", newPath, value.laneWidth.value);
    result = CheckLastError("TravelerInformation", gkFuncRefGet, result);
  }
  else
  {
    if( C2xIsTokenAvailable(packetHandle, "TravelerInformation", newPath) )
    {
      C2xRemoveToken(packetHandle, "TravelerInformation", newPath);
    }
  }

  snprintf(newPath, elcount(newPath), "%s.%s", oldPath, "directionality");
  if(value.directionality.isValidFlag==1)
  {
    C2xSetTokenInt(packetHandle, "TravelerInformation", newPath, value.directionality.value);
    result = CheckLastError("TravelerInformation", gkFuncRefGet, result);
  }
  else
  {
    if( C2xIsTokenAvailable(packetHandle, "TravelerInformation", newPath) )
    {
      C2xRemoveToken(packetHandle, "TravelerInformation", newPath);
    }
  }

  snprintf(newPath, elcount(newPath), "%s.%s", oldPath, "nodeList");
  SetTravelerInformationCommon_NodeListXYParams(packetHandle, value.nodeList, newPath);
  result = CheckLastError("TravelerInformation", gkFuncRefGet, result);

  return result;
}

int GetTravelerInformationRegionOffsetsParams(LONG packetHandle, struct TravelerInformationRegionOffsets value, char oldPath[])
{
  char newPath[300];
  int result;

  result = 0;

  snprintf(newPath, elcount(newPath), "%s.%s", oldPath, "xOffset");
  value.xOffset = C2xGetTokenInt(packetHandle, "TravelerInformation", newPath);
  result = CheckLastError("TravelerInformation", gkFuncRefGet, result);

  snprintf(newPath, elcount(newPath), "%s.%s", oldPath, "yOffset");
  value.yOffset = C2xGetTokenInt(packetHandle, "TravelerInformation", newPath);
  result = CheckLastError("TravelerInformation", gkFuncRefGet, result);

  snprintf(newPath, elcount(newPath), "%s.%s", oldPath, "zOffset");
  value.zOffset.isValidFlag = C2xIsTokenAvailable(packetHandle, "TravelerInformation", newPath);
  if(value.zOffset.isValidFlag==1)
  {
    value.zOffset.value = C2xGetTokenInt(packetHandle, "TravelerInformation", newPath);
    result = CheckLastError("TravelerInformation", gkFuncRefGet, result);
  }
  return result;
}

int SetTravelerInformationRegionOffsetsParams(LONG packetHandle, struct TravelerInformationRegionOffsets value, char oldPath[])
{
  char newPath[300];
  int result;

  result = 0;

  snprintf(newPath, elcount(newPath), "%s.%s", oldPath, "xOffset");
  C2xSetTokenInt(packetHandle, "TravelerInformation", newPath, value.xOffset);
  result = CheckLastError("TravelerInformation", gkFuncRefGet, result);

  snprintf(newPath, elcount(newPath), "%s.%s", oldPath, "yOffset");
  C2xSetTokenInt(packetHandle, "TravelerInformation", newPath, value.yOffset);
  result = CheckLastError("TravelerInformation", gkFuncRefGet, result);

  snprintf(newPath, elcount(newPath), "%s.%s", oldPath, "zOffset");
  if(value.zOffset.isValidFlag==1)
  {
    C2xSetTokenInt(packetHandle, "TravelerInformation", newPath, value.zOffset.value);
    result = CheckLastError("TravelerInformation", gkFuncRefGet, result);
  }
  else
  {
    if( C2xIsTokenAvailable(packetHandle, "TravelerInformation", newPath) )
    {
      C2xRemoveToken(packetHandle, "TravelerInformation", newPath);
    }
  }

  return result;
}

int GetTravelerInformationRegionListParams(LONG packetHandle, struct TravelerInformationRegionList value, char oldPath[])
{
  char newPath[300]; 
  int i;
  int result;

  result = 0;

  value.length = C2xGetTokenInt(packetHandle, "TravelerInformation", oldPath);
  if((result = CheckLastError("TravelerInformation", gkFuncRefGet, result))==0)
  {
    for(i=0; i<value.length; i++)
    {
      snprintf(newPath, elcount(newPath), "%s[%d]", oldPath, i);
      GetTravelerInformationRegionOffsetsParams(packetHandle, value.arrayValue[i], newPath);
      result = CheckLastError("TravelerInformation", gkFuncRefGet, result);
    }
  }
  return result;
}

int SetTravelerInformationRegionListParams(LONG packetHandle, struct TravelerInformationRegionList value, char oldPath[])
{
  char newPath[300]; 
  int i;
  int result;

  result = 0;

  C2xRemoveToken(packetHandle, "TravelerInformation", oldPath);
  for(i=0; i<value.length; i++)
  {
    snprintf(newPath, elcount(newPath), "%s[%d]", oldPath, i);
    SetTravelerInformationRegionOffsetsParams(packetHandle, value.arrayValue[i], newPath);
    result = CheckLastError("TravelerInformation", gkFuncRefGet, result);
  }
  return result;
}

int GetTravelerInformationRegionPointSetParams(LONG packetHandle, struct TravelerInformationRegionPointSet value, char oldPath[])
{
  char newPath[300];
  int result;

  result = 0;

  snprintf(newPath, elcount(newPath), "%s.%s", oldPath, "anchor");
  value.anchor.isValidFlag = C2xIsTokenAvailable(packetHandle, "TravelerInformation", newPath);
  if(value.anchor.isValidFlag==1)
  {
    GetTravelerInformationCommon_Position3DParams(packetHandle, value.anchor, newPath);
    result = CheckLastError("TravelerInformation", gkFuncRefGet, result);
  }
  snprintf(newPath, elcount(newPath), "%s.%s", oldPath, "scale");
  value.scale.isValidFlag = C2xIsTokenAvailable(packetHandle, "TravelerInformation", newPath);
  if(value.scale.isValidFlag==1)
  {
    value.scale.value = C2xGetTokenInt(packetHandle, "TravelerInformation", newPath);
    result = CheckLastError("TravelerInformation", gkFuncRefGet, result);
  }
  snprintf(newPath, elcount(newPath), "%s.%s", oldPath, "nodeList");
  GetTravelerInformationRegionListParams(packetHandle, value.nodeList, newPath);
  result = CheckLastError("TravelerInformation", gkFuncRefGet, result);

  return result;
}

int SetTravelerInformationRegionPointSetParams(LONG packetHandle, struct TravelerInformationRegionPointSet value, char oldPath[])
{
  char newPath[300];
  int result;

  result = 0;

  snprintf(newPath, elcount(newPath), "%s.%s", oldPath, "anchor");
  if(value.anchor.isValidFlag==1)
  {
    SetTravelerInformationCommon_Position3DParams(packetHandle, value.anchor, newPath);
    result = CheckLastError("TravelerInformation", gkFuncRefGet, result);
  }
  else
  {
    if( C2xIsTokenAvailable(packetHandle, "TravelerInformation", newPath) )
    {
      C2xRemoveToken(packetHandle, "TravelerInformation", newPath);
    }
  }

  snprintf(newPath, elcount(newPath), "%s.%s", oldPath, "scale");
  if(value.scale.isValidFlag==1)
  {
    C2xSetTokenInt(packetHandle, "TravelerInformation", newPath, value.scale.value);
    result = CheckLastError("TravelerInformation", gkFuncRefGet, result);
  }
  else
  {
    if( C2xIsTokenAvailable(packetHandle, "TravelerInformation", newPath) )
    {
      C2xRemoveToken(packetHandle, "TravelerInformation", newPath);
    }
  }

  snprintf(newPath, elcount(newPath), "%s.%s", oldPath, "nodeList");
  SetTravelerInformationRegionListParams(packetHandle, value.nodeList, newPath);
  result = CheckLastError("TravelerInformation", gkFuncRefGet, result);

  return result;
}

int GetTravelerInformationValidRegion_areaParams(LONG packetHandle, struct TravelerInformationValidRegion_area value, char oldPath[])
{
  char newPath[300];
  int result;

  result = 0;

  value.choice = C2xGetTokenInt(packetHandle, "TravelerInformation", oldPath);

  switch(value.choice)
  {
    case 0:
    {
      snprintf(newPath, elcount(newPath), "%s.%s", oldPath, "shapePointSet");
      GetTravelerInformationShapePointSetParams(packetHandle, value.shapePointSet, newPath);
      result = CheckLastError("TravelerInformation", gkFuncRefGet, result);
    }
    break;
    case 1:
    {
      snprintf(newPath, elcount(newPath), "%s.%s", oldPath, "circle");
      GetTravelerInformationCircleParams(packetHandle, value.circle, newPath);
      result = CheckLastError("TravelerInformation", gkFuncRefGet, result);
    }
    break;
    case 2:
    {
      snprintf(newPath, elcount(newPath), "%s.%s", oldPath, "regionPointSet");
      GetTravelerInformationRegionPointSetParams(packetHandle, value.regionPointSet, newPath);
      result = CheckLastError("TravelerInformation", gkFuncRefGet, result);
    }
    break;
  }
  return result;
}

int SetTravelerInformationValidRegion_areaParams(LONG packetHandle, struct TravelerInformationValidRegion_area value, char oldPath[])
{
  char newPath[300];
  int result;

  result = 0;

  switch(value.choice)
  {
    case 0:
    {
      snprintf(newPath, elcount(newPath), "%s.%s", oldPath, "shapePointSet");
      SetTravelerInformationShapePointSetParams(packetHandle, value.shapePointSet, newPath);
      result = CheckLastError("TravelerInformation", gkFuncRefGet, result);
    }
    break;
    case 1:
    {
      snprintf(newPath, elcount(newPath), "%s.%s", oldPath, "circle");
      SetTravelerInformationCircleParams(packetHandle, value.circle, newPath);
      result = CheckLastError("TravelerInformation", gkFuncRefGet, result);
    }
    break;
    case 2:
    {
      snprintf(newPath, elcount(newPath), "%s.%s", oldPath, "regionPointSet");
      SetTravelerInformationRegionPointSetParams(packetHandle, value.regionPointSet, newPath);
      result = CheckLastError("TravelerInformation", gkFuncRefGet, result);
    }
    break;
  }
  return result;
}

int GetTravelerInformationValidRegionParams(LONG packetHandle, struct TravelerInformationValidRegion value, char oldPath[])
{
  char newPath[300]; 
  int j; 
  int k;
  int result;

  result = 0;

  snprintf(newPath, elcount(newPath), "%s.%s", oldPath, "direction");
  value.direction.isValidFlag = 1;
  value.direction.stringLength = C2xGetTokenLengthBit(packetHandle, "TravelerInformation", newPath);
  if ((result = CheckLastError("TravelerInformation", gkFuncRefGet, result))==0)
  {
    if(value.direction.stringLength > 0)
    {
      for(j=0; j<value.direction.stringLength; j++)
      {
        if(C2xGetTokenBitOfBitString(packetHandle, "TravelerInformation", newPath, j) == 0)
        {
          value.direction.string[j] = '0';
        }
        else if(C2xGetTokenBitOfBitString(packetHandle, "TravelerInformation", newPath, j) == 1)
        {
          value.direction.string[j] = '1';
        }

        if(value.direction.stringLength == 1)
        {
          value.direction.string[1] = '0';
        }
        result = CheckLastError("TravelerInformation", gkFuncRefGet, result);
      }
    }
    else
    {
      for(k = value.direction.stringLength+1; k > -1; k--)
      {
        if(value.direction.string[k] == '1')
        {
          value.direction.string[k] = '0';
        }
      }
    }
  }

  snprintf(newPath, elcount(newPath), "%s.%s", oldPath, "extent");
  value.extent.isValidFlag = C2xIsTokenAvailable(packetHandle, "TravelerInformation", newPath);
  if(value.extent.isValidFlag==1)
  {
    value.extent.value = C2xGetTokenInt(packetHandle, "TravelerInformation", newPath);
    result = CheckLastError("TravelerInformation", gkFuncRefGet, result);
  }
  snprintf(newPath, elcount(newPath), "%s.%s", oldPath, "area");
  GetTravelerInformationValidRegion_areaParams(packetHandle, value.area, newPath);
  result = CheckLastError("TravelerInformation", gkFuncRefGet, result);

  return result;
}

int SetTravelerInformationValidRegionParams(LONG packetHandle, struct TravelerInformationValidRegion value, char oldPath[])
{
  char newPath[300]; 
  int j;
  int result;

  result = 0;

  snprintf(newPath, elcount(newPath), "%s.%s", oldPath, "direction");
    for(j=0; j<value.direction.stringLength; j++)
    {
      if(value.direction.string[j] == '0')
      {
        C2xSetTokenBitOfBitString(packetHandle, "TravelerInformation", newPath, j, 0);
      }
      else
      {
        C2xSetTokenBitOfBitString(packetHandle, "TravelerInformation", newPath, j, 1);
      }
      result = CheckLastError("TravelerInformation", gkFuncRefGet, result);
    }

  snprintf(newPath, elcount(newPath), "%s.%s", oldPath, "extent");
  if(value.extent.isValidFlag==1)
  {
    C2xSetTokenInt(packetHandle, "TravelerInformation", newPath, value.extent.value);
    result = CheckLastError("TravelerInformation", gkFuncRefGet, result);
  }
  else
  {
    if( C2xIsTokenAvailable(packetHandle, "TravelerInformation", newPath) )
    {
      C2xRemoveToken(packetHandle, "TravelerInformation", newPath);
    }
  }

  snprintf(newPath, elcount(newPath), "%s.%s", oldPath, "area");
  SetTravelerInformationValidRegion_areaParams(packetHandle, value.area, newPath);
  result = CheckLastError("TravelerInformation", gkFuncRefGet, result);

  return result;
}

int GetTravelerInformationGeographicalPath_descriptionParams(LONG packetHandle, struct TravelerInformationGeographicalPath_description value, char oldPath[])
{
  char newPath[300];
  int result;

  result = 0;

  value.choice = C2xGetTokenInt(packetHandle, "TravelerInformation", oldPath);

  switch(value.choice)
  {
    case 0:
    {
      snprintf(newPath, elcount(newPath), "%s.%s", oldPath, "path");
      GetTravelerInformationOffsetSystemParams(packetHandle, value.path, newPath);
      result = CheckLastError("TravelerInformation", gkFuncRefGet, result);
    }
    break;
    case 1:
    {
      snprintf(newPath, elcount(newPath), "%s.%s", oldPath, "geometry");
      GetTravelerInformationGeometricProjectionParams(packetHandle, value.geometry, newPath);
      result = CheckLastError("TravelerInformation", gkFuncRefGet, result);
    }
    break;
    case 2:
    {
      snprintf(newPath, elcount(newPath), "%s.%s", oldPath, "oldRegion");
      GetTravelerInformationValidRegionParams(packetHandle, value.oldRegion, newPath);
      result = CheckLastError("TravelerInformation", gkFuncRefGet, result);
    }
    break;
  }
  return result;
}

int SetTravelerInformationGeographicalPath_descriptionParams(LONG packetHandle, struct TravelerInformationGeographicalPath_description value, char oldPath[])
{
  char newPath[300];
  int result;

  result = 0;

  switch(value.choice)
  {
    case 0:
    {
      snprintf(newPath, elcount(newPath), "%s.%s", oldPath, "path");
      SetTravelerInformationOffsetSystemParams(packetHandle, value.path, newPath);
      result = CheckLastError("TravelerInformation", gkFuncRefGet, result);
    }
    break;
    case 1:
    {
      snprintf(newPath, elcount(newPath), "%s.%s", oldPath, "geometry");
      SetTravelerInformationGeometricProjectionParams(packetHandle, value.geometry, newPath);
      result = CheckLastError("TravelerInformation", gkFuncRefGet, result);
    }
    break;
    case 2:
    {
      snprintf(newPath, elcount(newPath), "%s.%s", oldPath, "oldRegion");
      SetTravelerInformationValidRegionParams(packetHandle, value.oldRegion, newPath);
      result = CheckLastError("TravelerInformation", gkFuncRefGet, result);
    }
    break;
  }
  return result;
}

int GetTravelerInformationCommon_RegionalExtension_Reg_GeographicalPathParams(LONG packetHandle, struct TravelerInformationCommon_RegionalExtension_Reg_GeographicalPath value, char oldPath[])
{
  char newPath[300];
  int result;

  result = 0;

  snprintf(newPath, elcount(newPath), "%s.%s", oldPath, "regionId");
  value.regionId = C2xGetTokenInt(packetHandle, "TravelerInformation", newPath);
  result = CheckLastError("TravelerInformation", gkFuncRefGet, result);

  return result;
}

int SetTravelerInformationCommon_RegionalExtension_Reg_GeographicalPathParams(LONG packetHandle, struct TravelerInformationCommon_RegionalExtension_Reg_GeographicalPath value, char oldPath[])
{
  char newPath[300];
  int result;

  result = 0;


  return result;
}

int GetTravelerInformationGeographicalPath_regionalParams(LONG packetHandle, struct TravelerInformationGeographicalPath_regional value, char oldPath[])
{
  char newPath[300]; 
  int i;
  int result;

  result = 0;

  value.length = C2xGetTokenInt(packetHandle, "TravelerInformation", oldPath);
  if((result = CheckLastError("TravelerInformation", gkFuncRefGet, result))==0)
  {
    for(i=0; i<value.length; i++)
    {
      snprintf(newPath, elcount(newPath), "%s[%d]", oldPath, i);
      GetTravelerInformationCommon_RegionalExtension_Reg_GeographicalPathParams(packetHandle, value.arrayValue[i], newPath);
      result = CheckLastError("TravelerInformation", gkFuncRefGet, result);
    }
  }
  return result;
}

int SetTravelerInformationGeographicalPath_regionalParams(LONG packetHandle, struct TravelerInformationGeographicalPath_regional value, char oldPath[])
{
  char newPath[300]; 
  int i;
  int result;

  result = 0;

  C2xRemoveToken(packetHandle, "TravelerInformation", oldPath);
  for(i=0; i<value.length; i++)
  {
    snprintf(newPath, elcount(newPath), "%s[%d]", oldPath, i);
    SetTravelerInformationCommon_RegionalExtension_Reg_GeographicalPathParams(packetHandle, value.arrayValue[i], newPath);
    result = CheckLastError("TravelerInformation", gkFuncRefGet, result);
  }
  return result;
}

int GetTravelerInformationGeographicalPathParams(LONG packetHandle, struct TravelerInformationGeographicalPath value, char oldPath[])
{
  char newPath[300]; 
  int j; 
  int k;
  int result;

  result = 0;

  snprintf(newPath, elcount(newPath), "%s.%s", oldPath, "name");
  value.name.isValidFlag = C2xIsTokenAvailable(packetHandle, "TravelerInformation", newPath);
  if(value.name.isValidFlag==1)
  {
    value.name.stringLength = C2xGetTokenData(packetHandle, "TravelerInformation", newPath, elcount(value.name.string), value.name.string);
    result = CheckLastError("TravelerInformation", gkFuncRefGet, result);
  }
  snprintf(newPath, elcount(newPath), "%s.%s", oldPath, "id");
  value.id.isValidFlag = C2xIsTokenAvailable(packetHandle, "TravelerInformation", newPath);
  if(value.id.isValidFlag==1)
  {
    GetTravelerInformationCommon_RoadSegmentReferenceIDParams(packetHandle, value.id, newPath);
    result = CheckLastError("TravelerInformation", gkFuncRefGet, result);
  }
  snprintf(newPath, elcount(newPath), "%s.%s", oldPath, "anchor");
  value.anchor.isValidFlag = C2xIsTokenAvailable(packetHandle, "TravelerInformation", newPath);
  if(value.anchor.isValidFlag==1)
  {
    GetTravelerInformationCommon_Position3DParams(packetHandle, value.anchor, newPath);
    result = CheckLastError("TravelerInformation", gkFuncRefGet, result);
  }
  snprintf(newPath, elcount(newPath), "%s.%s", oldPath, "laneWidth");
  value.laneWidth.isValidFlag = C2xIsTokenAvailable(packetHandle, "TravelerInformation", newPath);
  if(value.laneWidth.isValidFlag==1)
  {
    value.laneWidth.value = C2xGetTokenInt(packetHandle, "TravelerInformation", newPath);
    result = CheckLastError("TravelerInformation", gkFuncRefGet, result);
  }
  snprintf(newPath, elcount(newPath), "%s.%s", oldPath, "directionality");
  value.directionality.isValidFlag = C2xIsTokenAvailable(packetHandle, "TravelerInformation", newPath);
  if(value.directionality.isValidFlag==1)
  {
    value.directionality.value = C2xGetTokenInt(packetHandle, "TravelerInformation", newPath);
    result = CheckLastError("TravelerInformation", gkFuncRefGet, result);
  }
  snprintf(newPath, elcount(newPath), "%s.%s", oldPath, "closedPath");
  value.closedPath.isValidFlag = C2xIsTokenAvailable(packetHandle, "TravelerInformation", newPath);
  if(value.closedPath.isValidFlag==1)
  {
    value.closedPath.value = C2xGetTokenInt64(packetHandle, "TravelerInformation", newPath);
    result = CheckLastError("TravelerInformation", gkFuncRefGet, result);
  }
  snprintf(newPath, elcount(newPath), "%s.%s", oldPath, "direction");
  value.direction.isValidFlag = C2xIsTokenAvailable(packetHandle, "TravelerInformation", newPath);
  if(value.direction.isValidFlag==1)
  {
    value.direction.isValidFlag = 1;
    value.direction.stringLength = C2xGetTokenLengthBit(packetHandle, "TravelerInformation", newPath);
    if ((result = CheckLastError("TravelerInformation", gkFuncRefGet, result))==0)
    {
      if(value.direction.stringLength > 0)
      {
        for(j=0; j<value.direction.stringLength; j++)
        {
          if(C2xGetTokenBitOfBitString(packetHandle, "TravelerInformation", newPath, j) == 0)
          {
            value.direction.string[j] = '0';
          }
          else if(C2xGetTokenBitOfBitString(packetHandle, "TravelerInformation", newPath, j) == 1)
          {
            value.direction.string[j] = '1';
          }

          if(value.direction.stringLength == 1)
          {
            value.direction.string[1] = '0';
          }
          result = CheckLastError("TravelerInformation", gkFuncRefGet, result);
        }
      }
      else
      {
        for(k = value.direction.stringLength+1; k > -1; k--)
        {
          if(value.direction.string[k] == '1')
          {
            value.direction.string[k] = '0';
          }
        }
      }
    }

  }
  snprintf(newPath, elcount(newPath), "%s.%s", oldPath, "description");
  value.description.isValidFlag = C2xIsTokenAvailable(packetHandle, "TravelerInformation", newPath);
  if(value.description.isValidFlag==1)
  {
    GetTravelerInformationGeographicalPath_descriptionParams(packetHandle, value.description, newPath);
    result = CheckLastError("TravelerInformation", gkFuncRefGet, result);
  }
  snprintf(newPath, elcount(newPath), "%s.%s", oldPath, "regional");
  value.regional.isValidFlag = C2xIsTokenAvailable(packetHandle, "TravelerInformation", newPath);
  if(value.regional.isValidFlag==1)
  {
    GetTravelerInformationGeographicalPath_regionalParams(packetHandle, value.regional, newPath);
    result = CheckLastError("TravelerInformation", gkFuncRefGet, result);
  }
  return result;
}

int SetTravelerInformationGeographicalPathParams(LONG packetHandle, struct TravelerInformationGeographicalPath value, char oldPath[])
{
  char newPath[300]; 
  int j;
  int result;

  result = 0;

  snprintf(newPath, elcount(newPath), "%s.%s", oldPath, "name");
  if(value.name.isValidFlag==1)
  {
    C2xSetTokenData(packetHandle, "TravelerInformation", newPath, value.name.stringLength, value.name.string);
    result = CheckLastError("TravelerInformation", gkFuncRefGet, result);
  }
  else
  {
    if( C2xIsTokenAvailable(packetHandle, "TravelerInformation", newPath) )
    {
      C2xRemoveToken(packetHandle, "TravelerInformation", newPath);
    }
  }

  snprintf(newPath, elcount(newPath), "%s.%s", oldPath, "id");
  if(value.id.isValidFlag==1)
  {
    SetTravelerInformationCommon_RoadSegmentReferenceIDParams(packetHandle, value.id, newPath);
    result = CheckLastError("TravelerInformation", gkFuncRefGet, result);
  }
  else
  {
    if( C2xIsTokenAvailable(packetHandle, "TravelerInformation", newPath) )
    {
      C2xRemoveToken(packetHandle, "TravelerInformation", newPath);
    }
  }

  snprintf(newPath, elcount(newPath), "%s.%s", oldPath, "anchor");
  if(value.anchor.isValidFlag==1)
  {
    SetTravelerInformationCommon_Position3DParams(packetHandle, value.anchor, newPath);
    result = CheckLastError("TravelerInformation", gkFuncRefGet, result);
  }
  else
  {
    if( C2xIsTokenAvailable(packetHandle, "TravelerInformation", newPath) )
    {
      C2xRemoveToken(packetHandle, "TravelerInformation", newPath);
    }
  }

  snprintf(newPath, elcount(newPath), "%s.%s", oldPath, "laneWidth");
  if(value.laneWidth.isValidFlag==1)
  {
    C2xSetTokenInt(packetHandle, "TravelerInformation", newPath, value.laneWidth.value);
    result = CheckLastError("TravelerInformation", gkFuncRefGet, result);
  }
  else
  {
    if( C2xIsTokenAvailable(packetHandle, "TravelerInformation", newPath) )
    {
      C2xRemoveToken(packetHandle, "TravelerInformation", newPath);
    }
  }

  snprintf(newPath, elcount(newPath), "%s.%s", oldPath, "directionality");
  if(value.directionality.isValidFlag==1)
  {
    C2xSetTokenInt(packetHandle, "TravelerInformation", newPath, value.directionality.value);
    result = CheckLastError("TravelerInformation", gkFuncRefGet, result);
  }
  else
  {
    if( C2xIsTokenAvailable(packetHandle, "TravelerInformation", newPath) )
    {
      C2xRemoveToken(packetHandle, "TravelerInformation", newPath);
    }
  }

  snprintf(newPath, elcount(newPath), "%s.%s", oldPath, "closedPath");
  if(value.closedPath.isValidFlag==1)
  {
    C2xSetTokenInt64(packetHandle, "TravelerInformation", newPath, value.closedPath.value);
    result = CheckLastError("TravelerInformation", gkFuncRefGet, result);
  }
  else
  {
    if( C2xIsTokenAvailable(packetHandle, "TravelerInformation", newPath) )
    {
      C2xRemoveToken(packetHandle, "TravelerInformation", newPath);
    }
  }

  snprintf(newPath, elcount(newPath), "%s.%s", oldPath, "direction");
  if(value.direction.isValidFlag==1)
  {
      for(j=0; j<value.direction.stringLength; j++)
      {
        if(value.direction.string[j] == '0')
        {
          C2xSetTokenBitOfBitString(packetHandle, "TravelerInformation", newPath, j, 0);
        }
        else
        {
          C2xSetTokenBitOfBitString(packetHandle, "TravelerInformation", newPath, j, 1);
        }
        result = CheckLastError("TravelerInformation", gkFuncRefGet, result);
      }
  }
  else
  {
    if( C2xIsTokenAvailable(packetHandle, "TravelerInformation", newPath) )
    {
      C2xRemoveToken(packetHandle, "TravelerInformation", newPath);
    }
  }

  snprintf(newPath, elcount(newPath), "%s.%s", oldPath, "description");
  if(value.description.isValidFlag==1)
  {
    SetTravelerInformationGeographicalPath_descriptionParams(packetHandle, value.description, newPath);
    result = CheckLastError("TravelerInformation", gkFuncRefGet, result);
  }
  else
  {
    if( C2xIsTokenAvailable(packetHandle, "TravelerInformation", newPath) )
    {
      C2xRemoveToken(packetHandle, "TravelerInformation", newPath);
    }
  }

  snprintf(newPath, elcount(newPath), "%s.%s", oldPath, "regional");
  if(value.regional.isValidFlag==1)
  {
    SetTravelerInformationGeographicalPath_regionalParams(packetHandle, value.regional, newPath);
    result = CheckLastError("TravelerInformation", gkFuncRefGet, result);
  }
  else
  {
    if( C2xIsTokenAvailable(packetHandle, "TravelerInformation", newPath) )
    {
      C2xRemoveToken(packetHandle, "TravelerInformation", newPath);
    }
  }

  return result;
}

int GetTravelerInformationTravelerDataFrame_regionsParams(LONG packetHandle, struct TravelerInformationTravelerDataFrame_regions value, char oldPath[])
{
  char newPath[300]; 
  int i;
  int result;

  result = 0;

  value.length = C2xGetTokenInt(packetHandle, "TravelerInformation", oldPath);
  if((result = CheckLastError("TravelerInformation", gkFuncRefGet, result))==0)
  {
    for(i=0; i<value.length; i++)
    {
      snprintf(newPath, elcount(newPath), "%s[%d]", oldPath, i);
      GetTravelerInformationGeographicalPathParams(packetHandle, value.arrayValue[i], newPath);
      result = CheckLastError("TravelerInformation", gkFuncRefGet, result);
    }
  }
  return result;
}

int SetTravelerInformationTravelerDataFrame_regionsParams(LONG packetHandle, struct TravelerInformationTravelerDataFrame_regions value, char oldPath[])
{
  char newPath[300]; 
  int i;
  int result;

  result = 0;

  C2xRemoveToken(packetHandle, "TravelerInformation", oldPath);
  for(i=0; i<value.length; i++)
  {
    snprintf(newPath, elcount(newPath), "%s[%d]", oldPath, i);
    SetTravelerInformationGeographicalPathParams(packetHandle, value.arrayValue[i], newPath);
    result = CheckLastError("TravelerInformation", gkFuncRefGet, result);
  }
  return result;
}

int GetTravelerInformationITIS_ITIScodesAndText__itemParams(LONG packetHandle, struct TravelerInformationITIS_ITIScodesAndText__item value, char oldPath[])
{
  char newPath[300];
  int result;

  result = 0;

  value.choice = C2xGetTokenInt(packetHandle, "TravelerInformation", oldPath);

  switch(value.choice)
  {
    case 0:
    {
      snprintf(newPath, elcount(newPath), "%s.%s", oldPath, "itis");
      value.itis = C2xGetTokenInt(packetHandle, "TravelerInformation", newPath);
      result = CheckLastError("TravelerInformation", gkFuncRefGet, result);
    }
    break;
    case 1:
    {
      snprintf(newPath, elcount(newPath), "%s.%s", oldPath, "text");
      value.text.stringLength = C2xGetTokenData(packetHandle, "TravelerInformation", newPath, elcount(value.text.string), value.text.string);
      result = CheckLastError("TravelerInformation", gkFuncRefGet, result);
    }
    break;
  }
  return result;
}

int SetTravelerInformationITIS_ITIScodesAndText__itemParams(LONG packetHandle, struct TravelerInformationITIS_ITIScodesAndText__item value, char oldPath[])
{
  char newPath[300];
  int result;

  result = 0;

  switch(value.choice)
  {
    case 0:
    {
      snprintf(newPath, elcount(newPath), "%s.%s", oldPath, "itis");
      C2xSetTokenInt(packetHandle, "TravelerInformation", newPath, value.itis);
      result = CheckLastError("TravelerInformation", gkFuncRefGet, result);
    }
    break;
    case 1:
    {
      snprintf(newPath, elcount(newPath), "%s.%s", oldPath, "text");
      C2xSetTokenData(packetHandle, "TravelerInformation", newPath, value.text.stringLength, value.text.string);
      result = CheckLastError("TravelerInformation", gkFuncRefGet, result);
    }
    break;
  }
  return result;
}

int GetTravelerInformationITIS_ITIScodesAndText_Params(LONG packetHandle, struct TravelerInformationITIS_ITIScodesAndText_ value, char oldPath[])
{
  char newPath[300];
  int result;

  result = 0;

  snprintf(newPath, elcount(newPath), "%s.%s", oldPath, "item");
  GetTravelerInformationITIS_ITIScodesAndText__itemParams(packetHandle, value.item, newPath);
  result = CheckLastError("TravelerInformation", gkFuncRefGet, result);

  return result;
}

int SetTravelerInformationITIS_ITIScodesAndText_Params(LONG packetHandle, struct TravelerInformationITIS_ITIScodesAndText_ value, char oldPath[])
{
  char newPath[300];
  int result;

  result = 0;

  snprintf(newPath, elcount(newPath), "%s.%s", oldPath, "item");
  SetTravelerInformationITIS_ITIScodesAndText__itemParams(packetHandle, value.item, newPath);
  result = CheckLastError("TravelerInformation", gkFuncRefGet, result);

  return result;
}

int GetTravelerInformationITIS_ITIScodesAndTextParams(LONG packetHandle, struct TravelerInformationITIS_ITIScodesAndText value, char oldPath[])
{
  char newPath[300]; 
  int i;
  int result;

  result = 0;

  value.length = C2xGetTokenInt(packetHandle, "TravelerInformation", oldPath);
  if((result = CheckLastError("TravelerInformation", gkFuncRefGet, result))==0)
  {
    for(i=0; i<value.length; i++)
    {
      snprintf(newPath, elcount(newPath), "%s[%d]", oldPath, i);
      GetTravelerInformationITIS_ITIScodesAndText_Params(packetHandle, value.arrayValue[i], newPath);
      result = CheckLastError("TravelerInformation", gkFuncRefGet, result);
    }
  }
  return result;
}

int SetTravelerInformationITIS_ITIScodesAndTextParams(LONG packetHandle, struct TravelerInformationITIS_ITIScodesAndText value, char oldPath[])
{
  char newPath[300]; 
  int i;
  int result;

  result = 0;

  C2xRemoveToken(packetHandle, "TravelerInformation", oldPath);
  for(i=0; i<value.length; i++)
  {
    snprintf(newPath, elcount(newPath), "%s[%d]", oldPath, i);
    SetTravelerInformationITIS_ITIScodesAndText_Params(packetHandle, value.arrayValue[i], newPath);
    result = CheckLastError("TravelerInformation", gkFuncRefGet, result);
  }
  return result;
}

int GetTravelerInformationWorkZone__itemParams(LONG packetHandle, struct TravelerInformationWorkZone__item value, char oldPath[])
{
  char newPath[300];
  int result;

  result = 0;

  value.choice = C2xGetTokenInt(packetHandle, "TravelerInformation", oldPath);

  switch(value.choice)
  {
    case 0:
    {
      snprintf(newPath, elcount(newPath), "%s.%s", oldPath, "itis");
      value.itis = C2xGetTokenInt(packetHandle, "TravelerInformation", newPath);
      result = CheckLastError("TravelerInformation", gkFuncRefGet, result);
    }
    break;
    case 1:
    {
      snprintf(newPath, elcount(newPath), "%s.%s", oldPath, "text");
      value.text.stringLength = C2xGetTokenData(packetHandle, "TravelerInformation", newPath, elcount(value.text.string), value.text.string);
      result = CheckLastError("TravelerInformation", gkFuncRefGet, result);
    }
    break;
  }
  return result;
}

int SetTravelerInformationWorkZone__itemParams(LONG packetHandle, struct TravelerInformationWorkZone__item value, char oldPath[])
{
  char newPath[300];
  int result;

  result = 0;

  switch(value.choice)
  {
    case 0:
    {
      snprintf(newPath, elcount(newPath), "%s.%s", oldPath, "itis");
      C2xSetTokenInt(packetHandle, "TravelerInformation", newPath, value.itis);
      result = CheckLastError("TravelerInformation", gkFuncRefGet, result);
    }
    break;
    case 1:
    {
      snprintf(newPath, elcount(newPath), "%s.%s", oldPath, "text");
      C2xSetTokenData(packetHandle, "TravelerInformation", newPath, value.text.stringLength, value.text.string);
      result = CheckLastError("TravelerInformation", gkFuncRefGet, result);
    }
    break;
  }
  return result;
}

int GetTravelerInformationWorkZone_Params(LONG packetHandle, struct TravelerInformationWorkZone_ value, char oldPath[])
{
  char newPath[300];
  int result;

  result = 0;

  snprintf(newPath, elcount(newPath), "%s.%s", oldPath, "item");
  GetTravelerInformationWorkZone__itemParams(packetHandle, value.item, newPath);
  result = CheckLastError("TravelerInformation", gkFuncRefGet, result);

  return result;
}

int SetTravelerInformationWorkZone_Params(LONG packetHandle, struct TravelerInformationWorkZone_ value, char oldPath[])
{
  char newPath[300];
  int result;

  result = 0;

  snprintf(newPath, elcount(newPath), "%s.%s", oldPath, "item");
  SetTravelerInformationWorkZone__itemParams(packetHandle, value.item, newPath);
  result = CheckLastError("TravelerInformation", gkFuncRefGet, result);

  return result;
}

int GetTravelerInformationWorkZoneParams(LONG packetHandle, struct TravelerInformationWorkZone value, char oldPath[])
{
  char newPath[300]; 
  int i;
  int result;

  result = 0;

  value.length = C2xGetTokenInt(packetHandle, "TravelerInformation", oldPath);
  if((result = CheckLastError("TravelerInformation", gkFuncRefGet, result))==0)
  {
    for(i=0; i<value.length; i++)
    {
      snprintf(newPath, elcount(newPath), "%s[%d]", oldPath, i);
      GetTravelerInformationWorkZone_Params(packetHandle, value.arrayValue[i], newPath);
      result = CheckLastError("TravelerInformation", gkFuncRefGet, result);
    }
  }
  return result;
}

int SetTravelerInformationWorkZoneParams(LONG packetHandle, struct TravelerInformationWorkZone value, char oldPath[])
{
  char newPath[300]; 
  int i;
  int result;

  result = 0;

  C2xRemoveToken(packetHandle, "TravelerInformation", oldPath);
  for(i=0; i<value.length; i++)
  {
    snprintf(newPath, elcount(newPath), "%s[%d]", oldPath, i);
    SetTravelerInformationWorkZone_Params(packetHandle, value.arrayValue[i], newPath);
    result = CheckLastError("TravelerInformation", gkFuncRefGet, result);
  }
  return result;
}

int GetTravelerInformationGenericSignage__itemParams(LONG packetHandle, struct TravelerInformationGenericSignage__item value, char oldPath[])
{
  char newPath[300];
  int result;

  result = 0;

  value.choice = C2xGetTokenInt(packetHandle, "TravelerInformation", oldPath);

  switch(value.choice)
  {
    case 0:
    {
      snprintf(newPath, elcount(newPath), "%s.%s", oldPath, "itis");
      value.itis = C2xGetTokenInt(packetHandle, "TravelerInformation", newPath);
      result = CheckLastError("TravelerInformation", gkFuncRefGet, result);
    }
    break;
    case 1:
    {
      snprintf(newPath, elcount(newPath), "%s.%s", oldPath, "text");
      value.text.stringLength = C2xGetTokenData(packetHandle, "TravelerInformation", newPath, elcount(value.text.string), value.text.string);
      result = CheckLastError("TravelerInformation", gkFuncRefGet, result);
    }
    break;
  }
  return result;
}

int SetTravelerInformationGenericSignage__itemParams(LONG packetHandle, struct TravelerInformationGenericSignage__item value, char oldPath[])
{
  char newPath[300];
  int result;

  result = 0;

  switch(value.choice)
  {
    case 0:
    {
      snprintf(newPath, elcount(newPath), "%s.%s", oldPath, "itis");
      C2xSetTokenInt(packetHandle, "TravelerInformation", newPath, value.itis);
      result = CheckLastError("TravelerInformation", gkFuncRefGet, result);
    }
    break;
    case 1:
    {
      snprintf(newPath, elcount(newPath), "%s.%s", oldPath, "text");
      C2xSetTokenData(packetHandle, "TravelerInformation", newPath, value.text.stringLength, value.text.string);
      result = CheckLastError("TravelerInformation", gkFuncRefGet, result);
    }
    break;
  }
  return result;
}

int GetTravelerInformationGenericSignage_Params(LONG packetHandle, struct TravelerInformationGenericSignage_ value, char oldPath[])
{
  char newPath[300];
  int result;

  result = 0;

  snprintf(newPath, elcount(newPath), "%s.%s", oldPath, "item");
  GetTravelerInformationGenericSignage__itemParams(packetHandle, value.item, newPath);
  result = CheckLastError("TravelerInformation", gkFuncRefGet, result);

  return result;
}

int SetTravelerInformationGenericSignage_Params(LONG packetHandle, struct TravelerInformationGenericSignage_ value, char oldPath[])
{
  char newPath[300];
  int result;

  result = 0;

  snprintf(newPath, elcount(newPath), "%s.%s", oldPath, "item");
  SetTravelerInformationGenericSignage__itemParams(packetHandle, value.item, newPath);
  result = CheckLastError("TravelerInformation", gkFuncRefGet, result);

  return result;
}

int GetTravelerInformationGenericSignageParams(LONG packetHandle, struct TravelerInformationGenericSignage value, char oldPath[])
{
  char newPath[300]; 
  int i;
  int result;

  result = 0;

  value.length = C2xGetTokenInt(packetHandle, "TravelerInformation", oldPath);
  if((result = CheckLastError("TravelerInformation", gkFuncRefGet, result))==0)
  {
    for(i=0; i<value.length; i++)
    {
      snprintf(newPath, elcount(newPath), "%s[%d]", oldPath, i);
      GetTravelerInformationGenericSignage_Params(packetHandle, value.arrayValue[i], newPath);
      result = CheckLastError("TravelerInformation", gkFuncRefGet, result);
    }
  }
  return result;
}

int SetTravelerInformationGenericSignageParams(LONG packetHandle, struct TravelerInformationGenericSignage value, char oldPath[])
{
  char newPath[300]; 
  int i;
  int result;

  result = 0;

  C2xRemoveToken(packetHandle, "TravelerInformation", oldPath);
  for(i=0; i<value.length; i++)
  {
    snprintf(newPath, elcount(newPath), "%s[%d]", oldPath, i);
    SetTravelerInformationGenericSignage_Params(packetHandle, value.arrayValue[i], newPath);
    result = CheckLastError("TravelerInformation", gkFuncRefGet, result);
  }
  return result;
}

int GetTravelerInformationSpeedLimit__itemParams(LONG packetHandle, struct TravelerInformationSpeedLimit__item value, char oldPath[])
{
  char newPath[300];
  int result;

  result = 0;

  value.choice = C2xGetTokenInt(packetHandle, "TravelerInformation", oldPath);

  switch(value.choice)
  {
    case 0:
    {
      snprintf(newPath, elcount(newPath), "%s.%s", oldPath, "itis");
      value.itis = C2xGetTokenInt(packetHandle, "TravelerInformation", newPath);
      result = CheckLastError("TravelerInformation", gkFuncRefGet, result);
    }
    break;
    case 1:
    {
      snprintf(newPath, elcount(newPath), "%s.%s", oldPath, "text");
      value.text.stringLength = C2xGetTokenData(packetHandle, "TravelerInformation", newPath, elcount(value.text.string), value.text.string);
      result = CheckLastError("TravelerInformation", gkFuncRefGet, result);
    }
    break;
  }
  return result;
}

int SetTravelerInformationSpeedLimit__itemParams(LONG packetHandle, struct TravelerInformationSpeedLimit__item value, char oldPath[])
{
  char newPath[300];
  int result;

  result = 0;

  switch(value.choice)
  {
    case 0:
    {
      snprintf(newPath, elcount(newPath), "%s.%s", oldPath, "itis");
      C2xSetTokenInt(packetHandle, "TravelerInformation", newPath, value.itis);
      result = CheckLastError("TravelerInformation", gkFuncRefGet, result);
    }
    break;
    case 1:
    {
      snprintf(newPath, elcount(newPath), "%s.%s", oldPath, "text");
      C2xSetTokenData(packetHandle, "TravelerInformation", newPath, value.text.stringLength, value.text.string);
      result = CheckLastError("TravelerInformation", gkFuncRefGet, result);
    }
    break;
  }
  return result;
}

int GetTravelerInformationSpeedLimit_Params(LONG packetHandle, struct TravelerInformationSpeedLimit_ value, char oldPath[])
{
  char newPath[300];
  int result;

  result = 0;

  snprintf(newPath, elcount(newPath), "%s.%s", oldPath, "item");
  GetTravelerInformationSpeedLimit__itemParams(packetHandle, value.item, newPath);
  result = CheckLastError("TravelerInformation", gkFuncRefGet, result);

  return result;
}

int SetTravelerInformationSpeedLimit_Params(LONG packetHandle, struct TravelerInformationSpeedLimit_ value, char oldPath[])
{
  char newPath[300];
  int result;

  result = 0;

  snprintf(newPath, elcount(newPath), "%s.%s", oldPath, "item");
  SetTravelerInformationSpeedLimit__itemParams(packetHandle, value.item, newPath);
  result = CheckLastError("TravelerInformation", gkFuncRefGet, result);

  return result;
}

int GetTravelerInformationSpeedLimitParams(LONG packetHandle, struct TravelerInformationSpeedLimit value, char oldPath[])
{
  char newPath[300]; 
  int i;
  int result;

  result = 0;

  value.length = C2xGetTokenInt(packetHandle, "TravelerInformation", oldPath);
  if((result = CheckLastError("TravelerInformation", gkFuncRefGet, result))==0)
  {
    for(i=0; i<value.length; i++)
    {
      snprintf(newPath, elcount(newPath), "%s[%d]", oldPath, i);
      GetTravelerInformationSpeedLimit_Params(packetHandle, value.arrayValue[i], newPath);
      result = CheckLastError("TravelerInformation", gkFuncRefGet, result);
    }
  }
  return result;
}

int SetTravelerInformationSpeedLimitParams(LONG packetHandle, struct TravelerInformationSpeedLimit value, char oldPath[])
{
  char newPath[300]; 
  int i;
  int result;

  result = 0;

  C2xRemoveToken(packetHandle, "TravelerInformation", oldPath);
  for(i=0; i<value.length; i++)
  {
    snprintf(newPath, elcount(newPath), "%s[%d]", oldPath, i);
    SetTravelerInformationSpeedLimit_Params(packetHandle, value.arrayValue[i], newPath);
    result = CheckLastError("TravelerInformation", gkFuncRefGet, result);
  }
  return result;
}

int GetTravelerInformationExitService__itemParams(LONG packetHandle, struct TravelerInformationExitService__item value, char oldPath[])
{
  char newPath[300];
  int result;

  result = 0;

  value.choice = C2xGetTokenInt(packetHandle, "TravelerInformation", oldPath);

  switch(value.choice)
  {
    case 0:
    {
      snprintf(newPath, elcount(newPath), "%s.%s", oldPath, "itis");
      value.itis = C2xGetTokenInt(packetHandle, "TravelerInformation", newPath);
      result = CheckLastError("TravelerInformation", gkFuncRefGet, result);
    }
    break;
    case 1:
    {
      snprintf(newPath, elcount(newPath), "%s.%s", oldPath, "text");
      value.text.stringLength = C2xGetTokenData(packetHandle, "TravelerInformation", newPath, elcount(value.text.string), value.text.string);
      result = CheckLastError("TravelerInformation", gkFuncRefGet, result);
    }
    break;
  }
  return result;
}

int SetTravelerInformationExitService__itemParams(LONG packetHandle, struct TravelerInformationExitService__item value, char oldPath[])
{
  char newPath[300];
  int result;

  result = 0;

  switch(value.choice)
  {
    case 0:
    {
      snprintf(newPath, elcount(newPath), "%s.%s", oldPath, "itis");
      C2xSetTokenInt(packetHandle, "TravelerInformation", newPath, value.itis);
      result = CheckLastError("TravelerInformation", gkFuncRefGet, result);
    }
    break;
    case 1:
    {
      snprintf(newPath, elcount(newPath), "%s.%s", oldPath, "text");
      C2xSetTokenData(packetHandle, "TravelerInformation", newPath, value.text.stringLength, value.text.string);
      result = CheckLastError("TravelerInformation", gkFuncRefGet, result);
    }
    break;
  }
  return result;
}

int GetTravelerInformationExitService_Params(LONG packetHandle, struct TravelerInformationExitService_ value, char oldPath[])
{
  char newPath[300];
  int result;

  result = 0;

  snprintf(newPath, elcount(newPath), "%s.%s", oldPath, "item");
  GetTravelerInformationExitService__itemParams(packetHandle, value.item, newPath);
  result = CheckLastError("TravelerInformation", gkFuncRefGet, result);

  return result;
}

int SetTravelerInformationExitService_Params(LONG packetHandle, struct TravelerInformationExitService_ value, char oldPath[])
{
  char newPath[300];
  int result;

  result = 0;

  snprintf(newPath, elcount(newPath), "%s.%s", oldPath, "item");
  SetTravelerInformationExitService__itemParams(packetHandle, value.item, newPath);
  result = CheckLastError("TravelerInformation", gkFuncRefGet, result);

  return result;
}

int GetTravelerInformationExitServiceParams(LONG packetHandle, struct TravelerInformationExitService value, char oldPath[])
{
  char newPath[300]; 
  int i;
  int result;

  result = 0;

  value.length = C2xGetTokenInt(packetHandle, "TravelerInformation", oldPath);
  if((result = CheckLastError("TravelerInformation", gkFuncRefGet, result))==0)
  {
    for(i=0; i<value.length; i++)
    {
      snprintf(newPath, elcount(newPath), "%s[%d]", oldPath, i);
      GetTravelerInformationExitService_Params(packetHandle, value.arrayValue[i], newPath);
      result = CheckLastError("TravelerInformation", gkFuncRefGet, result);
    }
  }
  return result;
}

int SetTravelerInformationExitServiceParams(LONG packetHandle, struct TravelerInformationExitService value, char oldPath[])
{
  char newPath[300]; 
  int i;
  int result;

  result = 0;

  C2xRemoveToken(packetHandle, "TravelerInformation", oldPath);
  for(i=0; i<value.length; i++)
  {
    snprintf(newPath, elcount(newPath), "%s[%d]", oldPath, i);
    SetTravelerInformationExitService_Params(packetHandle, value.arrayValue[i], newPath);
    result = CheckLastError("TravelerInformation", gkFuncRefGet, result);
  }
  return result;
}

int GetTravelerInformationTravelerDataFrame_contentParams(LONG packetHandle, struct TravelerInformationTravelerDataFrame_content value, char oldPath[])
{
  char newPath[300];
  int result;

  result = 0;

  value.choice = C2xGetTokenInt(packetHandle, "TravelerInformation", oldPath);

  switch(value.choice)
  {
    case 0:
    {
      snprintf(newPath, elcount(newPath), "%s.%s", oldPath, "advisory");
      GetTravelerInformationITIS_ITIScodesAndTextParams(packetHandle, value.advisory, newPath);
      result = CheckLastError("TravelerInformation", gkFuncRefGet, result);
    }
    break;
    case 1:
    {
      snprintf(newPath, elcount(newPath), "%s.%s", oldPath, "workZone");
      GetTravelerInformationWorkZoneParams(packetHandle, value.workZone, newPath);
      result = CheckLastError("TravelerInformation", gkFuncRefGet, result);
    }
    break;
    case 2:
    {
      snprintf(newPath, elcount(newPath), "%s.%s", oldPath, "genericSign");
      GetTravelerInformationGenericSignageParams(packetHandle, value.genericSign, newPath);
      result = CheckLastError("TravelerInformation", gkFuncRefGet, result);
    }
    break;
    case 3:
    {
      snprintf(newPath, elcount(newPath), "%s.%s", oldPath, "speedLimit");
      GetTravelerInformationSpeedLimitParams(packetHandle, value.speedLimit, newPath);
      result = CheckLastError("TravelerInformation", gkFuncRefGet, result);
    }
    break;
    case 4:
    {
      snprintf(newPath, elcount(newPath), "%s.%s", oldPath, "exitService");
      GetTravelerInformationExitServiceParams(packetHandle, value.exitService, newPath);
      result = CheckLastError("TravelerInformation", gkFuncRefGet, result);
    }
    break;
  }
  return result;
}

int SetTravelerInformationTravelerDataFrame_contentParams(LONG packetHandle, struct TravelerInformationTravelerDataFrame_content value, char oldPath[])
{
  char newPath[300];
  int result;

  result = 0;

  switch(value.choice)
  {
    case 0:
    {
      snprintf(newPath, elcount(newPath), "%s.%s", oldPath, "advisory");
      SetTravelerInformationITIS_ITIScodesAndTextParams(packetHandle, value.advisory, newPath);
      result = CheckLastError("TravelerInformation", gkFuncRefGet, result);
    }
    break;
    case 1:
    {
      snprintf(newPath, elcount(newPath), "%s.%s", oldPath, "workZone");
      SetTravelerInformationWorkZoneParams(packetHandle, value.workZone, newPath);
      result = CheckLastError("TravelerInformation", gkFuncRefGet, result);
    }
    break;
    case 2:
    {
      snprintf(newPath, elcount(newPath), "%s.%s", oldPath, "genericSign");
      SetTravelerInformationGenericSignageParams(packetHandle, value.genericSign, newPath);
      result = CheckLastError("TravelerInformation", gkFuncRefGet, result);
    }
    break;
    case 3:
    {
      snprintf(newPath, elcount(newPath), "%s.%s", oldPath, "speedLimit");
      SetTravelerInformationSpeedLimitParams(packetHandle, value.speedLimit, newPath);
      result = CheckLastError("TravelerInformation", gkFuncRefGet, result);
    }
    break;
    case 4:
    {
      snprintf(newPath, elcount(newPath), "%s.%s", oldPath, "exitService");
      SetTravelerInformationExitServiceParams(packetHandle, value.exitService, newPath);
      result = CheckLastError("TravelerInformation", gkFuncRefGet, result);
    }
    break;
  }
  return result;
}

int GetTravelerInformationCommon_PortlandCementParams(LONG packetHandle, struct TravelerInformationCommon_PortlandCement value, char oldPath[])
{
  char newPath[300];
  int result;

  result = 0;

  snprintf(newPath, elcount(newPath), "%s.%s", oldPath, "type");
  value.type = C2xGetTokenInt(packetHandle, "TravelerInformation", newPath);
  result = CheckLastError("TravelerInformation", gkFuncRefGet, result);

  return result;
}

int SetTravelerInformationCommon_PortlandCementParams(LONG packetHandle, struct TravelerInformationCommon_PortlandCement value, char oldPath[])
{
  char newPath[300];
  int result;

  result = 0;

  snprintf(newPath, elcount(newPath), "%s.%s", oldPath, "type");
  C2xSetTokenInt(packetHandle, "TravelerInformation", newPath, value.type);
  result = CheckLastError("TravelerInformation", gkFuncRefGet, result);

  return result;
}

int GetTravelerInformationCommon_AsphaltOrTarParams(LONG packetHandle, struct TravelerInformationCommon_AsphaltOrTar value, char oldPath[])
{
  char newPath[300];
  int result;

  result = 0;

  snprintf(newPath, elcount(newPath), "%s.%s", oldPath, "type");
  value.type = C2xGetTokenInt(packetHandle, "TravelerInformation", newPath);
  result = CheckLastError("TravelerInformation", gkFuncRefGet, result);

  return result;
}

int SetTravelerInformationCommon_AsphaltOrTarParams(LONG packetHandle, struct TravelerInformationCommon_AsphaltOrTar value, char oldPath[])
{
  char newPath[300];
  int result;

  result = 0;

  snprintf(newPath, elcount(newPath), "%s.%s", oldPath, "type");
  C2xSetTokenInt(packetHandle, "TravelerInformation", newPath, value.type);
  result = CheckLastError("TravelerInformation", gkFuncRefGet, result);

  return result;
}

int GetTravelerInformationCommon_GravelParams(LONG packetHandle, struct TravelerInformationCommon_Gravel value, char oldPath[])
{
  char newPath[300];
  int result;

  result = 0;

  snprintf(newPath, elcount(newPath), "%s.%s", oldPath, "type");
  value.type = C2xGetTokenInt(packetHandle, "TravelerInformation", newPath);
  result = CheckLastError("TravelerInformation", gkFuncRefGet, result);

  return result;
}

int SetTravelerInformationCommon_GravelParams(LONG packetHandle, struct TravelerInformationCommon_Gravel value, char oldPath[])
{
  char newPath[300];
  int result;

  result = 0;

  snprintf(newPath, elcount(newPath), "%s.%s", oldPath, "type");
  C2xSetTokenInt(packetHandle, "TravelerInformation", newPath, value.type);
  result = CheckLastError("TravelerInformation", gkFuncRefGet, result);

  return result;
}

int GetTravelerInformationCommon_GrassParams(LONG packetHandle, struct TravelerInformationCommon_Grass value, char oldPath[])
{
  char newPath[300];
  int result;

  result = 0;

  snprintf(newPath, elcount(newPath), "%s.%s", oldPath, "type");
  value.type = C2xGetTokenInt(packetHandle, "TravelerInformation", newPath);
  result = CheckLastError("TravelerInformation", gkFuncRefGet, result);

  return result;
}

int SetTravelerInformationCommon_GrassParams(LONG packetHandle, struct TravelerInformationCommon_Grass value, char oldPath[])
{
  char newPath[300];
  int result;

  result = 0;

  snprintf(newPath, elcount(newPath), "%s.%s", oldPath, "type");
  C2xSetTokenInt(packetHandle, "TravelerInformation", newPath, value.type);
  result = CheckLastError("TravelerInformation", gkFuncRefGet, result);

  return result;
}

int GetTravelerInformationCommon_CindersParams(LONG packetHandle, struct TravelerInformationCommon_Cinders value, char oldPath[])
{
  char newPath[300];
  int result;

  result = 0;

  snprintf(newPath, elcount(newPath), "%s.%s", oldPath, "type");
  value.type = C2xGetTokenInt(packetHandle, "TravelerInformation", newPath);
  result = CheckLastError("TravelerInformation", gkFuncRefGet, result);

  return result;
}

int SetTravelerInformationCommon_CindersParams(LONG packetHandle, struct TravelerInformationCommon_Cinders value, char oldPath[])
{
  char newPath[300];
  int result;

  result = 0;

  snprintf(newPath, elcount(newPath), "%s.%s", oldPath, "type");
  C2xSetTokenInt(packetHandle, "TravelerInformation", newPath, value.type);
  result = CheckLastError("TravelerInformation", gkFuncRefGet, result);

  return result;
}

int GetTravelerInformationCommon_RockParams(LONG packetHandle, struct TravelerInformationCommon_Rock value, char oldPath[])
{
  char newPath[300];
  int result;

  result = 0;

  snprintf(newPath, elcount(newPath), "%s.%s", oldPath, "type");
  value.type = C2xGetTokenInt(packetHandle, "TravelerInformation", newPath);
  result = CheckLastError("TravelerInformation", gkFuncRefGet, result);

  return result;
}

int SetTravelerInformationCommon_RockParams(LONG packetHandle, struct TravelerInformationCommon_Rock value, char oldPath[])
{
  char newPath[300];
  int result;

  result = 0;

  snprintf(newPath, elcount(newPath), "%s.%s", oldPath, "type");
  C2xSetTokenInt(packetHandle, "TravelerInformation", newPath, value.type);
  result = CheckLastError("TravelerInformation", gkFuncRefGet, result);

  return result;
}

int GetTravelerInformationCommon_IceParams(LONG packetHandle, struct TravelerInformationCommon_Ice value, char oldPath[])
{
  char newPath[300];
  int result;

  result = 0;

  snprintf(newPath, elcount(newPath), "%s.%s", oldPath, "type");
  value.type = C2xGetTokenInt(packetHandle, "TravelerInformation", newPath);
  result = CheckLastError("TravelerInformation", gkFuncRefGet, result);

  return result;
}

int SetTravelerInformationCommon_IceParams(LONG packetHandle, struct TravelerInformationCommon_Ice value, char oldPath[])
{
  char newPath[300];
  int result;

  result = 0;

  snprintf(newPath, elcount(newPath), "%s.%s", oldPath, "type");
  C2xSetTokenInt(packetHandle, "TravelerInformation", newPath, value.type);
  result = CheckLastError("TravelerInformation", gkFuncRefGet, result);

  return result;
}

int GetTravelerInformationCommon_SnowParams(LONG packetHandle, struct TravelerInformationCommon_Snow value, char oldPath[])
{
  char newPath[300];
  int result;

  result = 0;

  snprintf(newPath, elcount(newPath), "%s.%s", oldPath, "type");
  value.type = C2xGetTokenInt(packetHandle, "TravelerInformation", newPath);
  result = CheckLastError("TravelerInformation", gkFuncRefGet, result);

  return result;
}

int SetTravelerInformationCommon_SnowParams(LONG packetHandle, struct TravelerInformationCommon_Snow value, char oldPath[])
{
  char newPath[300];
  int result;

  result = 0;

  snprintf(newPath, elcount(newPath), "%s.%s", oldPath, "type");
  C2xSetTokenInt(packetHandle, "TravelerInformation", newPath, value.type);
  result = CheckLastError("TravelerInformation", gkFuncRefGet, result);

  return result;
}

int GetTravelerInformationCommon_DescriptionOfRoadSurfaceParams(LONG packetHandle, struct TravelerInformationCommon_DescriptionOfRoadSurface value, char oldPath[])
{
  char newPath[300];
  int result;

  result = 0;

  value.choice = C2xGetTokenInt(packetHandle, "TravelerInformation", oldPath);

  switch(value.choice)
  {
    case 0:
    {
      snprintf(newPath, elcount(newPath), "%s.%s", oldPath, "portlandCement");
      GetTravelerInformationCommon_PortlandCementParams(packetHandle, value.portlandCement, newPath);
      result = CheckLastError("TravelerInformation", gkFuncRefGet, result);
    }
    break;
    case 1:
    {
      snprintf(newPath, elcount(newPath), "%s.%s", oldPath, "asphaltOrTar");
      GetTravelerInformationCommon_AsphaltOrTarParams(packetHandle, value.asphaltOrTar, newPath);
      result = CheckLastError("TravelerInformation", gkFuncRefGet, result);
    }
    break;
    case 2:
    {
      snprintf(newPath, elcount(newPath), "%s.%s", oldPath, "gravel");
      GetTravelerInformationCommon_GravelParams(packetHandle, value.gravel, newPath);
      result = CheckLastError("TravelerInformation", gkFuncRefGet, result);
    }
    break;
    case 3:
    {
      snprintf(newPath, elcount(newPath), "%s.%s", oldPath, "grass");
      GetTravelerInformationCommon_GrassParams(packetHandle, value.grass, newPath);
      result = CheckLastError("TravelerInformation", gkFuncRefGet, result);
    }
    break;
    case 4:
    {
      snprintf(newPath, elcount(newPath), "%s.%s", oldPath, "cinders");
      GetTravelerInformationCommon_CindersParams(packetHandle, value.cinders, newPath);
      result = CheckLastError("TravelerInformation", gkFuncRefGet, result);
    }
    break;
    case 5:
    {
      snprintf(newPath, elcount(newPath), "%s.%s", oldPath, "rock");
      GetTravelerInformationCommon_RockParams(packetHandle, value.rock, newPath);
      result = CheckLastError("TravelerInformation", gkFuncRefGet, result);
    }
    break;
    case 6:
    {
      snprintf(newPath, elcount(newPath), "%s.%s", oldPath, "ice");
      GetTravelerInformationCommon_IceParams(packetHandle, value.ice, newPath);
      result = CheckLastError("TravelerInformation", gkFuncRefGet, result);
    }
    break;
    case 7:
    {
      snprintf(newPath, elcount(newPath), "%s.%s", oldPath, "snow");
      GetTravelerInformationCommon_SnowParams(packetHandle, value.snow, newPath);
      result = CheckLastError("TravelerInformation", gkFuncRefGet, result);
    }
    break;
  }
  return result;
}

int SetTravelerInformationCommon_DescriptionOfRoadSurfaceParams(LONG packetHandle, struct TravelerInformationCommon_DescriptionOfRoadSurface value, char oldPath[])
{
  char newPath[300];
  int result;

  result = 0;

  switch(value.choice)
  {
    case 0:
    {
      snprintf(newPath, elcount(newPath), "%s.%s", oldPath, "portlandCement");
      SetTravelerInformationCommon_PortlandCementParams(packetHandle, value.portlandCement, newPath);
      result = CheckLastError("TravelerInformation", gkFuncRefGet, result);
    }
    break;
    case 1:
    {
      snprintf(newPath, elcount(newPath), "%s.%s", oldPath, "asphaltOrTar");
      SetTravelerInformationCommon_AsphaltOrTarParams(packetHandle, value.asphaltOrTar, newPath);
      result = CheckLastError("TravelerInformation", gkFuncRefGet, result);
    }
    break;
    case 2:
    {
      snprintf(newPath, elcount(newPath), "%s.%s", oldPath, "gravel");
      SetTravelerInformationCommon_GravelParams(packetHandle, value.gravel, newPath);
      result = CheckLastError("TravelerInformation", gkFuncRefGet, result);
    }
    break;
    case 3:
    {
      snprintf(newPath, elcount(newPath), "%s.%s", oldPath, "grass");
      SetTravelerInformationCommon_GrassParams(packetHandle, value.grass, newPath);
      result = CheckLastError("TravelerInformation", gkFuncRefGet, result);
    }
    break;
    case 4:
    {
      snprintf(newPath, elcount(newPath), "%s.%s", oldPath, "cinders");
      SetTravelerInformationCommon_CindersParams(packetHandle, value.cinders, newPath);
      result = CheckLastError("TravelerInformation", gkFuncRefGet, result);
    }
    break;
    case 5:
    {
      snprintf(newPath, elcount(newPath), "%s.%s", oldPath, "rock");
      SetTravelerInformationCommon_RockParams(packetHandle, value.rock, newPath);
      result = CheckLastError("TravelerInformation", gkFuncRefGet, result);
    }
    break;
    case 6:
    {
      snprintf(newPath, elcount(newPath), "%s.%s", oldPath, "ice");
      SetTravelerInformationCommon_IceParams(packetHandle, value.ice, newPath);
      result = CheckLastError("TravelerInformation", gkFuncRefGet, result);
    }
    break;
    case 7:
    {
      snprintf(newPath, elcount(newPath), "%s.%s", oldPath, "snow");
      SetTravelerInformationCommon_SnowParams(packetHandle, value.snow, newPath);
      result = CheckLastError("TravelerInformation", gkFuncRefGet, result);
    }
    break;
  }
  return result;
}

int GetTravelerInformationCommon_RoadRoughnessParams(LONG packetHandle, struct TravelerInformationCommon_RoadRoughness value, char oldPath[])
{
  char newPath[300];
  int result;

  result = 0;

  snprintf(newPath, elcount(newPath), "%s.%s", oldPath, "meanVerticalVariation");
  value.meanVerticalVariation = C2xGetTokenInt(packetHandle, "TravelerInformation", newPath);
  result = CheckLastError("TravelerInformation", gkFuncRefGet, result);

  snprintf(newPath, elcount(newPath), "%s.%s", oldPath, "verticalVariationStdDev");
  value.verticalVariationStdDev.isValidFlag = C2xIsTokenAvailable(packetHandle, "TravelerInformation", newPath);
  if(value.verticalVariationStdDev.isValidFlag==1)
  {
    value.verticalVariationStdDev.value = C2xGetTokenInt(packetHandle, "TravelerInformation", newPath);
    result = CheckLastError("TravelerInformation", gkFuncRefGet, result);
  }
  snprintf(newPath, elcount(newPath), "%s.%s", oldPath, "meanHorizontalVariation");
  value.meanHorizontalVariation.isValidFlag = C2xIsTokenAvailable(packetHandle, "TravelerInformation", newPath);
  if(value.meanHorizontalVariation.isValidFlag==1)
  {
    value.meanHorizontalVariation.value = C2xGetTokenInt(packetHandle, "TravelerInformation", newPath);
    result = CheckLastError("TravelerInformation", gkFuncRefGet, result);
  }
  snprintf(newPath, elcount(newPath), "%s.%s", oldPath, "horizontalVariationStdDev");
  value.horizontalVariationStdDev.isValidFlag = C2xIsTokenAvailable(packetHandle, "TravelerInformation", newPath);
  if(value.horizontalVariationStdDev.isValidFlag==1)
  {
    value.horizontalVariationStdDev.value = C2xGetTokenInt(packetHandle, "TravelerInformation", newPath);
    result = CheckLastError("TravelerInformation", gkFuncRefGet, result);
  }
  return result;
}

int SetTravelerInformationCommon_RoadRoughnessParams(LONG packetHandle, struct TravelerInformationCommon_RoadRoughness value, char oldPath[])
{
  char newPath[300];
  int result;

  result = 0;

  snprintf(newPath, elcount(newPath), "%s.%s", oldPath, "meanVerticalVariation");
  C2xSetTokenInt(packetHandle, "TravelerInformation", newPath, value.meanVerticalVariation);
  result = CheckLastError("TravelerInformation", gkFuncRefGet, result);

  snprintf(newPath, elcount(newPath), "%s.%s", oldPath, "verticalVariationStdDev");
  if(value.verticalVariationStdDev.isValidFlag==1)
  {
    C2xSetTokenInt(packetHandle, "TravelerInformation", newPath, value.verticalVariationStdDev.value);
    result = CheckLastError("TravelerInformation", gkFuncRefGet, result);
  }
  else
  {
    if( C2xIsTokenAvailable(packetHandle, "TravelerInformation", newPath) )
    {
      C2xRemoveToken(packetHandle, "TravelerInformation", newPath);
    }
  }

  snprintf(newPath, elcount(newPath), "%s.%s", oldPath, "meanHorizontalVariation");
  if(value.meanHorizontalVariation.isValidFlag==1)
  {
    C2xSetTokenInt(packetHandle, "TravelerInformation", newPath, value.meanHorizontalVariation.value);
    result = CheckLastError("TravelerInformation", gkFuncRefGet, result);
  }
  else
  {
    if( C2xIsTokenAvailable(packetHandle, "TravelerInformation", newPath) )
    {
      C2xRemoveToken(packetHandle, "TravelerInformation", newPath);
    }
  }

  snprintf(newPath, elcount(newPath), "%s.%s", oldPath, "horizontalVariationStdDev");
  if(value.horizontalVariationStdDev.isValidFlag==1)
  {
    C2xSetTokenInt(packetHandle, "TravelerInformation", newPath, value.horizontalVariationStdDev.value);
    result = CheckLastError("TravelerInformation", gkFuncRefGet, result);
  }
  else
  {
    if( C2xIsTokenAvailable(packetHandle, "TravelerInformation", newPath) )
    {
      C2xRemoveToken(packetHandle, "TravelerInformation", newPath);
    }
  }

  return result;
}

int GetTravelerInformationCommon_FrictionInformationParams(LONG packetHandle, struct TravelerInformationCommon_FrictionInformation value, char oldPath[])
{
  char newPath[300];
  int result;

  result = 0;

  snprintf(newPath, elcount(newPath), "%s.%s", oldPath, "roadSurfaceDescription");
  GetTravelerInformationCommon_DescriptionOfRoadSurfaceParams(packetHandle, value.roadSurfaceDescription, newPath);
  result = CheckLastError("TravelerInformation", gkFuncRefGet, result);

  snprintf(newPath, elcount(newPath), "%s.%s", oldPath, "dryOrWet");
  value.dryOrWet.isValidFlag = C2xIsTokenAvailable(packetHandle, "TravelerInformation", newPath);
  if(value.dryOrWet.isValidFlag==1)
  {
    value.dryOrWet.value = C2xGetTokenInt(packetHandle, "TravelerInformation", newPath);
    result = CheckLastError("TravelerInformation", gkFuncRefGet, result);
  }
  snprintf(newPath, elcount(newPath), "%s.%s", oldPath, "roadRoughness");
  value.roadRoughness.isValidFlag = C2xIsTokenAvailable(packetHandle, "TravelerInformation", newPath);
  if(value.roadRoughness.isValidFlag==1)
  {
    GetTravelerInformationCommon_RoadRoughnessParams(packetHandle, value.roadRoughness, newPath);
    result = CheckLastError("TravelerInformation", gkFuncRefGet, result);
  }
  return result;
}

int SetTravelerInformationCommon_FrictionInformationParams(LONG packetHandle, struct TravelerInformationCommon_FrictionInformation value, char oldPath[])
{
  char newPath[300];
  int result;

  result = 0;

  snprintf(newPath, elcount(newPath), "%s.%s", oldPath, "roadSurfaceDescription");
  SetTravelerInformationCommon_DescriptionOfRoadSurfaceParams(packetHandle, value.roadSurfaceDescription, newPath);
  result = CheckLastError("TravelerInformation", gkFuncRefGet, result);

  snprintf(newPath, elcount(newPath), "%s.%s", oldPath, "dryOrWet");
  if(value.dryOrWet.isValidFlag==1)
  {
    C2xSetTokenInt(packetHandle, "TravelerInformation", newPath, value.dryOrWet.value);
    result = CheckLastError("TravelerInformation", gkFuncRefGet, result);
  }
  else
  {
    if( C2xIsTokenAvailable(packetHandle, "TravelerInformation", newPath) )
    {
      C2xRemoveToken(packetHandle, "TravelerInformation", newPath);
    }
  }

  snprintf(newPath, elcount(newPath), "%s.%s", oldPath, "roadRoughness");
  if(value.roadRoughness.isValidFlag==1)
  {
    SetTravelerInformationCommon_RoadRoughnessParams(packetHandle, value.roadRoughness, newPath);
    result = CheckLastError("TravelerInformation", gkFuncRefGet, result);
  }
  else
  {
    if( C2xIsTokenAvailable(packetHandle, "TravelerInformation", newPath) )
    {
      C2xRemoveToken(packetHandle, "TravelerInformation", newPath);
    }
  }

  return result;
}

int GetTravelerInformationTravelerDataFrameNewPartIIIContentParams(LONG packetHandle, struct TravelerInformationTravelerDataFrameNewPartIIIContent value, char oldPath[])
{
  char newPath[300];
  int result;

  result = 0;

  value.choice = C2xGetTokenInt(packetHandle, "TravelerInformation", oldPath);

  switch(value.choice)
  {
    case 0:
    {
      snprintf(newPath, elcount(newPath), "%s.%s", oldPath, "frictionInfo");
      GetTravelerInformationCommon_FrictionInformationParams(packetHandle, value.frictionInfo, newPath);
      result = CheckLastError("TravelerInformation", gkFuncRefGet, result);
    }
    break;
  }
  return result;
}

int SetTravelerInformationTravelerDataFrameNewPartIIIContentParams(LONG packetHandle, struct TravelerInformationTravelerDataFrameNewPartIIIContent value, char oldPath[])
{
  char newPath[300];
  int result;

  result = 0;

  switch(value.choice)
  {
    case 0:
    {
      snprintf(newPath, elcount(newPath), "%s.%s", oldPath, "frictionInfo");
      SetTravelerInformationCommon_FrictionInformationParams(packetHandle, value.frictionInfo, newPath);
      result = CheckLastError("TravelerInformation", gkFuncRefGet, result);
    }
    break;
  }
  return result;
}

int GetTravelerInformationTravelerDataFrameParams(LONG packetHandle, struct TravelerInformationTravelerDataFrame value, char oldPath[])
{
  char newPath[300];
  int result;

  result = 0;

  snprintf(newPath, elcount(newPath), "%s.%s", oldPath, "doNotUse1");
  value.doNotUse1 = C2xGetTokenInt(packetHandle, "TravelerInformation", newPath);
  result = CheckLastError("TravelerInformation", gkFuncRefGet, result);

  snprintf(newPath, elcount(newPath), "%s.%s", oldPath, "frameType");
  value.frameType = C2xGetTokenInt(packetHandle, "TravelerInformation", newPath);
  result = CheckLastError("TravelerInformation", gkFuncRefGet, result);

  snprintf(newPath, elcount(newPath), "%s.%s", oldPath, "msgId");
  GetTravelerInformationTravelerDataFrame_msgIdParams(packetHandle, value.msgId, newPath);
  result = CheckLastError("TravelerInformation", gkFuncRefGet, result);

  snprintf(newPath, elcount(newPath), "%s.%s", oldPath, "startYear");
  value.startYear.isValidFlag = C2xIsTokenAvailable(packetHandle, "TravelerInformation", newPath);
  if(value.startYear.isValidFlag==1)
  {
    value.startYear.value = C2xGetTokenInt(packetHandle, "TravelerInformation", newPath);
    result = CheckLastError("TravelerInformation", gkFuncRefGet, result);
  }
  snprintf(newPath, elcount(newPath), "%s.%s", oldPath, "startTime");
  value.startTime = C2xGetTokenInt(packetHandle, "TravelerInformation", newPath);
  result = CheckLastError("TravelerInformation", gkFuncRefGet, result);

  snprintf(newPath, elcount(newPath), "%s.%s", oldPath, "durationTime");
  value.durationTime = C2xGetTokenInt(packetHandle, "TravelerInformation", newPath);
  result = CheckLastError("TravelerInformation", gkFuncRefGet, result);

  snprintf(newPath, elcount(newPath), "%s.%s", oldPath, "priority");
  value.priority = C2xGetTokenInt(packetHandle, "TravelerInformation", newPath);
  result = CheckLastError("TravelerInformation", gkFuncRefGet, result);

  snprintf(newPath, elcount(newPath), "%s.%s", oldPath, "doNotUse2");
  value.doNotUse2 = C2xGetTokenInt(packetHandle, "TravelerInformation", newPath);
  result = CheckLastError("TravelerInformation", gkFuncRefGet, result);

  snprintf(newPath, elcount(newPath), "%s.%s", oldPath, "regions");
  GetTravelerInformationTravelerDataFrame_regionsParams(packetHandle, value.regions, newPath);
  result = CheckLastError("TravelerInformation", gkFuncRefGet, result);

  snprintf(newPath, elcount(newPath), "%s.%s", oldPath, "doNotUse3");
  value.doNotUse3 = C2xGetTokenInt(packetHandle, "TravelerInformation", newPath);
  result = CheckLastError("TravelerInformation", gkFuncRefGet, result);

  snprintf(newPath, elcount(newPath), "%s.%s", oldPath, "doNotUse4");
  value.doNotUse4 = C2xGetTokenInt(packetHandle, "TravelerInformation", newPath);
  result = CheckLastError("TravelerInformation", gkFuncRefGet, result);

  snprintf(newPath, elcount(newPath), "%s.%s", oldPath, "content");
  GetTravelerInformationTravelerDataFrame_contentParams(packetHandle, value.content, newPath);
  result = CheckLastError("TravelerInformation", gkFuncRefGet, result);

  snprintf(newPath, elcount(newPath), "%s.%s", oldPath, "url");
  value.url.isValidFlag = C2xIsTokenAvailable(packetHandle, "TravelerInformation", newPath);
  if(value.url.isValidFlag==1)
  {
    value.url.stringLength = C2xGetTokenData(packetHandle, "TravelerInformation", newPath, elcount(value.url.string), value.url.string);
    result = CheckLastError("TravelerInformation", gkFuncRefGet, result);
  }
  snprintf(newPath, elcount(newPath), "%s.%s", oldPath, "contentNew");
  GetTravelerInformationTravelerDataFrameNewPartIIIContentParams(packetHandle, value.contentNew, newPath);
  result = CheckLastError("TravelerInformation", gkFuncRefGet, result);

  return result;
}

int SetTravelerInformationTravelerDataFrameParams(LONG packetHandle, struct TravelerInformationTravelerDataFrame value, char oldPath[])
{
  char newPath[300];
  int result;

  result = 0;

  snprintf(newPath, elcount(newPath), "%s.%s", oldPath, "doNotUse1");
  C2xSetTokenInt(packetHandle, "TravelerInformation", newPath, value.doNotUse1);
  result = CheckLastError("TravelerInformation", gkFuncRefGet, result);

  snprintf(newPath, elcount(newPath), "%s.%s", oldPath, "frameType");
  C2xSetTokenInt(packetHandle, "TravelerInformation", newPath, value.frameType);
  result = CheckLastError("TravelerInformation", gkFuncRefGet, result);

  snprintf(newPath, elcount(newPath), "%s.%s", oldPath, "msgId");
  SetTravelerInformationTravelerDataFrame_msgIdParams(packetHandle, value.msgId, newPath);
  result = CheckLastError("TravelerInformation", gkFuncRefGet, result);

  snprintf(newPath, elcount(newPath), "%s.%s", oldPath, "startYear");
  if(value.startYear.isValidFlag==1)
  {
    C2xSetTokenInt(packetHandle, "TravelerInformation", newPath, value.startYear.value);
    result = CheckLastError("TravelerInformation", gkFuncRefGet, result);
  }
  else
  {
    if( C2xIsTokenAvailable(packetHandle, "TravelerInformation", newPath) )
    {
      C2xRemoveToken(packetHandle, "TravelerInformation", newPath);
    }
  }

  snprintf(newPath, elcount(newPath), "%s.%s", oldPath, "startTime");
  C2xSetTokenInt(packetHandle, "TravelerInformation", newPath, value.startTime);
  result = CheckLastError("TravelerInformation", gkFuncRefGet, result);

  snprintf(newPath, elcount(newPath), "%s.%s", oldPath, "durationTime");
  C2xSetTokenInt(packetHandle, "TravelerInformation", newPath, value.durationTime);
  result = CheckLastError("TravelerInformation", gkFuncRefGet, result);

  snprintf(newPath, elcount(newPath), "%s.%s", oldPath, "priority");
  C2xSetTokenInt(packetHandle, "TravelerInformation", newPath, value.priority);
  result = CheckLastError("TravelerInformation", gkFuncRefGet, result);

  snprintf(newPath, elcount(newPath), "%s.%s", oldPath, "doNotUse2");
  C2xSetTokenInt(packetHandle, "TravelerInformation", newPath, value.doNotUse2);
  result = CheckLastError("TravelerInformation", gkFuncRefGet, result);

  snprintf(newPath, elcount(newPath), "%s.%s", oldPath, "regions");
  SetTravelerInformationTravelerDataFrame_regionsParams(packetHandle, value.regions, newPath);
  result = CheckLastError("TravelerInformation", gkFuncRefGet, result);

  snprintf(newPath, elcount(newPath), "%s.%s", oldPath, "doNotUse3");
  C2xSetTokenInt(packetHandle, "TravelerInformation", newPath, value.doNotUse3);
  result = CheckLastError("TravelerInformation", gkFuncRefGet, result);

  snprintf(newPath, elcount(newPath), "%s.%s", oldPath, "doNotUse4");
  C2xSetTokenInt(packetHandle, "TravelerInformation", newPath, value.doNotUse4);
  result = CheckLastError("TravelerInformation", gkFuncRefGet, result);

  snprintf(newPath, elcount(newPath), "%s.%s", oldPath, "content");
  SetTravelerInformationTravelerDataFrame_contentParams(packetHandle, value.content, newPath);
  result = CheckLastError("TravelerInformation", gkFuncRefGet, result);

  snprintf(newPath, elcount(newPath), "%s.%s", oldPath, "url");
  if(value.url.isValidFlag==1)
  {
    C2xSetTokenData(packetHandle, "TravelerInformation", newPath, value.url.stringLength, value.url.string);
    result = CheckLastError("TravelerInformation", gkFuncRefGet, result);
  }
  else
  {
    if( C2xIsTokenAvailable(packetHandle, "TravelerInformation", newPath) )
    {
      C2xRemoveToken(packetHandle, "TravelerInformation", newPath);
    }
  }

  snprintf(newPath, elcount(newPath), "%s.%s", oldPath, "contentNew");
  SetTravelerInformationTravelerDataFrameNewPartIIIContentParams(packetHandle, value.contentNew, newPath);
  result = CheckLastError("TravelerInformation", gkFuncRefGet, result);

  return result;
}

int GetTravelerInformationTravelerDataFrameListParams(LONG packetHandle, struct TravelerInformationTravelerDataFrameList value, char oldPath[])
{
  char newPath[300]; 
  int i;
  int result;

  result = 0;

  value.length = C2xGetTokenInt(packetHandle, "TravelerInformation", oldPath);
  if((result = CheckLastError("TravelerInformation", gkFuncRefGet, result))==0)
  {
    for(i=0; i<value.length; i++)
    {
      snprintf(newPath, elcount(newPath), "%s[%d]", oldPath, i);
      GetTravelerInformationTravelerDataFrameParams(packetHandle, value.arrayValue[i], newPath);
      result = CheckLastError("TravelerInformation", gkFuncRefGet, result);
    }
  }
  return result;
}

int SetTravelerInformationTravelerDataFrameListParams(LONG packetHandle, struct TravelerInformationTravelerDataFrameList value, char oldPath[])
{
  char newPath[300]; 
  int i;
  int result;

  result = 0;

  C2xRemoveToken(packetHandle, "TravelerInformation", oldPath);
  for(i=0; i<value.length; i++)
  {
    snprintf(newPath, elcount(newPath), "%s[%d]", oldPath, i);
    SetTravelerInformationTravelerDataFrameParams(packetHandle, value.arrayValue[i], newPath);
    result = CheckLastError("TravelerInformation", gkFuncRefGet, result);
  }
  return result;
}

int GetTravelerInformationCommon_RegionalExtension_Reg_TravelerInformationParams(LONG packetHandle, struct TravelerInformationCommon_RegionalExtension_Reg_TravelerInformation value, char oldPath[])
{
  char newPath[300];
  int result;

  result = 0;

  snprintf(newPath, elcount(newPath), "%s.%s", oldPath, "regionId");
  value.regionId = C2xGetTokenInt(packetHandle, "TravelerInformation", newPath);
  result = CheckLastError("TravelerInformation", gkFuncRefGet, result);

  return result;
}

int SetTravelerInformationCommon_RegionalExtension_Reg_TravelerInformationParams(LONG packetHandle, struct TravelerInformationCommon_RegionalExtension_Reg_TravelerInformation value, char oldPath[])
{
  char newPath[300];
  int result;

  result = 0;


  return result;
}

int GetTravelerInformationTravelerInformation_regionalParams(LONG packetHandle, struct TravelerInformationTravelerInformation_regional value, char oldPath[])
{
  char newPath[300]; 
  int i;
  int result;

  result = 0;

  value.length = C2xGetTokenInt(packetHandle, "TravelerInformation", oldPath);
  if((result = CheckLastError("TravelerInformation", gkFuncRefGet, result))==0)
  {
    for(i=0; i<value.length; i++)
    {
      snprintf(newPath, elcount(newPath), "%s[%d]", oldPath, i);
      GetTravelerInformationCommon_RegionalExtension_Reg_TravelerInformationParams(packetHandle, value.arrayValue[i], newPath);
      result = CheckLastError("TravelerInformation", gkFuncRefGet, result);
    }
  }
  return result;
}

int SetTravelerInformationTravelerInformation_regionalParams(LONG packetHandle, struct TravelerInformationTravelerInformation_regional value, char oldPath[])
{
  char newPath[300]; 
  int i;
  int result;

  result = 0;

  C2xRemoveToken(packetHandle, "TravelerInformation", oldPath);
  for(i=0; i<value.length; i++)
  {
    snprintf(newPath, elcount(newPath), "%s[%d]", oldPath, i);
    SetTravelerInformationCommon_RegionalExtension_Reg_TravelerInformationParams(packetHandle, value.arrayValue[i], newPath);
    result = CheckLastError("TravelerInformation", gkFuncRefGet, result);
  }
  return result;
}

int GetTravelerInformation_TravelerInformationParams(LONG packetHandle, struct TravelerInformation_TravelerInformation value, char oldPath[])
{
  char newPath[300];
  int result;

  result = 0;

  snprintf(newPath, elcount(newPath), "%s.%s", oldPath, "msgCnt");
  value.msgCnt = C2xGetTokenInt(packetHandle, "TravelerInformation", newPath);
  result = CheckLastError("TravelerInformation", gkFuncRefGet, result);

  snprintf(newPath, elcount(newPath), "%s.%s", oldPath, "timeStamp");
  value.timeStamp.isValidFlag = C2xIsTokenAvailable(packetHandle, "TravelerInformation", newPath);
  if(value.timeStamp.isValidFlag==1)
  {
    value.timeStamp.value = C2xGetTokenInt(packetHandle, "TravelerInformation", newPath);
    result = CheckLastError("TravelerInformation", gkFuncRefGet, result);
  }
  snprintf(newPath, elcount(newPath), "%s.%s", oldPath, "packetID");
  value.packetID.isValidFlag = C2xIsTokenAvailable(packetHandle, "TravelerInformation", newPath);
  if(value.packetID.isValidFlag==1)
  {
    value.packetID.isValidFlag = 1;
    value.packetID.stringLength = C2xGetTokenData(packetHandle, "TravelerInformation", newPath, elcount(value.packetID.string), value.packetID.string);
  }
  snprintf(newPath, elcount(newPath), "%s.%s", oldPath, "urlB");
  value.urlB.isValidFlag = C2xIsTokenAvailable(packetHandle, "TravelerInformation", newPath);
  if(value.urlB.isValidFlag==1)
  {
    value.urlB.stringLength = C2xGetTokenData(packetHandle, "TravelerInformation", newPath, elcount(value.urlB.string), value.urlB.string);
    result = CheckLastError("TravelerInformation", gkFuncRefGet, result);
  }
  snprintf(newPath, elcount(newPath), "%s.%s", oldPath, "dataFrames");
  GetTravelerInformationTravelerDataFrameListParams(packetHandle, value.dataFrames, newPath);
  result = CheckLastError("TravelerInformation", gkFuncRefGet, result);

  snprintf(newPath, elcount(newPath), "%s.%s", oldPath, "regional");
  value.regional.isValidFlag = C2xIsTokenAvailable(packetHandle, "TravelerInformation", newPath);
  if(value.regional.isValidFlag==1)
  {
    GetTravelerInformationTravelerInformation_regionalParams(packetHandle, value.regional, newPath);
    result = CheckLastError("TravelerInformation", gkFuncRefGet, result);
  }
  return result;
}

int SetTravelerInformation_TravelerInformationParams(LONG packetHandle, struct TravelerInformation_TravelerInformation value, char oldPath[])
{
  char newPath[300];
  int result;

  result = 0;

  snprintf(newPath, elcount(newPath), "%s.%s", oldPath, "msgCnt");
  C2xSetTokenInt(packetHandle, "TravelerInformation", newPath, value.msgCnt);
  result = CheckLastError("TravelerInformation", gkFuncRefGet, result);

  snprintf(newPath, elcount(newPath), "%s.%s", oldPath, "timeStamp");
  if(value.timeStamp.isValidFlag==1)
  {
    C2xSetTokenInt(packetHandle, "TravelerInformation", newPath, value.timeStamp.value);
    result = CheckLastError("TravelerInformation", gkFuncRefGet, result);
  }
  else
  {
    if( C2xIsTokenAvailable(packetHandle, "TravelerInformation", newPath) )
    {
      C2xRemoveToken(packetHandle, "TravelerInformation", newPath);
    }
  }

  snprintf(newPath, elcount(newPath), "%s.%s", oldPath, "packetID");
  if(value.packetID.isValidFlag==1)
  {
    C2xSetTokenData(packetHandle, "TravelerInformation", newPath, value.packetID.stringLength, value.packetID.string);
  }
  else
  {
    if( C2xIsTokenAvailable(packetHandle, "TravelerInformation", newPath) )
    {
      C2xRemoveToken(packetHandle, "TravelerInformation", newPath);
    }
  }

  snprintf(newPath, elcount(newPath), "%s.%s", oldPath, "urlB");
  if(value.urlB.isValidFlag==1)
  {
    C2xSetTokenData(packetHandle, "TravelerInformation", newPath, value.urlB.stringLength, value.urlB.string);
    result = CheckLastError("TravelerInformation", gkFuncRefGet, result);
  }
  else
  {
    if( C2xIsTokenAvailable(packetHandle, "TravelerInformation", newPath) )
    {
      C2xRemoveToken(packetHandle, "TravelerInformation", newPath);
    }
  }

  snprintf(newPath, elcount(newPath), "%s.%s", oldPath, "dataFrames");
  SetTravelerInformationTravelerDataFrameListParams(packetHandle, value.dataFrames, newPath);
  result = CheckLastError("TravelerInformation", gkFuncRefGet, result);

  snprintf(newPath, elcount(newPath), "%s.%s", oldPath, "regional");
  if(value.regional.isValidFlag==1)
  {
    SetTravelerInformationTravelerInformation_regionalParams(packetHandle, value.regional, newPath);
    result = CheckLastError("TravelerInformation", gkFuncRefGet, result);
  }
  else
  {
    if( C2xIsTokenAvailable(packetHandle, "TravelerInformation", newPath) )
    {
      C2xRemoveToken(packetHandle, "TravelerInformation", newPath);
    }
  }

  return result;
}

int GetTravelerInformationMESSAGE_ID_AND_TYPEParams(LONG packetHandle, WORD tableKey, struct TravelerInformationMESSAGE_ID_AND_TYPE value, char oldPath[])
{
  char newPath[300];
  int result;

  result = 0;

  switch(tableKey)
  {
    case 31:
    {
      snprintf(newPath, elcount(newPath), "%s.%s", oldPath, "travelerInformation");
      GetTravelerInformation_TravelerInformationParams(packetHandle, value.travelerInformation, newPath);
      result = CheckLastError("TravelerInformation", gkFuncRefGet, result);
    }
    break;
  }
  return result;
}

int SetTravelerInformationMESSAGE_ID_AND_TYPEParams(LONG packetHandle, WORD tableKey, struct TravelerInformationMESSAGE_ID_AND_TYPE value, char oldPath[])
{
  char newPath[300];
  int result;

  result = 0;

  switch(tableKey)
  {
    case 31:
    {
      snprintf(newPath, elcount(newPath), "%s.%s", oldPath, "travelerInformation");
      SetTravelerInformation_TravelerInformationParams(packetHandle, value.travelerInformation, newPath);
      result = CheckLastError("TravelerInformation", gkFuncRefGet, result);
    }
    break;
  }
  return result;
}

int API_GetTravelerInformationParams(LONG packetHandle, struct TravelerInformation value)
{
  int result;
  result = 0;

  value.messageId = C2xGetTokenInt(packetHandle, "TravelerInformation", "messageId");
  result = CheckLastError("TravelerInformation", gkFuncRefGet, result);

  GetTravelerInformationMESSAGE_ID_AND_TYPEParams(packetHandle, value.messageId, value.value, "value");
  result = CheckLastError("TravelerInformation", gkFuncRefGet, result);

  return result;
}

int API_SetTravelerInformationParams(LONG packetHandle, struct TravelerInformation value)
{
  int result;
  result = 0;

  value.messageId = 31;

  SetTravelerInformationMESSAGE_ID_AND_TYPEParams(packetHandle, value.messageId, value.value, "value");
  result = CheckLastError("TravelerInformation", gkFuncRefGet, result);

  return result;
}

