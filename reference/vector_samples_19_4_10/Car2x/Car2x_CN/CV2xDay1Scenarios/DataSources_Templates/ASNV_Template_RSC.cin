/*@!Encoding:1252*/
/*
//  (c) Vector Informatik GmbH. All rights reserved.
//
//  This file contains definitions of structs and methods that may be used
//  to set and get the values of an ASN.1 defined packet's payload.
//
//  //This example demonstrates how to set a packet's payload:
//  LONG packetHandle;
//  struct RSC payload;
//  //you need to set the values of the variable "payload" yourself
//  packetHandle = API_InitRSCPacket();
//  if (packetHandle!=0) {
//    if (API_SetRSCParams(packetHandle, payload)==0) {
//      if (C2xCompletePacket(packetHandle)==0) {
//        C2xOutputPacket(packetHandle);
//      }
//    }
//  }
//                                                                             */
includes
{
}
variables
{
    struct RSCRoadsideCoordination_id {
        INT isValidFlag;   // necessary if this struct is used as an optional field of a SEQUENCE
        CHAR string[9];
        INT  stringLength;
    };
    
    struct RSCPosition3D {
        INT isValidFlag;   // necessary if this struct is used as an optional field of a SEQUENCE
        LONG lat;  // INTEGER, -900000000..900000001;
        LONG lon;  // INTEGER, -1799999999..1800000001;
        struct OPT_LONG_ASN elevation;  // INTEGER, OPTIONAL, -4096..61439;
    };
    
    struct RSCVehicleCoordination_vehId {
        INT isValidFlag;   // necessary if this struct is used as an optional field of a SEQUENCE
        CHAR string[9];
        INT  stringLength;
    };
    
    struct RSCDriveBehavior {
        INT isValidFlag;   // necessary if this struct is used as an optional field of a SEQUENCE
        CHAR string[15];
        INT  stringLength;
    };
    
    struct RSCNodeReferenceID {
        INT isValidFlag;   // necessary if this struct is used as an optional field of a SEQUENCE
        struct OPT_WORD_ASN region;  // INTEGER, OPTIONAL, 0..65535;
        WORD id;  // INTEGER, 0..65535;
    };
    
    struct RSCReferenceLanes {
        INT isValidFlag;   // necessary if this struct is used as an optional field of a SEQUENCE
        CHAR string[17];
        INT  stringLength;
    };
    
    struct RSCReferenceLink {
        INT isValidFlag;   // necessary if this struct is used as an optional field of a SEQUENCE
        struct RSCNodeReferenceID upstreamNodeId;  // SEQUENCE;
        struct RSCNodeReferenceID downstreamNodeId;  // SEQUENCE;
        struct RSCReferenceLanes referenceLanes;  // BITSTRING, OPTIONAL;
    };
    
    struct RSCPosition_LL_24B {
        INT isValidFlag;   // necessary if this struct is used as an optional field of a SEQUENCE
        INT lon;  // INTEGER, -2048..2047;
        INT lat;  // INTEGER, -2048..2047;
    };
    
    struct RSCPosition_LL_28B {
        INT isValidFlag;   // necessary if this struct is used as an optional field of a SEQUENCE
        INT lon;  // INTEGER, -8192..8191;
        INT lat;  // INTEGER, -8192..8191;
    };
    
    struct RSCPosition_LL_32B {
        INT isValidFlag;   // necessary if this struct is used as an optional field of a SEQUENCE
        INT lon;  // INTEGER, -32768..32767;
        INT lat;  // INTEGER, -32768..32767;
    };
    
    struct RSCPosition_LL_36B {
        INT isValidFlag;   // necessary if this struct is used as an optional field of a SEQUENCE
        LONG lon;  // INTEGER, -131072..131071;
        LONG lat;  // INTEGER, -131072..131071;
    };
    
    struct RSCPosition_LL_44B {
        INT isValidFlag;   // necessary if this struct is used as an optional field of a SEQUENCE
        LONG lon;  // INTEGER, -2097152..2097151;
        LONG lat;  // INTEGER, -2097152..2097151;
    };
    
    struct RSCPosition_LL_48B {
        INT isValidFlag;   // necessary if this struct is used as an optional field of a SEQUENCE
        LONG lon;  // INTEGER, -8388608..8388607;
        LONG lat;  // INTEGER, -8388608..8388607;
    };
    
    struct RSCPosition_LLmD_64b {
        INT isValidFlag;   // necessary if this struct is used as an optional field of a SEQUENCE
        LONG lon;  // INTEGER, -1799999999..1800000001;
        LONG lat;  // INTEGER, -900000000..900000001;
    };
    
    struct RSCPositionOffsetLL {
        INT isValidFlag;   // necessary if this struct is used as an optional field of a SEQUENCE
        INT choice;
        struct RSCPosition_LL_24B position_LL1;  // SEQUENCE;
        struct RSCPosition_LL_28B position_LL2;  // SEQUENCE;
        struct RSCPosition_LL_32B position_LL3;  // SEQUENCE;
        struct RSCPosition_LL_36B position_LL4;  // SEQUENCE;
        struct RSCPosition_LL_44B position_LL5;  // SEQUENCE;
        struct RSCPosition_LL_48B position_LL6;  // SEQUENCE;
        struct RSCPosition_LLmD_64b position_LatLon;  // SEQUENCE;
    };
    
    struct RSCVerticalOffset {
        INT isValidFlag;   // necessary if this struct is used as an optional field of a SEQUENCE
        INT choice;
        INT offset1;  // INTEGER, -64..63;
        INT offset2;  // INTEGER, -128..127;
        INT offset3;  // INTEGER, -256..255;
        INT offset4;  // INTEGER, -512..511;
        INT offset5;  // INTEGER, -1024..1023;
        INT offset6;  // INTEGER, -2048..2047;
        LONG elevation;  // INTEGER, -4096..61439;
    };
    
    struct RSCPositionOffsetLLV {
        INT isValidFlag;   // necessary if this struct is used as an optional field of a SEQUENCE
        struct RSCPositionOffsetLL offsetLL;  // CHOICE;
        struct RSCVerticalOffset offsetV;  // CHOICE, OPTIONAL;
    };
    
    struct RSCPathPointList {
        INT isValidFlag;   // necessary if this struct is used as an optional field of a SEQUENCE
        INT length;
        struct RSCPositionOffsetLLV arrayValue[32];  // SEQUENCE;
    };
    
    struct RSCReferencePath {
        INT isValidFlag;   // necessary if this struct is used as an optional field of a SEQUENCE
        struct RSCPathPointList activePath;  // SEQUENCEOF;
        WORD pathRadius;  // INTEGER, 0..65535;
    };
    
    struct RSCDriveSuggestion {
        INT isValidFlag;   // necessary if this struct is used as an optional field of a SEQUENCE
        struct RSCDriveBehavior suggestion;  // BITSTRING;
        struct OPT_WORD_ASN lifeTime;  // INTEGER, OPTIONAL, 1..65535;
        struct RSCReferenceLink relatedLink;  // SEQUENCE, OPTIONAL;
        struct RSCReferencePath relatedPath;  // SEQUENCE, OPTIONAL;
    };
    
    struct RSCPositionConfidenceSet {
        INT isValidFlag;   // necessary if this struct is used as an optional field of a SEQUENCE
        INT pos;  // ENUMERATED, unavailable(0), a500m(1), a200m(2), a100m(3), a50m(4), a20m(5), a10m(6), a5m(7), a2m(8), a1m(9), a50cm(10), a20cm(11), a10cm(12), a5cm(13), a2cm(14), a1cm(15);
        struct OPT_ENUM_ASN elevation;  // ENUMERATED, OPTIONAL, unavailable(0), elev_500_00(1), elev_200_00(2), elev_100_00(3), elev_050_00(4), elev_020_00(5), elev_010_00(6), elev_005_00(7), elev_002_00(8), elev_001_00(9), elev_000_50(10), elev_000_20(11), elev_000_10(12), elev_000_05(13), elev_000_02(14), elev_000_01(15);
    };
    
    struct RSCAccelerationSet4Way {
        INT isValidFlag;   // necessary if this struct is used as an optional field of a SEQUENCE
        INT lon;  // INTEGER, -2000..2001;
        INT lat;  // INTEGER, -2000..2001;
        INT vert;  // INTEGER, -127..127;
        INT yaw;  // INTEGER, -32767..32767;
    };
    
    struct RSCAccSet4WayConfidence {
        INT isValidFlag;   // necessary if this struct is used as an optional field of a SEQUENCE
        INT lonAccConfidence;  // ENUMERATED, unavailable(0), prec100deg(1), prec10deg(2), prec5deg(3), prec1deg(4), prec0_1deg(5), prec0_05deg(6), prec0_01deg(7);
        INT latAccConfidence;  // ENUMERATED, unavailable(0), prec100deg(1), prec10deg(2), prec5deg(3), prec1deg(4), prec0_1deg(5), prec0_05deg(6), prec0_01deg(7);
        INT vertAccConfidence;  // ENUMERATED, unavailable(0), prec100deg(1), prec10deg(2), prec5deg(3), prec1deg(4), prec0_1deg(5), prec0_05deg(6), prec0_01deg(7);
        INT yawRateCon;  // ENUMERATED, unavailable(0), prec100deg(1), prec10deg(2), prec5deg(3), prec1deg(4), prec0_1deg(5), prec0_05deg(6), prec0_01deg(7);
    };
    
    struct RSCPathPlanningPoint {
        INT isValidFlag;   // necessary if this struct is used as an optional field of a SEQUENCE
        struct RSCReferenceLink posInMap;  // SEQUENCE, OPTIONAL;
        struct RSCPositionOffsetLLV pos;  // SEQUENCE;
        struct RSCPositionConfidenceSet posAccuracy;  // SEQUENCE, OPTIONAL;
        struct OPT_WORD_ASN speed;  // INTEGER, OPTIONAL, 0..8191;
        struct OPT_ENUM_ASN speedCfd;  // ENUMERATED, OPTIONAL, unavailable(0), prec100ms(1), prec10ms(2), prec5ms(3), prec1ms(4), prec0_1ms(5), prec0_05ms(6), prec0_01ms(7);
        struct OPT_WORD_ASN heading;  // INTEGER, OPTIONAL, 0..28800;
        struct OPT_ENUM_ASN headingCfd;  // ENUMERATED, OPTIONAL, unavailable(0), prec10deg(1), prec05deg(2), prec01deg(3), prec0_1deg(4), prec0_05deg(5), prec0_01deg(6), prec0_0125deg(7);
        struct RSCAccelerationSet4Way accelSet;  // SEQUENCE, OPTIONAL;
        struct RSCAccSet4WayConfidence acc4WayConfidence;  // SEQUENCE, OPTIONAL;
        struct OPT_WORD_ASN estimatedTime;  // INTEGER, OPTIONAL, 1..65535;
        struct OPT_BYTE_ASN timeConfidence;  // INTEGER, OPTIONAL, 0..200;
    };
    
    struct RSCPathPlanning {
        INT isValidFlag;   // necessary if this struct is used as an optional field of a SEQUENCE
        INT length;
        struct RSCPathPlanningPoint arrayValue[100];  // SEQUENCE;
    };
    
    struct RSCCoordinationInfo {
        INT isValidFlag;   // necessary if this struct is used as an optional field of a SEQUENCE
        CHAR string[9];
        INT  stringLength;
    };
    
    struct RSCVehicleCoordination {
        INT isValidFlag;   // necessary if this struct is used as an optional field of a SEQUENCE
        struct RSCVehicleCoordination_vehId vehId;  // OCTETSTRING;
        struct RSCDriveSuggestion driveSuggestion;  // SEQUENCE, OPTIONAL;
        struct RSCPathPlanning pathGuidance;  // SEQUENCEOF, OPTIONAL;
        struct RSCCoordinationInfo info;  // BITSTRING, OPTIONAL;
    };
    
    struct RSCRoadsideCoordination_coordinates {
        INT isValidFlag;   // necessary if this struct is used as an optional field of a SEQUENCE
        INT length;
        struct RSCVehicleCoordination arrayValue[16];  // SEQUENCE;
    };
    
    struct RSCDDateTime {
        INT isValidFlag;   // necessary if this struct is used as an optional field of a SEQUENCE
        struct OPT_WORD_ASN year;  // INTEGER, OPTIONAL, 0..4095;
        struct OPT_BYTE_ASN month;  // INTEGER, OPTIONAL, 0..12;
        struct OPT_BYTE_ASN day;  // INTEGER, OPTIONAL, 0..31;
        struct OPT_BYTE_ASN hour;  // INTEGER, OPTIONAL, 0..24;
        struct OPT_BYTE_ASN minute;  // INTEGER, OPTIONAL, 0..60;
        struct OPT_WORD_ASN second;  // INTEGER, OPTIONAL, 0..65535;
        struct OPT_INT_ASN offset;  // INTEGER, OPTIONAL, -720..721;
    };
    
    struct RSCDescription_textString {
        INT isValidFlag;   // necessary if this struct is used as an optional field of a SEQUENCE
        CHAR string[513];
        INT  stringLength;
    };
    
    struct RSCDescription_textGB2312 {
        INT isValidFlag;   // necessary if this struct is used as an optional field of a SEQUENCE
        CHAR string[513];
        INT  stringLength;
    };
    
    struct RSCDescription {
        INT isValidFlag;   // necessary if this struct is used as an optional field of a SEQUENCE
        INT choice;
        struct RSCDescription_textString textString;  // IA5STRING;
        struct RSCDescription_textGB2312 textGB2312;  // OCTETSTRING;
    };
    
    struct RSCLaneCoordination {
        INT isValidFlag;   // necessary if this struct is used as an optional field of a SEQUENCE
        struct RSCReferenceLink targetLane;  // SEQUENCE;
        struct RSCReferencePath relatedPath;  // SEQUENCE, OPTIONAL;
        struct RSCDDateTime tBegin;  // SEQUENCE, OPTIONAL;
        struct RSCDDateTime tEnd;  // SEQUENCE, OPTIONAL;
        struct OPT_WORD_ASN recommendedSpeed;  // INTEGER, OPTIONAL, 0..8191;
        struct RSCDriveBehavior recommendedBehavior;  // BITSTRING, OPTIONAL;
        struct RSCCoordinationInfo info;  // BITSTRING, OPTIONAL;
        struct RSCDescription description;  // CHOICE, OPTIONAL;
    };
    
    struct RSCRoadsideCoordination_laneCoordinates {
        INT isValidFlag;   // necessary if this struct is used as an optional field of a SEQUENCE
        INT length;
        struct RSCLaneCoordination arrayValue[8];  // SEQUENCE;
    };
    
    struct RSCRSC_RoadsideCoordination {
        INT isValidFlag;   // necessary if this struct is used as an optional field of a SEQUENCE
        BYTE msgCnt;  // INTEGER, 0..127;
        struct RSCRoadsideCoordination_id id;  // OCTETSTRING;
        WORD secMark;  // INTEGER, 0..65535;
        struct RSCPosition3D refPos;  // SEQUENCE;
        struct RSCRoadsideCoordination_coordinates coordinates;  // SEQUENCEOF, OPTIONAL;
        struct RSCRoadsideCoordination_laneCoordinates laneCoordinates;  // SEQUENCEOF, OPTIONAL;
    };
    
    struct RSCMessageTypes {
        struct RSCRSC_RoadsideCoordination rscData;  // SEQUENCE;
    };
    
    struct RSCMessageFrameExt {
        INT isValidFlag;   // necessary if this struct is used as an optional field of a SEQUENCE
        WORD messageId;  // INTEGER, 0..32767;
        struct RSCMessageTypes value;  // TABLE;
    };
    
    struct RSC {
        INT isValidFlag;   // necessary if this struct is used as an optional field of a SEQUENCE
        INT choice;
        struct RSCMessageFrameExt msgFrameExt;  // SEQUENCE;
    };
    
}

/*
// init function to create a simple packet handle
*/ 
LONG API_InitRSCPacket()
{
  return C2xInitPacket("RSC"); 
}

/*
// init function to create a simple packet handle and
// initialize the struct with valid data
*/ 
LONG API_InitRSCPacket(struct RSC msgStruct)
{
  long pktHandle;

  pktHandle = API_InitRSCPacket();

  if (pktHandle != 0)
  {
    // create valid message and application data
    if (C2xCompletePacket(pktHandle) == 0) 
    {
      API_GetRSCParams(pktHandle, msgStruct);
    }
  }
  return pktHandle;
}

/*
// init function to create a packet with security layer and
// initialize the struct with valid data
*/ 
LONG API_InitRSCPacket(struct RSC msgStruct, char packetTypeDesignator[], char certificateName[])
{
  long pktHandle, certHdl;

  // initialize the packet
  pktHandle = C2xInitPacket("RSC", packetTypeDesignator);

  if (pktHandle != 0)
  {
    certHdl = C2xSecCertificateGetHandle(certificateName);  // get the certificate handle for the cert with name "certificateName"
    if (certHdl != 0) 
    {
      C2xSecPacketSetSignerHandle(pktHandle, certHdl); // set the certHdl to the packet
    }

    // create valid message and application data
    if (C2xCompletePacket(pktHandle) == 0) 
    {
      // copy application data to the application structure
      API_GetRSCParams(pktHandle, msgStruct);
    }
  }
  return pktHandle;
}
    

int GetRSCPosition3DParams(LONG packetHandle, struct RSCPosition3D value, char oldPath[])
{
  char newPath[300];
  int result;

  result = 0;

  snprintf(newPath, elcount(newPath), "%s.%s", oldPath, "lat");
  value.lat = C2xGetTokenInt(packetHandle, "RSC", newPath);
  result = CheckLastError("RSC", gkFuncRefGet, result);

  snprintf(newPath, elcount(newPath), "%s.%s", oldPath, "lon");
  value.lon = C2xGetTokenInt(packetHandle, "RSC", newPath);
  result = CheckLastError("RSC", gkFuncRefGet, result);

  snprintf(newPath, elcount(newPath), "%s.%s", oldPath, "elevation");
  value.elevation.isValidFlag = C2xIsTokenAvailable(packetHandle, "RSC", newPath);
  if(value.elevation.isValidFlag==1)
  {
    value.elevation.value = C2xGetTokenInt(packetHandle, "RSC", newPath);
    result = CheckLastError("RSC", gkFuncRefGet, result);
  }
  return result;
}

int SetRSCPosition3DParams(LONG packetHandle, struct RSCPosition3D value, char oldPath[])
{
  char newPath[300];
  int result;

  result = 0;

  snprintf(newPath, elcount(newPath), "%s.%s", oldPath, "lat");
  C2xSetTokenInt(packetHandle, "RSC", newPath, value.lat);
  result = CheckLastError("RSC", gkFuncRefGet, result);

  snprintf(newPath, elcount(newPath), "%s.%s", oldPath, "lon");
  C2xSetTokenInt(packetHandle, "RSC", newPath, value.lon);
  result = CheckLastError("RSC", gkFuncRefGet, result);

  snprintf(newPath, elcount(newPath), "%s.%s", oldPath, "elevation");
  if(value.elevation.isValidFlag==1)
  {
    C2xSetTokenInt(packetHandle, "RSC", newPath, value.elevation.value);
    result = CheckLastError("RSC", gkFuncRefGet, result);
  }
  else
  {
    if( C2xIsTokenAvailable(packetHandle, "RSC", newPath) )
    {
      C2xRemoveToken(packetHandle, "RSC", newPath);
    }
  }

  return result;
}

int GetRSCNodeReferenceIDParams(LONG packetHandle, struct RSCNodeReferenceID value, char oldPath[])
{
  char newPath[300];
  int result;

  result = 0;

  snprintf(newPath, elcount(newPath), "%s.%s", oldPath, "region");
  value.region.isValidFlag = C2xIsTokenAvailable(packetHandle, "RSC", newPath);
  if(value.region.isValidFlag==1)
  {
    value.region.value = C2xGetTokenInt(packetHandle, "RSC", newPath);
    result = CheckLastError("RSC", gkFuncRefGet, result);
  }
  snprintf(newPath, elcount(newPath), "%s.%s", oldPath, "id");
  value.id = C2xGetTokenInt(packetHandle, "RSC", newPath);
  result = CheckLastError("RSC", gkFuncRefGet, result);

  return result;
}

int SetRSCNodeReferenceIDParams(LONG packetHandle, struct RSCNodeReferenceID value, char oldPath[])
{
  char newPath[300];
  int result;

  result = 0;

  snprintf(newPath, elcount(newPath), "%s.%s", oldPath, "region");
  if(value.region.isValidFlag==1)
  {
    C2xSetTokenInt(packetHandle, "RSC", newPath, value.region.value);
    result = CheckLastError("RSC", gkFuncRefGet, result);
  }
  else
  {
    if( C2xIsTokenAvailable(packetHandle, "RSC", newPath) )
    {
      C2xRemoveToken(packetHandle, "RSC", newPath);
    }
  }

  snprintf(newPath, elcount(newPath), "%s.%s", oldPath, "id");
  C2xSetTokenInt(packetHandle, "RSC", newPath, value.id);
  result = CheckLastError("RSC", gkFuncRefGet, result);

  return result;
}

int GetRSCReferenceLinkParams(LONG packetHandle, struct RSCReferenceLink value, char oldPath[])
{
  char newPath[300]; 
  int j; 
  int k;
  int result;

  result = 0;

  snprintf(newPath, elcount(newPath), "%s.%s", oldPath, "upstreamNodeId");
  GetRSCNodeReferenceIDParams(packetHandle, value.upstreamNodeId, newPath);
  result = CheckLastError("RSC", gkFuncRefGet, result);

  snprintf(newPath, elcount(newPath), "%s.%s", oldPath, "downstreamNodeId");
  GetRSCNodeReferenceIDParams(packetHandle, value.downstreamNodeId, newPath);
  result = CheckLastError("RSC", gkFuncRefGet, result);

  snprintf(newPath, elcount(newPath), "%s.%s", oldPath, "referenceLanes");
  value.referenceLanes.isValidFlag = C2xIsTokenAvailable(packetHandle, "RSC", newPath);
  if(value.referenceLanes.isValidFlag==1)
  {
    value.referenceLanes.isValidFlag = 1;
    value.referenceLanes.stringLength = C2xGetTokenLengthBit(packetHandle, "RSC", newPath);
    if ((result = CheckLastError("RSC", gkFuncRefGet, result))==0)
    {
      if(value.referenceLanes.stringLength > 0)
      {
        for(j=0; j<value.referenceLanes.stringLength; j++)
        {
          if(C2xGetTokenBitOfBitString(packetHandle, "RSC", newPath, j) == 0)
          {
            value.referenceLanes.string[j] = '0';
          }
          else if(C2xGetTokenBitOfBitString(packetHandle, "RSC", newPath, j) == 1)
          {
            value.referenceLanes.string[j] = '1';
          }

          if(value.referenceLanes.stringLength == 1)
          {
            value.referenceLanes.string[1] = '0';
          }
          result = CheckLastError("RSC", gkFuncRefGet, result);
        }
      }
      else
      {
        for(k = value.referenceLanes.stringLength+1; k > -1; k--)
        {
          if(value.referenceLanes.string[k] == '1')
          {
            value.referenceLanes.string[k] = '0';
          }
        }
      }
    }

  }
  return result;
}

int SetRSCReferenceLinkParams(LONG packetHandle, struct RSCReferenceLink value, char oldPath[])
{
  char newPath[300]; 
  int j;
  int result;

  result = 0;

  snprintf(newPath, elcount(newPath), "%s.%s", oldPath, "upstreamNodeId");
  SetRSCNodeReferenceIDParams(packetHandle, value.upstreamNodeId, newPath);
  result = CheckLastError("RSC", gkFuncRefGet, result);

  snprintf(newPath, elcount(newPath), "%s.%s", oldPath, "downstreamNodeId");
  SetRSCNodeReferenceIDParams(packetHandle, value.downstreamNodeId, newPath);
  result = CheckLastError("RSC", gkFuncRefGet, result);

  snprintf(newPath, elcount(newPath), "%s.%s", oldPath, "referenceLanes");
  if(value.referenceLanes.isValidFlag==1)
  {
      for(j=0; j<value.referenceLanes.stringLength; j++)
      {
        if(value.referenceLanes.string[j] == '0')
        {
          C2xSetTokenBitOfBitString(packetHandle, "RSC", newPath, j, 0);
        }
        else
        {
          C2xSetTokenBitOfBitString(packetHandle, "RSC", newPath, j, 1);
        }
        result = CheckLastError("RSC", gkFuncRefGet, result);
      }
  }
  else
  {
    if( C2xIsTokenAvailable(packetHandle, "RSC", newPath) )
    {
      C2xRemoveToken(packetHandle, "RSC", newPath);
    }
  }

  return result;
}

int GetRSCPosition_LL_24BParams(LONG packetHandle, struct RSCPosition_LL_24B value, char oldPath[])
{
  char newPath[300];
  int result;

  result = 0;

  snprintf(newPath, elcount(newPath), "%s.%s", oldPath, "lon");
  value.lon = C2xGetTokenInt(packetHandle, "RSC", newPath);
  result = CheckLastError("RSC", gkFuncRefGet, result);

  snprintf(newPath, elcount(newPath), "%s.%s", oldPath, "lat");
  value.lat = C2xGetTokenInt(packetHandle, "RSC", newPath);
  result = CheckLastError("RSC", gkFuncRefGet, result);

  return result;
}

int SetRSCPosition_LL_24BParams(LONG packetHandle, struct RSCPosition_LL_24B value, char oldPath[])
{
  char newPath[300];
  int result;

  result = 0;

  snprintf(newPath, elcount(newPath), "%s.%s", oldPath, "lon");
  C2xSetTokenInt(packetHandle, "RSC", newPath, value.lon);
  result = CheckLastError("RSC", gkFuncRefGet, result);

  snprintf(newPath, elcount(newPath), "%s.%s", oldPath, "lat");
  C2xSetTokenInt(packetHandle, "RSC", newPath, value.lat);
  result = CheckLastError("RSC", gkFuncRefGet, result);

  return result;
}

int GetRSCPosition_LL_28BParams(LONG packetHandle, struct RSCPosition_LL_28B value, char oldPath[])
{
  char newPath[300];
  int result;

  result = 0;

  snprintf(newPath, elcount(newPath), "%s.%s", oldPath, "lon");
  value.lon = C2xGetTokenInt(packetHandle, "RSC", newPath);
  result = CheckLastError("RSC", gkFuncRefGet, result);

  snprintf(newPath, elcount(newPath), "%s.%s", oldPath, "lat");
  value.lat = C2xGetTokenInt(packetHandle, "RSC", newPath);
  result = CheckLastError("RSC", gkFuncRefGet, result);

  return result;
}

int SetRSCPosition_LL_28BParams(LONG packetHandle, struct RSCPosition_LL_28B value, char oldPath[])
{
  char newPath[300];
  int result;

  result = 0;

  snprintf(newPath, elcount(newPath), "%s.%s", oldPath, "lon");
  C2xSetTokenInt(packetHandle, "RSC", newPath, value.lon);
  result = CheckLastError("RSC", gkFuncRefGet, result);

  snprintf(newPath, elcount(newPath), "%s.%s", oldPath, "lat");
  C2xSetTokenInt(packetHandle, "RSC", newPath, value.lat);
  result = CheckLastError("RSC", gkFuncRefGet, result);

  return result;
}

int GetRSCPosition_LL_32BParams(LONG packetHandle, struct RSCPosition_LL_32B value, char oldPath[])
{
  char newPath[300];
  int result;

  result = 0;

  snprintf(newPath, elcount(newPath), "%s.%s", oldPath, "lon");
  value.lon = C2xGetTokenInt(packetHandle, "RSC", newPath);
  result = CheckLastError("RSC", gkFuncRefGet, result);

  snprintf(newPath, elcount(newPath), "%s.%s", oldPath, "lat");
  value.lat = C2xGetTokenInt(packetHandle, "RSC", newPath);
  result = CheckLastError("RSC", gkFuncRefGet, result);

  return result;
}

int SetRSCPosition_LL_32BParams(LONG packetHandle, struct RSCPosition_LL_32B value, char oldPath[])
{
  char newPath[300];
  int result;

  result = 0;

  snprintf(newPath, elcount(newPath), "%s.%s", oldPath, "lon");
  C2xSetTokenInt(packetHandle, "RSC", newPath, value.lon);
  result = CheckLastError("RSC", gkFuncRefGet, result);

  snprintf(newPath, elcount(newPath), "%s.%s", oldPath, "lat");
  C2xSetTokenInt(packetHandle, "RSC", newPath, value.lat);
  result = CheckLastError("RSC", gkFuncRefGet, result);

  return result;
}

int GetRSCPosition_LL_36BParams(LONG packetHandle, struct RSCPosition_LL_36B value, char oldPath[])
{
  char newPath[300];
  int result;

  result = 0;

  snprintf(newPath, elcount(newPath), "%s.%s", oldPath, "lon");
  value.lon = C2xGetTokenInt(packetHandle, "RSC", newPath);
  result = CheckLastError("RSC", gkFuncRefGet, result);

  snprintf(newPath, elcount(newPath), "%s.%s", oldPath, "lat");
  value.lat = C2xGetTokenInt(packetHandle, "RSC", newPath);
  result = CheckLastError("RSC", gkFuncRefGet, result);

  return result;
}

int SetRSCPosition_LL_36BParams(LONG packetHandle, struct RSCPosition_LL_36B value, char oldPath[])
{
  char newPath[300];
  int result;

  result = 0;

  snprintf(newPath, elcount(newPath), "%s.%s", oldPath, "lon");
  C2xSetTokenInt(packetHandle, "RSC", newPath, value.lon);
  result = CheckLastError("RSC", gkFuncRefGet, result);

  snprintf(newPath, elcount(newPath), "%s.%s", oldPath, "lat");
  C2xSetTokenInt(packetHandle, "RSC", newPath, value.lat);
  result = CheckLastError("RSC", gkFuncRefGet, result);

  return result;
}

int GetRSCPosition_LL_44BParams(LONG packetHandle, struct RSCPosition_LL_44B value, char oldPath[])
{
  char newPath[300];
  int result;

  result = 0;

  snprintf(newPath, elcount(newPath), "%s.%s", oldPath, "lon");
  value.lon = C2xGetTokenInt(packetHandle, "RSC", newPath);
  result = CheckLastError("RSC", gkFuncRefGet, result);

  snprintf(newPath, elcount(newPath), "%s.%s", oldPath, "lat");
  value.lat = C2xGetTokenInt(packetHandle, "RSC", newPath);
  result = CheckLastError("RSC", gkFuncRefGet, result);

  return result;
}

int SetRSCPosition_LL_44BParams(LONG packetHandle, struct RSCPosition_LL_44B value, char oldPath[])
{
  char newPath[300];
  int result;

  result = 0;

  snprintf(newPath, elcount(newPath), "%s.%s", oldPath, "lon");
  C2xSetTokenInt(packetHandle, "RSC", newPath, value.lon);
  result = CheckLastError("RSC", gkFuncRefGet, result);

  snprintf(newPath, elcount(newPath), "%s.%s", oldPath, "lat");
  C2xSetTokenInt(packetHandle, "RSC", newPath, value.lat);
  result = CheckLastError("RSC", gkFuncRefGet, result);

  return result;
}

int GetRSCPosition_LL_48BParams(LONG packetHandle, struct RSCPosition_LL_48B value, char oldPath[])
{
  char newPath[300];
  int result;

  result = 0;

  snprintf(newPath, elcount(newPath), "%s.%s", oldPath, "lon");
  value.lon = C2xGetTokenInt(packetHandle, "RSC", newPath);
  result = CheckLastError("RSC", gkFuncRefGet, result);

  snprintf(newPath, elcount(newPath), "%s.%s", oldPath, "lat");
  value.lat = C2xGetTokenInt(packetHandle, "RSC", newPath);
  result = CheckLastError("RSC", gkFuncRefGet, result);

  return result;
}

int SetRSCPosition_LL_48BParams(LONG packetHandle, struct RSCPosition_LL_48B value, char oldPath[])
{
  char newPath[300];
  int result;

  result = 0;

  snprintf(newPath, elcount(newPath), "%s.%s", oldPath, "lon");
  C2xSetTokenInt(packetHandle, "RSC", newPath, value.lon);
  result = CheckLastError("RSC", gkFuncRefGet, result);

  snprintf(newPath, elcount(newPath), "%s.%s", oldPath, "lat");
  C2xSetTokenInt(packetHandle, "RSC", newPath, value.lat);
  result = CheckLastError("RSC", gkFuncRefGet, result);

  return result;
}

int GetRSCPosition_LLmD_64bParams(LONG packetHandle, struct RSCPosition_LLmD_64b value, char oldPath[])
{
  char newPath[300];
  int result;

  result = 0;

  snprintf(newPath, elcount(newPath), "%s.%s", oldPath, "lon");
  value.lon = C2xGetTokenInt(packetHandle, "RSC", newPath);
  result = CheckLastError("RSC", gkFuncRefGet, result);

  snprintf(newPath, elcount(newPath), "%s.%s", oldPath, "lat");
  value.lat = C2xGetTokenInt(packetHandle, "RSC", newPath);
  result = CheckLastError("RSC", gkFuncRefGet, result);

  return result;
}

int SetRSCPosition_LLmD_64bParams(LONG packetHandle, struct RSCPosition_LLmD_64b value, char oldPath[])
{
  char newPath[300];
  int result;

  result = 0;

  snprintf(newPath, elcount(newPath), "%s.%s", oldPath, "lon");
  C2xSetTokenInt(packetHandle, "RSC", newPath, value.lon);
  result = CheckLastError("RSC", gkFuncRefGet, result);

  snprintf(newPath, elcount(newPath), "%s.%s", oldPath, "lat");
  C2xSetTokenInt(packetHandle, "RSC", newPath, value.lat);
  result = CheckLastError("RSC", gkFuncRefGet, result);

  return result;
}

int GetRSCPositionOffsetLLParams(LONG packetHandle, struct RSCPositionOffsetLL value, char oldPath[])
{
  char newPath[300];
  int result;

  result = 0;

  value.choice = C2xGetTokenInt(packetHandle, "RSC", oldPath);

  switch(value.choice)
  {
    case 0:
    {
      snprintf(newPath, elcount(newPath), "%s.%s", oldPath, "position_LL1");
      GetRSCPosition_LL_24BParams(packetHandle, value.position_LL1, newPath);
      result = CheckLastError("RSC", gkFuncRefGet, result);
    }
    break;
    case 1:
    {
      snprintf(newPath, elcount(newPath), "%s.%s", oldPath, "position_LL2");
      GetRSCPosition_LL_28BParams(packetHandle, value.position_LL2, newPath);
      result = CheckLastError("RSC", gkFuncRefGet, result);
    }
    break;
    case 2:
    {
      snprintf(newPath, elcount(newPath), "%s.%s", oldPath, "position_LL3");
      GetRSCPosition_LL_32BParams(packetHandle, value.position_LL3, newPath);
      result = CheckLastError("RSC", gkFuncRefGet, result);
    }
    break;
    case 3:
    {
      snprintf(newPath, elcount(newPath), "%s.%s", oldPath, "position_LL4");
      GetRSCPosition_LL_36BParams(packetHandle, value.position_LL4, newPath);
      result = CheckLastError("RSC", gkFuncRefGet, result);
    }
    break;
    case 4:
    {
      snprintf(newPath, elcount(newPath), "%s.%s", oldPath, "position_LL5");
      GetRSCPosition_LL_44BParams(packetHandle, value.position_LL5, newPath);
      result = CheckLastError("RSC", gkFuncRefGet, result);
    }
    break;
    case 5:
    {
      snprintf(newPath, elcount(newPath), "%s.%s", oldPath, "position_LL6");
      GetRSCPosition_LL_48BParams(packetHandle, value.position_LL6, newPath);
      result = CheckLastError("RSC", gkFuncRefGet, result);
    }
    break;
    case 6:
    {
      snprintf(newPath, elcount(newPath), "%s.%s", oldPath, "position_LatLon");
      GetRSCPosition_LLmD_64bParams(packetHandle, value.position_LatLon, newPath);
      result = CheckLastError("RSC", gkFuncRefGet, result);
    }
    break;
  }
  return result;
}

int SetRSCPositionOffsetLLParams(LONG packetHandle, struct RSCPositionOffsetLL value, char oldPath[])
{
  char newPath[300];
  int result;

  result = 0;

  switch(value.choice)
  {
    case 0:
    {
      snprintf(newPath, elcount(newPath), "%s.%s", oldPath, "position_LL1");
      SetRSCPosition_LL_24BParams(packetHandle, value.position_LL1, newPath);
      result = CheckLastError("RSC", gkFuncRefGet, result);
    }
    break;
    case 1:
    {
      snprintf(newPath, elcount(newPath), "%s.%s", oldPath, "position_LL2");
      SetRSCPosition_LL_28BParams(packetHandle, value.position_LL2, newPath);
      result = CheckLastError("RSC", gkFuncRefGet, result);
    }
    break;
    case 2:
    {
      snprintf(newPath, elcount(newPath), "%s.%s", oldPath, "position_LL3");
      SetRSCPosition_LL_32BParams(packetHandle, value.position_LL3, newPath);
      result = CheckLastError("RSC", gkFuncRefGet, result);
    }
    break;
    case 3:
    {
      snprintf(newPath, elcount(newPath), "%s.%s", oldPath, "position_LL4");
      SetRSCPosition_LL_36BParams(packetHandle, value.position_LL4, newPath);
      result = CheckLastError("RSC", gkFuncRefGet, result);
    }
    break;
    case 4:
    {
      snprintf(newPath, elcount(newPath), "%s.%s", oldPath, "position_LL5");
      SetRSCPosition_LL_44BParams(packetHandle, value.position_LL5, newPath);
      result = CheckLastError("RSC", gkFuncRefGet, result);
    }
    break;
    case 5:
    {
      snprintf(newPath, elcount(newPath), "%s.%s", oldPath, "position_LL6");
      SetRSCPosition_LL_48BParams(packetHandle, value.position_LL6, newPath);
      result = CheckLastError("RSC", gkFuncRefGet, result);
    }
    break;
    case 6:
    {
      snprintf(newPath, elcount(newPath), "%s.%s", oldPath, "position_LatLon");
      SetRSCPosition_LLmD_64bParams(packetHandle, value.position_LatLon, newPath);
      result = CheckLastError("RSC", gkFuncRefGet, result);
    }
    break;
  }
  return result;
}

int GetRSCVerticalOffsetParams(LONG packetHandle, struct RSCVerticalOffset value, char oldPath[])
{
  char newPath[300];
  int result;

  result = 0;

  value.choice = C2xGetTokenInt(packetHandle, "RSC", oldPath);

  switch(value.choice)
  {
    case 0:
    {
      snprintf(newPath, elcount(newPath), "%s.%s", oldPath, "offset1");
      value.offset1 = C2xGetTokenInt(packetHandle, "RSC", newPath);
      result = CheckLastError("RSC", gkFuncRefGet, result);
    }
    break;
    case 1:
    {
      snprintf(newPath, elcount(newPath), "%s.%s", oldPath, "offset2");
      value.offset2 = C2xGetTokenInt(packetHandle, "RSC", newPath);
      result = CheckLastError("RSC", gkFuncRefGet, result);
    }
    break;
    case 2:
    {
      snprintf(newPath, elcount(newPath), "%s.%s", oldPath, "offset3");
      value.offset3 = C2xGetTokenInt(packetHandle, "RSC", newPath);
      result = CheckLastError("RSC", gkFuncRefGet, result);
    }
    break;
    case 3:
    {
      snprintf(newPath, elcount(newPath), "%s.%s", oldPath, "offset4");
      value.offset4 = C2xGetTokenInt(packetHandle, "RSC", newPath);
      result = CheckLastError("RSC", gkFuncRefGet, result);
    }
    break;
    case 4:
    {
      snprintf(newPath, elcount(newPath), "%s.%s", oldPath, "offset5");
      value.offset5 = C2xGetTokenInt(packetHandle, "RSC", newPath);
      result = CheckLastError("RSC", gkFuncRefGet, result);
    }
    break;
    case 5:
    {
      snprintf(newPath, elcount(newPath), "%s.%s", oldPath, "offset6");
      value.offset6 = C2xGetTokenInt(packetHandle, "RSC", newPath);
      result = CheckLastError("RSC", gkFuncRefGet, result);
    }
    break;
    case 6:
    {
      snprintf(newPath, elcount(newPath), "%s.%s", oldPath, "elevation");
      value.elevation = C2xGetTokenInt(packetHandle, "RSC", newPath);
      result = CheckLastError("RSC", gkFuncRefGet, result);
    }
    break;
  }
  return result;
}

int SetRSCVerticalOffsetParams(LONG packetHandle, struct RSCVerticalOffset value, char oldPath[])
{
  char newPath[300];
  int result;

  result = 0;

  switch(value.choice)
  {
    case 0:
    {
      snprintf(newPath, elcount(newPath), "%s.%s", oldPath, "offset1");
      C2xSetTokenInt(packetHandle, "RSC", newPath, value.offset1);
      result = CheckLastError("RSC", gkFuncRefGet, result);
    }
    break;
    case 1:
    {
      snprintf(newPath, elcount(newPath), "%s.%s", oldPath, "offset2");
      C2xSetTokenInt(packetHandle, "RSC", newPath, value.offset2);
      result = CheckLastError("RSC", gkFuncRefGet, result);
    }
    break;
    case 2:
    {
      snprintf(newPath, elcount(newPath), "%s.%s", oldPath, "offset3");
      C2xSetTokenInt(packetHandle, "RSC", newPath, value.offset3);
      result = CheckLastError("RSC", gkFuncRefGet, result);
    }
    break;
    case 3:
    {
      snprintf(newPath, elcount(newPath), "%s.%s", oldPath, "offset4");
      C2xSetTokenInt(packetHandle, "RSC", newPath, value.offset4);
      result = CheckLastError("RSC", gkFuncRefGet, result);
    }
    break;
    case 4:
    {
      snprintf(newPath, elcount(newPath), "%s.%s", oldPath, "offset5");
      C2xSetTokenInt(packetHandle, "RSC", newPath, value.offset5);
      result = CheckLastError("RSC", gkFuncRefGet, result);
    }
    break;
    case 5:
    {
      snprintf(newPath, elcount(newPath), "%s.%s", oldPath, "offset6");
      C2xSetTokenInt(packetHandle, "RSC", newPath, value.offset6);
      result = CheckLastError("RSC", gkFuncRefGet, result);
    }
    break;
    case 6:
    {
      snprintf(newPath, elcount(newPath), "%s.%s", oldPath, "elevation");
      C2xSetTokenInt(packetHandle, "RSC", newPath, value.elevation);
      result = CheckLastError("RSC", gkFuncRefGet, result);
    }
    break;
  }
  return result;
}

int GetRSCPositionOffsetLLVParams(LONG packetHandle, struct RSCPositionOffsetLLV value, char oldPath[])
{
  char newPath[300];
  int result;

  result = 0;

  snprintf(newPath, elcount(newPath), "%s.%s", oldPath, "offsetLL");
  GetRSCPositionOffsetLLParams(packetHandle, value.offsetLL, newPath);
  result = CheckLastError("RSC", gkFuncRefGet, result);

  snprintf(newPath, elcount(newPath), "%s.%s", oldPath, "offsetV");
  value.offsetV.isValidFlag = C2xIsTokenAvailable(packetHandle, "RSC", newPath);
  if(value.offsetV.isValidFlag==1)
  {
    GetRSCVerticalOffsetParams(packetHandle, value.offsetV, newPath);
    result = CheckLastError("RSC", gkFuncRefGet, result);
  }
  return result;
}

int SetRSCPositionOffsetLLVParams(LONG packetHandle, struct RSCPositionOffsetLLV value, char oldPath[])
{
  char newPath[300];
  int result;

  result = 0;

  snprintf(newPath, elcount(newPath), "%s.%s", oldPath, "offsetLL");
  SetRSCPositionOffsetLLParams(packetHandle, value.offsetLL, newPath);
  result = CheckLastError("RSC", gkFuncRefGet, result);

  snprintf(newPath, elcount(newPath), "%s.%s", oldPath, "offsetV");
  if(value.offsetV.isValidFlag==1)
  {
    SetRSCVerticalOffsetParams(packetHandle, value.offsetV, newPath);
    result = CheckLastError("RSC", gkFuncRefGet, result);
  }
  else
  {
    if( C2xIsTokenAvailable(packetHandle, "RSC", newPath) )
    {
      C2xRemoveToken(packetHandle, "RSC", newPath);
    }
  }

  return result;
}

int GetRSCPathPointListParams(LONG packetHandle, struct RSCPathPointList value, char oldPath[])
{
  char newPath[300]; 
  int i;
  int result;

  result = 0;

  value.length = C2xGetTokenInt(packetHandle, "RSC", oldPath);
  if((result = CheckLastError("RSC", gkFuncRefGet, result))==0)
  {
    for(i=0; i<value.length; i++)
    {
      snprintf(newPath, elcount(newPath), "%s[%d]", oldPath, i);
      GetRSCPositionOffsetLLVParams(packetHandle, value.arrayValue[i], newPath);
      result = CheckLastError("RSC", gkFuncRefGet, result);
    }
  }
  return result;
}

int SetRSCPathPointListParams(LONG packetHandle, struct RSCPathPointList value, char oldPath[])
{
  char newPath[300]; 
  int i;
  int result;

  result = 0;

  C2xRemoveToken(packetHandle, "RSC", oldPath);
  for(i=0; i<value.length; i++)
  {
    snprintf(newPath, elcount(newPath), "%s[%d]", oldPath, i);
    SetRSCPositionOffsetLLVParams(packetHandle, value.arrayValue[i], newPath);
    result = CheckLastError("RSC", gkFuncRefGet, result);
  }
  return result;
}

int GetRSCReferencePathParams(LONG packetHandle, struct RSCReferencePath value, char oldPath[])
{
  char newPath[300];
  int result;

  result = 0;

  snprintf(newPath, elcount(newPath), "%s.%s", oldPath, "activePath");
  GetRSCPathPointListParams(packetHandle, value.activePath, newPath);
  result = CheckLastError("RSC", gkFuncRefGet, result);

  snprintf(newPath, elcount(newPath), "%s.%s", oldPath, "pathRadius");
  value.pathRadius = C2xGetTokenInt(packetHandle, "RSC", newPath);
  result = CheckLastError("RSC", gkFuncRefGet, result);

  return result;
}

int SetRSCReferencePathParams(LONG packetHandle, struct RSCReferencePath value, char oldPath[])
{
  char newPath[300];
  int result;

  result = 0;

  snprintf(newPath, elcount(newPath), "%s.%s", oldPath, "activePath");
  SetRSCPathPointListParams(packetHandle, value.activePath, newPath);
  result = CheckLastError("RSC", gkFuncRefGet, result);

  snprintf(newPath, elcount(newPath), "%s.%s", oldPath, "pathRadius");
  C2xSetTokenInt(packetHandle, "RSC", newPath, value.pathRadius);
  result = CheckLastError("RSC", gkFuncRefGet, result);

  return result;
}

int GetRSCDriveSuggestionParams(LONG packetHandle, struct RSCDriveSuggestion value, char oldPath[])
{
  char newPath[300]; 
  int j; 
  int k;
  int result;

  result = 0;

  snprintf(newPath, elcount(newPath), "%s.%s", oldPath, "suggestion");
  value.suggestion.isValidFlag = 1;
  value.suggestion.stringLength = C2xGetTokenLengthBit(packetHandle, "RSC", newPath);
  if ((result = CheckLastError("RSC", gkFuncRefGet, result))==0)
  {
    if(value.suggestion.stringLength > 0)
    {
      for(j=0; j<value.suggestion.stringLength; j++)
      {
        if(C2xGetTokenBitOfBitString(packetHandle, "RSC", newPath, j) == 0)
        {
          value.suggestion.string[j] = '0';
        }
        else if(C2xGetTokenBitOfBitString(packetHandle, "RSC", newPath, j) == 1)
        {
          value.suggestion.string[j] = '1';
        }

        if(value.suggestion.stringLength == 1)
        {
          value.suggestion.string[1] = '0';
        }
        result = CheckLastError("RSC", gkFuncRefGet, result);
      }
    }
    else
    {
      for(k = value.suggestion.stringLength+1; k > -1; k--)
      {
        if(value.suggestion.string[k] == '1')
        {
          value.suggestion.string[k] = '0';
        }
      }
    }
  }

  snprintf(newPath, elcount(newPath), "%s.%s", oldPath, "lifeTime");
  value.lifeTime.isValidFlag = C2xIsTokenAvailable(packetHandle, "RSC", newPath);
  if(value.lifeTime.isValidFlag==1)
  {
    value.lifeTime.value = C2xGetTokenInt(packetHandle, "RSC", newPath);
    result = CheckLastError("RSC", gkFuncRefGet, result);
  }
  snprintf(newPath, elcount(newPath), "%s.%s", oldPath, "relatedLink");
  value.relatedLink.isValidFlag = C2xIsTokenAvailable(packetHandle, "RSC", newPath);
  if(value.relatedLink.isValidFlag==1)
  {
    GetRSCReferenceLinkParams(packetHandle, value.relatedLink, newPath);
    result = CheckLastError("RSC", gkFuncRefGet, result);
  }
  snprintf(newPath, elcount(newPath), "%s.%s", oldPath, "relatedPath");
  value.relatedPath.isValidFlag = C2xIsTokenAvailable(packetHandle, "RSC", newPath);
  if(value.relatedPath.isValidFlag==1)
  {
    GetRSCReferencePathParams(packetHandle, value.relatedPath, newPath);
    result = CheckLastError("RSC", gkFuncRefGet, result);
  }
  return result;
}

int SetRSCDriveSuggestionParams(LONG packetHandle, struct RSCDriveSuggestion value, char oldPath[])
{
  char newPath[300]; 
  int j;
  int result;

  result = 0;

  snprintf(newPath, elcount(newPath), "%s.%s", oldPath, "suggestion");
    for(j=0; j<value.suggestion.stringLength; j++)
    {
      if(value.suggestion.string[j] == '0')
      {
        C2xSetTokenBitOfBitString(packetHandle, "RSC", newPath, j, 0);
      }
      else
      {
        C2xSetTokenBitOfBitString(packetHandle, "RSC", newPath, j, 1);
      }
      result = CheckLastError("RSC", gkFuncRefGet, result);
    }

  snprintf(newPath, elcount(newPath), "%s.%s", oldPath, "lifeTime");
  if(value.lifeTime.isValidFlag==1)
  {
    if (value.lifeTime.value < 1)
    {
        C2xSetTokenInt(packetHandle, "RSC", newPath, 1);
    }
    else if (value.lifeTime.value > 65535)
    {
        C2xSetTokenInt(packetHandle, "RSC", newPath, 65535);
    }
    else
    {
        C2xSetTokenInt(packetHandle, "RSC", newPath, value.lifeTime.value);
    }
    result = CheckLastError("RSC", gkFuncRefGet, result);
  }
  else
  {
    if( C2xIsTokenAvailable(packetHandle, "RSC", newPath) )
    {
      C2xRemoveToken(packetHandle, "RSC", newPath);
    }
  }

  snprintf(newPath, elcount(newPath), "%s.%s", oldPath, "relatedLink");
  if(value.relatedLink.isValidFlag==1)
  {
    SetRSCReferenceLinkParams(packetHandle, value.relatedLink, newPath);
    result = CheckLastError("RSC", gkFuncRefGet, result);
  }
  else
  {
    if( C2xIsTokenAvailable(packetHandle, "RSC", newPath) )
    {
      C2xRemoveToken(packetHandle, "RSC", newPath);
    }
  }

  snprintf(newPath, elcount(newPath), "%s.%s", oldPath, "relatedPath");
  if(value.relatedPath.isValidFlag==1)
  {
    SetRSCReferencePathParams(packetHandle, value.relatedPath, newPath);
    result = CheckLastError("RSC", gkFuncRefGet, result);
  }
  else
  {
    if( C2xIsTokenAvailable(packetHandle, "RSC", newPath) )
    {
      C2xRemoveToken(packetHandle, "RSC", newPath);
    }
  }

  return result;
}

int GetRSCPositionConfidenceSetParams(LONG packetHandle, struct RSCPositionConfidenceSet value, char oldPath[])
{
  char newPath[300];
  int result;

  result = 0;

  snprintf(newPath, elcount(newPath), "%s.%s", oldPath, "pos");
  value.pos = C2xGetTokenInt(packetHandle, "RSC", newPath);
  result = CheckLastError("RSC", gkFuncRefGet, result);

  snprintf(newPath, elcount(newPath), "%s.%s", oldPath, "elevation");
  value.elevation.isValidFlag = C2xIsTokenAvailable(packetHandle, "RSC", newPath);
  if(value.elevation.isValidFlag==1)
  {
    value.elevation.value = C2xGetTokenInt(packetHandle, "RSC", newPath);
    result = CheckLastError("RSC", gkFuncRefGet, result);
  }
  return result;
}

int SetRSCPositionConfidenceSetParams(LONG packetHandle, struct RSCPositionConfidenceSet value, char oldPath[])
{
  char newPath[300];
  int result;

  result = 0;

  snprintf(newPath, elcount(newPath), "%s.%s", oldPath, "pos");
  C2xSetTokenInt(packetHandle, "RSC", newPath, value.pos);
  result = CheckLastError("RSC", gkFuncRefGet, result);

  snprintf(newPath, elcount(newPath), "%s.%s", oldPath, "elevation");
  if(value.elevation.isValidFlag==1)
  {
    C2xSetTokenInt(packetHandle, "RSC", newPath, value.elevation.value);
    result = CheckLastError("RSC", gkFuncRefGet, result);
  }
  else
  {
    if( C2xIsTokenAvailable(packetHandle, "RSC", newPath) )
    {
      C2xRemoveToken(packetHandle, "RSC", newPath);
    }
  }

  return result;
}

int GetRSCAccelerationSet4WayParams(LONG packetHandle, struct RSCAccelerationSet4Way value, char oldPath[])
{
  char newPath[300];
  int result;

  result = 0;

  snprintf(newPath, elcount(newPath), "%s.%s", oldPath, "lon");
  value.lon = C2xGetTokenInt(packetHandle, "RSC", newPath);
  result = CheckLastError("RSC", gkFuncRefGet, result);

  snprintf(newPath, elcount(newPath), "%s.%s", oldPath, "lat");
  value.lat = C2xGetTokenInt(packetHandle, "RSC", newPath);
  result = CheckLastError("RSC", gkFuncRefGet, result);

  snprintf(newPath, elcount(newPath), "%s.%s", oldPath, "vert");
  value.vert = C2xGetTokenInt(packetHandle, "RSC", newPath);
  result = CheckLastError("RSC", gkFuncRefGet, result);

  snprintf(newPath, elcount(newPath), "%s.%s", oldPath, "yaw");
  value.yaw = C2xGetTokenInt(packetHandle, "RSC", newPath);
  result = CheckLastError("RSC", gkFuncRefGet, result);

  return result;
}

int SetRSCAccelerationSet4WayParams(LONG packetHandle, struct RSCAccelerationSet4Way value, char oldPath[])
{
  char newPath[300];
  int result;

  result = 0;

  snprintf(newPath, elcount(newPath), "%s.%s", oldPath, "lon");
  C2xSetTokenInt(packetHandle, "RSC", newPath, value.lon);
  result = CheckLastError("RSC", gkFuncRefGet, result);

  snprintf(newPath, elcount(newPath), "%s.%s", oldPath, "lat");
  C2xSetTokenInt(packetHandle, "RSC", newPath, value.lat);
  result = CheckLastError("RSC", gkFuncRefGet, result);

  snprintf(newPath, elcount(newPath), "%s.%s", oldPath, "vert");
  C2xSetTokenInt(packetHandle, "RSC", newPath, value.vert);
  result = CheckLastError("RSC", gkFuncRefGet, result);

  snprintf(newPath, elcount(newPath), "%s.%s", oldPath, "yaw");
  C2xSetTokenInt(packetHandle, "RSC", newPath, value.yaw);
  result = CheckLastError("RSC", gkFuncRefGet, result);

  return result;
}

int GetRSCAccSet4WayConfidenceParams(LONG packetHandle, struct RSCAccSet4WayConfidence value, char oldPath[])
{
  char newPath[300];
  int result;

  result = 0;

  snprintf(newPath, elcount(newPath), "%s.%s", oldPath, "lonAccConfidence");
  value.lonAccConfidence = C2xGetTokenInt(packetHandle, "RSC", newPath);
  result = CheckLastError("RSC", gkFuncRefGet, result);

  snprintf(newPath, elcount(newPath), "%s.%s", oldPath, "latAccConfidence");
  value.latAccConfidence = C2xGetTokenInt(packetHandle, "RSC", newPath);
  result = CheckLastError("RSC", gkFuncRefGet, result);

  snprintf(newPath, elcount(newPath), "%s.%s", oldPath, "vertAccConfidence");
  value.vertAccConfidence = C2xGetTokenInt(packetHandle, "RSC", newPath);
  result = CheckLastError("RSC", gkFuncRefGet, result);

  snprintf(newPath, elcount(newPath), "%s.%s", oldPath, "yawRateCon");
  value.yawRateCon = C2xGetTokenInt(packetHandle, "RSC", newPath);
  result = CheckLastError("RSC", gkFuncRefGet, result);

  return result;
}

int SetRSCAccSet4WayConfidenceParams(LONG packetHandle, struct RSCAccSet4WayConfidence value, char oldPath[])
{
  char newPath[300];
  int result;

  result = 0;

  snprintf(newPath, elcount(newPath), "%s.%s", oldPath, "lonAccConfidence");
  C2xSetTokenInt(packetHandle, "RSC", newPath, value.lonAccConfidence);
  result = CheckLastError("RSC", gkFuncRefGet, result);

  snprintf(newPath, elcount(newPath), "%s.%s", oldPath, "latAccConfidence");
  C2xSetTokenInt(packetHandle, "RSC", newPath, value.latAccConfidence);
  result = CheckLastError("RSC", gkFuncRefGet, result);

  snprintf(newPath, elcount(newPath), "%s.%s", oldPath, "vertAccConfidence");
  C2xSetTokenInt(packetHandle, "RSC", newPath, value.vertAccConfidence);
  result = CheckLastError("RSC", gkFuncRefGet, result);

  snprintf(newPath, elcount(newPath), "%s.%s", oldPath, "yawRateCon");
  C2xSetTokenInt(packetHandle, "RSC", newPath, value.yawRateCon);
  result = CheckLastError("RSC", gkFuncRefGet, result);

  return result;
}

int GetRSCPathPlanningPointParams(LONG packetHandle, struct RSCPathPlanningPoint value, char oldPath[])
{
  char newPath[300];
  int result;

  result = 0;

  snprintf(newPath, elcount(newPath), "%s.%s", oldPath, "posInMap");
  value.posInMap.isValidFlag = C2xIsTokenAvailable(packetHandle, "RSC", newPath);
  if(value.posInMap.isValidFlag==1)
  {
    GetRSCReferenceLinkParams(packetHandle, value.posInMap, newPath);
    result = CheckLastError("RSC", gkFuncRefGet, result);
  }
  snprintf(newPath, elcount(newPath), "%s.%s", oldPath, "pos");
  GetRSCPositionOffsetLLVParams(packetHandle, value.pos, newPath);
  result = CheckLastError("RSC", gkFuncRefGet, result);

  snprintf(newPath, elcount(newPath), "%s.%s", oldPath, "posAccuracy");
  value.posAccuracy.isValidFlag = C2xIsTokenAvailable(packetHandle, "RSC", newPath);
  if(value.posAccuracy.isValidFlag==1)
  {
    GetRSCPositionConfidenceSetParams(packetHandle, value.posAccuracy, newPath);
    result = CheckLastError("RSC", gkFuncRefGet, result);
  }
  snprintf(newPath, elcount(newPath), "%s.%s", oldPath, "speed");
  value.speed.isValidFlag = C2xIsTokenAvailable(packetHandle, "RSC", newPath);
  if(value.speed.isValidFlag==1)
  {
    value.speed.value = C2xGetTokenInt(packetHandle, "RSC", newPath);
    result = CheckLastError("RSC", gkFuncRefGet, result);
  }
  snprintf(newPath, elcount(newPath), "%s.%s", oldPath, "speedCfd");
  value.speedCfd.isValidFlag = C2xIsTokenAvailable(packetHandle, "RSC", newPath);
  if(value.speedCfd.isValidFlag==1)
  {
    value.speedCfd.value = C2xGetTokenInt(packetHandle, "RSC", newPath);
    result = CheckLastError("RSC", gkFuncRefGet, result);
  }
  snprintf(newPath, elcount(newPath), "%s.%s", oldPath, "heading");
  value.heading.isValidFlag = C2xIsTokenAvailable(packetHandle, "RSC", newPath);
  if(value.heading.isValidFlag==1)
  {
    value.heading.value = C2xGetTokenInt(packetHandle, "RSC", newPath);
    result = CheckLastError("RSC", gkFuncRefGet, result);
  }
  snprintf(newPath, elcount(newPath), "%s.%s", oldPath, "headingCfd");
  value.headingCfd.isValidFlag = C2xIsTokenAvailable(packetHandle, "RSC", newPath);
  if(value.headingCfd.isValidFlag==1)
  {
    value.headingCfd.value = C2xGetTokenInt(packetHandle, "RSC", newPath);
    result = CheckLastError("RSC", gkFuncRefGet, result);
  }
  snprintf(newPath, elcount(newPath), "%s.%s", oldPath, "accelSet");
  value.accelSet.isValidFlag = C2xIsTokenAvailable(packetHandle, "RSC", newPath);
  if(value.accelSet.isValidFlag==1)
  {
    GetRSCAccelerationSet4WayParams(packetHandle, value.accelSet, newPath);
    result = CheckLastError("RSC", gkFuncRefGet, result);
  }
  snprintf(newPath, elcount(newPath), "%s.%s", oldPath, "acc4WayConfidence");
  value.acc4WayConfidence.isValidFlag = C2xIsTokenAvailable(packetHandle, "RSC", newPath);
  if(value.acc4WayConfidence.isValidFlag==1)
  {
    GetRSCAccSet4WayConfidenceParams(packetHandle, value.acc4WayConfidence, newPath);
    result = CheckLastError("RSC", gkFuncRefGet, result);
  }
  snprintf(newPath, elcount(newPath), "%s.%s", oldPath, "estimatedTime");
  value.estimatedTime.isValidFlag = C2xIsTokenAvailable(packetHandle, "RSC", newPath);
  if(value.estimatedTime.isValidFlag==1)
  {
    value.estimatedTime.value = C2xGetTokenInt(packetHandle, "RSC", newPath);
    result = CheckLastError("RSC", gkFuncRefGet, result);
  }
  snprintf(newPath, elcount(newPath), "%s.%s", oldPath, "timeConfidence");
  value.timeConfidence.isValidFlag = C2xIsTokenAvailable(packetHandle, "RSC", newPath);
  if(value.timeConfidence.isValidFlag==1)
  {
    value.timeConfidence.value = C2xGetTokenInt(packetHandle, "RSC", newPath);
    result = CheckLastError("RSC", gkFuncRefGet, result);
  }
  return result;
}

int SetRSCPathPlanningPointParams(LONG packetHandle, struct RSCPathPlanningPoint value, char oldPath[])
{
  char newPath[300];
  int result;

  result = 0;

  snprintf(newPath, elcount(newPath), "%s.%s", oldPath, "posInMap");
  if(value.posInMap.isValidFlag==1)
  {
    SetRSCReferenceLinkParams(packetHandle, value.posInMap, newPath);
    result = CheckLastError("RSC", gkFuncRefGet, result);
  }
  else
  {
    if( C2xIsTokenAvailable(packetHandle, "RSC", newPath) )
    {
      C2xRemoveToken(packetHandle, "RSC", newPath);
    }
  }

  snprintf(newPath, elcount(newPath), "%s.%s", oldPath, "pos");
  SetRSCPositionOffsetLLVParams(packetHandle, value.pos, newPath);
  result = CheckLastError("RSC", gkFuncRefGet, result);

  snprintf(newPath, elcount(newPath), "%s.%s", oldPath, "posAccuracy");
  if(value.posAccuracy.isValidFlag==1)
  {
    SetRSCPositionConfidenceSetParams(packetHandle, value.posAccuracy, newPath);
    result = CheckLastError("RSC", gkFuncRefGet, result);
  }
  else
  {
    if( C2xIsTokenAvailable(packetHandle, "RSC", newPath) )
    {
      C2xRemoveToken(packetHandle, "RSC", newPath);
    }
  }

  snprintf(newPath, elcount(newPath), "%s.%s", oldPath, "speed");
  if(value.speed.isValidFlag==1)
  {
    C2xSetTokenInt(packetHandle, "RSC", newPath, value.speed.value);
    result = CheckLastError("RSC", gkFuncRefGet, result);
  }
  else
  {
    if( C2xIsTokenAvailable(packetHandle, "RSC", newPath) )
    {
      C2xRemoveToken(packetHandle, "RSC", newPath);
    }
  }

  snprintf(newPath, elcount(newPath), "%s.%s", oldPath, "speedCfd");
  if(value.speedCfd.isValidFlag==1)
  {
    C2xSetTokenInt(packetHandle, "RSC", newPath, value.speedCfd.value);
    result = CheckLastError("RSC", gkFuncRefGet, result);
  }
  else
  {
    if( C2xIsTokenAvailable(packetHandle, "RSC", newPath) )
    {
      C2xRemoveToken(packetHandle, "RSC", newPath);
    }
  }

  snprintf(newPath, elcount(newPath), "%s.%s", oldPath, "heading");
  if(value.heading.isValidFlag==1)
  {
    C2xSetTokenInt(packetHandle, "RSC", newPath, value.heading.value);
    result = CheckLastError("RSC", gkFuncRefGet, result);
  }
  else
  {
    if( C2xIsTokenAvailable(packetHandle, "RSC", newPath) )
    {
      C2xRemoveToken(packetHandle, "RSC", newPath);
    }
  }

  snprintf(newPath, elcount(newPath), "%s.%s", oldPath, "headingCfd");
  if(value.headingCfd.isValidFlag==1)
  {
    C2xSetTokenInt(packetHandle, "RSC", newPath, value.headingCfd.value);
    result = CheckLastError("RSC", gkFuncRefGet, result);
  }
  else
  {
    if( C2xIsTokenAvailable(packetHandle, "RSC", newPath) )
    {
      C2xRemoveToken(packetHandle, "RSC", newPath);
    }
  }

  snprintf(newPath, elcount(newPath), "%s.%s", oldPath, "accelSet");
  if(value.accelSet.isValidFlag==1)
  {
    SetRSCAccelerationSet4WayParams(packetHandle, value.accelSet, newPath);
    result = CheckLastError("RSC", gkFuncRefGet, result);
  }
  else
  {
    if( C2xIsTokenAvailable(packetHandle, "RSC", newPath) )
    {
      C2xRemoveToken(packetHandle, "RSC", newPath);
    }
  }

  snprintf(newPath, elcount(newPath), "%s.%s", oldPath, "acc4WayConfidence");
  if(value.acc4WayConfidence.isValidFlag==1)
  {
    SetRSCAccSet4WayConfidenceParams(packetHandle, value.acc4WayConfidence, newPath);
    result = CheckLastError("RSC", gkFuncRefGet, result);
  }
  else
  {
    if( C2xIsTokenAvailable(packetHandle, "RSC", newPath) )
    {
      C2xRemoveToken(packetHandle, "RSC", newPath);
    }
  }

  snprintf(newPath, elcount(newPath), "%s.%s", oldPath, "estimatedTime");
  if(value.estimatedTime.isValidFlag==1)
  {
    if (value.estimatedTime.value < 1)
    {
        C2xSetTokenInt(packetHandle, "RSC", newPath, 1);
    }
    else if (value.estimatedTime.value > 65535)
    {
        C2xSetTokenInt(packetHandle, "RSC", newPath, 65535);
    }
    else
    {
        C2xSetTokenInt(packetHandle, "RSC", newPath, value.estimatedTime.value);
    }
    result = CheckLastError("RSC", gkFuncRefGet, result);
  }
  else
  {
    if( C2xIsTokenAvailable(packetHandle, "RSC", newPath) )
    {
      C2xRemoveToken(packetHandle, "RSC", newPath);
    }
  }

  snprintf(newPath, elcount(newPath), "%s.%s", oldPath, "timeConfidence");
  if(value.timeConfidence.isValidFlag==1)
  {
    C2xSetTokenInt(packetHandle, "RSC", newPath, value.timeConfidence.value);
    result = CheckLastError("RSC", gkFuncRefGet, result);
  }
  else
  {
    if( C2xIsTokenAvailable(packetHandle, "RSC", newPath) )
    {
      C2xRemoveToken(packetHandle, "RSC", newPath);
    }
  }

  return result;
}

int GetRSCPathPlanningParams(LONG packetHandle, struct RSCPathPlanning value, char oldPath[])
{
  char newPath[300]; 
  int i;
  int result;

  result = 0;

  value.length = C2xGetTokenInt(packetHandle, "RSC", oldPath);
  if((result = CheckLastError("RSC", gkFuncRefGet, result))==0)
  {
    for(i=0; i<value.length; i++)
    {
      snprintf(newPath, elcount(newPath), "%s[%d]", oldPath, i);
      GetRSCPathPlanningPointParams(packetHandle, value.arrayValue[i], newPath);
      result = CheckLastError("RSC", gkFuncRefGet, result);
    }
  }
  return result;
}

int SetRSCPathPlanningParams(LONG packetHandle, struct RSCPathPlanning value, char oldPath[])
{
  char newPath[300]; 
  int i;
  int result;

  result = 0;

  C2xRemoveToken(packetHandle, "RSC", oldPath);
  for(i=0; i<value.length; i++)
  {
    snprintf(newPath, elcount(newPath), "%s[%d]", oldPath, i);
    SetRSCPathPlanningPointParams(packetHandle, value.arrayValue[i], newPath);
    result = CheckLastError("RSC", gkFuncRefGet, result);
  }
  return result;
}

int GetRSCVehicleCoordinationParams(LONG packetHandle, struct RSCVehicleCoordination value, char oldPath[])
{
  char newPath[300]; 
  int j; 
  int k;
  char buffer[300];
  int result;

  result = 0;

  snprintf(newPath, elcount(newPath), "%s.%s", oldPath, "vehId");
  value.vehId.stringLength = C2xGetTokenData(packetHandle, "RSC", newPath, elcount(value.vehId.string), value.vehId.string);
  snprintf(newPath, elcount(newPath), "%s.%s", oldPath, "driveSuggestion");
  value.driveSuggestion.isValidFlag = C2xIsTokenAvailable(packetHandle, "RSC", newPath);
  if(value.driveSuggestion.isValidFlag==1)
  {
    GetRSCDriveSuggestionParams(packetHandle, value.driveSuggestion, newPath);
    result = CheckLastError("RSC", gkFuncRefGet, result);
  }
  snprintf(newPath, elcount(newPath), "%s.%s", oldPath, "pathGuidance");
  value.pathGuidance.isValidFlag = C2xIsTokenAvailable(packetHandle, "RSC", newPath);
  if(value.pathGuidance.isValidFlag==1)
  {
    GetRSCPathPlanningParams(packetHandle, value.pathGuidance, newPath);
    result = CheckLastError("RSC", gkFuncRefGet, result);
  }
  snprintf(newPath, elcount(newPath), "%s.%s", oldPath, "info");
  value.info.isValidFlag = C2xIsTokenAvailable(packetHandle, "RSC", newPath);
  if(value.info.isValidFlag==1)
  {
    value.info.isValidFlag = 1;
    value.info.stringLength = C2xGetTokenLengthBit(packetHandle, "RSC", newPath);
    if ((result = CheckLastError("RSC", gkFuncRefGet, result))==0)
    {
      if(value.info.stringLength > 0)
      {
        for(j=0; j<value.info.stringLength; j++)
        {
          if(C2xGetTokenBitOfBitString(packetHandle, "RSC", newPath, j) == 0)
          {
            value.info.string[j] = '0';
          }
          else if(C2xGetTokenBitOfBitString(packetHandle, "RSC", newPath, j) == 1)
          {
            value.info.string[j] = '1';
          }

          if(value.info.stringLength == 1)
          {
            value.info.string[1] = '0';
          }
          result = CheckLastError("RSC", gkFuncRefGet, result);
        }
      }
      else
      {
        for(k = value.info.stringLength+1; k > -1; k--)
        {
          if(value.info.string[k] == '1')
          {
            value.info.string[k] = '0';
          }
        }
      }
    }

  }
  return result;
}

int SetRSCVehicleCoordinationParams(LONG packetHandle, struct RSCVehicleCoordination value, char oldPath[])
{
  char newPath[300]; 
  int j;
  char buffer[300];
  int result;

  result = 0;

  snprintf(newPath, elcount(newPath), "%s.%s", oldPath, "vehId");
  C2xSetTokenData(packetHandle, "RSC", newPath, value.vehId.stringLength, value.vehId.string);

  snprintf(newPath, elcount(newPath), "%s.%s", oldPath, "driveSuggestion");
  if(value.driveSuggestion.isValidFlag==1)
  {
    SetRSCDriveSuggestionParams(packetHandle, value.driveSuggestion, newPath);
    result = CheckLastError("RSC", gkFuncRefGet, result);
  }
  else
  {
    if( C2xIsTokenAvailable(packetHandle, "RSC", newPath) )
    {
      C2xRemoveToken(packetHandle, "RSC", newPath);
    }
  }

  snprintf(newPath, elcount(newPath), "%s.%s", oldPath, "pathGuidance");
  if(value.pathGuidance.isValidFlag==1)
  {
    SetRSCPathPlanningParams(packetHandle, value.pathGuidance, newPath);
    result = CheckLastError("RSC", gkFuncRefGet, result);
  }
  else
  {
    if( C2xIsTokenAvailable(packetHandle, "RSC", newPath) )
    {
      C2xRemoveToken(packetHandle, "RSC", newPath);
    }
  }

  snprintf(newPath, elcount(newPath), "%s.%s", oldPath, "info");
  if(value.info.isValidFlag==1)
  {
      for(j=0; j<value.info.stringLength; j++)
      {
        if(value.info.string[j] == '0')
        {
          C2xSetTokenBitOfBitString(packetHandle, "RSC", newPath, j, 0);
        }
        else
        {
          C2xSetTokenBitOfBitString(packetHandle, "RSC", newPath, j, 1);
        }
        result = CheckLastError("RSC", gkFuncRefGet, result);
      }
  }
  else
  {
    if( C2xIsTokenAvailable(packetHandle, "RSC", newPath) )
    {
      C2xRemoveToken(packetHandle, "RSC", newPath);
    }
  }

  return result;
}

int GetRSCRoadsideCoordination_coordinatesParams(LONG packetHandle, struct RSCRoadsideCoordination_coordinates value, char oldPath[])
{
  char newPath[300]; 
  int i;
  int result;

  result = 0;

  value.length = C2xGetTokenInt(packetHandle, "RSC", oldPath);
  if((result = CheckLastError("RSC", gkFuncRefGet, result))==0)
  {
    for(i=0; i<value.length; i++)
    {
      snprintf(newPath, elcount(newPath), "%s[%d]", oldPath, i);
      GetRSCVehicleCoordinationParams(packetHandle, value.arrayValue[i], newPath);
      result = CheckLastError("RSC", gkFuncRefGet, result);
    }
  }
  return result;
}

int SetRSCRoadsideCoordination_coordinatesParams(LONG packetHandle, struct RSCRoadsideCoordination_coordinates value, char oldPath[])
{
  char newPath[300]; 
  int i;
  int result;

  result = 0;

  C2xRemoveToken(packetHandle, "RSC", oldPath);
  for(i=0; i<value.length; i++)
  {
    snprintf(newPath, elcount(newPath), "%s[%d]", oldPath, i);
    SetRSCVehicleCoordinationParams(packetHandle, value.arrayValue[i], newPath);
    result = CheckLastError("RSC", gkFuncRefGet, result);
  }
  return result;
}

int GetRSCDDateTimeParams(LONG packetHandle, struct RSCDDateTime value, char oldPath[])
{
  char newPath[300];
  int result;

  result = 0;

  snprintf(newPath, elcount(newPath), "%s.%s", oldPath, "year");
  value.year.isValidFlag = C2xIsTokenAvailable(packetHandle, "RSC", newPath);
  if(value.year.isValidFlag==1)
  {
    value.year.value = C2xGetTokenInt(packetHandle, "RSC", newPath);
    result = CheckLastError("RSC", gkFuncRefGet, result);
  }
  snprintf(newPath, elcount(newPath), "%s.%s", oldPath, "month");
  value.month.isValidFlag = C2xIsTokenAvailable(packetHandle, "RSC", newPath);
  if(value.month.isValidFlag==1)
  {
    value.month.value = C2xGetTokenInt(packetHandle, "RSC", newPath);
    result = CheckLastError("RSC", gkFuncRefGet, result);
  }
  snprintf(newPath, elcount(newPath), "%s.%s", oldPath, "day");
  value.day.isValidFlag = C2xIsTokenAvailable(packetHandle, "RSC", newPath);
  if(value.day.isValidFlag==1)
  {
    value.day.value = C2xGetTokenInt(packetHandle, "RSC", newPath);
    result = CheckLastError("RSC", gkFuncRefGet, result);
  }
  snprintf(newPath, elcount(newPath), "%s.%s", oldPath, "hour");
  value.hour.isValidFlag = C2xIsTokenAvailable(packetHandle, "RSC", newPath);
  if(value.hour.isValidFlag==1)
  {
    value.hour.value = C2xGetTokenInt(packetHandle, "RSC", newPath);
    result = CheckLastError("RSC", gkFuncRefGet, result);
  }
  snprintf(newPath, elcount(newPath), "%s.%s", oldPath, "minute");
  value.minute.isValidFlag = C2xIsTokenAvailable(packetHandle, "RSC", newPath);
  if(value.minute.isValidFlag==1)
  {
    value.minute.value = C2xGetTokenInt(packetHandle, "RSC", newPath);
    result = CheckLastError("RSC", gkFuncRefGet, result);
  }
  snprintf(newPath, elcount(newPath), "%s.%s", oldPath, "second");
  value.second.isValidFlag = C2xIsTokenAvailable(packetHandle, "RSC", newPath);
  if(value.second.isValidFlag==1)
  {
    value.second.value = C2xGetTokenInt(packetHandle, "RSC", newPath);
    result = CheckLastError("RSC", gkFuncRefGet, result);
  }
  snprintf(newPath, elcount(newPath), "%s.%s", oldPath, "offset");
  value.offset.isValidFlag = C2xIsTokenAvailable(packetHandle, "RSC", newPath);
  if(value.offset.isValidFlag==1)
  {
    value.offset.value = C2xGetTokenInt(packetHandle, "RSC", newPath);
    result = CheckLastError("RSC", gkFuncRefGet, result);
  }
  return result;
}

int SetRSCDDateTimeParams(LONG packetHandle, struct RSCDDateTime value, char oldPath[])
{
  char newPath[300];
  int result;

  result = 0;

  snprintf(newPath, elcount(newPath), "%s.%s", oldPath, "year");
  if(value.year.isValidFlag==1)
  {
    C2xSetTokenInt(packetHandle, "RSC", newPath, value.year.value);
    result = CheckLastError("RSC", gkFuncRefGet, result);
  }
  else
  {
    if( C2xIsTokenAvailable(packetHandle, "RSC", newPath) )
    {
      C2xRemoveToken(packetHandle, "RSC", newPath);
    }
  }

  snprintf(newPath, elcount(newPath), "%s.%s", oldPath, "month");
  if(value.month.isValidFlag==1)
  {
    C2xSetTokenInt(packetHandle, "RSC", newPath, value.month.value);
    result = CheckLastError("RSC", gkFuncRefGet, result);
  }
  else
  {
    if( C2xIsTokenAvailable(packetHandle, "RSC", newPath) )
    {
      C2xRemoveToken(packetHandle, "RSC", newPath);
    }
  }

  snprintf(newPath, elcount(newPath), "%s.%s", oldPath, "day");
  if(value.day.isValidFlag==1)
  {
    C2xSetTokenInt(packetHandle, "RSC", newPath, value.day.value);
    result = CheckLastError("RSC", gkFuncRefGet, result);
  }
  else
  {
    if( C2xIsTokenAvailable(packetHandle, "RSC", newPath) )
    {
      C2xRemoveToken(packetHandle, "RSC", newPath);
    }
  }

  snprintf(newPath, elcount(newPath), "%s.%s", oldPath, "hour");
  if(value.hour.isValidFlag==1)
  {
    C2xSetTokenInt(packetHandle, "RSC", newPath, value.hour.value);
    result = CheckLastError("RSC", gkFuncRefGet, result);
  }
  else
  {
    if( C2xIsTokenAvailable(packetHandle, "RSC", newPath) )
    {
      C2xRemoveToken(packetHandle, "RSC", newPath);
    }
  }

  snprintf(newPath, elcount(newPath), "%s.%s", oldPath, "minute");
  if(value.minute.isValidFlag==1)
  {
    C2xSetTokenInt(packetHandle, "RSC", newPath, value.minute.value);
    result = CheckLastError("RSC", gkFuncRefGet, result);
  }
  else
  {
    if( C2xIsTokenAvailable(packetHandle, "RSC", newPath) )
    {
      C2xRemoveToken(packetHandle, "RSC", newPath);
    }
  }

  snprintf(newPath, elcount(newPath), "%s.%s", oldPath, "second");
  if(value.second.isValidFlag==1)
  {
    C2xSetTokenInt(packetHandle, "RSC", newPath, value.second.value);
    result = CheckLastError("RSC", gkFuncRefGet, result);
  }
  else
  {
    if( C2xIsTokenAvailable(packetHandle, "RSC", newPath) )
    {
      C2xRemoveToken(packetHandle, "RSC", newPath);
    }
  }

  snprintf(newPath, elcount(newPath), "%s.%s", oldPath, "offset");
  if(value.offset.isValidFlag==1)
  {
    C2xSetTokenInt(packetHandle, "RSC", newPath, value.offset.value);
    result = CheckLastError("RSC", gkFuncRefGet, result);
  }
  else
  {
    if( C2xIsTokenAvailable(packetHandle, "RSC", newPath) )
    {
      C2xRemoveToken(packetHandle, "RSC", newPath);
    }
  }

  return result;
}

int GetRSCDescriptionParams(LONG packetHandle, struct RSCDescription value, char oldPath[])
{
  char newPath[300];
  int result;

  result = 0;

  value.choice = C2xGetTokenInt(packetHandle, "RSC", oldPath);

  switch(value.choice)
  {
    case 0:
    {
      snprintf(newPath, elcount(newPath), "%s.%s", oldPath, "textString");
      value.textString.stringLength = C2xGetTokenData(packetHandle, "RSC", newPath, elcount(value.textString.string), value.textString.string);
      result = CheckLastError("RSC", gkFuncRefGet, result);
    }
    break;
    case 1:
    {
      snprintf(newPath, elcount(newPath), "%s.%s", oldPath, "textGB2312");
      value.textGB2312.stringLength = C2xGetTokenData(packetHandle, "RSC", newPath, elcount(value.textGB2312.string), value.textGB2312.string);
      result = CheckLastError("RSC", gkFuncRefGet, result);
    }
    break;
  }
  return result;
}

int SetRSCDescriptionParams(LONG packetHandle, struct RSCDescription value, char oldPath[])
{
  char newPath[300];
  int result;

  result = 0;

  switch(value.choice)
  {
    case 0:
    {
      snprintf(newPath, elcount(newPath), "%s.%s", oldPath, "textString");
      C2xSetTokenData(packetHandle, "RSC", newPath, value.textString.stringLength, value.textString.string);
      result = CheckLastError("RSC", gkFuncRefGet, result);
    }
    break;
    case 1:
    {
      snprintf(newPath, elcount(newPath), "%s.%s", oldPath, "textGB2312");
      C2xSetTokenData(packetHandle, "RSC", newPath, value.textGB2312.stringLength, value.textGB2312.string);
      result = CheckLastError("RSC", gkFuncRefGet, result);
    }
    break;
  }
  return result;
}

int GetRSCLaneCoordinationParams(LONG packetHandle, struct RSCLaneCoordination value, char oldPath[])
{
  char newPath[300]; 
  int j; 
  int k;
  int result;

  result = 0;

  snprintf(newPath, elcount(newPath), "%s.%s", oldPath, "targetLane");
  GetRSCReferenceLinkParams(packetHandle, value.targetLane, newPath);
  result = CheckLastError("RSC", gkFuncRefGet, result);

  snprintf(newPath, elcount(newPath), "%s.%s", oldPath, "relatedPath");
  value.relatedPath.isValidFlag = C2xIsTokenAvailable(packetHandle, "RSC", newPath);
  if(value.relatedPath.isValidFlag==1)
  {
    GetRSCReferencePathParams(packetHandle, value.relatedPath, newPath);
    result = CheckLastError("RSC", gkFuncRefGet, result);
  }
  snprintf(newPath, elcount(newPath), "%s.%s", oldPath, "tBegin");
  value.tBegin.isValidFlag = C2xIsTokenAvailable(packetHandle, "RSC", newPath);
  if(value.tBegin.isValidFlag==1)
  {
    GetRSCDDateTimeParams(packetHandle, value.tBegin, newPath);
    result = CheckLastError("RSC", gkFuncRefGet, result);
  }
  snprintf(newPath, elcount(newPath), "%s.%s", oldPath, "tEnd");
  value.tEnd.isValidFlag = C2xIsTokenAvailable(packetHandle, "RSC", newPath);
  if(value.tEnd.isValidFlag==1)
  {
    GetRSCDDateTimeParams(packetHandle, value.tEnd, newPath);
    result = CheckLastError("RSC", gkFuncRefGet, result);
  }
  snprintf(newPath, elcount(newPath), "%s.%s", oldPath, "recommendedSpeed");
  value.recommendedSpeed.isValidFlag = C2xIsTokenAvailable(packetHandle, "RSC", newPath);
  if(value.recommendedSpeed.isValidFlag==1)
  {
    value.recommendedSpeed.value = C2xGetTokenInt(packetHandle, "RSC", newPath);
    result = CheckLastError("RSC", gkFuncRefGet, result);
  }
  snprintf(newPath, elcount(newPath), "%s.%s", oldPath, "recommendedBehavior");
  value.recommendedBehavior.isValidFlag = C2xIsTokenAvailable(packetHandle, "RSC", newPath);
  if(value.recommendedBehavior.isValidFlag==1)
  {
    value.recommendedBehavior.isValidFlag = 1;
    value.recommendedBehavior.stringLength = C2xGetTokenLengthBit(packetHandle, "RSC", newPath);
    if ((result = CheckLastError("RSC", gkFuncRefGet, result))==0)
    {
      if(value.recommendedBehavior.stringLength > 0)
      {
        for(j=0; j<value.recommendedBehavior.stringLength; j++)
        {
          if(C2xGetTokenBitOfBitString(packetHandle, "RSC", newPath, j) == 0)
          {
            value.recommendedBehavior.string[j] = '0';
          }
          else if(C2xGetTokenBitOfBitString(packetHandle, "RSC", newPath, j) == 1)
          {
            value.recommendedBehavior.string[j] = '1';
          }

          if(value.recommendedBehavior.stringLength == 1)
          {
            value.recommendedBehavior.string[1] = '0';
          }
          result = CheckLastError("RSC", gkFuncRefGet, result);
        }
      }
      else
      {
        for(k = value.recommendedBehavior.stringLength+1; k > -1; k--)
        {
          if(value.recommendedBehavior.string[k] == '1')
          {
            value.recommendedBehavior.string[k] = '0';
          }
        }
      }
    }

  }
  snprintf(newPath, elcount(newPath), "%s.%s", oldPath, "info");
  value.info.isValidFlag = C2xIsTokenAvailable(packetHandle, "RSC", newPath);
  if(value.info.isValidFlag==1)
  {
    value.info.isValidFlag = 1;
    value.info.stringLength = C2xGetTokenLengthBit(packetHandle, "RSC", newPath);
    if ((result = CheckLastError("RSC", gkFuncRefGet, result))==0)
    {
      if(value.info.stringLength > 0)
      {
        for(j=0; j<value.info.stringLength; j++)
        {
          if(C2xGetTokenBitOfBitString(packetHandle, "RSC", newPath, j) == 0)
          {
            value.info.string[j] = '0';
          }
          else if(C2xGetTokenBitOfBitString(packetHandle, "RSC", newPath, j) == 1)
          {
            value.info.string[j] = '1';
          }

          if(value.info.stringLength == 1)
          {
            value.info.string[1] = '0';
          }
          result = CheckLastError("RSC", gkFuncRefGet, result);
        }
      }
      else
      {
        for(k = value.info.stringLength+1; k > -1; k--)
        {
          if(value.info.string[k] == '1')
          {
            value.info.string[k] = '0';
          }
        }
      }
    }

  }
  snprintf(newPath, elcount(newPath), "%s.%s", oldPath, "description");
  value.description.isValidFlag = C2xIsTokenAvailable(packetHandle, "RSC", newPath);
  if(value.description.isValidFlag==1)
  {
    GetRSCDescriptionParams(packetHandle, value.description, newPath);
    result = CheckLastError("RSC", gkFuncRefGet, result);
  }
  return result;
}

int SetRSCLaneCoordinationParams(LONG packetHandle, struct RSCLaneCoordination value, char oldPath[])
{
  char newPath[300]; 
  int j;
  int result;

  result = 0;

  snprintf(newPath, elcount(newPath), "%s.%s", oldPath, "targetLane");
  SetRSCReferenceLinkParams(packetHandle, value.targetLane, newPath);
  result = CheckLastError("RSC", gkFuncRefGet, result);

  snprintf(newPath, elcount(newPath), "%s.%s", oldPath, "relatedPath");
  if(value.relatedPath.isValidFlag==1)
  {
    SetRSCReferencePathParams(packetHandle, value.relatedPath, newPath);
    result = CheckLastError("RSC", gkFuncRefGet, result);
  }
  else
  {
    if( C2xIsTokenAvailable(packetHandle, "RSC", newPath) )
    {
      C2xRemoveToken(packetHandle, "RSC", newPath);
    }
  }

  snprintf(newPath, elcount(newPath), "%s.%s", oldPath, "tBegin");
  if(value.tBegin.isValidFlag==1)
  {
    SetRSCDDateTimeParams(packetHandle, value.tBegin, newPath);
    result = CheckLastError("RSC", gkFuncRefGet, result);
  }
  else
  {
    if( C2xIsTokenAvailable(packetHandle, "RSC", newPath) )
    {
      C2xRemoveToken(packetHandle, "RSC", newPath);
    }
  }

  snprintf(newPath, elcount(newPath), "%s.%s", oldPath, "tEnd");
  if(value.tEnd.isValidFlag==1)
  {
    SetRSCDDateTimeParams(packetHandle, value.tEnd, newPath);
    result = CheckLastError("RSC", gkFuncRefGet, result);
  }
  else
  {
    if( C2xIsTokenAvailable(packetHandle, "RSC", newPath) )
    {
      C2xRemoveToken(packetHandle, "RSC", newPath);
    }
  }

  snprintf(newPath, elcount(newPath), "%s.%s", oldPath, "recommendedSpeed");
  if(value.recommendedSpeed.isValidFlag==1)
  {
    C2xSetTokenInt(packetHandle, "RSC", newPath, value.recommendedSpeed.value);
    result = CheckLastError("RSC", gkFuncRefGet, result);
  }
  else
  {
    if( C2xIsTokenAvailable(packetHandle, "RSC", newPath) )
    {
      C2xRemoveToken(packetHandle, "RSC", newPath);
    }
  }

  snprintf(newPath, elcount(newPath), "%s.%s", oldPath, "recommendedBehavior");
  if(value.recommendedBehavior.isValidFlag==1)
  {
      for(j=0; j<value.recommendedBehavior.stringLength; j++)
      {
        if(value.recommendedBehavior.string[j] == '0')
        {
          C2xSetTokenBitOfBitString(packetHandle, "RSC", newPath, j, 0);
        }
        else
        {
          C2xSetTokenBitOfBitString(packetHandle, "RSC", newPath, j, 1);
        }
        result = CheckLastError("RSC", gkFuncRefGet, result);
      }
  }
  else
  {
    if( C2xIsTokenAvailable(packetHandle, "RSC", newPath) )
    {
      C2xRemoveToken(packetHandle, "RSC", newPath);
    }
  }

  snprintf(newPath, elcount(newPath), "%s.%s", oldPath, "info");
  if(value.info.isValidFlag==1)
  {
      for(j=0; j<value.info.stringLength; j++)
      {
        if(value.info.string[j] == '0')
        {
          C2xSetTokenBitOfBitString(packetHandle, "RSC", newPath, j, 0);
        }
        else
        {
          C2xSetTokenBitOfBitString(packetHandle, "RSC", newPath, j, 1);
        }
        result = CheckLastError("RSC", gkFuncRefGet, result);
      }
  }
  else
  {
    if( C2xIsTokenAvailable(packetHandle, "RSC", newPath) )
    {
      C2xRemoveToken(packetHandle, "RSC", newPath);
    }
  }

  snprintf(newPath, elcount(newPath), "%s.%s", oldPath, "description");
  if(value.description.isValidFlag==1)
  {
    SetRSCDescriptionParams(packetHandle, value.description, newPath);
    result = CheckLastError("RSC", gkFuncRefGet, result);
  }
  else
  {
    if( C2xIsTokenAvailable(packetHandle, "RSC", newPath) )
    {
      C2xRemoveToken(packetHandle, "RSC", newPath);
    }
  }

  return result;
}

int GetRSCRoadsideCoordination_laneCoordinatesParams(LONG packetHandle, struct RSCRoadsideCoordination_laneCoordinates value, char oldPath[])
{
  char newPath[300]; 
  int i;
  int result;

  result = 0;

  value.length = C2xGetTokenInt(packetHandle, "RSC", oldPath);
  if((result = CheckLastError("RSC", gkFuncRefGet, result))==0)
  {
    for(i=0; i<value.length; i++)
    {
      snprintf(newPath, elcount(newPath), "%s[%d]", oldPath, i);
      GetRSCLaneCoordinationParams(packetHandle, value.arrayValue[i], newPath);
      result = CheckLastError("RSC", gkFuncRefGet, result);
    }
  }
  return result;
}

int SetRSCRoadsideCoordination_laneCoordinatesParams(LONG packetHandle, struct RSCRoadsideCoordination_laneCoordinates value, char oldPath[])
{
  char newPath[300]; 
  int i;
  int result;

  result = 0;

  C2xRemoveToken(packetHandle, "RSC", oldPath);
  for(i=0; i<value.length; i++)
  {
    snprintf(newPath, elcount(newPath), "%s[%d]", oldPath, i);
    SetRSCLaneCoordinationParams(packetHandle, value.arrayValue[i], newPath);
    result = CheckLastError("RSC", gkFuncRefGet, result);
  }
  return result;
}

int GetRSCRSC_RoadsideCoordinationParams(LONG packetHandle, struct RSCRSC_RoadsideCoordination value, char oldPath[])
{
  char newPath[300];
  int result;

  result = 0;

  snprintf(newPath, elcount(newPath), "%s.%s", oldPath, "msgCnt");
  value.msgCnt = C2xGetTokenInt(packetHandle, "RSC", newPath);
  result = CheckLastError("RSC", gkFuncRefGet, result);

  snprintf(newPath, elcount(newPath), "%s.%s", oldPath, "id");
  value.id.stringLength = C2xGetTokenData(packetHandle, "RSC", newPath, elcount(value.id.string), value.id.string);
  snprintf(newPath, elcount(newPath), "%s.%s", oldPath, "secMark");
  value.secMark = C2xGetTokenInt(packetHandle, "RSC", newPath);
  result = CheckLastError("RSC", gkFuncRefGet, result);

  snprintf(newPath, elcount(newPath), "%s.%s", oldPath, "refPos");
  GetRSCPosition3DParams(packetHandle, value.refPos, newPath);
  result = CheckLastError("RSC", gkFuncRefGet, result);

  snprintf(newPath, elcount(newPath), "%s.%s", oldPath, "coordinates");
  value.coordinates.isValidFlag = C2xIsTokenAvailable(packetHandle, "RSC", newPath);
  if(value.coordinates.isValidFlag==1)
  {
    GetRSCRoadsideCoordination_coordinatesParams(packetHandle, value.coordinates, newPath);
    result = CheckLastError("RSC", gkFuncRefGet, result);
  }
  snprintf(newPath, elcount(newPath), "%s.%s", oldPath, "laneCoordinates");
  value.laneCoordinates.isValidFlag = C2xIsTokenAvailable(packetHandle, "RSC", newPath);
  if(value.laneCoordinates.isValidFlag==1)
  {
    GetRSCRoadsideCoordination_laneCoordinatesParams(packetHandle, value.laneCoordinates, newPath);
    result = CheckLastError("RSC", gkFuncRefGet, result);
  }
  return result;
}

int SetRSCRSC_RoadsideCoordinationParams(LONG packetHandle, struct RSCRSC_RoadsideCoordination value, char oldPath[])
{
  char newPath[300];
  int result;

  result = 0;

  snprintf(newPath, elcount(newPath), "%s.%s", oldPath, "msgCnt");
  C2xSetTokenInt(packetHandle, "RSC", newPath, value.msgCnt);
  result = CheckLastError("RSC", gkFuncRefGet, result);

  if(value.id.stringLength == 0)
  {
    value.id.stringLength = 8;
    memcpy(value.id.string, "00000000", value.id.stringLength);
  }

  snprintf(newPath, elcount(newPath), "%s.%s", oldPath, "id");
  C2xSetTokenData(packetHandle, "RSC", newPath, value.id.stringLength, value.id.string);

  snprintf(newPath, elcount(newPath), "%s.%s", oldPath, "secMark");
  C2xSetTokenInt(packetHandle, "RSC", newPath, value.secMark);
  result = CheckLastError("RSC", gkFuncRefGet, result);

  snprintf(newPath, elcount(newPath), "%s.%s", oldPath, "refPos");
  SetRSCPosition3DParams(packetHandle, value.refPos, newPath);
  result = CheckLastError("RSC", gkFuncRefGet, result);

  snprintf(newPath, elcount(newPath), "%s.%s", oldPath, "coordinates");
  if(value.coordinates.isValidFlag==1)
  {
    SetRSCRoadsideCoordination_coordinatesParams(packetHandle, value.coordinates, newPath);
    result = CheckLastError("RSC", gkFuncRefGet, result);
  }
  else
  {
    if( C2xIsTokenAvailable(packetHandle, "RSC", newPath) )
    {
      C2xRemoveToken(packetHandle, "RSC", newPath);
    }
  }

  snprintf(newPath, elcount(newPath), "%s.%s", oldPath, "laneCoordinates");
  if(value.laneCoordinates.isValidFlag==1)
  {
    SetRSCRoadsideCoordination_laneCoordinatesParams(packetHandle, value.laneCoordinates, newPath);
    result = CheckLastError("RSC", gkFuncRefGet, result);
  }
  else
  {
    if( C2xIsTokenAvailable(packetHandle, "RSC", newPath) )
    {
      C2xRemoveToken(packetHandle, "RSC", newPath);
    }
  }

  return result;
}

int GetRSCMessageTypesParams(LONG packetHandle, WORD tableKey, struct RSCMessageTypes value, char oldPath[])
{
  char newPath[300];
  int result;

  result = 0;

  switch(tableKey)
  {
    case 11:
    {
      snprintf(newPath, elcount(newPath), "%s.%s", oldPath, "rscData");
      GetRSCRSC_RoadsideCoordinationParams(packetHandle, value.rscData, newPath);
      result = CheckLastError("RSC", gkFuncRefGet, result);
    }
    break;
  }
  return result;
}

int SetRSCMessageTypesParams(LONG packetHandle, WORD tableKey, struct RSCMessageTypes value, char oldPath[])
{
  char newPath[300];
  int result;

  result = 0;

  switch(tableKey)
  {
    case 11:
    {
      snprintf(newPath, elcount(newPath), "%s.%s", oldPath, "rscData");
      SetRSCRSC_RoadsideCoordinationParams(packetHandle, value.rscData, newPath);
      result = CheckLastError("RSC", gkFuncRefGet, result);
    }
    break;
  }
  return result;
}

int GetRSCMessageFrameExtParams(LONG packetHandle, struct RSCMessageFrameExt value, char oldPath[])
{
  char newPath[300];
  int result;

  result = 0;

  snprintf(newPath, elcount(newPath), "%s.%s", oldPath, "messageId");
  value.messageId = C2xGetTokenInt(packetHandle, "RSC", newPath);
  result = CheckLastError("RSC", gkFuncRefGet, result);

  snprintf(newPath, elcount(newPath), "%s.%s", oldPath, "value");
  GetRSCMessageTypesParams(packetHandle, value.messageId, value.value, newPath);
  result = CheckLastError("RSC", gkFuncRefGet, result);

  return result;
}

int SetRSCMessageFrameExtParams(LONG packetHandle, struct RSCMessageFrameExt value, char oldPath[])
{
  char newPath[300];
  int result;

  result = 0;


  snprintf(newPath, elcount(newPath), "%s.%s", oldPath, "value");
  SetRSCMessageTypesParams(packetHandle, value.messageId, value.value, newPath);
  result = CheckLastError("RSC", gkFuncRefGet, result);

  return result;
}

int API_GetRSCParams(LONG packetHandle, struct RSC value)
{
  int result;
  result = 0;

  value.msgFrameExt.isValidFlag = 1;
  GetRSCMessageFrameExtParams(packetHandle, value.msgFrameExt, "msgFrameExt");
  result = CheckLastError("RSC", gkFuncRefGet, result);

  return result;
}

int API_SetRSCParams(LONG packetHandle, struct RSC value)
{
  int result;
  result = 0;

  SetRSCMessageFrameExtParams(packetHandle, value.msgFrameExt, "msgFrameExt");
  result = CheckLastError("RSC", gkFuncRefGet, result);

  return result;
}

