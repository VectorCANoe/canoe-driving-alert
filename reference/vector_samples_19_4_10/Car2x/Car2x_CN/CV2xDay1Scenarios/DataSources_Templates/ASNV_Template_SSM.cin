/*@!Encoding:1252*/
/*
//  (c) Vector Informatik GmbH. All rights reserved.
//
//  This file contains definitions of structs and methods that may be used
//  to set and get the values of an ASN.1 defined packet's payload.
//
//  //This example demonstrates how to set a packet's payload:
//  LONG packetHandle;
//  struct SSM payload;
//  //you need to set the values of the variable "payload" yourself
//  packetHandle = API_InitSSMPacket();
//  if (packetHandle!=0) {
//    if (API_SetSSMParams(packetHandle, payload)==0) {
//      if (C2xCompletePacket(packetHandle)==0) {
//        C2xOutputPacket(packetHandle);
//      }
//    }
//  }
//                                                                             */
includes
{
}
variables
{
    struct SSMSensorSharingMsg_id {
        INT isValidFlag;   // necessary if this struct is used as an optional field of a SEQUENCE
        CHAR string[9];
        INT  stringLength;
    };
    
    struct SSMPosition3D {
        INT isValidFlag;   // necessary if this struct is used as an optional field of a SEQUENCE
        LONG lat;  // INTEGER, -900000000..900000001;
        LONG lon;  // INTEGER, -1799999999..1800000001;
        struct OPT_LONG_ASN elevation;  // INTEGER, OPTIONAL, -4096..61439;
    };
    
    struct SSMPosition_LL_24B {
        INT isValidFlag;   // necessary if this struct is used as an optional field of a SEQUENCE
        INT lon;  // INTEGER, -2048..2047;
        INT lat;  // INTEGER, -2048..2047;
    };
    
    struct SSMPosition_LL_28B {
        INT isValidFlag;   // necessary if this struct is used as an optional field of a SEQUENCE
        INT lon;  // INTEGER, -8192..8191;
        INT lat;  // INTEGER, -8192..8191;
    };
    
    struct SSMPosition_LL_32B {
        INT isValidFlag;   // necessary if this struct is used as an optional field of a SEQUENCE
        INT lon;  // INTEGER, -32768..32767;
        INT lat;  // INTEGER, -32768..32767;
    };
    
    struct SSMPosition_LL_36B {
        INT isValidFlag;   // necessary if this struct is used as an optional field of a SEQUENCE
        LONG lon;  // INTEGER, -131072..131071;
        LONG lat;  // INTEGER, -131072..131071;
    };
    
    struct SSMPosition_LL_44B {
        INT isValidFlag;   // necessary if this struct is used as an optional field of a SEQUENCE
        LONG lon;  // INTEGER, -2097152..2097151;
        LONG lat;  // INTEGER, -2097152..2097151;
    };
    
    struct SSMPosition_LL_48B {
        INT isValidFlag;   // necessary if this struct is used as an optional field of a SEQUENCE
        LONG lon;  // INTEGER, -8388608..8388607;
        LONG lat;  // INTEGER, -8388608..8388607;
    };
    
    struct SSMPosition_LLmD_64b {
        INT isValidFlag;   // necessary if this struct is used as an optional field of a SEQUENCE
        LONG lon;  // INTEGER, -1799999999..1800000001;
        LONG lat;  // INTEGER, -900000000..900000001;
    };
    
    struct SSMPositionOffsetLL {
        INT isValidFlag;   // necessary if this struct is used as an optional field of a SEQUENCE
        INT choice;
        struct SSMPosition_LL_24B position_LL1;  // SEQUENCE;
        struct SSMPosition_LL_28B position_LL2;  // SEQUENCE;
        struct SSMPosition_LL_32B position_LL3;  // SEQUENCE;
        struct SSMPosition_LL_36B position_LL4;  // SEQUENCE;
        struct SSMPosition_LL_44B position_LL5;  // SEQUENCE;
        struct SSMPosition_LL_48B position_LL6;  // SEQUENCE;
        struct SSMPosition_LLmD_64b position_LatLon;  // SEQUENCE;
    };
    
    struct SSMVerticalOffset {
        INT isValidFlag;   // necessary if this struct is used as an optional field of a SEQUENCE
        INT choice;
        INT offset1;  // INTEGER, -64..63;
        INT offset2;  // INTEGER, -128..127;
        INT offset3;  // INTEGER, -256..255;
        INT offset4;  // INTEGER, -512..511;
        INT offset5;  // INTEGER, -1024..1023;
        INT offset6;  // INTEGER, -2048..2047;
        LONG elevation;  // INTEGER, -4096..61439;
    };
    
    struct SSMPositionOffsetLLV {
        INT isValidFlag;   // necessary if this struct is used as an optional field of a SEQUENCE
        struct SSMPositionOffsetLL offsetLL;  // CHOICE;
        struct SSMVerticalOffset offsetV;  // CHOICE, OPTIONAL;
    };
    
    struct SSMPolygon {
        INT isValidFlag;   // necessary if this struct is used as an optional field of a SEQUENCE
        INT length;
        struct SSMPositionOffsetLLV arrayValue[32];  // SEQUENCE;
    };
    
    struct SSMDetectedRegion {
        INT isValidFlag;   // necessary if this struct is used as an optional field of a SEQUENCE
        INT length;
        struct SSMPolygon arrayValue[8];  // SEQUENCEOF;
    };
    
    struct SSMParticipantData_id {
        INT isValidFlag;   // necessary if this struct is used as an optional field of a SEQUENCE
        CHAR string[9];
        INT  stringLength;
    };
    
    struct SSMPositionConfidenceSet {
        INT isValidFlag;   // necessary if this struct is used as an optional field of a SEQUENCE
        INT pos;  // ENUMERATED, unavailable(0), a500m(1), a200m(2), a100m(3), a50m(4), a20m(5), a10m(6), a5m(7), a2m(8), a1m(9), a50cm(10), a20cm(11), a10cm(12), a5cm(13), a2cm(14), a1cm(15);
        struct OPT_ENUM_ASN elevation;  // ENUMERATED, OPTIONAL, unavailable(0), elev_500_00(1), elev_200_00(2), elev_100_00(3), elev_050_00(4), elev_020_00(5), elev_010_00(6), elev_005_00(7), elev_002_00(8), elev_001_00(9), elev_000_50(10), elev_000_20(11), elev_000_10(12), elev_000_05(13), elev_000_02(14), elev_000_01(15);
    };
    
    struct SSMMotionConfidenceSet {
        INT isValidFlag;   // necessary if this struct is used as an optional field of a SEQUENCE
        struct OPT_ENUM_ASN speedCfd;  // ENUMERATED, OPTIONAL, unavailable(0), prec100ms(1), prec10ms(2), prec5ms(3), prec1ms(4), prec0_1ms(5), prec0_05ms(6), prec0_01ms(7);
        struct OPT_ENUM_ASN headingCfd;  // ENUMERATED, OPTIONAL, unavailable(0), prec10deg(1), prec05deg(2), prec01deg(3), prec0_1deg(4), prec0_05deg(5), prec0_01deg(6), prec0_0125deg(7);
        struct OPT_ENUM_ASN steerCfd;  // ENUMERATED, OPTIONAL, unavailable(0), prec2deg(1), prec1deg(2), prec0_02deg(3);
    };
    
    struct SSMAccelerationSet4Way {
        INT isValidFlag;   // necessary if this struct is used as an optional field of a SEQUENCE
        INT lon;  // INTEGER, -2000..2001;
        INT lat;  // INTEGER, -2000..2001;
        INT vert;  // INTEGER, -127..127;
        INT yaw;  // INTEGER, -32767..32767;
    };
    
    struct SSMVehicleSize {
        INT isValidFlag;   // necessary if this struct is used as an optional field of a SEQUENCE
        WORD width;  // INTEGER, 0..1023;
        WORD length;  // INTEGER, 0..4095;
        struct OPT_BYTE_ASN height;  // INTEGER, OPTIONAL, 0..127;
    };
    
    struct SSMVehicleClassification {
        INT isValidFlag;   // necessary if this struct is used as an optional field of a SEQUENCE
        BYTE classification;  // INTEGER, 0..255, unknownVehicleClass(0), specialVehicleClass(1), passenger_Vehicle_TypeUnknown(10), passenger_Vehicle_TypeOther(11), lightTruck_Vehicle_TypeUnknown(20), lightTruck_Vehicle_TypeOther(21), truck_Vehicle_TypeUnknown(25), truck_Vehicle_TypeOther(26), truck_axleCnt2(27), truck_axleCnt3(28), truck_axleCnt4(29), truck_axleCnt4Trailer(30), truck_axleCnt5Trailer(31), truck_axleCnt6Trailer(32), truck_axleCnt5MultiTrailer(33), truck_axleCnt6MultiTrailer(34), truck_axleCnt7MultiTrailer(35), motorcycle_TypeUnknown(40), motorcycle_TypeOther(41), motorcycle_Cruiser_Standard(42), motorcycle_SportUnclad(43), motorcycle_SportTouring(44), motorcycle_SuperSport(45), motorcycle_Touring(46), motorcycle_Trike(47), motorcycle_wPassengers(48), transit_TypeUnknown(50), transit_TypeOther(51), transit_BRT(52), transit_ExpressBus(53), transit_LocalBus(54), transit_SchoolBus(55), transit_FixedGuideway(56), transit_Paratransit(57), transit_Paratransit_Ambulance(58), emergency_TypeUnknown(60), emergency_TypeOther(61), emergency_Fire_Light_Vehicle(62), emergency_Fire_Heavy_Vehicle(63), emergency_Fire_Paramedic_Vehicle(64), emergency_Fire_Ambulance_Vehicle(65), emergency_Police_Light_Vehicle(66), emergency_Police_Heavy_Vehicle(67), emergency_Other_Responder(68), emergency_Other_Ambulance(69), otherTraveler_TypeUnknown(80), otherTraveler_TypeOther(81), otherTraveler_Pedestrian(82), otherTraveler_Visually_Disabled(83), otherTraveler_Physically_Disabled(84), otherTraveler_Bicycle(85), otherTraveler_Vulnerable_Roadworker(86), infrastructure_TypeUnknown(90), infrastructure_Fixed(91), infrastructure_Movable(92), equipped_CargoTrailer(93);
        struct OPT_BYTE_ASN fuelType;  // INTEGER, OPTIONAL, 0..15, unknownFuel(0), gasoline(1), ethanol(2), diesel(3), electric(4), hybrid(5), hydrogen(6), natGasLiquid(7), natGasComp(8), propane(9);
    };
    
    struct SSMParticipantData {
        INT isValidFlag;   // necessary if this struct is used as an optional field of a SEQUENCE
        INT ptcType;  // ENUMERATED, unknown(0), motor(1), non_motor(2), pedestrian(3), rsu(4);
        WORD ptcId;  // INTEGER, 0..65535;
        INT source;  // ENUMERATED, unknown(0), selfinfo(1), v2x(2), video(3), microwaveRadar(4), loop(5), lidar(6), integrated(7);
        struct SSMParticipantData_id id;  // OCTETSTRING, OPTIONAL;
        WORD secMark;  // INTEGER, 0..65535;
        struct SSMPositionOffsetLLV pos;  // SEQUENCE;
        struct SSMPositionConfidenceSet posConfidence;  // SEQUENCE;
        struct OPT_ENUM_ASN transmission;  // ENUMERATED, OPTIONAL, neutral(0), park(1), forwardGears(2), reverseGears(3), reserved1(4), reserved2(5), reserved3(6), unavailable(7);
        WORD speed;  // INTEGER, 0..8191;
        WORD heading;  // INTEGER, 0..28800;
        struct OPT_INT_ASN angle;  // INTEGER, OPTIONAL, -126..127;
        struct SSMMotionConfidenceSet motionCfd;  // SEQUENCE, OPTIONAL;
        struct SSMAccelerationSet4Way accelSet;  // SEQUENCE, OPTIONAL;
        struct SSMVehicleSize size;  // SEQUENCE;
        struct SSMVehicleClassification vehicleClass;  // SEQUENCE, OPTIONAL;
    };
    
    struct SSMObjectSizeConfidence {
        INT isValidFlag;   // necessary if this struct is used as an optional field of a SEQUENCE
        INT widthConf;  // ENUMERATED, unavailable(0), size_100_00(1), size_050_00(2), size_020_00(3), size_010_00(4), size_005_00(5), size_002_00(6), size_001_00(7), size_000_50(8), size_000_20(9), size_000_10(10), size_000_05(11), size_000_02(12), size_000_01(13);
        INT lengthConf;  // ENUMERATED, unavailable(0), size_100_00(1), size_050_00(2), size_020_00(3), size_010_00(4), size_005_00(5), size_002_00(6), size_001_00(7), size_000_50(8), size_000_20(9), size_000_10(10), size_000_05(11), size_000_02(12), size_000_01(13);
        struct OPT_ENUM_ASN heightConf;  // ENUMERATED, OPTIONAL, unavailable(0), size_100_00(1), size_050_00(2), size_020_00(3), size_010_00(4), size_005_00(5), size_002_00(6), size_001_00(7), size_000_50(8), size_000_20(9), size_000_10(10), size_000_05(11), size_000_02(12), size_000_01(13);
    };
    
    struct SSMAccSet4WayConfidence {
        INT isValidFlag;   // necessary if this struct is used as an optional field of a SEQUENCE
        INT lonAccConfidence;  // ENUMERATED, unavailable(0), prec100deg(1), prec10deg(2), prec5deg(3), prec1deg(4), prec0_1deg(5), prec0_05deg(6), prec0_01deg(7);
        INT latAccConfidence;  // ENUMERATED, unavailable(0), prec100deg(1), prec10deg(2), prec5deg(3), prec1deg(4), prec0_1deg(5), prec0_05deg(6), prec0_01deg(7);
        INT vertAccConfidence;  // ENUMERATED, unavailable(0), prec100deg(1), prec10deg(2), prec5deg(3), prec1deg(4), prec0_1deg(5), prec0_05deg(6), prec0_01deg(7);
        INT yawRateCon;  // ENUMERATED, unavailable(0), prec100deg(1), prec10deg(2), prec5deg(3), prec1deg(4), prec0_1deg(5), prec0_05deg(6), prec0_01deg(7);
    };
    
    struct SSMDDateTime {
        INT isValidFlag;   // necessary if this struct is used as an optional field of a SEQUENCE
        struct OPT_WORD_ASN year;  // INTEGER, OPTIONAL, 0..4095;
        struct OPT_BYTE_ASN month;  // INTEGER, OPTIONAL, 0..12;
        struct OPT_BYTE_ASN day;  // INTEGER, OPTIONAL, 0..31;
        struct OPT_BYTE_ASN hour;  // INTEGER, OPTIONAL, 0..24;
        struct OPT_BYTE_ASN minute;  // INTEGER, OPTIONAL, 0..60;
        struct OPT_WORD_ASN second;  // INTEGER, OPTIONAL, 0..65535;
        struct OPT_INT_ASN offset;  // INTEGER, OPTIONAL, -720..721;
    };
    
    struct SSMPositionalAccuracy {
        INT isValidFlag;   // necessary if this struct is used as an optional field of a SEQUENCE
        BYTE semiMajor;  // INTEGER, 0..255;
        BYTE semiMinor;  // INTEGER, 0..255;
        WORD orientation;  // INTEGER, 0..65535;
    };
    
    struct SSMFullPositionVector {
        INT isValidFlag;   // necessary if this struct is used as an optional field of a SEQUENCE
        struct SSMDDateTime utcTime;  // SEQUENCE, OPTIONAL;
        struct SSMPosition3D pos;  // SEQUENCE;
        struct OPT_WORD_ASN heading;  // INTEGER, OPTIONAL, 0..28800;
        struct OPT_ENUM_ASN transmission;  // ENUMERATED, OPTIONAL, neutral(0), park(1), forwardGears(2), reverseGears(3), reserved1(4), reserved2(5), reserved3(6), unavailable(7);
        struct OPT_WORD_ASN speed;  // INTEGER, OPTIONAL, 0..8191;
        struct SSMPositionalAccuracy posAccuracy;  // SEQUENCE, OPTIONAL;
        struct SSMPositionConfidenceSet posConficence;  // SEQUENCE, OPTIONAL;
        struct OPT_ENUM_ASN timeConfidence;  // ENUMERATED, OPTIONAL, unavailable(0), time_100_000(1), time_050_000(2), time_020_000(3), time_010_000(4), time_002_000(5), time_001_000(6), time_000_500(7), time_000_200(8), time_000_100(9), time_000_050(10), time_000_020(11), time_000_010(12), time_000_005(13), time_000_002(14), time_000_001(15), time_000_000_5(16), time_000_000_2(17), time_000_000_1(18), time_000_000_05(19), time_000_000_02(20), time_000_000_01(21), time_000_000_005(22), time_000_000_002(23), time_000_000_001(24), time_000_000_000_5(25), time_000_000_000_2(26), time_000_000_000_1(27), time_000_000_000_05(28), time_000_000_000_02(29), time_000_000_000_01(30), time_000_000_000_005(31), time_000_000_000_002(32), time_000_000_000_001(33), time_000_000_000_000_5(34), time_000_000_000_000_2(35), time_000_000_000_000_1(36), time_000_000_000_000_05(37), time_000_000_000_000_02(38), time_000_000_000_000_01(39);
        struct SSMMotionConfidenceSet motionCfd;  // SEQUENCE, OPTIONAL;
    };
    
    struct SSMGNSSstatus {
        INT isValidFlag;   // necessary if this struct is used as an optional field of a SEQUENCE
        CHAR string[9];
        INT  stringLength;
    };
    
    struct SSMPathHistoryPoint {
        INT isValidFlag;   // necessary if this struct is used as an optional field of a SEQUENCE
        struct SSMPositionOffsetLLV llvOffset;  // SEQUENCE;
        WORD timeOffset;  // INTEGER, 1..65535;
        struct OPT_WORD_ASN speed;  // INTEGER, OPTIONAL, 0..8191;
        struct SSMPositionConfidenceSet posAccuracy;  // SEQUENCE, OPTIONAL;
        struct OPT_BYTE_ASN heading;  // INTEGER, OPTIONAL, 0..240;
    };
    
    struct SSMPathHistoryPointList {
        INT isValidFlag;   // necessary if this struct is used as an optional field of a SEQUENCE
        INT length;
        struct SSMPathHistoryPoint arrayValue[23];  // SEQUENCE;
    };
    
    struct SSMPathHistory {
        INT isValidFlag;   // necessary if this struct is used as an optional field of a SEQUENCE
        struct SSMFullPositionVector initialPosition;  // SEQUENCE, OPTIONAL;
        struct SSMGNSSstatus currGNSSstatus;  // BITSTRING, OPTIONAL;
        struct SSMPathHistoryPointList crumbData;  // SEQUENCEOF;
    };
    
    struct SSMDriveBehavior {
        INT isValidFlag;   // necessary if this struct is used as an optional field of a SEQUENCE
        CHAR string[15];
        INT  stringLength;
    };
    
    struct SSMNodeReferenceID {
        INT isValidFlag;   // necessary if this struct is used as an optional field of a SEQUENCE
        struct OPT_WORD_ASN region;  // INTEGER, OPTIONAL, 0..65535;
        WORD id;  // INTEGER, 0..65535;
    };
    
    struct SSMReferenceLanes {
        INT isValidFlag;   // necessary if this struct is used as an optional field of a SEQUENCE
        CHAR string[17];
        INT  stringLength;
    };
    
    struct SSMReferenceLink {
        INT isValidFlag;   // necessary if this struct is used as an optional field of a SEQUENCE
        struct SSMNodeReferenceID upstreamNodeId;  // SEQUENCE;
        struct SSMNodeReferenceID downstreamNodeId;  // SEQUENCE;
        struct SSMReferenceLanes referenceLanes;  // BITSTRING, OPTIONAL;
    };
    
    struct SSMPathPlanningPoint {
        INT isValidFlag;   // necessary if this struct is used as an optional field of a SEQUENCE
        struct SSMReferenceLink posInMap;  // SEQUENCE, OPTIONAL;
        struct SSMPositionOffsetLLV pos;  // SEQUENCE;
        struct SSMPositionConfidenceSet posAccuracy;  // SEQUENCE, OPTIONAL;
        struct OPT_WORD_ASN speed;  // INTEGER, OPTIONAL, 0..8191;
        struct OPT_ENUM_ASN speedCfd;  // ENUMERATED, OPTIONAL, unavailable(0), prec100ms(1), prec10ms(2), prec5ms(3), prec1ms(4), prec0_1ms(5), prec0_05ms(6), prec0_01ms(7);
        struct OPT_WORD_ASN heading;  // INTEGER, OPTIONAL, 0..28800;
        struct OPT_ENUM_ASN headingCfd;  // ENUMERATED, OPTIONAL, unavailable(0), prec10deg(1), prec05deg(2), prec01deg(3), prec0_1deg(4), prec0_05deg(5), prec0_01deg(6), prec0_0125deg(7);
        struct SSMAccelerationSet4Way accelSet;  // SEQUENCE, OPTIONAL;
        struct SSMAccSet4WayConfidence acc4WayConfidence;  // SEQUENCE, OPTIONAL;
        struct OPT_WORD_ASN estimatedTime;  // INTEGER, OPTIONAL, 1..65535;
        struct OPT_BYTE_ASN timeConfidence;  // INTEGER, OPTIONAL, 0..200;
    };
    
    struct SSMPathPlanning {
        INT isValidFlag;   // necessary if this struct is used as an optional field of a SEQUENCE
        INT length;
        struct SSMPathPlanningPoint arrayValue[100];  // SEQUENCE;
    };
    
    struct SSMPlanning {
        INT isValidFlag;   // necessary if this struct is used as an optional field of a SEQUENCE
        struct OPT_WORD_ASN duration;  // INTEGER, OPTIONAL, 0..600;
        struct OPT_BYTE_ASN planConfidence;  // INTEGER, OPTIONAL, 0..200;
        struct SSMDriveBehavior drivingBehavior;  // BITSTRING, OPTIONAL;
        struct SSMPathPlanning pathPlanning;  // SEQUENCEOF, OPTIONAL;
    };
    
    struct SSMPlanningList {
        INT isValidFlag;   // necessary if this struct is used as an optional field of a SEQUENCE
        INT length;
        struct SSMPlanning arrayValue[8];  // SEQUENCE;
    };
    
    struct SSMExteriorLights {
        INT isValidFlag;   // necessary if this struct is used as an optional field of a SEQUENCE
        CHAR string[10];
        INT  stringLength;
    };
    
    struct SSMAttitude {
        INT isValidFlag;   // necessary if this struct is used as an optional field of a SEQUENCE
        INT pitch;  // INTEGER, -7200..7200;
        INT roll;  // INTEGER, -7200..7200;
        INT yaw;  // INTEGER, -14400..14400;
    };
    
    struct SSMAttitudeConfidence {
        INT isValidFlag;   // necessary if this struct is used as an optional field of a SEQUENCE
        INT pitchConfidence;  // ENUMERATED, unavailable(0), prec10deg(1), prec05deg(2), prec01deg(3), prec0_1deg(4), prec0_05deg(5), prec0_01deg(6), prec0_0125deg(7);
        INT rollRateConfidence;  // ENUMERATED, unavailable(0), prec10deg(1), prec05deg(2), prec01deg(3), prec0_1deg(4), prec0_05deg(5), prec0_01deg(6), prec0_0125deg(7);
        INT yawRate;  // ENUMERATED, unavailable(0), prec10deg(1), prec05deg(2), prec01deg(3), prec0_1deg(4), prec0_05deg(5), prec0_01deg(6), prec0_0125deg(7);
    };
    
    struct SSMAngularVelocity {
        INT isValidFlag;   // necessary if this struct is used as an optional field of a SEQUENCE
        INT pitchRate;  // INTEGER, -32767..32767;
        INT rollRate;  // INTEGER, -32767..32767;
        INT yawRate;  // INTEGER, -32767..32767;
    };
    
    struct SSMAngularVelocityConfidence {
        INT isValidFlag;   // necessary if this struct is used as an optional field of a SEQUENCE
        INT pitchRate;  // ENUMERATED, unavailable(0), prec100deg(1), prec10deg(2), prec5deg(3), prec1deg(4), prec0_1deg(5), prec0_05deg(6), prec0_01deg(7);
        INT rollRate;  // ENUMERATED, unavailable(0), prec100deg(1), prec10deg(2), prec5deg(3), prec1deg(4), prec0_1deg(5), prec0_05deg(6), prec0_01deg(7);
        INT yawRate;  // ENUMERATED, unavailable(0), prec100deg(1), prec10deg(2), prec5deg(3), prec1deg(4), prec0_1deg(5), prec0_05deg(6), prec0_01deg(7);
    };
    
    struct SSMMotorDataExtension {
        INT isValidFlag;   // necessary if this struct is used as an optional field of a SEQUENCE
        struct SSMExteriorLights lights;  // BITSTRING, OPTIONAL;
        struct SSMAttitude vehAttitude;  // SEQUENCE, OPTIONAL;
        struct SSMAttitudeConfidence vehAttitudeConfidence;  // SEQUENCE, OPTIONAL;
        struct SSMAngularVelocity vehAngVel;  // SEQUENCE, OPTIONAL;
        struct SSMAngularVelocityConfidence vehAngVelConfidence;  // SEQUENCE, OPTIONAL;
    };
    
    struct SSMPropelledInformation {
        INT isValidFlag;   // necessary if this struct is used as an optional field of a SEQUENCE
        INT choice;
        INT human;  // ENUMERATED, unavailable(0), otherTypes(1), onFoot(2), skateboard(3), pushOrKickScooter(4), wheelchair(5);
        INT animal;  // ENUMERATED, unavailable(0), otherTypes(1), animalMounted(2), animalDrawnCarriage(3);
        INT motor;  // ENUMERATED, unavailable(0), otherTypes(1), wheelChair(2), bicycle(3), scooter(4), selfBalancingDevice(5);
    };
    
    struct SSMPersonalDeviceUsageState {
        INT isValidFlag;   // necessary if this struct is used as an optional field of a SEQUENCE
        CHAR string[10];
        INT  stringLength;
    };
    
    struct SSMPersonalAssistive {
        INT isValidFlag;   // necessary if this struct is used as an optional field of a SEQUENCE
        CHAR string[7];
        INT  stringLength;
    };
    
    struct SSMPersonalExtensions {
        INT isValidFlag;   // necessary if this struct is used as an optional field of a SEQUENCE
        struct SSMPersonalDeviceUsageState useState;  // BITSTRING, OPTIONAL;
        struct SSMPersonalAssistive assistType;  // BITSTRING, OPTIONAL;
    };
    
    struct SSMRoadWorkerActivityType {
        INT isValidFlag;   // necessary if this struct is used as an optional field of a SEQUENCE
        CHAR string[7];
        INT  stringLength;
    };
    
    struct SSMRoadWorkerExtensions {
        INT isValidFlag;   // necessary if this struct is used as an optional field of a SEQUENCE
        struct OPT_ENUM_ASN workerType;  // ENUMERATED, OPTIONAL, unavailable(0), trafficPolice(1), constructionPersonnel(2), policeOfficers(3), trafficControlPersons(4), railroadCrossingGuards(5), emergencyOrganizationPersonnel(6);
        struct SSMRoadWorkerActivityType activityType;  // BITSTRING, OPTIONAL;
    };
    
    struct SSMPersonalRequest {
        INT isValidFlag;   // necessary if this struct is used as an optional field of a SEQUENCE
        struct OPT_ENUM_ASN crossing;  // ENUMERATED, OPTIONAL, unavailable(0), request(1), crossing(2), finish(3);
    };
    
    struct SSMNon_motorData {
        INT isValidFlag;   // necessary if this struct is used as an optional field of a SEQUENCE
        INT basicType;  // ENUMERATED, unavailable(0), aPEDESTRIAN(1), aPEDALCYCLIST(2), aROADWORKER(3), anANIMAL(4);
        struct SSMPropelledInformation propulsion;  // CHOICE, OPTIONAL;
        struct OPT_ENUM_ASN clusterSize;  // ENUMERATED, OPTIONAL, unavailable(0), small(1), medium(2), large(3);
        struct OPT_ENUM_ASN attachment;  // ENUMERATED, OPTIONAL, unavailable(0), stroller(1), bicycleTrailer(2), cart(3), wheelchair(4), otherWalkAssistAttachments(5), pet(6);
        struct SSMPersonalExtensions personalExt;  // SEQUENCE, OPTIONAL;
        struct SSMRoadWorkerExtensions roadWorkerExt;  // SEQUENCE, OPTIONAL;
        struct SSMPersonalRequest personalReq;  // SEQUENCE, OPTIONAL;
    };
    
    struct SSMNon_motorDataExtension {
        INT isValidFlag;   // necessary if this struct is used as an optional field of a SEQUENCE
        BYTE overallRadius;  // INTEGER, 0..200;
        struct SSMNon_motorData non_motorData;  // SEQUENCE;
    };
    
    struct SSMDetectedPTCData_type_relatedExt {
        INT isValidFlag;   // necessary if this struct is used as an optional field of a SEQUENCE
        INT choice;
        struct SSMMotorDataExtension motorExt;  // SEQUENCE;
        struct SSMNon_motorDataExtension non_motorExt;  // SEQUENCE;
    };
    
    struct SSMDetectedPTCData {
        INT isValidFlag;   // necessary if this struct is used as an optional field of a SEQUENCE
        struct SSMParticipantData ptc;  // SEQUENCE;
        struct SSMObjectSizeConfidence objSizeConfidence;  // SEQUENCE, OPTIONAL;
        struct OPT_ENUM_ASN detectedPTCType;  // ENUMERATED, OPTIONAL, unknown(0), unknown_movable(1), unknown_unmovable(2), car(3), van(4), truck(5), bus(6), cyclist(7), motorcyclist(8), tricyclist(9), pedestrian(10);
        struct OPT_BYTE_ASN typeConfidence;  // INTEGER, OPTIONAL, 0..200;
        struct SSMAccSet4WayConfidence acc4WayConfidence;  // SEQUENCE, OPTIONAL;
        struct OPT_WORD_ASN statusDuration;  // INTEGER, OPTIONAL, 1..65535;
        struct SSMPathHistory pathHistory;  // SEQUENCE, OPTIONAL;
        struct SSMPlanningList planningList;  // SEQUENCEOF, OPTIONAL;
        struct OPT_WORD_ASN tracking;  // INTEGER, OPTIONAL, 1..65535;
        struct SSMPolygon polygon;  // SEQUENCEOF, OPTIONAL;
        struct SSMDetectedPTCData_type_relatedExt type_relatedExt;  // CHOICE, OPTIONAL;
    };
    
    struct SSMDetectedPTCList {
        INT isValidFlag;   // necessary if this struct is used as an optional field of a SEQUENCE
        INT length;
        struct SSMDetectedPTCData arrayValue[512];  // SEQUENCE;
    };
    
    struct SSMObjectSize {
        INT isValidFlag;   // necessary if this struct is used as an optional field of a SEQUENCE
        WORD width;  // INTEGER, 0..1023;
        WORD length;  // INTEGER, 0..1023;
        struct OPT_WORD_ASN height;  // INTEGER, OPTIONAL, 0..1023;
    };
    
    struct SSMDetectedObstacleData {
        INT isValidFlag;   // necessary if this struct is used as an optional field of a SEQUENCE
        INT obsType;  // ENUMERATED, unknown(0), rockfall(1), landslide(2), animal_intrusion(3), liquid_spill(4), goods_scattered(5), trafficcone(6), safety_triangle(7), traffic_roadblock(8), inspection_shaft_without_cover(9), unknown_fragments(10), unknown_hard_object(11), unknown_soft_object(12);
        struct OPT_BYTE_ASN objTypeConfidence;  // INTEGER, OPTIONAL, 0..200;
        WORD obsId;  // INTEGER, 0..65535;
        INT source;  // ENUMERATED, unknown(0), selfinfo(1), v2x(2), video(3), microwaveRadar(4), loop(5), lidar(6), integrated(7);
        WORD secMark;  // INTEGER, 0..65535;
        struct SSMPositionOffsetLLV pos;  // SEQUENCE;
        struct SSMPositionConfidenceSet posConfidence;  // SEQUENCE;
        WORD speed;  // INTEGER, 0..8191;
        struct OPT_ENUM_ASN speedCfd;  // ENUMERATED, OPTIONAL, unavailable(0), prec100ms(1), prec10ms(2), prec5ms(3), prec1ms(4), prec0_1ms(5), prec0_05ms(6), prec0_01ms(7);
        WORD heading;  // INTEGER, 0..28800;
        struct OPT_ENUM_ASN headingCfd;  // ENUMERATED, OPTIONAL, unavailable(0), prec10deg(1), prec05deg(2), prec01deg(3), prec0_1deg(4), prec0_05deg(5), prec0_01deg(6), prec0_0125deg(7);
        struct OPT_WORD_ASN verSpeed;  // INTEGER, OPTIONAL, 0..8191;
        struct OPT_ENUM_ASN verSpeedConfidence;  // ENUMERATED, OPTIONAL, unavailable(0), prec100ms(1), prec10ms(2), prec5ms(3), prec1ms(4), prec0_1ms(5), prec0_05ms(6), prec0_01ms(7);
        struct SSMAccelerationSet4Way accelSet;  // SEQUENCE, OPTIONAL;
        struct SSMObjectSize size;  // SEQUENCE;
        struct SSMObjectSizeConfidence objSizeConfidence;  // SEQUENCE, OPTIONAL;
        struct OPT_WORD_ASN tracking;  // INTEGER, OPTIONAL, 1..65535;
        struct SSMPolygon polygon;  // SEQUENCEOF, OPTIONAL;
    };
    
    struct SSMDetectedObstacleList {
        INT isValidFlag;   // necessary if this struct is used as an optional field of a SEQUENCE
        INT length;
        struct SSMDetectedObstacleData arrayValue[64];  // SEQUENCE;
    };
    
    struct SSMDescription_textString {
        INT isValidFlag;   // necessary if this struct is used as an optional field of a SEQUENCE
        CHAR string[513];
        INT  stringLength;
    };
    
    struct SSMDescription_textGB2312 {
        INT isValidFlag;   // necessary if this struct is used as an optional field of a SEQUENCE
        CHAR string[513];
        INT  stringLength;
    };
    
    struct SSMDescription {
        INT isValidFlag;   // necessary if this struct is used as an optional field of a SEQUENCE
        INT choice;
        struct SSMDescription_textString textString;  // IA5STRING;
        struct SSMDescription_textGB2312 textGB2312;  // OCTETSTRING;
    };
    
    struct SSMRSITimeDetails {
        INT isValidFlag;   // necessary if this struct is used as an optional field of a SEQUENCE
        struct OPT_DWORD_ASN startTime;  // INTEGER, OPTIONAL, 0..527040;
        struct OPT_DWORD_ASN endTime;  // INTEGER, OPTIONAL, 0..527040;
        struct OPT_ENUM_ASN endTimeConfidence;  // ENUMERATED, OPTIONAL, unavailable(0), time_100_000(1), time_050_000(2), time_020_000(3), time_010_000(4), time_002_000(5), time_001_000(6), time_000_500(7), time_000_200(8), time_000_100(9), time_000_050(10), time_000_020(11), time_000_010(12), time_000_005(13), time_000_002(14), time_000_001(15), time_000_000_5(16), time_000_000_2(17), time_000_000_1(18), time_000_000_05(19), time_000_000_02(20), time_000_000_01(21), time_000_000_005(22), time_000_000_002(23), time_000_000_001(24), time_000_000_000_5(25), time_000_000_000_2(26), time_000_000_000_1(27), time_000_000_000_05(28), time_000_000_000_02(29), time_000_000_000_01(30), time_000_000_000_005(31), time_000_000_000_002(32), time_000_000_000_001(33), time_000_000_000_000_5(34), time_000_000_000_000_2(35), time_000_000_000_000_1(36), time_000_000_000_000_05(37), time_000_000_000_000_02(38), time_000_000_000_000_01(39);
    };
    
    struct SSMRSIPriority {
        INT isValidFlag;   // necessary if this struct is used as an optional field of a SEQUENCE
        CHAR string[2];
        INT  stringLength;
    };
    
    struct SSMPathPointList {
        INT isValidFlag;   // necessary if this struct is used as an optional field of a SEQUENCE
        INT length;
        struct SSMPositionOffsetLLV arrayValue[32];  // SEQUENCE;
    };
    
    struct SSMReferencePath {
        INT isValidFlag;   // necessary if this struct is used as an optional field of a SEQUENCE
        struct SSMPathPointList activePath;  // SEQUENCEOF;
        WORD pathRadius;  // INTEGER, 0..65535;
    };
    
    struct SSMReferencePathList {
        INT isValidFlag;   // necessary if this struct is used as an optional field of a SEQUENCE
        INT length;
        struct SSMReferencePath arrayValue[8];  // SEQUENCE;
    };
    
    struct SSMReferenceLinkList {
        INT isValidFlag;   // necessary if this struct is used as an optional field of a SEQUENCE
        INT length;
        struct SSMReferenceLink arrayValue[16];  // SEQUENCE;
    };
    
    struct SSMRTEData {
        INT isValidFlag;   // necessary if this struct is used as an optional field of a SEQUENCE
        BYTE rteId;  // INTEGER, 0..255;
        WORD eventType;  // INTEGER, 0..65535;
        INT eventSource;  // ENUMERATED, unknown(0), police(1), government(2), meteorological(3), internet(4), detection(5);
        struct SSMPositionOffsetLLV eventPos;  // SEQUENCE, OPTIONAL;
        struct OPT_WORD_ASN eventRadius;  // INTEGER, OPTIONAL, 0..65535;
        struct SSMDescription description;  // CHOICE, OPTIONAL;
        struct SSMRSITimeDetails timeDetails;  // SEQUENCE, OPTIONAL;
        struct SSMRSIPriority priority;  // OCTETSTRING, OPTIONAL;
        struct SSMReferencePathList referencePaths;  // SEQUENCEOF, OPTIONAL;
        struct SSMReferenceLinkList referenceLinks;  // SEQUENCEOF, OPTIONAL;
        struct OPT_BYTE_ASN eventConfidence;  // INTEGER, OPTIONAL, 0..200;
    };
    
    struct SSMRTEList {
        INT isValidFlag;   // necessary if this struct is used as an optional field of a SEQUENCE
        INT length;
        struct SSMRTEData arrayValue[8];  // SEQUENCE;
    };
    
    struct SSMSensorSharing_SensorSharingMsg {
        INT isValidFlag;   // necessary if this struct is used as an optional field of a SEQUENCE
        BYTE msgCnt;  // INTEGER, 0..127;
        struct SSMSensorSharingMsg_id id;  // OCTETSTRING;
        INT equipmentType;  // ENUMERATED, unknown(0), rsu(1), obu(2), vru(3);
        WORD secMark;  // INTEGER, 0..65535;
        struct SSMPosition3D sensorPos;  // SEQUENCE;
        struct SSMDetectedRegion detectedRegion;  // SEQUENCEOF, OPTIONAL;
        struct SSMDetectedPTCList participants;  // SEQUENCEOF, OPTIONAL;
        struct SSMDetectedObstacleList obstacles;  // SEQUENCEOF, OPTIONAL;
        struct SSMRTEList rtes;  // SEQUENCEOF, OPTIONAL;
    };
    
    struct SSMMessageTypes {
        struct SSMSensorSharing_SensorSharingMsg ssmData;  // SEQUENCE;
    };
    
    struct SSMMessageFrameExt {
        INT isValidFlag;   // necessary if this struct is used as an optional field of a SEQUENCE
        WORD messageId;  // INTEGER, 0..32767;
        struct SSMMessageTypes value;  // TABLE;
    };
    
    struct SSM {
        INT isValidFlag;   // necessary if this struct is used as an optional field of a SEQUENCE
        INT choice;
        struct SSMMessageFrameExt msgFrameExt;  // SEQUENCE;
    };
    
}

/*
// init function to create a simple packet handle
*/ 
LONG API_InitSSMPacket()
{
  return C2xInitPacket("SSM"); 
}

/*
// init function to create a simple packet handle and
// initialize the struct with valid data
*/ 
LONG API_InitSSMPacket(struct SSM msgStruct)
{
  long pktHandle;

  pktHandle = API_InitSSMPacket();

  if (pktHandle != 0)
  {
    // create valid message and application data
    if (C2xCompletePacket(pktHandle) == 0) 
    {
      API_GetSSMParams(pktHandle, msgStruct);
    }
  }
  return pktHandle;
}

/*
// init function to create a packet with security layer and
// initialize the struct with valid data
*/ 
LONG API_InitSSMPacket(struct SSM msgStruct, char packetTypeDesignator[], char certificateName[])
{
  long pktHandle, certHdl;

  // initialize the packet
  pktHandle = C2xInitPacket("SSM", packetTypeDesignator);

  if (pktHandle != 0)
  {
    certHdl = C2xSecCertificateGetHandle(certificateName);  // get the certificate handle for the cert with name "certificateName"
    if (certHdl != 0) 
    {
      C2xSecPacketSetSignerHandle(pktHandle, certHdl); // set the certHdl to the packet
    }

    // create valid message and application data
    if (C2xCompletePacket(pktHandle) == 0) 
    {
      // copy application data to the application structure
      API_GetSSMParams(pktHandle, msgStruct);
    }
  }
  return pktHandle;
}
    

int GetSSMPosition3DParams(LONG packetHandle, struct SSMPosition3D value, char oldPath[])
{
  char newPath[300];
  int result;

  result = 0;

  snprintf(newPath, elcount(newPath), "%s.%s", oldPath, "lat");
  value.lat = C2xGetTokenInt(packetHandle, "SSM", newPath);
  result = CheckLastError("SSM", gkFuncRefGet, result);

  snprintf(newPath, elcount(newPath), "%s.%s", oldPath, "lon");
  value.lon = C2xGetTokenInt(packetHandle, "SSM", newPath);
  result = CheckLastError("SSM", gkFuncRefGet, result);

  snprintf(newPath, elcount(newPath), "%s.%s", oldPath, "elevation");
  value.elevation.isValidFlag = C2xIsTokenAvailable(packetHandle, "SSM", newPath);
  if(value.elevation.isValidFlag==1)
  {
    value.elevation.value = C2xGetTokenInt(packetHandle, "SSM", newPath);
    result = CheckLastError("SSM", gkFuncRefGet, result);
  }
  return result;
}

int SetSSMPosition3DParams(LONG packetHandle, struct SSMPosition3D value, char oldPath[])
{
  char newPath[300];
  int result;

  result = 0;

  snprintf(newPath, elcount(newPath), "%s.%s", oldPath, "lat");
  C2xSetTokenInt(packetHandle, "SSM", newPath, value.lat);
  result = CheckLastError("SSM", gkFuncRefGet, result);

  snprintf(newPath, elcount(newPath), "%s.%s", oldPath, "lon");
  C2xSetTokenInt(packetHandle, "SSM", newPath, value.lon);
  result = CheckLastError("SSM", gkFuncRefGet, result);

  snprintf(newPath, elcount(newPath), "%s.%s", oldPath, "elevation");
  if(value.elevation.isValidFlag==1)
  {
    C2xSetTokenInt(packetHandle, "SSM", newPath, value.elevation.value);
    result = CheckLastError("SSM", gkFuncRefGet, result);
  }
  else
  {
    if( C2xIsTokenAvailable(packetHandle, "SSM", newPath) )
    {
      C2xRemoveToken(packetHandle, "SSM", newPath);
    }
  }

  return result;
}

int GetSSMPosition_LL_24BParams(LONG packetHandle, struct SSMPosition_LL_24B value, char oldPath[])
{
  char newPath[300];
  int result;

  result = 0;

  snprintf(newPath, elcount(newPath), "%s.%s", oldPath, "lon");
  value.lon = C2xGetTokenInt(packetHandle, "SSM", newPath);
  result = CheckLastError("SSM", gkFuncRefGet, result);

  snprintf(newPath, elcount(newPath), "%s.%s", oldPath, "lat");
  value.lat = C2xGetTokenInt(packetHandle, "SSM", newPath);
  result = CheckLastError("SSM", gkFuncRefGet, result);

  return result;
}

int SetSSMPosition_LL_24BParams(LONG packetHandle, struct SSMPosition_LL_24B value, char oldPath[])
{
  char newPath[300];
  int result;

  result = 0;

  snprintf(newPath, elcount(newPath), "%s.%s", oldPath, "lon");
  C2xSetTokenInt(packetHandle, "SSM", newPath, value.lon);
  result = CheckLastError("SSM", gkFuncRefGet, result);

  snprintf(newPath, elcount(newPath), "%s.%s", oldPath, "lat");
  C2xSetTokenInt(packetHandle, "SSM", newPath, value.lat);
  result = CheckLastError("SSM", gkFuncRefGet, result);

  return result;
}

int GetSSMPosition_LL_28BParams(LONG packetHandle, struct SSMPosition_LL_28B value, char oldPath[])
{
  char newPath[300];
  int result;

  result = 0;

  snprintf(newPath, elcount(newPath), "%s.%s", oldPath, "lon");
  value.lon = C2xGetTokenInt(packetHandle, "SSM", newPath);
  result = CheckLastError("SSM", gkFuncRefGet, result);

  snprintf(newPath, elcount(newPath), "%s.%s", oldPath, "lat");
  value.lat = C2xGetTokenInt(packetHandle, "SSM", newPath);
  result = CheckLastError("SSM", gkFuncRefGet, result);

  return result;
}

int SetSSMPosition_LL_28BParams(LONG packetHandle, struct SSMPosition_LL_28B value, char oldPath[])
{
  char newPath[300];
  int result;

  result = 0;

  snprintf(newPath, elcount(newPath), "%s.%s", oldPath, "lon");
  C2xSetTokenInt(packetHandle, "SSM", newPath, value.lon);
  result = CheckLastError("SSM", gkFuncRefGet, result);

  snprintf(newPath, elcount(newPath), "%s.%s", oldPath, "lat");
  C2xSetTokenInt(packetHandle, "SSM", newPath, value.lat);
  result = CheckLastError("SSM", gkFuncRefGet, result);

  return result;
}

int GetSSMPosition_LL_32BParams(LONG packetHandle, struct SSMPosition_LL_32B value, char oldPath[])
{
  char newPath[300];
  int result;

  result = 0;

  snprintf(newPath, elcount(newPath), "%s.%s", oldPath, "lon");
  value.lon = C2xGetTokenInt(packetHandle, "SSM", newPath);
  result = CheckLastError("SSM", gkFuncRefGet, result);

  snprintf(newPath, elcount(newPath), "%s.%s", oldPath, "lat");
  value.lat = C2xGetTokenInt(packetHandle, "SSM", newPath);
  result = CheckLastError("SSM", gkFuncRefGet, result);

  return result;
}

int SetSSMPosition_LL_32BParams(LONG packetHandle, struct SSMPosition_LL_32B value, char oldPath[])
{
  char newPath[300];
  int result;

  result = 0;

  snprintf(newPath, elcount(newPath), "%s.%s", oldPath, "lon");
  C2xSetTokenInt(packetHandle, "SSM", newPath, value.lon);
  result = CheckLastError("SSM", gkFuncRefGet, result);

  snprintf(newPath, elcount(newPath), "%s.%s", oldPath, "lat");
  C2xSetTokenInt(packetHandle, "SSM", newPath, value.lat);
  result = CheckLastError("SSM", gkFuncRefGet, result);

  return result;
}

int GetSSMPosition_LL_36BParams(LONG packetHandle, struct SSMPosition_LL_36B value, char oldPath[])
{
  char newPath[300];
  int result;

  result = 0;

  snprintf(newPath, elcount(newPath), "%s.%s", oldPath, "lon");
  value.lon = C2xGetTokenInt(packetHandle, "SSM", newPath);
  result = CheckLastError("SSM", gkFuncRefGet, result);

  snprintf(newPath, elcount(newPath), "%s.%s", oldPath, "lat");
  value.lat = C2xGetTokenInt(packetHandle, "SSM", newPath);
  result = CheckLastError("SSM", gkFuncRefGet, result);

  return result;
}

int SetSSMPosition_LL_36BParams(LONG packetHandle, struct SSMPosition_LL_36B value, char oldPath[])
{
  char newPath[300];
  int result;

  result = 0;

  snprintf(newPath, elcount(newPath), "%s.%s", oldPath, "lon");
  C2xSetTokenInt(packetHandle, "SSM", newPath, value.lon);
  result = CheckLastError("SSM", gkFuncRefGet, result);

  snprintf(newPath, elcount(newPath), "%s.%s", oldPath, "lat");
  C2xSetTokenInt(packetHandle, "SSM", newPath, value.lat);
  result = CheckLastError("SSM", gkFuncRefGet, result);

  return result;
}

int GetSSMPosition_LL_44BParams(LONG packetHandle, struct SSMPosition_LL_44B value, char oldPath[])
{
  char newPath[300];
  int result;

  result = 0;

  snprintf(newPath, elcount(newPath), "%s.%s", oldPath, "lon");
  value.lon = C2xGetTokenInt(packetHandle, "SSM", newPath);
  result = CheckLastError("SSM", gkFuncRefGet, result);

  snprintf(newPath, elcount(newPath), "%s.%s", oldPath, "lat");
  value.lat = C2xGetTokenInt(packetHandle, "SSM", newPath);
  result = CheckLastError("SSM", gkFuncRefGet, result);

  return result;
}

int SetSSMPosition_LL_44BParams(LONG packetHandle, struct SSMPosition_LL_44B value, char oldPath[])
{
  char newPath[300];
  int result;

  result = 0;

  snprintf(newPath, elcount(newPath), "%s.%s", oldPath, "lon");
  C2xSetTokenInt(packetHandle, "SSM", newPath, value.lon);
  result = CheckLastError("SSM", gkFuncRefGet, result);

  snprintf(newPath, elcount(newPath), "%s.%s", oldPath, "lat");
  C2xSetTokenInt(packetHandle, "SSM", newPath, value.lat);
  result = CheckLastError("SSM", gkFuncRefGet, result);

  return result;
}

int GetSSMPosition_LL_48BParams(LONG packetHandle, struct SSMPosition_LL_48B value, char oldPath[])
{
  char newPath[300];
  int result;

  result = 0;

  snprintf(newPath, elcount(newPath), "%s.%s", oldPath, "lon");
  value.lon = C2xGetTokenInt(packetHandle, "SSM", newPath);
  result = CheckLastError("SSM", gkFuncRefGet, result);

  snprintf(newPath, elcount(newPath), "%s.%s", oldPath, "lat");
  value.lat = C2xGetTokenInt(packetHandle, "SSM", newPath);
  result = CheckLastError("SSM", gkFuncRefGet, result);

  return result;
}

int SetSSMPosition_LL_48BParams(LONG packetHandle, struct SSMPosition_LL_48B value, char oldPath[])
{
  char newPath[300];
  int result;

  result = 0;

  snprintf(newPath, elcount(newPath), "%s.%s", oldPath, "lon");
  C2xSetTokenInt(packetHandle, "SSM", newPath, value.lon);
  result = CheckLastError("SSM", gkFuncRefGet, result);

  snprintf(newPath, elcount(newPath), "%s.%s", oldPath, "lat");
  C2xSetTokenInt(packetHandle, "SSM", newPath, value.lat);
  result = CheckLastError("SSM", gkFuncRefGet, result);

  return result;
}

int GetSSMPosition_LLmD_64bParams(LONG packetHandle, struct SSMPosition_LLmD_64b value, char oldPath[])
{
  char newPath[300];
  int result;

  result = 0;

  snprintf(newPath, elcount(newPath), "%s.%s", oldPath, "lon");
  value.lon = C2xGetTokenInt(packetHandle, "SSM", newPath);
  result = CheckLastError("SSM", gkFuncRefGet, result);

  snprintf(newPath, elcount(newPath), "%s.%s", oldPath, "lat");
  value.lat = C2xGetTokenInt(packetHandle, "SSM", newPath);
  result = CheckLastError("SSM", gkFuncRefGet, result);

  return result;
}

int SetSSMPosition_LLmD_64bParams(LONG packetHandle, struct SSMPosition_LLmD_64b value, char oldPath[])
{
  char newPath[300];
  int result;

  result = 0;

  snprintf(newPath, elcount(newPath), "%s.%s", oldPath, "lon");
  C2xSetTokenInt(packetHandle, "SSM", newPath, value.lon);
  result = CheckLastError("SSM", gkFuncRefGet, result);

  snprintf(newPath, elcount(newPath), "%s.%s", oldPath, "lat");
  C2xSetTokenInt(packetHandle, "SSM", newPath, value.lat);
  result = CheckLastError("SSM", gkFuncRefGet, result);

  return result;
}

int GetSSMPositionOffsetLLParams(LONG packetHandle, struct SSMPositionOffsetLL value, char oldPath[])
{
  char newPath[300];
  int result;

  result = 0;

  value.choice = C2xGetTokenInt(packetHandle, "SSM", oldPath);

  switch(value.choice)
  {
    case 0:
    {
      snprintf(newPath, elcount(newPath), "%s.%s", oldPath, "position_LL1");
      GetSSMPosition_LL_24BParams(packetHandle, value.position_LL1, newPath);
      result = CheckLastError("SSM", gkFuncRefGet, result);
    }
    break;
    case 1:
    {
      snprintf(newPath, elcount(newPath), "%s.%s", oldPath, "position_LL2");
      GetSSMPosition_LL_28BParams(packetHandle, value.position_LL2, newPath);
      result = CheckLastError("SSM", gkFuncRefGet, result);
    }
    break;
    case 2:
    {
      snprintf(newPath, elcount(newPath), "%s.%s", oldPath, "position_LL3");
      GetSSMPosition_LL_32BParams(packetHandle, value.position_LL3, newPath);
      result = CheckLastError("SSM", gkFuncRefGet, result);
    }
    break;
    case 3:
    {
      snprintf(newPath, elcount(newPath), "%s.%s", oldPath, "position_LL4");
      GetSSMPosition_LL_36BParams(packetHandle, value.position_LL4, newPath);
      result = CheckLastError("SSM", gkFuncRefGet, result);
    }
    break;
    case 4:
    {
      snprintf(newPath, elcount(newPath), "%s.%s", oldPath, "position_LL5");
      GetSSMPosition_LL_44BParams(packetHandle, value.position_LL5, newPath);
      result = CheckLastError("SSM", gkFuncRefGet, result);
    }
    break;
    case 5:
    {
      snprintf(newPath, elcount(newPath), "%s.%s", oldPath, "position_LL6");
      GetSSMPosition_LL_48BParams(packetHandle, value.position_LL6, newPath);
      result = CheckLastError("SSM", gkFuncRefGet, result);
    }
    break;
    case 6:
    {
      snprintf(newPath, elcount(newPath), "%s.%s", oldPath, "position_LatLon");
      GetSSMPosition_LLmD_64bParams(packetHandle, value.position_LatLon, newPath);
      result = CheckLastError("SSM", gkFuncRefGet, result);
    }
    break;
  }
  return result;
}

int SetSSMPositionOffsetLLParams(LONG packetHandle, struct SSMPositionOffsetLL value, char oldPath[])
{
  char newPath[300];
  int result;

  result = 0;

  switch(value.choice)
  {
    case 0:
    {
      snprintf(newPath, elcount(newPath), "%s.%s", oldPath, "position_LL1");
      SetSSMPosition_LL_24BParams(packetHandle, value.position_LL1, newPath);
      result = CheckLastError("SSM", gkFuncRefGet, result);
    }
    break;
    case 1:
    {
      snprintf(newPath, elcount(newPath), "%s.%s", oldPath, "position_LL2");
      SetSSMPosition_LL_28BParams(packetHandle, value.position_LL2, newPath);
      result = CheckLastError("SSM", gkFuncRefGet, result);
    }
    break;
    case 2:
    {
      snprintf(newPath, elcount(newPath), "%s.%s", oldPath, "position_LL3");
      SetSSMPosition_LL_32BParams(packetHandle, value.position_LL3, newPath);
      result = CheckLastError("SSM", gkFuncRefGet, result);
    }
    break;
    case 3:
    {
      snprintf(newPath, elcount(newPath), "%s.%s", oldPath, "position_LL4");
      SetSSMPosition_LL_36BParams(packetHandle, value.position_LL4, newPath);
      result = CheckLastError("SSM", gkFuncRefGet, result);
    }
    break;
    case 4:
    {
      snprintf(newPath, elcount(newPath), "%s.%s", oldPath, "position_LL5");
      SetSSMPosition_LL_44BParams(packetHandle, value.position_LL5, newPath);
      result = CheckLastError("SSM", gkFuncRefGet, result);
    }
    break;
    case 5:
    {
      snprintf(newPath, elcount(newPath), "%s.%s", oldPath, "position_LL6");
      SetSSMPosition_LL_48BParams(packetHandle, value.position_LL6, newPath);
      result = CheckLastError("SSM", gkFuncRefGet, result);
    }
    break;
    case 6:
    {
      snprintf(newPath, elcount(newPath), "%s.%s", oldPath, "position_LatLon");
      SetSSMPosition_LLmD_64bParams(packetHandle, value.position_LatLon, newPath);
      result = CheckLastError("SSM", gkFuncRefGet, result);
    }
    break;
  }
  return result;
}

int GetSSMVerticalOffsetParams(LONG packetHandle, struct SSMVerticalOffset value, char oldPath[])
{
  char newPath[300];
  int result;

  result = 0;

  value.choice = C2xGetTokenInt(packetHandle, "SSM", oldPath);

  switch(value.choice)
  {
    case 0:
    {
      snprintf(newPath, elcount(newPath), "%s.%s", oldPath, "offset1");
      value.offset1 = C2xGetTokenInt(packetHandle, "SSM", newPath);
      result = CheckLastError("SSM", gkFuncRefGet, result);
    }
    break;
    case 1:
    {
      snprintf(newPath, elcount(newPath), "%s.%s", oldPath, "offset2");
      value.offset2 = C2xGetTokenInt(packetHandle, "SSM", newPath);
      result = CheckLastError("SSM", gkFuncRefGet, result);
    }
    break;
    case 2:
    {
      snprintf(newPath, elcount(newPath), "%s.%s", oldPath, "offset3");
      value.offset3 = C2xGetTokenInt(packetHandle, "SSM", newPath);
      result = CheckLastError("SSM", gkFuncRefGet, result);
    }
    break;
    case 3:
    {
      snprintf(newPath, elcount(newPath), "%s.%s", oldPath, "offset4");
      value.offset4 = C2xGetTokenInt(packetHandle, "SSM", newPath);
      result = CheckLastError("SSM", gkFuncRefGet, result);
    }
    break;
    case 4:
    {
      snprintf(newPath, elcount(newPath), "%s.%s", oldPath, "offset5");
      value.offset5 = C2xGetTokenInt(packetHandle, "SSM", newPath);
      result = CheckLastError("SSM", gkFuncRefGet, result);
    }
    break;
    case 5:
    {
      snprintf(newPath, elcount(newPath), "%s.%s", oldPath, "offset6");
      value.offset6 = C2xGetTokenInt(packetHandle, "SSM", newPath);
      result = CheckLastError("SSM", gkFuncRefGet, result);
    }
    break;
    case 6:
    {
      snprintf(newPath, elcount(newPath), "%s.%s", oldPath, "elevation");
      value.elevation = C2xGetTokenInt(packetHandle, "SSM", newPath);
      result = CheckLastError("SSM", gkFuncRefGet, result);
    }
    break;
  }
  return result;
}

int SetSSMVerticalOffsetParams(LONG packetHandle, struct SSMVerticalOffset value, char oldPath[])
{
  char newPath[300];
  int result;

  result = 0;

  switch(value.choice)
  {
    case 0:
    {
      snprintf(newPath, elcount(newPath), "%s.%s", oldPath, "offset1");
      C2xSetTokenInt(packetHandle, "SSM", newPath, value.offset1);
      result = CheckLastError("SSM", gkFuncRefGet, result);
    }
    break;
    case 1:
    {
      snprintf(newPath, elcount(newPath), "%s.%s", oldPath, "offset2");
      C2xSetTokenInt(packetHandle, "SSM", newPath, value.offset2);
      result = CheckLastError("SSM", gkFuncRefGet, result);
    }
    break;
    case 2:
    {
      snprintf(newPath, elcount(newPath), "%s.%s", oldPath, "offset3");
      C2xSetTokenInt(packetHandle, "SSM", newPath, value.offset3);
      result = CheckLastError("SSM", gkFuncRefGet, result);
    }
    break;
    case 3:
    {
      snprintf(newPath, elcount(newPath), "%s.%s", oldPath, "offset4");
      C2xSetTokenInt(packetHandle, "SSM", newPath, value.offset4);
      result = CheckLastError("SSM", gkFuncRefGet, result);
    }
    break;
    case 4:
    {
      snprintf(newPath, elcount(newPath), "%s.%s", oldPath, "offset5");
      C2xSetTokenInt(packetHandle, "SSM", newPath, value.offset5);
      result = CheckLastError("SSM", gkFuncRefGet, result);
    }
    break;
    case 5:
    {
      snprintf(newPath, elcount(newPath), "%s.%s", oldPath, "offset6");
      C2xSetTokenInt(packetHandle, "SSM", newPath, value.offset6);
      result = CheckLastError("SSM", gkFuncRefGet, result);
    }
    break;
    case 6:
    {
      snprintf(newPath, elcount(newPath), "%s.%s", oldPath, "elevation");
      C2xSetTokenInt(packetHandle, "SSM", newPath, value.elevation);
      result = CheckLastError("SSM", gkFuncRefGet, result);
    }
    break;
  }
  return result;
}

int GetSSMPositionOffsetLLVParams(LONG packetHandle, struct SSMPositionOffsetLLV value, char oldPath[])
{
  char newPath[300];
  int result;

  result = 0;

  snprintf(newPath, elcount(newPath), "%s.%s", oldPath, "offsetLL");
  GetSSMPositionOffsetLLParams(packetHandle, value.offsetLL, newPath);
  result = CheckLastError("SSM", gkFuncRefGet, result);

  snprintf(newPath, elcount(newPath), "%s.%s", oldPath, "offsetV");
  value.offsetV.isValidFlag = C2xIsTokenAvailable(packetHandle, "SSM", newPath);
  if(value.offsetV.isValidFlag==1)
  {
    GetSSMVerticalOffsetParams(packetHandle, value.offsetV, newPath);
    result = CheckLastError("SSM", gkFuncRefGet, result);
  }
  return result;
}

int SetSSMPositionOffsetLLVParams(LONG packetHandle, struct SSMPositionOffsetLLV value, char oldPath[])
{
  char newPath[300];
  int result;

  result = 0;

  snprintf(newPath, elcount(newPath), "%s.%s", oldPath, "offsetLL");
  SetSSMPositionOffsetLLParams(packetHandle, value.offsetLL, newPath);
  result = CheckLastError("SSM", gkFuncRefGet, result);

  snprintf(newPath, elcount(newPath), "%s.%s", oldPath, "offsetV");
  if(value.offsetV.isValidFlag==1)
  {
    SetSSMVerticalOffsetParams(packetHandle, value.offsetV, newPath);
    result = CheckLastError("SSM", gkFuncRefGet, result);
  }
  else
  {
    if( C2xIsTokenAvailable(packetHandle, "SSM", newPath) )
    {
      C2xRemoveToken(packetHandle, "SSM", newPath);
    }
  }

  return result;
}

int GetSSMPolygonParams(LONG packetHandle, struct SSMPolygon value, char oldPath[])
{
  char newPath[300]; 
  int i;
  int result;

  result = 0;

  value.length = C2xGetTokenInt(packetHandle, "SSM", oldPath);
  if((result = CheckLastError("SSM", gkFuncRefGet, result))==0)
  {
    for(i=0; i<value.length; i++)
    {
      snprintf(newPath, elcount(newPath), "%s[%d]", oldPath, i);
      GetSSMPositionOffsetLLVParams(packetHandle, value.arrayValue[i], newPath);
      result = CheckLastError("SSM", gkFuncRefGet, result);
    }
  }
  return result;
}

int SetSSMPolygonParams(LONG packetHandle, struct SSMPolygon value, char oldPath[])
{
  char newPath[300]; 
  int i;
  int result;

  result = 0;

  C2xRemoveToken(packetHandle, "SSM", oldPath);
  for(i=0; i<value.length; i++)
  {
    snprintf(newPath, elcount(newPath), "%s[%d]", oldPath, i);
    SetSSMPositionOffsetLLVParams(packetHandle, value.arrayValue[i], newPath);
    result = CheckLastError("SSM", gkFuncRefGet, result);
  }
  return result;
}

int GetSSMDetectedRegionParams(LONG packetHandle, struct SSMDetectedRegion value, char oldPath[])
{
  char newPath[300]; 
  int i;
  int result;

  result = 0;

  value.length = C2xGetTokenInt(packetHandle, "SSM", oldPath);
  if((result = CheckLastError("SSM", gkFuncRefGet, result))==0)
  {
    for(i=0; i<value.length; i++)
    {
      snprintf(newPath, elcount(newPath), "%s[%d]", oldPath, i);
      GetSSMPolygonParams(packetHandle, value.arrayValue[i], newPath);
      result = CheckLastError("SSM", gkFuncRefGet, result);
    }
  }
  return result;
}

int SetSSMDetectedRegionParams(LONG packetHandle, struct SSMDetectedRegion value, char oldPath[])
{
  char newPath[300]; 
  int i;
  int result;

  result = 0;

  C2xRemoveToken(packetHandle, "SSM", oldPath);
  for(i=0; i<value.length; i++)
  {
    snprintf(newPath, elcount(newPath), "%s[%d]", oldPath, i);
    SetSSMPolygonParams(packetHandle, value.arrayValue[i], newPath);
    result = CheckLastError("SSM", gkFuncRefGet, result);
  }
  return result;
}

int GetSSMPositionConfidenceSetParams(LONG packetHandle, struct SSMPositionConfidenceSet value, char oldPath[])
{
  char newPath[300];
  int result;

  result = 0;

  snprintf(newPath, elcount(newPath), "%s.%s", oldPath, "pos");
  value.pos = C2xGetTokenInt(packetHandle, "SSM", newPath);
  result = CheckLastError("SSM", gkFuncRefGet, result);

  snprintf(newPath, elcount(newPath), "%s.%s", oldPath, "elevation");
  value.elevation.isValidFlag = C2xIsTokenAvailable(packetHandle, "SSM", newPath);
  if(value.elevation.isValidFlag==1)
  {
    value.elevation.value = C2xGetTokenInt(packetHandle, "SSM", newPath);
    result = CheckLastError("SSM", gkFuncRefGet, result);
  }
  return result;
}

int SetSSMPositionConfidenceSetParams(LONG packetHandle, struct SSMPositionConfidenceSet value, char oldPath[])
{
  char newPath[300];
  int result;

  result = 0;

  snprintf(newPath, elcount(newPath), "%s.%s", oldPath, "pos");
  C2xSetTokenInt(packetHandle, "SSM", newPath, value.pos);
  result = CheckLastError("SSM", gkFuncRefGet, result);

  snprintf(newPath, elcount(newPath), "%s.%s", oldPath, "elevation");
  if(value.elevation.isValidFlag==1)
  {
    C2xSetTokenInt(packetHandle, "SSM", newPath, value.elevation.value);
    result = CheckLastError("SSM", gkFuncRefGet, result);
  }
  else
  {
    if( C2xIsTokenAvailable(packetHandle, "SSM", newPath) )
    {
      C2xRemoveToken(packetHandle, "SSM", newPath);
    }
  }

  return result;
}

int GetSSMMotionConfidenceSetParams(LONG packetHandle, struct SSMMotionConfidenceSet value, char oldPath[])
{
  char newPath[300];
  int result;

  result = 0;

  snprintf(newPath, elcount(newPath), "%s.%s", oldPath, "speedCfd");
  value.speedCfd.isValidFlag = C2xIsTokenAvailable(packetHandle, "SSM", newPath);
  if(value.speedCfd.isValidFlag==1)
  {
    value.speedCfd.value = C2xGetTokenInt(packetHandle, "SSM", newPath);
    result = CheckLastError("SSM", gkFuncRefGet, result);
  }
  snprintf(newPath, elcount(newPath), "%s.%s", oldPath, "headingCfd");
  value.headingCfd.isValidFlag = C2xIsTokenAvailable(packetHandle, "SSM", newPath);
  if(value.headingCfd.isValidFlag==1)
  {
    value.headingCfd.value = C2xGetTokenInt(packetHandle, "SSM", newPath);
    result = CheckLastError("SSM", gkFuncRefGet, result);
  }
  snprintf(newPath, elcount(newPath), "%s.%s", oldPath, "steerCfd");
  value.steerCfd.isValidFlag = C2xIsTokenAvailable(packetHandle, "SSM", newPath);
  if(value.steerCfd.isValidFlag==1)
  {
    value.steerCfd.value = C2xGetTokenInt(packetHandle, "SSM", newPath);
    result = CheckLastError("SSM", gkFuncRefGet, result);
  }
  return result;
}

int SetSSMMotionConfidenceSetParams(LONG packetHandle, struct SSMMotionConfidenceSet value, char oldPath[])
{
  char newPath[300];
  int result;

  result = 0;

  snprintf(newPath, elcount(newPath), "%s.%s", oldPath, "speedCfd");
  if(value.speedCfd.isValidFlag==1)
  {
    C2xSetTokenInt(packetHandle, "SSM", newPath, value.speedCfd.value);
    result = CheckLastError("SSM", gkFuncRefGet, result);
  }
  else
  {
    if( C2xIsTokenAvailable(packetHandle, "SSM", newPath) )
    {
      C2xRemoveToken(packetHandle, "SSM", newPath);
    }
  }

  snprintf(newPath, elcount(newPath), "%s.%s", oldPath, "headingCfd");
  if(value.headingCfd.isValidFlag==1)
  {
    C2xSetTokenInt(packetHandle, "SSM", newPath, value.headingCfd.value);
    result = CheckLastError("SSM", gkFuncRefGet, result);
  }
  else
  {
    if( C2xIsTokenAvailable(packetHandle, "SSM", newPath) )
    {
      C2xRemoveToken(packetHandle, "SSM", newPath);
    }
  }

  snprintf(newPath, elcount(newPath), "%s.%s", oldPath, "steerCfd");
  if(value.steerCfd.isValidFlag==1)
  {
    C2xSetTokenInt(packetHandle, "SSM", newPath, value.steerCfd.value);
    result = CheckLastError("SSM", gkFuncRefGet, result);
  }
  else
  {
    if( C2xIsTokenAvailable(packetHandle, "SSM", newPath) )
    {
      C2xRemoveToken(packetHandle, "SSM", newPath);
    }
  }

  return result;
}

int GetSSMAccelerationSet4WayParams(LONG packetHandle, struct SSMAccelerationSet4Way value, char oldPath[])
{
  char newPath[300];
  int result;

  result = 0;

  snprintf(newPath, elcount(newPath), "%s.%s", oldPath, "lon");
  value.lon = C2xGetTokenInt(packetHandle, "SSM", newPath);
  result = CheckLastError("SSM", gkFuncRefGet, result);

  snprintf(newPath, elcount(newPath), "%s.%s", oldPath, "lat");
  value.lat = C2xGetTokenInt(packetHandle, "SSM", newPath);
  result = CheckLastError("SSM", gkFuncRefGet, result);

  snprintf(newPath, elcount(newPath), "%s.%s", oldPath, "vert");
  value.vert = C2xGetTokenInt(packetHandle, "SSM", newPath);
  result = CheckLastError("SSM", gkFuncRefGet, result);

  snprintf(newPath, elcount(newPath), "%s.%s", oldPath, "yaw");
  value.yaw = C2xGetTokenInt(packetHandle, "SSM", newPath);
  result = CheckLastError("SSM", gkFuncRefGet, result);

  return result;
}

int SetSSMAccelerationSet4WayParams(LONG packetHandle, struct SSMAccelerationSet4Way value, char oldPath[])
{
  char newPath[300];
  int result;

  result = 0;

  snprintf(newPath, elcount(newPath), "%s.%s", oldPath, "lon");
  C2xSetTokenInt(packetHandle, "SSM", newPath, value.lon);
  result = CheckLastError("SSM", gkFuncRefGet, result);

  snprintf(newPath, elcount(newPath), "%s.%s", oldPath, "lat");
  C2xSetTokenInt(packetHandle, "SSM", newPath, value.lat);
  result = CheckLastError("SSM", gkFuncRefGet, result);

  snprintf(newPath, elcount(newPath), "%s.%s", oldPath, "vert");
  C2xSetTokenInt(packetHandle, "SSM", newPath, value.vert);
  result = CheckLastError("SSM", gkFuncRefGet, result);

  snprintf(newPath, elcount(newPath), "%s.%s", oldPath, "yaw");
  C2xSetTokenInt(packetHandle, "SSM", newPath, value.yaw);
  result = CheckLastError("SSM", gkFuncRefGet, result);

  return result;
}

int GetSSMVehicleSizeParams(LONG packetHandle, struct SSMVehicleSize value, char oldPath[])
{
  char newPath[300];
  int result;

  result = 0;

  snprintf(newPath, elcount(newPath), "%s.%s", oldPath, "width");
  value.width = C2xGetTokenInt(packetHandle, "SSM", newPath);
  result = CheckLastError("SSM", gkFuncRefGet, result);

  snprintf(newPath, elcount(newPath), "%s.%s", oldPath, "length");
  value.length = C2xGetTokenInt(packetHandle, "SSM", newPath);
  result = CheckLastError("SSM", gkFuncRefGet, result);

  snprintf(newPath, elcount(newPath), "%s.%s", oldPath, "height");
  value.height.isValidFlag = C2xIsTokenAvailable(packetHandle, "SSM", newPath);
  if(value.height.isValidFlag==1)
  {
    value.height.value = C2xGetTokenInt(packetHandle, "SSM", newPath);
    result = CheckLastError("SSM", gkFuncRefGet, result);
  }
  return result;
}

int SetSSMVehicleSizeParams(LONG packetHandle, struct SSMVehicleSize value, char oldPath[])
{
  char newPath[300];
  int result;

  result = 0;

  snprintf(newPath, elcount(newPath), "%s.%s", oldPath, "width");
  C2xSetTokenInt(packetHandle, "SSM", newPath, value.width);
  result = CheckLastError("SSM", gkFuncRefGet, result);

  snprintf(newPath, elcount(newPath), "%s.%s", oldPath, "length");
  C2xSetTokenInt(packetHandle, "SSM", newPath, value.length);
  result = CheckLastError("SSM", gkFuncRefGet, result);

  snprintf(newPath, elcount(newPath), "%s.%s", oldPath, "height");
  if(value.height.isValidFlag==1)
  {
    C2xSetTokenInt(packetHandle, "SSM", newPath, value.height.value);
    result = CheckLastError("SSM", gkFuncRefGet, result);
  }
  else
  {
    if( C2xIsTokenAvailable(packetHandle, "SSM", newPath) )
    {
      C2xRemoveToken(packetHandle, "SSM", newPath);
    }
  }

  return result;
}

int GetSSMVehicleClassificationParams(LONG packetHandle, struct SSMVehicleClassification value, char oldPath[])
{
  char newPath[300];
  int result;

  result = 0;

  snprintf(newPath, elcount(newPath), "%s.%s", oldPath, "classification");
  value.classification = C2xGetTokenInt(packetHandle, "SSM", newPath);
  result = CheckLastError("SSM", gkFuncRefGet, result);

  snprintf(newPath, elcount(newPath), "%s.%s", oldPath, "fuelType");
  value.fuelType.isValidFlag = C2xIsTokenAvailable(packetHandle, "SSM", newPath);
  if(value.fuelType.isValidFlag==1)
  {
    value.fuelType.value = C2xGetTokenInt(packetHandle, "SSM", newPath);
    result = CheckLastError("SSM", gkFuncRefGet, result);
  }
  return result;
}

int SetSSMVehicleClassificationParams(LONG packetHandle, struct SSMVehicleClassification value, char oldPath[])
{
  char newPath[300];
  int result;

  result = 0;

  snprintf(newPath, elcount(newPath), "%s.%s", oldPath, "classification");
  C2xSetTokenInt(packetHandle, "SSM", newPath, value.classification);
  result = CheckLastError("SSM", gkFuncRefGet, result);

  snprintf(newPath, elcount(newPath), "%s.%s", oldPath, "fuelType");
  if(value.fuelType.isValidFlag==1)
  {
    C2xSetTokenInt(packetHandle, "SSM", newPath, value.fuelType.value);
    result = CheckLastError("SSM", gkFuncRefGet, result);
  }
  else
  {
    if( C2xIsTokenAvailable(packetHandle, "SSM", newPath) )
    {
      C2xRemoveToken(packetHandle, "SSM", newPath);
    }
  }

  return result;
}

int GetSSMParticipantDataParams(LONG packetHandle, struct SSMParticipantData value, char oldPath[])
{
  char newPath[300];
  int result;

  result = 0;

  snprintf(newPath, elcount(newPath), "%s.%s", oldPath, "ptcType");
  value.ptcType = C2xGetTokenInt(packetHandle, "SSM", newPath);
  result = CheckLastError("SSM", gkFuncRefGet, result);

  snprintf(newPath, elcount(newPath), "%s.%s", oldPath, "ptcId");
  value.ptcId = C2xGetTokenInt(packetHandle, "SSM", newPath);
  result = CheckLastError("SSM", gkFuncRefGet, result);

  snprintf(newPath, elcount(newPath), "%s.%s", oldPath, "source");
  value.source = C2xGetTokenInt(packetHandle, "SSM", newPath);
  result = CheckLastError("SSM", gkFuncRefGet, result);

  snprintf(newPath, elcount(newPath), "%s.%s", oldPath, "id");
  value.id.isValidFlag = C2xIsTokenAvailable(packetHandle, "SSM", newPath);
  if(value.id.isValidFlag==1)
  {
    value.id.isValidFlag = 1;
    value.id.stringLength = C2xGetTokenData(packetHandle, "SSM", newPath, elcount(value.id.string), value.id.string);
  }
  snprintf(newPath, elcount(newPath), "%s.%s", oldPath, "secMark");
  value.secMark = C2xGetTokenInt(packetHandle, "SSM", newPath);
  result = CheckLastError("SSM", gkFuncRefGet, result);

  snprintf(newPath, elcount(newPath), "%s.%s", oldPath, "pos");
  GetSSMPositionOffsetLLVParams(packetHandle, value.pos, newPath);
  result = CheckLastError("SSM", gkFuncRefGet, result);

  snprintf(newPath, elcount(newPath), "%s.%s", oldPath, "posConfidence");
  GetSSMPositionConfidenceSetParams(packetHandle, value.posConfidence, newPath);
  result = CheckLastError("SSM", gkFuncRefGet, result);

  snprintf(newPath, elcount(newPath), "%s.%s", oldPath, "transmission");
  value.transmission.isValidFlag = C2xIsTokenAvailable(packetHandle, "SSM", newPath);
  if(value.transmission.isValidFlag==1)
  {
    value.transmission.value = C2xGetTokenInt(packetHandle, "SSM", newPath);
    result = CheckLastError("SSM", gkFuncRefGet, result);
  }
  snprintf(newPath, elcount(newPath), "%s.%s", oldPath, "speed");
  value.speed = C2xGetTokenInt(packetHandle, "SSM", newPath);
  result = CheckLastError("SSM", gkFuncRefGet, result);

  snprintf(newPath, elcount(newPath), "%s.%s", oldPath, "heading");
  value.heading = C2xGetTokenInt(packetHandle, "SSM", newPath);
  result = CheckLastError("SSM", gkFuncRefGet, result);

  snprintf(newPath, elcount(newPath), "%s.%s", oldPath, "angle");
  value.angle.isValidFlag = C2xIsTokenAvailable(packetHandle, "SSM", newPath);
  if(value.angle.isValidFlag==1)
  {
    value.angle.value = C2xGetTokenInt(packetHandle, "SSM", newPath);
    result = CheckLastError("SSM", gkFuncRefGet, result);
  }
  snprintf(newPath, elcount(newPath), "%s.%s", oldPath, "motionCfd");
  value.motionCfd.isValidFlag = C2xIsTokenAvailable(packetHandle, "SSM", newPath);
  if(value.motionCfd.isValidFlag==1)
  {
    GetSSMMotionConfidenceSetParams(packetHandle, value.motionCfd, newPath);
    result = CheckLastError("SSM", gkFuncRefGet, result);
  }
  snprintf(newPath, elcount(newPath), "%s.%s", oldPath, "accelSet");
  value.accelSet.isValidFlag = C2xIsTokenAvailable(packetHandle, "SSM", newPath);
  if(value.accelSet.isValidFlag==1)
  {
    GetSSMAccelerationSet4WayParams(packetHandle, value.accelSet, newPath);
    result = CheckLastError("SSM", gkFuncRefGet, result);
  }
  snprintf(newPath, elcount(newPath), "%s.%s", oldPath, "size");
  GetSSMVehicleSizeParams(packetHandle, value.size, newPath);
  result = CheckLastError("SSM", gkFuncRefGet, result);

  snprintf(newPath, elcount(newPath), "%s.%s", oldPath, "vehicleClass");
  value.vehicleClass.isValidFlag = C2xIsTokenAvailable(packetHandle, "SSM", newPath);
  if(value.vehicleClass.isValidFlag==1)
  {
    GetSSMVehicleClassificationParams(packetHandle, value.vehicleClass, newPath);
    result = CheckLastError("SSM", gkFuncRefGet, result);
  }
  return result;
}

int SetSSMParticipantDataParams(LONG packetHandle, struct SSMParticipantData value, char oldPath[])
{
  char newPath[300];
  int result;

  result = 0;

  snprintf(newPath, elcount(newPath), "%s.%s", oldPath, "ptcType");
  C2xSetTokenInt(packetHandle, "SSM", newPath, value.ptcType);
  result = CheckLastError("SSM", gkFuncRefGet, result);

  snprintf(newPath, elcount(newPath), "%s.%s", oldPath, "ptcId");
  C2xSetTokenInt(packetHandle, "SSM", newPath, value.ptcId);
  result = CheckLastError("SSM", gkFuncRefGet, result);

  snprintf(newPath, elcount(newPath), "%s.%s", oldPath, "source");
  C2xSetTokenInt(packetHandle, "SSM", newPath, value.source);
  result = CheckLastError("SSM", gkFuncRefGet, result);

  if(value.id.stringLength == 0)
  {
    value.id.stringLength = 8;
    memcpy(value.id.string, "00000000", value.id.stringLength);
  }

  snprintf(newPath, elcount(newPath), "%s.%s", oldPath, "id");
  if(value.id.isValidFlag==1)
  {
    C2xSetTokenData(packetHandle, "SSM", newPath, value.id.stringLength, value.id.string);
  }
  else
  {
    if( C2xIsTokenAvailable(packetHandle, "SSM", newPath) )
    {
      C2xRemoveToken(packetHandle, "SSM", newPath);
    }
  }

  snprintf(newPath, elcount(newPath), "%s.%s", oldPath, "secMark");
  C2xSetTokenInt(packetHandle, "SSM", newPath, value.secMark);
  result = CheckLastError("SSM", gkFuncRefGet, result);

  snprintf(newPath, elcount(newPath), "%s.%s", oldPath, "pos");
  SetSSMPositionOffsetLLVParams(packetHandle, value.pos, newPath);
  result = CheckLastError("SSM", gkFuncRefGet, result);

  snprintf(newPath, elcount(newPath), "%s.%s", oldPath, "posConfidence");
  SetSSMPositionConfidenceSetParams(packetHandle, value.posConfidence, newPath);
  result = CheckLastError("SSM", gkFuncRefGet, result);

  snprintf(newPath, elcount(newPath), "%s.%s", oldPath, "transmission");
  if(value.transmission.isValidFlag==1)
  {
    C2xSetTokenInt(packetHandle, "SSM", newPath, value.transmission.value);
    result = CheckLastError("SSM", gkFuncRefGet, result);
  }
  else
  {
    if( C2xIsTokenAvailable(packetHandle, "SSM", newPath) )
    {
      C2xRemoveToken(packetHandle, "SSM", newPath);
    }
  }

  snprintf(newPath, elcount(newPath), "%s.%s", oldPath, "speed");
  C2xSetTokenInt(packetHandle, "SSM", newPath, value.speed);
  result = CheckLastError("SSM", gkFuncRefGet, result);

  snprintf(newPath, elcount(newPath), "%s.%s", oldPath, "heading");
  C2xSetTokenInt(packetHandle, "SSM", newPath, value.heading);
  result = CheckLastError("SSM", gkFuncRefGet, result);

  snprintf(newPath, elcount(newPath), "%s.%s", oldPath, "angle");
  if(value.angle.isValidFlag==1)
  {
    C2xSetTokenInt(packetHandle, "SSM", newPath, value.angle.value);
    result = CheckLastError("SSM", gkFuncRefGet, result);
  }
  else
  {
    if( C2xIsTokenAvailable(packetHandle, "SSM", newPath) )
    {
      C2xRemoveToken(packetHandle, "SSM", newPath);
    }
  }

  snprintf(newPath, elcount(newPath), "%s.%s", oldPath, "motionCfd");
  if(value.motionCfd.isValidFlag==1)
  {
    SetSSMMotionConfidenceSetParams(packetHandle, value.motionCfd, newPath);
    result = CheckLastError("SSM", gkFuncRefGet, result);
  }
  else
  {
    if( C2xIsTokenAvailable(packetHandle, "SSM", newPath) )
    {
      C2xRemoveToken(packetHandle, "SSM", newPath);
    }
  }

  snprintf(newPath, elcount(newPath), "%s.%s", oldPath, "accelSet");
  if(value.accelSet.isValidFlag==1)
  {
    SetSSMAccelerationSet4WayParams(packetHandle, value.accelSet, newPath);
    result = CheckLastError("SSM", gkFuncRefGet, result);
  }
  else
  {
    if( C2xIsTokenAvailable(packetHandle, "SSM", newPath) )
    {
      C2xRemoveToken(packetHandle, "SSM", newPath);
    }
  }

  snprintf(newPath, elcount(newPath), "%s.%s", oldPath, "size");
  SetSSMVehicleSizeParams(packetHandle, value.size, newPath);
  result = CheckLastError("SSM", gkFuncRefGet, result);

  snprintf(newPath, elcount(newPath), "%s.%s", oldPath, "vehicleClass");
  if(value.vehicleClass.isValidFlag==1)
  {
    SetSSMVehicleClassificationParams(packetHandle, value.vehicleClass, newPath);
    result = CheckLastError("SSM", gkFuncRefGet, result);
  }
  else
  {
    if( C2xIsTokenAvailable(packetHandle, "SSM", newPath) )
    {
      C2xRemoveToken(packetHandle, "SSM", newPath);
    }
  }

  return result;
}

int GetSSMObjectSizeConfidenceParams(LONG packetHandle, struct SSMObjectSizeConfidence value, char oldPath[])
{
  char newPath[300];
  int result;

  result = 0;

  snprintf(newPath, elcount(newPath), "%s.%s", oldPath, "widthConf");
  value.widthConf = C2xGetTokenInt(packetHandle, "SSM", newPath);
  result = CheckLastError("SSM", gkFuncRefGet, result);

  snprintf(newPath, elcount(newPath), "%s.%s", oldPath, "lengthConf");
  value.lengthConf = C2xGetTokenInt(packetHandle, "SSM", newPath);
  result = CheckLastError("SSM", gkFuncRefGet, result);

  snprintf(newPath, elcount(newPath), "%s.%s", oldPath, "heightConf");
  value.heightConf.isValidFlag = C2xIsTokenAvailable(packetHandle, "SSM", newPath);
  if(value.heightConf.isValidFlag==1)
  {
    value.heightConf.value = C2xGetTokenInt(packetHandle, "SSM", newPath);
    result = CheckLastError("SSM", gkFuncRefGet, result);
  }
  return result;
}

int SetSSMObjectSizeConfidenceParams(LONG packetHandle, struct SSMObjectSizeConfidence value, char oldPath[])
{
  char newPath[300];
  int result;

  result = 0;

  snprintf(newPath, elcount(newPath), "%s.%s", oldPath, "widthConf");
  C2xSetTokenInt(packetHandle, "SSM", newPath, value.widthConf);
  result = CheckLastError("SSM", gkFuncRefGet, result);

  snprintf(newPath, elcount(newPath), "%s.%s", oldPath, "lengthConf");
  C2xSetTokenInt(packetHandle, "SSM", newPath, value.lengthConf);
  result = CheckLastError("SSM", gkFuncRefGet, result);

  snprintf(newPath, elcount(newPath), "%s.%s", oldPath, "heightConf");
  if(value.heightConf.isValidFlag==1)
  {
    C2xSetTokenInt(packetHandle, "SSM", newPath, value.heightConf.value);
    result = CheckLastError("SSM", gkFuncRefGet, result);
  }
  else
  {
    if( C2xIsTokenAvailable(packetHandle, "SSM", newPath) )
    {
      C2xRemoveToken(packetHandle, "SSM", newPath);
    }
  }

  return result;
}

int GetSSMAccSet4WayConfidenceParams(LONG packetHandle, struct SSMAccSet4WayConfidence value, char oldPath[])
{
  char newPath[300];
  int result;

  result = 0;

  snprintf(newPath, elcount(newPath), "%s.%s", oldPath, "lonAccConfidence");
  value.lonAccConfidence = C2xGetTokenInt(packetHandle, "SSM", newPath);
  result = CheckLastError("SSM", gkFuncRefGet, result);

  snprintf(newPath, elcount(newPath), "%s.%s", oldPath, "latAccConfidence");
  value.latAccConfidence = C2xGetTokenInt(packetHandle, "SSM", newPath);
  result = CheckLastError("SSM", gkFuncRefGet, result);

  snprintf(newPath, elcount(newPath), "%s.%s", oldPath, "vertAccConfidence");
  value.vertAccConfidence = C2xGetTokenInt(packetHandle, "SSM", newPath);
  result = CheckLastError("SSM", gkFuncRefGet, result);

  snprintf(newPath, elcount(newPath), "%s.%s", oldPath, "yawRateCon");
  value.yawRateCon = C2xGetTokenInt(packetHandle, "SSM", newPath);
  result = CheckLastError("SSM", gkFuncRefGet, result);

  return result;
}

int SetSSMAccSet4WayConfidenceParams(LONG packetHandle, struct SSMAccSet4WayConfidence value, char oldPath[])
{
  char newPath[300];
  int result;

  result = 0;

  snprintf(newPath, elcount(newPath), "%s.%s", oldPath, "lonAccConfidence");
  C2xSetTokenInt(packetHandle, "SSM", newPath, value.lonAccConfidence);
  result = CheckLastError("SSM", gkFuncRefGet, result);

  snprintf(newPath, elcount(newPath), "%s.%s", oldPath, "latAccConfidence");
  C2xSetTokenInt(packetHandle, "SSM", newPath, value.latAccConfidence);
  result = CheckLastError("SSM", gkFuncRefGet, result);

  snprintf(newPath, elcount(newPath), "%s.%s", oldPath, "vertAccConfidence");
  C2xSetTokenInt(packetHandle, "SSM", newPath, value.vertAccConfidence);
  result = CheckLastError("SSM", gkFuncRefGet, result);

  snprintf(newPath, elcount(newPath), "%s.%s", oldPath, "yawRateCon");
  C2xSetTokenInt(packetHandle, "SSM", newPath, value.yawRateCon);
  result = CheckLastError("SSM", gkFuncRefGet, result);

  return result;
}

int GetSSMDDateTimeParams(LONG packetHandle, struct SSMDDateTime value, char oldPath[])
{
  char newPath[300];
  int result;

  result = 0;

  snprintf(newPath, elcount(newPath), "%s.%s", oldPath, "year");
  value.year.isValidFlag = C2xIsTokenAvailable(packetHandle, "SSM", newPath);
  if(value.year.isValidFlag==1)
  {
    value.year.value = C2xGetTokenInt(packetHandle, "SSM", newPath);
    result = CheckLastError("SSM", gkFuncRefGet, result);
  }
  snprintf(newPath, elcount(newPath), "%s.%s", oldPath, "month");
  value.month.isValidFlag = C2xIsTokenAvailable(packetHandle, "SSM", newPath);
  if(value.month.isValidFlag==1)
  {
    value.month.value = C2xGetTokenInt(packetHandle, "SSM", newPath);
    result = CheckLastError("SSM", gkFuncRefGet, result);
  }
  snprintf(newPath, elcount(newPath), "%s.%s", oldPath, "day");
  value.day.isValidFlag = C2xIsTokenAvailable(packetHandle, "SSM", newPath);
  if(value.day.isValidFlag==1)
  {
    value.day.value = C2xGetTokenInt(packetHandle, "SSM", newPath);
    result = CheckLastError("SSM", gkFuncRefGet, result);
  }
  snprintf(newPath, elcount(newPath), "%s.%s", oldPath, "hour");
  value.hour.isValidFlag = C2xIsTokenAvailable(packetHandle, "SSM", newPath);
  if(value.hour.isValidFlag==1)
  {
    value.hour.value = C2xGetTokenInt(packetHandle, "SSM", newPath);
    result = CheckLastError("SSM", gkFuncRefGet, result);
  }
  snprintf(newPath, elcount(newPath), "%s.%s", oldPath, "minute");
  value.minute.isValidFlag = C2xIsTokenAvailable(packetHandle, "SSM", newPath);
  if(value.minute.isValidFlag==1)
  {
    value.minute.value = C2xGetTokenInt(packetHandle, "SSM", newPath);
    result = CheckLastError("SSM", gkFuncRefGet, result);
  }
  snprintf(newPath, elcount(newPath), "%s.%s", oldPath, "second");
  value.second.isValidFlag = C2xIsTokenAvailable(packetHandle, "SSM", newPath);
  if(value.second.isValidFlag==1)
  {
    value.second.value = C2xGetTokenInt(packetHandle, "SSM", newPath);
    result = CheckLastError("SSM", gkFuncRefGet, result);
  }
  snprintf(newPath, elcount(newPath), "%s.%s", oldPath, "offset");
  value.offset.isValidFlag = C2xIsTokenAvailable(packetHandle, "SSM", newPath);
  if(value.offset.isValidFlag==1)
  {
    value.offset.value = C2xGetTokenInt(packetHandle, "SSM", newPath);
    result = CheckLastError("SSM", gkFuncRefGet, result);
  }
  return result;
}

int SetSSMDDateTimeParams(LONG packetHandle, struct SSMDDateTime value, char oldPath[])
{
  char newPath[300];
  int result;

  result = 0;

  snprintf(newPath, elcount(newPath), "%s.%s", oldPath, "year");
  if(value.year.isValidFlag==1)
  {
    C2xSetTokenInt(packetHandle, "SSM", newPath, value.year.value);
    result = CheckLastError("SSM", gkFuncRefGet, result);
  }
  else
  {
    if( C2xIsTokenAvailable(packetHandle, "SSM", newPath) )
    {
      C2xRemoveToken(packetHandle, "SSM", newPath);
    }
  }

  snprintf(newPath, elcount(newPath), "%s.%s", oldPath, "month");
  if(value.month.isValidFlag==1)
  {
    C2xSetTokenInt(packetHandle, "SSM", newPath, value.month.value);
    result = CheckLastError("SSM", gkFuncRefGet, result);
  }
  else
  {
    if( C2xIsTokenAvailable(packetHandle, "SSM", newPath) )
    {
      C2xRemoveToken(packetHandle, "SSM", newPath);
    }
  }

  snprintf(newPath, elcount(newPath), "%s.%s", oldPath, "day");
  if(value.day.isValidFlag==1)
  {
    C2xSetTokenInt(packetHandle, "SSM", newPath, value.day.value);
    result = CheckLastError("SSM", gkFuncRefGet, result);
  }
  else
  {
    if( C2xIsTokenAvailable(packetHandle, "SSM", newPath) )
    {
      C2xRemoveToken(packetHandle, "SSM", newPath);
    }
  }

  snprintf(newPath, elcount(newPath), "%s.%s", oldPath, "hour");
  if(value.hour.isValidFlag==1)
  {
    C2xSetTokenInt(packetHandle, "SSM", newPath, value.hour.value);
    result = CheckLastError("SSM", gkFuncRefGet, result);
  }
  else
  {
    if( C2xIsTokenAvailable(packetHandle, "SSM", newPath) )
    {
      C2xRemoveToken(packetHandle, "SSM", newPath);
    }
  }

  snprintf(newPath, elcount(newPath), "%s.%s", oldPath, "minute");
  if(value.minute.isValidFlag==1)
  {
    C2xSetTokenInt(packetHandle, "SSM", newPath, value.minute.value);
    result = CheckLastError("SSM", gkFuncRefGet, result);
  }
  else
  {
    if( C2xIsTokenAvailable(packetHandle, "SSM", newPath) )
    {
      C2xRemoveToken(packetHandle, "SSM", newPath);
    }
  }

  snprintf(newPath, elcount(newPath), "%s.%s", oldPath, "second");
  if(value.second.isValidFlag==1)
  {
    C2xSetTokenInt(packetHandle, "SSM", newPath, value.second.value);
    result = CheckLastError("SSM", gkFuncRefGet, result);
  }
  else
  {
    if( C2xIsTokenAvailable(packetHandle, "SSM", newPath) )
    {
      C2xRemoveToken(packetHandle, "SSM", newPath);
    }
  }

  snprintf(newPath, elcount(newPath), "%s.%s", oldPath, "offset");
  if(value.offset.isValidFlag==1)
  {
    C2xSetTokenInt(packetHandle, "SSM", newPath, value.offset.value);
    result = CheckLastError("SSM", gkFuncRefGet, result);
  }
  else
  {
    if( C2xIsTokenAvailable(packetHandle, "SSM", newPath) )
    {
      C2xRemoveToken(packetHandle, "SSM", newPath);
    }
  }

  return result;
}

int GetSSMPositionalAccuracyParams(LONG packetHandle, struct SSMPositionalAccuracy value, char oldPath[])
{
  char newPath[300];
  int result;

  result = 0;

  snprintf(newPath, elcount(newPath), "%s.%s", oldPath, "semiMajor");
  value.semiMajor = C2xGetTokenInt(packetHandle, "SSM", newPath);
  result = CheckLastError("SSM", gkFuncRefGet, result);

  snprintf(newPath, elcount(newPath), "%s.%s", oldPath, "semiMinor");
  value.semiMinor = C2xGetTokenInt(packetHandle, "SSM", newPath);
  result = CheckLastError("SSM", gkFuncRefGet, result);

  snprintf(newPath, elcount(newPath), "%s.%s", oldPath, "orientation");
  value.orientation = C2xGetTokenInt(packetHandle, "SSM", newPath);
  result = CheckLastError("SSM", gkFuncRefGet, result);

  return result;
}

int SetSSMPositionalAccuracyParams(LONG packetHandle, struct SSMPositionalAccuracy value, char oldPath[])
{
  char newPath[300];
  int result;

  result = 0;

  snprintf(newPath, elcount(newPath), "%s.%s", oldPath, "semiMajor");
  C2xSetTokenInt(packetHandle, "SSM", newPath, value.semiMajor);
  result = CheckLastError("SSM", gkFuncRefGet, result);

  snprintf(newPath, elcount(newPath), "%s.%s", oldPath, "semiMinor");
  C2xSetTokenInt(packetHandle, "SSM", newPath, value.semiMinor);
  result = CheckLastError("SSM", gkFuncRefGet, result);

  snprintf(newPath, elcount(newPath), "%s.%s", oldPath, "orientation");
  C2xSetTokenInt(packetHandle, "SSM", newPath, value.orientation);
  result = CheckLastError("SSM", gkFuncRefGet, result);

  return result;
}

int GetSSMFullPositionVectorParams(LONG packetHandle, struct SSMFullPositionVector value, char oldPath[])
{
  char newPath[300];
  int result;

  result = 0;

  snprintf(newPath, elcount(newPath), "%s.%s", oldPath, "utcTime");
  value.utcTime.isValidFlag = C2xIsTokenAvailable(packetHandle, "SSM", newPath);
  if(value.utcTime.isValidFlag==1)
  {
    GetSSMDDateTimeParams(packetHandle, value.utcTime, newPath);
    result = CheckLastError("SSM", gkFuncRefGet, result);
  }
  snprintf(newPath, elcount(newPath), "%s.%s", oldPath, "pos");
  GetSSMPosition3DParams(packetHandle, value.pos, newPath);
  result = CheckLastError("SSM", gkFuncRefGet, result);

  snprintf(newPath, elcount(newPath), "%s.%s", oldPath, "heading");
  value.heading.isValidFlag = C2xIsTokenAvailable(packetHandle, "SSM", newPath);
  if(value.heading.isValidFlag==1)
  {
    value.heading.value = C2xGetTokenInt(packetHandle, "SSM", newPath);
    result = CheckLastError("SSM", gkFuncRefGet, result);
  }
  snprintf(newPath, elcount(newPath), "%s.%s", oldPath, "transmission");
  value.transmission.isValidFlag = C2xIsTokenAvailable(packetHandle, "SSM", newPath);
  if(value.transmission.isValidFlag==1)
  {
    value.transmission.value = C2xGetTokenInt(packetHandle, "SSM", newPath);
    result = CheckLastError("SSM", gkFuncRefGet, result);
  }
  snprintf(newPath, elcount(newPath), "%s.%s", oldPath, "speed");
  value.speed.isValidFlag = C2xIsTokenAvailable(packetHandle, "SSM", newPath);
  if(value.speed.isValidFlag==1)
  {
    value.speed.value = C2xGetTokenInt(packetHandle, "SSM", newPath);
    result = CheckLastError("SSM", gkFuncRefGet, result);
  }
  snprintf(newPath, elcount(newPath), "%s.%s", oldPath, "posAccuracy");
  value.posAccuracy.isValidFlag = C2xIsTokenAvailable(packetHandle, "SSM", newPath);
  if(value.posAccuracy.isValidFlag==1)
  {
    GetSSMPositionalAccuracyParams(packetHandle, value.posAccuracy, newPath);
    result = CheckLastError("SSM", gkFuncRefGet, result);
  }
  snprintf(newPath, elcount(newPath), "%s.%s", oldPath, "posConficence");
  value.posConficence.isValidFlag = C2xIsTokenAvailable(packetHandle, "SSM", newPath);
  if(value.posConficence.isValidFlag==1)
  {
    GetSSMPositionConfidenceSetParams(packetHandle, value.posConficence, newPath);
    result = CheckLastError("SSM", gkFuncRefGet, result);
  }
  snprintf(newPath, elcount(newPath), "%s.%s", oldPath, "timeConfidence");
  value.timeConfidence.isValidFlag = C2xIsTokenAvailable(packetHandle, "SSM", newPath);
  if(value.timeConfidence.isValidFlag==1)
  {
    value.timeConfidence.value = C2xGetTokenInt(packetHandle, "SSM", newPath);
    result = CheckLastError("SSM", gkFuncRefGet, result);
  }
  snprintf(newPath, elcount(newPath), "%s.%s", oldPath, "motionCfd");
  value.motionCfd.isValidFlag = C2xIsTokenAvailable(packetHandle, "SSM", newPath);
  if(value.motionCfd.isValidFlag==1)
  {
    GetSSMMotionConfidenceSetParams(packetHandle, value.motionCfd, newPath);
    result = CheckLastError("SSM", gkFuncRefGet, result);
  }
  return result;
}

int SetSSMFullPositionVectorParams(LONG packetHandle, struct SSMFullPositionVector value, char oldPath[])
{
  char newPath[300];
  int result;

  result = 0;

  snprintf(newPath, elcount(newPath), "%s.%s", oldPath, "utcTime");
  if(value.utcTime.isValidFlag==1)
  {
    SetSSMDDateTimeParams(packetHandle, value.utcTime, newPath);
    result = CheckLastError("SSM", gkFuncRefGet, result);
  }
  else
  {
    if( C2xIsTokenAvailable(packetHandle, "SSM", newPath) )
    {
      C2xRemoveToken(packetHandle, "SSM", newPath);
    }
  }

  snprintf(newPath, elcount(newPath), "%s.%s", oldPath, "pos");
  SetSSMPosition3DParams(packetHandle, value.pos, newPath);
  result = CheckLastError("SSM", gkFuncRefGet, result);

  snprintf(newPath, elcount(newPath), "%s.%s", oldPath, "heading");
  if(value.heading.isValidFlag==1)
  {
    C2xSetTokenInt(packetHandle, "SSM", newPath, value.heading.value);
    result = CheckLastError("SSM", gkFuncRefGet, result);
  }
  else
  {
    if( C2xIsTokenAvailable(packetHandle, "SSM", newPath) )
    {
      C2xRemoveToken(packetHandle, "SSM", newPath);
    }
  }

  snprintf(newPath, elcount(newPath), "%s.%s", oldPath, "transmission");
  if(value.transmission.isValidFlag==1)
  {
    C2xSetTokenInt(packetHandle, "SSM", newPath, value.transmission.value);
    result = CheckLastError("SSM", gkFuncRefGet, result);
  }
  else
  {
    if( C2xIsTokenAvailable(packetHandle, "SSM", newPath) )
    {
      C2xRemoveToken(packetHandle, "SSM", newPath);
    }
  }

  snprintf(newPath, elcount(newPath), "%s.%s", oldPath, "speed");
  if(value.speed.isValidFlag==1)
  {
    C2xSetTokenInt(packetHandle, "SSM", newPath, value.speed.value);
    result = CheckLastError("SSM", gkFuncRefGet, result);
  }
  else
  {
    if( C2xIsTokenAvailable(packetHandle, "SSM", newPath) )
    {
      C2xRemoveToken(packetHandle, "SSM", newPath);
    }
  }

  snprintf(newPath, elcount(newPath), "%s.%s", oldPath, "posAccuracy");
  if(value.posAccuracy.isValidFlag==1)
  {
    SetSSMPositionalAccuracyParams(packetHandle, value.posAccuracy, newPath);
    result = CheckLastError("SSM", gkFuncRefGet, result);
  }
  else
  {
    if( C2xIsTokenAvailable(packetHandle, "SSM", newPath) )
    {
      C2xRemoveToken(packetHandle, "SSM", newPath);
    }
  }

  snprintf(newPath, elcount(newPath), "%s.%s", oldPath, "posConficence");
  if(value.posConficence.isValidFlag==1)
  {
    SetSSMPositionConfidenceSetParams(packetHandle, value.posConficence, newPath);
    result = CheckLastError("SSM", gkFuncRefGet, result);
  }
  else
  {
    if( C2xIsTokenAvailable(packetHandle, "SSM", newPath) )
    {
      C2xRemoveToken(packetHandle, "SSM", newPath);
    }
  }

  snprintf(newPath, elcount(newPath), "%s.%s", oldPath, "timeConfidence");
  if(value.timeConfidence.isValidFlag==1)
  {
    C2xSetTokenInt(packetHandle, "SSM", newPath, value.timeConfidence.value);
    result = CheckLastError("SSM", gkFuncRefGet, result);
  }
  else
  {
    if( C2xIsTokenAvailable(packetHandle, "SSM", newPath) )
    {
      C2xRemoveToken(packetHandle, "SSM", newPath);
    }
  }

  snprintf(newPath, elcount(newPath), "%s.%s", oldPath, "motionCfd");
  if(value.motionCfd.isValidFlag==1)
  {
    SetSSMMotionConfidenceSetParams(packetHandle, value.motionCfd, newPath);
    result = CheckLastError("SSM", gkFuncRefGet, result);
  }
  else
  {
    if( C2xIsTokenAvailable(packetHandle, "SSM", newPath) )
    {
      C2xRemoveToken(packetHandle, "SSM", newPath);
    }
  }

  return result;
}

int GetSSMPathHistoryPointParams(LONG packetHandle, struct SSMPathHistoryPoint value, char oldPath[])
{
  char newPath[300];
  int result;

  result = 0;

  snprintf(newPath, elcount(newPath), "%s.%s", oldPath, "llvOffset");
  GetSSMPositionOffsetLLVParams(packetHandle, value.llvOffset, newPath);
  result = CheckLastError("SSM", gkFuncRefGet, result);

  snprintf(newPath, elcount(newPath), "%s.%s", oldPath, "timeOffset");
  value.timeOffset = C2xGetTokenInt(packetHandle, "SSM", newPath);
  result = CheckLastError("SSM", gkFuncRefGet, result);

  snprintf(newPath, elcount(newPath), "%s.%s", oldPath, "speed");
  value.speed.isValidFlag = C2xIsTokenAvailable(packetHandle, "SSM", newPath);
  if(value.speed.isValidFlag==1)
  {
    value.speed.value = C2xGetTokenInt(packetHandle, "SSM", newPath);
    result = CheckLastError("SSM", gkFuncRefGet, result);
  }
  snprintf(newPath, elcount(newPath), "%s.%s", oldPath, "posAccuracy");
  value.posAccuracy.isValidFlag = C2xIsTokenAvailable(packetHandle, "SSM", newPath);
  if(value.posAccuracy.isValidFlag==1)
  {
    GetSSMPositionConfidenceSetParams(packetHandle, value.posAccuracy, newPath);
    result = CheckLastError("SSM", gkFuncRefGet, result);
  }
  snprintf(newPath, elcount(newPath), "%s.%s", oldPath, "heading");
  value.heading.isValidFlag = C2xIsTokenAvailable(packetHandle, "SSM", newPath);
  if(value.heading.isValidFlag==1)
  {
    value.heading.value = C2xGetTokenInt(packetHandle, "SSM", newPath);
    result = CheckLastError("SSM", gkFuncRefGet, result);
  }
  return result;
}

int SetSSMPathHistoryPointParams(LONG packetHandle, struct SSMPathHistoryPoint value, char oldPath[])
{
  char newPath[300];
  int result;

  result = 0;

  snprintf(newPath, elcount(newPath), "%s.%s", oldPath, "llvOffset");
  SetSSMPositionOffsetLLVParams(packetHandle, value.llvOffset, newPath);
  result = CheckLastError("SSM", gkFuncRefGet, result);

  snprintf(newPath, elcount(newPath), "%s.%s", oldPath, "timeOffset");
  if (value.timeOffset < 1)
  {
    C2xSetTokenInt(packetHandle, "SSM", newPath, 1);
  }
  else if (value.timeOffset > 65535)
  {
    C2xSetTokenInt(packetHandle, "SSM", newPath, 65535);
  }
  else
  {
    C2xSetTokenInt(packetHandle, "SSM", newPath, value.timeOffset);
  }
  result = CheckLastError("SSM", gkFuncRefGet, result);

  snprintf(newPath, elcount(newPath), "%s.%s", oldPath, "speed");
  if(value.speed.isValidFlag==1)
  {
    C2xSetTokenInt(packetHandle, "SSM", newPath, value.speed.value);
    result = CheckLastError("SSM", gkFuncRefGet, result);
  }
  else
  {
    if( C2xIsTokenAvailable(packetHandle, "SSM", newPath) )
    {
      C2xRemoveToken(packetHandle, "SSM", newPath);
    }
  }

  snprintf(newPath, elcount(newPath), "%s.%s", oldPath, "posAccuracy");
  if(value.posAccuracy.isValidFlag==1)
  {
    SetSSMPositionConfidenceSetParams(packetHandle, value.posAccuracy, newPath);
    result = CheckLastError("SSM", gkFuncRefGet, result);
  }
  else
  {
    if( C2xIsTokenAvailable(packetHandle, "SSM", newPath) )
    {
      C2xRemoveToken(packetHandle, "SSM", newPath);
    }
  }

  snprintf(newPath, elcount(newPath), "%s.%s", oldPath, "heading");
  if(value.heading.isValidFlag==1)
  {
    C2xSetTokenInt(packetHandle, "SSM", newPath, value.heading.value);
    result = CheckLastError("SSM", gkFuncRefGet, result);
  }
  else
  {
    if( C2xIsTokenAvailable(packetHandle, "SSM", newPath) )
    {
      C2xRemoveToken(packetHandle, "SSM", newPath);
    }
  }

  return result;
}

int GetSSMPathHistoryPointListParams(LONG packetHandle, struct SSMPathHistoryPointList value, char oldPath[])
{
  char newPath[300]; 
  int i;
  int result;

  result = 0;

  value.length = C2xGetTokenInt(packetHandle, "SSM", oldPath);
  if((result = CheckLastError("SSM", gkFuncRefGet, result))==0)
  {
    for(i=0; i<value.length; i++)
    {
      snprintf(newPath, elcount(newPath), "%s[%d]", oldPath, i);
      GetSSMPathHistoryPointParams(packetHandle, value.arrayValue[i], newPath);
      result = CheckLastError("SSM", gkFuncRefGet, result);
    }
  }
  return result;
}

int SetSSMPathHistoryPointListParams(LONG packetHandle, struct SSMPathHistoryPointList value, char oldPath[])
{
  char newPath[300]; 
  int i;
  int result;

  result = 0;

  C2xRemoveToken(packetHandle, "SSM", oldPath);
  for(i=0; i<value.length; i++)
  {
    snprintf(newPath, elcount(newPath), "%s[%d]", oldPath, i);
    SetSSMPathHistoryPointParams(packetHandle, value.arrayValue[i], newPath);
    result = CheckLastError("SSM", gkFuncRefGet, result);
  }
  return result;
}

int GetSSMPathHistoryParams(LONG packetHandle, struct SSMPathHistory value, char oldPath[])
{
  char newPath[300]; 
  int j; 
  int k;
  int result;

  result = 0;

  snprintf(newPath, elcount(newPath), "%s.%s", oldPath, "initialPosition");
  value.initialPosition.isValidFlag = C2xIsTokenAvailable(packetHandle, "SSM", newPath);
  if(value.initialPosition.isValidFlag==1)
  {
    GetSSMFullPositionVectorParams(packetHandle, value.initialPosition, newPath);
    result = CheckLastError("SSM", gkFuncRefGet, result);
  }
  snprintf(newPath, elcount(newPath), "%s.%s", oldPath, "currGNSSstatus");
  value.currGNSSstatus.isValidFlag = C2xIsTokenAvailable(packetHandle, "SSM", newPath);
  if(value.currGNSSstatus.isValidFlag==1)
  {
    value.currGNSSstatus.isValidFlag = 1;
    value.currGNSSstatus.stringLength = C2xGetTokenLengthBit(packetHandle, "SSM", newPath);
    if ((result = CheckLastError("SSM", gkFuncRefGet, result))==0)
    {
      if(value.currGNSSstatus.stringLength > 0)
      {
        for(j=0; j<value.currGNSSstatus.stringLength; j++)
        {
          if(C2xGetTokenBitOfBitString(packetHandle, "SSM", newPath, j) == 0)
          {
            value.currGNSSstatus.string[j] = '0';
          }
          else if(C2xGetTokenBitOfBitString(packetHandle, "SSM", newPath, j) == 1)
          {
            value.currGNSSstatus.string[j] = '1';
          }

          if(value.currGNSSstatus.stringLength == 1)
          {
            value.currGNSSstatus.string[1] = '0';
          }
          result = CheckLastError("SSM", gkFuncRefGet, result);
        }
      }
      else
      {
        for(k = value.currGNSSstatus.stringLength+1; k > -1; k--)
        {
          if(value.currGNSSstatus.string[k] == '1')
          {
            value.currGNSSstatus.string[k] = '0';
          }
        }
      }
    }

  }
  snprintf(newPath, elcount(newPath), "%s.%s", oldPath, "crumbData");
  GetSSMPathHistoryPointListParams(packetHandle, value.crumbData, newPath);
  result = CheckLastError("SSM", gkFuncRefGet, result);

  return result;
}

int SetSSMPathHistoryParams(LONG packetHandle, struct SSMPathHistory value, char oldPath[])
{
  char newPath[300]; 
  int j;
  int result;

  result = 0;

  snprintf(newPath, elcount(newPath), "%s.%s", oldPath, "initialPosition");
  if(value.initialPosition.isValidFlag==1)
  {
    SetSSMFullPositionVectorParams(packetHandle, value.initialPosition, newPath);
    result = CheckLastError("SSM", gkFuncRefGet, result);
  }
  else
  {
    if( C2xIsTokenAvailable(packetHandle, "SSM", newPath) )
    {
      C2xRemoveToken(packetHandle, "SSM", newPath);
    }
  }

  snprintf(newPath, elcount(newPath), "%s.%s", oldPath, "currGNSSstatus");
  if(value.currGNSSstatus.isValidFlag==1)
  {
      for(j=0; j<value.currGNSSstatus.stringLength; j++)
      {
        if(value.currGNSSstatus.string[j] == '0')
        {
          C2xSetTokenBitOfBitString(packetHandle, "SSM", newPath, j, 0);
        }
        else
        {
          C2xSetTokenBitOfBitString(packetHandle, "SSM", newPath, j, 1);
        }
        result = CheckLastError("SSM", gkFuncRefGet, result);
      }
  }
  else
  {
    if( C2xIsTokenAvailable(packetHandle, "SSM", newPath) )
    {
      C2xRemoveToken(packetHandle, "SSM", newPath);
    }
  }

  snprintf(newPath, elcount(newPath), "%s.%s", oldPath, "crumbData");
  SetSSMPathHistoryPointListParams(packetHandle, value.crumbData, newPath);
  result = CheckLastError("SSM", gkFuncRefGet, result);

  return result;
}

int GetSSMNodeReferenceIDParams(LONG packetHandle, struct SSMNodeReferenceID value, char oldPath[])
{
  char newPath[300];
  int result;

  result = 0;

  snprintf(newPath, elcount(newPath), "%s.%s", oldPath, "region");
  value.region.isValidFlag = C2xIsTokenAvailable(packetHandle, "SSM", newPath);
  if(value.region.isValidFlag==1)
  {
    value.region.value = C2xGetTokenInt(packetHandle, "SSM", newPath);
    result = CheckLastError("SSM", gkFuncRefGet, result);
  }
  snprintf(newPath, elcount(newPath), "%s.%s", oldPath, "id");
  value.id = C2xGetTokenInt(packetHandle, "SSM", newPath);
  result = CheckLastError("SSM", gkFuncRefGet, result);

  return result;
}

int SetSSMNodeReferenceIDParams(LONG packetHandle, struct SSMNodeReferenceID value, char oldPath[])
{
  char newPath[300];
  int result;

  result = 0;

  snprintf(newPath, elcount(newPath), "%s.%s", oldPath, "region");
  if(value.region.isValidFlag==1)
  {
    C2xSetTokenInt(packetHandle, "SSM", newPath, value.region.value);
    result = CheckLastError("SSM", gkFuncRefGet, result);
  }
  else
  {
    if( C2xIsTokenAvailable(packetHandle, "SSM", newPath) )
    {
      C2xRemoveToken(packetHandle, "SSM", newPath);
    }
  }

  snprintf(newPath, elcount(newPath), "%s.%s", oldPath, "id");
  C2xSetTokenInt(packetHandle, "SSM", newPath, value.id);
  result = CheckLastError("SSM", gkFuncRefGet, result);

  return result;
}

int GetSSMReferenceLinkParams(LONG packetHandle, struct SSMReferenceLink value, char oldPath[])
{
  char newPath[300]; 
  int j; 
  int k;
  int result;

  result = 0;

  snprintf(newPath, elcount(newPath), "%s.%s", oldPath, "upstreamNodeId");
  GetSSMNodeReferenceIDParams(packetHandle, value.upstreamNodeId, newPath);
  result = CheckLastError("SSM", gkFuncRefGet, result);

  snprintf(newPath, elcount(newPath), "%s.%s", oldPath, "downstreamNodeId");
  GetSSMNodeReferenceIDParams(packetHandle, value.downstreamNodeId, newPath);
  result = CheckLastError("SSM", gkFuncRefGet, result);

  snprintf(newPath, elcount(newPath), "%s.%s", oldPath, "referenceLanes");
  value.referenceLanes.isValidFlag = C2xIsTokenAvailable(packetHandle, "SSM", newPath);
  if(value.referenceLanes.isValidFlag==1)
  {
    value.referenceLanes.isValidFlag = 1;
    value.referenceLanes.stringLength = C2xGetTokenLengthBit(packetHandle, "SSM", newPath);
    if ((result = CheckLastError("SSM", gkFuncRefGet, result))==0)
    {
      if(value.referenceLanes.stringLength > 0)
      {
        for(j=0; j<value.referenceLanes.stringLength; j++)
        {
          if(C2xGetTokenBitOfBitString(packetHandle, "SSM", newPath, j) == 0)
          {
            value.referenceLanes.string[j] = '0';
          }
          else if(C2xGetTokenBitOfBitString(packetHandle, "SSM", newPath, j) == 1)
          {
            value.referenceLanes.string[j] = '1';
          }

          if(value.referenceLanes.stringLength == 1)
          {
            value.referenceLanes.string[1] = '0';
          }
          result = CheckLastError("SSM", gkFuncRefGet, result);
        }
      }
      else
      {
        for(k = value.referenceLanes.stringLength+1; k > -1; k--)
        {
          if(value.referenceLanes.string[k] == '1')
          {
            value.referenceLanes.string[k] = '0';
          }
        }
      }
    }

  }
  return result;
}

int SetSSMReferenceLinkParams(LONG packetHandle, struct SSMReferenceLink value, char oldPath[])
{
  char newPath[300]; 
  int j;
  int result;

  result = 0;

  snprintf(newPath, elcount(newPath), "%s.%s", oldPath, "upstreamNodeId");
  SetSSMNodeReferenceIDParams(packetHandle, value.upstreamNodeId, newPath);
  result = CheckLastError("SSM", gkFuncRefGet, result);

  snprintf(newPath, elcount(newPath), "%s.%s", oldPath, "downstreamNodeId");
  SetSSMNodeReferenceIDParams(packetHandle, value.downstreamNodeId, newPath);
  result = CheckLastError("SSM", gkFuncRefGet, result);

  snprintf(newPath, elcount(newPath), "%s.%s", oldPath, "referenceLanes");
  if(value.referenceLanes.isValidFlag==1)
  {
      for(j=0; j<value.referenceLanes.stringLength; j++)
      {
        if(value.referenceLanes.string[j] == '0')
        {
          C2xSetTokenBitOfBitString(packetHandle, "SSM", newPath, j, 0);
        }
        else
        {
          C2xSetTokenBitOfBitString(packetHandle, "SSM", newPath, j, 1);
        }
        result = CheckLastError("SSM", gkFuncRefGet, result);
      }
  }
  else
  {
    if( C2xIsTokenAvailable(packetHandle, "SSM", newPath) )
    {
      C2xRemoveToken(packetHandle, "SSM", newPath);
    }
  }

  return result;
}

int GetSSMPathPlanningPointParams(LONG packetHandle, struct SSMPathPlanningPoint value, char oldPath[])
{
  char newPath[300];
  int result;

  result = 0;

  snprintf(newPath, elcount(newPath), "%s.%s", oldPath, "posInMap");
  value.posInMap.isValidFlag = C2xIsTokenAvailable(packetHandle, "SSM", newPath);
  if(value.posInMap.isValidFlag==1)
  {
    GetSSMReferenceLinkParams(packetHandle, value.posInMap, newPath);
    result = CheckLastError("SSM", gkFuncRefGet, result);
  }
  snprintf(newPath, elcount(newPath), "%s.%s", oldPath, "pos");
  GetSSMPositionOffsetLLVParams(packetHandle, value.pos, newPath);
  result = CheckLastError("SSM", gkFuncRefGet, result);

  snprintf(newPath, elcount(newPath), "%s.%s", oldPath, "posAccuracy");
  value.posAccuracy.isValidFlag = C2xIsTokenAvailable(packetHandle, "SSM", newPath);
  if(value.posAccuracy.isValidFlag==1)
  {
    GetSSMPositionConfidenceSetParams(packetHandle, value.posAccuracy, newPath);
    result = CheckLastError("SSM", gkFuncRefGet, result);
  }
  snprintf(newPath, elcount(newPath), "%s.%s", oldPath, "speed");
  value.speed.isValidFlag = C2xIsTokenAvailable(packetHandle, "SSM", newPath);
  if(value.speed.isValidFlag==1)
  {
    value.speed.value = C2xGetTokenInt(packetHandle, "SSM", newPath);
    result = CheckLastError("SSM", gkFuncRefGet, result);
  }
  snprintf(newPath, elcount(newPath), "%s.%s", oldPath, "speedCfd");
  value.speedCfd.isValidFlag = C2xIsTokenAvailable(packetHandle, "SSM", newPath);
  if(value.speedCfd.isValidFlag==1)
  {
    value.speedCfd.value = C2xGetTokenInt(packetHandle, "SSM", newPath);
    result = CheckLastError("SSM", gkFuncRefGet, result);
  }
  snprintf(newPath, elcount(newPath), "%s.%s", oldPath, "heading");
  value.heading.isValidFlag = C2xIsTokenAvailable(packetHandle, "SSM", newPath);
  if(value.heading.isValidFlag==1)
  {
    value.heading.value = C2xGetTokenInt(packetHandle, "SSM", newPath);
    result = CheckLastError("SSM", gkFuncRefGet, result);
  }
  snprintf(newPath, elcount(newPath), "%s.%s", oldPath, "headingCfd");
  value.headingCfd.isValidFlag = C2xIsTokenAvailable(packetHandle, "SSM", newPath);
  if(value.headingCfd.isValidFlag==1)
  {
    value.headingCfd.value = C2xGetTokenInt(packetHandle, "SSM", newPath);
    result = CheckLastError("SSM", gkFuncRefGet, result);
  }
  snprintf(newPath, elcount(newPath), "%s.%s", oldPath, "accelSet");
  value.accelSet.isValidFlag = C2xIsTokenAvailable(packetHandle, "SSM", newPath);
  if(value.accelSet.isValidFlag==1)
  {
    GetSSMAccelerationSet4WayParams(packetHandle, value.accelSet, newPath);
    result = CheckLastError("SSM", gkFuncRefGet, result);
  }
  snprintf(newPath, elcount(newPath), "%s.%s", oldPath, "acc4WayConfidence");
  value.acc4WayConfidence.isValidFlag = C2xIsTokenAvailable(packetHandle, "SSM", newPath);
  if(value.acc4WayConfidence.isValidFlag==1)
  {
    GetSSMAccSet4WayConfidenceParams(packetHandle, value.acc4WayConfidence, newPath);
    result = CheckLastError("SSM", gkFuncRefGet, result);
  }
  snprintf(newPath, elcount(newPath), "%s.%s", oldPath, "estimatedTime");
  value.estimatedTime.isValidFlag = C2xIsTokenAvailable(packetHandle, "SSM", newPath);
  if(value.estimatedTime.isValidFlag==1)
  {
    value.estimatedTime.value = C2xGetTokenInt(packetHandle, "SSM", newPath);
    result = CheckLastError("SSM", gkFuncRefGet, result);
  }
  snprintf(newPath, elcount(newPath), "%s.%s", oldPath, "timeConfidence");
  value.timeConfidence.isValidFlag = C2xIsTokenAvailable(packetHandle, "SSM", newPath);
  if(value.timeConfidence.isValidFlag==1)
  {
    value.timeConfidence.value = C2xGetTokenInt(packetHandle, "SSM", newPath);
    result = CheckLastError("SSM", gkFuncRefGet, result);
  }
  return result;
}

int SetSSMPathPlanningPointParams(LONG packetHandle, struct SSMPathPlanningPoint value, char oldPath[])
{
  char newPath[300];
  int result;

  result = 0;

  snprintf(newPath, elcount(newPath), "%s.%s", oldPath, "posInMap");
  if(value.posInMap.isValidFlag==1)
  {
    SetSSMReferenceLinkParams(packetHandle, value.posInMap, newPath);
    result = CheckLastError("SSM", gkFuncRefGet, result);
  }
  else
  {
    if( C2xIsTokenAvailable(packetHandle, "SSM", newPath) )
    {
      C2xRemoveToken(packetHandle, "SSM", newPath);
    }
  }

  snprintf(newPath, elcount(newPath), "%s.%s", oldPath, "pos");
  SetSSMPositionOffsetLLVParams(packetHandle, value.pos, newPath);
  result = CheckLastError("SSM", gkFuncRefGet, result);

  snprintf(newPath, elcount(newPath), "%s.%s", oldPath, "posAccuracy");
  if(value.posAccuracy.isValidFlag==1)
  {
    SetSSMPositionConfidenceSetParams(packetHandle, value.posAccuracy, newPath);
    result = CheckLastError("SSM", gkFuncRefGet, result);
  }
  else
  {
    if( C2xIsTokenAvailable(packetHandle, "SSM", newPath) )
    {
      C2xRemoveToken(packetHandle, "SSM", newPath);
    }
  }

  snprintf(newPath, elcount(newPath), "%s.%s", oldPath, "speed");
  if(value.speed.isValidFlag==1)
  {
    C2xSetTokenInt(packetHandle, "SSM", newPath, value.speed.value);
    result = CheckLastError("SSM", gkFuncRefGet, result);
  }
  else
  {
    if( C2xIsTokenAvailable(packetHandle, "SSM", newPath) )
    {
      C2xRemoveToken(packetHandle, "SSM", newPath);
    }
  }

  snprintf(newPath, elcount(newPath), "%s.%s", oldPath, "speedCfd");
  if(value.speedCfd.isValidFlag==1)
  {
    C2xSetTokenInt(packetHandle, "SSM", newPath, value.speedCfd.value);
    result = CheckLastError("SSM", gkFuncRefGet, result);
  }
  else
  {
    if( C2xIsTokenAvailable(packetHandle, "SSM", newPath) )
    {
      C2xRemoveToken(packetHandle, "SSM", newPath);
    }
  }

  snprintf(newPath, elcount(newPath), "%s.%s", oldPath, "heading");
  if(value.heading.isValidFlag==1)
  {
    C2xSetTokenInt(packetHandle, "SSM", newPath, value.heading.value);
    result = CheckLastError("SSM", gkFuncRefGet, result);
  }
  else
  {
    if( C2xIsTokenAvailable(packetHandle, "SSM", newPath) )
    {
      C2xRemoveToken(packetHandle, "SSM", newPath);
    }
  }

  snprintf(newPath, elcount(newPath), "%s.%s", oldPath, "headingCfd");
  if(value.headingCfd.isValidFlag==1)
  {
    C2xSetTokenInt(packetHandle, "SSM", newPath, value.headingCfd.value);
    result = CheckLastError("SSM", gkFuncRefGet, result);
  }
  else
  {
    if( C2xIsTokenAvailable(packetHandle, "SSM", newPath) )
    {
      C2xRemoveToken(packetHandle, "SSM", newPath);
    }
  }

  snprintf(newPath, elcount(newPath), "%s.%s", oldPath, "accelSet");
  if(value.accelSet.isValidFlag==1)
  {
    SetSSMAccelerationSet4WayParams(packetHandle, value.accelSet, newPath);
    result = CheckLastError("SSM", gkFuncRefGet, result);
  }
  else
  {
    if( C2xIsTokenAvailable(packetHandle, "SSM", newPath) )
    {
      C2xRemoveToken(packetHandle, "SSM", newPath);
    }
  }

  snprintf(newPath, elcount(newPath), "%s.%s", oldPath, "acc4WayConfidence");
  if(value.acc4WayConfidence.isValidFlag==1)
  {
    SetSSMAccSet4WayConfidenceParams(packetHandle, value.acc4WayConfidence, newPath);
    result = CheckLastError("SSM", gkFuncRefGet, result);
  }
  else
  {
    if( C2xIsTokenAvailable(packetHandle, "SSM", newPath) )
    {
      C2xRemoveToken(packetHandle, "SSM", newPath);
    }
  }

  snprintf(newPath, elcount(newPath), "%s.%s", oldPath, "estimatedTime");
  if(value.estimatedTime.isValidFlag==1)
  {
    if (value.estimatedTime.value < 1)
    {
        C2xSetTokenInt(packetHandle, "SSM", newPath, 1);
    }
    else if (value.estimatedTime.value > 65535)
    {
        C2xSetTokenInt(packetHandle, "SSM", newPath, 65535);
    }
    else
    {
        C2xSetTokenInt(packetHandle, "SSM", newPath, value.estimatedTime.value);
    }
    result = CheckLastError("SSM", gkFuncRefGet, result);
  }
  else
  {
    if( C2xIsTokenAvailable(packetHandle, "SSM", newPath) )
    {
      C2xRemoveToken(packetHandle, "SSM", newPath);
    }
  }

  snprintf(newPath, elcount(newPath), "%s.%s", oldPath, "timeConfidence");
  if(value.timeConfidence.isValidFlag==1)
  {
    C2xSetTokenInt(packetHandle, "SSM", newPath, value.timeConfidence.value);
    result = CheckLastError("SSM", gkFuncRefGet, result);
  }
  else
  {
    if( C2xIsTokenAvailable(packetHandle, "SSM", newPath) )
    {
      C2xRemoveToken(packetHandle, "SSM", newPath);
    }
  }

  return result;
}

int GetSSMPathPlanningParams(LONG packetHandle, struct SSMPathPlanning value, char oldPath[])
{
  char newPath[300]; 
  int i;
  int result;

  result = 0;

  value.length = C2xGetTokenInt(packetHandle, "SSM", oldPath);
  if((result = CheckLastError("SSM", gkFuncRefGet, result))==0)
  {
    for(i=0; i<value.length; i++)
    {
      snprintf(newPath, elcount(newPath), "%s[%d]", oldPath, i);
      GetSSMPathPlanningPointParams(packetHandle, value.arrayValue[i], newPath);
      result = CheckLastError("SSM", gkFuncRefGet, result);
    }
  }
  return result;
}

int SetSSMPathPlanningParams(LONG packetHandle, struct SSMPathPlanning value, char oldPath[])
{
  char newPath[300]; 
  int i;
  int result;

  result = 0;

  C2xRemoveToken(packetHandle, "SSM", oldPath);
  for(i=0; i<value.length; i++)
  {
    snprintf(newPath, elcount(newPath), "%s[%d]", oldPath, i);
    SetSSMPathPlanningPointParams(packetHandle, value.arrayValue[i], newPath);
    result = CheckLastError("SSM", gkFuncRefGet, result);
  }
  return result;
}

int GetSSMPlanningParams(LONG packetHandle, struct SSMPlanning value, char oldPath[])
{
  char newPath[300]; 
  int j; 
  int k;
  int result;

  result = 0;

  snprintf(newPath, elcount(newPath), "%s.%s", oldPath, "duration");
  value.duration.isValidFlag = C2xIsTokenAvailable(packetHandle, "SSM", newPath);
  if(value.duration.isValidFlag==1)
  {
    value.duration.value = C2xGetTokenInt(packetHandle, "SSM", newPath);
    result = CheckLastError("SSM", gkFuncRefGet, result);
  }
  snprintf(newPath, elcount(newPath), "%s.%s", oldPath, "planConfidence");
  value.planConfidence.isValidFlag = C2xIsTokenAvailable(packetHandle, "SSM", newPath);
  if(value.planConfidence.isValidFlag==1)
  {
    value.planConfidence.value = C2xGetTokenInt(packetHandle, "SSM", newPath);
    result = CheckLastError("SSM", gkFuncRefGet, result);
  }
  snprintf(newPath, elcount(newPath), "%s.%s", oldPath, "drivingBehavior");
  value.drivingBehavior.isValidFlag = C2xIsTokenAvailable(packetHandle, "SSM", newPath);
  if(value.drivingBehavior.isValidFlag==1)
  {
    value.drivingBehavior.isValidFlag = 1;
    value.drivingBehavior.stringLength = C2xGetTokenLengthBit(packetHandle, "SSM", newPath);
    if ((result = CheckLastError("SSM", gkFuncRefGet, result))==0)
    {
      if(value.drivingBehavior.stringLength > 0)
      {
        for(j=0; j<value.drivingBehavior.stringLength; j++)
        {
          if(C2xGetTokenBitOfBitString(packetHandle, "SSM", newPath, j) == 0)
          {
            value.drivingBehavior.string[j] = '0';
          }
          else if(C2xGetTokenBitOfBitString(packetHandle, "SSM", newPath, j) == 1)
          {
            value.drivingBehavior.string[j] = '1';
          }

          if(value.drivingBehavior.stringLength == 1)
          {
            value.drivingBehavior.string[1] = '0';
          }
          result = CheckLastError("SSM", gkFuncRefGet, result);
        }
      }
      else
      {
        for(k = value.drivingBehavior.stringLength+1; k > -1; k--)
        {
          if(value.drivingBehavior.string[k] == '1')
          {
            value.drivingBehavior.string[k] = '0';
          }
        }
      }
    }

  }
  snprintf(newPath, elcount(newPath), "%s.%s", oldPath, "pathPlanning");
  value.pathPlanning.isValidFlag = C2xIsTokenAvailable(packetHandle, "SSM", newPath);
  if(value.pathPlanning.isValidFlag==1)
  {
    GetSSMPathPlanningParams(packetHandle, value.pathPlanning, newPath);
    result = CheckLastError("SSM", gkFuncRefGet, result);
  }
  return result;
}

int SetSSMPlanningParams(LONG packetHandle, struct SSMPlanning value, char oldPath[])
{
  char newPath[300]; 
  int j;
  int result;

  result = 0;

  snprintf(newPath, elcount(newPath), "%s.%s", oldPath, "duration");
  if(value.duration.isValidFlag==1)
  {
    C2xSetTokenInt(packetHandle, "SSM", newPath, value.duration.value);
    result = CheckLastError("SSM", gkFuncRefGet, result);
  }
  else
  {
    if( C2xIsTokenAvailable(packetHandle, "SSM", newPath) )
    {
      C2xRemoveToken(packetHandle, "SSM", newPath);
    }
  }

  snprintf(newPath, elcount(newPath), "%s.%s", oldPath, "planConfidence");
  if(value.planConfidence.isValidFlag==1)
  {
    C2xSetTokenInt(packetHandle, "SSM", newPath, value.planConfidence.value);
    result = CheckLastError("SSM", gkFuncRefGet, result);
  }
  else
  {
    if( C2xIsTokenAvailable(packetHandle, "SSM", newPath) )
    {
      C2xRemoveToken(packetHandle, "SSM", newPath);
    }
  }

  snprintf(newPath, elcount(newPath), "%s.%s", oldPath, "drivingBehavior");
  if(value.drivingBehavior.isValidFlag==1)
  {
      for(j=0; j<value.drivingBehavior.stringLength; j++)
      {
        if(value.drivingBehavior.string[j] == '0')
        {
          C2xSetTokenBitOfBitString(packetHandle, "SSM", newPath, j, 0);
        }
        else
        {
          C2xSetTokenBitOfBitString(packetHandle, "SSM", newPath, j, 1);
        }
        result = CheckLastError("SSM", gkFuncRefGet, result);
      }
  }
  else
  {
    if( C2xIsTokenAvailable(packetHandle, "SSM", newPath) )
    {
      C2xRemoveToken(packetHandle, "SSM", newPath);
    }
  }

  snprintf(newPath, elcount(newPath), "%s.%s", oldPath, "pathPlanning");
  if(value.pathPlanning.isValidFlag==1)
  {
    SetSSMPathPlanningParams(packetHandle, value.pathPlanning, newPath);
    result = CheckLastError("SSM", gkFuncRefGet, result);
  }
  else
  {
    if( C2xIsTokenAvailable(packetHandle, "SSM", newPath) )
    {
      C2xRemoveToken(packetHandle, "SSM", newPath);
    }
  }

  return result;
}

int GetSSMPlanningListParams(LONG packetHandle, struct SSMPlanningList value, char oldPath[])
{
  char newPath[300]; 
  int i;
  int result;

  result = 0;

  value.length = C2xGetTokenInt(packetHandle, "SSM", oldPath);
  if((result = CheckLastError("SSM", gkFuncRefGet, result))==0)
  {
    for(i=0; i<value.length; i++)
    {
      snprintf(newPath, elcount(newPath), "%s[%d]", oldPath, i);
      GetSSMPlanningParams(packetHandle, value.arrayValue[i], newPath);
      result = CheckLastError("SSM", gkFuncRefGet, result);
    }
  }
  return result;
}

int SetSSMPlanningListParams(LONG packetHandle, struct SSMPlanningList value, char oldPath[])
{
  char newPath[300]; 
  int i;
  int result;

  result = 0;

  C2xRemoveToken(packetHandle, "SSM", oldPath);
  for(i=0; i<value.length; i++)
  {
    snprintf(newPath, elcount(newPath), "%s[%d]", oldPath, i);
    SetSSMPlanningParams(packetHandle, value.arrayValue[i], newPath);
    result = CheckLastError("SSM", gkFuncRefGet, result);
  }
  return result;
}

int GetSSMAttitudeParams(LONG packetHandle, struct SSMAttitude value, char oldPath[])
{
  char newPath[300];
  int result;

  result = 0;

  snprintf(newPath, elcount(newPath), "%s.%s", oldPath, "pitch");
  value.pitch = C2xGetTokenInt(packetHandle, "SSM", newPath);
  result = CheckLastError("SSM", gkFuncRefGet, result);

  snprintf(newPath, elcount(newPath), "%s.%s", oldPath, "roll");
  value.roll = C2xGetTokenInt(packetHandle, "SSM", newPath);
  result = CheckLastError("SSM", gkFuncRefGet, result);

  snprintf(newPath, elcount(newPath), "%s.%s", oldPath, "yaw");
  value.yaw = C2xGetTokenInt(packetHandle, "SSM", newPath);
  result = CheckLastError("SSM", gkFuncRefGet, result);

  return result;
}

int SetSSMAttitudeParams(LONG packetHandle, struct SSMAttitude value, char oldPath[])
{
  char newPath[300];
  int result;

  result = 0;

  snprintf(newPath, elcount(newPath), "%s.%s", oldPath, "pitch");
  C2xSetTokenInt(packetHandle, "SSM", newPath, value.pitch);
  result = CheckLastError("SSM", gkFuncRefGet, result);

  snprintf(newPath, elcount(newPath), "%s.%s", oldPath, "roll");
  C2xSetTokenInt(packetHandle, "SSM", newPath, value.roll);
  result = CheckLastError("SSM", gkFuncRefGet, result);

  snprintf(newPath, elcount(newPath), "%s.%s", oldPath, "yaw");
  C2xSetTokenInt(packetHandle, "SSM", newPath, value.yaw);
  result = CheckLastError("SSM", gkFuncRefGet, result);

  return result;
}

int GetSSMAttitudeConfidenceParams(LONG packetHandle, struct SSMAttitudeConfidence value, char oldPath[])
{
  char newPath[300];
  int result;

  result = 0;

  snprintf(newPath, elcount(newPath), "%s.%s", oldPath, "pitchConfidence");
  value.pitchConfidence = C2xGetTokenInt(packetHandle, "SSM", newPath);
  result = CheckLastError("SSM", gkFuncRefGet, result);

  snprintf(newPath, elcount(newPath), "%s.%s", oldPath, "rollRateConfidence");
  value.rollRateConfidence = C2xGetTokenInt(packetHandle, "SSM", newPath);
  result = CheckLastError("SSM", gkFuncRefGet, result);

  snprintf(newPath, elcount(newPath), "%s.%s", oldPath, "yawRate");
  value.yawRate = C2xGetTokenInt(packetHandle, "SSM", newPath);
  result = CheckLastError("SSM", gkFuncRefGet, result);

  return result;
}

int SetSSMAttitudeConfidenceParams(LONG packetHandle, struct SSMAttitudeConfidence value, char oldPath[])
{
  char newPath[300];
  int result;

  result = 0;

  snprintf(newPath, elcount(newPath), "%s.%s", oldPath, "pitchConfidence");
  C2xSetTokenInt(packetHandle, "SSM", newPath, value.pitchConfidence);
  result = CheckLastError("SSM", gkFuncRefGet, result);

  snprintf(newPath, elcount(newPath), "%s.%s", oldPath, "rollRateConfidence");
  C2xSetTokenInt(packetHandle, "SSM", newPath, value.rollRateConfidence);
  result = CheckLastError("SSM", gkFuncRefGet, result);

  snprintf(newPath, elcount(newPath), "%s.%s", oldPath, "yawRate");
  C2xSetTokenInt(packetHandle, "SSM", newPath, value.yawRate);
  result = CheckLastError("SSM", gkFuncRefGet, result);

  return result;
}

int GetSSMAngularVelocityParams(LONG packetHandle, struct SSMAngularVelocity value, char oldPath[])
{
  char newPath[300];
  int result;

  result = 0;

  snprintf(newPath, elcount(newPath), "%s.%s", oldPath, "pitchRate");
  value.pitchRate = C2xGetTokenInt(packetHandle, "SSM", newPath);
  result = CheckLastError("SSM", gkFuncRefGet, result);

  snprintf(newPath, elcount(newPath), "%s.%s", oldPath, "rollRate");
  value.rollRate = C2xGetTokenInt(packetHandle, "SSM", newPath);
  result = CheckLastError("SSM", gkFuncRefGet, result);

  snprintf(newPath, elcount(newPath), "%s.%s", oldPath, "yawRate");
  value.yawRate = C2xGetTokenInt(packetHandle, "SSM", newPath);
  result = CheckLastError("SSM", gkFuncRefGet, result);

  return result;
}

int SetSSMAngularVelocityParams(LONG packetHandle, struct SSMAngularVelocity value, char oldPath[])
{
  char newPath[300];
  int result;

  result = 0;

  snprintf(newPath, elcount(newPath), "%s.%s", oldPath, "pitchRate");
  C2xSetTokenInt(packetHandle, "SSM", newPath, value.pitchRate);
  result = CheckLastError("SSM", gkFuncRefGet, result);

  snprintf(newPath, elcount(newPath), "%s.%s", oldPath, "rollRate");
  C2xSetTokenInt(packetHandle, "SSM", newPath, value.rollRate);
  result = CheckLastError("SSM", gkFuncRefGet, result);

  snprintf(newPath, elcount(newPath), "%s.%s", oldPath, "yawRate");
  C2xSetTokenInt(packetHandle, "SSM", newPath, value.yawRate);
  result = CheckLastError("SSM", gkFuncRefGet, result);

  return result;
}

int GetSSMAngularVelocityConfidenceParams(LONG packetHandle, struct SSMAngularVelocityConfidence value, char oldPath[])
{
  char newPath[300];
  int result;

  result = 0;

  snprintf(newPath, elcount(newPath), "%s.%s", oldPath, "pitchRate");
  value.pitchRate = C2xGetTokenInt(packetHandle, "SSM", newPath);
  result = CheckLastError("SSM", gkFuncRefGet, result);

  snprintf(newPath, elcount(newPath), "%s.%s", oldPath, "rollRate");
  value.rollRate = C2xGetTokenInt(packetHandle, "SSM", newPath);
  result = CheckLastError("SSM", gkFuncRefGet, result);

  snprintf(newPath, elcount(newPath), "%s.%s", oldPath, "yawRate");
  value.yawRate = C2xGetTokenInt(packetHandle, "SSM", newPath);
  result = CheckLastError("SSM", gkFuncRefGet, result);

  return result;
}

int SetSSMAngularVelocityConfidenceParams(LONG packetHandle, struct SSMAngularVelocityConfidence value, char oldPath[])
{
  char newPath[300];
  int result;

  result = 0;

  snprintf(newPath, elcount(newPath), "%s.%s", oldPath, "pitchRate");
  C2xSetTokenInt(packetHandle, "SSM", newPath, value.pitchRate);
  result = CheckLastError("SSM", gkFuncRefGet, result);

  snprintf(newPath, elcount(newPath), "%s.%s", oldPath, "rollRate");
  C2xSetTokenInt(packetHandle, "SSM", newPath, value.rollRate);
  result = CheckLastError("SSM", gkFuncRefGet, result);

  snprintf(newPath, elcount(newPath), "%s.%s", oldPath, "yawRate");
  C2xSetTokenInt(packetHandle, "SSM", newPath, value.yawRate);
  result = CheckLastError("SSM", gkFuncRefGet, result);

  return result;
}

int GetSSMMotorDataExtensionParams(LONG packetHandle, struct SSMMotorDataExtension value, char oldPath[])
{
  char newPath[300]; 
  int j; 
  int k;
  int result;

  result = 0;

  snprintf(newPath, elcount(newPath), "%s.%s", oldPath, "lights");
  value.lights.isValidFlag = C2xIsTokenAvailable(packetHandle, "SSM", newPath);
  if(value.lights.isValidFlag==1)
  {
    value.lights.isValidFlag = 1;
    value.lights.stringLength = C2xGetTokenLengthBit(packetHandle, "SSM", newPath);
    if ((result = CheckLastError("SSM", gkFuncRefGet, result))==0)
    {
      if(value.lights.stringLength > 0)
      {
        for(j=0; j<value.lights.stringLength; j++)
        {
          if(C2xGetTokenBitOfBitString(packetHandle, "SSM", newPath, j) == 0)
          {
            value.lights.string[j] = '0';
          }
          else if(C2xGetTokenBitOfBitString(packetHandle, "SSM", newPath, j) == 1)
          {
            value.lights.string[j] = '1';
          }

          if(value.lights.stringLength == 1)
          {
            value.lights.string[1] = '0';
          }
          result = CheckLastError("SSM", gkFuncRefGet, result);
        }
      }
      else
      {
        for(k = value.lights.stringLength+1; k > -1; k--)
        {
          if(value.lights.string[k] == '1')
          {
            value.lights.string[k] = '0';
          }
        }
      }
    }

  }
  snprintf(newPath, elcount(newPath), "%s.%s", oldPath, "vehAttitude");
  value.vehAttitude.isValidFlag = C2xIsTokenAvailable(packetHandle, "SSM", newPath);
  if(value.vehAttitude.isValidFlag==1)
  {
    GetSSMAttitudeParams(packetHandle, value.vehAttitude, newPath);
    result = CheckLastError("SSM", gkFuncRefGet, result);
  }
  snprintf(newPath, elcount(newPath), "%s.%s", oldPath, "vehAttitudeConfidence");
  value.vehAttitudeConfidence.isValidFlag = C2xIsTokenAvailable(packetHandle, "SSM", newPath);
  if(value.vehAttitudeConfidence.isValidFlag==1)
  {
    GetSSMAttitudeConfidenceParams(packetHandle, value.vehAttitudeConfidence, newPath);
    result = CheckLastError("SSM", gkFuncRefGet, result);
  }
  snprintf(newPath, elcount(newPath), "%s.%s", oldPath, "vehAngVel");
  value.vehAngVel.isValidFlag = C2xIsTokenAvailable(packetHandle, "SSM", newPath);
  if(value.vehAngVel.isValidFlag==1)
  {
    GetSSMAngularVelocityParams(packetHandle, value.vehAngVel, newPath);
    result = CheckLastError("SSM", gkFuncRefGet, result);
  }
  snprintf(newPath, elcount(newPath), "%s.%s", oldPath, "vehAngVelConfidence");
  value.vehAngVelConfidence.isValidFlag = C2xIsTokenAvailable(packetHandle, "SSM", newPath);
  if(value.vehAngVelConfidence.isValidFlag==1)
  {
    GetSSMAngularVelocityConfidenceParams(packetHandle, value.vehAngVelConfidence, newPath);
    result = CheckLastError("SSM", gkFuncRefGet, result);
  }
  return result;
}

int SetSSMMotorDataExtensionParams(LONG packetHandle, struct SSMMotorDataExtension value, char oldPath[])
{
  char newPath[300]; 
  int j;
  int result;

  result = 0;

  snprintf(newPath, elcount(newPath), "%s.%s", oldPath, "lights");
  if(value.lights.isValidFlag==1)
  {
      for(j=0; j<value.lights.stringLength; j++)
      {
        if(value.lights.string[j] == '0')
        {
          C2xSetTokenBitOfBitString(packetHandle, "SSM", newPath, j, 0);
        }
        else
        {
          C2xSetTokenBitOfBitString(packetHandle, "SSM", newPath, j, 1);
        }
        result = CheckLastError("SSM", gkFuncRefGet, result);
      }
  }
  else
  {
    if( C2xIsTokenAvailable(packetHandle, "SSM", newPath) )
    {
      C2xRemoveToken(packetHandle, "SSM", newPath);
    }
  }

  snprintf(newPath, elcount(newPath), "%s.%s", oldPath, "vehAttitude");
  if(value.vehAttitude.isValidFlag==1)
  {
    SetSSMAttitudeParams(packetHandle, value.vehAttitude, newPath);
    result = CheckLastError("SSM", gkFuncRefGet, result);
  }
  else
  {
    if( C2xIsTokenAvailable(packetHandle, "SSM", newPath) )
    {
      C2xRemoveToken(packetHandle, "SSM", newPath);
    }
  }

  snprintf(newPath, elcount(newPath), "%s.%s", oldPath, "vehAttitudeConfidence");
  if(value.vehAttitudeConfidence.isValidFlag==1)
  {
    SetSSMAttitudeConfidenceParams(packetHandle, value.vehAttitudeConfidence, newPath);
    result = CheckLastError("SSM", gkFuncRefGet, result);
  }
  else
  {
    if( C2xIsTokenAvailable(packetHandle, "SSM", newPath) )
    {
      C2xRemoveToken(packetHandle, "SSM", newPath);
    }
  }

  snprintf(newPath, elcount(newPath), "%s.%s", oldPath, "vehAngVel");
  if(value.vehAngVel.isValidFlag==1)
  {
    SetSSMAngularVelocityParams(packetHandle, value.vehAngVel, newPath);
    result = CheckLastError("SSM", gkFuncRefGet, result);
  }
  else
  {
    if( C2xIsTokenAvailable(packetHandle, "SSM", newPath) )
    {
      C2xRemoveToken(packetHandle, "SSM", newPath);
    }
  }

  snprintf(newPath, elcount(newPath), "%s.%s", oldPath, "vehAngVelConfidence");
  if(value.vehAngVelConfidence.isValidFlag==1)
  {
    SetSSMAngularVelocityConfidenceParams(packetHandle, value.vehAngVelConfidence, newPath);
    result = CheckLastError("SSM", gkFuncRefGet, result);
  }
  else
  {
    if( C2xIsTokenAvailable(packetHandle, "SSM", newPath) )
    {
      C2xRemoveToken(packetHandle, "SSM", newPath);
    }
  }

  return result;
}

int GetSSMPropelledInformationParams(LONG packetHandle, struct SSMPropelledInformation value, char oldPath[])
{
  char newPath[300];
  int result;

  result = 0;

  value.choice = C2xGetTokenInt(packetHandle, "SSM", oldPath);

  switch(value.choice)
  {
    case 0:
    {
      snprintf(newPath, elcount(newPath), "%s.%s", oldPath, "human");
      value.human = C2xGetTokenInt(packetHandle, "SSM", newPath);
      result = CheckLastError("SSM", gkFuncRefGet, result);
    }
    break;
    case 1:
    {
      snprintf(newPath, elcount(newPath), "%s.%s", oldPath, "animal");
      value.animal = C2xGetTokenInt(packetHandle, "SSM", newPath);
      result = CheckLastError("SSM", gkFuncRefGet, result);
    }
    break;
    case 2:
    {
      snprintf(newPath, elcount(newPath), "%s.%s", oldPath, "motor");
      value.motor = C2xGetTokenInt(packetHandle, "SSM", newPath);
      result = CheckLastError("SSM", gkFuncRefGet, result);
    }
    break;
  }
  return result;
}

int SetSSMPropelledInformationParams(LONG packetHandle, struct SSMPropelledInformation value, char oldPath[])
{
  char newPath[300];
  int result;

  result = 0;

  switch(value.choice)
  {
    case 0:
    {
      snprintf(newPath, elcount(newPath), "%s.%s", oldPath, "human");
      C2xSetTokenInt(packetHandle, "SSM", newPath, value.human);
      result = CheckLastError("SSM", gkFuncRefGet, result);
    }
    break;
    case 1:
    {
      snprintf(newPath, elcount(newPath), "%s.%s", oldPath, "animal");
      C2xSetTokenInt(packetHandle, "SSM", newPath, value.animal);
      result = CheckLastError("SSM", gkFuncRefGet, result);
    }
    break;
    case 2:
    {
      snprintf(newPath, elcount(newPath), "%s.%s", oldPath, "motor");
      C2xSetTokenInt(packetHandle, "SSM", newPath, value.motor);
      result = CheckLastError("SSM", gkFuncRefGet, result);
    }
    break;
  }
  return result;
}

int GetSSMPersonalExtensionsParams(LONG packetHandle, struct SSMPersonalExtensions value, char oldPath[])
{
  char newPath[300]; 
  int j; 
  int k;
  int result;

  result = 0;

  snprintf(newPath, elcount(newPath), "%s.%s", oldPath, "useState");
  value.useState.isValidFlag = C2xIsTokenAvailable(packetHandle, "SSM", newPath);
  if(value.useState.isValidFlag==1)
  {
    value.useState.isValidFlag = 1;
    value.useState.stringLength = C2xGetTokenLengthBit(packetHandle, "SSM", newPath);
    if ((result = CheckLastError("SSM", gkFuncRefGet, result))==0)
    {
      if(value.useState.stringLength > 0)
      {
        for(j=0; j<value.useState.stringLength; j++)
        {
          if(C2xGetTokenBitOfBitString(packetHandle, "SSM", newPath, j) == 0)
          {
            value.useState.string[j] = '0';
          }
          else if(C2xGetTokenBitOfBitString(packetHandle, "SSM", newPath, j) == 1)
          {
            value.useState.string[j] = '1';
          }

          if(value.useState.stringLength == 1)
          {
            value.useState.string[1] = '0';
          }
          result = CheckLastError("SSM", gkFuncRefGet, result);
        }
      }
      else
      {
        for(k = value.useState.stringLength+1; k > -1; k--)
        {
          if(value.useState.string[k] == '1')
          {
            value.useState.string[k] = '0';
          }
        }
      }
    }

  }
  snprintf(newPath, elcount(newPath), "%s.%s", oldPath, "assistType");
  value.assistType.isValidFlag = C2xIsTokenAvailable(packetHandle, "SSM", newPath);
  if(value.assistType.isValidFlag==1)
  {
    value.assistType.isValidFlag = 1;
    value.assistType.stringLength = C2xGetTokenLengthBit(packetHandle, "SSM", newPath);
    if ((result = CheckLastError("SSM", gkFuncRefGet, result))==0)
    {
      if(value.assistType.stringLength > 0)
      {
        for(j=0; j<value.assistType.stringLength; j++)
        {
          if(C2xGetTokenBitOfBitString(packetHandle, "SSM", newPath, j) == 0)
          {
            value.assistType.string[j] = '0';
          }
          else if(C2xGetTokenBitOfBitString(packetHandle, "SSM", newPath, j) == 1)
          {
            value.assistType.string[j] = '1';
          }

          if(value.assistType.stringLength == 1)
          {
            value.assistType.string[1] = '0';
          }
          result = CheckLastError("SSM", gkFuncRefGet, result);
        }
      }
      else
      {
        for(k = value.assistType.stringLength+1; k > -1; k--)
        {
          if(value.assistType.string[k] == '1')
          {
            value.assistType.string[k] = '0';
          }
        }
      }
    }

  }
  return result;
}

int SetSSMPersonalExtensionsParams(LONG packetHandle, struct SSMPersonalExtensions value, char oldPath[])
{
  char newPath[300]; 
  int j;
  int result;

  result = 0;

  snprintf(newPath, elcount(newPath), "%s.%s", oldPath, "useState");
  if(value.useState.isValidFlag==1)
  {
      for(j=0; j<value.useState.stringLength; j++)
      {
        if(value.useState.string[j] == '0')
        {
          C2xSetTokenBitOfBitString(packetHandle, "SSM", newPath, j, 0);
        }
        else
        {
          C2xSetTokenBitOfBitString(packetHandle, "SSM", newPath, j, 1);
        }
        result = CheckLastError("SSM", gkFuncRefGet, result);
      }
  }
  else
  {
    if( C2xIsTokenAvailable(packetHandle, "SSM", newPath) )
    {
      C2xRemoveToken(packetHandle, "SSM", newPath);
    }
  }

  snprintf(newPath, elcount(newPath), "%s.%s", oldPath, "assistType");
  if(value.assistType.isValidFlag==1)
  {
      for(j=0; j<value.assistType.stringLength; j++)
      {
        if(value.assistType.string[j] == '0')
        {
          C2xSetTokenBitOfBitString(packetHandle, "SSM", newPath, j, 0);
        }
        else
        {
          C2xSetTokenBitOfBitString(packetHandle, "SSM", newPath, j, 1);
        }
        result = CheckLastError("SSM", gkFuncRefGet, result);
      }
  }
  else
  {
    if( C2xIsTokenAvailable(packetHandle, "SSM", newPath) )
    {
      C2xRemoveToken(packetHandle, "SSM", newPath);
    }
  }

  return result;
}

int GetSSMRoadWorkerExtensionsParams(LONG packetHandle, struct SSMRoadWorkerExtensions value, char oldPath[])
{
  char newPath[300]; 
  int j; 
  int k;
  int result;

  result = 0;

  snprintf(newPath, elcount(newPath), "%s.%s", oldPath, "workerType");
  value.workerType.isValidFlag = C2xIsTokenAvailable(packetHandle, "SSM", newPath);
  if(value.workerType.isValidFlag==1)
  {
    value.workerType.value = C2xGetTokenInt(packetHandle, "SSM", newPath);
    result = CheckLastError("SSM", gkFuncRefGet, result);
  }
  snprintf(newPath, elcount(newPath), "%s.%s", oldPath, "activityType");
  value.activityType.isValidFlag = C2xIsTokenAvailable(packetHandle, "SSM", newPath);
  if(value.activityType.isValidFlag==1)
  {
    value.activityType.isValidFlag = 1;
    value.activityType.stringLength = C2xGetTokenLengthBit(packetHandle, "SSM", newPath);
    if ((result = CheckLastError("SSM", gkFuncRefGet, result))==0)
    {
      if(value.activityType.stringLength > 0)
      {
        for(j=0; j<value.activityType.stringLength; j++)
        {
          if(C2xGetTokenBitOfBitString(packetHandle, "SSM", newPath, j) == 0)
          {
            value.activityType.string[j] = '0';
          }
          else if(C2xGetTokenBitOfBitString(packetHandle, "SSM", newPath, j) == 1)
          {
            value.activityType.string[j] = '1';
          }

          if(value.activityType.stringLength == 1)
          {
            value.activityType.string[1] = '0';
          }
          result = CheckLastError("SSM", gkFuncRefGet, result);
        }
      }
      else
      {
        for(k = value.activityType.stringLength+1; k > -1; k--)
        {
          if(value.activityType.string[k] == '1')
          {
            value.activityType.string[k] = '0';
          }
        }
      }
    }

  }
  return result;
}

int SetSSMRoadWorkerExtensionsParams(LONG packetHandle, struct SSMRoadWorkerExtensions value, char oldPath[])
{
  char newPath[300]; 
  int j;
  int result;

  result = 0;

  snprintf(newPath, elcount(newPath), "%s.%s", oldPath, "workerType");
  if(value.workerType.isValidFlag==1)
  {
    C2xSetTokenInt(packetHandle, "SSM", newPath, value.workerType.value);
    result = CheckLastError("SSM", gkFuncRefGet, result);
  }
  else
  {
    if( C2xIsTokenAvailable(packetHandle, "SSM", newPath) )
    {
      C2xRemoveToken(packetHandle, "SSM", newPath);
    }
  }

  snprintf(newPath, elcount(newPath), "%s.%s", oldPath, "activityType");
  if(value.activityType.isValidFlag==1)
  {
      for(j=0; j<value.activityType.stringLength; j++)
      {
        if(value.activityType.string[j] == '0')
        {
          C2xSetTokenBitOfBitString(packetHandle, "SSM", newPath, j, 0);
        }
        else
        {
          C2xSetTokenBitOfBitString(packetHandle, "SSM", newPath, j, 1);
        }
        result = CheckLastError("SSM", gkFuncRefGet, result);
      }
  }
  else
  {
    if( C2xIsTokenAvailable(packetHandle, "SSM", newPath) )
    {
      C2xRemoveToken(packetHandle, "SSM", newPath);
    }
  }

  return result;
}

int GetSSMPersonalRequestParams(LONG packetHandle, struct SSMPersonalRequest value, char oldPath[])
{
  char newPath[300];
  int result;

  result = 0;

  snprintf(newPath, elcount(newPath), "%s.%s", oldPath, "crossing");
  value.crossing.isValidFlag = C2xIsTokenAvailable(packetHandle, "SSM", newPath);
  if(value.crossing.isValidFlag==1)
  {
    value.crossing.value = C2xGetTokenInt(packetHandle, "SSM", newPath);
    result = CheckLastError("SSM", gkFuncRefGet, result);
  }
  return result;
}

int SetSSMPersonalRequestParams(LONG packetHandle, struct SSMPersonalRequest value, char oldPath[])
{
  char newPath[300];
  int result;

  result = 0;

  snprintf(newPath, elcount(newPath), "%s.%s", oldPath, "crossing");
  if(value.crossing.isValidFlag==1)
  {
    C2xSetTokenInt(packetHandle, "SSM", newPath, value.crossing.value);
    result = CheckLastError("SSM", gkFuncRefGet, result);
  }
  else
  {
    if( C2xIsTokenAvailable(packetHandle, "SSM", newPath) )
    {
      C2xRemoveToken(packetHandle, "SSM", newPath);
    }
  }

  return result;
}

int GetSSMNon_motorDataParams(LONG packetHandle, struct SSMNon_motorData value, char oldPath[])
{
  char newPath[300];
  int result;

  result = 0;

  snprintf(newPath, elcount(newPath), "%s.%s", oldPath, "basicType");
  value.basicType = C2xGetTokenInt(packetHandle, "SSM", newPath);
  result = CheckLastError("SSM", gkFuncRefGet, result);

  snprintf(newPath, elcount(newPath), "%s.%s", oldPath, "propulsion");
  value.propulsion.isValidFlag = C2xIsTokenAvailable(packetHandle, "SSM", newPath);
  if(value.propulsion.isValidFlag==1)
  {
    GetSSMPropelledInformationParams(packetHandle, value.propulsion, newPath);
    result = CheckLastError("SSM", gkFuncRefGet, result);
  }
  snprintf(newPath, elcount(newPath), "%s.%s", oldPath, "clusterSize");
  value.clusterSize.isValidFlag = C2xIsTokenAvailable(packetHandle, "SSM", newPath);
  if(value.clusterSize.isValidFlag==1)
  {
    value.clusterSize.value = C2xGetTokenInt(packetHandle, "SSM", newPath);
    result = CheckLastError("SSM", gkFuncRefGet, result);
  }
  snprintf(newPath, elcount(newPath), "%s.%s", oldPath, "attachment");
  value.attachment.isValidFlag = C2xIsTokenAvailable(packetHandle, "SSM", newPath);
  if(value.attachment.isValidFlag==1)
  {
    value.attachment.value = C2xGetTokenInt(packetHandle, "SSM", newPath);
    result = CheckLastError("SSM", gkFuncRefGet, result);
  }
  snprintf(newPath, elcount(newPath), "%s.%s", oldPath, "personalExt");
  value.personalExt.isValidFlag = C2xIsTokenAvailable(packetHandle, "SSM", newPath);
  if(value.personalExt.isValidFlag==1)
  {
    GetSSMPersonalExtensionsParams(packetHandle, value.personalExt, newPath);
    result = CheckLastError("SSM", gkFuncRefGet, result);
  }
  snprintf(newPath, elcount(newPath), "%s.%s", oldPath, "roadWorkerExt");
  value.roadWorkerExt.isValidFlag = C2xIsTokenAvailable(packetHandle, "SSM", newPath);
  if(value.roadWorkerExt.isValidFlag==1)
  {
    GetSSMRoadWorkerExtensionsParams(packetHandle, value.roadWorkerExt, newPath);
    result = CheckLastError("SSM", gkFuncRefGet, result);
  }
  snprintf(newPath, elcount(newPath), "%s.%s", oldPath, "personalReq");
  value.personalReq.isValidFlag = C2xIsTokenAvailable(packetHandle, "SSM", newPath);
  if(value.personalReq.isValidFlag==1)
  {
    GetSSMPersonalRequestParams(packetHandle, value.personalReq, newPath);
    result = CheckLastError("SSM", gkFuncRefGet, result);
  }
  return result;
}

int SetSSMNon_motorDataParams(LONG packetHandle, struct SSMNon_motorData value, char oldPath[])
{
  char newPath[300];
  int result;

  result = 0;

  snprintf(newPath, elcount(newPath), "%s.%s", oldPath, "basicType");
  C2xSetTokenInt(packetHandle, "SSM", newPath, value.basicType);
  result = CheckLastError("SSM", gkFuncRefGet, result);

  snprintf(newPath, elcount(newPath), "%s.%s", oldPath, "propulsion");
  if(value.propulsion.isValidFlag==1)
  {
    SetSSMPropelledInformationParams(packetHandle, value.propulsion, newPath);
    result = CheckLastError("SSM", gkFuncRefGet, result);
  }
  else
  {
    if( C2xIsTokenAvailable(packetHandle, "SSM", newPath) )
    {
      C2xRemoveToken(packetHandle, "SSM", newPath);
    }
  }

  snprintf(newPath, elcount(newPath), "%s.%s", oldPath, "clusterSize");
  if(value.clusterSize.isValidFlag==1)
  {
    C2xSetTokenInt(packetHandle, "SSM", newPath, value.clusterSize.value);
    result = CheckLastError("SSM", gkFuncRefGet, result);
  }
  else
  {
    if( C2xIsTokenAvailable(packetHandle, "SSM", newPath) )
    {
      C2xRemoveToken(packetHandle, "SSM", newPath);
    }
  }

  snprintf(newPath, elcount(newPath), "%s.%s", oldPath, "attachment");
  if(value.attachment.isValidFlag==1)
  {
    C2xSetTokenInt(packetHandle, "SSM", newPath, value.attachment.value);
    result = CheckLastError("SSM", gkFuncRefGet, result);
  }
  else
  {
    if( C2xIsTokenAvailable(packetHandle, "SSM", newPath) )
    {
      C2xRemoveToken(packetHandle, "SSM", newPath);
    }
  }

  snprintf(newPath, elcount(newPath), "%s.%s", oldPath, "personalExt");
  if(value.personalExt.isValidFlag==1)
  {
    SetSSMPersonalExtensionsParams(packetHandle, value.personalExt, newPath);
    result = CheckLastError("SSM", gkFuncRefGet, result);
  }
  else
  {
    if( C2xIsTokenAvailable(packetHandle, "SSM", newPath) )
    {
      C2xRemoveToken(packetHandle, "SSM", newPath);
    }
  }

  snprintf(newPath, elcount(newPath), "%s.%s", oldPath, "roadWorkerExt");
  if(value.roadWorkerExt.isValidFlag==1)
  {
    SetSSMRoadWorkerExtensionsParams(packetHandle, value.roadWorkerExt, newPath);
    result = CheckLastError("SSM", gkFuncRefGet, result);
  }
  else
  {
    if( C2xIsTokenAvailable(packetHandle, "SSM", newPath) )
    {
      C2xRemoveToken(packetHandle, "SSM", newPath);
    }
  }

  snprintf(newPath, elcount(newPath), "%s.%s", oldPath, "personalReq");
  if(value.personalReq.isValidFlag==1)
  {
    SetSSMPersonalRequestParams(packetHandle, value.personalReq, newPath);
    result = CheckLastError("SSM", gkFuncRefGet, result);
  }
  else
  {
    if( C2xIsTokenAvailable(packetHandle, "SSM", newPath) )
    {
      C2xRemoveToken(packetHandle, "SSM", newPath);
    }
  }

  return result;
}

int GetSSMNon_motorDataExtensionParams(LONG packetHandle, struct SSMNon_motorDataExtension value, char oldPath[])
{
  char newPath[300];
  int result;

  result = 0;

  snprintf(newPath, elcount(newPath), "%s.%s", oldPath, "overallRadius");
  value.overallRadius = C2xGetTokenInt(packetHandle, "SSM", newPath);
  result = CheckLastError("SSM", gkFuncRefGet, result);

  snprintf(newPath, elcount(newPath), "%s.%s", oldPath, "non_motorData");
  GetSSMNon_motorDataParams(packetHandle, value.non_motorData, newPath);
  result = CheckLastError("SSM", gkFuncRefGet, result);

  return result;
}

int SetSSMNon_motorDataExtensionParams(LONG packetHandle, struct SSMNon_motorDataExtension value, char oldPath[])
{
  char newPath[300];
  int result;

  result = 0;

  snprintf(newPath, elcount(newPath), "%s.%s", oldPath, "overallRadius");
  C2xSetTokenInt(packetHandle, "SSM", newPath, value.overallRadius);
  result = CheckLastError("SSM", gkFuncRefGet, result);

  snprintf(newPath, elcount(newPath), "%s.%s", oldPath, "non_motorData");
  SetSSMNon_motorDataParams(packetHandle, value.non_motorData, newPath);
  result = CheckLastError("SSM", gkFuncRefGet, result);

  return result;
}

int GetSSMDetectedPTCData_type_relatedExtParams(LONG packetHandle, struct SSMDetectedPTCData_type_relatedExt value, char oldPath[])
{
  char newPath[300];
  int result;

  result = 0;

  value.choice = C2xGetTokenInt(packetHandle, "SSM", oldPath);

  switch(value.choice)
  {
    case 0:
    {
      snprintf(newPath, elcount(newPath), "%s.%s", oldPath, "motorExt");
      GetSSMMotorDataExtensionParams(packetHandle, value.motorExt, newPath);
      result = CheckLastError("SSM", gkFuncRefGet, result);
    }
    break;
    case 1:
    {
      snprintf(newPath, elcount(newPath), "%s.%s", oldPath, "non_motorExt");
      GetSSMNon_motorDataExtensionParams(packetHandle, value.non_motorExt, newPath);
      result = CheckLastError("SSM", gkFuncRefGet, result);
    }
    break;
  }
  return result;
}

int SetSSMDetectedPTCData_type_relatedExtParams(LONG packetHandle, struct SSMDetectedPTCData_type_relatedExt value, char oldPath[])
{
  char newPath[300];
  int result;

  result = 0;

  switch(value.choice)
  {
    case 0:
    {
      snprintf(newPath, elcount(newPath), "%s.%s", oldPath, "motorExt");
      SetSSMMotorDataExtensionParams(packetHandle, value.motorExt, newPath);
      result = CheckLastError("SSM", gkFuncRefGet, result);
    }
    break;
    case 1:
    {
      snprintf(newPath, elcount(newPath), "%s.%s", oldPath, "non_motorExt");
      SetSSMNon_motorDataExtensionParams(packetHandle, value.non_motorExt, newPath);
      result = CheckLastError("SSM", gkFuncRefGet, result);
    }
    break;
  }
  return result;
}

int GetSSMDetectedPTCDataParams(LONG packetHandle, struct SSMDetectedPTCData value, char oldPath[])
{
  char newPath[300];
  int result;

  result = 0;

  snprintf(newPath, elcount(newPath), "%s.%s", oldPath, "ptc");
  GetSSMParticipantDataParams(packetHandle, value.ptc, newPath);
  result = CheckLastError("SSM", gkFuncRefGet, result);

  snprintf(newPath, elcount(newPath), "%s.%s", oldPath, "objSizeConfidence");
  value.objSizeConfidence.isValidFlag = C2xIsTokenAvailable(packetHandle, "SSM", newPath);
  if(value.objSizeConfidence.isValidFlag==1)
  {
    GetSSMObjectSizeConfidenceParams(packetHandle, value.objSizeConfidence, newPath);
    result = CheckLastError("SSM", gkFuncRefGet, result);
  }
  snprintf(newPath, elcount(newPath), "%s.%s", oldPath, "detectedPTCType");
  value.detectedPTCType.isValidFlag = C2xIsTokenAvailable(packetHandle, "SSM", newPath);
  if(value.detectedPTCType.isValidFlag==1)
  {
    value.detectedPTCType.value = C2xGetTokenInt(packetHandle, "SSM", newPath);
    result = CheckLastError("SSM", gkFuncRefGet, result);
  }
  snprintf(newPath, elcount(newPath), "%s.%s", oldPath, "typeConfidence");
  value.typeConfidence.isValidFlag = C2xIsTokenAvailable(packetHandle, "SSM", newPath);
  if(value.typeConfidence.isValidFlag==1)
  {
    value.typeConfidence.value = C2xGetTokenInt(packetHandle, "SSM", newPath);
    result = CheckLastError("SSM", gkFuncRefGet, result);
  }
  snprintf(newPath, elcount(newPath), "%s.%s", oldPath, "acc4WayConfidence");
  value.acc4WayConfidence.isValidFlag = C2xIsTokenAvailable(packetHandle, "SSM", newPath);
  if(value.acc4WayConfidence.isValidFlag==1)
  {
    GetSSMAccSet4WayConfidenceParams(packetHandle, value.acc4WayConfidence, newPath);
    result = CheckLastError("SSM", gkFuncRefGet, result);
  }
  snprintf(newPath, elcount(newPath), "%s.%s", oldPath, "statusDuration");
  value.statusDuration.isValidFlag = C2xIsTokenAvailable(packetHandle, "SSM", newPath);
  if(value.statusDuration.isValidFlag==1)
  {
    value.statusDuration.value = C2xGetTokenInt(packetHandle, "SSM", newPath);
    result = CheckLastError("SSM", gkFuncRefGet, result);
  }
  snprintf(newPath, elcount(newPath), "%s.%s", oldPath, "pathHistory");
  value.pathHistory.isValidFlag = C2xIsTokenAvailable(packetHandle, "SSM", newPath);
  if(value.pathHistory.isValidFlag==1)
  {
    GetSSMPathHistoryParams(packetHandle, value.pathHistory, newPath);
    result = CheckLastError("SSM", gkFuncRefGet, result);
  }
  snprintf(newPath, elcount(newPath), "%s.%s", oldPath, "planningList");
  value.planningList.isValidFlag = C2xIsTokenAvailable(packetHandle, "SSM", newPath);
  if(value.planningList.isValidFlag==1)
  {
    GetSSMPlanningListParams(packetHandle, value.planningList, newPath);
    result = CheckLastError("SSM", gkFuncRefGet, result);
  }
  snprintf(newPath, elcount(newPath), "%s.%s", oldPath, "tracking");
  value.tracking.isValidFlag = C2xIsTokenAvailable(packetHandle, "SSM", newPath);
  if(value.tracking.isValidFlag==1)
  {
    value.tracking.value = C2xGetTokenInt(packetHandle, "SSM", newPath);
    result = CheckLastError("SSM", gkFuncRefGet, result);
  }
  snprintf(newPath, elcount(newPath), "%s.%s", oldPath, "polygon");
  value.polygon.isValidFlag = C2xIsTokenAvailable(packetHandle, "SSM", newPath);
  if(value.polygon.isValidFlag==1)
  {
    GetSSMPolygonParams(packetHandle, value.polygon, newPath);
    result = CheckLastError("SSM", gkFuncRefGet, result);
  }
  snprintf(newPath, elcount(newPath), "%s.%s", oldPath, "type_relatedExt");
  value.type_relatedExt.isValidFlag = C2xIsTokenAvailable(packetHandle, "SSM", newPath);
  if(value.type_relatedExt.isValidFlag==1)
  {
    GetSSMDetectedPTCData_type_relatedExtParams(packetHandle, value.type_relatedExt, newPath);
    result = CheckLastError("SSM", gkFuncRefGet, result);
  }
  return result;
}

int SetSSMDetectedPTCDataParams(LONG packetHandle, struct SSMDetectedPTCData value, char oldPath[])
{
  char newPath[300];
  int result;

  result = 0;

  snprintf(newPath, elcount(newPath), "%s.%s", oldPath, "ptc");
  SetSSMParticipantDataParams(packetHandle, value.ptc, newPath);
  result = CheckLastError("SSM", gkFuncRefGet, result);

  snprintf(newPath, elcount(newPath), "%s.%s", oldPath, "objSizeConfidence");
  if(value.objSizeConfidence.isValidFlag==1)
  {
    SetSSMObjectSizeConfidenceParams(packetHandle, value.objSizeConfidence, newPath);
    result = CheckLastError("SSM", gkFuncRefGet, result);
  }
  else
  {
    if( C2xIsTokenAvailable(packetHandle, "SSM", newPath) )
    {
      C2xRemoveToken(packetHandle, "SSM", newPath);
    }
  }

  snprintf(newPath, elcount(newPath), "%s.%s", oldPath, "detectedPTCType");
  if(value.detectedPTCType.isValidFlag==1)
  {
    C2xSetTokenInt(packetHandle, "SSM", newPath, value.detectedPTCType.value);
    result = CheckLastError("SSM", gkFuncRefGet, result);
  }
  else
  {
    if( C2xIsTokenAvailable(packetHandle, "SSM", newPath) )
    {
      C2xRemoveToken(packetHandle, "SSM", newPath);
    }
  }

  snprintf(newPath, elcount(newPath), "%s.%s", oldPath, "typeConfidence");
  if(value.typeConfidence.isValidFlag==1)
  {
    C2xSetTokenInt(packetHandle, "SSM", newPath, value.typeConfidence.value);
    result = CheckLastError("SSM", gkFuncRefGet, result);
  }
  else
  {
    if( C2xIsTokenAvailable(packetHandle, "SSM", newPath) )
    {
      C2xRemoveToken(packetHandle, "SSM", newPath);
    }
  }

  snprintf(newPath, elcount(newPath), "%s.%s", oldPath, "acc4WayConfidence");
  if(value.acc4WayConfidence.isValidFlag==1)
  {
    SetSSMAccSet4WayConfidenceParams(packetHandle, value.acc4WayConfidence, newPath);
    result = CheckLastError("SSM", gkFuncRefGet, result);
  }
  else
  {
    if( C2xIsTokenAvailable(packetHandle, "SSM", newPath) )
    {
      C2xRemoveToken(packetHandle, "SSM", newPath);
    }
  }

  snprintf(newPath, elcount(newPath), "%s.%s", oldPath, "statusDuration");
  if(value.statusDuration.isValidFlag==1)
  {
    if (value.statusDuration.value < 1)
    {
        C2xSetTokenInt(packetHandle, "SSM", newPath, 1);
    }
    else if (value.statusDuration.value > 65535)
    {
        C2xSetTokenInt(packetHandle, "SSM", newPath, 65535);
    }
    else
    {
        C2xSetTokenInt(packetHandle, "SSM", newPath, value.statusDuration.value);
    }
    result = CheckLastError("SSM", gkFuncRefGet, result);
  }
  else
  {
    if( C2xIsTokenAvailable(packetHandle, "SSM", newPath) )
    {
      C2xRemoveToken(packetHandle, "SSM", newPath);
    }
  }

  snprintf(newPath, elcount(newPath), "%s.%s", oldPath, "pathHistory");
  if(value.pathHistory.isValidFlag==1)
  {
    SetSSMPathHistoryParams(packetHandle, value.pathHistory, newPath);
    result = CheckLastError("SSM", gkFuncRefGet, result);
  }
  else
  {
    if( C2xIsTokenAvailable(packetHandle, "SSM", newPath) )
    {
      C2xRemoveToken(packetHandle, "SSM", newPath);
    }
  }

  snprintf(newPath, elcount(newPath), "%s.%s", oldPath, "planningList");
  if(value.planningList.isValidFlag==1)
  {
    SetSSMPlanningListParams(packetHandle, value.planningList, newPath);
    result = CheckLastError("SSM", gkFuncRefGet, result);
  }
  else
  {
    if( C2xIsTokenAvailable(packetHandle, "SSM", newPath) )
    {
      C2xRemoveToken(packetHandle, "SSM", newPath);
    }
  }

  snprintf(newPath, elcount(newPath), "%s.%s", oldPath, "tracking");
  if(value.tracking.isValidFlag==1)
  {
    if (value.tracking.value < 1)
    {
        C2xSetTokenInt(packetHandle, "SSM", newPath, 1);
    }
    else if (value.tracking.value > 65535)
    {
        C2xSetTokenInt(packetHandle, "SSM", newPath, 65535);
    }
    else
    {
        C2xSetTokenInt(packetHandle, "SSM", newPath, value.tracking.value);
    }
    result = CheckLastError("SSM", gkFuncRefGet, result);
  }
  else
  {
    if( C2xIsTokenAvailable(packetHandle, "SSM", newPath) )
    {
      C2xRemoveToken(packetHandle, "SSM", newPath);
    }
  }

  snprintf(newPath, elcount(newPath), "%s.%s", oldPath, "polygon");
  if(value.polygon.isValidFlag==1)
  {
    SetSSMPolygonParams(packetHandle, value.polygon, newPath);
    result = CheckLastError("SSM", gkFuncRefGet, result);
  }
  else
  {
    if( C2xIsTokenAvailable(packetHandle, "SSM", newPath) )
    {
      C2xRemoveToken(packetHandle, "SSM", newPath);
    }
  }

  snprintf(newPath, elcount(newPath), "%s.%s", oldPath, "type_relatedExt");
  if(value.type_relatedExt.isValidFlag==1)
  {
    SetSSMDetectedPTCData_type_relatedExtParams(packetHandle, value.type_relatedExt, newPath);
    result = CheckLastError("SSM", gkFuncRefGet, result);
  }
  else
  {
    if( C2xIsTokenAvailable(packetHandle, "SSM", newPath) )
    {
      C2xRemoveToken(packetHandle, "SSM", newPath);
    }
  }

  return result;
}

int GetSSMDetectedPTCListParams(LONG packetHandle, struct SSMDetectedPTCList value, char oldPath[])
{
  char newPath[300]; 
  int i;
  int result;

  result = 0;

  value.length = C2xGetTokenInt(packetHandle, "SSM", oldPath);
  if((result = CheckLastError("SSM", gkFuncRefGet, result))==0)
  {
    for(i=0; i<value.length; i++)
    {
      snprintf(newPath, elcount(newPath), "%s[%d]", oldPath, i);
      GetSSMDetectedPTCDataParams(packetHandle, value.arrayValue[i], newPath);
      result = CheckLastError("SSM", gkFuncRefGet, result);
    }
  }
  return result;
}

int SetSSMDetectedPTCListParams(LONG packetHandle, struct SSMDetectedPTCList value, char oldPath[])
{
  char newPath[300]; 
  int i;
  int result;

  result = 0;

  C2xRemoveToken(packetHandle, "SSM", oldPath);
  for(i=0; i<value.length; i++)
  {
    snprintf(newPath, elcount(newPath), "%s[%d]", oldPath, i);
    SetSSMDetectedPTCDataParams(packetHandle, value.arrayValue[i], newPath);
    result = CheckLastError("SSM", gkFuncRefGet, result);
  }
  return result;
}

int GetSSMObjectSizeParams(LONG packetHandle, struct SSMObjectSize value, char oldPath[])
{
  char newPath[300];
  int result;

  result = 0;

  snprintf(newPath, elcount(newPath), "%s.%s", oldPath, "width");
  value.width = C2xGetTokenInt(packetHandle, "SSM", newPath);
  result = CheckLastError("SSM", gkFuncRefGet, result);

  snprintf(newPath, elcount(newPath), "%s.%s", oldPath, "length");
  value.length = C2xGetTokenInt(packetHandle, "SSM", newPath);
  result = CheckLastError("SSM", gkFuncRefGet, result);

  snprintf(newPath, elcount(newPath), "%s.%s", oldPath, "height");
  value.height.isValidFlag = C2xIsTokenAvailable(packetHandle, "SSM", newPath);
  if(value.height.isValidFlag==1)
  {
    value.height.value = C2xGetTokenInt(packetHandle, "SSM", newPath);
    result = CheckLastError("SSM", gkFuncRefGet, result);
  }
  return result;
}

int SetSSMObjectSizeParams(LONG packetHandle, struct SSMObjectSize value, char oldPath[])
{
  char newPath[300];
  int result;

  result = 0;

  snprintf(newPath, elcount(newPath), "%s.%s", oldPath, "width");
  C2xSetTokenInt(packetHandle, "SSM", newPath, value.width);
  result = CheckLastError("SSM", gkFuncRefGet, result);

  snprintf(newPath, elcount(newPath), "%s.%s", oldPath, "length");
  C2xSetTokenInt(packetHandle, "SSM", newPath, value.length);
  result = CheckLastError("SSM", gkFuncRefGet, result);

  snprintf(newPath, elcount(newPath), "%s.%s", oldPath, "height");
  if(value.height.isValidFlag==1)
  {
    C2xSetTokenInt(packetHandle, "SSM", newPath, value.height.value);
    result = CheckLastError("SSM", gkFuncRefGet, result);
  }
  else
  {
    if( C2xIsTokenAvailable(packetHandle, "SSM", newPath) )
    {
      C2xRemoveToken(packetHandle, "SSM", newPath);
    }
  }

  return result;
}

int GetSSMDetectedObstacleDataParams(LONG packetHandle, struct SSMDetectedObstacleData value, char oldPath[])
{
  char newPath[300];
  int result;

  result = 0;

  snprintf(newPath, elcount(newPath), "%s.%s", oldPath, "obsType");
  value.obsType = C2xGetTokenInt(packetHandle, "SSM", newPath);
  result = CheckLastError("SSM", gkFuncRefGet, result);

  snprintf(newPath, elcount(newPath), "%s.%s", oldPath, "objTypeConfidence");
  value.objTypeConfidence.isValidFlag = C2xIsTokenAvailable(packetHandle, "SSM", newPath);
  if(value.objTypeConfidence.isValidFlag==1)
  {
    value.objTypeConfidence.value = C2xGetTokenInt(packetHandle, "SSM", newPath);
    result = CheckLastError("SSM", gkFuncRefGet, result);
  }
  snprintf(newPath, elcount(newPath), "%s.%s", oldPath, "obsId");
  value.obsId = C2xGetTokenInt(packetHandle, "SSM", newPath);
  result = CheckLastError("SSM", gkFuncRefGet, result);

  snprintf(newPath, elcount(newPath), "%s.%s", oldPath, "source");
  value.source = C2xGetTokenInt(packetHandle, "SSM", newPath);
  result = CheckLastError("SSM", gkFuncRefGet, result);

  snprintf(newPath, elcount(newPath), "%s.%s", oldPath, "secMark");
  value.secMark = C2xGetTokenInt(packetHandle, "SSM", newPath);
  result = CheckLastError("SSM", gkFuncRefGet, result);

  snprintf(newPath, elcount(newPath), "%s.%s", oldPath, "pos");
  GetSSMPositionOffsetLLVParams(packetHandle, value.pos, newPath);
  result = CheckLastError("SSM", gkFuncRefGet, result);

  snprintf(newPath, elcount(newPath), "%s.%s", oldPath, "posConfidence");
  GetSSMPositionConfidenceSetParams(packetHandle, value.posConfidence, newPath);
  result = CheckLastError("SSM", gkFuncRefGet, result);

  snprintf(newPath, elcount(newPath), "%s.%s", oldPath, "speed");
  value.speed = C2xGetTokenInt(packetHandle, "SSM", newPath);
  result = CheckLastError("SSM", gkFuncRefGet, result);

  snprintf(newPath, elcount(newPath), "%s.%s", oldPath, "speedCfd");
  value.speedCfd.isValidFlag = C2xIsTokenAvailable(packetHandle, "SSM", newPath);
  if(value.speedCfd.isValidFlag==1)
  {
    value.speedCfd.value = C2xGetTokenInt(packetHandle, "SSM", newPath);
    result = CheckLastError("SSM", gkFuncRefGet, result);
  }
  snprintf(newPath, elcount(newPath), "%s.%s", oldPath, "heading");
  value.heading = C2xGetTokenInt(packetHandle, "SSM", newPath);
  result = CheckLastError("SSM", gkFuncRefGet, result);

  snprintf(newPath, elcount(newPath), "%s.%s", oldPath, "headingCfd");
  value.headingCfd.isValidFlag = C2xIsTokenAvailable(packetHandle, "SSM", newPath);
  if(value.headingCfd.isValidFlag==1)
  {
    value.headingCfd.value = C2xGetTokenInt(packetHandle, "SSM", newPath);
    result = CheckLastError("SSM", gkFuncRefGet, result);
  }
  snprintf(newPath, elcount(newPath), "%s.%s", oldPath, "verSpeed");
  value.verSpeed.isValidFlag = C2xIsTokenAvailable(packetHandle, "SSM", newPath);
  if(value.verSpeed.isValidFlag==1)
  {
    value.verSpeed.value = C2xGetTokenInt(packetHandle, "SSM", newPath);
    result = CheckLastError("SSM", gkFuncRefGet, result);
  }
  snprintf(newPath, elcount(newPath), "%s.%s", oldPath, "verSpeedConfidence");
  value.verSpeedConfidence.isValidFlag = C2xIsTokenAvailable(packetHandle, "SSM", newPath);
  if(value.verSpeedConfidence.isValidFlag==1)
  {
    value.verSpeedConfidence.value = C2xGetTokenInt(packetHandle, "SSM", newPath);
    result = CheckLastError("SSM", gkFuncRefGet, result);
  }
  snprintf(newPath, elcount(newPath), "%s.%s", oldPath, "accelSet");
  value.accelSet.isValidFlag = C2xIsTokenAvailable(packetHandle, "SSM", newPath);
  if(value.accelSet.isValidFlag==1)
  {
    GetSSMAccelerationSet4WayParams(packetHandle, value.accelSet, newPath);
    result = CheckLastError("SSM", gkFuncRefGet, result);
  }
  snprintf(newPath, elcount(newPath), "%s.%s", oldPath, "size");
  GetSSMObjectSizeParams(packetHandle, value.size, newPath);
  result = CheckLastError("SSM", gkFuncRefGet, result);

  snprintf(newPath, elcount(newPath), "%s.%s", oldPath, "objSizeConfidence");
  value.objSizeConfidence.isValidFlag = C2xIsTokenAvailable(packetHandle, "SSM", newPath);
  if(value.objSizeConfidence.isValidFlag==1)
  {
    GetSSMObjectSizeConfidenceParams(packetHandle, value.objSizeConfidence, newPath);
    result = CheckLastError("SSM", gkFuncRefGet, result);
  }
  snprintf(newPath, elcount(newPath), "%s.%s", oldPath, "tracking");
  value.tracking.isValidFlag = C2xIsTokenAvailable(packetHandle, "SSM", newPath);
  if(value.tracking.isValidFlag==1)
  {
    value.tracking.value = C2xGetTokenInt(packetHandle, "SSM", newPath);
    result = CheckLastError("SSM", gkFuncRefGet, result);
  }
  snprintf(newPath, elcount(newPath), "%s.%s", oldPath, "polygon");
  value.polygon.isValidFlag = C2xIsTokenAvailable(packetHandle, "SSM", newPath);
  if(value.polygon.isValidFlag==1)
  {
    GetSSMPolygonParams(packetHandle, value.polygon, newPath);
    result = CheckLastError("SSM", gkFuncRefGet, result);
  }
  return result;
}

int SetSSMDetectedObstacleDataParams(LONG packetHandle, struct SSMDetectedObstacleData value, char oldPath[])
{
  char newPath[300];
  int result;

  result = 0;

  snprintf(newPath, elcount(newPath), "%s.%s", oldPath, "obsType");
  C2xSetTokenInt(packetHandle, "SSM", newPath, value.obsType);
  result = CheckLastError("SSM", gkFuncRefGet, result);

  snprintf(newPath, elcount(newPath), "%s.%s", oldPath, "objTypeConfidence");
  if(value.objTypeConfidence.isValidFlag==1)
  {
    C2xSetTokenInt(packetHandle, "SSM", newPath, value.objTypeConfidence.value);
    result = CheckLastError("SSM", gkFuncRefGet, result);
  }
  else
  {
    if( C2xIsTokenAvailable(packetHandle, "SSM", newPath) )
    {
      C2xRemoveToken(packetHandle, "SSM", newPath);
    }
  }

  snprintf(newPath, elcount(newPath), "%s.%s", oldPath, "obsId");
  C2xSetTokenInt(packetHandle, "SSM", newPath, value.obsId);
  result = CheckLastError("SSM", gkFuncRefGet, result);

  snprintf(newPath, elcount(newPath), "%s.%s", oldPath, "source");
  C2xSetTokenInt(packetHandle, "SSM", newPath, value.source);
  result = CheckLastError("SSM", gkFuncRefGet, result);

  snprintf(newPath, elcount(newPath), "%s.%s", oldPath, "secMark");
  C2xSetTokenInt(packetHandle, "SSM", newPath, value.secMark);
  result = CheckLastError("SSM", gkFuncRefGet, result);

  snprintf(newPath, elcount(newPath), "%s.%s", oldPath, "pos");
  SetSSMPositionOffsetLLVParams(packetHandle, value.pos, newPath);
  result = CheckLastError("SSM", gkFuncRefGet, result);

  snprintf(newPath, elcount(newPath), "%s.%s", oldPath, "posConfidence");
  SetSSMPositionConfidenceSetParams(packetHandle, value.posConfidence, newPath);
  result = CheckLastError("SSM", gkFuncRefGet, result);

  snprintf(newPath, elcount(newPath), "%s.%s", oldPath, "speed");
  C2xSetTokenInt(packetHandle, "SSM", newPath, value.speed);
  result = CheckLastError("SSM", gkFuncRefGet, result);

  snprintf(newPath, elcount(newPath), "%s.%s", oldPath, "speedCfd");
  if(value.speedCfd.isValidFlag==1)
  {
    C2xSetTokenInt(packetHandle, "SSM", newPath, value.speedCfd.value);
    result = CheckLastError("SSM", gkFuncRefGet, result);
  }
  else
  {
    if( C2xIsTokenAvailable(packetHandle, "SSM", newPath) )
    {
      C2xRemoveToken(packetHandle, "SSM", newPath);
    }
  }

  snprintf(newPath, elcount(newPath), "%s.%s", oldPath, "heading");
  C2xSetTokenInt(packetHandle, "SSM", newPath, value.heading);
  result = CheckLastError("SSM", gkFuncRefGet, result);

  snprintf(newPath, elcount(newPath), "%s.%s", oldPath, "headingCfd");
  if(value.headingCfd.isValidFlag==1)
  {
    C2xSetTokenInt(packetHandle, "SSM", newPath, value.headingCfd.value);
    result = CheckLastError("SSM", gkFuncRefGet, result);
  }
  else
  {
    if( C2xIsTokenAvailable(packetHandle, "SSM", newPath) )
    {
      C2xRemoveToken(packetHandle, "SSM", newPath);
    }
  }

  snprintf(newPath, elcount(newPath), "%s.%s", oldPath, "verSpeed");
  if(value.verSpeed.isValidFlag==1)
  {
    C2xSetTokenInt(packetHandle, "SSM", newPath, value.verSpeed.value);
    result = CheckLastError("SSM", gkFuncRefGet, result);
  }
  else
  {
    if( C2xIsTokenAvailable(packetHandle, "SSM", newPath) )
    {
      C2xRemoveToken(packetHandle, "SSM", newPath);
    }
  }

  snprintf(newPath, elcount(newPath), "%s.%s", oldPath, "verSpeedConfidence");
  if(value.verSpeedConfidence.isValidFlag==1)
  {
    C2xSetTokenInt(packetHandle, "SSM", newPath, value.verSpeedConfidence.value);
    result = CheckLastError("SSM", gkFuncRefGet, result);
  }
  else
  {
    if( C2xIsTokenAvailable(packetHandle, "SSM", newPath) )
    {
      C2xRemoveToken(packetHandle, "SSM", newPath);
    }
  }

  snprintf(newPath, elcount(newPath), "%s.%s", oldPath, "accelSet");
  if(value.accelSet.isValidFlag==1)
  {
    SetSSMAccelerationSet4WayParams(packetHandle, value.accelSet, newPath);
    result = CheckLastError("SSM", gkFuncRefGet, result);
  }
  else
  {
    if( C2xIsTokenAvailable(packetHandle, "SSM", newPath) )
    {
      C2xRemoveToken(packetHandle, "SSM", newPath);
    }
  }

  snprintf(newPath, elcount(newPath), "%s.%s", oldPath, "size");
  SetSSMObjectSizeParams(packetHandle, value.size, newPath);
  result = CheckLastError("SSM", gkFuncRefGet, result);

  snprintf(newPath, elcount(newPath), "%s.%s", oldPath, "objSizeConfidence");
  if(value.objSizeConfidence.isValidFlag==1)
  {
    SetSSMObjectSizeConfidenceParams(packetHandle, value.objSizeConfidence, newPath);
    result = CheckLastError("SSM", gkFuncRefGet, result);
  }
  else
  {
    if( C2xIsTokenAvailable(packetHandle, "SSM", newPath) )
    {
      C2xRemoveToken(packetHandle, "SSM", newPath);
    }
  }

  snprintf(newPath, elcount(newPath), "%s.%s", oldPath, "tracking");
  if(value.tracking.isValidFlag==1)
  {
    if (value.tracking.value < 1)
    {
        C2xSetTokenInt(packetHandle, "SSM", newPath, 1);
    }
    else if (value.tracking.value > 65535)
    {
        C2xSetTokenInt(packetHandle, "SSM", newPath, 65535);
    }
    else
    {
        C2xSetTokenInt(packetHandle, "SSM", newPath, value.tracking.value);
    }
    result = CheckLastError("SSM", gkFuncRefGet, result);
  }
  else
  {
    if( C2xIsTokenAvailable(packetHandle, "SSM", newPath) )
    {
      C2xRemoveToken(packetHandle, "SSM", newPath);
    }
  }

  snprintf(newPath, elcount(newPath), "%s.%s", oldPath, "polygon");
  if(value.polygon.isValidFlag==1)
  {
    SetSSMPolygonParams(packetHandle, value.polygon, newPath);
    result = CheckLastError("SSM", gkFuncRefGet, result);
  }
  else
  {
    if( C2xIsTokenAvailable(packetHandle, "SSM", newPath) )
    {
      C2xRemoveToken(packetHandle, "SSM", newPath);
    }
  }

  return result;
}

int GetSSMDetectedObstacleListParams(LONG packetHandle, struct SSMDetectedObstacleList value, char oldPath[])
{
  char newPath[300]; 
  int i;
  int result;

  result = 0;

  value.length = C2xGetTokenInt(packetHandle, "SSM", oldPath);
  if((result = CheckLastError("SSM", gkFuncRefGet, result))==0)
  {
    for(i=0; i<value.length; i++)
    {
      snprintf(newPath, elcount(newPath), "%s[%d]", oldPath, i);
      GetSSMDetectedObstacleDataParams(packetHandle, value.arrayValue[i], newPath);
      result = CheckLastError("SSM", gkFuncRefGet, result);
    }
  }
  return result;
}

int SetSSMDetectedObstacleListParams(LONG packetHandle, struct SSMDetectedObstacleList value, char oldPath[])
{
  char newPath[300]; 
  int i;
  int result;

  result = 0;

  C2xRemoveToken(packetHandle, "SSM", oldPath);
  for(i=0; i<value.length; i++)
  {
    snprintf(newPath, elcount(newPath), "%s[%d]", oldPath, i);
    SetSSMDetectedObstacleDataParams(packetHandle, value.arrayValue[i], newPath);
    result = CheckLastError("SSM", gkFuncRefGet, result);
  }
  return result;
}

int GetSSMDescriptionParams(LONG packetHandle, struct SSMDescription value, char oldPath[])
{
  char newPath[300];
  int result;

  result = 0;

  value.choice = C2xGetTokenInt(packetHandle, "SSM", oldPath);

  switch(value.choice)
  {
    case 0:
    {
      snprintf(newPath, elcount(newPath), "%s.%s", oldPath, "textString");
      value.textString.stringLength = C2xGetTokenData(packetHandle, "SSM", newPath, elcount(value.textString.string), value.textString.string);
      result = CheckLastError("SSM", gkFuncRefGet, result);
    }
    break;
    case 1:
    {
      snprintf(newPath, elcount(newPath), "%s.%s", oldPath, "textGB2312");
      value.textGB2312.stringLength = C2xGetTokenData(packetHandle, "SSM", newPath, elcount(value.textGB2312.string), value.textGB2312.string);
      result = CheckLastError("SSM", gkFuncRefGet, result);
    }
    break;
  }
  return result;
}

int SetSSMDescriptionParams(LONG packetHandle, struct SSMDescription value, char oldPath[])
{
  char newPath[300];
  int result;

  result = 0;

  switch(value.choice)
  {
    case 0:
    {
      snprintf(newPath, elcount(newPath), "%s.%s", oldPath, "textString");
      C2xSetTokenData(packetHandle, "SSM", newPath, value.textString.stringLength, value.textString.string);
      result = CheckLastError("SSM", gkFuncRefGet, result);
    }
    break;
    case 1:
    {
      snprintf(newPath, elcount(newPath), "%s.%s", oldPath, "textGB2312");
      C2xSetTokenData(packetHandle, "SSM", newPath, value.textGB2312.stringLength, value.textGB2312.string);
      result = CheckLastError("SSM", gkFuncRefGet, result);
    }
    break;
  }
  return result;
}

int GetSSMRSITimeDetailsParams(LONG packetHandle, struct SSMRSITimeDetails value, char oldPath[])
{
  char newPath[300];
  int result;

  result = 0;

  snprintf(newPath, elcount(newPath), "%s.%s", oldPath, "startTime");
  value.startTime.isValidFlag = C2xIsTokenAvailable(packetHandle, "SSM", newPath);
  if(value.startTime.isValidFlag==1)
  {
    value.startTime.value = C2xGetTokenInt(packetHandle, "SSM", newPath);
    result = CheckLastError("SSM", gkFuncRefGet, result);
  }
  snprintf(newPath, elcount(newPath), "%s.%s", oldPath, "endTime");
  value.endTime.isValidFlag = C2xIsTokenAvailable(packetHandle, "SSM", newPath);
  if(value.endTime.isValidFlag==1)
  {
    value.endTime.value = C2xGetTokenInt(packetHandle, "SSM", newPath);
    result = CheckLastError("SSM", gkFuncRefGet, result);
  }
  snprintf(newPath, elcount(newPath), "%s.%s", oldPath, "endTimeConfidence");
  value.endTimeConfidence.isValidFlag = C2xIsTokenAvailable(packetHandle, "SSM", newPath);
  if(value.endTimeConfidence.isValidFlag==1)
  {
    value.endTimeConfidence.value = C2xGetTokenInt(packetHandle, "SSM", newPath);
    result = CheckLastError("SSM", gkFuncRefGet, result);
  }
  return result;
}

int SetSSMRSITimeDetailsParams(LONG packetHandle, struct SSMRSITimeDetails value, char oldPath[])
{
  char newPath[300];
  int result;

  result = 0;

  snprintf(newPath, elcount(newPath), "%s.%s", oldPath, "startTime");
  if(value.startTime.isValidFlag==1)
  {
    C2xSetTokenInt(packetHandle, "SSM", newPath, value.startTime.value);
    result = CheckLastError("SSM", gkFuncRefGet, result);
  }
  else
  {
    if( C2xIsTokenAvailable(packetHandle, "SSM", newPath) )
    {
      C2xRemoveToken(packetHandle, "SSM", newPath);
    }
  }

  snprintf(newPath, elcount(newPath), "%s.%s", oldPath, "endTime");
  if(value.endTime.isValidFlag==1)
  {
    C2xSetTokenInt(packetHandle, "SSM", newPath, value.endTime.value);
    result = CheckLastError("SSM", gkFuncRefGet, result);
  }
  else
  {
    if( C2xIsTokenAvailable(packetHandle, "SSM", newPath) )
    {
      C2xRemoveToken(packetHandle, "SSM", newPath);
    }
  }

  snprintf(newPath, elcount(newPath), "%s.%s", oldPath, "endTimeConfidence");
  if(value.endTimeConfidence.isValidFlag==1)
  {
    C2xSetTokenInt(packetHandle, "SSM", newPath, value.endTimeConfidence.value);
    result = CheckLastError("SSM", gkFuncRefGet, result);
  }
  else
  {
    if( C2xIsTokenAvailable(packetHandle, "SSM", newPath) )
    {
      C2xRemoveToken(packetHandle, "SSM", newPath);
    }
  }

  return result;
}

int GetSSMPathPointListParams(LONG packetHandle, struct SSMPathPointList value, char oldPath[])
{
  char newPath[300]; 
  int i;
  int result;

  result = 0;

  value.length = C2xGetTokenInt(packetHandle, "SSM", oldPath);
  if((result = CheckLastError("SSM", gkFuncRefGet, result))==0)
  {
    for(i=0; i<value.length; i++)
    {
      snprintf(newPath, elcount(newPath), "%s[%d]", oldPath, i);
      GetSSMPositionOffsetLLVParams(packetHandle, value.arrayValue[i], newPath);
      result = CheckLastError("SSM", gkFuncRefGet, result);
    }
  }
  return result;
}

int SetSSMPathPointListParams(LONG packetHandle, struct SSMPathPointList value, char oldPath[])
{
  char newPath[300]; 
  int i;
  int result;

  result = 0;

  C2xRemoveToken(packetHandle, "SSM", oldPath);
  for(i=0; i<value.length; i++)
  {
    snprintf(newPath, elcount(newPath), "%s[%d]", oldPath, i);
    SetSSMPositionOffsetLLVParams(packetHandle, value.arrayValue[i], newPath);
    result = CheckLastError("SSM", gkFuncRefGet, result);
  }
  return result;
}

int GetSSMReferencePathParams(LONG packetHandle, struct SSMReferencePath value, char oldPath[])
{
  char newPath[300];
  int result;

  result = 0;

  snprintf(newPath, elcount(newPath), "%s.%s", oldPath, "activePath");
  GetSSMPathPointListParams(packetHandle, value.activePath, newPath);
  result = CheckLastError("SSM", gkFuncRefGet, result);

  snprintf(newPath, elcount(newPath), "%s.%s", oldPath, "pathRadius");
  value.pathRadius = C2xGetTokenInt(packetHandle, "SSM", newPath);
  result = CheckLastError("SSM", gkFuncRefGet, result);

  return result;
}

int SetSSMReferencePathParams(LONG packetHandle, struct SSMReferencePath value, char oldPath[])
{
  char newPath[300];
  int result;

  result = 0;

  snprintf(newPath, elcount(newPath), "%s.%s", oldPath, "activePath");
  SetSSMPathPointListParams(packetHandle, value.activePath, newPath);
  result = CheckLastError("SSM", gkFuncRefGet, result);

  snprintf(newPath, elcount(newPath), "%s.%s", oldPath, "pathRadius");
  C2xSetTokenInt(packetHandle, "SSM", newPath, value.pathRadius);
  result = CheckLastError("SSM", gkFuncRefGet, result);

  return result;
}

int GetSSMReferencePathListParams(LONG packetHandle, struct SSMReferencePathList value, char oldPath[])
{
  char newPath[300]; 
  int i;
  int result;

  result = 0;

  value.length = C2xGetTokenInt(packetHandle, "SSM", oldPath);
  if((result = CheckLastError("SSM", gkFuncRefGet, result))==0)
  {
    for(i=0; i<value.length; i++)
    {
      snprintf(newPath, elcount(newPath), "%s[%d]", oldPath, i);
      GetSSMReferencePathParams(packetHandle, value.arrayValue[i], newPath);
      result = CheckLastError("SSM", gkFuncRefGet, result);
    }
  }
  return result;
}

int SetSSMReferencePathListParams(LONG packetHandle, struct SSMReferencePathList value, char oldPath[])
{
  char newPath[300]; 
  int i;
  int result;

  result = 0;

  C2xRemoveToken(packetHandle, "SSM", oldPath);
  for(i=0; i<value.length; i++)
  {
    snprintf(newPath, elcount(newPath), "%s[%d]", oldPath, i);
    SetSSMReferencePathParams(packetHandle, value.arrayValue[i], newPath);
    result = CheckLastError("SSM", gkFuncRefGet, result);
  }
  return result;
}

int GetSSMReferenceLinkListParams(LONG packetHandle, struct SSMReferenceLinkList value, char oldPath[])
{
  char newPath[300]; 
  int i;
  int result;

  result = 0;

  value.length = C2xGetTokenInt(packetHandle, "SSM", oldPath);
  if((result = CheckLastError("SSM", gkFuncRefGet, result))==0)
  {
    for(i=0; i<value.length; i++)
    {
      snprintf(newPath, elcount(newPath), "%s[%d]", oldPath, i);
      GetSSMReferenceLinkParams(packetHandle, value.arrayValue[i], newPath);
      result = CheckLastError("SSM", gkFuncRefGet, result);
    }
  }
  return result;
}

int SetSSMReferenceLinkListParams(LONG packetHandle, struct SSMReferenceLinkList value, char oldPath[])
{
  char newPath[300]; 
  int i;
  int result;

  result = 0;

  C2xRemoveToken(packetHandle, "SSM", oldPath);
  for(i=0; i<value.length; i++)
  {
    snprintf(newPath, elcount(newPath), "%s[%d]", oldPath, i);
    SetSSMReferenceLinkParams(packetHandle, value.arrayValue[i], newPath);
    result = CheckLastError("SSM", gkFuncRefGet, result);
  }
  return result;
}

int GetSSMRTEDataParams(LONG packetHandle, struct SSMRTEData value, char oldPath[])
{
  char newPath[300];
  int result;

  result = 0;

  snprintf(newPath, elcount(newPath), "%s.%s", oldPath, "rteId");
  value.rteId = C2xGetTokenInt(packetHandle, "SSM", newPath);
  result = CheckLastError("SSM", gkFuncRefGet, result);

  snprintf(newPath, elcount(newPath), "%s.%s", oldPath, "eventType");
  value.eventType = C2xGetTokenInt(packetHandle, "SSM", newPath);
  result = CheckLastError("SSM", gkFuncRefGet, result);

  snprintf(newPath, elcount(newPath), "%s.%s", oldPath, "eventSource");
  value.eventSource = C2xGetTokenInt(packetHandle, "SSM", newPath);
  result = CheckLastError("SSM", gkFuncRefGet, result);

  snprintf(newPath, elcount(newPath), "%s.%s", oldPath, "eventPos");
  value.eventPos.isValidFlag = C2xIsTokenAvailable(packetHandle, "SSM", newPath);
  if(value.eventPos.isValidFlag==1)
  {
    GetSSMPositionOffsetLLVParams(packetHandle, value.eventPos, newPath);
    result = CheckLastError("SSM", gkFuncRefGet, result);
  }
  snprintf(newPath, elcount(newPath), "%s.%s", oldPath, "eventRadius");
  value.eventRadius.isValidFlag = C2xIsTokenAvailable(packetHandle, "SSM", newPath);
  if(value.eventRadius.isValidFlag==1)
  {
    value.eventRadius.value = C2xGetTokenInt(packetHandle, "SSM", newPath);
    result = CheckLastError("SSM", gkFuncRefGet, result);
  }
  snprintf(newPath, elcount(newPath), "%s.%s", oldPath, "description");
  value.description.isValidFlag = C2xIsTokenAvailable(packetHandle, "SSM", newPath);
  if(value.description.isValidFlag==1)
  {
    GetSSMDescriptionParams(packetHandle, value.description, newPath);
    result = CheckLastError("SSM", gkFuncRefGet, result);
  }
  snprintf(newPath, elcount(newPath), "%s.%s", oldPath, "timeDetails");
  value.timeDetails.isValidFlag = C2xIsTokenAvailable(packetHandle, "SSM", newPath);
  if(value.timeDetails.isValidFlag==1)
  {
    GetSSMRSITimeDetailsParams(packetHandle, value.timeDetails, newPath);
    result = CheckLastError("SSM", gkFuncRefGet, result);
  }
  snprintf(newPath, elcount(newPath), "%s.%s", oldPath, "priority");
  value.priority.isValidFlag = C2xIsTokenAvailable(packetHandle, "SSM", newPath);
  if(value.priority.isValidFlag==1)
  {
    value.priority.isValidFlag = 1;
    value.priority.stringLength = C2xGetTokenData(packetHandle, "SSM", newPath, elcount(value.priority.string), value.priority.string);
  }
  snprintf(newPath, elcount(newPath), "%s.%s", oldPath, "referencePaths");
  value.referencePaths.isValidFlag = C2xIsTokenAvailable(packetHandle, "SSM", newPath);
  if(value.referencePaths.isValidFlag==1)
  {
    GetSSMReferencePathListParams(packetHandle, value.referencePaths, newPath);
    result = CheckLastError("SSM", gkFuncRefGet, result);
  }
  snprintf(newPath, elcount(newPath), "%s.%s", oldPath, "referenceLinks");
  value.referenceLinks.isValidFlag = C2xIsTokenAvailable(packetHandle, "SSM", newPath);
  if(value.referenceLinks.isValidFlag==1)
  {
    GetSSMReferenceLinkListParams(packetHandle, value.referenceLinks, newPath);
    result = CheckLastError("SSM", gkFuncRefGet, result);
  }
  snprintf(newPath, elcount(newPath), "%s.%s", oldPath, "eventConfidence");
  value.eventConfidence.isValidFlag = C2xIsTokenAvailable(packetHandle, "SSM", newPath);
  if(value.eventConfidence.isValidFlag==1)
  {
    value.eventConfidence.value = C2xGetTokenInt(packetHandle, "SSM", newPath);
    result = CheckLastError("SSM", gkFuncRefGet, result);
  }
  return result;
}

int SetSSMRTEDataParams(LONG packetHandle, struct SSMRTEData value, char oldPath[])
{
  char newPath[300];
  int result;

  result = 0;

  snprintf(newPath, elcount(newPath), "%s.%s", oldPath, "rteId");
  C2xSetTokenInt(packetHandle, "SSM", newPath, value.rteId);
  result = CheckLastError("SSM", gkFuncRefGet, result);

  snprintf(newPath, elcount(newPath), "%s.%s", oldPath, "eventType");
  C2xSetTokenInt(packetHandle, "SSM", newPath, value.eventType);
  result = CheckLastError("SSM", gkFuncRefGet, result);

  snprintf(newPath, elcount(newPath), "%s.%s", oldPath, "eventSource");
  C2xSetTokenInt(packetHandle, "SSM", newPath, value.eventSource);
  result = CheckLastError("SSM", gkFuncRefGet, result);

  snprintf(newPath, elcount(newPath), "%s.%s", oldPath, "eventPos");
  if(value.eventPos.isValidFlag==1)
  {
    SetSSMPositionOffsetLLVParams(packetHandle, value.eventPos, newPath);
    result = CheckLastError("SSM", gkFuncRefGet, result);
  }
  else
  {
    if( C2xIsTokenAvailable(packetHandle, "SSM", newPath) )
    {
      C2xRemoveToken(packetHandle, "SSM", newPath);
    }
  }

  snprintf(newPath, elcount(newPath), "%s.%s", oldPath, "eventRadius");
  if(value.eventRadius.isValidFlag==1)
  {
    C2xSetTokenInt(packetHandle, "SSM", newPath, value.eventRadius.value);
    result = CheckLastError("SSM", gkFuncRefGet, result);
  }
  else
  {
    if( C2xIsTokenAvailable(packetHandle, "SSM", newPath) )
    {
      C2xRemoveToken(packetHandle, "SSM", newPath);
    }
  }

  snprintf(newPath, elcount(newPath), "%s.%s", oldPath, "description");
  if(value.description.isValidFlag==1)
  {
    SetSSMDescriptionParams(packetHandle, value.description, newPath);
    result = CheckLastError("SSM", gkFuncRefGet, result);
  }
  else
  {
    if( C2xIsTokenAvailable(packetHandle, "SSM", newPath) )
    {
      C2xRemoveToken(packetHandle, "SSM", newPath);
    }
  }

  snprintf(newPath, elcount(newPath), "%s.%s", oldPath, "timeDetails");
  if(value.timeDetails.isValidFlag==1)
  {
    SetSSMRSITimeDetailsParams(packetHandle, value.timeDetails, newPath);
    result = CheckLastError("SSM", gkFuncRefGet, result);
  }
  else
  {
    if( C2xIsTokenAvailable(packetHandle, "SSM", newPath) )
    {
      C2xRemoveToken(packetHandle, "SSM", newPath);
    }
  }

  snprintf(newPath, elcount(newPath), "%s.%s", oldPath, "priority");
  if(value.priority.isValidFlag==1)
  {
    C2xSetTokenData(packetHandle, "SSM", newPath, value.priority.stringLength, value.priority.string);
  }
  else
  {
    if( C2xIsTokenAvailable(packetHandle, "SSM", newPath) )
    {
      C2xRemoveToken(packetHandle, "SSM", newPath);
    }
  }

  snprintf(newPath, elcount(newPath), "%s.%s", oldPath, "referencePaths");
  if(value.referencePaths.isValidFlag==1)
  {
    SetSSMReferencePathListParams(packetHandle, value.referencePaths, newPath);
    result = CheckLastError("SSM", gkFuncRefGet, result);
  }
  else
  {
    if( C2xIsTokenAvailable(packetHandle, "SSM", newPath) )
    {
      C2xRemoveToken(packetHandle, "SSM", newPath);
    }
  }

  snprintf(newPath, elcount(newPath), "%s.%s", oldPath, "referenceLinks");
  if(value.referenceLinks.isValidFlag==1)
  {
    SetSSMReferenceLinkListParams(packetHandle, value.referenceLinks, newPath);
    result = CheckLastError("SSM", gkFuncRefGet, result);
  }
  else
  {
    if( C2xIsTokenAvailable(packetHandle, "SSM", newPath) )
    {
      C2xRemoveToken(packetHandle, "SSM", newPath);
    }
  }

  snprintf(newPath, elcount(newPath), "%s.%s", oldPath, "eventConfidence");
  if(value.eventConfidence.isValidFlag==1)
  {
    C2xSetTokenInt(packetHandle, "SSM", newPath, value.eventConfidence.value);
    result = CheckLastError("SSM", gkFuncRefGet, result);
  }
  else
  {
    if( C2xIsTokenAvailable(packetHandle, "SSM", newPath) )
    {
      C2xRemoveToken(packetHandle, "SSM", newPath);
    }
  }

  return result;
}

int GetSSMRTEListParams(LONG packetHandle, struct SSMRTEList value, char oldPath[])
{
  char newPath[300]; 
  int i;
  int result;

  result = 0;

  value.length = C2xGetTokenInt(packetHandle, "SSM", oldPath);
  if((result = CheckLastError("SSM", gkFuncRefGet, result))==0)
  {
    for(i=0; i<value.length; i++)
    {
      snprintf(newPath, elcount(newPath), "%s[%d]", oldPath, i);
      GetSSMRTEDataParams(packetHandle, value.arrayValue[i], newPath);
      result = CheckLastError("SSM", gkFuncRefGet, result);
    }
  }
  return result;
}

int SetSSMRTEListParams(LONG packetHandle, struct SSMRTEList value, char oldPath[])
{
  char newPath[300]; 
  int i;
  int result;

  result = 0;

  C2xRemoveToken(packetHandle, "SSM", oldPath);
  for(i=0; i<value.length; i++)
  {
    snprintf(newPath, elcount(newPath), "%s[%d]", oldPath, i);
    SetSSMRTEDataParams(packetHandle, value.arrayValue[i], newPath);
    result = CheckLastError("SSM", gkFuncRefGet, result);
  }
  return result;
}

int GetSSMSensorSharing_SensorSharingMsgParams(LONG packetHandle, struct SSMSensorSharing_SensorSharingMsg value, char oldPath[])
{
  char newPath[300];
  int result;

  result = 0;

  snprintf(newPath, elcount(newPath), "%s.%s", oldPath, "msgCnt");
  value.msgCnt = C2xGetTokenInt(packetHandle, "SSM", newPath);
  result = CheckLastError("SSM", gkFuncRefGet, result);

  snprintf(newPath, elcount(newPath), "%s.%s", oldPath, "id");
  value.id.stringLength = C2xGetTokenData(packetHandle, "SSM", newPath, elcount(value.id.string), value.id.string);
  snprintf(newPath, elcount(newPath), "%s.%s", oldPath, "equipmentType");
  value.equipmentType = C2xGetTokenInt(packetHandle, "SSM", newPath);
  result = CheckLastError("SSM", gkFuncRefGet, result);

  snprintf(newPath, elcount(newPath), "%s.%s", oldPath, "secMark");
  value.secMark = C2xGetTokenInt(packetHandle, "SSM", newPath);
  result = CheckLastError("SSM", gkFuncRefGet, result);

  snprintf(newPath, elcount(newPath), "%s.%s", oldPath, "sensorPos");
  GetSSMPosition3DParams(packetHandle, value.sensorPos, newPath);
  result = CheckLastError("SSM", gkFuncRefGet, result);

  snprintf(newPath, elcount(newPath), "%s.%s", oldPath, "detectedRegion");
  value.detectedRegion.isValidFlag = C2xIsTokenAvailable(packetHandle, "SSM", newPath);
  if(value.detectedRegion.isValidFlag==1)
  {
    GetSSMDetectedRegionParams(packetHandle, value.detectedRegion, newPath);
    result = CheckLastError("SSM", gkFuncRefGet, result);
  }
  snprintf(newPath, elcount(newPath), "%s.%s", oldPath, "participants");
  value.participants.isValidFlag = C2xIsTokenAvailable(packetHandle, "SSM", newPath);
  if(value.participants.isValidFlag==1)
  {
    GetSSMDetectedPTCListParams(packetHandle, value.participants, newPath);
    result = CheckLastError("SSM", gkFuncRefGet, result);
  }
  snprintf(newPath, elcount(newPath), "%s.%s", oldPath, "obstacles");
  value.obstacles.isValidFlag = C2xIsTokenAvailable(packetHandle, "SSM", newPath);
  if(value.obstacles.isValidFlag==1)
  {
    GetSSMDetectedObstacleListParams(packetHandle, value.obstacles, newPath);
    result = CheckLastError("SSM", gkFuncRefGet, result);
  }
  snprintf(newPath, elcount(newPath), "%s.%s", oldPath, "rtes");
  value.rtes.isValidFlag = C2xIsTokenAvailable(packetHandle, "SSM", newPath);
  if(value.rtes.isValidFlag==1)
  {
    GetSSMRTEListParams(packetHandle, value.rtes, newPath);
    result = CheckLastError("SSM", gkFuncRefGet, result);
  }
  return result;
}

int SetSSMSensorSharing_SensorSharingMsgParams(LONG packetHandle, struct SSMSensorSharing_SensorSharingMsg value, char oldPath[])
{
  char newPath[300];
  int result;

  result = 0;

  snprintf(newPath, elcount(newPath), "%s.%s", oldPath, "msgCnt");
  C2xSetTokenInt(packetHandle, "SSM", newPath, value.msgCnt);
  result = CheckLastError("SSM", gkFuncRefGet, result);

  if(value.id.stringLength == 0)
  {
    value.id.stringLength = 8;
    memcpy(value.id.string, "00000000", value.id.stringLength);
  }

  snprintf(newPath, elcount(newPath), "%s.%s", oldPath, "id");
  C2xSetTokenData(packetHandle, "SSM", newPath, value.id.stringLength, value.id.string);

  snprintf(newPath, elcount(newPath), "%s.%s", oldPath, "equipmentType");
  C2xSetTokenInt(packetHandle, "SSM", newPath, value.equipmentType);
  result = CheckLastError("SSM", gkFuncRefGet, result);

  snprintf(newPath, elcount(newPath), "%s.%s", oldPath, "secMark");
  C2xSetTokenInt(packetHandle, "SSM", newPath, value.secMark);
  result = CheckLastError("SSM", gkFuncRefGet, result);

  snprintf(newPath, elcount(newPath), "%s.%s", oldPath, "sensorPos");
  SetSSMPosition3DParams(packetHandle, value.sensorPos, newPath);
  result = CheckLastError("SSM", gkFuncRefGet, result);

  snprintf(newPath, elcount(newPath), "%s.%s", oldPath, "detectedRegion");
  if(value.detectedRegion.isValidFlag==1)
  {
    SetSSMDetectedRegionParams(packetHandle, value.detectedRegion, newPath);
    result = CheckLastError("SSM", gkFuncRefGet, result);
  }
  else
  {
    if( C2xIsTokenAvailable(packetHandle, "SSM", newPath) )
    {
      C2xRemoveToken(packetHandle, "SSM", newPath);
    }
  }

  snprintf(newPath, elcount(newPath), "%s.%s", oldPath, "participants");
  if(value.participants.isValidFlag==1)
  {
    SetSSMDetectedPTCListParams(packetHandle, value.participants, newPath);
    result = CheckLastError("SSM", gkFuncRefGet, result);
  }
  else
  {
    if( C2xIsTokenAvailable(packetHandle, "SSM", newPath) )
    {
      C2xRemoveToken(packetHandle, "SSM", newPath);
    }
  }

  snprintf(newPath, elcount(newPath), "%s.%s", oldPath, "obstacles");
  if(value.obstacles.isValidFlag==1)
  {
    SetSSMDetectedObstacleListParams(packetHandle, value.obstacles, newPath);
    result = CheckLastError("SSM", gkFuncRefGet, result);
  }
  else
  {
    if( C2xIsTokenAvailable(packetHandle, "SSM", newPath) )
    {
      C2xRemoveToken(packetHandle, "SSM", newPath);
    }
  }

  snprintf(newPath, elcount(newPath), "%s.%s", oldPath, "rtes");
  if(value.rtes.isValidFlag==1)
  {
    SetSSMRTEListParams(packetHandle, value.rtes, newPath);
    result = CheckLastError("SSM", gkFuncRefGet, result);
  }
  else
  {
    if( C2xIsTokenAvailable(packetHandle, "SSM", newPath) )
    {
      C2xRemoveToken(packetHandle, "SSM", newPath);
    }
  }

  return result;
}

int GetSSMMessageTypesParams(LONG packetHandle, WORD tableKey, struct SSMMessageTypes value, char oldPath[])
{
  char newPath[300];
  int result;

  result = 0;

  switch(tableKey)
  {
    case 12:
    {
      snprintf(newPath, elcount(newPath), "%s.%s", oldPath, "ssmData");
      GetSSMSensorSharing_SensorSharingMsgParams(packetHandle, value.ssmData, newPath);
      result = CheckLastError("SSM", gkFuncRefGet, result);
    }
    break;
  }
  return result;
}

int SetSSMMessageTypesParams(LONG packetHandle, WORD tableKey, struct SSMMessageTypes value, char oldPath[])
{
  char newPath[300];
  int result;

  result = 0;

  switch(tableKey)
  {
    case 12:
    {
      snprintf(newPath, elcount(newPath), "%s.%s", oldPath, "ssmData");
      SetSSMSensorSharing_SensorSharingMsgParams(packetHandle, value.ssmData, newPath);
      result = CheckLastError("SSM", gkFuncRefGet, result);
    }
    break;
  }
  return result;
}

int GetSSMMessageFrameExtParams(LONG packetHandle, struct SSMMessageFrameExt value, char oldPath[])
{
  char newPath[300];
  int result;

  result = 0;

  snprintf(newPath, elcount(newPath), "%s.%s", oldPath, "messageId");
  value.messageId = C2xGetTokenInt(packetHandle, "SSM", newPath);
  result = CheckLastError("SSM", gkFuncRefGet, result);

  snprintf(newPath, elcount(newPath), "%s.%s", oldPath, "value");
  GetSSMMessageTypesParams(packetHandle, value.messageId, value.value, newPath);
  result = CheckLastError("SSM", gkFuncRefGet, result);

  return result;
}

int SetSSMMessageFrameExtParams(LONG packetHandle, struct SSMMessageFrameExt value, char oldPath[])
{
  char newPath[300];
  int result;

  result = 0;


  snprintf(newPath, elcount(newPath), "%s.%s", oldPath, "value");
  SetSSMMessageTypesParams(packetHandle, value.messageId, value.value, newPath);
  result = CheckLastError("SSM", gkFuncRefGet, result);

  return result;
}

int API_GetSSMParams(LONG packetHandle, struct SSM value)
{
  int result;
  result = 0;

  value.msgFrameExt.isValidFlag = 1;
  GetSSMMessageFrameExtParams(packetHandle, value.msgFrameExt, "msgFrameExt");
  result = CheckLastError("SSM", gkFuncRefGet, result);

  return result;
}

int API_SetSSMParams(LONG packetHandle, struct SSM value)
{
  int result;
  result = 0;

  SetSSMMessageFrameExtParams(packetHandle, value.msgFrameExt, "msgFrameExt");
  result = CheckLastError("SSM", gkFuncRefGet, result);

  return result;
}

