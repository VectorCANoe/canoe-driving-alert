/*@!Encoding:1252*/
///////////////////////////////////////////////////////////////////
// RSU.can CAPL node defines the C-V2X communication behavior of
// "RSU" road side unit in addition to the behavior defined in the
// scenario file for station "RSU" .
///////////////////////////////////////////////////////////////////
includes
{
  #include "..\DataSources_Templates\ASNV_Template_BaseDatatypes.cin"
  #include "..\DataSources_Templates\ASNV_Template_RoadSideInformation.cin"
}

variables
{
  // Traffic signs according to China GB5768
  enum KnownRSIAlertTypes 
  {
	 SharpTurn = 2,
	 Rockfall = 15,
	 SlippyRoad = 17,
	 Tunnel = 21,
	 Danger = 37,
	 UnderConstruction = 38
  };
  
  // Contains the value of rsiFrame.msgCnt token for the next
  // RoadSideInformation transmit
  byte rsiMsgCount = 0;
  
  // Map API definitions and handles for RSU and pedestrian P position visualisation
  enum MapObjectTypes
  {
    Square = 1,
    Rectangle = 2,
    Ellipse = 3,
    Cross = 4,
    Triangle = 5,
    Line = 6,
    Bitmap = 7,
    Text = 8
  };
  
  long hEventRadiusCircle = 0;
  long hEventPosCross = 0;
  long hEventPosText = 0;
  long hRSUPosCross = 0;
  long hRSUPosText = 0;
  
  long RSUEventType = 38; //Under Construction
  long EventRadius = 100; //Radius 100m
}

on start
{
  enum CallbackType{OnRx, PreTx};
  // Register callback function "OnPreTxRoadSideInformation" 
  C2xRegisterCallback(PreTx, "OnPreTxRoadSideInformation", "RoadSideInformation");
  
  // Create Map API visualisation objects
  hEventRadiusCircle = CreateMapObject(Ellipse);
  SetMapObjectLineColor(hEventRadiusCircle, makeRGB(0xFF,0,0));
  hEventPosCross = CreateMapObject(Cross);
  SetMapObjectLineColor(hEventPosCross, makeRGB(0xFF,0,0));
  SetMapObjectPenWidth(hEventPosCross, 2);
  SetMapObjectSize(hEventPosCross, 10);
  hEventPosText = CreateMapObject(Text);
  hRSUPosCross = CreateMapObject(Cross);
  SetMapObjectLineColor(hRSUPosCross, makeRGB(0xFF,0,0));
  SetMapObjectPenWidth(hRSUPosCross, 2);
  SetMapObjectSize(hRSUPosCross, 10);
  hRSUPosText = CreateMapObject(Text);
  SetMapObjectText(hRSUPosText, "RSU");
}

// Called each time before sending the RoadSideInformation
long OnPreTxRoadSideInformation(long packet)
{
  struct RoadSideInformation rsi;
  double eventPosLat, eventPosLon, eventPosElev;
  
  // Get all RoadSideInformation data (was set by scenario) into temporary "rsi" variable
  API_GetRoadSideInformationParams(packet, rsi);

  rsi.rsiFrame.msgCnt = rsiMsgCount++;
  rsiMsgCount = rsiMsgCount%128;

  // Get RSU position from the scenario and apply it to this RoadSideInformation frame
  rsi.rsiFrame.refPos.lat = C2xGetStationAttributeDouble("Latitude") * 1e7;
  rsi.rsiFrame.refPos.lon = C2xGetStationAttributeDouble("Longitude") * 1e7;
  rsi.rsiFrame.refPos.elevation.isValidFlag = 1;
  rsi.rsiFrame.refPos.elevation.value = C2xGetStationAttributeDouble("Elevation") * 10;

  // Get RSI event position from the scenario and apply it to this RoadSideInformation frame
  eventPosLat = C2xGetStationAttributeDouble("RSIEvent", "Latitude");
  eventPosLon = C2xGetStationAttributeDouble("RSIEvent", "Longitude");
  eventPosElev = C2xGetStationAttributeDouble("RSIEvent", "Elevation");
  rsi.rsiFrame.rtes.isValidFlag = 1;
  rsi.rsiFrame.rtes.length = 1;
  rsi.rsiFrame.rtes.arrayValue[0].eventType = RSUEventType; // get event type from panel/sysvar
  rsi.rsiFrame.rtes.arrayValue[0].eventPos.isValidFlag = 1;
  rsi.rsiFrame.rtes.arrayValue[0].eventPos.offsetLL.choice = 6;
  rsi.rsiFrame.rtes.arrayValue[0].eventPos.offsetLL.position_LatLon.lat = eventPosLat * 1e7;
  rsi.rsiFrame.rtes.arrayValue[0].eventPos.offsetLL.position_LatLon.lon = eventPosLon * 1e7;
  rsi.rsiFrame.rtes.arrayValue[0].eventPos.offsetV.isValidFlag = 1;
  rsi.rsiFrame.rtes.arrayValue[0].eventPos.offsetV.choice = 6;
  rsi.rsiFrame.rtes.arrayValue[0].eventPos.offsetV.elevation = (C2xGetStationAttributeDouble("Elevation") - eventPosElev) * 10;
  rsi.rsiFrame.rtes.arrayValue[0].eventRadius.isValidFlag = 1;
  rsi.rsiFrame.rtes.arrayValue[0].eventRadius.value = EventRadius*10; // get event radius from panel/sysvar
  
  // Apply all changes to the packet
  API_SetRoadSideInformationParams(packet, rsi);
 
  // Draw RSU position and RoadSideInformation event data on the map
  DrawRSUAndEvent(eventPosLat, eventPosLon);

  return 1; // Allow sending this RoadSideInformation frame
}

// Draw RSU position and RoadSideInformation event data on the map
void DrawRSUAndEvent(double eventPosLat, double eventPosLon)
{
  double rsuPosLat, rsuPosLon;
  char eventText[2000];

  // RSU position from the scenario
  rsuPosLat = C2xGetStationAttributeDouble("Latitude");
  rsuPosLon = C2xGetStationAttributeDouble("Longitude");
  
  // Visualize RSI event data
  SetMapObjectPosition(hEventRadiusCircle, eventPosLat, eventPosLon);
  SetMapObjectSize(hEventRadiusCircle, EventRadius*2.0, EventRadius*2.0);
  
  SetMapObjectPosition(hEventPosCross, eventPosLat, eventPosLon);
  SetMapObjectPosition(hEventPosText, eventPosLat+0.0001, eventPosLon+0.0002);
  snprintf(eventText, elcount(eventText),"RSI Event Type: %d", RSUEventType);
  SetMapObjectText(hEventPosText, eventText);
  
  SetMapObjectPosition(hRSUPosCross, rsuPosLat, rsuPosLon);
  SetMapObjectPosition(hRSUPosText, rsuPosLat, rsuPosLon+0.00015);
  
  DrawMapObject(hEventRadiusCircle);
  DrawMapObject(hEventPosCross);
  DrawMapObject(hEventPosText);

  DrawMapObject(hRSUPosCross);
  DrawMapObject(hRSUPosText);
}
