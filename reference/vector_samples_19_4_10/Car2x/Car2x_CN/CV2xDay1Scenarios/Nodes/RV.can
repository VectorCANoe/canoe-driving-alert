/*@!Encoding:1252*/
includes
{
  #include "..\DataSources_Templates\ASNV_Template_BaseDatatypes.cin"
  #include "..\DataSources_Templates\ASNV_Template_BasicSafetyMessage.cin"
}

variables
{ 
  /*
    Default name of reference point in scenario files (should be the same in all files).
  */
  char refPoint[50] = "RefPoint";
  /*
    Desired offset to reference point (i.e. offset of the ego vehicle to reference point when this station crosses the reference point).
    Can be set to positive or negative value. An offset of 0 means stations collide at reference point.
  */

  msTimer calculationTimer;
}

on start
{
  setTimerCyclic(calculationTimer,  100);
}


/*
  On Timer (here: 1 second), the speed of the Station is adjusted to the current speed of the ego vehicle.
  This ensures that the Station and the ego vehicle will reach the specified reference point at the same time or with an defined offset
*/
 on timer calculationTimer
{
  double speed, latitude, longitude;
  
  if (C2xIsScenarioStarted())
  {
    //BLW/LCW (a)
    if(@ScenarioCtrl::ScenarioNumber == 2)
    {
      C2xAdjustStationSpeedForCollision("RV", refPoint, @GNSS::Ath1.Latitude, @GNSS::Ath1.Longitude, @GNSS::Ath1.Speed, 0);
    }
    
    //BLW/LCW (b)
    if(@ScenarioCtrl::ScenarioNumber == 3)
    {
      C2xAdjustStationSpeedForCollision("RV", refPoint, @GNSS::Ath1.Latitude, @GNSS::Ath1.Longitude, @GNSS::Ath1.Speed, 0);
      
    }
    
    //DNPW
    if(@ScenarioCtrl::ScenarioNumber == 6)
    {
      C2xAdjustStationSpeedForCollision("RV", refPoint, @GNSS::Ath1.Latitude, @GNSS::Ath1.Longitude, @GNSS::Ath1.Speed, 20);
      C2xAdjustStationSpeedForCollision("RV2", refPoint, @GNSS::Ath1.Latitude, @GNSS::Ath1.Longitude, @GNSS::Ath1.Speed, 0);
    }
    
    //FCW (d)
    if (@ScenarioCtrl::ScenarioNumber == 13)
    {
      C2xAdjustStationSpeedForCollision("RV2", refPoint, @GNSS::Ath1.Latitude, @GNSS::Ath1.Longitude, @GNSS::Ath1.Speed, 60);
    }
    
    //ICW (b)
    if (@ScenarioCtrl::ScenarioNumber == 17)
    {
      C2xAdjustStationSpeedForCollision("RV", refPoint, @GNSS::Ath1.Latitude, @GNSS::Ath1.Longitude, @GNSS::Ath1.Speed, 0);
    }
    
    //LTA
    if (@ScenarioCtrl::ScenarioNumber == 19)
    {
      C2xAdjustStationSpeedForCollision("RV", refPoint, @GNSS::Ath1.Latitude, @GNSS::Ath1.Longitude, @GNSS::Ath1.Speed, 0);
    }
    
    //VRUCW (a)
    if (@ScenarioCtrl::ScenarioNumber == 23)
    {
      C2xAdjustStationSpeedForCollision("RV", refPoint, @GNSS::Ath1.Latitude, @GNSS::Ath1.Longitude, @GNSS::Ath1.Speed, 30);
    }
    
    //VRUCW (c)
    if (@ScenarioCtrl::ScenarioNumber == 25)
    {
      C2xAdjustStationSpeedForCollision("P", refPoint, @GNSS::Ath1.Latitude, @GNSS::Ath1.Longitude, @GNSS::Ath1.Speed, 0);
    }
  }
}
 
