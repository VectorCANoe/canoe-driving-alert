/*@!Encoding:1252*/
////////////////////////////////////////////////////////////////
// HV.can CAPL node defines the C-V2X communication behavior of
// "HV" vehicle in addition to the behavior defined in the
// scenario file for station "HV".
////////////////////////////////////////////////////////////////

includes
{
  #include "..\DataSources_Templates\ASNV_Template_BaseDatatypes.cin"
  #include "..\DataSources_Templates\ASNV_Template_BasicSafetyMessage.cin"
}

variables
{
  // Contains the value of bsmFrame.msgCnt token for the next
  // BasicSafetyMessage transmit
  byte bsmMsgCount = 0;
}

// Called before the measurement starts
on start
{
  enum CallbackType{OnRx, PreTx};
  // Register callback function "OnPreTxBasicSafetyMessage" 
  C2xRegisterCallback(PreTx, "OnPreTxBasicSafetyMessage", "BasicSafetyMessage");
}

// Called each time before sending the BasicSafetyMessage
void OnPreTxBasicSafetyMessage(long packet)
{

}

