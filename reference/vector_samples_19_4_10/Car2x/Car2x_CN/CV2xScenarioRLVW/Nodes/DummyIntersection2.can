/*@!Encoding:65001*/
includes
{
  #include "..\DataSources_Templates\ASNV_Template_BaseDatatypes.cin"
  #include "..\DataSources_Templates\ASNV_Template_MAPData.cin"
  #include "Intersection.cin"
}

// Called before the CANoe measurement starts
on start
{
  enum CallbackType{OnRx, PreTx};
  // Register MapData ans SPAT callback functions
  C2xRegisterCallback(PreTx, "OnPreTxMapData", "MapData");
}

// Called each time before sending the MapData frame
long OnPreTxMapData(long packet)
{
  if(C2xIsScenarioStarted())
  {
    struct MAPData map;
    double latIC, lonIC; // Intersection reference point location
    
    
    // Intersection reference point
    latIC = 31.2151852; 
    lonIC = 121.4206538; 
     
    // Get all MapData frame data into temporary "map" variable
    API_GetMapDataParams(packet, map);
    
    // Define intersection identity and geometry
    CreateMapData(map, latIC, lonIC, 102, 1, "DummyIntersection 102");
    
    // Apply all changes to the packet
    API_SetMapDataParams(packet, map);
    return 1; // Allow sending this frame
  }
  else
  {
    return 0;
  }
}

// Define intersection identity and geometry
void CreateMapData(struct MAPData map, double latIC, double lonIC, int intersectionId, int intersectionRegion, char name[])
{
  struct MapDataLane lane1;

  map.mapFrame.nodes.isValidFlag = 1;
  map.mapFrame.nodes.length = 1;
  map.mapFrame.nodes.arrayValue[0].refPos.lat = latIC*1e7;
  map.mapFrame.nodes.arrayValue[0].refPos.lon = lonIC*1e7;
  map.mapFrame.nodes.arrayValue[0].id.id = intersectionId;
  map.mapFrame.nodes.arrayValue[0].id.region.isValidFlag = 1;
  map.mapFrame.nodes.arrayValue[0].id.region.value = intersectionRegion;

  map.mapFrame.nodes.arrayValue[0].name.isValidFlag = 1;
  map.mapFrame.nodes.arrayValue[0].name.stringLength = strlen(name)+1;
  strncpy(map.mapFrame.nodes.arrayValue[0].name.string,name,strlen(name)+1);
  
  // Create lane geometry by specifying the offsets from the intersection reference location
  CreateLane(lane1, 1); 
  LaneAddNodeAsLL1(lane1.points, -50, -250);
  AddLaneNodeAsLL3(lane1.points, -1250, -10000); 
  AddLaneNodeAsLL3(lane1.points, -2700, -21300);
  
  // Copy lanes data into the "map" temporary variable
  map.mapFrame.nodes.arrayValue[0].inLinks.isValidFlag = 1;
  map.mapFrame.nodes.arrayValue[0].inLinks.length = 1;
  map.mapFrame.nodes.arrayValue[0].inLinks.arrayValue[0].upstreamNodeId.isValidFlag =1;
  map.mapFrame.nodes.arrayValue[0].inLinks.arrayValue[0].upstreamNodeId.id = 1;
  map.mapFrame.nodes.arrayValue[0].inLinks.arrayValue[0].lanes.isValidFlag = 1;
  map.mapFrame.nodes.arrayValue[0].inLinks.arrayValue[0].lanes.length = 1;
  memcpy(map.mapFrame.nodes.arrayValue[0].inLinks.arrayValue[0].lanes.arrayValue[0], lane1);
}