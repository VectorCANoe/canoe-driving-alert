/*@!Encoding:1252*/
///////////////////////////////////////////////////////////////////
// RSU.can CAPL node defines the C-V2X communication behavior of
// "RSU" road side unit in addition to the behavior defined in the
// scenario file for station "RSU" .
///////////////////////////////////////////////////////////////////
includes
{
  #include "..\DataSources_Templates\ASNV_Template_BaseDatatypes.cin"
  #include "..\DataSources_Templates\ASNV_Template_MAPData.cin"
  #include "..\DataSources_Templates\ASNV_Template_SPAT.cin"
  #include "ScenarioCtrl.cin"
  #include "Intersection.cin"
}

variables
{
}

// Called before the CANoe measurement starts
on start
{
  enum CallbackType{OnRx, PreTx};
  // Register MapData ans SPAT callback functions
  C2xRegisterCallback(PreTx, "OnPreTxMapData", "MapData");
  C2xRegisterCallback(PreTx, "OnPreTxSPAT", "SPAT");
}


// Called each time before sending the MapData frame
long OnPreTxMapData(long packet)
{
  struct MAPData map;
  double latRSU, lonRSU; // RSU location
  double latIC, lonIC; // Intersection reference point location
  
  // The RSU location in the scenario
  latRSU = C2xGetStationAttributeDouble("Latitude");
  lonRSU = C2xGetStationAttributeDouble("Longitude");
  
  // Intersection reference point is set equal to RSU location
  latIC = latRSU;
  lonIC = lonRSU;
   
  // Get all MapData frame data into temporary "map" variable
  API_GetMapDataParams(packet, map);
  
  // Define intersection identity and geometry
  CreateMapData(map, latIC, lonIC, 1, 1, "IntersectionRLVW");
  
  // Apply all changes to the packet
  API_SetMapDataParams(packet, map);
  return 1; // Allow sending this frame
}

// Called each time before sending the SPAT frame
long OnPreTxSPAT(long packet)
{
  struct SPAT spat;
  
  // Get all SPAT frame data into temporary "spat" variable
  API_GetSPATParams(packet, spat);
  
  // Define actual traffic light phases and traffic light state
  CreateSPAT(spat, 1, 1, 20, TrafficLightRed);
  
  // Apply all changes to the packet
  API_SetSPATParams(packet, spat);
  return 1; // Allow sending this frame
}

// Define actual traffic light phases and traffic light state
void CreateSPAT(struct SPAT spat, long intersectionId, long intersectionRegion, long phaseId, long lightState)
{
  spat.spatFrame.intersections.length = 1;
  spat.spatFrame.intersections.arrayValue[0].intersectionId.isValidFlag = 1;
  spat.spatFrame.intersections.arrayValue[0].intersectionId.id = intersectionId;
  spat.spatFrame.intersections.arrayValue[0].intersectionId.region.isValidFlag = 1;
  spat.spatFrame.intersections.arrayValue[0].intersectionId.region.value = intersectionRegion;

  // Create one intersection phase with given id
  spat.spatFrame.intersections.arrayValue[0].phases.length = 3;
  spat.spatFrame.intersections.arrayValue[0].phases.arrayValue[0].phaseStates.length = 1;
  spat.spatFrame.intersections.arrayValue[0].phases.arrayValue[0].phaseStates.arrayValue[0].light = lightState;
  spat.spatFrame.intersections.arrayValue[0].phases.arrayValue[0].id = phaseId;
  
  // Create second ans third intersection phase which will always be red for the demo

  spat.spatFrame.intersections.arrayValue[0].phases.arrayValue[1].phaseStates.length = 1;
  spat.spatFrame.intersections.arrayValue[0].phases.arrayValue[1].phaseStates.arrayValue[0].light = TrafficLightRed;
  spat.spatFrame.intersections.arrayValue[0].phases.arrayValue[1].id = 10;

  spat.spatFrame.intersections.arrayValue[0].phases.arrayValue[2].phaseStates.length = 1;
  spat.spatFrame.intersections.arrayValue[0].phases.arrayValue[2].phaseStates.arrayValue[0].light = TrafficLightRed;
  spat.spatFrame.intersections.arrayValue[0].phases.arrayValue[2].id = 30;
}

// Define intersection identity and geometry
void CreateMapData(struct MAPData map, double latIC, double lonIC, int intersectionId, int intersectionRegion, char name[])
{
  struct MapDataLane lane1, lane2, lane3;

  map.mapFrame.nodes.isValidFlag = 1;
  map.mapFrame.nodes.length = 1;
  map.mapFrame.nodes.arrayValue[0].refPos.lat = latIC*1e7;
  map.mapFrame.nodes.arrayValue[0].refPos.lon = lonIC*1e7;
  map.mapFrame.nodes.arrayValue[0].id.id = intersectionId;
  map.mapFrame.nodes.arrayValue[0].id.region.isValidFlag = 1;
  map.mapFrame.nodes.arrayValue[0].id.region.value = intersectionRegion;

  map.mapFrame.nodes.arrayValue[0].name.isValidFlag = 1;
  map.mapFrame.nodes.arrayValue[0].name.stringLength = strlen(name)+1;
  strncpy(map.mapFrame.nodes.arrayValue[0].name.string,name,strlen(name)+1);
  
  // Create lane geometry by specifying the offsets from the intersection reference location
  CreateLane(lane1, 1); 
  AddLaneNodeAsLL2(lane1.points, 8000, -1600); 
  AddLaneNodeAsLL3(lane1.points, 4000, -800); 
  LaneAddNodeAsLL1(lane1.points, 450, 0); // point offsets are specified in 1/10 micro degree of latitude/longitude

  CreateLane(lane2, 2);
  AddLaneNodeAsLL3(lane2.points, -680, -4000); 
  AddLaneNodeAsLL2(lane2.points, -420, -2000); 
  LaneAddNodeAsLL1(lane2.points, -220, -500); 

  CreateLane(lane3, 3);
  AddLaneNodeAsLL3(lane3.points, 610, 4000);
  AddLaneNodeAsLL2(lane3.points, 370, 2000); 
  LaneAddNodeAsLL1(lane3.points, 240, 450); 
  
  lane1.connectsTo.isValidFlag = 1;
  lane1.connectsTo.length=3;
  lane1.connectsTo.arrayValue[0].isValidFlag = 1;
  lane1.connectsTo.arrayValue[0].remoteIntersection.isValidFlag =1;
  lane1.connectsTo.arrayValue[0].remoteIntersection.id = 101;
  lane1.connectsTo.arrayValue[0].phaseId.isValidFlag = 1;
  lane1.connectsTo.arrayValue[0].phaseId.value = 10;
  lane1.connectsTo.arrayValue[0].connectingLane.isValidFlag = 1;
  lane1.connectsTo.arrayValue[0].connectingLane.lane = 1;
  
  lane1.connectsTo.arrayValue[1].remoteIntersection.isValidFlag =1;
  lane1.connectsTo.arrayValue[1].remoteIntersection.id = 102;
  lane1.connectsTo.arrayValue[1].phaseId.isValidFlag = 1;
  lane1.connectsTo.arrayValue[1].phaseId.value = 10;
  lane1.connectsTo.arrayValue[1].connectingLane.isValidFlag = 1;
  lane1.connectsTo.arrayValue[1].connectingLane.lane = 1;
  
  lane1.connectsTo.arrayValue[2].remoteIntersection.isValidFlag =1;
  lane1.connectsTo.arrayValue[2].remoteIntersection.id = 103;
  lane1.connectsTo.arrayValue[2].phaseId.isValidFlag = 1;
  lane1.connectsTo.arrayValue[2].phaseId.value = 10;
  lane1.connectsTo.arrayValue[2].connectingLane.isValidFlag = 1;
  lane1.connectsTo.arrayValue[2].connectingLane.lane = 1;
  
  lane2.connectsTo.isValidFlag = 1;
  lane2.connectsTo.length=2;
  lane2.connectsTo.arrayValue[0].isValidFlag = 1;
  lane2.connectsTo.arrayValue[0].remoteIntersection.isValidFlag =1;
  lane2.connectsTo.arrayValue[0].remoteIntersection.id = 102;
  lane2.connectsTo.arrayValue[0].phaseId.isValidFlag = 1;
  lane2.connectsTo.arrayValue[0].phaseId.value = 20;
  lane2.connectsTo.arrayValue[0].connectingLane.isValidFlag = 1;
  lane2.connectsTo.arrayValue[0].connectingLane.lane = 1;
	  
  lane2.connectsTo.arrayValue[1].remoteIntersection.isValidFlag =1;
  lane2.connectsTo.arrayValue[1].remoteIntersection.id = 103;
  lane2.connectsTo.arrayValue[1].phaseId.isValidFlag = 1;
  lane2.connectsTo.arrayValue[1].phaseId.value = 20;
  lane2.connectsTo.arrayValue[1].connectingLane.isValidFlag = 1;
  lane2.connectsTo.arrayValue[1].connectingLane.lane = 1;
  
  
  lane3.connectsTo.isValidFlag = 1;
  lane3.connectsTo.length=1;
  lane3.connectsTo.arrayValue[0].isValidFlag = 1;
  lane3.connectsTo.arrayValue[0].remoteIntersection.isValidFlag =1;
  lane3.connectsTo.arrayValue[0].remoteIntersection.id = 101;
  lane3.connectsTo.arrayValue[0].phaseId.isValidFlag = 1;
  lane3.connectsTo.arrayValue[0].phaseId.value = 30;
  lane3.connectsTo.arrayValue[0].connectingLane.isValidFlag = 1;
  lane3.connectsTo.arrayValue[0].connectingLane.lane = 1;

  
  // Copy lanes data into the "map" temporary variable
  // 3 inLinks with 1 lanes per inLink
  map.mapFrame.nodes.arrayValue[0].inLinks.isValidFlag = 1;
  map.mapFrame.nodes.arrayValue[0].inLinks.length = 3;
  map.mapFrame.nodes.arrayValue[0].inLinks.arrayValue[0].upstreamNodeId.isValidFlag =1;
  map.mapFrame.nodes.arrayValue[0].inLinks.arrayValue[0].upstreamNodeId.id = 104;
  map.mapFrame.nodes.arrayValue[0].inLinks.arrayValue[0].lanes.isValidFlag = 1;
  map.mapFrame.nodes.arrayValue[0].inLinks.arrayValue[0].lanes.length = 1;
  map.mapFrame.nodes.arrayValue[0].inLinks.arrayValue[1].upstreamNodeId.isValidFlag =1;
  map.mapFrame.nodes.arrayValue[0].inLinks.arrayValue[1].upstreamNodeId.id = 101;
  map.mapFrame.nodes.arrayValue[0].inLinks.arrayValue[1].lanes.isValidFlag = 1;
  map.mapFrame.nodes.arrayValue[0].inLinks.arrayValue[1].lanes.length = 1;
  map.mapFrame.nodes.arrayValue[0].inLinks.arrayValue[2].upstreamNodeId.isValidFlag =1;
  map.mapFrame.nodes.arrayValue[0].inLinks.arrayValue[2].upstreamNodeId.id = 102;
  map.mapFrame.nodes.arrayValue[0].inLinks.arrayValue[2].lanes.isValidFlag = 1;
  map.mapFrame.nodes.arrayValue[0].inLinks.arrayValue[2].lanes.length = 1;
  memcpy(map.mapFrame.nodes.arrayValue[0].inLinks.arrayValue[0].lanes.arrayValue[0], lane1);
  memcpy(map.mapFrame.nodes.arrayValue[0].inLinks.arrayValue[1].lanes.arrayValue[0], lane2);
  memcpy(map.mapFrame.nodes.arrayValue[0].inLinks.arrayValue[2].lanes.arrayValue[0], lane3);
}



