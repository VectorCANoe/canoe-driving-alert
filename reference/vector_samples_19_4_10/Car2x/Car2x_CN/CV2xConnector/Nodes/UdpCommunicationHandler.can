/*@!Encoding:1252*/

includes
{
  // Library for UDP Communication, contains API Functions for convenient use
  #include "UdpCommunicationLib.cin"
}

// Section for global variables
variables
{
  
}

on preStart
{ 
  // Register this node as "receiver". If multiple nodes are available in the Simulation Setup, set this flag only once as 
  // otherwise every node will dispatch packets which leads to multiplied messages in the trace window
  isUdpCommHdlNode = 1;
}

on start
{ 
  // The values from the Panel "UDP Connection Settings" are used to open an UDP Communication
  API_OpenUDPCommunication();
}

on preStop
{
  // Close the UDP Communication
  API_CloseUDPCommunication();
}