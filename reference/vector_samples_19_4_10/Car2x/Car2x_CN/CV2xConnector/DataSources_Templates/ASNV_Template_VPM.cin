/*@!Encoding:1252*/
/*
//  (c) Vector Informatik GmbH. All rights reserved.
//
//  This file contains definitions of structs and methods that may be used
//  to set and get the values of an ASN.1 defined packet's payload.
//
//  //This example demonstrates how to set a packet's payload:
//  LONG packetHandle;
//  struct VPM payload;
//  //you need to set the values of the variable "payload" yourself
//  packetHandle = API_InitVPMPacket();
//  if (packetHandle!=0) {
//    if (API_SetVPMParams(packetHandle, payload)==0) {
//      if (C2xCompletePacket(packetHandle)==0) {
//        C2xOutputPacket(packetHandle);
//      }
//    }
//  }
//                                                                             */
includes
{
}
variables
{
    struct VPMDDateTime {
        INT isValidFlag;   // necessary if this struct is used as an optional field of a SEQUENCE
        struct OPT_WORD_ASN year;  // INTEGER, OPTIONAL, 0..4095;
        struct OPT_BYTE_ASN month;  // INTEGER, OPTIONAL, 0..12;
        struct OPT_BYTE_ASN day;  // INTEGER, OPTIONAL, 0..31;
        struct OPT_BYTE_ASN hour;  // INTEGER, OPTIONAL, 0..24;
        struct OPT_BYTE_ASN minute;  // INTEGER, OPTIONAL, 0..60;
        struct OPT_WORD_ASN second;  // INTEGER, OPTIONAL, 0..65535;
        struct OPT_INT_ASN offset;  // INTEGER, OPTIONAL, -720..721;
    };
    
    struct VPMRST_id {
        INT isValidFlag;   // necessary if this struct is used as an optional field of a SEQUENCE
        CHAR string[9];
        INT  stringLength;
    };
    
    struct VPMPosition3D {
        INT isValidFlag;   // necessary if this struct is used as an optional field of a SEQUENCE
        LONG lat;  // INTEGER, -900000000..900000001;
        LONG lon;  // INTEGER, -1799999999..1800000001;
        struct OPT_LONG_ASN elevation;  // INTEGER, OPTIONAL, -4096..61439;
    };
    
    struct VPMTollingNodeInfo {
        INT isValidFlag;   // necessary if this struct is used as an optional field of a SEQUENCE
        struct OPT_DWORD_ASN id;  // INTEGER, OPTIONAL, 0..4294967295;
        struct VPMPosition3D pos;  // SEQUENCE, OPTIONAL;
        struct OPT_ENUM_ASN tollingNodeType;  // ENUMERATED, OPTIONAL, entranceStation(0), exitStation(1), entranceAndExitStation(2), gantry(3);
        struct OPT_ENUM_ASN tollingDirection;  // ENUMERATED, OPTIONAL, north(0), northeast(1), east(2), southeast(3), south(4), southwest(5), west(6), northwest(7);
    };
    
    struct VPMPosition_LL_24B {
        INT isValidFlag;   // necessary if this struct is used as an optional field of a SEQUENCE
        INT lon;  // INTEGER, -2048..2047;
        INT lat;  // INTEGER, -2048..2047;
    };
    
    struct VPMPosition_LL_28B {
        INT isValidFlag;   // necessary if this struct is used as an optional field of a SEQUENCE
        INT lon;  // INTEGER, -8192..8191;
        INT lat;  // INTEGER, -8192..8191;
    };
    
    struct VPMPosition_LL_32B {
        INT isValidFlag;   // necessary if this struct is used as an optional field of a SEQUENCE
        INT lon;  // INTEGER, -32768..32767;
        INT lat;  // INTEGER, -32768..32767;
    };
    
    struct VPMPosition_LL_36B {
        INT isValidFlag;   // necessary if this struct is used as an optional field of a SEQUENCE
        LONG lon;  // INTEGER, -131072..131071;
        LONG lat;  // INTEGER, -131072..131071;
    };
    
    struct VPMPosition_LL_44B {
        INT isValidFlag;   // necessary if this struct is used as an optional field of a SEQUENCE
        LONG lon;  // INTEGER, -2097152..2097151;
        LONG lat;  // INTEGER, -2097152..2097151;
    };
    
    struct VPMPosition_LL_48B {
        INT isValidFlag;   // necessary if this struct is used as an optional field of a SEQUENCE
        LONG lon;  // INTEGER, -8388608..8388607;
        LONG lat;  // INTEGER, -8388608..8388607;
    };
    
    struct VPMPosition_LLmD_64b {
        INT isValidFlag;   // necessary if this struct is used as an optional field of a SEQUENCE
        LONG lon;  // INTEGER, -1799999999..1800000001;
        LONG lat;  // INTEGER, -900000000..900000001;
    };
    
    struct VPMPositionOffsetLL {
        INT isValidFlag;   // necessary if this struct is used as an optional field of a SEQUENCE
        INT choice;
        struct VPMPosition_LL_24B position_LL1;  // SEQUENCE;
        struct VPMPosition_LL_28B position_LL2;  // SEQUENCE;
        struct VPMPosition_LL_32B position_LL3;  // SEQUENCE;
        struct VPMPosition_LL_36B position_LL4;  // SEQUENCE;
        struct VPMPosition_LL_44B position_LL5;  // SEQUENCE;
        struct VPMPosition_LL_48B position_LL6;  // SEQUENCE;
        struct VPMPosition_LLmD_64b position_LatLon;  // SEQUENCE;
    };
    
    struct VPMVerticalOffset {
        INT isValidFlag;   // necessary if this struct is used as an optional field of a SEQUENCE
        INT choice;
        INT offset1;  // INTEGER, -64..63;
        INT offset2;  // INTEGER, -128..127;
        INT offset3;  // INTEGER, -256..255;
        INT offset4;  // INTEGER, -512..511;
        INT offset5;  // INTEGER, -1024..1023;
        INT offset6;  // INTEGER, -2048..2047;
        LONG elevation;  // INTEGER, -4096..61439;
    };
    
    struct VPMPositionOffsetLLV {
        INT isValidFlag;   // necessary if this struct is used as an optional field of a SEQUENCE
        struct VPMPositionOffsetLL offsetLL;  // CHOICE;
        struct VPMVerticalOffset offsetV;  // CHOICE, OPTIONAL;
    };
    
    struct VPMNodeReferenceID {
        INT isValidFlag;   // necessary if this struct is used as an optional field of a SEQUENCE
        struct OPT_WORD_ASN region;  // INTEGER, OPTIONAL, 0..65535;
        WORD id;  // INTEGER, 0..65535;
    };
    
    struct VPMTollInfo_tollRoad {
        INT isValidFlag;   // necessary if this struct is used as an optional field of a SEQUENCE
        INT length;
        struct VPMNodeReferenceID arrayValue[256];  // SEQUENCE;
    };
    
    struct VPMPathPointList {
        INT isValidFlag;   // necessary if this struct is used as an optional field of a SEQUENCE
        INT length;
        struct VPMPositionOffsetLLV arrayValue[32];  // SEQUENCE;
    };
    
    struct VPMReferencePath {
        INT isValidFlag;   // necessary if this struct is used as an optional field of a SEQUENCE
        struct VPMPathPointList activePath;  // SEQUENCEOF;
        WORD pathRadius;  // INTEGER, 0..65535;
    };
    
    struct VPMTollInfo {
        INT isValidFlag;   // necessary if this struct is used as an optional field of a SEQUENCE
        struct OPT_DWORD_ASN price;  // INTEGER, OPTIONAL, 0..424967295;
        struct VPMPositionOffsetLLV entrancePos;  // SEQUENCE, OPTIONAL;
        struct VPMPositionOffsetLLV exitPos;  // SEQUENCE, OPTIONAL;
        struct VPMTollInfo_tollRoad tollRoad;  // SEQUENCEOF, OPTIONAL;
        struct VPMReferencePath tollPath;  // SEQUENCE, OPTIONAL;
        struct VPMDDateTime timeBegin;  // SEQUENCE, OPTIONAL;
        struct VPMDDateTime timeEnd;  // SEQUENCE, OPTIONAL;
    };
    
    struct VPMPaymentInfoType1_serviceInfo {
        INT isValidFlag;   // necessary if this struct is used as an optional field of a SEQUENCE
        CHAR string[513];
        INT  stringLength;
    };
    
    struct VPMPaymentInfoType1 {
        INT isValidFlag;   // necessary if this struct is used as an optional field of a SEQUENCE
        struct VPMTollingNodeInfo tollingNodeInfo;  // SEQUENCE, OPTIONAL;
        struct VPMTollInfo tollInfo;  // SEQUENCE, OPTIONAL;
        struct VPMPaymentInfoType1_serviceInfo serviceInfo;  // OCTETSTRING, OPTIONAL;
    };
    
    struct VPMPaymentInfo {
        INT isValidFlag;   // necessary if this struct is used as an optional field of a SEQUENCE
        INT choice;
        struct VPMPaymentInfoType1 paymentInfoType1;  // SEQUENCE;
    };
    
    struct VPMApplicationParameter {
        INT isValidFlag;   // necessary if this struct is used as an optional field of a SEQUENCE
        INT pid;  // ENUMERATED, system(0), freeflow(1), enclosed(2), congestion(3), charging(4), parking(5);
        struct VPMPaymentInfo paymentInfo;  // CHOICE;
    };
    
    struct VPMPaymentList {
        INT isValidFlag;   // necessary if this struct is used as an optional field of a SEQUENCE
        INT length;
        struct VPMApplicationParameter arrayValue[16];  // SEQUENCE;
    };
    
    struct VPMRST {
        INT isValidFlag;   // necessary if this struct is used as an optional field of a SEQUENCE
        struct VPMDDateTime time;  // SEQUENCE;
        struct VPMRST_id id;  // OCTETSTRING;
        struct VPMPaymentList paymentList;  // SEQUENCEOF;
    };
    
    struct VPMVSI_obuId {
        INT isValidFlag;   // necessary if this struct is used as an optional field of a SEQUENCE
        CHAR string[9];
        INT  stringLength;
    };
    
    struct VPMVSI_targetId {
        INT isValidFlag;   // necessary if this struct is used as an optional field of a SEQUENCE
        CHAR string[9];
        INT  stringLength;
    };
    
    struct VPMOBUMotionStatus {
        INT isValidFlag;   // necessary if this struct is used as an optional field of a SEQUENCE
        struct VPMPosition3D pos;  // SEQUENCE, OPTIONAL;
        struct OPT_WORD_ASN heading;  // INTEGER, OPTIONAL, 0..28800;
        struct OPT_WORD_ASN speed;  // INTEGER, OPTIONAL, 0..8191;
    };
    
    struct VPMOBUInfo {
        INT isValidFlag;   // necessary if this struct is used as an optional field of a SEQUENCE
        INT obuType;  // ENUMERATED, oemObu(0), aftermarketObu(1), mobilePhone(2);
        struct VPMOBUMotionStatus obuMotionStatus;  // SEQUENCE, OPTIONAL;
    };
    
    struct VPMGBICCInfo_iccIssueInfo {
        INT isValidFlag;   // necessary if this struct is used as an optional field of a SEQUENCE
        CHAR string[128];
        INT  stringLength;
    };
    
    struct VPMGBICCInfo_iccUniTollInfo {
        INT isValidFlag;   // necessary if this struct is used as an optional field of a SEQUENCE
        CHAR string[128];
        INT  stringLength;
    };
    
    struct VPMGBICCInfo_iccBalance {
        INT isValidFlag;   // necessary if this struct is used as an optional field of a SEQUENCE
        CHAR string[128];
        INT  stringLength;
    };
    
    struct VPMGBICCInfo {
        INT isValidFlag;   // necessary if this struct is used as an optional field of a SEQUENCE
        struct VPMGBICCInfo_iccIssueInfo iccIssueInfo;  // OCTETSTRING;
        struct VPMGBICCInfo_iccUniTollInfo iccUniTollInfo;  // OCTETSTRING;
        struct VPMGBICCInfo_iccBalance iccBalance;  // OCTETSTRING;
    };
    
    struct VPMSysInfo_contractProvider {
        INT isValidFlag;   // necessary if this struct is used as an optional field of a SEQUENCE
        CHAR string[9];
        INT  stringLength;
    };
    
    struct VPMSysInfo_contractSerialNumer {
        INT isValidFlag;   // necessary if this struct is used as an optional field of a SEQUENCE
        CHAR string[9];
        INT  stringLength;
    };
    
    struct VPMDate {
        INT isValidFlag;   // necessary if this struct is used as an optional field of a SEQUENCE
        WORD year;  // INTEGER, 0..4095;
        BYTE month;  // INTEGER, 0..12;
        BYTE day;  // INTEGER, 0..31;
    };
    
    struct VPMSysInfo_reserved {
        INT isValidFlag;   // necessary if this struct is used as an optional field of a SEQUENCE
        CHAR string[65];
        INT  stringLength;
    };
    
    struct VPMSysInfo {
        INT isValidFlag;   // necessary if this struct is used as an optional field of a SEQUENCE
        struct VPMSysInfo_contractProvider contractProvider;  // OCTETSTRING;
        BYTE contractType;  // INTEGER, 0..127;
        BYTE contractVersion;  // INTEGER, 0..127;
        struct VPMSysInfo_contractSerialNumer contractSerialNumer;  // OCTETSTRING;
        struct VPMDate contractSignedDate;  // SEQUENCE;
        struct VPMDate contractExpiredDate;  // SEQUENCE;
        struct VPMSysInfo_reserved reserved;  // OCTETSTRING;
    };
    
    struct VPMVehicleInfo_vehicleLicencePlateNumber {
        INT isValidFlag;   // necessary if this struct is used as an optional field of a SEQUENCE
        CHAR string[13];
        INT  stringLength;
    };
    
    struct VPMVehicleInfo_vehicleLicencePlateColor {
        INT isValidFlag;   // necessary if this struct is used as an optional field of a SEQUENCE
        CHAR string[3];
        INT  stringLength;
    };
    
    struct VPMVehicleDimensions {
        INT isValidFlag;   // necessary if this struct is used as an optional field of a SEQUENCE
        WORD vehicleLength;  // INTEGER, 0..65535;
        BYTE vehicleWidth;  // INTEGER, 0..255;
        BYTE vehicleHeigth;  // INTEGER, 0..255;
    };
    
    struct VPMVehicleInfo_vehicleSpecificInformation {
        INT isValidFlag;   // necessary if this struct is used as an optional field of a SEQUENCE
        CHAR string[17];
        INT  stringLength;
    };
    
    struct VPMVehicleInfo_vehicleEngineNumber {
        INT isValidFlag;   // necessary if this struct is used as an optional field of a SEQUENCE
        CHAR string[17];
        INT  stringLength;
    };
    
    struct VPMVehicleInfo_description {
        INT isValidFlag;   // necessary if this struct is used as an optional field of a SEQUENCE
        CHAR string[257];
        INT  stringLength;
    };
    
    struct VPMVehicleInfo {
        INT isValidFlag;   // necessary if this struct is used as an optional field of a SEQUENCE
        struct VPMVehicleInfo_vehicleLicencePlateNumber vehicleLicencePlateNumber;  // OCTETSTRING;
        struct VPMVehicleInfo_vehicleLicencePlateColor vehicleLicencePlateColor;  // OCTETSTRING;
        BYTE vehicleTollingClass;  // INTEGER, 0..127;
        BYTE vehicleUserType;  // INTEGER, 0..127;
        struct VPMVehicleDimensions vehicleDimensions;  // SEQUENCE;
        BYTE vehicleWheels;  // INTEGER, 0..127;
        BYTE vehicleAxles;  // INTEGER, 0..127;
        WORD vehicleWheelBases;  // INTEGER, 0..65535;
        DWORD vehicleWeightLimits;  // INTEGER, 0..16777215;
        struct VPMVehicleInfo_vehicleSpecificInformation vehicleSpecificInformation;  // OCTETSTRING;
        struct VPMVehicleInfo_vehicleEngineNumber vehicleEngineNumber;  // OCTETSTRING;
        struct VPMVehicleInfo_description description;  // OCTETSTRING, OPTIONAL;
    };
    
    struct VPMTollingPos {
        INT isValidFlag;   // necessary if this struct is used as an optional field of a SEQUENCE
        DWORD id;  // INTEGER, 0..4294967295;
        struct VPMPosition3D pos;  // SEQUENCE, OPTIONAL;
    };
    
    struct VPMPassedPos_tollingAmount {
        INT isValidFlag;   // necessary if this struct is used as an optional field of a SEQUENCE
        CHAR string[5];
        INT  stringLength;
    };
    
    struct VPMPassedPos {
        INT isValidFlag;   // necessary if this struct is used as an optional field of a SEQUENCE
        struct VPMTollingPos tollingPos;  // SEQUENCE;
        struct VPMDDateTime tollingTime;  // SEQUENCE;
        struct VPMPassedPos_tollingAmount tollingAmount;  // OCTETSTRING, OPTIONAL;
    };
    
    struct VPMPassedSitesInfo_passedPos {
        INT isValidFlag;   // necessary if this struct is used as an optional field of a SEQUENCE
        INT length;
        struct VPMPassedPos arrayValue[512];  // SEQUENCE;
    };
    
    struct VPMPassedSitesInfo {
        INT isValidFlag;   // necessary if this struct is used as an optional field of a SEQUENCE
        struct VPMPassedPos entranceInfo;  // SEQUENCE, OPTIONAL;
        struct VPMPassedSitesInfo_passedPos passedPos;  // SEQUENCEOF, OPTIONAL;
    };
    
    struct VPMOBUPaymentInfoType1 {
        INT isValidFlag;   // necessary if this struct is used as an optional field of a SEQUENCE
        struct OPT_ENUM_ASN equipmentClass;  // ENUMERATED, OPTIONAL, onechipOBU(0), iccOBU(1), cpcOBU(2);
        struct VPMGBICCInfo gbiCCInfo;  // SEQUENCE, OPTIONAL;
        struct VPMSysInfo sysInfo;  // SEQUENCE, OPTIONAL;
        struct VPMVehicleInfo vehicleInfo;  // SEQUENCE, OPTIONAL;
        struct VPMPassedSitesInfo passedSitesInfo;  // SEQUENCE, OPTIONAL;
    };
    
    struct VPMOBUPaymentInfo {
        INT isValidFlag;   // necessary if this struct is used as an optional field of a SEQUENCE
        INT choice;
        struct VPMOBUPaymentInfoType1 obuPaymentInfoType1;  // SEQUENCE;
    };
    
    struct VPMVPApplicationParameter {
        INT isValidFlag;   // necessary if this struct is used as an optional field of a SEQUENCE
        INT pid;  // ENUMERATED, system(0), freeflow(1), enclosed(2), congestion(3), charging(4), parking(5);
        struct VPMOBUPaymentInfo obuPaymentInfo;  // CHOICE;
    };
    
    struct VPMVPApplicationList {
        INT isValidFlag;   // necessary if this struct is used as an optional field of a SEQUENCE
        INT length;
        struct VPMVPApplicationParameter arrayValue[16];  // SEQUENCE;
    };
    
    struct VPMRandStr8 {
        INT isValidFlag;   // necessary if this struct is used as an optional field of a SEQUENCE
        CHAR string[9];
        INT  stringLength;
    };
    
    struct VPMVSI {
        INT isValidFlag;   // necessary if this struct is used as an optional field of a SEQUENCE
        struct VPMDDateTime time;  // SEQUENCE;
        struct VPMVSI_obuId obuId;  // OCTETSTRING;
        struct VPMVSI_targetId targetId;  // OCTETSTRING, OPTIONAL;
        struct VPMOBUInfo obuInfo;  // SEQUENCE, OPTIONAL;
        struct VPMVPApplicationList vpapplicationList;  // SEQUENCEOF, OPTIONAL;
        struct VPMRandStr8 rndOBU;  // OCTETSTRING, OPTIONAL;
    };
    
    struct VPMAction_Request_sourceId {
        INT isValidFlag;   // necessary if this struct is used as an optional field of a SEQUENCE
        CHAR string[9];
        INT  stringLength;
    };
    
    struct VPMAction_Request_targetId {
        INT isValidFlag;   // necessary if this struct is used as an optional field of a SEQUENCE
        CHAR string[9];
        INT  stringLength;
    };
    
    struct VPMRangeOfFile {
        INT isValidFlag;   // necessary if this struct is used as an optional field of a SEQUENCE
        WORD offset;  // INTEGER, 0..32767;
        BYTE length;  // INTEGER, 0..127;
    };
    
    struct VPMGetTollDataRq {
        INT isValidFlag;   // necessary if this struct is used as an optional field of a SEQUENCE
        struct VPMRangeOfFile vehicleInfo;  // SEQUENCE;
        struct VPMRangeOfFile tollInfo;  // SEQUENCE, OPTIONAL;
        struct OPT_BYTE_ASN keyIdForAC;  // INTEGER, OPTIONAL, 0..255;
    };
    
    struct VPMFile {
        INT isValidFlag;   // necessary if this struct is used as an optional field of a SEQUENCE
        CHAR string[128];
        INT  stringLength;
    };
    
    struct VPMGetTollDataRs {
        INT isValidFlag;   // necessary if this struct is used as an optional field of a SEQUENCE
        struct VPMFile vehicleInfo;  // OCTETSTRING;
        struct VPMFile tollInfo;  // OCTETSTRING, OPTIONAL;
    };
    
    struct VPMGetSecureRq {
        INT isValidFlag;   // necessary if this struct is used as an optional field of a SEQUENCE
        struct VPMRangeOfFile vehicleInfo;  // SEQUENCE;
        struct VPMRandStr8 rndRsuForAuthen;  // OCTETSTRING;
        BYTE keyIdForAuthen;  // INTEGER, 0..255;
        struct OPT_BYTE_ASN keyIdForEncrypt;  // INTEGER, OPTIONAL, 0..255;
    };
    
    struct VPMGetSecureRs_authenticator {
        INT isValidFlag;   // necessary if this struct is used as an optional field of a SEQUENCE
        CHAR string[9];
        INT  stringLength;
    };
    
    struct VPMGetSecureRs {
        INT isValidFlag;   // necessary if this struct is used as an optional field of a SEQUENCE
        struct VPMRangeOfFile file;  // SEQUENCE;
        struct VPMGetSecureRs_authenticator authenticator;  // OCTETSTRING;
    };
    
    struct VPMTransPara_transAmount {
        INT isValidFlag;   // necessary if this struct is used as an optional field of a SEQUENCE
        CHAR string[5];
        INT  stringLength;
    };
    
    struct VPMTransPara_transType {
        INT isValidFlag;   // necessary if this struct is used as an optional field of a SEQUENCE
        CHAR string[2];
        INT  stringLength;
    };
    
    struct VPMTransPara_terminalID {
        INT isValidFlag;   // necessary if this struct is used as an optional field of a SEQUENCE
        CHAR string[7];
        INT  stringLength;
    };
    
    struct VPMTransPara_transSN {
        INT isValidFlag;   // necessary if this struct is used as an optional field of a SEQUENCE
        CHAR string[5];
        INT  stringLength;
    };
    
    struct VPMTransPara_transTime {
        INT isValidFlag;   // necessary if this struct is used as an optional field of a SEQUENCE
        CHAR string[8];
        INT  stringLength;
    };
    
    struct VPMTransPara_transStationID {
        INT isValidFlag;   // necessary if this struct is used as an optional field of a SEQUENCE
        CHAR string[4];
        INT  stringLength;
    };
    
    struct VPMTransPara {
        INT isValidFlag;   // necessary if this struct is used as an optional field of a SEQUENCE
        struct VPMTransPara_transAmount transAmount;  // OCTETSTRING;
        struct VPMTransPara_transType transType;  // OCTETSTRING;
        struct VPMTransPara_terminalID terminalID;  // OCTETSTRING;
        struct VPMTransPara_transSN transSN;  // OCTETSTRING;
        struct VPMTransPara_transTime transTime;  // OCTETSTRING;
        struct VPMTransPara_transStationID transStationID;  // OCTETSTRING;
    };
    
    struct VPMPartOfFile {
        INT isValidFlag;   // necessary if this struct is used as an optional field of a SEQUENCE
        WORD offset;  // INTEGER, 0..32767;
        BYTE length;  // INTEGER, 0..127;
        struct VPMFile fileContent;  // OCTETSTRING;
    };
    
    struct VPMSetTollDataRq {
        INT isValidFlag;   // necessary if this struct is used as an optional field of a SEQUENCE
        struct VPMRandStr8 rndRSU;  // OCTETSTRING, OPTIONAL;
        struct VPMTransPara transPara;  // SEQUENCE, OPTIONAL;
        struct VPMPartOfFile tollInfo;  // SEQUENCE, OPTIONAL;
        struct VPMTollingPos tollingPos;  // SEQUENCE, OPTIONAL;
        struct OPT_BYTE_ASN keyIdForAuthen;  // INTEGER, OPTIONAL, 0..255;
    };
    
    struct VPMSetTollDataRs_tacInfo {
        INT isValidFlag;   // necessary if this struct is used as an optional field of a SEQUENCE
        CHAR string[5];
        INT  stringLength;
    };
    
    struct VPMSetTollDataRs_authenticator {
        INT isValidFlag;   // necessary if this struct is used as an optional field of a SEQUENCE
        CHAR string[9];
        INT  stringLength;
    };
    
    struct VPMAccountInfo_account {
        INT isValidFlag;   // necessary if this struct is used as an optional field of a SEQUENCE
        CHAR string[33];
        INT  stringLength;
    };
    
    struct VPMAccountInfo {
        INT isValidFlag;   // necessary if this struct is used as an optional field of a SEQUENCE
        struct VPMAccountInfo_account account;  // OCTETSTRING;
    };
    
    struct VPMTransCredential_tc {
        INT isValidFlag;   // necessary if this struct is used as an optional field of a SEQUENCE
        CHAR string[33];
        INT  stringLength;
    };
    
    struct VPMTransCredential {
        INT isValidFlag;   // necessary if this struct is used as an optional field of a SEQUENCE
        struct VPMTransCredential_tc tc;  // OCTETSTRING;
    };
    
    struct VPMSetTollDataRs {
        INT isValidFlag;   // necessary if this struct is used as an optional field of a SEQUENCE
        struct VPMSetTollDataRs_tacInfo tacInfo;  // OCTETSTRING, OPTIONAL;
        struct VPMSetTollDataRs_authenticator authenticator;  // OCTETSTRING, OPTIONAL;
        struct VPMAccountInfo accountInfo;  // SEQUENCE, OPTIONAL;
        struct VPMTransCredential transCredential;  // SEQUENCE, OPTIONAL;
    };
    
    struct VPMApduList_ {
        INT isValidFlag;   // necessary if this struct is used as an optional field of a SEQUENCE
        CHAR string[128];
        INT  stringLength;
    };
    
    struct VPMApduList {
        INT isValidFlag;   // necessary if this struct is used as an optional field of a SEQUENCE
        INT length;
        struct VPMApduList_ arrayValue[32];  // OCTETSTRING;
    };
    
    struct VPMChannelRq {
        INT isValidFlag;   // necessary if this struct is used as an optional field of a SEQUENCE
        INT channelid;  // ENUMERATED, obu(0), esam(1), icc(2), hmi(3), beeper(4);
        struct VPMApduList apdu;  // SEQUENCEOF;
    };
    
    struct VPMChannelRs {
        INT isValidFlag;   // necessary if this struct is used as an optional field of a SEQUENCE
        INT channelid;  // ENUMERATED, obu(0), esam(1), icc(2), hmi(3), beeper(4);
        struct VPMApduList apdu;  // SEQUENCEOF;
    };
    
    struct VPMSetMMIRq {
        INT isValidFlag;   // necessary if this struct is used as an optional field of a SEQUENCE
        INT toll;  // ENUMERATED, ok(0), nok(1), contactOperator(2);
    };
    
    struct VPMTransInfo {
        INT isValidFlag;   // necessary if this struct is used as an optional field of a SEQUENCE
        INT choice;
        struct VPMGetTollDataRq getTollDataRq;  // SEQUENCE;
        struct VPMGetTollDataRs getTollDataRs;  // SEQUENCE;
        struct VPMGetSecureRq getSecureRq;  // SEQUENCE;
        struct VPMGetSecureRs getSecureRs;  // SEQUENCE;
        struct VPMSetTollDataRq setTollDataRq;  // SEQUENCE;
        struct VPMSetTollDataRs setTollDataRs;  // SEQUENCE;
        struct VPMChannelRq transferChannelRq;  // SEQUENCE;
        struct VPMChannelRs transferChannelRs;  // SEQUENCE;
        struct VPMSetMMIRq setMMIRq;  // SEQUENCE;
    };
    
    struct VPMAction_Request_accessCredentials {
        INT isValidFlag;   // necessary if this struct is used as an optional field of a SEQUENCE
        CHAR string[9];
        INT  stringLength;
    };
    
    struct VPMAction_Request {
        INT isValidFlag;   // necessary if this struct is used as an optional field of a SEQUENCE
        struct VPMDDateTime time;  // SEQUENCE;
        INT mode;  // BOOLEAN;
        struct VPMAction_Request_sourceId sourceId;  // OCTETSTRING;
        struct VPMAction_Request_targetId targetId;  // OCTETSTRING, OPTIONAL;
        INT paymentEntityId;  // ENUMERATED, system(0), freeflow(1), enclosed(2), congestion(3), charging(4), parking(5);
        struct VPMTransInfo actionParameter;  // CHOICE;
        struct VPMAction_Request_accessCredentials accessCredentials;  // OCTETSTRING, OPTIONAL;
    };
    
    struct VPMAction_Response_sourceId {
        INT isValidFlag;   // necessary if this struct is used as an optional field of a SEQUENCE
        CHAR string[9];
        INT  stringLength;
    };
    
    struct VPMAction_Response_targetId {
        INT isValidFlag;   // necessary if this struct is used as an optional field of a SEQUENCE
        CHAR string[9];
        INT  stringLength;
    };
    
    struct VPMAction_Response {
        INT isValidFlag;   // necessary if this struct is used as an optional field of a SEQUENCE
        struct VPMDDateTime time;  // SEQUENCE;
        struct VPMAction_Response_sourceId sourceId;  // OCTETSTRING;
        struct VPMAction_Response_targetId targetId;  // OCTETSTRING, OPTIONAL;
        INT paymentEntityId;  // ENUMERATED, system(0), freeflow(1), enclosed(2), congestion(3), charging(4), parking(5);
        struct VPMTransInfo responseParameter;  // CHOICE, OPTIONAL;
        INT ret;  // ENUMERATED, noError(0), accessDenied(1), argumnetError(2), complexityLimitation(3), processingFailure(4), processing(5);
    };
    
    struct VPMVehiclePaymentMessage_payment {
        INT isValidFlag;   // necessary if this struct is used as an optional field of a SEQUENCE
        INT choice;
        struct VPMRST initialzation_request;  // SEQUENCE;
        struct VPMVSI initialzation_response;  // SEQUENCE;
        struct VPMAction_Request action_request;  // SEQUENCE;
        struct VPMAction_Response action_response;  // SEQUENCE;
    };
    
    struct VPMVPM_VehiclePaymentMessage {
        INT isValidFlag;   // necessary if this struct is used as an optional field of a SEQUENCE
        BYTE msgCnt;  // INTEGER, 0..127;
        struct VPMVehiclePaymentMessage_payment payment;  // CHOICE;
    };
    
    struct VPMMessageTypes {
        struct VPMVPM_VehiclePaymentMessage vpmData;  // SEQUENCE;
    };
    
    struct VPMMessageFrameExt {
        INT isValidFlag;   // necessary if this struct is used as an optional field of a SEQUENCE
        WORD messageId;  // INTEGER, 0..32767;
        struct VPMMessageTypes value;  // TABLE;
    };
    
    struct VPM {
        INT isValidFlag;   // necessary if this struct is used as an optional field of a SEQUENCE
        INT choice;
        struct VPMMessageFrameExt msgFrameExt;  // SEQUENCE;
    };
    
}

/*
// init function to create a simple packet handle
*/ 
LONG API_InitVPMPacket()
{
  return C2xInitPacket("VPM"); 
}

/*
// init function to create a simple packet handle and
// initialize the struct with valid data
*/ 
LONG API_InitVPMPacket(struct VPM msgStruct)
{
  long pktHandle;

  pktHandle = API_InitVPMPacket();

  if (pktHandle != 0)
  {
    // create valid message and application data
    if (C2xCompletePacket(pktHandle) == 0) 
    {
      API_GetVPMParams(pktHandle, msgStruct);
    }
  }
  return pktHandle;
}

/*
// init function to create a packet with security layer and
// initialize the struct with valid data
*/ 
LONG API_InitVPMPacket(struct VPM msgStruct, char packetTypeDesignator[], char certificateName[])
{
  long pktHandle, certHdl;

  // initialize the packet
  pktHandle = C2xInitPacket("VPM", packetTypeDesignator);

  if (pktHandle != 0)
  {
    certHdl = C2xSecCertificateGetHandle(certificateName);  // get the certificate handle for the cert with name "certificateName"
    if (certHdl != 0) 
    {
      C2xSecPacketSetSignerHandle(pktHandle, certHdl); // set the certHdl to the packet
    }

    // create valid message and application data
    if (C2xCompletePacket(pktHandle) == 0) 
    {
      // copy application data to the application structure
      API_GetVPMParams(pktHandle, msgStruct);
    }
  }
  return pktHandle;
}
    

int GetVPMDDateTimeParams(LONG packetHandle, struct VPMDDateTime value, char oldPath[])
{
  char newPath[300];
  int result;

  result = 0;

  snprintf(newPath, elcount(newPath), "%s.%s", oldPath, "year");
  value.year.isValidFlag = C2xIsTokenAvailable(packetHandle, "VPM", newPath);
  if(value.year.isValidFlag==1)
  {
    value.year.value = C2xGetTokenInt(packetHandle, "VPM", newPath);
    result = CheckLastError("VPM", gkFuncRefGet, result);
  }
  snprintf(newPath, elcount(newPath), "%s.%s", oldPath, "month");
  value.month.isValidFlag = C2xIsTokenAvailable(packetHandle, "VPM", newPath);
  if(value.month.isValidFlag==1)
  {
    value.month.value = C2xGetTokenInt(packetHandle, "VPM", newPath);
    result = CheckLastError("VPM", gkFuncRefGet, result);
  }
  snprintf(newPath, elcount(newPath), "%s.%s", oldPath, "day");
  value.day.isValidFlag = C2xIsTokenAvailable(packetHandle, "VPM", newPath);
  if(value.day.isValidFlag==1)
  {
    value.day.value = C2xGetTokenInt(packetHandle, "VPM", newPath);
    result = CheckLastError("VPM", gkFuncRefGet, result);
  }
  snprintf(newPath, elcount(newPath), "%s.%s", oldPath, "hour");
  value.hour.isValidFlag = C2xIsTokenAvailable(packetHandle, "VPM", newPath);
  if(value.hour.isValidFlag==1)
  {
    value.hour.value = C2xGetTokenInt(packetHandle, "VPM", newPath);
    result = CheckLastError("VPM", gkFuncRefGet, result);
  }
  snprintf(newPath, elcount(newPath), "%s.%s", oldPath, "minute");
  value.minute.isValidFlag = C2xIsTokenAvailable(packetHandle, "VPM", newPath);
  if(value.minute.isValidFlag==1)
  {
    value.minute.value = C2xGetTokenInt(packetHandle, "VPM", newPath);
    result = CheckLastError("VPM", gkFuncRefGet, result);
  }
  snprintf(newPath, elcount(newPath), "%s.%s", oldPath, "second");
  value.second.isValidFlag = C2xIsTokenAvailable(packetHandle, "VPM", newPath);
  if(value.second.isValidFlag==1)
  {
    value.second.value = C2xGetTokenInt(packetHandle, "VPM", newPath);
    result = CheckLastError("VPM", gkFuncRefGet, result);
  }
  snprintf(newPath, elcount(newPath), "%s.%s", oldPath, "offset");
  value.offset.isValidFlag = C2xIsTokenAvailable(packetHandle, "VPM", newPath);
  if(value.offset.isValidFlag==1)
  {
    value.offset.value = C2xGetTokenInt(packetHandle, "VPM", newPath);
    result = CheckLastError("VPM", gkFuncRefGet, result);
  }
  return result;
}

int SetVPMDDateTimeParams(LONG packetHandle, struct VPMDDateTime value, char oldPath[])
{
  char newPath[300];
  int result;

  result = 0;

  snprintf(newPath, elcount(newPath), "%s.%s", oldPath, "year");
  if(value.year.isValidFlag==1)
  {
    C2xSetTokenInt(packetHandle, "VPM", newPath, value.year.value);
    result = CheckLastError("VPM", gkFuncRefGet, result);
  }
  else
  {
    if( C2xIsTokenAvailable(packetHandle, "VPM", newPath) )
    {
      C2xRemoveToken(packetHandle, "VPM", newPath);
    }
  }

  snprintf(newPath, elcount(newPath), "%s.%s", oldPath, "month");
  if(value.month.isValidFlag==1)
  {
    C2xSetTokenInt(packetHandle, "VPM", newPath, value.month.value);
    result = CheckLastError("VPM", gkFuncRefGet, result);
  }
  else
  {
    if( C2xIsTokenAvailable(packetHandle, "VPM", newPath) )
    {
      C2xRemoveToken(packetHandle, "VPM", newPath);
    }
  }

  snprintf(newPath, elcount(newPath), "%s.%s", oldPath, "day");
  if(value.day.isValidFlag==1)
  {
    C2xSetTokenInt(packetHandle, "VPM", newPath, value.day.value);
    result = CheckLastError("VPM", gkFuncRefGet, result);
  }
  else
  {
    if( C2xIsTokenAvailable(packetHandle, "VPM", newPath) )
    {
      C2xRemoveToken(packetHandle, "VPM", newPath);
    }
  }

  snprintf(newPath, elcount(newPath), "%s.%s", oldPath, "hour");
  if(value.hour.isValidFlag==1)
  {
    C2xSetTokenInt(packetHandle, "VPM", newPath, value.hour.value);
    result = CheckLastError("VPM", gkFuncRefGet, result);
  }
  else
  {
    if( C2xIsTokenAvailable(packetHandle, "VPM", newPath) )
    {
      C2xRemoveToken(packetHandle, "VPM", newPath);
    }
  }

  snprintf(newPath, elcount(newPath), "%s.%s", oldPath, "minute");
  if(value.minute.isValidFlag==1)
  {
    C2xSetTokenInt(packetHandle, "VPM", newPath, value.minute.value);
    result = CheckLastError("VPM", gkFuncRefGet, result);
  }
  else
  {
    if( C2xIsTokenAvailable(packetHandle, "VPM", newPath) )
    {
      C2xRemoveToken(packetHandle, "VPM", newPath);
    }
  }

  snprintf(newPath, elcount(newPath), "%s.%s", oldPath, "second");
  if(value.second.isValidFlag==1)
  {
    C2xSetTokenInt(packetHandle, "VPM", newPath, value.second.value);
    result = CheckLastError("VPM", gkFuncRefGet, result);
  }
  else
  {
    if( C2xIsTokenAvailable(packetHandle, "VPM", newPath) )
    {
      C2xRemoveToken(packetHandle, "VPM", newPath);
    }
  }

  snprintf(newPath, elcount(newPath), "%s.%s", oldPath, "offset");
  if(value.offset.isValidFlag==1)
  {
    C2xSetTokenInt(packetHandle, "VPM", newPath, value.offset.value);
    result = CheckLastError("VPM", gkFuncRefGet, result);
  }
  else
  {
    if( C2xIsTokenAvailable(packetHandle, "VPM", newPath) )
    {
      C2xRemoveToken(packetHandle, "VPM", newPath);
    }
  }

  return result;
}

int GetVPMPosition3DParams(LONG packetHandle, struct VPMPosition3D value, char oldPath[])
{
  char newPath[300];
  int result;

  result = 0;

  snprintf(newPath, elcount(newPath), "%s.%s", oldPath, "lat");
  value.lat = C2xGetTokenInt(packetHandle, "VPM", newPath);
  result = CheckLastError("VPM", gkFuncRefGet, result);

  snprintf(newPath, elcount(newPath), "%s.%s", oldPath, "lon");
  value.lon = C2xGetTokenInt(packetHandle, "VPM", newPath);
  result = CheckLastError("VPM", gkFuncRefGet, result);

  snprintf(newPath, elcount(newPath), "%s.%s", oldPath, "elevation");
  value.elevation.isValidFlag = C2xIsTokenAvailable(packetHandle, "VPM", newPath);
  if(value.elevation.isValidFlag==1)
  {
    value.elevation.value = C2xGetTokenInt(packetHandle, "VPM", newPath);
    result = CheckLastError("VPM", gkFuncRefGet, result);
  }
  return result;
}

int SetVPMPosition3DParams(LONG packetHandle, struct VPMPosition3D value, char oldPath[])
{
  char newPath[300];
  int result;

  result = 0;

  snprintf(newPath, elcount(newPath), "%s.%s", oldPath, "lat");
  C2xSetTokenInt(packetHandle, "VPM", newPath, value.lat);
  result = CheckLastError("VPM", gkFuncRefGet, result);

  snprintf(newPath, elcount(newPath), "%s.%s", oldPath, "lon");
  C2xSetTokenInt(packetHandle, "VPM", newPath, value.lon);
  result = CheckLastError("VPM", gkFuncRefGet, result);

  snprintf(newPath, elcount(newPath), "%s.%s", oldPath, "elevation");
  if(value.elevation.isValidFlag==1)
  {
    C2xSetTokenInt(packetHandle, "VPM", newPath, value.elevation.value);
    result = CheckLastError("VPM", gkFuncRefGet, result);
  }
  else
  {
    if( C2xIsTokenAvailable(packetHandle, "VPM", newPath) )
    {
      C2xRemoveToken(packetHandle, "VPM", newPath);
    }
  }

  return result;
}

int GetVPMTollingNodeInfoParams(LONG packetHandle, struct VPMTollingNodeInfo value, char oldPath[])
{
  char newPath[300];
  int result;

  result = 0;

  snprintf(newPath, elcount(newPath), "%s.%s", oldPath, "id");
  value.id.isValidFlag = C2xIsTokenAvailable(packetHandle, "VPM", newPath);
  if(value.id.isValidFlag==1)
  {
    value.id.value = C2xGetTokenInt64(packetHandle, "VPM", newPath);
    result = CheckLastError("VPM", gkFuncRefGet, result);
  }
  snprintf(newPath, elcount(newPath), "%s.%s", oldPath, "pos");
  value.pos.isValidFlag = C2xIsTokenAvailable(packetHandle, "VPM", newPath);
  if(value.pos.isValidFlag==1)
  {
    GetVPMPosition3DParams(packetHandle, value.pos, newPath);
    result = CheckLastError("VPM", gkFuncRefGet, result);
  }
  snprintf(newPath, elcount(newPath), "%s.%s", oldPath, "tollingNodeType");
  value.tollingNodeType.isValidFlag = C2xIsTokenAvailable(packetHandle, "VPM", newPath);
  if(value.tollingNodeType.isValidFlag==1)
  {
    value.tollingNodeType.value = C2xGetTokenInt(packetHandle, "VPM", newPath);
    result = CheckLastError("VPM", gkFuncRefGet, result);
  }
  snprintf(newPath, elcount(newPath), "%s.%s", oldPath, "tollingDirection");
  value.tollingDirection.isValidFlag = C2xIsTokenAvailable(packetHandle, "VPM", newPath);
  if(value.tollingDirection.isValidFlag==1)
  {
    value.tollingDirection.value = C2xGetTokenInt(packetHandle, "VPM", newPath);
    result = CheckLastError("VPM", gkFuncRefGet, result);
  }
  return result;
}

int SetVPMTollingNodeInfoParams(LONG packetHandle, struct VPMTollingNodeInfo value, char oldPath[])
{
  char newPath[300];
  int result;

  result = 0;

  snprintf(newPath, elcount(newPath), "%s.%s", oldPath, "id");
  if(value.id.isValidFlag==1)
  {
    C2xSetTokenInt64(packetHandle, "VPM", newPath, value.id.value);
    result = CheckLastError("VPM", gkFuncRefGet, result);
  }
  else
  {
    if( C2xIsTokenAvailable(packetHandle, "VPM", newPath) )
    {
      C2xRemoveToken(packetHandle, "VPM", newPath);
    }
  }

  snprintf(newPath, elcount(newPath), "%s.%s", oldPath, "pos");
  if(value.pos.isValidFlag==1)
  {
    SetVPMPosition3DParams(packetHandle, value.pos, newPath);
    result = CheckLastError("VPM", gkFuncRefGet, result);
  }
  else
  {
    if( C2xIsTokenAvailable(packetHandle, "VPM", newPath) )
    {
      C2xRemoveToken(packetHandle, "VPM", newPath);
    }
  }

  snprintf(newPath, elcount(newPath), "%s.%s", oldPath, "tollingNodeType");
  if(value.tollingNodeType.isValidFlag==1)
  {
    C2xSetTokenInt(packetHandle, "VPM", newPath, value.tollingNodeType.value);
    result = CheckLastError("VPM", gkFuncRefGet, result);
  }
  else
  {
    if( C2xIsTokenAvailable(packetHandle, "VPM", newPath) )
    {
      C2xRemoveToken(packetHandle, "VPM", newPath);
    }
  }

  snprintf(newPath, elcount(newPath), "%s.%s", oldPath, "tollingDirection");
  if(value.tollingDirection.isValidFlag==1)
  {
    C2xSetTokenInt(packetHandle, "VPM", newPath, value.tollingDirection.value);
    result = CheckLastError("VPM", gkFuncRefGet, result);
  }
  else
  {
    if( C2xIsTokenAvailable(packetHandle, "VPM", newPath) )
    {
      C2xRemoveToken(packetHandle, "VPM", newPath);
    }
  }

  return result;
}

int GetVPMPosition_LL_24BParams(LONG packetHandle, struct VPMPosition_LL_24B value, char oldPath[])
{
  char newPath[300];
  int result;

  result = 0;

  snprintf(newPath, elcount(newPath), "%s.%s", oldPath, "lon");
  value.lon = C2xGetTokenInt(packetHandle, "VPM", newPath);
  result = CheckLastError("VPM", gkFuncRefGet, result);

  snprintf(newPath, elcount(newPath), "%s.%s", oldPath, "lat");
  value.lat = C2xGetTokenInt(packetHandle, "VPM", newPath);
  result = CheckLastError("VPM", gkFuncRefGet, result);

  return result;
}

int SetVPMPosition_LL_24BParams(LONG packetHandle, struct VPMPosition_LL_24B value, char oldPath[])
{
  char newPath[300];
  int result;

  result = 0;

  snprintf(newPath, elcount(newPath), "%s.%s", oldPath, "lon");
  C2xSetTokenInt(packetHandle, "VPM", newPath, value.lon);
  result = CheckLastError("VPM", gkFuncRefGet, result);

  snprintf(newPath, elcount(newPath), "%s.%s", oldPath, "lat");
  C2xSetTokenInt(packetHandle, "VPM", newPath, value.lat);
  result = CheckLastError("VPM", gkFuncRefGet, result);

  return result;
}

int GetVPMPosition_LL_28BParams(LONG packetHandle, struct VPMPosition_LL_28B value, char oldPath[])
{
  char newPath[300];
  int result;

  result = 0;

  snprintf(newPath, elcount(newPath), "%s.%s", oldPath, "lon");
  value.lon = C2xGetTokenInt(packetHandle, "VPM", newPath);
  result = CheckLastError("VPM", gkFuncRefGet, result);

  snprintf(newPath, elcount(newPath), "%s.%s", oldPath, "lat");
  value.lat = C2xGetTokenInt(packetHandle, "VPM", newPath);
  result = CheckLastError("VPM", gkFuncRefGet, result);

  return result;
}

int SetVPMPosition_LL_28BParams(LONG packetHandle, struct VPMPosition_LL_28B value, char oldPath[])
{
  char newPath[300];
  int result;

  result = 0;

  snprintf(newPath, elcount(newPath), "%s.%s", oldPath, "lon");
  C2xSetTokenInt(packetHandle, "VPM", newPath, value.lon);
  result = CheckLastError("VPM", gkFuncRefGet, result);

  snprintf(newPath, elcount(newPath), "%s.%s", oldPath, "lat");
  C2xSetTokenInt(packetHandle, "VPM", newPath, value.lat);
  result = CheckLastError("VPM", gkFuncRefGet, result);

  return result;
}

int GetVPMPosition_LL_32BParams(LONG packetHandle, struct VPMPosition_LL_32B value, char oldPath[])
{
  char newPath[300];
  int result;

  result = 0;

  snprintf(newPath, elcount(newPath), "%s.%s", oldPath, "lon");
  value.lon = C2xGetTokenInt(packetHandle, "VPM", newPath);
  result = CheckLastError("VPM", gkFuncRefGet, result);

  snprintf(newPath, elcount(newPath), "%s.%s", oldPath, "lat");
  value.lat = C2xGetTokenInt(packetHandle, "VPM", newPath);
  result = CheckLastError("VPM", gkFuncRefGet, result);

  return result;
}

int SetVPMPosition_LL_32BParams(LONG packetHandle, struct VPMPosition_LL_32B value, char oldPath[])
{
  char newPath[300];
  int result;

  result = 0;

  snprintf(newPath, elcount(newPath), "%s.%s", oldPath, "lon");
  C2xSetTokenInt(packetHandle, "VPM", newPath, value.lon);
  result = CheckLastError("VPM", gkFuncRefGet, result);

  snprintf(newPath, elcount(newPath), "%s.%s", oldPath, "lat");
  C2xSetTokenInt(packetHandle, "VPM", newPath, value.lat);
  result = CheckLastError("VPM", gkFuncRefGet, result);

  return result;
}

int GetVPMPosition_LL_36BParams(LONG packetHandle, struct VPMPosition_LL_36B value, char oldPath[])
{
  char newPath[300];
  int result;

  result = 0;

  snprintf(newPath, elcount(newPath), "%s.%s", oldPath, "lon");
  value.lon = C2xGetTokenInt(packetHandle, "VPM", newPath);
  result = CheckLastError("VPM", gkFuncRefGet, result);

  snprintf(newPath, elcount(newPath), "%s.%s", oldPath, "lat");
  value.lat = C2xGetTokenInt(packetHandle, "VPM", newPath);
  result = CheckLastError("VPM", gkFuncRefGet, result);

  return result;
}

int SetVPMPosition_LL_36BParams(LONG packetHandle, struct VPMPosition_LL_36B value, char oldPath[])
{
  char newPath[300];
  int result;

  result = 0;

  snprintf(newPath, elcount(newPath), "%s.%s", oldPath, "lon");
  C2xSetTokenInt(packetHandle, "VPM", newPath, value.lon);
  result = CheckLastError("VPM", gkFuncRefGet, result);

  snprintf(newPath, elcount(newPath), "%s.%s", oldPath, "lat");
  C2xSetTokenInt(packetHandle, "VPM", newPath, value.lat);
  result = CheckLastError("VPM", gkFuncRefGet, result);

  return result;
}

int GetVPMPosition_LL_44BParams(LONG packetHandle, struct VPMPosition_LL_44B value, char oldPath[])
{
  char newPath[300];
  int result;

  result = 0;

  snprintf(newPath, elcount(newPath), "%s.%s", oldPath, "lon");
  value.lon = C2xGetTokenInt(packetHandle, "VPM", newPath);
  result = CheckLastError("VPM", gkFuncRefGet, result);

  snprintf(newPath, elcount(newPath), "%s.%s", oldPath, "lat");
  value.lat = C2xGetTokenInt(packetHandle, "VPM", newPath);
  result = CheckLastError("VPM", gkFuncRefGet, result);

  return result;
}

int SetVPMPosition_LL_44BParams(LONG packetHandle, struct VPMPosition_LL_44B value, char oldPath[])
{
  char newPath[300];
  int result;

  result = 0;

  snprintf(newPath, elcount(newPath), "%s.%s", oldPath, "lon");
  C2xSetTokenInt(packetHandle, "VPM", newPath, value.lon);
  result = CheckLastError("VPM", gkFuncRefGet, result);

  snprintf(newPath, elcount(newPath), "%s.%s", oldPath, "lat");
  C2xSetTokenInt(packetHandle, "VPM", newPath, value.lat);
  result = CheckLastError("VPM", gkFuncRefGet, result);

  return result;
}

int GetVPMPosition_LL_48BParams(LONG packetHandle, struct VPMPosition_LL_48B value, char oldPath[])
{
  char newPath[300];
  int result;

  result = 0;

  snprintf(newPath, elcount(newPath), "%s.%s", oldPath, "lon");
  value.lon = C2xGetTokenInt(packetHandle, "VPM", newPath);
  result = CheckLastError("VPM", gkFuncRefGet, result);

  snprintf(newPath, elcount(newPath), "%s.%s", oldPath, "lat");
  value.lat = C2xGetTokenInt(packetHandle, "VPM", newPath);
  result = CheckLastError("VPM", gkFuncRefGet, result);

  return result;
}

int SetVPMPosition_LL_48BParams(LONG packetHandle, struct VPMPosition_LL_48B value, char oldPath[])
{
  char newPath[300];
  int result;

  result = 0;

  snprintf(newPath, elcount(newPath), "%s.%s", oldPath, "lon");
  C2xSetTokenInt(packetHandle, "VPM", newPath, value.lon);
  result = CheckLastError("VPM", gkFuncRefGet, result);

  snprintf(newPath, elcount(newPath), "%s.%s", oldPath, "lat");
  C2xSetTokenInt(packetHandle, "VPM", newPath, value.lat);
  result = CheckLastError("VPM", gkFuncRefGet, result);

  return result;
}

int GetVPMPosition_LLmD_64bParams(LONG packetHandle, struct VPMPosition_LLmD_64b value, char oldPath[])
{
  char newPath[300];
  int result;

  result = 0;

  snprintf(newPath, elcount(newPath), "%s.%s", oldPath, "lon");
  value.lon = C2xGetTokenInt(packetHandle, "VPM", newPath);
  result = CheckLastError("VPM", gkFuncRefGet, result);

  snprintf(newPath, elcount(newPath), "%s.%s", oldPath, "lat");
  value.lat = C2xGetTokenInt(packetHandle, "VPM", newPath);
  result = CheckLastError("VPM", gkFuncRefGet, result);

  return result;
}

int SetVPMPosition_LLmD_64bParams(LONG packetHandle, struct VPMPosition_LLmD_64b value, char oldPath[])
{
  char newPath[300];
  int result;

  result = 0;

  snprintf(newPath, elcount(newPath), "%s.%s", oldPath, "lon");
  C2xSetTokenInt(packetHandle, "VPM", newPath, value.lon);
  result = CheckLastError("VPM", gkFuncRefGet, result);

  snprintf(newPath, elcount(newPath), "%s.%s", oldPath, "lat");
  C2xSetTokenInt(packetHandle, "VPM", newPath, value.lat);
  result = CheckLastError("VPM", gkFuncRefGet, result);

  return result;
}

int GetVPMPositionOffsetLLParams(LONG packetHandle, struct VPMPositionOffsetLL value, char oldPath[])
{
  char newPath[300];
  int result;

  result = 0;

  value.choice = C2xGetTokenInt(packetHandle, "VPM", oldPath);

  switch(value.choice)
  {
    case 0:
    {
      snprintf(newPath, elcount(newPath), "%s.%s", oldPath, "position_LL1");
      GetVPMPosition_LL_24BParams(packetHandle, value.position_LL1, newPath);
      result = CheckLastError("VPM", gkFuncRefGet, result);
    }
    break;
    case 1:
    {
      snprintf(newPath, elcount(newPath), "%s.%s", oldPath, "position_LL2");
      GetVPMPosition_LL_28BParams(packetHandle, value.position_LL2, newPath);
      result = CheckLastError("VPM", gkFuncRefGet, result);
    }
    break;
    case 2:
    {
      snprintf(newPath, elcount(newPath), "%s.%s", oldPath, "position_LL3");
      GetVPMPosition_LL_32BParams(packetHandle, value.position_LL3, newPath);
      result = CheckLastError("VPM", gkFuncRefGet, result);
    }
    break;
    case 3:
    {
      snprintf(newPath, elcount(newPath), "%s.%s", oldPath, "position_LL4");
      GetVPMPosition_LL_36BParams(packetHandle, value.position_LL4, newPath);
      result = CheckLastError("VPM", gkFuncRefGet, result);
    }
    break;
    case 4:
    {
      snprintf(newPath, elcount(newPath), "%s.%s", oldPath, "position_LL5");
      GetVPMPosition_LL_44BParams(packetHandle, value.position_LL5, newPath);
      result = CheckLastError("VPM", gkFuncRefGet, result);
    }
    break;
    case 5:
    {
      snprintf(newPath, elcount(newPath), "%s.%s", oldPath, "position_LL6");
      GetVPMPosition_LL_48BParams(packetHandle, value.position_LL6, newPath);
      result = CheckLastError("VPM", gkFuncRefGet, result);
    }
    break;
    case 6:
    {
      snprintf(newPath, elcount(newPath), "%s.%s", oldPath, "position_LatLon");
      GetVPMPosition_LLmD_64bParams(packetHandle, value.position_LatLon, newPath);
      result = CheckLastError("VPM", gkFuncRefGet, result);
    }
    break;
  }
  return result;
}

int SetVPMPositionOffsetLLParams(LONG packetHandle, struct VPMPositionOffsetLL value, char oldPath[])
{
  char newPath[300];
  int result;

  result = 0;

  switch(value.choice)
  {
    case 0:
    {
      snprintf(newPath, elcount(newPath), "%s.%s", oldPath, "position_LL1");
      SetVPMPosition_LL_24BParams(packetHandle, value.position_LL1, newPath);
      result = CheckLastError("VPM", gkFuncRefGet, result);
    }
    break;
    case 1:
    {
      snprintf(newPath, elcount(newPath), "%s.%s", oldPath, "position_LL2");
      SetVPMPosition_LL_28BParams(packetHandle, value.position_LL2, newPath);
      result = CheckLastError("VPM", gkFuncRefGet, result);
    }
    break;
    case 2:
    {
      snprintf(newPath, elcount(newPath), "%s.%s", oldPath, "position_LL3");
      SetVPMPosition_LL_32BParams(packetHandle, value.position_LL3, newPath);
      result = CheckLastError("VPM", gkFuncRefGet, result);
    }
    break;
    case 3:
    {
      snprintf(newPath, elcount(newPath), "%s.%s", oldPath, "position_LL4");
      SetVPMPosition_LL_36BParams(packetHandle, value.position_LL4, newPath);
      result = CheckLastError("VPM", gkFuncRefGet, result);
    }
    break;
    case 4:
    {
      snprintf(newPath, elcount(newPath), "%s.%s", oldPath, "position_LL5");
      SetVPMPosition_LL_44BParams(packetHandle, value.position_LL5, newPath);
      result = CheckLastError("VPM", gkFuncRefGet, result);
    }
    break;
    case 5:
    {
      snprintf(newPath, elcount(newPath), "%s.%s", oldPath, "position_LL6");
      SetVPMPosition_LL_48BParams(packetHandle, value.position_LL6, newPath);
      result = CheckLastError("VPM", gkFuncRefGet, result);
    }
    break;
    case 6:
    {
      snprintf(newPath, elcount(newPath), "%s.%s", oldPath, "position_LatLon");
      SetVPMPosition_LLmD_64bParams(packetHandle, value.position_LatLon, newPath);
      result = CheckLastError("VPM", gkFuncRefGet, result);
    }
    break;
  }
  return result;
}

int GetVPMVerticalOffsetParams(LONG packetHandle, struct VPMVerticalOffset value, char oldPath[])
{
  char newPath[300];
  int result;

  result = 0;

  value.choice = C2xGetTokenInt(packetHandle, "VPM", oldPath);

  switch(value.choice)
  {
    case 0:
    {
      snprintf(newPath, elcount(newPath), "%s.%s", oldPath, "offset1");
      value.offset1 = C2xGetTokenInt(packetHandle, "VPM", newPath);
      result = CheckLastError("VPM", gkFuncRefGet, result);
    }
    break;
    case 1:
    {
      snprintf(newPath, elcount(newPath), "%s.%s", oldPath, "offset2");
      value.offset2 = C2xGetTokenInt(packetHandle, "VPM", newPath);
      result = CheckLastError("VPM", gkFuncRefGet, result);
    }
    break;
    case 2:
    {
      snprintf(newPath, elcount(newPath), "%s.%s", oldPath, "offset3");
      value.offset3 = C2xGetTokenInt(packetHandle, "VPM", newPath);
      result = CheckLastError("VPM", gkFuncRefGet, result);
    }
    break;
    case 3:
    {
      snprintf(newPath, elcount(newPath), "%s.%s", oldPath, "offset4");
      value.offset4 = C2xGetTokenInt(packetHandle, "VPM", newPath);
      result = CheckLastError("VPM", gkFuncRefGet, result);
    }
    break;
    case 4:
    {
      snprintf(newPath, elcount(newPath), "%s.%s", oldPath, "offset5");
      value.offset5 = C2xGetTokenInt(packetHandle, "VPM", newPath);
      result = CheckLastError("VPM", gkFuncRefGet, result);
    }
    break;
    case 5:
    {
      snprintf(newPath, elcount(newPath), "%s.%s", oldPath, "offset6");
      value.offset6 = C2xGetTokenInt(packetHandle, "VPM", newPath);
      result = CheckLastError("VPM", gkFuncRefGet, result);
    }
    break;
    case 6:
    {
      snprintf(newPath, elcount(newPath), "%s.%s", oldPath, "elevation");
      value.elevation = C2xGetTokenInt(packetHandle, "VPM", newPath);
      result = CheckLastError("VPM", gkFuncRefGet, result);
    }
    break;
  }
  return result;
}

int SetVPMVerticalOffsetParams(LONG packetHandle, struct VPMVerticalOffset value, char oldPath[])
{
  char newPath[300];
  int result;

  result = 0;

  switch(value.choice)
  {
    case 0:
    {
      snprintf(newPath, elcount(newPath), "%s.%s", oldPath, "offset1");
      C2xSetTokenInt(packetHandle, "VPM", newPath, value.offset1);
      result = CheckLastError("VPM", gkFuncRefGet, result);
    }
    break;
    case 1:
    {
      snprintf(newPath, elcount(newPath), "%s.%s", oldPath, "offset2");
      C2xSetTokenInt(packetHandle, "VPM", newPath, value.offset2);
      result = CheckLastError("VPM", gkFuncRefGet, result);
    }
    break;
    case 2:
    {
      snprintf(newPath, elcount(newPath), "%s.%s", oldPath, "offset3");
      C2xSetTokenInt(packetHandle, "VPM", newPath, value.offset3);
      result = CheckLastError("VPM", gkFuncRefGet, result);
    }
    break;
    case 3:
    {
      snprintf(newPath, elcount(newPath), "%s.%s", oldPath, "offset4");
      C2xSetTokenInt(packetHandle, "VPM", newPath, value.offset4);
      result = CheckLastError("VPM", gkFuncRefGet, result);
    }
    break;
    case 4:
    {
      snprintf(newPath, elcount(newPath), "%s.%s", oldPath, "offset5");
      C2xSetTokenInt(packetHandle, "VPM", newPath, value.offset5);
      result = CheckLastError("VPM", gkFuncRefGet, result);
    }
    break;
    case 5:
    {
      snprintf(newPath, elcount(newPath), "%s.%s", oldPath, "offset6");
      C2xSetTokenInt(packetHandle, "VPM", newPath, value.offset6);
      result = CheckLastError("VPM", gkFuncRefGet, result);
    }
    break;
    case 6:
    {
      snprintf(newPath, elcount(newPath), "%s.%s", oldPath, "elevation");
      C2xSetTokenInt(packetHandle, "VPM", newPath, value.elevation);
      result = CheckLastError("VPM", gkFuncRefGet, result);
    }
    break;
  }
  return result;
}

int GetVPMPositionOffsetLLVParams(LONG packetHandle, struct VPMPositionOffsetLLV value, char oldPath[])
{
  char newPath[300];
  int result;

  result = 0;

  snprintf(newPath, elcount(newPath), "%s.%s", oldPath, "offsetLL");
  GetVPMPositionOffsetLLParams(packetHandle, value.offsetLL, newPath);
  result = CheckLastError("VPM", gkFuncRefGet, result);

  snprintf(newPath, elcount(newPath), "%s.%s", oldPath, "offsetV");
  value.offsetV.isValidFlag = C2xIsTokenAvailable(packetHandle, "VPM", newPath);
  if(value.offsetV.isValidFlag==1)
  {
    GetVPMVerticalOffsetParams(packetHandle, value.offsetV, newPath);
    result = CheckLastError("VPM", gkFuncRefGet, result);
  }
  return result;
}

int SetVPMPositionOffsetLLVParams(LONG packetHandle, struct VPMPositionOffsetLLV value, char oldPath[])
{
  char newPath[300];
  int result;

  result = 0;

  snprintf(newPath, elcount(newPath), "%s.%s", oldPath, "offsetLL");
  SetVPMPositionOffsetLLParams(packetHandle, value.offsetLL, newPath);
  result = CheckLastError("VPM", gkFuncRefGet, result);

  snprintf(newPath, elcount(newPath), "%s.%s", oldPath, "offsetV");
  if(value.offsetV.isValidFlag==1)
  {
    SetVPMVerticalOffsetParams(packetHandle, value.offsetV, newPath);
    result = CheckLastError("VPM", gkFuncRefGet, result);
  }
  else
  {
    if( C2xIsTokenAvailable(packetHandle, "VPM", newPath) )
    {
      C2xRemoveToken(packetHandle, "VPM", newPath);
    }
  }

  return result;
}

int GetVPMNodeReferenceIDParams(LONG packetHandle, struct VPMNodeReferenceID value, char oldPath[])
{
  char newPath[300];
  int result;

  result = 0;

  snprintf(newPath, elcount(newPath), "%s.%s", oldPath, "region");
  value.region.isValidFlag = C2xIsTokenAvailable(packetHandle, "VPM", newPath);
  if(value.region.isValidFlag==1)
  {
    value.region.value = C2xGetTokenInt(packetHandle, "VPM", newPath);
    result = CheckLastError("VPM", gkFuncRefGet, result);
  }
  snprintf(newPath, elcount(newPath), "%s.%s", oldPath, "id");
  value.id = C2xGetTokenInt(packetHandle, "VPM", newPath);
  result = CheckLastError("VPM", gkFuncRefGet, result);

  return result;
}

int SetVPMNodeReferenceIDParams(LONG packetHandle, struct VPMNodeReferenceID value, char oldPath[])
{
  char newPath[300];
  int result;

  result = 0;

  snprintf(newPath, elcount(newPath), "%s.%s", oldPath, "region");
  if(value.region.isValidFlag==1)
  {
    C2xSetTokenInt(packetHandle, "VPM", newPath, value.region.value);
    result = CheckLastError("VPM", gkFuncRefGet, result);
  }
  else
  {
    if( C2xIsTokenAvailable(packetHandle, "VPM", newPath) )
    {
      C2xRemoveToken(packetHandle, "VPM", newPath);
    }
  }

  snprintf(newPath, elcount(newPath), "%s.%s", oldPath, "id");
  C2xSetTokenInt(packetHandle, "VPM", newPath, value.id);
  result = CheckLastError("VPM", gkFuncRefGet, result);

  return result;
}

int GetVPMTollInfo_tollRoadParams(LONG packetHandle, struct VPMTollInfo_tollRoad value, char oldPath[])
{
  char newPath[300]; 
  int i;
  int result;

  result = 0;

  value.length = C2xGetTokenInt(packetHandle, "VPM", oldPath);
  if((result = CheckLastError("VPM", gkFuncRefGet, result))==0)
  {
    for(i=0; i<value.length; i++)
    {
      snprintf(newPath, elcount(newPath), "%s[%d]", oldPath, i);
      GetVPMNodeReferenceIDParams(packetHandle, value.arrayValue[i], newPath);
      result = CheckLastError("VPM", gkFuncRefGet, result);
    }
  }
  return result;
}

int SetVPMTollInfo_tollRoadParams(LONG packetHandle, struct VPMTollInfo_tollRoad value, char oldPath[])
{
  char newPath[300]; 
  int i;
  int result;

  result = 0;

  C2xRemoveToken(packetHandle, "VPM", oldPath);
  for(i=0; i<value.length; i++)
  {
    snprintf(newPath, elcount(newPath), "%s[%d]", oldPath, i);
    SetVPMNodeReferenceIDParams(packetHandle, value.arrayValue[i], newPath);
    result = CheckLastError("VPM", gkFuncRefGet, result);
  }
  return result;
}

int GetVPMPathPointListParams(LONG packetHandle, struct VPMPathPointList value, char oldPath[])
{
  char newPath[300]; 
  int i;
  int result;

  result = 0;

  value.length = C2xGetTokenInt(packetHandle, "VPM", oldPath);
  if((result = CheckLastError("VPM", gkFuncRefGet, result))==0)
  {
    for(i=0; i<value.length; i++)
    {
      snprintf(newPath, elcount(newPath), "%s[%d]", oldPath, i);
      GetVPMPositionOffsetLLVParams(packetHandle, value.arrayValue[i], newPath);
      result = CheckLastError("VPM", gkFuncRefGet, result);
    }
  }
  return result;
}

int SetVPMPathPointListParams(LONG packetHandle, struct VPMPathPointList value, char oldPath[])
{
  char newPath[300]; 
  int i;
  int result;

  result = 0;

  C2xRemoveToken(packetHandle, "VPM", oldPath);
  for(i=0; i<value.length; i++)
  {
    snprintf(newPath, elcount(newPath), "%s[%d]", oldPath, i);
    SetVPMPositionOffsetLLVParams(packetHandle, value.arrayValue[i], newPath);
    result = CheckLastError("VPM", gkFuncRefGet, result);
  }
  return result;
}

int GetVPMReferencePathParams(LONG packetHandle, struct VPMReferencePath value, char oldPath[])
{
  char newPath[300];
  int result;

  result = 0;

  snprintf(newPath, elcount(newPath), "%s.%s", oldPath, "activePath");
  GetVPMPathPointListParams(packetHandle, value.activePath, newPath);
  result = CheckLastError("VPM", gkFuncRefGet, result);

  snprintf(newPath, elcount(newPath), "%s.%s", oldPath, "pathRadius");
  value.pathRadius = C2xGetTokenInt(packetHandle, "VPM", newPath);
  result = CheckLastError("VPM", gkFuncRefGet, result);

  return result;
}

int SetVPMReferencePathParams(LONG packetHandle, struct VPMReferencePath value, char oldPath[])
{
  char newPath[300];
  int result;

  result = 0;

  snprintf(newPath, elcount(newPath), "%s.%s", oldPath, "activePath");
  SetVPMPathPointListParams(packetHandle, value.activePath, newPath);
  result = CheckLastError("VPM", gkFuncRefGet, result);

  snprintf(newPath, elcount(newPath), "%s.%s", oldPath, "pathRadius");
  C2xSetTokenInt(packetHandle, "VPM", newPath, value.pathRadius);
  result = CheckLastError("VPM", gkFuncRefGet, result);

  return result;
}

int GetVPMTollInfoParams(LONG packetHandle, struct VPMTollInfo value, char oldPath[])
{
  char newPath[300];
  int result;

  result = 0;

  snprintf(newPath, elcount(newPath), "%s.%s", oldPath, "price");
  value.price.isValidFlag = C2xIsTokenAvailable(packetHandle, "VPM", newPath);
  if(value.price.isValidFlag==1)
  {
    value.price.value = C2xGetTokenInt(packetHandle, "VPM", newPath);
    result = CheckLastError("VPM", gkFuncRefGet, result);
  }
  snprintf(newPath, elcount(newPath), "%s.%s", oldPath, "entrancePos");
  value.entrancePos.isValidFlag = C2xIsTokenAvailable(packetHandle, "VPM", newPath);
  if(value.entrancePos.isValidFlag==1)
  {
    GetVPMPositionOffsetLLVParams(packetHandle, value.entrancePos, newPath);
    result = CheckLastError("VPM", gkFuncRefGet, result);
  }
  snprintf(newPath, elcount(newPath), "%s.%s", oldPath, "exitPos");
  value.exitPos.isValidFlag = C2xIsTokenAvailable(packetHandle, "VPM", newPath);
  if(value.exitPos.isValidFlag==1)
  {
    GetVPMPositionOffsetLLVParams(packetHandle, value.exitPos, newPath);
    result = CheckLastError("VPM", gkFuncRefGet, result);
  }
  snprintf(newPath, elcount(newPath), "%s.%s", oldPath, "tollRoad");
  value.tollRoad.isValidFlag = C2xIsTokenAvailable(packetHandle, "VPM", newPath);
  if(value.tollRoad.isValidFlag==1)
  {
    GetVPMTollInfo_tollRoadParams(packetHandle, value.tollRoad, newPath);
    result = CheckLastError("VPM", gkFuncRefGet, result);
  }
  snprintf(newPath, elcount(newPath), "%s.%s", oldPath, "tollPath");
  value.tollPath.isValidFlag = C2xIsTokenAvailable(packetHandle, "VPM", newPath);
  if(value.tollPath.isValidFlag==1)
  {
    GetVPMReferencePathParams(packetHandle, value.tollPath, newPath);
    result = CheckLastError("VPM", gkFuncRefGet, result);
  }
  snprintf(newPath, elcount(newPath), "%s.%s", oldPath, "timeBegin");
  value.timeBegin.isValidFlag = C2xIsTokenAvailable(packetHandle, "VPM", newPath);
  if(value.timeBegin.isValidFlag==1)
  {
    GetVPMDDateTimeParams(packetHandle, value.timeBegin, newPath);
    result = CheckLastError("VPM", gkFuncRefGet, result);
  }
  snprintf(newPath, elcount(newPath), "%s.%s", oldPath, "timeEnd");
  value.timeEnd.isValidFlag = C2xIsTokenAvailable(packetHandle, "VPM", newPath);
  if(value.timeEnd.isValidFlag==1)
  {
    GetVPMDDateTimeParams(packetHandle, value.timeEnd, newPath);
    result = CheckLastError("VPM", gkFuncRefGet, result);
  }
  return result;
}

int SetVPMTollInfoParams(LONG packetHandle, struct VPMTollInfo value, char oldPath[])
{
  char newPath[300];
  int result;

  result = 0;

  snprintf(newPath, elcount(newPath), "%s.%s", oldPath, "price");
  if(value.price.isValidFlag==1)
  {
    C2xSetTokenInt(packetHandle, "VPM", newPath, value.price.value);
    result = CheckLastError("VPM", gkFuncRefGet, result);
  }
  else
  {
    if( C2xIsTokenAvailable(packetHandle, "VPM", newPath) )
    {
      C2xRemoveToken(packetHandle, "VPM", newPath);
    }
  }

  snprintf(newPath, elcount(newPath), "%s.%s", oldPath, "entrancePos");
  if(value.entrancePos.isValidFlag==1)
  {
    SetVPMPositionOffsetLLVParams(packetHandle, value.entrancePos, newPath);
    result = CheckLastError("VPM", gkFuncRefGet, result);
  }
  else
  {
    if( C2xIsTokenAvailable(packetHandle, "VPM", newPath) )
    {
      C2xRemoveToken(packetHandle, "VPM", newPath);
    }
  }

  snprintf(newPath, elcount(newPath), "%s.%s", oldPath, "exitPos");
  if(value.exitPos.isValidFlag==1)
  {
    SetVPMPositionOffsetLLVParams(packetHandle, value.exitPos, newPath);
    result = CheckLastError("VPM", gkFuncRefGet, result);
  }
  else
  {
    if( C2xIsTokenAvailable(packetHandle, "VPM", newPath) )
    {
      C2xRemoveToken(packetHandle, "VPM", newPath);
    }
  }

  snprintf(newPath, elcount(newPath), "%s.%s", oldPath, "tollRoad");
  if(value.tollRoad.isValidFlag==1)
  {
    SetVPMTollInfo_tollRoadParams(packetHandle, value.tollRoad, newPath);
    result = CheckLastError("VPM", gkFuncRefGet, result);
  }
  else
  {
    if( C2xIsTokenAvailable(packetHandle, "VPM", newPath) )
    {
      C2xRemoveToken(packetHandle, "VPM", newPath);
    }
  }

  snprintf(newPath, elcount(newPath), "%s.%s", oldPath, "tollPath");
  if(value.tollPath.isValidFlag==1)
  {
    SetVPMReferencePathParams(packetHandle, value.tollPath, newPath);
    result = CheckLastError("VPM", gkFuncRefGet, result);
  }
  else
  {
    if( C2xIsTokenAvailable(packetHandle, "VPM", newPath) )
    {
      C2xRemoveToken(packetHandle, "VPM", newPath);
    }
  }

  snprintf(newPath, elcount(newPath), "%s.%s", oldPath, "timeBegin");
  if(value.timeBegin.isValidFlag==1)
  {
    SetVPMDDateTimeParams(packetHandle, value.timeBegin, newPath);
    result = CheckLastError("VPM", gkFuncRefGet, result);
  }
  else
  {
    if( C2xIsTokenAvailable(packetHandle, "VPM", newPath) )
    {
      C2xRemoveToken(packetHandle, "VPM", newPath);
    }
  }

  snprintf(newPath, elcount(newPath), "%s.%s", oldPath, "timeEnd");
  if(value.timeEnd.isValidFlag==1)
  {
    SetVPMDDateTimeParams(packetHandle, value.timeEnd, newPath);
    result = CheckLastError("VPM", gkFuncRefGet, result);
  }
  else
  {
    if( C2xIsTokenAvailable(packetHandle, "VPM", newPath) )
    {
      C2xRemoveToken(packetHandle, "VPM", newPath);
    }
  }

  return result;
}

int GetVPMPaymentInfoType1Params(LONG packetHandle, struct VPMPaymentInfoType1 value, char oldPath[])
{
  char newPath[300];
  int result;

  result = 0;

  snprintf(newPath, elcount(newPath), "%s.%s", oldPath, "tollingNodeInfo");
  value.tollingNodeInfo.isValidFlag = C2xIsTokenAvailable(packetHandle, "VPM", newPath);
  if(value.tollingNodeInfo.isValidFlag==1)
  {
    GetVPMTollingNodeInfoParams(packetHandle, value.tollingNodeInfo, newPath);
    result = CheckLastError("VPM", gkFuncRefGet, result);
  }
  snprintf(newPath, elcount(newPath), "%s.%s", oldPath, "tollInfo");
  value.tollInfo.isValidFlag = C2xIsTokenAvailable(packetHandle, "VPM", newPath);
  if(value.tollInfo.isValidFlag==1)
  {
    GetVPMTollInfoParams(packetHandle, value.tollInfo, newPath);
    result = CheckLastError("VPM", gkFuncRefGet, result);
  }
  snprintf(newPath, elcount(newPath), "%s.%s", oldPath, "serviceInfo");
  value.serviceInfo.isValidFlag = C2xIsTokenAvailable(packetHandle, "VPM", newPath);
  if(value.serviceInfo.isValidFlag==1)
  {
    value.serviceInfo.isValidFlag = 1;
    value.serviceInfo.stringLength = C2xGetTokenData(packetHandle, "VPM", newPath, elcount(value.serviceInfo.string), value.serviceInfo.string);
  }
  return result;
}

int SetVPMPaymentInfoType1Params(LONG packetHandle, struct VPMPaymentInfoType1 value, char oldPath[])
{
  char newPath[300];
  int result;

  result = 0;

  snprintf(newPath, elcount(newPath), "%s.%s", oldPath, "tollingNodeInfo");
  if(value.tollingNodeInfo.isValidFlag==1)
  {
    SetVPMTollingNodeInfoParams(packetHandle, value.tollingNodeInfo, newPath);
    result = CheckLastError("VPM", gkFuncRefGet, result);
  }
  else
  {
    if( C2xIsTokenAvailable(packetHandle, "VPM", newPath) )
    {
      C2xRemoveToken(packetHandle, "VPM", newPath);
    }
  }

  snprintf(newPath, elcount(newPath), "%s.%s", oldPath, "tollInfo");
  if(value.tollInfo.isValidFlag==1)
  {
    SetVPMTollInfoParams(packetHandle, value.tollInfo, newPath);
    result = CheckLastError("VPM", gkFuncRefGet, result);
  }
  else
  {
    if( C2xIsTokenAvailable(packetHandle, "VPM", newPath) )
    {
      C2xRemoveToken(packetHandle, "VPM", newPath);
    }
  }

  snprintf(newPath, elcount(newPath), "%s.%s", oldPath, "serviceInfo");
  if(value.serviceInfo.isValidFlag==1)
  {
    C2xSetTokenData(packetHandle, "VPM", newPath, value.serviceInfo.stringLength, value.serviceInfo.string);
  }
  else
  {
    if( C2xIsTokenAvailable(packetHandle, "VPM", newPath) )
    {
      C2xRemoveToken(packetHandle, "VPM", newPath);
    }
  }

  return result;
}

int GetVPMPaymentInfoParams(LONG packetHandle, struct VPMPaymentInfo value, char oldPath[])
{
  char newPath[300];
  int result;

  result = 0;

  value.choice = C2xGetTokenInt(packetHandle, "VPM", oldPath);

  switch(value.choice)
  {
    case 0:
    {
      snprintf(newPath, elcount(newPath), "%s.%s", oldPath, "paymentInfoType1");
      GetVPMPaymentInfoType1Params(packetHandle, value.paymentInfoType1, newPath);
      result = CheckLastError("VPM", gkFuncRefGet, result);
    }
    break;
  }
  return result;
}

int SetVPMPaymentInfoParams(LONG packetHandle, struct VPMPaymentInfo value, char oldPath[])
{
  char newPath[300];
  int result;

  result = 0;

  switch(value.choice)
  {
    case 0:
    {
      snprintf(newPath, elcount(newPath), "%s.%s", oldPath, "paymentInfoType1");
      SetVPMPaymentInfoType1Params(packetHandle, value.paymentInfoType1, newPath);
      result = CheckLastError("VPM", gkFuncRefGet, result);
    }
    break;
  }
  return result;
}

int GetVPMApplicationParameterParams(LONG packetHandle, struct VPMApplicationParameter value, char oldPath[])
{
  char newPath[300];
  int result;

  result = 0;

  snprintf(newPath, elcount(newPath), "%s.%s", oldPath, "pid");
  value.pid = C2xGetTokenInt(packetHandle, "VPM", newPath);
  result = CheckLastError("VPM", gkFuncRefGet, result);

  snprintf(newPath, elcount(newPath), "%s.%s", oldPath, "paymentInfo");
  GetVPMPaymentInfoParams(packetHandle, value.paymentInfo, newPath);
  result = CheckLastError("VPM", gkFuncRefGet, result);

  return result;
}

int SetVPMApplicationParameterParams(LONG packetHandle, struct VPMApplicationParameter value, char oldPath[])
{
  char newPath[300];
  int result;

  result = 0;

  snprintf(newPath, elcount(newPath), "%s.%s", oldPath, "pid");
  C2xSetTokenInt(packetHandle, "VPM", newPath, value.pid);
  result = CheckLastError("VPM", gkFuncRefGet, result);

  snprintf(newPath, elcount(newPath), "%s.%s", oldPath, "paymentInfo");
  SetVPMPaymentInfoParams(packetHandle, value.paymentInfo, newPath);
  result = CheckLastError("VPM", gkFuncRefGet, result);

  return result;
}

int GetVPMPaymentListParams(LONG packetHandle, struct VPMPaymentList value, char oldPath[])
{
  char newPath[300]; 
  int i;
  int result;

  result = 0;

  value.length = C2xGetTokenInt(packetHandle, "VPM", oldPath);
  if((result = CheckLastError("VPM", gkFuncRefGet, result))==0)
  {
    for(i=0; i<value.length; i++)
    {
      snprintf(newPath, elcount(newPath), "%s[%d]", oldPath, i);
      GetVPMApplicationParameterParams(packetHandle, value.arrayValue[i], newPath);
      result = CheckLastError("VPM", gkFuncRefGet, result);
    }
  }
  return result;
}

int SetVPMPaymentListParams(LONG packetHandle, struct VPMPaymentList value, char oldPath[])
{
  char newPath[300]; 
  int i;
  int result;

  result = 0;

  C2xRemoveToken(packetHandle, "VPM", oldPath);
  for(i=0; i<value.length; i++)
  {
    snprintf(newPath, elcount(newPath), "%s[%d]", oldPath, i);
    SetVPMApplicationParameterParams(packetHandle, value.arrayValue[i], newPath);
    result = CheckLastError("VPM", gkFuncRefGet, result);
  }
  return result;
}

int GetVPMRSTParams(LONG packetHandle, struct VPMRST value, char oldPath[])
{
  char newPath[300];
  int result;

  result = 0;

  snprintf(newPath, elcount(newPath), "%s.%s", oldPath, "time");
  GetVPMDDateTimeParams(packetHandle, value.time, newPath);
  result = CheckLastError("VPM", gkFuncRefGet, result);

  snprintf(newPath, elcount(newPath), "%s.%s", oldPath, "id");
  value.id.stringLength = C2xGetTokenData(packetHandle, "VPM", newPath, elcount(value.id.string), value.id.string);
  snprintf(newPath, elcount(newPath), "%s.%s", oldPath, "paymentList");
  GetVPMPaymentListParams(packetHandle, value.paymentList, newPath);
  result = CheckLastError("VPM", gkFuncRefGet, result);

  return result;
}

int SetVPMRSTParams(LONG packetHandle, struct VPMRST value, char oldPath[])
{
  char newPath[300];
  int result;

  result = 0;

  snprintf(newPath, elcount(newPath), "%s.%s", oldPath, "time");
  SetVPMDDateTimeParams(packetHandle, value.time, newPath);
  result = CheckLastError("VPM", gkFuncRefGet, result);

  if(value.id.stringLength == 0)
  {
    value.id.stringLength = 8;
    memcpy(value.id.string, "00000000", value.id.stringLength);
  }

  snprintf(newPath, elcount(newPath), "%s.%s", oldPath, "id");
  C2xSetTokenData(packetHandle, "VPM", newPath, value.id.stringLength, value.id.string);

  snprintf(newPath, elcount(newPath), "%s.%s", oldPath, "paymentList");
  SetVPMPaymentListParams(packetHandle, value.paymentList, newPath);
  result = CheckLastError("VPM", gkFuncRefGet, result);

  return result;
}

int GetVPMOBUMotionStatusParams(LONG packetHandle, struct VPMOBUMotionStatus value, char oldPath[])
{
  char newPath[300];
  int result;

  result = 0;

  snprintf(newPath, elcount(newPath), "%s.%s", oldPath, "pos");
  value.pos.isValidFlag = C2xIsTokenAvailable(packetHandle, "VPM", newPath);
  if(value.pos.isValidFlag==1)
  {
    GetVPMPosition3DParams(packetHandle, value.pos, newPath);
    result = CheckLastError("VPM", gkFuncRefGet, result);
  }
  snprintf(newPath, elcount(newPath), "%s.%s", oldPath, "heading");
  value.heading.isValidFlag = C2xIsTokenAvailable(packetHandle, "VPM", newPath);
  if(value.heading.isValidFlag==1)
  {
    value.heading.value = C2xGetTokenInt(packetHandle, "VPM", newPath);
    result = CheckLastError("VPM", gkFuncRefGet, result);
  }
  snprintf(newPath, elcount(newPath), "%s.%s", oldPath, "speed");
  value.speed.isValidFlag = C2xIsTokenAvailable(packetHandle, "VPM", newPath);
  if(value.speed.isValidFlag==1)
  {
    value.speed.value = C2xGetTokenInt(packetHandle, "VPM", newPath);
    result = CheckLastError("VPM", gkFuncRefGet, result);
  }
  return result;
}

int SetVPMOBUMotionStatusParams(LONG packetHandle, struct VPMOBUMotionStatus value, char oldPath[])
{
  char newPath[300];
  int result;

  result = 0;

  snprintf(newPath, elcount(newPath), "%s.%s", oldPath, "pos");
  if(value.pos.isValidFlag==1)
  {
    SetVPMPosition3DParams(packetHandle, value.pos, newPath);
    result = CheckLastError("VPM", gkFuncRefGet, result);
  }
  else
  {
    if( C2xIsTokenAvailable(packetHandle, "VPM", newPath) )
    {
      C2xRemoveToken(packetHandle, "VPM", newPath);
    }
  }

  snprintf(newPath, elcount(newPath), "%s.%s", oldPath, "heading");
  if(value.heading.isValidFlag==1)
  {
    C2xSetTokenInt(packetHandle, "VPM", newPath, value.heading.value);
    result = CheckLastError("VPM", gkFuncRefGet, result);
  }
  else
  {
    if( C2xIsTokenAvailable(packetHandle, "VPM", newPath) )
    {
      C2xRemoveToken(packetHandle, "VPM", newPath);
    }
  }

  snprintf(newPath, elcount(newPath), "%s.%s", oldPath, "speed");
  if(value.speed.isValidFlag==1)
  {
    C2xSetTokenInt(packetHandle, "VPM", newPath, value.speed.value);
    result = CheckLastError("VPM", gkFuncRefGet, result);
  }
  else
  {
    if( C2xIsTokenAvailable(packetHandle, "VPM", newPath) )
    {
      C2xRemoveToken(packetHandle, "VPM", newPath);
    }
  }

  return result;
}

int GetVPMOBUInfoParams(LONG packetHandle, struct VPMOBUInfo value, char oldPath[])
{
  char newPath[300];
  int result;

  result = 0;

  snprintf(newPath, elcount(newPath), "%s.%s", oldPath, "obuType");
  value.obuType = C2xGetTokenInt(packetHandle, "VPM", newPath);
  result = CheckLastError("VPM", gkFuncRefGet, result);

  snprintf(newPath, elcount(newPath), "%s.%s", oldPath, "obuMotionStatus");
  value.obuMotionStatus.isValidFlag = C2xIsTokenAvailable(packetHandle, "VPM", newPath);
  if(value.obuMotionStatus.isValidFlag==1)
  {
    GetVPMOBUMotionStatusParams(packetHandle, value.obuMotionStatus, newPath);
    result = CheckLastError("VPM", gkFuncRefGet, result);
  }
  return result;
}

int SetVPMOBUInfoParams(LONG packetHandle, struct VPMOBUInfo value, char oldPath[])
{
  char newPath[300];
  int result;

  result = 0;

  snprintf(newPath, elcount(newPath), "%s.%s", oldPath, "obuType");
  C2xSetTokenInt(packetHandle, "VPM", newPath, value.obuType);
  result = CheckLastError("VPM", gkFuncRefGet, result);

  snprintf(newPath, elcount(newPath), "%s.%s", oldPath, "obuMotionStatus");
  if(value.obuMotionStatus.isValidFlag==1)
  {
    SetVPMOBUMotionStatusParams(packetHandle, value.obuMotionStatus, newPath);
    result = CheckLastError("VPM", gkFuncRefGet, result);
  }
  else
  {
    if( C2xIsTokenAvailable(packetHandle, "VPM", newPath) )
    {
      C2xRemoveToken(packetHandle, "VPM", newPath);
    }
  }

  return result;
}

int GetVPMGBICCInfoParams(LONG packetHandle, struct VPMGBICCInfo value, char oldPath[])
{
  char newPath[300];
  char buffer[300];
  int result;

  result = 0;

  snprintf(newPath, elcount(newPath), "%s.%s", oldPath, "iccIssueInfo");
  value.iccIssueInfo.stringLength = C2xGetTokenData(packetHandle, "VPM", newPath, elcount(value.iccIssueInfo.string), value.iccIssueInfo.string);
  snprintf(newPath, elcount(newPath), "%s.%s", oldPath, "iccUniTollInfo");
  value.iccUniTollInfo.stringLength = C2xGetTokenData(packetHandle, "VPM", newPath, elcount(value.iccUniTollInfo.string), value.iccUniTollInfo.string);
  snprintf(newPath, elcount(newPath), "%s.%s", oldPath, "iccBalance");
  value.iccBalance.stringLength = C2xGetTokenData(packetHandle, "VPM", newPath, elcount(value.iccBalance.string), value.iccBalance.string);
  return result;
}

int SetVPMGBICCInfoParams(LONG packetHandle, struct VPMGBICCInfo value, char oldPath[])
{
  char newPath[300];
  char buffer[300];
  int result;

  result = 0;

  snprintf(newPath, elcount(newPath), "%s.%s", oldPath, "iccIssueInfo");
  C2xSetTokenData(packetHandle, "VPM", newPath, value.iccIssueInfo.stringLength, value.iccIssueInfo.string);

  snprintf(newPath, elcount(newPath), "%s.%s", oldPath, "iccUniTollInfo");
  C2xSetTokenData(packetHandle, "VPM", newPath, value.iccUniTollInfo.stringLength, value.iccUniTollInfo.string);

  snprintf(newPath, elcount(newPath), "%s.%s", oldPath, "iccBalance");
  C2xSetTokenData(packetHandle, "VPM", newPath, value.iccBalance.stringLength, value.iccBalance.string);

  return result;
}

int GetVPMDateParams(LONG packetHandle, struct VPMDate value, char oldPath[])
{
  char newPath[300];
  int result;

  result = 0;

  snprintf(newPath, elcount(newPath), "%s.%s", oldPath, "year");
  value.year = C2xGetTokenInt(packetHandle, "VPM", newPath);
  result = CheckLastError("VPM", gkFuncRefGet, result);

  snprintf(newPath, elcount(newPath), "%s.%s", oldPath, "month");
  value.month = C2xGetTokenInt(packetHandle, "VPM", newPath);
  result = CheckLastError("VPM", gkFuncRefGet, result);

  snprintf(newPath, elcount(newPath), "%s.%s", oldPath, "day");
  value.day = C2xGetTokenInt(packetHandle, "VPM", newPath);
  result = CheckLastError("VPM", gkFuncRefGet, result);

  return result;
}

int SetVPMDateParams(LONG packetHandle, struct VPMDate value, char oldPath[])
{
  char newPath[300];
  int result;

  result = 0;

  snprintf(newPath, elcount(newPath), "%s.%s", oldPath, "year");
  C2xSetTokenInt(packetHandle, "VPM", newPath, value.year);
  result = CheckLastError("VPM", gkFuncRefGet, result);

  snprintf(newPath, elcount(newPath), "%s.%s", oldPath, "month");
  C2xSetTokenInt(packetHandle, "VPM", newPath, value.month);
  result = CheckLastError("VPM", gkFuncRefGet, result);

  snprintf(newPath, elcount(newPath), "%s.%s", oldPath, "day");
  C2xSetTokenInt(packetHandle, "VPM", newPath, value.day);
  result = CheckLastError("VPM", gkFuncRefGet, result);

  return result;
}

int GetVPMSysInfoParams(LONG packetHandle, struct VPMSysInfo value, char oldPath[])
{
  char newPath[300];
  char buffer[300];
  int result;

  result = 0;

  snprintf(newPath, elcount(newPath), "%s.%s", oldPath, "contractProvider");
  value.contractProvider.stringLength = C2xGetTokenData(packetHandle, "VPM", newPath, elcount(value.contractProvider.string), value.contractProvider.string);
  snprintf(newPath, elcount(newPath), "%s.%s", oldPath, "contractType");
  value.contractType = C2xGetTokenInt(packetHandle, "VPM", newPath);
  result = CheckLastError("VPM", gkFuncRefGet, result);

  snprintf(newPath, elcount(newPath), "%s.%s", oldPath, "contractVersion");
  value.contractVersion = C2xGetTokenInt(packetHandle, "VPM", newPath);
  result = CheckLastError("VPM", gkFuncRefGet, result);

  snprintf(newPath, elcount(newPath), "%s.%s", oldPath, "contractSerialNumer");
  value.contractSerialNumer.stringLength = C2xGetTokenData(packetHandle, "VPM", newPath, elcount(value.contractSerialNumer.string), value.contractSerialNumer.string);
  snprintf(newPath, elcount(newPath), "%s.%s", oldPath, "contractSignedDate");
  GetVPMDateParams(packetHandle, value.contractSignedDate, newPath);
  result = CheckLastError("VPM", gkFuncRefGet, result);

  snprintf(newPath, elcount(newPath), "%s.%s", oldPath, "contractExpiredDate");
  GetVPMDateParams(packetHandle, value.contractExpiredDate, newPath);
  result = CheckLastError("VPM", gkFuncRefGet, result);

  snprintf(newPath, elcount(newPath), "%s.%s", oldPath, "reserved");
  value.reserved.stringLength = C2xGetTokenData(packetHandle, "VPM", newPath, elcount(value.reserved.string), value.reserved.string);
  return result;
}

int SetVPMSysInfoParams(LONG packetHandle, struct VPMSysInfo value, char oldPath[])
{
  char newPath[300];
  char buffer[300];
  int result;

  result = 0;

  snprintf(newPath, elcount(newPath), "%s.%s", oldPath, "contractProvider");
  C2xSetTokenData(packetHandle, "VPM", newPath, value.contractProvider.stringLength, value.contractProvider.string);

  snprintf(newPath, elcount(newPath), "%s.%s", oldPath, "contractType");
  C2xSetTokenInt(packetHandle, "VPM", newPath, value.contractType);
  result = CheckLastError("VPM", gkFuncRefGet, result);

  snprintf(newPath, elcount(newPath), "%s.%s", oldPath, "contractVersion");
  C2xSetTokenInt(packetHandle, "VPM", newPath, value.contractVersion);
  result = CheckLastError("VPM", gkFuncRefGet, result);

  snprintf(newPath, elcount(newPath), "%s.%s", oldPath, "contractSerialNumer");
  C2xSetTokenData(packetHandle, "VPM", newPath, value.contractSerialNumer.stringLength, value.contractSerialNumer.string);

  snprintf(newPath, elcount(newPath), "%s.%s", oldPath, "contractSignedDate");
  SetVPMDateParams(packetHandle, value.contractSignedDate, newPath);
  result = CheckLastError("VPM", gkFuncRefGet, result);

  snprintf(newPath, elcount(newPath), "%s.%s", oldPath, "contractExpiredDate");
  SetVPMDateParams(packetHandle, value.contractExpiredDate, newPath);
  result = CheckLastError("VPM", gkFuncRefGet, result);

  snprintf(newPath, elcount(newPath), "%s.%s", oldPath, "reserved");
  C2xSetTokenData(packetHandle, "VPM", newPath, value.reserved.stringLength, value.reserved.string);

  return result;
}

int GetVPMVehicleDimensionsParams(LONG packetHandle, struct VPMVehicleDimensions value, char oldPath[])
{
  char newPath[300];
  int result;

  result = 0;

  snprintf(newPath, elcount(newPath), "%s.%s", oldPath, "vehicleLength");
  value.vehicleLength = C2xGetTokenInt(packetHandle, "VPM", newPath);
  result = CheckLastError("VPM", gkFuncRefGet, result);

  snprintf(newPath, elcount(newPath), "%s.%s", oldPath, "vehicleWidth");
  value.vehicleWidth = C2xGetTokenInt(packetHandle, "VPM", newPath);
  result = CheckLastError("VPM", gkFuncRefGet, result);

  snprintf(newPath, elcount(newPath), "%s.%s", oldPath, "vehicleHeigth");
  value.vehicleHeigth = C2xGetTokenInt(packetHandle, "VPM", newPath);
  result = CheckLastError("VPM", gkFuncRefGet, result);

  return result;
}

int SetVPMVehicleDimensionsParams(LONG packetHandle, struct VPMVehicleDimensions value, char oldPath[])
{
  char newPath[300];
  int result;

  result = 0;

  snprintf(newPath, elcount(newPath), "%s.%s", oldPath, "vehicleLength");
  C2xSetTokenInt(packetHandle, "VPM", newPath, value.vehicleLength);
  result = CheckLastError("VPM", gkFuncRefGet, result);

  snprintf(newPath, elcount(newPath), "%s.%s", oldPath, "vehicleWidth");
  C2xSetTokenInt(packetHandle, "VPM", newPath, value.vehicleWidth);
  result = CheckLastError("VPM", gkFuncRefGet, result);

  snprintf(newPath, elcount(newPath), "%s.%s", oldPath, "vehicleHeigth");
  C2xSetTokenInt(packetHandle, "VPM", newPath, value.vehicleHeigth);
  result = CheckLastError("VPM", gkFuncRefGet, result);

  return result;
}

int GetVPMVehicleInfoParams(LONG packetHandle, struct VPMVehicleInfo value, char oldPath[])
{
  char newPath[300];
  char buffer[300];
  int result;

  result = 0;

  snprintf(newPath, elcount(newPath), "%s.%s", oldPath, "vehicleLicencePlateNumber");
  value.vehicleLicencePlateNumber.stringLength = C2xGetTokenData(packetHandle, "VPM", newPath, elcount(value.vehicleLicencePlateNumber.string), value.vehicleLicencePlateNumber.string);
  snprintf(newPath, elcount(newPath), "%s.%s", oldPath, "vehicleLicencePlateColor");
  value.vehicleLicencePlateColor.stringLength = C2xGetTokenData(packetHandle, "VPM", newPath, elcount(value.vehicleLicencePlateColor.string), value.vehicleLicencePlateColor.string);
  snprintf(newPath, elcount(newPath), "%s.%s", oldPath, "vehicleTollingClass");
  value.vehicleTollingClass = C2xGetTokenInt(packetHandle, "VPM", newPath);
  result = CheckLastError("VPM", gkFuncRefGet, result);

  snprintf(newPath, elcount(newPath), "%s.%s", oldPath, "vehicleUserType");
  value.vehicleUserType = C2xGetTokenInt(packetHandle, "VPM", newPath);
  result = CheckLastError("VPM", gkFuncRefGet, result);

  snprintf(newPath, elcount(newPath), "%s.%s", oldPath, "vehicleDimensions");
  GetVPMVehicleDimensionsParams(packetHandle, value.vehicleDimensions, newPath);
  result = CheckLastError("VPM", gkFuncRefGet, result);

  snprintf(newPath, elcount(newPath), "%s.%s", oldPath, "vehicleWheels");
  value.vehicleWheels = C2xGetTokenInt(packetHandle, "VPM", newPath);
  result = CheckLastError("VPM", gkFuncRefGet, result);

  snprintf(newPath, elcount(newPath), "%s.%s", oldPath, "vehicleAxles");
  value.vehicleAxles = C2xGetTokenInt(packetHandle, "VPM", newPath);
  result = CheckLastError("VPM", gkFuncRefGet, result);

  snprintf(newPath, elcount(newPath), "%s.%s", oldPath, "vehicleWheelBases");
  value.vehicleWheelBases = C2xGetTokenInt(packetHandle, "VPM", newPath);
  result = CheckLastError("VPM", gkFuncRefGet, result);

  snprintf(newPath, elcount(newPath), "%s.%s", oldPath, "vehicleWeightLimits");
  value.vehicleWeightLimits = C2xGetTokenInt(packetHandle, "VPM", newPath);
  result = CheckLastError("VPM", gkFuncRefGet, result);

  snprintf(newPath, elcount(newPath), "%s.%s", oldPath, "vehicleSpecificInformation");
  value.vehicleSpecificInformation.stringLength = C2xGetTokenData(packetHandle, "VPM", newPath, elcount(value.vehicleSpecificInformation.string), value.vehicleSpecificInformation.string);
  snprintf(newPath, elcount(newPath), "%s.%s", oldPath, "vehicleEngineNumber");
  value.vehicleEngineNumber.stringLength = C2xGetTokenData(packetHandle, "VPM", newPath, elcount(value.vehicleEngineNumber.string), value.vehicleEngineNumber.string);
  snprintf(newPath, elcount(newPath), "%s.%s", oldPath, "description");
  value.description.isValidFlag = C2xIsTokenAvailable(packetHandle, "VPM", newPath);
  if(value.description.isValidFlag==1)
  {
    value.description.isValidFlag = 1;
    value.description.stringLength = C2xGetTokenData(packetHandle, "VPM", newPath, elcount(value.description.string), value.description.string);
  }
  return result;
}

int SetVPMVehicleInfoParams(LONG packetHandle, struct VPMVehicleInfo value, char oldPath[])
{
  char newPath[300];
  char buffer[300];
  int result;

  result = 0;

  snprintf(newPath, elcount(newPath), "%s.%s", oldPath, "vehicleLicencePlateNumber");
  C2xSetTokenData(packetHandle, "VPM", newPath, value.vehicleLicencePlateNumber.stringLength, value.vehicleLicencePlateNumber.string);

  snprintf(newPath, elcount(newPath), "%s.%s", oldPath, "vehicleLicencePlateColor");
  C2xSetTokenData(packetHandle, "VPM", newPath, value.vehicleLicencePlateColor.stringLength, value.vehicleLicencePlateColor.string);

  snprintf(newPath, elcount(newPath), "%s.%s", oldPath, "vehicleTollingClass");
  C2xSetTokenInt(packetHandle, "VPM", newPath, value.vehicleTollingClass);
  result = CheckLastError("VPM", gkFuncRefGet, result);

  snprintf(newPath, elcount(newPath), "%s.%s", oldPath, "vehicleUserType");
  C2xSetTokenInt(packetHandle, "VPM", newPath, value.vehicleUserType);
  result = CheckLastError("VPM", gkFuncRefGet, result);

  snprintf(newPath, elcount(newPath), "%s.%s", oldPath, "vehicleDimensions");
  SetVPMVehicleDimensionsParams(packetHandle, value.vehicleDimensions, newPath);
  result = CheckLastError("VPM", gkFuncRefGet, result);

  snprintf(newPath, elcount(newPath), "%s.%s", oldPath, "vehicleWheels");
  C2xSetTokenInt(packetHandle, "VPM", newPath, value.vehicleWheels);
  result = CheckLastError("VPM", gkFuncRefGet, result);

  snprintf(newPath, elcount(newPath), "%s.%s", oldPath, "vehicleAxles");
  C2xSetTokenInt(packetHandle, "VPM", newPath, value.vehicleAxles);
  result = CheckLastError("VPM", gkFuncRefGet, result);

  snprintf(newPath, elcount(newPath), "%s.%s", oldPath, "vehicleWheelBases");
  C2xSetTokenInt(packetHandle, "VPM", newPath, value.vehicleWheelBases);
  result = CheckLastError("VPM", gkFuncRefGet, result);

  snprintf(newPath, elcount(newPath), "%s.%s", oldPath, "vehicleWeightLimits");
  C2xSetTokenInt(packetHandle, "VPM", newPath, value.vehicleWeightLimits);
  result = CheckLastError("VPM", gkFuncRefGet, result);

  snprintf(newPath, elcount(newPath), "%s.%s", oldPath, "vehicleSpecificInformation");
  C2xSetTokenData(packetHandle, "VPM", newPath, value.vehicleSpecificInformation.stringLength, value.vehicleSpecificInformation.string);

  snprintf(newPath, elcount(newPath), "%s.%s", oldPath, "vehicleEngineNumber");
  C2xSetTokenData(packetHandle, "VPM", newPath, value.vehicleEngineNumber.stringLength, value.vehicleEngineNumber.string);

  snprintf(newPath, elcount(newPath), "%s.%s", oldPath, "description");
  if(value.description.isValidFlag==1)
  {
    C2xSetTokenData(packetHandle, "VPM", newPath, value.description.stringLength, value.description.string);
  }
  else
  {
    if( C2xIsTokenAvailable(packetHandle, "VPM", newPath) )
    {
      C2xRemoveToken(packetHandle, "VPM", newPath);
    }
  }

  return result;
}

int GetVPMTollingPosParams(LONG packetHandle, struct VPMTollingPos value, char oldPath[])
{
  char newPath[300];
  int result;

  result = 0;

  snprintf(newPath, elcount(newPath), "%s.%s", oldPath, "id");
  value.id = C2xGetTokenInt64(packetHandle, "VPM", newPath);
  result = CheckLastError("VPM", gkFuncRefGet, result);

  snprintf(newPath, elcount(newPath), "%s.%s", oldPath, "pos");
  value.pos.isValidFlag = C2xIsTokenAvailable(packetHandle, "VPM", newPath);
  if(value.pos.isValidFlag==1)
  {
    GetVPMPosition3DParams(packetHandle, value.pos, newPath);
    result = CheckLastError("VPM", gkFuncRefGet, result);
  }
  return result;
}

int SetVPMTollingPosParams(LONG packetHandle, struct VPMTollingPos value, char oldPath[])
{
  char newPath[300];
  int result;

  result = 0;

  snprintf(newPath, elcount(newPath), "%s.%s", oldPath, "id");
  C2xSetTokenInt64(packetHandle, "VPM", newPath, value.id);
  result = CheckLastError("VPM", gkFuncRefGet, result);

  snprintf(newPath, elcount(newPath), "%s.%s", oldPath, "pos");
  if(value.pos.isValidFlag==1)
  {
    SetVPMPosition3DParams(packetHandle, value.pos, newPath);
    result = CheckLastError("VPM", gkFuncRefGet, result);
  }
  else
  {
    if( C2xIsTokenAvailable(packetHandle, "VPM", newPath) )
    {
      C2xRemoveToken(packetHandle, "VPM", newPath);
    }
  }

  return result;
}

int GetVPMPassedPosParams(LONG packetHandle, struct VPMPassedPos value, char oldPath[])
{
  char newPath[300];
  int result;

  result = 0;

  snprintf(newPath, elcount(newPath), "%s.%s", oldPath, "tollingPos");
  GetVPMTollingPosParams(packetHandle, value.tollingPos, newPath);
  result = CheckLastError("VPM", gkFuncRefGet, result);

  snprintf(newPath, elcount(newPath), "%s.%s", oldPath, "tollingTime");
  GetVPMDDateTimeParams(packetHandle, value.tollingTime, newPath);
  result = CheckLastError("VPM", gkFuncRefGet, result);

  snprintf(newPath, elcount(newPath), "%s.%s", oldPath, "tollingAmount");
  value.tollingAmount.isValidFlag = C2xIsTokenAvailable(packetHandle, "VPM", newPath);
  if(value.tollingAmount.isValidFlag==1)
  {
    value.tollingAmount.isValidFlag = 1;
    value.tollingAmount.stringLength = C2xGetTokenData(packetHandle, "VPM", newPath, elcount(value.tollingAmount.string), value.tollingAmount.string);
  }
  return result;
}

int SetVPMPassedPosParams(LONG packetHandle, struct VPMPassedPos value, char oldPath[])
{
  char newPath[300];
  int result;

  result = 0;

  snprintf(newPath, elcount(newPath), "%s.%s", oldPath, "tollingPos");
  SetVPMTollingPosParams(packetHandle, value.tollingPos, newPath);
  result = CheckLastError("VPM", gkFuncRefGet, result);

  snprintf(newPath, elcount(newPath), "%s.%s", oldPath, "tollingTime");
  SetVPMDDateTimeParams(packetHandle, value.tollingTime, newPath);
  result = CheckLastError("VPM", gkFuncRefGet, result);

  snprintf(newPath, elcount(newPath), "%s.%s", oldPath, "tollingAmount");
  if(value.tollingAmount.isValidFlag==1)
  {
    C2xSetTokenData(packetHandle, "VPM", newPath, value.tollingAmount.stringLength, value.tollingAmount.string);
  }
  else
  {
    if( C2xIsTokenAvailable(packetHandle, "VPM", newPath) )
    {
      C2xRemoveToken(packetHandle, "VPM", newPath);
    }
  }

  return result;
}

int GetVPMPassedSitesInfo_passedPosParams(LONG packetHandle, struct VPMPassedSitesInfo_passedPos value, char oldPath[])
{
  char newPath[300]; 
  int i;
  int result;

  result = 0;

  value.length = C2xGetTokenInt(packetHandle, "VPM", oldPath);
  if((result = CheckLastError("VPM", gkFuncRefGet, result))==0)
  {
    for(i=0; i<value.length; i++)
    {
      snprintf(newPath, elcount(newPath), "%s[%d]", oldPath, i);
      GetVPMPassedPosParams(packetHandle, value.arrayValue[i], newPath);
      result = CheckLastError("VPM", gkFuncRefGet, result);
    }
  }
  return result;
}

int SetVPMPassedSitesInfo_passedPosParams(LONG packetHandle, struct VPMPassedSitesInfo_passedPos value, char oldPath[])
{
  char newPath[300]; 
  int i;
  int result;

  result = 0;

  C2xRemoveToken(packetHandle, "VPM", oldPath);
  for(i=0; i<value.length; i++)
  {
    snprintf(newPath, elcount(newPath), "%s[%d]", oldPath, i);
    SetVPMPassedPosParams(packetHandle, value.arrayValue[i], newPath);
    result = CheckLastError("VPM", gkFuncRefGet, result);
  }
  return result;
}

int GetVPMPassedSitesInfoParams(LONG packetHandle, struct VPMPassedSitesInfo value, char oldPath[])
{
  char newPath[300];
  int result;

  result = 0;

  snprintf(newPath, elcount(newPath), "%s.%s", oldPath, "entranceInfo");
  value.entranceInfo.isValidFlag = C2xIsTokenAvailable(packetHandle, "VPM", newPath);
  if(value.entranceInfo.isValidFlag==1)
  {
    GetVPMPassedPosParams(packetHandle, value.entranceInfo, newPath);
    result = CheckLastError("VPM", gkFuncRefGet, result);
  }
  snprintf(newPath, elcount(newPath), "%s.%s", oldPath, "passedPos");
  value.passedPos.isValidFlag = C2xIsTokenAvailable(packetHandle, "VPM", newPath);
  if(value.passedPos.isValidFlag==1)
  {
    GetVPMPassedSitesInfo_passedPosParams(packetHandle, value.passedPos, newPath);
    result = CheckLastError("VPM", gkFuncRefGet, result);
  }
  return result;
}

int SetVPMPassedSitesInfoParams(LONG packetHandle, struct VPMPassedSitesInfo value, char oldPath[])
{
  char newPath[300];
  int result;

  result = 0;

  snprintf(newPath, elcount(newPath), "%s.%s", oldPath, "entranceInfo");
  if(value.entranceInfo.isValidFlag==1)
  {
    SetVPMPassedPosParams(packetHandle, value.entranceInfo, newPath);
    result = CheckLastError("VPM", gkFuncRefGet, result);
  }
  else
  {
    if( C2xIsTokenAvailable(packetHandle, "VPM", newPath) )
    {
      C2xRemoveToken(packetHandle, "VPM", newPath);
    }
  }

  snprintf(newPath, elcount(newPath), "%s.%s", oldPath, "passedPos");
  if(value.passedPos.isValidFlag==1)
  {
    SetVPMPassedSitesInfo_passedPosParams(packetHandle, value.passedPos, newPath);
    result = CheckLastError("VPM", gkFuncRefGet, result);
  }
  else
  {
    if( C2xIsTokenAvailable(packetHandle, "VPM", newPath) )
    {
      C2xRemoveToken(packetHandle, "VPM", newPath);
    }
  }

  return result;
}

int GetVPMOBUPaymentInfoType1Params(LONG packetHandle, struct VPMOBUPaymentInfoType1 value, char oldPath[])
{
  char newPath[300];
  int result;

  result = 0;

  snprintf(newPath, elcount(newPath), "%s.%s", oldPath, "equipmentClass");
  value.equipmentClass.isValidFlag = C2xIsTokenAvailable(packetHandle, "VPM", newPath);
  if(value.equipmentClass.isValidFlag==1)
  {
    value.equipmentClass.value = C2xGetTokenInt(packetHandle, "VPM", newPath);
    result = CheckLastError("VPM", gkFuncRefGet, result);
  }
  snprintf(newPath, elcount(newPath), "%s.%s", oldPath, "gbiCCInfo");
  value.gbiCCInfo.isValidFlag = C2xIsTokenAvailable(packetHandle, "VPM", newPath);
  if(value.gbiCCInfo.isValidFlag==1)
  {
    GetVPMGBICCInfoParams(packetHandle, value.gbiCCInfo, newPath);
    result = CheckLastError("VPM", gkFuncRefGet, result);
  }
  snprintf(newPath, elcount(newPath), "%s.%s", oldPath, "sysInfo");
  value.sysInfo.isValidFlag = C2xIsTokenAvailable(packetHandle, "VPM", newPath);
  if(value.sysInfo.isValidFlag==1)
  {
    GetVPMSysInfoParams(packetHandle, value.sysInfo, newPath);
    result = CheckLastError("VPM", gkFuncRefGet, result);
  }
  snprintf(newPath, elcount(newPath), "%s.%s", oldPath, "vehicleInfo");
  value.vehicleInfo.isValidFlag = C2xIsTokenAvailable(packetHandle, "VPM", newPath);
  if(value.vehicleInfo.isValidFlag==1)
  {
    GetVPMVehicleInfoParams(packetHandle, value.vehicleInfo, newPath);
    result = CheckLastError("VPM", gkFuncRefGet, result);
  }
  snprintf(newPath, elcount(newPath), "%s.%s", oldPath, "passedSitesInfo");
  value.passedSitesInfo.isValidFlag = C2xIsTokenAvailable(packetHandle, "VPM", newPath);
  if(value.passedSitesInfo.isValidFlag==1)
  {
    GetVPMPassedSitesInfoParams(packetHandle, value.passedSitesInfo, newPath);
    result = CheckLastError("VPM", gkFuncRefGet, result);
  }
  return result;
}

int SetVPMOBUPaymentInfoType1Params(LONG packetHandle, struct VPMOBUPaymentInfoType1 value, char oldPath[])
{
  char newPath[300];
  int result;

  result = 0;

  snprintf(newPath, elcount(newPath), "%s.%s", oldPath, "equipmentClass");
  if(value.equipmentClass.isValidFlag==1)
  {
    C2xSetTokenInt(packetHandle, "VPM", newPath, value.equipmentClass.value);
    result = CheckLastError("VPM", gkFuncRefGet, result);
  }
  else
  {
    if( C2xIsTokenAvailable(packetHandle, "VPM", newPath) )
    {
      C2xRemoveToken(packetHandle, "VPM", newPath);
    }
  }

  snprintf(newPath, elcount(newPath), "%s.%s", oldPath, "gbiCCInfo");
  if(value.gbiCCInfo.isValidFlag==1)
  {
    SetVPMGBICCInfoParams(packetHandle, value.gbiCCInfo, newPath);
    result = CheckLastError("VPM", gkFuncRefGet, result);
  }
  else
  {
    if( C2xIsTokenAvailable(packetHandle, "VPM", newPath) )
    {
      C2xRemoveToken(packetHandle, "VPM", newPath);
    }
  }

  snprintf(newPath, elcount(newPath), "%s.%s", oldPath, "sysInfo");
  if(value.sysInfo.isValidFlag==1)
  {
    SetVPMSysInfoParams(packetHandle, value.sysInfo, newPath);
    result = CheckLastError("VPM", gkFuncRefGet, result);
  }
  else
  {
    if( C2xIsTokenAvailable(packetHandle, "VPM", newPath) )
    {
      C2xRemoveToken(packetHandle, "VPM", newPath);
    }
  }

  snprintf(newPath, elcount(newPath), "%s.%s", oldPath, "vehicleInfo");
  if(value.vehicleInfo.isValidFlag==1)
  {
    SetVPMVehicleInfoParams(packetHandle, value.vehicleInfo, newPath);
    result = CheckLastError("VPM", gkFuncRefGet, result);
  }
  else
  {
    if( C2xIsTokenAvailable(packetHandle, "VPM", newPath) )
    {
      C2xRemoveToken(packetHandle, "VPM", newPath);
    }
  }

  snprintf(newPath, elcount(newPath), "%s.%s", oldPath, "passedSitesInfo");
  if(value.passedSitesInfo.isValidFlag==1)
  {
    SetVPMPassedSitesInfoParams(packetHandle, value.passedSitesInfo, newPath);
    result = CheckLastError("VPM", gkFuncRefGet, result);
  }
  else
  {
    if( C2xIsTokenAvailable(packetHandle, "VPM", newPath) )
    {
      C2xRemoveToken(packetHandle, "VPM", newPath);
    }
  }

  return result;
}

int GetVPMOBUPaymentInfoParams(LONG packetHandle, struct VPMOBUPaymentInfo value, char oldPath[])
{
  char newPath[300];
  int result;

  result = 0;

  value.choice = C2xGetTokenInt(packetHandle, "VPM", oldPath);

  switch(value.choice)
  {
    case 0:
    {
      snprintf(newPath, elcount(newPath), "%s.%s", oldPath, "obuPaymentInfoType1");
      GetVPMOBUPaymentInfoType1Params(packetHandle, value.obuPaymentInfoType1, newPath);
      result = CheckLastError("VPM", gkFuncRefGet, result);
    }
    break;
  }
  return result;
}

int SetVPMOBUPaymentInfoParams(LONG packetHandle, struct VPMOBUPaymentInfo value, char oldPath[])
{
  char newPath[300];
  int result;

  result = 0;

  switch(value.choice)
  {
    case 0:
    {
      snprintf(newPath, elcount(newPath), "%s.%s", oldPath, "obuPaymentInfoType1");
      SetVPMOBUPaymentInfoType1Params(packetHandle, value.obuPaymentInfoType1, newPath);
      result = CheckLastError("VPM", gkFuncRefGet, result);
    }
    break;
  }
  return result;
}

int GetVPMVPApplicationParameterParams(LONG packetHandle, struct VPMVPApplicationParameter value, char oldPath[])
{
  char newPath[300];
  int result;

  result = 0;

  snprintf(newPath, elcount(newPath), "%s.%s", oldPath, "pid");
  value.pid = C2xGetTokenInt(packetHandle, "VPM", newPath);
  result = CheckLastError("VPM", gkFuncRefGet, result);

  snprintf(newPath, elcount(newPath), "%s.%s", oldPath, "obuPaymentInfo");
  GetVPMOBUPaymentInfoParams(packetHandle, value.obuPaymentInfo, newPath);
  result = CheckLastError("VPM", gkFuncRefGet, result);

  return result;
}

int SetVPMVPApplicationParameterParams(LONG packetHandle, struct VPMVPApplicationParameter value, char oldPath[])
{
  char newPath[300];
  int result;

  result = 0;

  snprintf(newPath, elcount(newPath), "%s.%s", oldPath, "pid");
  C2xSetTokenInt(packetHandle, "VPM", newPath, value.pid);
  result = CheckLastError("VPM", gkFuncRefGet, result);

  snprintf(newPath, elcount(newPath), "%s.%s", oldPath, "obuPaymentInfo");
  SetVPMOBUPaymentInfoParams(packetHandle, value.obuPaymentInfo, newPath);
  result = CheckLastError("VPM", gkFuncRefGet, result);

  return result;
}

int GetVPMVPApplicationListParams(LONG packetHandle, struct VPMVPApplicationList value, char oldPath[])
{
  char newPath[300]; 
  int i;
  int result;

  result = 0;

  value.length = C2xGetTokenInt(packetHandle, "VPM", oldPath);
  if((result = CheckLastError("VPM", gkFuncRefGet, result))==0)
  {
    for(i=0; i<value.length; i++)
    {
      snprintf(newPath, elcount(newPath), "%s[%d]", oldPath, i);
      GetVPMVPApplicationParameterParams(packetHandle, value.arrayValue[i], newPath);
      result = CheckLastError("VPM", gkFuncRefGet, result);
    }
  }
  return result;
}

int SetVPMVPApplicationListParams(LONG packetHandle, struct VPMVPApplicationList value, char oldPath[])
{
  char newPath[300]; 
  int i;
  int result;

  result = 0;

  C2xRemoveToken(packetHandle, "VPM", oldPath);
  for(i=0; i<value.length; i++)
  {
    snprintf(newPath, elcount(newPath), "%s[%d]", oldPath, i);
    SetVPMVPApplicationParameterParams(packetHandle, value.arrayValue[i], newPath);
    result = CheckLastError("VPM", gkFuncRefGet, result);
  }
  return result;
}

int GetVPMVSIParams(LONG packetHandle, struct VPMVSI value, char oldPath[])
{
  char newPath[300];
  int result;

  result = 0;

  snprintf(newPath, elcount(newPath), "%s.%s", oldPath, "time");
  GetVPMDDateTimeParams(packetHandle, value.time, newPath);
  result = CheckLastError("VPM", gkFuncRefGet, result);

  snprintf(newPath, elcount(newPath), "%s.%s", oldPath, "obuId");
  value.obuId.stringLength = C2xGetTokenData(packetHandle, "VPM", newPath, elcount(value.obuId.string), value.obuId.string);
  snprintf(newPath, elcount(newPath), "%s.%s", oldPath, "targetId");
  value.targetId.isValidFlag = C2xIsTokenAvailable(packetHandle, "VPM", newPath);
  if(value.targetId.isValidFlag==1)
  {
    value.targetId.isValidFlag = 1;
    value.targetId.stringLength = C2xGetTokenData(packetHandle, "VPM", newPath, elcount(value.targetId.string), value.targetId.string);
  }
  snprintf(newPath, elcount(newPath), "%s.%s", oldPath, "obuInfo");
  value.obuInfo.isValidFlag = C2xIsTokenAvailable(packetHandle, "VPM", newPath);
  if(value.obuInfo.isValidFlag==1)
  {
    GetVPMOBUInfoParams(packetHandle, value.obuInfo, newPath);
    result = CheckLastError("VPM", gkFuncRefGet, result);
  }
  snprintf(newPath, elcount(newPath), "%s.%s", oldPath, "vpapplicationList");
  value.vpapplicationList.isValidFlag = C2xIsTokenAvailable(packetHandle, "VPM", newPath);
  if(value.vpapplicationList.isValidFlag==1)
  {
    GetVPMVPApplicationListParams(packetHandle, value.vpapplicationList, newPath);
    result = CheckLastError("VPM", gkFuncRefGet, result);
  }
  snprintf(newPath, elcount(newPath), "%s.%s", oldPath, "rndOBU");
  value.rndOBU.isValidFlag = C2xIsTokenAvailable(packetHandle, "VPM", newPath);
  if(value.rndOBU.isValidFlag==1)
  {
    value.rndOBU.isValidFlag = 1;
    value.rndOBU.stringLength = C2xGetTokenData(packetHandle, "VPM", newPath, elcount(value.rndOBU.string), value.rndOBU.string);
  }
  return result;
}

int SetVPMVSIParams(LONG packetHandle, struct VPMVSI value, char oldPath[])
{
  char newPath[300];
  int result;

  result = 0;

  snprintf(newPath, elcount(newPath), "%s.%s", oldPath, "time");
  SetVPMDDateTimeParams(packetHandle, value.time, newPath);
  result = CheckLastError("VPM", gkFuncRefGet, result);

  snprintf(newPath, elcount(newPath), "%s.%s", oldPath, "obuId");
  C2xSetTokenData(packetHandle, "VPM", newPath, value.obuId.stringLength, value.obuId.string);

  snprintf(newPath, elcount(newPath), "%s.%s", oldPath, "targetId");
  if(value.targetId.isValidFlag==1)
  {
    C2xSetTokenData(packetHandle, "VPM", newPath, value.targetId.stringLength, value.targetId.string);
  }
  else
  {
    if( C2xIsTokenAvailable(packetHandle, "VPM", newPath) )
    {
      C2xRemoveToken(packetHandle, "VPM", newPath);
    }
  }

  snprintf(newPath, elcount(newPath), "%s.%s", oldPath, "obuInfo");
  if(value.obuInfo.isValidFlag==1)
  {
    SetVPMOBUInfoParams(packetHandle, value.obuInfo, newPath);
    result = CheckLastError("VPM", gkFuncRefGet, result);
  }
  else
  {
    if( C2xIsTokenAvailable(packetHandle, "VPM", newPath) )
    {
      C2xRemoveToken(packetHandle, "VPM", newPath);
    }
  }

  snprintf(newPath, elcount(newPath), "%s.%s", oldPath, "vpapplicationList");
  if(value.vpapplicationList.isValidFlag==1)
  {
    SetVPMVPApplicationListParams(packetHandle, value.vpapplicationList, newPath);
    result = CheckLastError("VPM", gkFuncRefGet, result);
  }
  else
  {
    if( C2xIsTokenAvailable(packetHandle, "VPM", newPath) )
    {
      C2xRemoveToken(packetHandle, "VPM", newPath);
    }
  }

  snprintf(newPath, elcount(newPath), "%s.%s", oldPath, "rndOBU");
  if(value.rndOBU.isValidFlag==1)
  {
    C2xSetTokenData(packetHandle, "VPM", newPath, value.rndOBU.stringLength, value.rndOBU.string);
  }
  else
  {
    if( C2xIsTokenAvailable(packetHandle, "VPM", newPath) )
    {
      C2xRemoveToken(packetHandle, "VPM", newPath);
    }
  }

  return result;
}

int GetVPMRangeOfFileParams(LONG packetHandle, struct VPMRangeOfFile value, char oldPath[])
{
  char newPath[300];
  int result;

  result = 0;

  snprintf(newPath, elcount(newPath), "%s.%s", oldPath, "offset");
  value.offset = C2xGetTokenInt(packetHandle, "VPM", newPath);
  result = CheckLastError("VPM", gkFuncRefGet, result);

  snprintf(newPath, elcount(newPath), "%s.%s", oldPath, "length");
  value.length = C2xGetTokenInt(packetHandle, "VPM", newPath);
  result = CheckLastError("VPM", gkFuncRefGet, result);

  return result;
}

int SetVPMRangeOfFileParams(LONG packetHandle, struct VPMRangeOfFile value, char oldPath[])
{
  char newPath[300];
  int result;

  result = 0;

  snprintf(newPath, elcount(newPath), "%s.%s", oldPath, "offset");
  C2xSetTokenInt(packetHandle, "VPM", newPath, value.offset);
  result = CheckLastError("VPM", gkFuncRefGet, result);

  snprintf(newPath, elcount(newPath), "%s.%s", oldPath, "length");
  C2xSetTokenInt(packetHandle, "VPM", newPath, value.length);
  result = CheckLastError("VPM", gkFuncRefGet, result);

  return result;
}

int GetVPMGetTollDataRqParams(LONG packetHandle, struct VPMGetTollDataRq value, char oldPath[])
{
  char newPath[300];
  int result;

  result = 0;

  snprintf(newPath, elcount(newPath), "%s.%s", oldPath, "vehicleInfo");
  GetVPMRangeOfFileParams(packetHandle, value.vehicleInfo, newPath);
  result = CheckLastError("VPM", gkFuncRefGet, result);

  snprintf(newPath, elcount(newPath), "%s.%s", oldPath, "tollInfo");
  value.tollInfo.isValidFlag = C2xIsTokenAvailable(packetHandle, "VPM", newPath);
  if(value.tollInfo.isValidFlag==1)
  {
    GetVPMRangeOfFileParams(packetHandle, value.tollInfo, newPath);
    result = CheckLastError("VPM", gkFuncRefGet, result);
  }
  snprintf(newPath, elcount(newPath), "%s.%s", oldPath, "keyIdForAC");
  value.keyIdForAC.isValidFlag = C2xIsTokenAvailable(packetHandle, "VPM", newPath);
  if(value.keyIdForAC.isValidFlag==1)
  {
    value.keyIdForAC.value = C2xGetTokenInt(packetHandle, "VPM", newPath);
    result = CheckLastError("VPM", gkFuncRefGet, result);
  }
  return result;
}

int SetVPMGetTollDataRqParams(LONG packetHandle, struct VPMGetTollDataRq value, char oldPath[])
{
  char newPath[300];
  int result;

  result = 0;

  snprintf(newPath, elcount(newPath), "%s.%s", oldPath, "vehicleInfo");
  SetVPMRangeOfFileParams(packetHandle, value.vehicleInfo, newPath);
  result = CheckLastError("VPM", gkFuncRefGet, result);

  snprintf(newPath, elcount(newPath), "%s.%s", oldPath, "tollInfo");
  if(value.tollInfo.isValidFlag==1)
  {
    SetVPMRangeOfFileParams(packetHandle, value.tollInfo, newPath);
    result = CheckLastError("VPM", gkFuncRefGet, result);
  }
  else
  {
    if( C2xIsTokenAvailable(packetHandle, "VPM", newPath) )
    {
      C2xRemoveToken(packetHandle, "VPM", newPath);
    }
  }

  snprintf(newPath, elcount(newPath), "%s.%s", oldPath, "keyIdForAC");
  if(value.keyIdForAC.isValidFlag==1)
  {
    C2xSetTokenInt(packetHandle, "VPM", newPath, value.keyIdForAC.value);
    result = CheckLastError("VPM", gkFuncRefGet, result);
  }
  else
  {
    if( C2xIsTokenAvailable(packetHandle, "VPM", newPath) )
    {
      C2xRemoveToken(packetHandle, "VPM", newPath);
    }
  }

  return result;
}

int GetVPMGetTollDataRsParams(LONG packetHandle, struct VPMGetTollDataRs value, char oldPath[])
{
  char newPath[300];
  char buffer[300];
  int result;

  result = 0;

  snprintf(newPath, elcount(newPath), "%s.%s", oldPath, "vehicleInfo");
  value.vehicleInfo.stringLength = C2xGetTokenData(packetHandle, "VPM", newPath, elcount(value.vehicleInfo.string), value.vehicleInfo.string);
  snprintf(newPath, elcount(newPath), "%s.%s", oldPath, "tollInfo");
  value.tollInfo.isValidFlag = C2xIsTokenAvailable(packetHandle, "VPM", newPath);
  if(value.tollInfo.isValidFlag==1)
  {
    value.tollInfo.isValidFlag = 1;
    value.tollInfo.stringLength = C2xGetTokenData(packetHandle, "VPM", newPath, elcount(value.tollInfo.string), value.tollInfo.string);
  }
  return result;
}

int SetVPMGetTollDataRsParams(LONG packetHandle, struct VPMGetTollDataRs value, char oldPath[])
{
  char newPath[300];
  char buffer[300];
  int result;

  result = 0;

  snprintf(newPath, elcount(newPath), "%s.%s", oldPath, "vehicleInfo");
  C2xSetTokenData(packetHandle, "VPM", newPath, value.vehicleInfo.stringLength, value.vehicleInfo.string);

  snprintf(newPath, elcount(newPath), "%s.%s", oldPath, "tollInfo");
  if(value.tollInfo.isValidFlag==1)
  {
    C2xSetTokenData(packetHandle, "VPM", newPath, value.tollInfo.stringLength, value.tollInfo.string);
  }
  else
  {
    if( C2xIsTokenAvailable(packetHandle, "VPM", newPath) )
    {
      C2xRemoveToken(packetHandle, "VPM", newPath);
    }
  }

  return result;
}

int GetVPMGetSecureRqParams(LONG packetHandle, struct VPMGetSecureRq value, char oldPath[])
{
  char newPath[300];
  int result;

  result = 0;

  snprintf(newPath, elcount(newPath), "%s.%s", oldPath, "vehicleInfo");
  GetVPMRangeOfFileParams(packetHandle, value.vehicleInfo, newPath);
  result = CheckLastError("VPM", gkFuncRefGet, result);

  snprintf(newPath, elcount(newPath), "%s.%s", oldPath, "rndRsuForAuthen");
  value.rndRsuForAuthen.stringLength = C2xGetTokenData(packetHandle, "VPM", newPath, elcount(value.rndRsuForAuthen.string), value.rndRsuForAuthen.string);
  snprintf(newPath, elcount(newPath), "%s.%s", oldPath, "keyIdForAuthen");
  value.keyIdForAuthen = C2xGetTokenInt(packetHandle, "VPM", newPath);
  result = CheckLastError("VPM", gkFuncRefGet, result);

  snprintf(newPath, elcount(newPath), "%s.%s", oldPath, "keyIdForEncrypt");
  value.keyIdForEncrypt.isValidFlag = C2xIsTokenAvailable(packetHandle, "VPM", newPath);
  if(value.keyIdForEncrypt.isValidFlag==1)
  {
    value.keyIdForEncrypt.value = C2xGetTokenInt(packetHandle, "VPM", newPath);
    result = CheckLastError("VPM", gkFuncRefGet, result);
  }
  return result;
}

int SetVPMGetSecureRqParams(LONG packetHandle, struct VPMGetSecureRq value, char oldPath[])
{
  char newPath[300];
  int result;

  result = 0;

  snprintf(newPath, elcount(newPath), "%s.%s", oldPath, "vehicleInfo");
  SetVPMRangeOfFileParams(packetHandle, value.vehicleInfo, newPath);
  result = CheckLastError("VPM", gkFuncRefGet, result);

  snprintf(newPath, elcount(newPath), "%s.%s", oldPath, "rndRsuForAuthen");
  C2xSetTokenData(packetHandle, "VPM", newPath, value.rndRsuForAuthen.stringLength, value.rndRsuForAuthen.string);

  snprintf(newPath, elcount(newPath), "%s.%s", oldPath, "keyIdForAuthen");
  C2xSetTokenInt(packetHandle, "VPM", newPath, value.keyIdForAuthen);
  result = CheckLastError("VPM", gkFuncRefGet, result);

  snprintf(newPath, elcount(newPath), "%s.%s", oldPath, "keyIdForEncrypt");
  if(value.keyIdForEncrypt.isValidFlag==1)
  {
    C2xSetTokenInt(packetHandle, "VPM", newPath, value.keyIdForEncrypt.value);
    result = CheckLastError("VPM", gkFuncRefGet, result);
  }
  else
  {
    if( C2xIsTokenAvailable(packetHandle, "VPM", newPath) )
    {
      C2xRemoveToken(packetHandle, "VPM", newPath);
    }
  }

  return result;
}

int GetVPMGetSecureRsParams(LONG packetHandle, struct VPMGetSecureRs value, char oldPath[])
{
  char newPath[300];
  int result;

  result = 0;

  snprintf(newPath, elcount(newPath), "%s.%s", oldPath, "file");
  GetVPMRangeOfFileParams(packetHandle, value.file, newPath);
  result = CheckLastError("VPM", gkFuncRefGet, result);

  snprintf(newPath, elcount(newPath), "%s.%s", oldPath, "authenticator");
  value.authenticator.stringLength = C2xGetTokenData(packetHandle, "VPM", newPath, elcount(value.authenticator.string), value.authenticator.string);
  return result;
}

int SetVPMGetSecureRsParams(LONG packetHandle, struct VPMGetSecureRs value, char oldPath[])
{
  char newPath[300];
  int result;

  result = 0;

  snprintf(newPath, elcount(newPath), "%s.%s", oldPath, "file");
  SetVPMRangeOfFileParams(packetHandle, value.file, newPath);
  result = CheckLastError("VPM", gkFuncRefGet, result);

  snprintf(newPath, elcount(newPath), "%s.%s", oldPath, "authenticator");
  C2xSetTokenData(packetHandle, "VPM", newPath, value.authenticator.stringLength, value.authenticator.string);

  return result;
}

int GetVPMTransParaParams(LONG packetHandle, struct VPMTransPara value, char oldPath[])
{
  char newPath[300];
  char buffer[300];
  int result;

  result = 0;

  snprintf(newPath, elcount(newPath), "%s.%s", oldPath, "transAmount");
  value.transAmount.stringLength = C2xGetTokenData(packetHandle, "VPM", newPath, elcount(value.transAmount.string), value.transAmount.string);
  snprintf(newPath, elcount(newPath), "%s.%s", oldPath, "transType");
  value.transType.stringLength = C2xGetTokenData(packetHandle, "VPM", newPath, elcount(value.transType.string), value.transType.string);
  snprintf(newPath, elcount(newPath), "%s.%s", oldPath, "terminalID");
  value.terminalID.stringLength = C2xGetTokenData(packetHandle, "VPM", newPath, elcount(value.terminalID.string), value.terminalID.string);
  snprintf(newPath, elcount(newPath), "%s.%s", oldPath, "transSN");
  value.transSN.stringLength = C2xGetTokenData(packetHandle, "VPM", newPath, elcount(value.transSN.string), value.transSN.string);
  snprintf(newPath, elcount(newPath), "%s.%s", oldPath, "transTime");
  value.transTime.stringLength = C2xGetTokenData(packetHandle, "VPM", newPath, elcount(value.transTime.string), value.transTime.string);
  snprintf(newPath, elcount(newPath), "%s.%s", oldPath, "transStationID");
  value.transStationID.stringLength = C2xGetTokenData(packetHandle, "VPM", newPath, elcount(value.transStationID.string), value.transStationID.string);
  return result;
}

int SetVPMTransParaParams(LONG packetHandle, struct VPMTransPara value, char oldPath[])
{
  char newPath[300];
  char buffer[300];
  int result;

  result = 0;

  snprintf(newPath, elcount(newPath), "%s.%s", oldPath, "transAmount");
  C2xSetTokenData(packetHandle, "VPM", newPath, value.transAmount.stringLength, value.transAmount.string);

  snprintf(newPath, elcount(newPath), "%s.%s", oldPath, "transType");
  C2xSetTokenData(packetHandle, "VPM", newPath, value.transType.stringLength, value.transType.string);

  snprintf(newPath, elcount(newPath), "%s.%s", oldPath, "terminalID");
  C2xSetTokenData(packetHandle, "VPM", newPath, value.terminalID.stringLength, value.terminalID.string);

  snprintf(newPath, elcount(newPath), "%s.%s", oldPath, "transSN");
  C2xSetTokenData(packetHandle, "VPM", newPath, value.transSN.stringLength, value.transSN.string);

  snprintf(newPath, elcount(newPath), "%s.%s", oldPath, "transTime");
  C2xSetTokenData(packetHandle, "VPM", newPath, value.transTime.stringLength, value.transTime.string);

  snprintf(newPath, elcount(newPath), "%s.%s", oldPath, "transStationID");
  C2xSetTokenData(packetHandle, "VPM", newPath, value.transStationID.stringLength, value.transStationID.string);

  return result;
}

int GetVPMPartOfFileParams(LONG packetHandle, struct VPMPartOfFile value, char oldPath[])
{
  char newPath[300];
  int result;

  result = 0;

  snprintf(newPath, elcount(newPath), "%s.%s", oldPath, "offset");
  value.offset = C2xGetTokenInt(packetHandle, "VPM", newPath);
  result = CheckLastError("VPM", gkFuncRefGet, result);

  snprintf(newPath, elcount(newPath), "%s.%s", oldPath, "length");
  value.length = C2xGetTokenInt(packetHandle, "VPM", newPath);
  result = CheckLastError("VPM", gkFuncRefGet, result);

  snprintf(newPath, elcount(newPath), "%s.%s", oldPath, "fileContent");
  value.fileContent.stringLength = C2xGetTokenData(packetHandle, "VPM", newPath, elcount(value.fileContent.string), value.fileContent.string);
  return result;
}

int SetVPMPartOfFileParams(LONG packetHandle, struct VPMPartOfFile value, char oldPath[])
{
  char newPath[300];
  int result;

  result = 0;

  snprintf(newPath, elcount(newPath), "%s.%s", oldPath, "offset");
  C2xSetTokenInt(packetHandle, "VPM", newPath, value.offset);
  result = CheckLastError("VPM", gkFuncRefGet, result);

  snprintf(newPath, elcount(newPath), "%s.%s", oldPath, "length");
  C2xSetTokenInt(packetHandle, "VPM", newPath, value.length);
  result = CheckLastError("VPM", gkFuncRefGet, result);

  snprintf(newPath, elcount(newPath), "%s.%s", oldPath, "fileContent");
  C2xSetTokenData(packetHandle, "VPM", newPath, value.fileContent.stringLength, value.fileContent.string);

  return result;
}

int GetVPMSetTollDataRqParams(LONG packetHandle, struct VPMSetTollDataRq value, char oldPath[])
{
  char newPath[300];
  char buffer[300];
  int result;

  result = 0;

  snprintf(newPath, elcount(newPath), "%s.%s", oldPath, "rndRSU");
  value.rndRSU.isValidFlag = C2xIsTokenAvailable(packetHandle, "VPM", newPath);
  if(value.rndRSU.isValidFlag==1)
  {
    value.rndRSU.isValidFlag = 1;
    value.rndRSU.stringLength = C2xGetTokenData(packetHandle, "VPM", newPath, elcount(value.rndRSU.string), value.rndRSU.string);
  }
  snprintf(newPath, elcount(newPath), "%s.%s", oldPath, "transPara");
  value.transPara.isValidFlag = C2xIsTokenAvailable(packetHandle, "VPM", newPath);
  if(value.transPara.isValidFlag==1)
  {
    GetVPMTransParaParams(packetHandle, value.transPara, newPath);
    result = CheckLastError("VPM", gkFuncRefGet, result);
  }
  snprintf(newPath, elcount(newPath), "%s.%s", oldPath, "tollInfo");
  value.tollInfo.isValidFlag = C2xIsTokenAvailable(packetHandle, "VPM", newPath);
  if(value.tollInfo.isValidFlag==1)
  {
    GetVPMPartOfFileParams(packetHandle, value.tollInfo, newPath);
    result = CheckLastError("VPM", gkFuncRefGet, result);
  }
  snprintf(newPath, elcount(newPath), "%s.%s", oldPath, "tollingPos");
  value.tollingPos.isValidFlag = C2xIsTokenAvailable(packetHandle, "VPM", newPath);
  if(value.tollingPos.isValidFlag==1)
  {
    GetVPMTollingPosParams(packetHandle, value.tollingPos, newPath);
    result = CheckLastError("VPM", gkFuncRefGet, result);
  }
  snprintf(newPath, elcount(newPath), "%s.%s", oldPath, "keyIdForAuthen");
  value.keyIdForAuthen.isValidFlag = C2xIsTokenAvailable(packetHandle, "VPM", newPath);
  if(value.keyIdForAuthen.isValidFlag==1)
  {
    value.keyIdForAuthen.value = C2xGetTokenInt(packetHandle, "VPM", newPath);
    result = CheckLastError("VPM", gkFuncRefGet, result);
  }
  return result;
}

int SetVPMSetTollDataRqParams(LONG packetHandle, struct VPMSetTollDataRq value, char oldPath[])
{
  char newPath[300];
  char buffer[300];
  int result;

  result = 0;

  snprintf(newPath, elcount(newPath), "%s.%s", oldPath, "rndRSU");
  if(value.rndRSU.isValidFlag==1)
  {
    C2xSetTokenData(packetHandle, "VPM", newPath, value.rndRSU.stringLength, value.rndRSU.string);
  }
  else
  {
    if( C2xIsTokenAvailable(packetHandle, "VPM", newPath) )
    {
      C2xRemoveToken(packetHandle, "VPM", newPath);
    }
  }

  snprintf(newPath, elcount(newPath), "%s.%s", oldPath, "transPara");
  if(value.transPara.isValidFlag==1)
  {
    SetVPMTransParaParams(packetHandle, value.transPara, newPath);
    result = CheckLastError("VPM", gkFuncRefGet, result);
  }
  else
  {
    if( C2xIsTokenAvailable(packetHandle, "VPM", newPath) )
    {
      C2xRemoveToken(packetHandle, "VPM", newPath);
    }
  }

  snprintf(newPath, elcount(newPath), "%s.%s", oldPath, "tollInfo");
  if(value.tollInfo.isValidFlag==1)
  {
    SetVPMPartOfFileParams(packetHandle, value.tollInfo, newPath);
    result = CheckLastError("VPM", gkFuncRefGet, result);
  }
  else
  {
    if( C2xIsTokenAvailable(packetHandle, "VPM", newPath) )
    {
      C2xRemoveToken(packetHandle, "VPM", newPath);
    }
  }

  snprintf(newPath, elcount(newPath), "%s.%s", oldPath, "tollingPos");
  if(value.tollingPos.isValidFlag==1)
  {
    SetVPMTollingPosParams(packetHandle, value.tollingPos, newPath);
    result = CheckLastError("VPM", gkFuncRefGet, result);
  }
  else
  {
    if( C2xIsTokenAvailable(packetHandle, "VPM", newPath) )
    {
      C2xRemoveToken(packetHandle, "VPM", newPath);
    }
  }

  snprintf(newPath, elcount(newPath), "%s.%s", oldPath, "keyIdForAuthen");
  if(value.keyIdForAuthen.isValidFlag==1)
  {
    C2xSetTokenInt(packetHandle, "VPM", newPath, value.keyIdForAuthen.value);
    result = CheckLastError("VPM", gkFuncRefGet, result);
  }
  else
  {
    if( C2xIsTokenAvailable(packetHandle, "VPM", newPath) )
    {
      C2xRemoveToken(packetHandle, "VPM", newPath);
    }
  }

  return result;
}

int GetVPMAccountInfoParams(LONG packetHandle, struct VPMAccountInfo value, char oldPath[])
{
  char newPath[300];
  char buffer[300];
  int result;

  result = 0;

  snprintf(newPath, elcount(newPath), "%s.%s", oldPath, "account");
  value.account.stringLength = C2xGetTokenData(packetHandle, "VPM", newPath, elcount(value.account.string), value.account.string);
  return result;
}

int SetVPMAccountInfoParams(LONG packetHandle, struct VPMAccountInfo value, char oldPath[])
{
  char newPath[300];
  char buffer[300];
  int result;

  result = 0;

  snprintf(newPath, elcount(newPath), "%s.%s", oldPath, "account");
  C2xSetTokenData(packetHandle, "VPM", newPath, value.account.stringLength, value.account.string);

  return result;
}

int GetVPMTransCredentialParams(LONG packetHandle, struct VPMTransCredential value, char oldPath[])
{
  char newPath[300];
  char buffer[300];
  int result;

  result = 0;

  snprintf(newPath, elcount(newPath), "%s.%s", oldPath, "tc");
  value.tc.stringLength = C2xGetTokenData(packetHandle, "VPM", newPath, elcount(value.tc.string), value.tc.string);
  return result;
}

int SetVPMTransCredentialParams(LONG packetHandle, struct VPMTransCredential value, char oldPath[])
{
  char newPath[300];
  char buffer[300];
  int result;

  result = 0;

  snprintf(newPath, elcount(newPath), "%s.%s", oldPath, "tc");
  C2xSetTokenData(packetHandle, "VPM", newPath, value.tc.stringLength, value.tc.string);

  return result;
}

int GetVPMSetTollDataRsParams(LONG packetHandle, struct VPMSetTollDataRs value, char oldPath[])
{
  char newPath[300];
  char buffer[300];
  int result;

  result = 0;

  snprintf(newPath, elcount(newPath), "%s.%s", oldPath, "tacInfo");
  value.tacInfo.isValidFlag = C2xIsTokenAvailable(packetHandle, "VPM", newPath);
  if(value.tacInfo.isValidFlag==1)
  {
    value.tacInfo.isValidFlag = 1;
    value.tacInfo.stringLength = C2xGetTokenData(packetHandle, "VPM", newPath, elcount(value.tacInfo.string), value.tacInfo.string);
  }
  snprintf(newPath, elcount(newPath), "%s.%s", oldPath, "authenticator");
  value.authenticator.isValidFlag = C2xIsTokenAvailable(packetHandle, "VPM", newPath);
  if(value.authenticator.isValidFlag==1)
  {
    value.authenticator.isValidFlag = 1;
    value.authenticator.stringLength = C2xGetTokenData(packetHandle, "VPM", newPath, elcount(value.authenticator.string), value.authenticator.string);
  }
  snprintf(newPath, elcount(newPath), "%s.%s", oldPath, "accountInfo");
  value.accountInfo.isValidFlag = C2xIsTokenAvailable(packetHandle, "VPM", newPath);
  if(value.accountInfo.isValidFlag==1)
  {
    GetVPMAccountInfoParams(packetHandle, value.accountInfo, newPath);
    result = CheckLastError("VPM", gkFuncRefGet, result);
  }
  snprintf(newPath, elcount(newPath), "%s.%s", oldPath, "transCredential");
  value.transCredential.isValidFlag = C2xIsTokenAvailable(packetHandle, "VPM", newPath);
  if(value.transCredential.isValidFlag==1)
  {
    GetVPMTransCredentialParams(packetHandle, value.transCredential, newPath);
    result = CheckLastError("VPM", gkFuncRefGet, result);
  }
  return result;
}

int SetVPMSetTollDataRsParams(LONG packetHandle, struct VPMSetTollDataRs value, char oldPath[])
{
  char newPath[300];
  char buffer[300];
  int result;

  result = 0;

  snprintf(newPath, elcount(newPath), "%s.%s", oldPath, "tacInfo");
  if(value.tacInfo.isValidFlag==1)
  {
    C2xSetTokenData(packetHandle, "VPM", newPath, value.tacInfo.stringLength, value.tacInfo.string);
  }
  else
  {
    if( C2xIsTokenAvailable(packetHandle, "VPM", newPath) )
    {
      C2xRemoveToken(packetHandle, "VPM", newPath);
    }
  }

  snprintf(newPath, elcount(newPath), "%s.%s", oldPath, "authenticator");
  if(value.authenticator.isValidFlag==1)
  {
    C2xSetTokenData(packetHandle, "VPM", newPath, value.authenticator.stringLength, value.authenticator.string);
  }
  else
  {
    if( C2xIsTokenAvailable(packetHandle, "VPM", newPath) )
    {
      C2xRemoveToken(packetHandle, "VPM", newPath);
    }
  }

  snprintf(newPath, elcount(newPath), "%s.%s", oldPath, "accountInfo");
  if(value.accountInfo.isValidFlag==1)
  {
    SetVPMAccountInfoParams(packetHandle, value.accountInfo, newPath);
    result = CheckLastError("VPM", gkFuncRefGet, result);
  }
  else
  {
    if( C2xIsTokenAvailable(packetHandle, "VPM", newPath) )
    {
      C2xRemoveToken(packetHandle, "VPM", newPath);
    }
  }

  snprintf(newPath, elcount(newPath), "%s.%s", oldPath, "transCredential");
  if(value.transCredential.isValidFlag==1)
  {
    SetVPMTransCredentialParams(packetHandle, value.transCredential, newPath);
    result = CheckLastError("VPM", gkFuncRefGet, result);
  }
  else
  {
    if( C2xIsTokenAvailable(packetHandle, "VPM", newPath) )
    {
      C2xRemoveToken(packetHandle, "VPM", newPath);
    }
  }

  return result;
}

int GetVPMApduListParams(LONG packetHandle, struct VPMApduList value, char oldPath[])
{
  char newPath[300]; 
  int i;
  char buffer[300];
  int result;

  result = 0;

  value.length = C2xGetTokenInt(packetHandle, "VPM", oldPath);
  if((result = CheckLastError("VPM", gkFuncRefGet, result))==0)
  {
    for(i=0; i<value.length; i++)
    {
      snprintf(newPath, elcount(newPath), "%s[%d]", oldPath, i);
      C2xGetTokenData(packetHandle, "VPM", newPath, elcount(buffer), buffer);
      strncpy(value.arrayValue[i].string , buffer, value.arrayValue[i].stringLength );
      result = CheckLastError("VPM", gkFuncRefGet, result);
    }
  }
  return result;
}

int SetVPMApduListParams(LONG packetHandle, struct VPMApduList value, char oldPath[])
{
  char newPath[300]; 
  int i;
  char buffer[300];
  int result;

  result = 0;

  C2xRemoveToken(packetHandle, "VPM", oldPath);
  for(i=0; i<value.length; i++)
  {
    snprintf(newPath, elcount(newPath), "%s[%d]", oldPath, i);
    strncpy(buffer,value.arrayValue[i].string , elcount(buffer));
    C2xSetTokenData(packetHandle, "VPM", newPath, elcount(buffer), buffer);
    result = CheckLastError("VPM", gkFuncRefGet, result);
  }
  return result;
}

int GetVPMChannelRqParams(LONG packetHandle, struct VPMChannelRq value, char oldPath[])
{
  char newPath[300];
  int result;

  result = 0;

  snprintf(newPath, elcount(newPath), "%s.%s", oldPath, "channelid");
  value.channelid = C2xGetTokenInt(packetHandle, "VPM", newPath);
  result = CheckLastError("VPM", gkFuncRefGet, result);

  snprintf(newPath, elcount(newPath), "%s.%s", oldPath, "apdu");
  GetVPMApduListParams(packetHandle, value.apdu, newPath);
  result = CheckLastError("VPM", gkFuncRefGet, result);

  return result;
}

int SetVPMChannelRqParams(LONG packetHandle, struct VPMChannelRq value, char oldPath[])
{
  char newPath[300];
  int result;

  result = 0;

  snprintf(newPath, elcount(newPath), "%s.%s", oldPath, "channelid");
  C2xSetTokenInt(packetHandle, "VPM", newPath, value.channelid);
  result = CheckLastError("VPM", gkFuncRefGet, result);

  snprintf(newPath, elcount(newPath), "%s.%s", oldPath, "apdu");
  SetVPMApduListParams(packetHandle, value.apdu, newPath);
  result = CheckLastError("VPM", gkFuncRefGet, result);

  return result;
}

int GetVPMChannelRsParams(LONG packetHandle, struct VPMChannelRs value, char oldPath[])
{
  char newPath[300];
  int result;

  result = 0;

  snprintf(newPath, elcount(newPath), "%s.%s", oldPath, "channelid");
  value.channelid = C2xGetTokenInt(packetHandle, "VPM", newPath);
  result = CheckLastError("VPM", gkFuncRefGet, result);

  snprintf(newPath, elcount(newPath), "%s.%s", oldPath, "apdu");
  GetVPMApduListParams(packetHandle, value.apdu, newPath);
  result = CheckLastError("VPM", gkFuncRefGet, result);

  return result;
}

int SetVPMChannelRsParams(LONG packetHandle, struct VPMChannelRs value, char oldPath[])
{
  char newPath[300];
  int result;

  result = 0;

  snprintf(newPath, elcount(newPath), "%s.%s", oldPath, "channelid");
  C2xSetTokenInt(packetHandle, "VPM", newPath, value.channelid);
  result = CheckLastError("VPM", gkFuncRefGet, result);

  snprintf(newPath, elcount(newPath), "%s.%s", oldPath, "apdu");
  SetVPMApduListParams(packetHandle, value.apdu, newPath);
  result = CheckLastError("VPM", gkFuncRefGet, result);

  return result;
}

int GetVPMSetMMIRqParams(LONG packetHandle, struct VPMSetMMIRq value, char oldPath[])
{
  char newPath[300];
  int result;

  result = 0;

  snprintf(newPath, elcount(newPath), "%s.%s", oldPath, "toll");
  value.toll = C2xGetTokenInt(packetHandle, "VPM", newPath);
  result = CheckLastError("VPM", gkFuncRefGet, result);

  return result;
}

int SetVPMSetMMIRqParams(LONG packetHandle, struct VPMSetMMIRq value, char oldPath[])
{
  char newPath[300];
  int result;

  result = 0;

  snprintf(newPath, elcount(newPath), "%s.%s", oldPath, "toll");
  C2xSetTokenInt(packetHandle, "VPM", newPath, value.toll);
  result = CheckLastError("VPM", gkFuncRefGet, result);

  return result;
}

int GetVPMTransInfoParams(LONG packetHandle, struct VPMTransInfo value, char oldPath[])
{
  char newPath[300];
  int result;

  result = 0;

  value.choice = C2xGetTokenInt(packetHandle, "VPM", oldPath);

  switch(value.choice)
  {
    case 0:
    {
      snprintf(newPath, elcount(newPath), "%s.%s", oldPath, "getTollDataRq");
      GetVPMGetTollDataRqParams(packetHandle, value.getTollDataRq, newPath);
      result = CheckLastError("VPM", gkFuncRefGet, result);
    }
    break;
    case 1:
    {
      snprintf(newPath, elcount(newPath), "%s.%s", oldPath, "getTollDataRs");
      GetVPMGetTollDataRsParams(packetHandle, value.getTollDataRs, newPath);
      result = CheckLastError("VPM", gkFuncRefGet, result);
    }
    break;
    case 2:
    {
      snprintf(newPath, elcount(newPath), "%s.%s", oldPath, "getSecureRq");
      GetVPMGetSecureRqParams(packetHandle, value.getSecureRq, newPath);
      result = CheckLastError("VPM", gkFuncRefGet, result);
    }
    break;
    case 3:
    {
      snprintf(newPath, elcount(newPath), "%s.%s", oldPath, "getSecureRs");
      GetVPMGetSecureRsParams(packetHandle, value.getSecureRs, newPath);
      result = CheckLastError("VPM", gkFuncRefGet, result);
    }
    break;
    case 4:
    {
      snprintf(newPath, elcount(newPath), "%s.%s", oldPath, "setTollDataRq");
      GetVPMSetTollDataRqParams(packetHandle, value.setTollDataRq, newPath);
      result = CheckLastError("VPM", gkFuncRefGet, result);
    }
    break;
    case 5:
    {
      snprintf(newPath, elcount(newPath), "%s.%s", oldPath, "setTollDataRs");
      GetVPMSetTollDataRsParams(packetHandle, value.setTollDataRs, newPath);
      result = CheckLastError("VPM", gkFuncRefGet, result);
    }
    break;
    case 6:
    {
      snprintf(newPath, elcount(newPath), "%s.%s", oldPath, "transferChannelRq");
      GetVPMChannelRqParams(packetHandle, value.transferChannelRq, newPath);
      result = CheckLastError("VPM", gkFuncRefGet, result);
    }
    break;
    case 7:
    {
      snprintf(newPath, elcount(newPath), "%s.%s", oldPath, "transferChannelRs");
      GetVPMChannelRsParams(packetHandle, value.transferChannelRs, newPath);
      result = CheckLastError("VPM", gkFuncRefGet, result);
    }
    break;
    case 8:
    {
      snprintf(newPath, elcount(newPath), "%s.%s", oldPath, "setMMIRq");
      GetVPMSetMMIRqParams(packetHandle, value.setMMIRq, newPath);
      result = CheckLastError("VPM", gkFuncRefGet, result);
    }
    break;
  }
  return result;
}

int SetVPMTransInfoParams(LONG packetHandle, struct VPMTransInfo value, char oldPath[])
{
  char newPath[300];
  int result;

  result = 0;

  switch(value.choice)
  {
    case 0:
    {
      snprintf(newPath, elcount(newPath), "%s.%s", oldPath, "getTollDataRq");
      SetVPMGetTollDataRqParams(packetHandle, value.getTollDataRq, newPath);
      result = CheckLastError("VPM", gkFuncRefGet, result);
    }
    break;
    case 1:
    {
      snprintf(newPath, elcount(newPath), "%s.%s", oldPath, "getTollDataRs");
      SetVPMGetTollDataRsParams(packetHandle, value.getTollDataRs, newPath);
      result = CheckLastError("VPM", gkFuncRefGet, result);
    }
    break;
    case 2:
    {
      snprintf(newPath, elcount(newPath), "%s.%s", oldPath, "getSecureRq");
      SetVPMGetSecureRqParams(packetHandle, value.getSecureRq, newPath);
      result = CheckLastError("VPM", gkFuncRefGet, result);
    }
    break;
    case 3:
    {
      snprintf(newPath, elcount(newPath), "%s.%s", oldPath, "getSecureRs");
      SetVPMGetSecureRsParams(packetHandle, value.getSecureRs, newPath);
      result = CheckLastError("VPM", gkFuncRefGet, result);
    }
    break;
    case 4:
    {
      snprintf(newPath, elcount(newPath), "%s.%s", oldPath, "setTollDataRq");
      SetVPMSetTollDataRqParams(packetHandle, value.setTollDataRq, newPath);
      result = CheckLastError("VPM", gkFuncRefGet, result);
    }
    break;
    case 5:
    {
      snprintf(newPath, elcount(newPath), "%s.%s", oldPath, "setTollDataRs");
      SetVPMSetTollDataRsParams(packetHandle, value.setTollDataRs, newPath);
      result = CheckLastError("VPM", gkFuncRefGet, result);
    }
    break;
    case 6:
    {
      snprintf(newPath, elcount(newPath), "%s.%s", oldPath, "transferChannelRq");
      SetVPMChannelRqParams(packetHandle, value.transferChannelRq, newPath);
      result = CheckLastError("VPM", gkFuncRefGet, result);
    }
    break;
    case 7:
    {
      snprintf(newPath, elcount(newPath), "%s.%s", oldPath, "transferChannelRs");
      SetVPMChannelRsParams(packetHandle, value.transferChannelRs, newPath);
      result = CheckLastError("VPM", gkFuncRefGet, result);
    }
    break;
    case 8:
    {
      snprintf(newPath, elcount(newPath), "%s.%s", oldPath, "setMMIRq");
      SetVPMSetMMIRqParams(packetHandle, value.setMMIRq, newPath);
      result = CheckLastError("VPM", gkFuncRefGet, result);
    }
    break;
  }
  return result;
}

int GetVPMAction_RequestParams(LONG packetHandle, struct VPMAction_Request value, char oldPath[])
{
  char newPath[300];
  int result;

  result = 0;

  snprintf(newPath, elcount(newPath), "%s.%s", oldPath, "time");
  GetVPMDDateTimeParams(packetHandle, value.time, newPath);
  result = CheckLastError("VPM", gkFuncRefGet, result);

  snprintf(newPath, elcount(newPath), "%s.%s", oldPath, "mode");
  value.mode = C2xGetTokenInt64(packetHandle, "VPM", newPath);
  result = CheckLastError("VPM", gkFuncRefGet, result);

  snprintf(newPath, elcount(newPath), "%s.%s", oldPath, "sourceId");
  value.sourceId.stringLength = C2xGetTokenData(packetHandle, "VPM", newPath, elcount(value.sourceId.string), value.sourceId.string);
  snprintf(newPath, elcount(newPath), "%s.%s", oldPath, "targetId");
  value.targetId.isValidFlag = C2xIsTokenAvailable(packetHandle, "VPM", newPath);
  if(value.targetId.isValidFlag==1)
  {
    value.targetId.isValidFlag = 1;
    value.targetId.stringLength = C2xGetTokenData(packetHandle, "VPM", newPath, elcount(value.targetId.string), value.targetId.string);
  }
  snprintf(newPath, elcount(newPath), "%s.%s", oldPath, "paymentEntityId");
  value.paymentEntityId = C2xGetTokenInt(packetHandle, "VPM", newPath);
  result = CheckLastError("VPM", gkFuncRefGet, result);

  snprintf(newPath, elcount(newPath), "%s.%s", oldPath, "actionParameter");
  GetVPMTransInfoParams(packetHandle, value.actionParameter, newPath);
  result = CheckLastError("VPM", gkFuncRefGet, result);

  snprintf(newPath, elcount(newPath), "%s.%s", oldPath, "accessCredentials");
  value.accessCredentials.isValidFlag = C2xIsTokenAvailable(packetHandle, "VPM", newPath);
  if(value.accessCredentials.isValidFlag==1)
  {
    value.accessCredentials.isValidFlag = 1;
    value.accessCredentials.stringLength = C2xGetTokenData(packetHandle, "VPM", newPath, elcount(value.accessCredentials.string), value.accessCredentials.string);
  }
  return result;
}

int SetVPMAction_RequestParams(LONG packetHandle, struct VPMAction_Request value, char oldPath[])
{
  char newPath[300];
  int result;

  result = 0;

  snprintf(newPath, elcount(newPath), "%s.%s", oldPath, "time");
  SetVPMDDateTimeParams(packetHandle, value.time, newPath);
  result = CheckLastError("VPM", gkFuncRefGet, result);

  snprintf(newPath, elcount(newPath), "%s.%s", oldPath, "mode");
  C2xSetTokenInt64(packetHandle, "VPM", newPath, value.mode);
  result = CheckLastError("VPM", gkFuncRefGet, result);

  snprintf(newPath, elcount(newPath), "%s.%s", oldPath, "sourceId");
  C2xSetTokenData(packetHandle, "VPM", newPath, value.sourceId.stringLength, value.sourceId.string);

  snprintf(newPath, elcount(newPath), "%s.%s", oldPath, "targetId");
  if(value.targetId.isValidFlag==1)
  {
    C2xSetTokenData(packetHandle, "VPM", newPath, value.targetId.stringLength, value.targetId.string);
  }
  else
  {
    if( C2xIsTokenAvailable(packetHandle, "VPM", newPath) )
    {
      C2xRemoveToken(packetHandle, "VPM", newPath);
    }
  }

  snprintf(newPath, elcount(newPath), "%s.%s", oldPath, "paymentEntityId");
  C2xSetTokenInt(packetHandle, "VPM", newPath, value.paymentEntityId);
  result = CheckLastError("VPM", gkFuncRefGet, result);

  snprintf(newPath, elcount(newPath), "%s.%s", oldPath, "actionParameter");
  SetVPMTransInfoParams(packetHandle, value.actionParameter, newPath);
  result = CheckLastError("VPM", gkFuncRefGet, result);

  snprintf(newPath, elcount(newPath), "%s.%s", oldPath, "accessCredentials");
  if(value.accessCredentials.isValidFlag==1)
  {
    C2xSetTokenData(packetHandle, "VPM", newPath, value.accessCredentials.stringLength, value.accessCredentials.string);
  }
  else
  {
    if( C2xIsTokenAvailable(packetHandle, "VPM", newPath) )
    {
      C2xRemoveToken(packetHandle, "VPM", newPath);
    }
  }

  return result;
}

int GetVPMAction_ResponseParams(LONG packetHandle, struct VPMAction_Response value, char oldPath[])
{
  char newPath[300];
  int result;

  result = 0;

  snprintf(newPath, elcount(newPath), "%s.%s", oldPath, "time");
  GetVPMDDateTimeParams(packetHandle, value.time, newPath);
  result = CheckLastError("VPM", gkFuncRefGet, result);

  snprintf(newPath, elcount(newPath), "%s.%s", oldPath, "sourceId");
  value.sourceId.stringLength = C2xGetTokenData(packetHandle, "VPM", newPath, elcount(value.sourceId.string), value.sourceId.string);
  snprintf(newPath, elcount(newPath), "%s.%s", oldPath, "targetId");
  value.targetId.isValidFlag = C2xIsTokenAvailable(packetHandle, "VPM", newPath);
  if(value.targetId.isValidFlag==1)
  {
    value.targetId.isValidFlag = 1;
    value.targetId.stringLength = C2xGetTokenData(packetHandle, "VPM", newPath, elcount(value.targetId.string), value.targetId.string);
  }
  snprintf(newPath, elcount(newPath), "%s.%s", oldPath, "paymentEntityId");
  value.paymentEntityId = C2xGetTokenInt(packetHandle, "VPM", newPath);
  result = CheckLastError("VPM", gkFuncRefGet, result);

  snprintf(newPath, elcount(newPath), "%s.%s", oldPath, "responseParameter");
  value.responseParameter.isValidFlag = C2xIsTokenAvailable(packetHandle, "VPM", newPath);
  if(value.responseParameter.isValidFlag==1)
  {
    GetVPMTransInfoParams(packetHandle, value.responseParameter, newPath);
    result = CheckLastError("VPM", gkFuncRefGet, result);
  }
  snprintf(newPath, elcount(newPath), "%s.%s", oldPath, "ret");
  value.ret = C2xGetTokenInt(packetHandle, "VPM", newPath);
  result = CheckLastError("VPM", gkFuncRefGet, result);

  return result;
}

int SetVPMAction_ResponseParams(LONG packetHandle, struct VPMAction_Response value, char oldPath[])
{
  char newPath[300];
  int result;

  result = 0;

  snprintf(newPath, elcount(newPath), "%s.%s", oldPath, "time");
  SetVPMDDateTimeParams(packetHandle, value.time, newPath);
  result = CheckLastError("VPM", gkFuncRefGet, result);

  snprintf(newPath, elcount(newPath), "%s.%s", oldPath, "sourceId");
  C2xSetTokenData(packetHandle, "VPM", newPath, value.sourceId.stringLength, value.sourceId.string);

  snprintf(newPath, elcount(newPath), "%s.%s", oldPath, "targetId");
  if(value.targetId.isValidFlag==1)
  {
    C2xSetTokenData(packetHandle, "VPM", newPath, value.targetId.stringLength, value.targetId.string);
  }
  else
  {
    if( C2xIsTokenAvailable(packetHandle, "VPM", newPath) )
    {
      C2xRemoveToken(packetHandle, "VPM", newPath);
    }
  }

  snprintf(newPath, elcount(newPath), "%s.%s", oldPath, "paymentEntityId");
  C2xSetTokenInt(packetHandle, "VPM", newPath, value.paymentEntityId);
  result = CheckLastError("VPM", gkFuncRefGet, result);

  snprintf(newPath, elcount(newPath), "%s.%s", oldPath, "responseParameter");
  if(value.responseParameter.isValidFlag==1)
  {
    SetVPMTransInfoParams(packetHandle, value.responseParameter, newPath);
    result = CheckLastError("VPM", gkFuncRefGet, result);
  }
  else
  {
    if( C2xIsTokenAvailable(packetHandle, "VPM", newPath) )
    {
      C2xRemoveToken(packetHandle, "VPM", newPath);
    }
  }

  snprintf(newPath, elcount(newPath), "%s.%s", oldPath, "ret");
  C2xSetTokenInt(packetHandle, "VPM", newPath, value.ret);
  result = CheckLastError("VPM", gkFuncRefGet, result);

  return result;
}

int GetVPMVehiclePaymentMessage_paymentParams(LONG packetHandle, struct VPMVehiclePaymentMessage_payment value, char oldPath[])
{
  char newPath[300];
  int result;

  result = 0;

  value.choice = C2xGetTokenInt(packetHandle, "VPM", oldPath);

  switch(value.choice)
  {
    case 0:
    {
      snprintf(newPath, elcount(newPath), "%s.%s", oldPath, "initialzation_request");
      GetVPMRSTParams(packetHandle, value.initialzation_request, newPath);
      result = CheckLastError("VPM", gkFuncRefGet, result);
    }
    break;
    case 1:
    {
      snprintf(newPath, elcount(newPath), "%s.%s", oldPath, "initialzation_response");
      GetVPMVSIParams(packetHandle, value.initialzation_response, newPath);
      result = CheckLastError("VPM", gkFuncRefGet, result);
    }
    break;
    case 2:
    {
      snprintf(newPath, elcount(newPath), "%s.%s", oldPath, "action_request");
      GetVPMAction_RequestParams(packetHandle, value.action_request, newPath);
      result = CheckLastError("VPM", gkFuncRefGet, result);
    }
    break;
    case 3:
    {
      snprintf(newPath, elcount(newPath), "%s.%s", oldPath, "action_response");
      GetVPMAction_ResponseParams(packetHandle, value.action_response, newPath);
      result = CheckLastError("VPM", gkFuncRefGet, result);
    }
    break;
  }
  return result;
}

int SetVPMVehiclePaymentMessage_paymentParams(LONG packetHandle, struct VPMVehiclePaymentMessage_payment value, char oldPath[])
{
  char newPath[300];
  int result;

  result = 0;

  switch(value.choice)
  {
    case 0:
    {
      snprintf(newPath, elcount(newPath), "%s.%s", oldPath, "initialzation_request");
      SetVPMRSTParams(packetHandle, value.initialzation_request, newPath);
      result = CheckLastError("VPM", gkFuncRefGet, result);
    }
    break;
    case 1:
    {
      snprintf(newPath, elcount(newPath), "%s.%s", oldPath, "initialzation_response");
      SetVPMVSIParams(packetHandle, value.initialzation_response, newPath);
      result = CheckLastError("VPM", gkFuncRefGet, result);
    }
    break;
    case 2:
    {
      snprintf(newPath, elcount(newPath), "%s.%s", oldPath, "action_request");
      SetVPMAction_RequestParams(packetHandle, value.action_request, newPath);
      result = CheckLastError("VPM", gkFuncRefGet, result);
    }
    break;
    case 3:
    {
      snprintf(newPath, elcount(newPath), "%s.%s", oldPath, "action_response");
      SetVPMAction_ResponseParams(packetHandle, value.action_response, newPath);
      result = CheckLastError("VPM", gkFuncRefGet, result);
    }
    break;
  }
  return result;
}

int GetVPMVPM_VehiclePaymentMessageParams(LONG packetHandle, struct VPMVPM_VehiclePaymentMessage value, char oldPath[])
{
  char newPath[300];
  int result;

  result = 0;

  snprintf(newPath, elcount(newPath), "%s.%s", oldPath, "msgCnt");
  value.msgCnt = C2xGetTokenInt(packetHandle, "VPM", newPath);
  result = CheckLastError("VPM", gkFuncRefGet, result);

  snprintf(newPath, elcount(newPath), "%s.%s", oldPath, "payment");
  GetVPMVehiclePaymentMessage_paymentParams(packetHandle, value.payment, newPath);
  result = CheckLastError("VPM", gkFuncRefGet, result);

  return result;
}

int SetVPMVPM_VehiclePaymentMessageParams(LONG packetHandle, struct VPMVPM_VehiclePaymentMessage value, char oldPath[])
{
  char newPath[300];
  int result;

  result = 0;

  snprintf(newPath, elcount(newPath), "%s.%s", oldPath, "msgCnt");
  C2xSetTokenInt(packetHandle, "VPM", newPath, value.msgCnt);
  result = CheckLastError("VPM", gkFuncRefGet, result);

  snprintf(newPath, elcount(newPath), "%s.%s", oldPath, "payment");
  SetVPMVehiclePaymentMessage_paymentParams(packetHandle, value.payment, newPath);
  result = CheckLastError("VPM", gkFuncRefGet, result);

  return result;
}

int GetVPMMessageTypesParams(LONG packetHandle, WORD tableKey, struct VPMMessageTypes value, char oldPath[])
{
  char newPath[300];
  int result;

  result = 0;

  switch(tableKey)
  {
    case 17:
    {
      snprintf(newPath, elcount(newPath), "%s.%s", oldPath, "vpmData");
      GetVPMVPM_VehiclePaymentMessageParams(packetHandle, value.vpmData, newPath);
      result = CheckLastError("VPM", gkFuncRefGet, result);
    }
    break;
  }
  return result;
}

int SetVPMMessageTypesParams(LONG packetHandle, WORD tableKey, struct VPMMessageTypes value, char oldPath[])
{
  char newPath[300];
  int result;

  result = 0;

  switch(tableKey)
  {
    case 17:
    {
      snprintf(newPath, elcount(newPath), "%s.%s", oldPath, "vpmData");
      SetVPMVPM_VehiclePaymentMessageParams(packetHandle, value.vpmData, newPath);
      result = CheckLastError("VPM", gkFuncRefGet, result);
    }
    break;
  }
  return result;
}

int GetVPMMessageFrameExtParams(LONG packetHandle, struct VPMMessageFrameExt value, char oldPath[])
{
  char newPath[300];
  int result;

  result = 0;

  snprintf(newPath, elcount(newPath), "%s.%s", oldPath, "messageId");
  value.messageId = C2xGetTokenInt(packetHandle, "VPM", newPath);
  result = CheckLastError("VPM", gkFuncRefGet, result);

  snprintf(newPath, elcount(newPath), "%s.%s", oldPath, "value");
  GetVPMMessageTypesParams(packetHandle, value.messageId, value.value, newPath);
  result = CheckLastError("VPM", gkFuncRefGet, result);

  return result;
}

int SetVPMMessageFrameExtParams(LONG packetHandle, struct VPMMessageFrameExt value, char oldPath[])
{
  char newPath[300];
  int result;

  result = 0;


  snprintf(newPath, elcount(newPath), "%s.%s", oldPath, "value");
  SetVPMMessageTypesParams(packetHandle, value.messageId, value.value, newPath);
  result = CheckLastError("VPM", gkFuncRefGet, result);

  return result;
}

int API_GetVPMParams(LONG packetHandle, struct VPM value)
{
  int result;
  result = 0;

  value.msgFrameExt.isValidFlag = 1;
  GetVPMMessageFrameExtParams(packetHandle, value.msgFrameExt, "msgFrameExt");
  result = CheckLastError("VPM", gkFuncRefGet, result);

  return result;
}

int API_SetVPMParams(LONG packetHandle, struct VPM value)
{
  int result;
  result = 0;

  SetVPMMessageFrameExtParams(packetHandle, value.msgFrameExt, "msgFrameExt");
  result = CheckLastError("VPM", gkFuncRefGet, result);

  return result;
}

