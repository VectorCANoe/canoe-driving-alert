/*@!Encoding:1252*/
includes
{
  #include "..\DataSources_Templates\ASNV_Template_BaseDatatypes.cin"
  #include "..\DataSources_Templates\ASNV_Template_BasicSafetyMessage.cin"
  #include "..\DataSources_Templates\ASNV_Template_MapData.cin"
  #include "..\DataSources_Templates\ASNV_Template_SPAT.cin"
  #include "..\DataSources_Templates\ASNV_Template_RoadSideInformation.cin"
  #include "..\DataSources_Templates\ASNV_Template_RoadsideSafetyMessage.cin"
  #include "..\DataSources_Templates\ASNV_Template_RTCM.cin"
  #include "..\DataSources_Templates\ASNV_Template_RSC.cin"
  #include "..\DataSources_Templates\ASNV_Template_SSM.cin"
  #include "..\DataSources_Templates\ASNV_Template_VIR.cin"
  #include "..\DataSources_Templates\ASNV_Template_PAM.cin"
  #include "..\DataSources_Templates\ASNV_Template_PSM.cin"
  #include "..\DataSources_Templates\ASNV_Template_CLPMM.cin"
  #include "..\DataSources_Templates\ASNV_Template_VPM.cin"
}

// On start, callback functions for the application messages can be registered.
// It is possible to do the same with the other application messages if needed.
on start
{
  enum CallbackType { OnRx, PreTx };
  
  C2xRegisterCallback(OnRx,  "OnRxBasicSafetyMessage",    "BasicSafetyMessage");
  C2xRegisterCallback(PreTx, "OnPreTxBasicSafetyMessage", "BasicSafetyMessage");
  
  C2xRegisterCallback(OnRx,  "OnRxMapData",    "MapData");
  C2xRegisterCallback(PreTx, "OnPreTxMapData", "MapData");
  
  C2xRegisterCallback(OnRx,  "OnRxRoadSideInformation",    "RoadSideInformation");
  C2xRegisterCallback(PreTx, "OnPreTxRoadSideInformation", "RoadSideInformation");
  
  C2xRegisterCallback(OnRx,  "OnRxRoadsideSafetyMessage",    "RoadsideSafetyMessage");
  C2xRegisterCallback(PreTx, "OnPreTxRoadsideSafetyMessage", "RoadsideSafetyMessage");
  
  C2xRegisterCallback(OnRx,  "OnRxSPAT",    "SPAT");
  C2xRegisterCallback(PreTx, "OnPreTxSPAT", "SPAT");
  
  C2xRegisterCallback(OnRx,  "OnRxRTCM",    "RTCM");
  C2xRegisterCallback(PreTx, "OnPreTxRTCM", "RTCM");

  C2xRegisterCallback(OnRx,  "OnRxRSC",    "RSC");
  C2xRegisterCallback(PreTx, "OnPreTxRSC", "RSC");

  C2xRegisterCallback(OnRx,  "OnRxSSM",    "SSM");
  C2xRegisterCallback(PreTx, "OnPreTxSSM", "SSM");

  C2xRegisterCallback(OnRx,  "OnRxVIR",    "VIR");
  C2xRegisterCallback(PreTx, "OnPreTxVIR", "VIR");
  
  C2xRegisterCallback(OnRx,  "OnRxPAM",    "PAM");
  C2xRegisterCallback(PreTx, "OnPreTxPAM", "PAM");

  C2xRegisterCallback(OnRx,  "OnRxPSM",    "PSM");
  C2xRegisterCallback(PreTx, "OnPreTxPSM", "PSM");
  
  C2xRegisterCallback(OnRx,  "OnRxCLPMM",    "CLPMM");
  C2xRegisterCallback(PreTx, "OnPreTxCLPMM", "CLPMM");

  C2xRegisterCallback(OnRx,  "OnRxVPM",    "VPM");
  C2xRegisterCallback(PreTx, "OnPreTxVPM", "VPM");
}

// Callback function on receiving BasicSafetyMessage messages
void OnRxBasicSafetyMessage(long channel, long dir, long radioChannel, long signalStrength, long signalQuality, long packet)
{

}

// Callback function before sending BasicSafetyMessage messages from IL
void OnPreTxBasicSafetyMessage(LONG packet)
{

}

// Callback function on receiving MapData messages
void OnRxMapData(long channel, long dir, long radioChannel, long signalStrength, long signalQuality, long packet)
{

}

// Callback function before sending MapData messages from IL
void OnPreTxMapData(LONG packet)
{

}

// Callback function on receiving RoadSideInformation messages
void OnRxRoadSideInformation(long channel, long dir, long radioChannel, long signalStrength, long signalQuality, long packet)
{

}

// Callback function before sending RoadSideInformation messages from IL
void OnPreTxRoadSideInformation(LONG packet)
{

}

// Callback function on receiving RoadsideSafetyMessage messages
void OnRxRoadsideSafetyMessage(long channel, long dir, long radioChannel, long signalStrength, long signalQuality, long packet)
{

}

// Callback function before sending RoadsideSafetyMessage messages from IL
void OnPreTxRoadsideSafetyMessage(LONG packet)
{

}


// Callback function on receiving SPAT messages
void OnRxSPAT(long channel, long dir, long radioChannel, long signalStrength, long signalQuality, long packet)
{

}

// Callback function before sending SPAT messages from IL
void OnPreTxSPAT(LONG packet)
{

}

// Callback function on receiving RTCM messages
void OnRxRTCM(long channel, long dir, long radioChannel, long signalStrength, long signalQuality, long packet)
{

}

// Callback function before sending RTCM messages from IL
void OnPreTxRTCM(LONG packet)
{

}

// Callback function on receiving RSC messages
void OnRxRSC(long channel, long dir, long radioChannel, long signalStrength, long signalQuality, long packet)
{

}

// Callback function before sending RSC messages from IL
void OnPreTxRSC(LONG packet)
{

}

// Callback function on receiving SSM messages
void OnRxSSM(long channel, long dir, long radioChannel, long signalStrength, long signalQuality, long packet)
{

}

// Callback function before sending SSM messages from IL
void OnPreTxSSM(LONG packet)
{

} 

// Callback function on receiving VIR messages
void OnRxVIR(long channel, long dir, long radioChannel, long signalStrength, long signalQuality, long packet)
{

}

// Callback function before sending VIR messages from IL
void OnPreTxVIR(LONG packet)
{

}

// Callback function on receiving PAM messages
void OnRxPAM(long channel, long dir, long radioChannel, long signalStrength, long signalQuality, long packet)
{

}

// Callback function before sending PAM messages from IL
void OnPreTxPAM(LONG packet)
{

}

// Callback function on receiving PSM messages
void OnRxPSM(long channel, long dir, long radioChannel, long signalStrength, long signalQuality, long packet)
{

}

// Callback function before sending PSM messages from IL
void OnPreTxPSM(LONG packet)
{

}

// Callback function on receiving CLPMM messages
void OnRxCLPMM(long channel, long dir, long radioChannel, long signalStrength, long signalQuality, long packet)
{

}

// Callback function before sending CLPMM messages from IL
void OnPreTxCLPMM(LONG packet)
{

}

// Callback function on receiving VPM messages
void OnRxVPM(long channel, long dir, long radioChannel, long signalStrength, long signalQuality, long packet)
{

}

// Callback function before sending VPM messages from IL
void OnPreTxVPM(LONG packet)
{

}

