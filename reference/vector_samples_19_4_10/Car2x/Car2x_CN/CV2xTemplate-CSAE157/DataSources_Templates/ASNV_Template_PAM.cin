/*@!Encoding:1252*/
/*
//  (c) Vector Informatik GmbH. All rights reserved.
//
//  This file contains definitions of structs and methods that may be used
//  to set and get the values of an ASN.1 defined packet's payload.
//
//  //This example demonstrates how to set a packet's payload:
//  LONG packetHandle;
//  struct PAM payload;
//  //you need to set the values of the variable "payload" yourself
//  packetHandle = API_InitPAMPacket();
//  if (packetHandle!=0) {
//    if (API_SetPAMParams(packetHandle, payload)==0) {
//      if (C2xCompletePacket(packetHandle)==0) {
//        C2xOutputPacket(packetHandle);
//      }
//    }
//  }
//                                                                             */
includes
{
}
variables
{
    struct PAMDescriptiveName {
        INT isValidFlag;   // necessary if this struct is used as an optional field of a SEQUENCE
        CHAR string[64];
        INT  stringLength;
    };
    
    struct PAMParkingLotInfo {
        INT isValidFlag;   // necessary if this struct is used as an optional field of a SEQUENCE
        struct OPT_WORD_ASN id;  // INTEGER, OPTIONAL, 0..65535;
        struct PAMDescriptiveName name;  // IA5STRING, OPTIONAL;
        struct OPT_WORD_ASN number;  // INTEGER, OPTIONAL, 0..65535;
        struct OPT_WORD_ASN buildingLayerNum;  // INTEGER, OPTIONAL, 0..256;
        struct OPT_ENUM_ASN avpType;  // ENUMERATED, OPTIONAL, p0(0), p1(1), p2(2), p3(3), p4(4), p5(5);
    };
    
    struct PAMPosition3D {
        INT isValidFlag;   // necessary if this struct is used as an optional field of a SEQUENCE
        LONG lat;  // INTEGER, -900000000..900000001;
        LONG lon;  // INTEGER, -1799999999..1800000001;
        struct OPT_LONG_ASN elevation;  // INTEGER, OPTIONAL, -4096..61439;
    };
    
    struct PAMPAMNodeAttributes {
        INT isValidFlag;   // necessary if this struct is used as an optional field of a SEQUENCE
        CHAR string[9];
        INT  stringLength;
    };
    
    struct PAMPosition_LL_24B {
        INT isValidFlag;   // necessary if this struct is used as an optional field of a SEQUENCE
        INT lon;  // INTEGER, -2048..2047;
        INT lat;  // INTEGER, -2048..2047;
    };
    
    struct PAMPosition_LL_28B {
        INT isValidFlag;   // necessary if this struct is used as an optional field of a SEQUENCE
        INT lon;  // INTEGER, -8192..8191;
        INT lat;  // INTEGER, -8192..8191;
    };
    
    struct PAMPosition_LL_32B {
        INT isValidFlag;   // necessary if this struct is used as an optional field of a SEQUENCE
        INT lon;  // INTEGER, -32768..32767;
        INT lat;  // INTEGER, -32768..32767;
    };
    
    struct PAMPosition_LL_36B {
        INT isValidFlag;   // necessary if this struct is used as an optional field of a SEQUENCE
        LONG lon;  // INTEGER, -131072..131071;
        LONG lat;  // INTEGER, -131072..131071;
    };
    
    struct PAMPosition_LL_44B {
        INT isValidFlag;   // necessary if this struct is used as an optional field of a SEQUENCE
        LONG lon;  // INTEGER, -2097152..2097151;
        LONG lat;  // INTEGER, -2097152..2097151;
    };
    
    struct PAMPosition_LL_48B {
        INT isValidFlag;   // necessary if this struct is used as an optional field of a SEQUENCE
        LONG lon;  // INTEGER, -8388608..8388607;
        LONG lat;  // INTEGER, -8388608..8388607;
    };
    
    struct PAMPosition_LLmD_64b {
        INT isValidFlag;   // necessary if this struct is used as an optional field of a SEQUENCE
        LONG lon;  // INTEGER, -1799999999..1800000001;
        LONG lat;  // INTEGER, -900000000..900000001;
    };
    
    struct PAMPositionOffsetLL {
        INT isValidFlag;   // necessary if this struct is used as an optional field of a SEQUENCE
        INT choice;
        struct PAMPosition_LL_24B position_LL1;  // SEQUENCE;
        struct PAMPosition_LL_28B position_LL2;  // SEQUENCE;
        struct PAMPosition_LL_32B position_LL3;  // SEQUENCE;
        struct PAMPosition_LL_36B position_LL4;  // SEQUENCE;
        struct PAMPosition_LL_44B position_LL5;  // SEQUENCE;
        struct PAMPosition_LL_48B position_LL6;  // SEQUENCE;
        struct PAMPosition_LLmD_64b position_LatLon;  // SEQUENCE;
    };
    
    struct PAMVerticalOffset {
        INT isValidFlag;   // necessary if this struct is used as an optional field of a SEQUENCE
        INT choice;
        INT offset1;  // INTEGER, -64..63;
        INT offset2;  // INTEGER, -128..127;
        INT offset3;  // INTEGER, -256..255;
        INT offset4;  // INTEGER, -512..511;
        INT offset5;  // INTEGER, -1024..1023;
        INT offset6;  // INTEGER, -2048..2047;
        LONG elevation;  // INTEGER, -4096..61439;
    };
    
    struct PAMPositionOffsetLLV {
        INT isValidFlag;   // necessary if this struct is used as an optional field of a SEQUENCE
        struct PAMPositionOffsetLL offsetLL;  // CHOICE;
        struct PAMVerticalOffset offsetV;  // CHOICE, OPTIONAL;
    };
    
    struct PAMRoadPoint {
        INT isValidFlag;   // necessary if this struct is used as an optional field of a SEQUENCE
        struct PAMPositionOffsetLLV posOffset;  // SEQUENCE;
    };
    
    struct PAMPointList {
        INT isValidFlag;   // necessary if this struct is used as an optional field of a SEQUENCE
        INT length;
        struct PAMRoadPoint arrayValue[31];  // SEQUENCE;
    };
    
    struct PAMPAMMovementList {
        INT isValidFlag;   // necessary if this struct is used as an optional field of a SEQUENCE
        INT length;
        WORD arrayValue[32];  // INTEGER, 0..65535;
    };
    
    struct PAMParkingSlotPosition {
        INT isValidFlag;   // necessary if this struct is used as an optional field of a SEQUENCE
        struct PAMPositionOffsetLLV topLeft;  // SEQUENCE;
        struct PAMPositionOffsetLLV topRight;  // SEQUENCE;
        struct PAMPositionOffsetLLV bottomLeft;  // SEQUENCE;
    };
    
    struct PAMParkingType {
        INT isValidFlag;   // necessary if this struct is used as an optional field of a SEQUENCE
        CHAR string[11];
        INT  stringLength;
    };
    
    struct PAMParkingSlot {
        INT isValidFlag;   // necessary if this struct is used as an optional field of a SEQUENCE
        WORD slotID;  // INTEGER, 0..65535;
        struct PAMParkingSlotPosition position;  // SEQUENCE, OPTIONAL;
        struct PAMDescriptiveName sign;  // IA5STRING, OPTIONAL;
        struct PAMParkingType parkingType;  // BITSTRING;
        INT status;  // ENUMERATED, unknown(0), available(1), occupied(2), reserved(3);
        INT parkingSpaceTheta;  // ENUMERATED, unknown(0), vertical(1), side(2), oblique(3);
        INT parkingLock;  // ENUMERATED, unknown(0), nolock(1), locked(2), unlocked(3);
    };
    
    struct PAMParkingSlots {
        INT isValidFlag;   // necessary if this struct is used as an optional field of a SEQUENCE
        INT length;
        struct PAMParkingSlot arrayValue[256];  // SEQUENCE;
    };
    
    struct PAMPAMDrive {
        INT isValidFlag;   // necessary if this struct is used as an optional field of a SEQUENCE
        WORD upstreamPAMNodeId;  // INTEGER, 0..65535;
        struct OPT_BYTE_ASN driveID;  // INTEGER, OPTIONAL, 0..255;
        struct OPT_BOOL_ASN twowaySepration;  // BOOLEAN, OPTIONAL;
        struct OPT_WORD_ASN speedLimit;  // INTEGER, OPTIONAL, 0..8191;
        struct OPT_BYTE_ASN heightRestriction;  // INTEGER, OPTIONAL, 0..100;
        struct OPT_WORD_ASN driveWidth;  // INTEGER, OPTIONAL, 0..32767;
        struct OPT_BYTE_ASN laneNum;  // INTEGER, OPTIONAL, 0..100;
        struct PAMPointList points;  // SEQUENCEOF, OPTIONAL;
        struct PAMPAMMovementList movements;  // SEQUENCEOF, OPTIONAL;
        struct PAMParkingSlots parkingSlots;  // SEQUENCEOF, OPTIONAL;
    };
    
    struct PAMPAMDriveList {
        INT isValidFlag;   // necessary if this struct is used as an optional field of a SEQUENCE
        INT length;
        struct PAMPAMDrive arrayValue[63];  // SEQUENCE;
    };
    
    struct PAMPAMNode {
        INT isValidFlag;   // necessary if this struct is used as an optional field of a SEQUENCE
        WORD id;  // INTEGER, 0..65535;
        struct PAMPosition3D refPos;  // SEQUENCE;
        struct OPT_INT_ASN floor;  // INTEGER, OPTIONAL, -128..128;
        struct PAMPAMNodeAttributes attributes;  // BITSTRING, OPTIONAL;
        struct PAMPAMDriveList inDrives;  // SEQUENCEOF, OPTIONAL;
    };
    
    struct PAMPAMNodeList {
        INT isValidFlag;   // necessary if this struct is used as an optional field of a SEQUENCE
        INT length;
        struct PAMPAMNode arrayValue[63];  // SEQUENCE;
    };
    
    struct PAMParkingGuide_vehId {
        INT isValidFlag;   // necessary if this struct is used as an optional field of a SEQUENCE
        CHAR string[9];
        INT  stringLength;
    };
    
    struct PAMParkingGuide_drivePath {
        INT isValidFlag;   // necessary if this struct is used as an optional field of a SEQUENCE
        INT length;
        WORD arrayValue[32];  // INTEGER, 0..65535;
    };
    
    struct PAMParkingGuide {
        INT isValidFlag;   // necessary if this struct is used as an optional field of a SEQUENCE
        struct PAMParkingGuide_vehId vehId;  // OCTETSTRING;
        struct PAMParkingGuide_drivePath drivePath;  // SEQUENCEOF;
        struct OPT_WORD_ASN targetParkingSlot;  // INTEGER, OPTIONAL, 0..65535;
    };
    
    struct PAMPAMData_parkingAreaGuidance {
        INT isValidFlag;   // necessary if this struct is used as an optional field of a SEQUENCE
        INT length;
        struct PAMParkingGuide arrayValue[16];  // SEQUENCE;
    };
    
    struct PAMPAM_PAMData {
        INT isValidFlag;   // necessary if this struct is used as an optional field of a SEQUENCE
        BYTE msgCnt;  // INTEGER, 0..127;
        struct OPT_DWORD_ASN timeStamp;  // INTEGER, OPTIONAL, 0..527040;
        struct PAMParkingLotInfo parkingLotInfo;  // SEQUENCE;
        struct PAMPAMNodeList pamNodes;  // SEQUENCEOF;
        struct PAMPAMData_parkingAreaGuidance parkingAreaGuidance;  // SEQUENCEOF, OPTIONAL;
    };
    
    struct PAMMessageTypes {
        struct PAMPAM_PAMData pamData;  // SEQUENCE;
    };
    
    struct PAMMessageFrameExt {
        INT isValidFlag;   // necessary if this struct is used as an optional field of a SEQUENCE
        WORD messageId;  // INTEGER, 0..32767;
        struct PAMMessageTypes value;  // TABLE;
    };
    
    struct PAM {
        INT isValidFlag;   // necessary if this struct is used as an optional field of a SEQUENCE
        INT choice;
        struct PAMMessageFrameExt msgFrameExt;  // SEQUENCE;
    };
    
}

/*
// init function to create a simple packet handle
*/ 
LONG API_InitPAMPacket()
{
  return C2xInitPacket("PAM"); 
}

/*
// init function to create a simple packet handle and
// initialize the struct with valid data
*/ 
LONG API_InitPAMPacket(struct PAM msgStruct)
{
  long pktHandle;

  pktHandle = API_InitPAMPacket();

  if (pktHandle != 0)
  {
    // create valid message and application data
    if (C2xCompletePacket(pktHandle) == 0) 
    {
      API_GetPAMParams(pktHandle, msgStruct);
    }
  }
  return pktHandle;
}

/*
// init function to create a packet with security layer and
// initialize the struct with valid data
*/ 
LONG API_InitPAMPacket(struct PAM msgStruct, char packetTypeDesignator[], char certificateName[])
{
  long pktHandle, certHdl;

  // initialize the packet
  pktHandle = C2xInitPacket("PAM", packetTypeDesignator);

  if (pktHandle != 0)
  {
    certHdl = C2xSecCertificateGetHandle(certificateName);  // get the certificate handle for the cert with name "certificateName"
    if (certHdl != 0) 
    {
      C2xSecPacketSetSignerHandle(pktHandle, certHdl); // set the certHdl to the packet
    }

    // create valid message and application data
    if (C2xCompletePacket(pktHandle) == 0) 
    {
      // copy application data to the application structure
      API_GetPAMParams(pktHandle, msgStruct);
    }
  }
  return pktHandle;
}
    

int GetPAMParkingLotInfoParams(LONG packetHandle, struct PAMParkingLotInfo value, char oldPath[])
{
  char newPath[300];
  int result;

  result = 0;

  snprintf(newPath, elcount(newPath), "%s.%s", oldPath, "id");
  value.id.isValidFlag = C2xIsTokenAvailable(packetHandle, "PAM", newPath);
  if(value.id.isValidFlag==1)
  {
    value.id.value = C2xGetTokenInt(packetHandle, "PAM", newPath);
    result = CheckLastError("PAM", gkFuncRefGet, result);
  }
  snprintf(newPath, elcount(newPath), "%s.%s", oldPath, "name");
  value.name.isValidFlag = C2xIsTokenAvailable(packetHandle, "PAM", newPath);
  if(value.name.isValidFlag==1)
  {
    value.name.stringLength = C2xGetTokenData(packetHandle, "PAM", newPath, elcount(value.name.string), value.name.string);
    result = CheckLastError("PAM", gkFuncRefGet, result);
  }
  snprintf(newPath, elcount(newPath), "%s.%s", oldPath, "number");
  value.number.isValidFlag = C2xIsTokenAvailable(packetHandle, "PAM", newPath);
  if(value.number.isValidFlag==1)
  {
    value.number.value = C2xGetTokenInt(packetHandle, "PAM", newPath);
    result = CheckLastError("PAM", gkFuncRefGet, result);
  }
  snprintf(newPath, elcount(newPath), "%s.%s", oldPath, "buildingLayerNum");
  value.buildingLayerNum.isValidFlag = C2xIsTokenAvailable(packetHandle, "PAM", newPath);
  if(value.buildingLayerNum.isValidFlag==1)
  {
    value.buildingLayerNum.value = C2xGetTokenInt(packetHandle, "PAM", newPath);
    result = CheckLastError("PAM", gkFuncRefGet, result);
  }
  snprintf(newPath, elcount(newPath), "%s.%s", oldPath, "avpType");
  value.avpType.isValidFlag = C2xIsTokenAvailable(packetHandle, "PAM", newPath);
  if(value.avpType.isValidFlag==1)
  {
    value.avpType.value = C2xGetTokenInt(packetHandle, "PAM", newPath);
    result = CheckLastError("PAM", gkFuncRefGet, result);
  }
  return result;
}

int SetPAMParkingLotInfoParams(LONG packetHandle, struct PAMParkingLotInfo value, char oldPath[])
{
  char newPath[300];
  int result;

  result = 0;

  snprintf(newPath, elcount(newPath), "%s.%s", oldPath, "id");
  if(value.id.isValidFlag==1)
  {
    C2xSetTokenInt(packetHandle, "PAM", newPath, value.id.value);
    result = CheckLastError("PAM", gkFuncRefGet, result);
  }
  else
  {
    if( C2xIsTokenAvailable(packetHandle, "PAM", newPath) )
    {
      C2xRemoveToken(packetHandle, "PAM", newPath);
    }
  }

  snprintf(newPath, elcount(newPath), "%s.%s", oldPath, "name");
  if(value.name.isValidFlag==1)
  {
    C2xSetTokenData(packetHandle, "PAM", newPath, value.name.stringLength, value.name.string);
    result = CheckLastError("PAM", gkFuncRefGet, result);
  }
  else
  {
    if( C2xIsTokenAvailable(packetHandle, "PAM", newPath) )
    {
      C2xRemoveToken(packetHandle, "PAM", newPath);
    }
  }

  snprintf(newPath, elcount(newPath), "%s.%s", oldPath, "number");
  if(value.number.isValidFlag==1)
  {
    C2xSetTokenInt(packetHandle, "PAM", newPath, value.number.value);
    result = CheckLastError("PAM", gkFuncRefGet, result);
  }
  else
  {
    if( C2xIsTokenAvailable(packetHandle, "PAM", newPath) )
    {
      C2xRemoveToken(packetHandle, "PAM", newPath);
    }
  }

  snprintf(newPath, elcount(newPath), "%s.%s", oldPath, "buildingLayerNum");
  if(value.buildingLayerNum.isValidFlag==1)
  {
    C2xSetTokenInt(packetHandle, "PAM", newPath, value.buildingLayerNum.value);
    result = CheckLastError("PAM", gkFuncRefGet, result);
  }
  else
  {
    if( C2xIsTokenAvailable(packetHandle, "PAM", newPath) )
    {
      C2xRemoveToken(packetHandle, "PAM", newPath);
    }
  }

  snprintf(newPath, elcount(newPath), "%s.%s", oldPath, "avpType");
  if(value.avpType.isValidFlag==1)
  {
    C2xSetTokenInt(packetHandle, "PAM", newPath, value.avpType.value);
    result = CheckLastError("PAM", gkFuncRefGet, result);
  }
  else
  {
    if( C2xIsTokenAvailable(packetHandle, "PAM", newPath) )
    {
      C2xRemoveToken(packetHandle, "PAM", newPath);
    }
  }

  return result;
}

int GetPAMPosition3DParams(LONG packetHandle, struct PAMPosition3D value, char oldPath[])
{
  char newPath[300];
  int result;

  result = 0;

  snprintf(newPath, elcount(newPath), "%s.%s", oldPath, "lat");
  value.lat = C2xGetTokenInt(packetHandle, "PAM", newPath);
  result = CheckLastError("PAM", gkFuncRefGet, result);

  snprintf(newPath, elcount(newPath), "%s.%s", oldPath, "lon");
  value.lon = C2xGetTokenInt(packetHandle, "PAM", newPath);
  result = CheckLastError("PAM", gkFuncRefGet, result);

  snprintf(newPath, elcount(newPath), "%s.%s", oldPath, "elevation");
  value.elevation.isValidFlag = C2xIsTokenAvailable(packetHandle, "PAM", newPath);
  if(value.elevation.isValidFlag==1)
  {
    value.elevation.value = C2xGetTokenInt(packetHandle, "PAM", newPath);
    result = CheckLastError("PAM", gkFuncRefGet, result);
  }
  return result;
}

int SetPAMPosition3DParams(LONG packetHandle, struct PAMPosition3D value, char oldPath[])
{
  char newPath[300];
  int result;

  result = 0;

  snprintf(newPath, elcount(newPath), "%s.%s", oldPath, "lat");
  C2xSetTokenInt(packetHandle, "PAM", newPath, value.lat);
  result = CheckLastError("PAM", gkFuncRefGet, result);

  snprintf(newPath, elcount(newPath), "%s.%s", oldPath, "lon");
  C2xSetTokenInt(packetHandle, "PAM", newPath, value.lon);
  result = CheckLastError("PAM", gkFuncRefGet, result);

  snprintf(newPath, elcount(newPath), "%s.%s", oldPath, "elevation");
  if(value.elevation.isValidFlag==1)
  {
    C2xSetTokenInt(packetHandle, "PAM", newPath, value.elevation.value);
    result = CheckLastError("PAM", gkFuncRefGet, result);
  }
  else
  {
    if( C2xIsTokenAvailable(packetHandle, "PAM", newPath) )
    {
      C2xRemoveToken(packetHandle, "PAM", newPath);
    }
  }

  return result;
}

int GetPAMPosition_LL_24BParams(LONG packetHandle, struct PAMPosition_LL_24B value, char oldPath[])
{
  char newPath[300];
  int result;

  result = 0;

  snprintf(newPath, elcount(newPath), "%s.%s", oldPath, "lon");
  value.lon = C2xGetTokenInt(packetHandle, "PAM", newPath);
  result = CheckLastError("PAM", gkFuncRefGet, result);

  snprintf(newPath, elcount(newPath), "%s.%s", oldPath, "lat");
  value.lat = C2xGetTokenInt(packetHandle, "PAM", newPath);
  result = CheckLastError("PAM", gkFuncRefGet, result);

  return result;
}

int SetPAMPosition_LL_24BParams(LONG packetHandle, struct PAMPosition_LL_24B value, char oldPath[])
{
  char newPath[300];
  int result;

  result = 0;

  snprintf(newPath, elcount(newPath), "%s.%s", oldPath, "lon");
  C2xSetTokenInt(packetHandle, "PAM", newPath, value.lon);
  result = CheckLastError("PAM", gkFuncRefGet, result);

  snprintf(newPath, elcount(newPath), "%s.%s", oldPath, "lat");
  C2xSetTokenInt(packetHandle, "PAM", newPath, value.lat);
  result = CheckLastError("PAM", gkFuncRefGet, result);

  return result;
}

int GetPAMPosition_LL_28BParams(LONG packetHandle, struct PAMPosition_LL_28B value, char oldPath[])
{
  char newPath[300];
  int result;

  result = 0;

  snprintf(newPath, elcount(newPath), "%s.%s", oldPath, "lon");
  value.lon = C2xGetTokenInt(packetHandle, "PAM", newPath);
  result = CheckLastError("PAM", gkFuncRefGet, result);

  snprintf(newPath, elcount(newPath), "%s.%s", oldPath, "lat");
  value.lat = C2xGetTokenInt(packetHandle, "PAM", newPath);
  result = CheckLastError("PAM", gkFuncRefGet, result);

  return result;
}

int SetPAMPosition_LL_28BParams(LONG packetHandle, struct PAMPosition_LL_28B value, char oldPath[])
{
  char newPath[300];
  int result;

  result = 0;

  snprintf(newPath, elcount(newPath), "%s.%s", oldPath, "lon");
  C2xSetTokenInt(packetHandle, "PAM", newPath, value.lon);
  result = CheckLastError("PAM", gkFuncRefGet, result);

  snprintf(newPath, elcount(newPath), "%s.%s", oldPath, "lat");
  C2xSetTokenInt(packetHandle, "PAM", newPath, value.lat);
  result = CheckLastError("PAM", gkFuncRefGet, result);

  return result;
}

int GetPAMPosition_LL_32BParams(LONG packetHandle, struct PAMPosition_LL_32B value, char oldPath[])
{
  char newPath[300];
  int result;

  result = 0;

  snprintf(newPath, elcount(newPath), "%s.%s", oldPath, "lon");
  value.lon = C2xGetTokenInt(packetHandle, "PAM", newPath);
  result = CheckLastError("PAM", gkFuncRefGet, result);

  snprintf(newPath, elcount(newPath), "%s.%s", oldPath, "lat");
  value.lat = C2xGetTokenInt(packetHandle, "PAM", newPath);
  result = CheckLastError("PAM", gkFuncRefGet, result);

  return result;
}

int SetPAMPosition_LL_32BParams(LONG packetHandle, struct PAMPosition_LL_32B value, char oldPath[])
{
  char newPath[300];
  int result;

  result = 0;

  snprintf(newPath, elcount(newPath), "%s.%s", oldPath, "lon");
  C2xSetTokenInt(packetHandle, "PAM", newPath, value.lon);
  result = CheckLastError("PAM", gkFuncRefGet, result);

  snprintf(newPath, elcount(newPath), "%s.%s", oldPath, "lat");
  C2xSetTokenInt(packetHandle, "PAM", newPath, value.lat);
  result = CheckLastError("PAM", gkFuncRefGet, result);

  return result;
}

int GetPAMPosition_LL_36BParams(LONG packetHandle, struct PAMPosition_LL_36B value, char oldPath[])
{
  char newPath[300];
  int result;

  result = 0;

  snprintf(newPath, elcount(newPath), "%s.%s", oldPath, "lon");
  value.lon = C2xGetTokenInt(packetHandle, "PAM", newPath);
  result = CheckLastError("PAM", gkFuncRefGet, result);

  snprintf(newPath, elcount(newPath), "%s.%s", oldPath, "lat");
  value.lat = C2xGetTokenInt(packetHandle, "PAM", newPath);
  result = CheckLastError("PAM", gkFuncRefGet, result);

  return result;
}

int SetPAMPosition_LL_36BParams(LONG packetHandle, struct PAMPosition_LL_36B value, char oldPath[])
{
  char newPath[300];
  int result;

  result = 0;

  snprintf(newPath, elcount(newPath), "%s.%s", oldPath, "lon");
  C2xSetTokenInt(packetHandle, "PAM", newPath, value.lon);
  result = CheckLastError("PAM", gkFuncRefGet, result);

  snprintf(newPath, elcount(newPath), "%s.%s", oldPath, "lat");
  C2xSetTokenInt(packetHandle, "PAM", newPath, value.lat);
  result = CheckLastError("PAM", gkFuncRefGet, result);

  return result;
}

int GetPAMPosition_LL_44BParams(LONG packetHandle, struct PAMPosition_LL_44B value, char oldPath[])
{
  char newPath[300];
  int result;

  result = 0;

  snprintf(newPath, elcount(newPath), "%s.%s", oldPath, "lon");
  value.lon = C2xGetTokenInt(packetHandle, "PAM", newPath);
  result = CheckLastError("PAM", gkFuncRefGet, result);

  snprintf(newPath, elcount(newPath), "%s.%s", oldPath, "lat");
  value.lat = C2xGetTokenInt(packetHandle, "PAM", newPath);
  result = CheckLastError("PAM", gkFuncRefGet, result);

  return result;
}

int SetPAMPosition_LL_44BParams(LONG packetHandle, struct PAMPosition_LL_44B value, char oldPath[])
{
  char newPath[300];
  int result;

  result = 0;

  snprintf(newPath, elcount(newPath), "%s.%s", oldPath, "lon");
  C2xSetTokenInt(packetHandle, "PAM", newPath, value.lon);
  result = CheckLastError("PAM", gkFuncRefGet, result);

  snprintf(newPath, elcount(newPath), "%s.%s", oldPath, "lat");
  C2xSetTokenInt(packetHandle, "PAM", newPath, value.lat);
  result = CheckLastError("PAM", gkFuncRefGet, result);

  return result;
}

int GetPAMPosition_LL_48BParams(LONG packetHandle, struct PAMPosition_LL_48B value, char oldPath[])
{
  char newPath[300];
  int result;

  result = 0;

  snprintf(newPath, elcount(newPath), "%s.%s", oldPath, "lon");
  value.lon = C2xGetTokenInt(packetHandle, "PAM", newPath);
  result = CheckLastError("PAM", gkFuncRefGet, result);

  snprintf(newPath, elcount(newPath), "%s.%s", oldPath, "lat");
  value.lat = C2xGetTokenInt(packetHandle, "PAM", newPath);
  result = CheckLastError("PAM", gkFuncRefGet, result);

  return result;
}

int SetPAMPosition_LL_48BParams(LONG packetHandle, struct PAMPosition_LL_48B value, char oldPath[])
{
  char newPath[300];
  int result;

  result = 0;

  snprintf(newPath, elcount(newPath), "%s.%s", oldPath, "lon");
  C2xSetTokenInt(packetHandle, "PAM", newPath, value.lon);
  result = CheckLastError("PAM", gkFuncRefGet, result);

  snprintf(newPath, elcount(newPath), "%s.%s", oldPath, "lat");
  C2xSetTokenInt(packetHandle, "PAM", newPath, value.lat);
  result = CheckLastError("PAM", gkFuncRefGet, result);

  return result;
}

int GetPAMPosition_LLmD_64bParams(LONG packetHandle, struct PAMPosition_LLmD_64b value, char oldPath[])
{
  char newPath[300];
  int result;

  result = 0;

  snprintf(newPath, elcount(newPath), "%s.%s", oldPath, "lon");
  value.lon = C2xGetTokenInt(packetHandle, "PAM", newPath);
  result = CheckLastError("PAM", gkFuncRefGet, result);

  snprintf(newPath, elcount(newPath), "%s.%s", oldPath, "lat");
  value.lat = C2xGetTokenInt(packetHandle, "PAM", newPath);
  result = CheckLastError("PAM", gkFuncRefGet, result);

  return result;
}

int SetPAMPosition_LLmD_64bParams(LONG packetHandle, struct PAMPosition_LLmD_64b value, char oldPath[])
{
  char newPath[300];
  int result;

  result = 0;

  snprintf(newPath, elcount(newPath), "%s.%s", oldPath, "lon");
  C2xSetTokenInt(packetHandle, "PAM", newPath, value.lon);
  result = CheckLastError("PAM", gkFuncRefGet, result);

  snprintf(newPath, elcount(newPath), "%s.%s", oldPath, "lat");
  C2xSetTokenInt(packetHandle, "PAM", newPath, value.lat);
  result = CheckLastError("PAM", gkFuncRefGet, result);

  return result;
}

int GetPAMPositionOffsetLLParams(LONG packetHandle, struct PAMPositionOffsetLL value, char oldPath[])
{
  char newPath[300];
  int result;

  result = 0;

  value.choice = C2xGetTokenInt(packetHandle, "PAM", oldPath);

  switch(value.choice)
  {
    case 0:
    {
      snprintf(newPath, elcount(newPath), "%s.%s", oldPath, "position_LL1");
      GetPAMPosition_LL_24BParams(packetHandle, value.position_LL1, newPath);
      result = CheckLastError("PAM", gkFuncRefGet, result);
    }
    break;
    case 1:
    {
      snprintf(newPath, elcount(newPath), "%s.%s", oldPath, "position_LL2");
      GetPAMPosition_LL_28BParams(packetHandle, value.position_LL2, newPath);
      result = CheckLastError("PAM", gkFuncRefGet, result);
    }
    break;
    case 2:
    {
      snprintf(newPath, elcount(newPath), "%s.%s", oldPath, "position_LL3");
      GetPAMPosition_LL_32BParams(packetHandle, value.position_LL3, newPath);
      result = CheckLastError("PAM", gkFuncRefGet, result);
    }
    break;
    case 3:
    {
      snprintf(newPath, elcount(newPath), "%s.%s", oldPath, "position_LL4");
      GetPAMPosition_LL_36BParams(packetHandle, value.position_LL4, newPath);
      result = CheckLastError("PAM", gkFuncRefGet, result);
    }
    break;
    case 4:
    {
      snprintf(newPath, elcount(newPath), "%s.%s", oldPath, "position_LL5");
      GetPAMPosition_LL_44BParams(packetHandle, value.position_LL5, newPath);
      result = CheckLastError("PAM", gkFuncRefGet, result);
    }
    break;
    case 5:
    {
      snprintf(newPath, elcount(newPath), "%s.%s", oldPath, "position_LL6");
      GetPAMPosition_LL_48BParams(packetHandle, value.position_LL6, newPath);
      result = CheckLastError("PAM", gkFuncRefGet, result);
    }
    break;
    case 6:
    {
      snprintf(newPath, elcount(newPath), "%s.%s", oldPath, "position_LatLon");
      GetPAMPosition_LLmD_64bParams(packetHandle, value.position_LatLon, newPath);
      result = CheckLastError("PAM", gkFuncRefGet, result);
    }
    break;
  }
  return result;
}

int SetPAMPositionOffsetLLParams(LONG packetHandle, struct PAMPositionOffsetLL value, char oldPath[])
{
  char newPath[300];
  int result;

  result = 0;

  switch(value.choice)
  {
    case 0:
    {
      snprintf(newPath, elcount(newPath), "%s.%s", oldPath, "position_LL1");
      SetPAMPosition_LL_24BParams(packetHandle, value.position_LL1, newPath);
      result = CheckLastError("PAM", gkFuncRefGet, result);
    }
    break;
    case 1:
    {
      snprintf(newPath, elcount(newPath), "%s.%s", oldPath, "position_LL2");
      SetPAMPosition_LL_28BParams(packetHandle, value.position_LL2, newPath);
      result = CheckLastError("PAM", gkFuncRefGet, result);
    }
    break;
    case 2:
    {
      snprintf(newPath, elcount(newPath), "%s.%s", oldPath, "position_LL3");
      SetPAMPosition_LL_32BParams(packetHandle, value.position_LL3, newPath);
      result = CheckLastError("PAM", gkFuncRefGet, result);
    }
    break;
    case 3:
    {
      snprintf(newPath, elcount(newPath), "%s.%s", oldPath, "position_LL4");
      SetPAMPosition_LL_36BParams(packetHandle, value.position_LL4, newPath);
      result = CheckLastError("PAM", gkFuncRefGet, result);
    }
    break;
    case 4:
    {
      snprintf(newPath, elcount(newPath), "%s.%s", oldPath, "position_LL5");
      SetPAMPosition_LL_44BParams(packetHandle, value.position_LL5, newPath);
      result = CheckLastError("PAM", gkFuncRefGet, result);
    }
    break;
    case 5:
    {
      snprintf(newPath, elcount(newPath), "%s.%s", oldPath, "position_LL6");
      SetPAMPosition_LL_48BParams(packetHandle, value.position_LL6, newPath);
      result = CheckLastError("PAM", gkFuncRefGet, result);
    }
    break;
    case 6:
    {
      snprintf(newPath, elcount(newPath), "%s.%s", oldPath, "position_LatLon");
      SetPAMPosition_LLmD_64bParams(packetHandle, value.position_LatLon, newPath);
      result = CheckLastError("PAM", gkFuncRefGet, result);
    }
    break;
  }
  return result;
}

int GetPAMVerticalOffsetParams(LONG packetHandle, struct PAMVerticalOffset value, char oldPath[])
{
  char newPath[300];
  int result;

  result = 0;

  value.choice = C2xGetTokenInt(packetHandle, "PAM", oldPath);

  switch(value.choice)
  {
    case 0:
    {
      snprintf(newPath, elcount(newPath), "%s.%s", oldPath, "offset1");
      value.offset1 = C2xGetTokenInt(packetHandle, "PAM", newPath);
      result = CheckLastError("PAM", gkFuncRefGet, result);
    }
    break;
    case 1:
    {
      snprintf(newPath, elcount(newPath), "%s.%s", oldPath, "offset2");
      value.offset2 = C2xGetTokenInt(packetHandle, "PAM", newPath);
      result = CheckLastError("PAM", gkFuncRefGet, result);
    }
    break;
    case 2:
    {
      snprintf(newPath, elcount(newPath), "%s.%s", oldPath, "offset3");
      value.offset3 = C2xGetTokenInt(packetHandle, "PAM", newPath);
      result = CheckLastError("PAM", gkFuncRefGet, result);
    }
    break;
    case 3:
    {
      snprintf(newPath, elcount(newPath), "%s.%s", oldPath, "offset4");
      value.offset4 = C2xGetTokenInt(packetHandle, "PAM", newPath);
      result = CheckLastError("PAM", gkFuncRefGet, result);
    }
    break;
    case 4:
    {
      snprintf(newPath, elcount(newPath), "%s.%s", oldPath, "offset5");
      value.offset5 = C2xGetTokenInt(packetHandle, "PAM", newPath);
      result = CheckLastError("PAM", gkFuncRefGet, result);
    }
    break;
    case 5:
    {
      snprintf(newPath, elcount(newPath), "%s.%s", oldPath, "offset6");
      value.offset6 = C2xGetTokenInt(packetHandle, "PAM", newPath);
      result = CheckLastError("PAM", gkFuncRefGet, result);
    }
    break;
    case 6:
    {
      snprintf(newPath, elcount(newPath), "%s.%s", oldPath, "elevation");
      value.elevation = C2xGetTokenInt(packetHandle, "PAM", newPath);
      result = CheckLastError("PAM", gkFuncRefGet, result);
    }
    break;
  }
  return result;
}

int SetPAMVerticalOffsetParams(LONG packetHandle, struct PAMVerticalOffset value, char oldPath[])
{
  char newPath[300];
  int result;

  result = 0;

  switch(value.choice)
  {
    case 0:
    {
      snprintf(newPath, elcount(newPath), "%s.%s", oldPath, "offset1");
      C2xSetTokenInt(packetHandle, "PAM", newPath, value.offset1);
      result = CheckLastError("PAM", gkFuncRefGet, result);
    }
    break;
    case 1:
    {
      snprintf(newPath, elcount(newPath), "%s.%s", oldPath, "offset2");
      C2xSetTokenInt(packetHandle, "PAM", newPath, value.offset2);
      result = CheckLastError("PAM", gkFuncRefGet, result);
    }
    break;
    case 2:
    {
      snprintf(newPath, elcount(newPath), "%s.%s", oldPath, "offset3");
      C2xSetTokenInt(packetHandle, "PAM", newPath, value.offset3);
      result = CheckLastError("PAM", gkFuncRefGet, result);
    }
    break;
    case 3:
    {
      snprintf(newPath, elcount(newPath), "%s.%s", oldPath, "offset4");
      C2xSetTokenInt(packetHandle, "PAM", newPath, value.offset4);
      result = CheckLastError("PAM", gkFuncRefGet, result);
    }
    break;
    case 4:
    {
      snprintf(newPath, elcount(newPath), "%s.%s", oldPath, "offset5");
      C2xSetTokenInt(packetHandle, "PAM", newPath, value.offset5);
      result = CheckLastError("PAM", gkFuncRefGet, result);
    }
    break;
    case 5:
    {
      snprintf(newPath, elcount(newPath), "%s.%s", oldPath, "offset6");
      C2xSetTokenInt(packetHandle, "PAM", newPath, value.offset6);
      result = CheckLastError("PAM", gkFuncRefGet, result);
    }
    break;
    case 6:
    {
      snprintf(newPath, elcount(newPath), "%s.%s", oldPath, "elevation");
      C2xSetTokenInt(packetHandle, "PAM", newPath, value.elevation);
      result = CheckLastError("PAM", gkFuncRefGet, result);
    }
    break;
  }
  return result;
}

int GetPAMPositionOffsetLLVParams(LONG packetHandle, struct PAMPositionOffsetLLV value, char oldPath[])
{
  char newPath[300];
  int result;

  result = 0;

  snprintf(newPath, elcount(newPath), "%s.%s", oldPath, "offsetLL");
  GetPAMPositionOffsetLLParams(packetHandle, value.offsetLL, newPath);
  result = CheckLastError("PAM", gkFuncRefGet, result);

  snprintf(newPath, elcount(newPath), "%s.%s", oldPath, "offsetV");
  value.offsetV.isValidFlag = C2xIsTokenAvailable(packetHandle, "PAM", newPath);
  if(value.offsetV.isValidFlag==1)
  {
    GetPAMVerticalOffsetParams(packetHandle, value.offsetV, newPath);
    result = CheckLastError("PAM", gkFuncRefGet, result);
  }
  return result;
}

int SetPAMPositionOffsetLLVParams(LONG packetHandle, struct PAMPositionOffsetLLV value, char oldPath[])
{
  char newPath[300];
  int result;

  result = 0;

  snprintf(newPath, elcount(newPath), "%s.%s", oldPath, "offsetLL");
  SetPAMPositionOffsetLLParams(packetHandle, value.offsetLL, newPath);
  result = CheckLastError("PAM", gkFuncRefGet, result);

  snprintf(newPath, elcount(newPath), "%s.%s", oldPath, "offsetV");
  if(value.offsetV.isValidFlag==1)
  {
    SetPAMVerticalOffsetParams(packetHandle, value.offsetV, newPath);
    result = CheckLastError("PAM", gkFuncRefGet, result);
  }
  else
  {
    if( C2xIsTokenAvailable(packetHandle, "PAM", newPath) )
    {
      C2xRemoveToken(packetHandle, "PAM", newPath);
    }
  }

  return result;
}

int GetPAMRoadPointParams(LONG packetHandle, struct PAMRoadPoint value, char oldPath[])
{
  char newPath[300];
  int result;

  result = 0;

  snprintf(newPath, elcount(newPath), "%s.%s", oldPath, "posOffset");
  GetPAMPositionOffsetLLVParams(packetHandle, value.posOffset, newPath);
  result = CheckLastError("PAM", gkFuncRefGet, result);

  return result;
}

int SetPAMRoadPointParams(LONG packetHandle, struct PAMRoadPoint value, char oldPath[])
{
  char newPath[300];
  int result;

  result = 0;

  snprintf(newPath, elcount(newPath), "%s.%s", oldPath, "posOffset");
  SetPAMPositionOffsetLLVParams(packetHandle, value.posOffset, newPath);
  result = CheckLastError("PAM", gkFuncRefGet, result);

  return result;
}

int GetPAMPointListParams(LONG packetHandle, struct PAMPointList value, char oldPath[])
{
  char newPath[300]; 
  int i;
  int result;

  result = 0;

  value.length = C2xGetTokenInt(packetHandle, "PAM", oldPath);
  if((result = CheckLastError("PAM", gkFuncRefGet, result))==0)
  {
    for(i=0; i<value.length; i++)
    {
      snprintf(newPath, elcount(newPath), "%s[%d]", oldPath, i);
      GetPAMRoadPointParams(packetHandle, value.arrayValue[i], newPath);
      result = CheckLastError("PAM", gkFuncRefGet, result);
    }
  }
  return result;
}

int SetPAMPointListParams(LONG packetHandle, struct PAMPointList value, char oldPath[])
{
  char newPath[300]; 
  int i;
  int result;

  result = 0;

  C2xRemoveToken(packetHandle, "PAM", oldPath);
  for(i=0; i<value.length; i++)
  {
    snprintf(newPath, elcount(newPath), "%s[%d]", oldPath, i);
    SetPAMRoadPointParams(packetHandle, value.arrayValue[i], newPath);
    result = CheckLastError("PAM", gkFuncRefGet, result);
  }
  return result;
}

int GetPAMPAMMovementListParams(LONG packetHandle, struct PAMPAMMovementList value, char oldPath[])
{
  char newPath[300]; 
  int i;
  int result;

  result = 0;

  value.length = C2xGetTokenInt(packetHandle, "PAM", oldPath);
  if((result = CheckLastError("PAM", gkFuncRefGet, result))==0)
  {
    for(i=0; i<value.length; i++)
    {
      snprintf(newPath, elcount(newPath), "%s[%d]", oldPath, i);
      value.arrayValue[i] = C2xGetTokenInt64(packetHandle, "PAM", newPath);
      result = CheckLastError("PAM", gkFuncRefGet, result);
    }
  }
  return result;
}

int SetPAMPAMMovementListParams(LONG packetHandle, struct PAMPAMMovementList value, char oldPath[])
{
  char newPath[300]; 
  int i;
  int result;

  result = 0;

  C2xRemoveToken(packetHandle, "PAM", oldPath);
  for(i=0; i<value.length; i++)
  {
    snprintf(newPath, elcount(newPath), "%s[%d]", oldPath, i);
    C2xSetTokenInt64(packetHandle, "PAM", newPath, value.arrayValue[i]);
    result = CheckLastError("PAM", gkFuncRefGet, result);
  }
  return result;
}

int GetPAMParkingSlotPositionParams(LONG packetHandle, struct PAMParkingSlotPosition value, char oldPath[])
{
  char newPath[300];
  int result;

  result = 0;

  snprintf(newPath, elcount(newPath), "%s.%s", oldPath, "topLeft");
  GetPAMPositionOffsetLLVParams(packetHandle, value.topLeft, newPath);
  result = CheckLastError("PAM", gkFuncRefGet, result);

  snprintf(newPath, elcount(newPath), "%s.%s", oldPath, "topRight");
  GetPAMPositionOffsetLLVParams(packetHandle, value.topRight, newPath);
  result = CheckLastError("PAM", gkFuncRefGet, result);

  snprintf(newPath, elcount(newPath), "%s.%s", oldPath, "bottomLeft");
  GetPAMPositionOffsetLLVParams(packetHandle, value.bottomLeft, newPath);
  result = CheckLastError("PAM", gkFuncRefGet, result);

  return result;
}

int SetPAMParkingSlotPositionParams(LONG packetHandle, struct PAMParkingSlotPosition value, char oldPath[])
{
  char newPath[300];
  int result;

  result = 0;

  snprintf(newPath, elcount(newPath), "%s.%s", oldPath, "topLeft");
  SetPAMPositionOffsetLLVParams(packetHandle, value.topLeft, newPath);
  result = CheckLastError("PAM", gkFuncRefGet, result);

  snprintf(newPath, elcount(newPath), "%s.%s", oldPath, "topRight");
  SetPAMPositionOffsetLLVParams(packetHandle, value.topRight, newPath);
  result = CheckLastError("PAM", gkFuncRefGet, result);

  snprintf(newPath, elcount(newPath), "%s.%s", oldPath, "bottomLeft");
  SetPAMPositionOffsetLLVParams(packetHandle, value.bottomLeft, newPath);
  result = CheckLastError("PAM", gkFuncRefGet, result);

  return result;
}

int GetPAMParkingSlotParams(LONG packetHandle, struct PAMParkingSlot value, char oldPath[])
{
  char newPath[300]; 
  int j; 
  int k;
  int result;

  result = 0;

  snprintf(newPath, elcount(newPath), "%s.%s", oldPath, "slotID");
  value.slotID = C2xGetTokenInt(packetHandle, "PAM", newPath);
  result = CheckLastError("PAM", gkFuncRefGet, result);

  snprintf(newPath, elcount(newPath), "%s.%s", oldPath, "position");
  value.position.isValidFlag = C2xIsTokenAvailable(packetHandle, "PAM", newPath);
  if(value.position.isValidFlag==1)
  {
    GetPAMParkingSlotPositionParams(packetHandle, value.position, newPath);
    result = CheckLastError("PAM", gkFuncRefGet, result);
  }
  snprintf(newPath, elcount(newPath), "%s.%s", oldPath, "sign");
  value.sign.isValidFlag = C2xIsTokenAvailable(packetHandle, "PAM", newPath);
  if(value.sign.isValidFlag==1)
  {
    value.sign.stringLength = C2xGetTokenData(packetHandle, "PAM", newPath, elcount(value.sign.string), value.sign.string);
    result = CheckLastError("PAM", gkFuncRefGet, result);
  }
  snprintf(newPath, elcount(newPath), "%s.%s", oldPath, "parkingType");
  value.parkingType.isValidFlag = 1;
  value.parkingType.stringLength = C2xGetTokenLengthBit(packetHandle, "PAM", newPath);
  if ((result = CheckLastError("PAM", gkFuncRefGet, result))==0)
  {
    if(value.parkingType.stringLength > 0)
    {
      for(j=0; j<value.parkingType.stringLength; j++)
      {
        if(C2xGetTokenBitOfBitString(packetHandle, "PAM", newPath, j) == 0)
        {
          value.parkingType.string[j] = '0';
        }
        else if(C2xGetTokenBitOfBitString(packetHandle, "PAM", newPath, j) == 1)
        {
          value.parkingType.string[j] = '1';
        }

        if(value.parkingType.stringLength == 1)
        {
          value.parkingType.string[1] = '0';
        }
        result = CheckLastError("PAM", gkFuncRefGet, result);
      }
    }
    else
    {
      for(k = value.parkingType.stringLength+1; k > -1; k--)
      {
        if(value.parkingType.string[k] == '1')
        {
          value.parkingType.string[k] = '0';
        }
      }
    }
  }

  snprintf(newPath, elcount(newPath), "%s.%s", oldPath, "status");
  value.status = C2xGetTokenInt(packetHandle, "PAM", newPath);
  result = CheckLastError("PAM", gkFuncRefGet, result);

  snprintf(newPath, elcount(newPath), "%s.%s", oldPath, "parkingSpaceTheta");
  value.parkingSpaceTheta = C2xGetTokenInt(packetHandle, "PAM", newPath);
  result = CheckLastError("PAM", gkFuncRefGet, result);

  snprintf(newPath, elcount(newPath), "%s.%s", oldPath, "parkingLock");
  value.parkingLock = C2xGetTokenInt(packetHandle, "PAM", newPath);
  result = CheckLastError("PAM", gkFuncRefGet, result);

  return result;
}

int SetPAMParkingSlotParams(LONG packetHandle, struct PAMParkingSlot value, char oldPath[])
{
  char newPath[300]; 
  int j;
  int result;

  result = 0;

  snprintf(newPath, elcount(newPath), "%s.%s", oldPath, "slotID");
  C2xSetTokenInt(packetHandle, "PAM", newPath, value.slotID);
  result = CheckLastError("PAM", gkFuncRefGet, result);

  snprintf(newPath, elcount(newPath), "%s.%s", oldPath, "position");
  if(value.position.isValidFlag==1)
  {
    SetPAMParkingSlotPositionParams(packetHandle, value.position, newPath);
    result = CheckLastError("PAM", gkFuncRefGet, result);
  }
  else
  {
    if( C2xIsTokenAvailable(packetHandle, "PAM", newPath) )
    {
      C2xRemoveToken(packetHandle, "PAM", newPath);
    }
  }

  snprintf(newPath, elcount(newPath), "%s.%s", oldPath, "sign");
  if(value.sign.isValidFlag==1)
  {
    C2xSetTokenData(packetHandle, "PAM", newPath, value.sign.stringLength, value.sign.string);
    result = CheckLastError("PAM", gkFuncRefGet, result);
  }
  else
  {
    if( C2xIsTokenAvailable(packetHandle, "PAM", newPath) )
    {
      C2xRemoveToken(packetHandle, "PAM", newPath);
    }
  }

  snprintf(newPath, elcount(newPath), "%s.%s", oldPath, "parkingType");
    for(j=0; j<value.parkingType.stringLength; j++)
    {
      if(value.parkingType.string[j] == '0')
      {
        C2xSetTokenBitOfBitString(packetHandle, "PAM", newPath, j, 0);
      }
      else
      {
        C2xSetTokenBitOfBitString(packetHandle, "PAM", newPath, j, 1);
      }
      result = CheckLastError("PAM", gkFuncRefGet, result);
    }

  snprintf(newPath, elcount(newPath), "%s.%s", oldPath, "status");
  C2xSetTokenInt(packetHandle, "PAM", newPath, value.status);
  result = CheckLastError("PAM", gkFuncRefGet, result);

  snprintf(newPath, elcount(newPath), "%s.%s", oldPath, "parkingSpaceTheta");
  C2xSetTokenInt(packetHandle, "PAM", newPath, value.parkingSpaceTheta);
  result = CheckLastError("PAM", gkFuncRefGet, result);

  snprintf(newPath, elcount(newPath), "%s.%s", oldPath, "parkingLock");
  C2xSetTokenInt(packetHandle, "PAM", newPath, value.parkingLock);
  result = CheckLastError("PAM", gkFuncRefGet, result);

  return result;
}

int GetPAMParkingSlotsParams(LONG packetHandle, struct PAMParkingSlots value, char oldPath[])
{
  char newPath[300]; 
  int i;
  int result;

  result = 0;

  value.length = C2xGetTokenInt(packetHandle, "PAM", oldPath);
  if((result = CheckLastError("PAM", gkFuncRefGet, result))==0)
  {
    for(i=0; i<value.length; i++)
    {
      snprintf(newPath, elcount(newPath), "%s[%d]", oldPath, i);
      GetPAMParkingSlotParams(packetHandle, value.arrayValue[i], newPath);
      result = CheckLastError("PAM", gkFuncRefGet, result);
    }
  }
  return result;
}

int SetPAMParkingSlotsParams(LONG packetHandle, struct PAMParkingSlots value, char oldPath[])
{
  char newPath[300]; 
  int i;
  int result;

  result = 0;

  C2xRemoveToken(packetHandle, "PAM", oldPath);
  for(i=0; i<value.length; i++)
  {
    snprintf(newPath, elcount(newPath), "%s[%d]", oldPath, i);
    SetPAMParkingSlotParams(packetHandle, value.arrayValue[i], newPath);
    result = CheckLastError("PAM", gkFuncRefGet, result);
  }
  return result;
}

int GetPAMPAMDriveParams(LONG packetHandle, struct PAMPAMDrive value, char oldPath[])
{
  char newPath[300];
  int result;

  result = 0;

  snprintf(newPath, elcount(newPath), "%s.%s", oldPath, "upstreamPAMNodeId");
  value.upstreamPAMNodeId = C2xGetTokenInt(packetHandle, "PAM", newPath);
  result = CheckLastError("PAM", gkFuncRefGet, result);

  snprintf(newPath, elcount(newPath), "%s.%s", oldPath, "driveID");
  value.driveID.isValidFlag = C2xIsTokenAvailable(packetHandle, "PAM", newPath);
  if(value.driveID.isValidFlag==1)
  {
    value.driveID.value = C2xGetTokenInt(packetHandle, "PAM", newPath);
    result = CheckLastError("PAM", gkFuncRefGet, result);
  }
  snprintf(newPath, elcount(newPath), "%s.%s", oldPath, "twowaySepration");
  value.twowaySepration.isValidFlag = C2xIsTokenAvailable(packetHandle, "PAM", newPath);
  if(value.twowaySepration.isValidFlag==1)
  {
    value.twowaySepration.value = C2xGetTokenInt64(packetHandle, "PAM", newPath);
    result = CheckLastError("PAM", gkFuncRefGet, result);
  }
  snprintf(newPath, elcount(newPath), "%s.%s", oldPath, "speedLimit");
  value.speedLimit.isValidFlag = C2xIsTokenAvailable(packetHandle, "PAM", newPath);
  if(value.speedLimit.isValidFlag==1)
  {
    value.speedLimit.value = C2xGetTokenInt(packetHandle, "PAM", newPath);
    result = CheckLastError("PAM", gkFuncRefGet, result);
  }
  snprintf(newPath, elcount(newPath), "%s.%s", oldPath, "heightRestriction");
  value.heightRestriction.isValidFlag = C2xIsTokenAvailable(packetHandle, "PAM", newPath);
  if(value.heightRestriction.isValidFlag==1)
  {
    value.heightRestriction.value = C2xGetTokenInt(packetHandle, "PAM", newPath);
    result = CheckLastError("PAM", gkFuncRefGet, result);
  }
  snprintf(newPath, elcount(newPath), "%s.%s", oldPath, "driveWidth");
  value.driveWidth.isValidFlag = C2xIsTokenAvailable(packetHandle, "PAM", newPath);
  if(value.driveWidth.isValidFlag==1)
  {
    value.driveWidth.value = C2xGetTokenInt(packetHandle, "PAM", newPath);
    result = CheckLastError("PAM", gkFuncRefGet, result);
  }
  snprintf(newPath, elcount(newPath), "%s.%s", oldPath, "laneNum");
  value.laneNum.isValidFlag = C2xIsTokenAvailable(packetHandle, "PAM", newPath);
  if(value.laneNum.isValidFlag==1)
  {
    value.laneNum.value = C2xGetTokenInt(packetHandle, "PAM", newPath);
    result = CheckLastError("PAM", gkFuncRefGet, result);
  }
  snprintf(newPath, elcount(newPath), "%s.%s", oldPath, "points");
  value.points.isValidFlag = C2xIsTokenAvailable(packetHandle, "PAM", newPath);
  if(value.points.isValidFlag==1)
  {
    GetPAMPointListParams(packetHandle, value.points, newPath);
    result = CheckLastError("PAM", gkFuncRefGet, result);
  }
  snprintf(newPath, elcount(newPath), "%s.%s", oldPath, "movements");
  value.movements.isValidFlag = C2xIsTokenAvailable(packetHandle, "PAM", newPath);
  if(value.movements.isValidFlag==1)
  {
    GetPAMPAMMovementListParams(packetHandle, value.movements, newPath);
    result = CheckLastError("PAM", gkFuncRefGet, result);
  }
  snprintf(newPath, elcount(newPath), "%s.%s", oldPath, "parkingSlots");
  value.parkingSlots.isValidFlag = C2xIsTokenAvailable(packetHandle, "PAM", newPath);
  if(value.parkingSlots.isValidFlag==1)
  {
    GetPAMParkingSlotsParams(packetHandle, value.parkingSlots, newPath);
    result = CheckLastError("PAM", gkFuncRefGet, result);
  }
  return result;
}

int SetPAMPAMDriveParams(LONG packetHandle, struct PAMPAMDrive value, char oldPath[])
{
  char newPath[300];
  int result;

  result = 0;

  snprintf(newPath, elcount(newPath), "%s.%s", oldPath, "upstreamPAMNodeId");
  C2xSetTokenInt(packetHandle, "PAM", newPath, value.upstreamPAMNodeId);
  result = CheckLastError("PAM", gkFuncRefGet, result);

  snprintf(newPath, elcount(newPath), "%s.%s", oldPath, "driveID");
  if(value.driveID.isValidFlag==1)
  {
    C2xSetTokenInt(packetHandle, "PAM", newPath, value.driveID.value);
    result = CheckLastError("PAM", gkFuncRefGet, result);
  }
  else
  {
    if( C2xIsTokenAvailable(packetHandle, "PAM", newPath) )
    {
      C2xRemoveToken(packetHandle, "PAM", newPath);
    }
  }

  snprintf(newPath, elcount(newPath), "%s.%s", oldPath, "twowaySepration");
  if(value.twowaySepration.isValidFlag==1)
  {
    C2xSetTokenInt64(packetHandle, "PAM", newPath, value.twowaySepration.value);
    result = CheckLastError("PAM", gkFuncRefGet, result);
  }
  else
  {
    if( C2xIsTokenAvailable(packetHandle, "PAM", newPath) )
    {
      C2xRemoveToken(packetHandle, "PAM", newPath);
    }
  }

  snprintf(newPath, elcount(newPath), "%s.%s", oldPath, "speedLimit");
  if(value.speedLimit.isValidFlag==1)
  {
    C2xSetTokenInt(packetHandle, "PAM", newPath, value.speedLimit.value);
    result = CheckLastError("PAM", gkFuncRefGet, result);
  }
  else
  {
    if( C2xIsTokenAvailable(packetHandle, "PAM", newPath) )
    {
      C2xRemoveToken(packetHandle, "PAM", newPath);
    }
  }

  snprintf(newPath, elcount(newPath), "%s.%s", oldPath, "heightRestriction");
  if(value.heightRestriction.isValidFlag==1)
  {
    C2xSetTokenInt(packetHandle, "PAM", newPath, value.heightRestriction.value);
    result = CheckLastError("PAM", gkFuncRefGet, result);
  }
  else
  {
    if( C2xIsTokenAvailable(packetHandle, "PAM", newPath) )
    {
      C2xRemoveToken(packetHandle, "PAM", newPath);
    }
  }

  snprintf(newPath, elcount(newPath), "%s.%s", oldPath, "driveWidth");
  if(value.driveWidth.isValidFlag==1)
  {
    C2xSetTokenInt(packetHandle, "PAM", newPath, value.driveWidth.value);
    result = CheckLastError("PAM", gkFuncRefGet, result);
  }
  else
  {
    if( C2xIsTokenAvailable(packetHandle, "PAM", newPath) )
    {
      C2xRemoveToken(packetHandle, "PAM", newPath);
    }
  }

  snprintf(newPath, elcount(newPath), "%s.%s", oldPath, "laneNum");
  if(value.laneNum.isValidFlag==1)
  {
    C2xSetTokenInt(packetHandle, "PAM", newPath, value.laneNum.value);
    result = CheckLastError("PAM", gkFuncRefGet, result);
  }
  else
  {
    if( C2xIsTokenAvailable(packetHandle, "PAM", newPath) )
    {
      C2xRemoveToken(packetHandle, "PAM", newPath);
    }
  }

  snprintf(newPath, elcount(newPath), "%s.%s", oldPath, "points");
  if(value.points.isValidFlag==1)
  {
    SetPAMPointListParams(packetHandle, value.points, newPath);
    result = CheckLastError("PAM", gkFuncRefGet, result);
  }
  else
  {
    if( C2xIsTokenAvailable(packetHandle, "PAM", newPath) )
    {
      C2xRemoveToken(packetHandle, "PAM", newPath);
    }
  }

  snprintf(newPath, elcount(newPath), "%s.%s", oldPath, "movements");
  if(value.movements.isValidFlag==1)
  {
    SetPAMPAMMovementListParams(packetHandle, value.movements, newPath);
    result = CheckLastError("PAM", gkFuncRefGet, result);
  }
  else
  {
    if( C2xIsTokenAvailable(packetHandle, "PAM", newPath) )
    {
      C2xRemoveToken(packetHandle, "PAM", newPath);
    }
  }

  snprintf(newPath, elcount(newPath), "%s.%s", oldPath, "parkingSlots");
  if(value.parkingSlots.isValidFlag==1)
  {
    SetPAMParkingSlotsParams(packetHandle, value.parkingSlots, newPath);
    result = CheckLastError("PAM", gkFuncRefGet, result);
  }
  else
  {
    if( C2xIsTokenAvailable(packetHandle, "PAM", newPath) )
    {
      C2xRemoveToken(packetHandle, "PAM", newPath);
    }
  }

  return result;
}

int GetPAMPAMDriveListParams(LONG packetHandle, struct PAMPAMDriveList value, char oldPath[])
{
  char newPath[300]; 
  int i;
  int result;

  result = 0;

  value.length = C2xGetTokenInt(packetHandle, "PAM", oldPath);
  if((result = CheckLastError("PAM", gkFuncRefGet, result))==0)
  {
    for(i=0; i<value.length; i++)
    {
      snprintf(newPath, elcount(newPath), "%s[%d]", oldPath, i);
      GetPAMPAMDriveParams(packetHandle, value.arrayValue[i], newPath);
      result = CheckLastError("PAM", gkFuncRefGet, result);
    }
  }
  return result;
}

int SetPAMPAMDriveListParams(LONG packetHandle, struct PAMPAMDriveList value, char oldPath[])
{
  char newPath[300]; 
  int i;
  int result;

  result = 0;

  C2xRemoveToken(packetHandle, "PAM", oldPath);
  for(i=0; i<value.length; i++)
  {
    snprintf(newPath, elcount(newPath), "%s[%d]", oldPath, i);
    SetPAMPAMDriveParams(packetHandle, value.arrayValue[i], newPath);
    result = CheckLastError("PAM", gkFuncRefGet, result);
  }
  return result;
}

int GetPAMPAMNodeParams(LONG packetHandle, struct PAMPAMNode value, char oldPath[])
{
  char newPath[300]; 
  int j; 
  int k;
  int result;

  result = 0;

  snprintf(newPath, elcount(newPath), "%s.%s", oldPath, "id");
  value.id = C2xGetTokenInt(packetHandle, "PAM", newPath);
  result = CheckLastError("PAM", gkFuncRefGet, result);

  snprintf(newPath, elcount(newPath), "%s.%s", oldPath, "refPos");
  GetPAMPosition3DParams(packetHandle, value.refPos, newPath);
  result = CheckLastError("PAM", gkFuncRefGet, result);

  snprintf(newPath, elcount(newPath), "%s.%s", oldPath, "floor");
  value.floor.isValidFlag = C2xIsTokenAvailable(packetHandle, "PAM", newPath);
  if(value.floor.isValidFlag==1)
  {
    value.floor.value = C2xGetTokenInt(packetHandle, "PAM", newPath);
    result = CheckLastError("PAM", gkFuncRefGet, result);
  }
  snprintf(newPath, elcount(newPath), "%s.%s", oldPath, "attributes");
  value.attributes.isValidFlag = C2xIsTokenAvailable(packetHandle, "PAM", newPath);
  if(value.attributes.isValidFlag==1)
  {
    value.attributes.isValidFlag = 1;
    value.attributes.stringLength = C2xGetTokenLengthBit(packetHandle, "PAM", newPath);
    if ((result = CheckLastError("PAM", gkFuncRefGet, result))==0)
    {
      if(value.attributes.stringLength > 0)
      {
        for(j=0; j<value.attributes.stringLength; j++)
        {
          if(C2xGetTokenBitOfBitString(packetHandle, "PAM", newPath, j) == 0)
          {
            value.attributes.string[j] = '0';
          }
          else if(C2xGetTokenBitOfBitString(packetHandle, "PAM", newPath, j) == 1)
          {
            value.attributes.string[j] = '1';
          }

          if(value.attributes.stringLength == 1)
          {
            value.attributes.string[1] = '0';
          }
          result = CheckLastError("PAM", gkFuncRefGet, result);
        }
      }
      else
      {
        for(k = value.attributes.stringLength+1; k > -1; k--)
        {
          if(value.attributes.string[k] == '1')
          {
            value.attributes.string[k] = '0';
          }
        }
      }
    }

  }
  snprintf(newPath, elcount(newPath), "%s.%s", oldPath, "inDrives");
  value.inDrives.isValidFlag = C2xIsTokenAvailable(packetHandle, "PAM", newPath);
  if(value.inDrives.isValidFlag==1)
  {
    GetPAMPAMDriveListParams(packetHandle, value.inDrives, newPath);
    result = CheckLastError("PAM", gkFuncRefGet, result);
  }
  return result;
}

int SetPAMPAMNodeParams(LONG packetHandle, struct PAMPAMNode value, char oldPath[])
{
  char newPath[300]; 
  int j;
  int result;

  result = 0;

  snprintf(newPath, elcount(newPath), "%s.%s", oldPath, "id");
  C2xSetTokenInt(packetHandle, "PAM", newPath, value.id);
  result = CheckLastError("PAM", gkFuncRefGet, result);

  snprintf(newPath, elcount(newPath), "%s.%s", oldPath, "refPos");
  SetPAMPosition3DParams(packetHandle, value.refPos, newPath);
  result = CheckLastError("PAM", gkFuncRefGet, result);

  snprintf(newPath, elcount(newPath), "%s.%s", oldPath, "floor");
  if(value.floor.isValidFlag==1)
  {
    C2xSetTokenInt(packetHandle, "PAM", newPath, value.floor.value);
    result = CheckLastError("PAM", gkFuncRefGet, result);
  }
  else
  {
    if( C2xIsTokenAvailable(packetHandle, "PAM", newPath) )
    {
      C2xRemoveToken(packetHandle, "PAM", newPath);
    }
  }

  snprintf(newPath, elcount(newPath), "%s.%s", oldPath, "attributes");
  if(value.attributes.isValidFlag==1)
  {
      for(j=0; j<value.attributes.stringLength; j++)
      {
        if(value.attributes.string[j] == '0')
        {
          C2xSetTokenBitOfBitString(packetHandle, "PAM", newPath, j, 0);
        }
        else
        {
          C2xSetTokenBitOfBitString(packetHandle, "PAM", newPath, j, 1);
        }
        result = CheckLastError("PAM", gkFuncRefGet, result);
      }
  }
  else
  {
    if( C2xIsTokenAvailable(packetHandle, "PAM", newPath) )
    {
      C2xRemoveToken(packetHandle, "PAM", newPath);
    }
  }

  snprintf(newPath, elcount(newPath), "%s.%s", oldPath, "inDrives");
  if(value.inDrives.isValidFlag==1)
  {
    SetPAMPAMDriveListParams(packetHandle, value.inDrives, newPath);
    result = CheckLastError("PAM", gkFuncRefGet, result);
  }
  else
  {
    if( C2xIsTokenAvailable(packetHandle, "PAM", newPath) )
    {
      C2xRemoveToken(packetHandle, "PAM", newPath);
    }
  }

  return result;
}

int GetPAMPAMNodeListParams(LONG packetHandle, struct PAMPAMNodeList value, char oldPath[])
{
  char newPath[300]; 
  int i;
  int result;

  result = 0;

  value.length = C2xGetTokenInt(packetHandle, "PAM", oldPath);
  if((result = CheckLastError("PAM", gkFuncRefGet, result))==0)
  {
    for(i=0; i<value.length; i++)
    {
      snprintf(newPath, elcount(newPath), "%s[%d]", oldPath, i);
      GetPAMPAMNodeParams(packetHandle, value.arrayValue[i], newPath);
      result = CheckLastError("PAM", gkFuncRefGet, result);
    }
  }
  return result;
}

int SetPAMPAMNodeListParams(LONG packetHandle, struct PAMPAMNodeList value, char oldPath[])
{
  char newPath[300]; 
  int i;
  int result;

  result = 0;

  C2xRemoveToken(packetHandle, "PAM", oldPath);
  for(i=0; i<value.length; i++)
  {
    snprintf(newPath, elcount(newPath), "%s[%d]", oldPath, i);
    SetPAMPAMNodeParams(packetHandle, value.arrayValue[i], newPath);
    result = CheckLastError("PAM", gkFuncRefGet, result);
  }
  return result;
}

int GetPAMParkingGuide_drivePathParams(LONG packetHandle, struct PAMParkingGuide_drivePath value, char oldPath[])
{
  char newPath[300]; 
  int i;
  int result;

  result = 0;

  value.length = C2xGetTokenInt(packetHandle, "PAM", oldPath);
  if((result = CheckLastError("PAM", gkFuncRefGet, result))==0)
  {
    for(i=0; i<value.length; i++)
    {
      snprintf(newPath, elcount(newPath), "%s[%d]", oldPath, i);
      value.arrayValue[i] = C2xGetTokenInt64(packetHandle, "PAM", newPath);
      result = CheckLastError("PAM", gkFuncRefGet, result);
    }
  }
  return result;
}

int SetPAMParkingGuide_drivePathParams(LONG packetHandle, struct PAMParkingGuide_drivePath value, char oldPath[])
{
  char newPath[300]; 
  int i;
  int result;

  result = 0;

  C2xRemoveToken(packetHandle, "PAM", oldPath);
  for(i=0; i<value.length; i++)
  {
    snprintf(newPath, elcount(newPath), "%s[%d]", oldPath, i);
    C2xSetTokenInt64(packetHandle, "PAM", newPath, value.arrayValue[i]);
    result = CheckLastError("PAM", gkFuncRefGet, result);
  }
  return result;
}

int GetPAMParkingGuideParams(LONG packetHandle, struct PAMParkingGuide value, char oldPath[])
{
  char newPath[300];
  char buffer[300];
  int result;

  result = 0;

  snprintf(newPath, elcount(newPath), "%s.%s", oldPath, "vehId");
  value.vehId.stringLength = C2xGetTokenData(packetHandle, "PAM", newPath, elcount(value.vehId.string), value.vehId.string);
  snprintf(newPath, elcount(newPath), "%s.%s", oldPath, "drivePath");
  GetPAMParkingGuide_drivePathParams(packetHandle, value.drivePath, newPath);
  result = CheckLastError("PAM", gkFuncRefGet, result);

  snprintf(newPath, elcount(newPath), "%s.%s", oldPath, "targetParkingSlot");
  value.targetParkingSlot.isValidFlag = C2xIsTokenAvailable(packetHandle, "PAM", newPath);
  if(value.targetParkingSlot.isValidFlag==1)
  {
    value.targetParkingSlot.value = C2xGetTokenInt(packetHandle, "PAM", newPath);
    result = CheckLastError("PAM", gkFuncRefGet, result);
  }
  return result;
}

int SetPAMParkingGuideParams(LONG packetHandle, struct PAMParkingGuide value, char oldPath[])
{
  char newPath[300];
  char buffer[300];
  int result;

  result = 0;

  snprintf(newPath, elcount(newPath), "%s.%s", oldPath, "vehId");
  C2xSetTokenData(packetHandle, "PAM", newPath, value.vehId.stringLength, value.vehId.string);

  snprintf(newPath, elcount(newPath), "%s.%s", oldPath, "drivePath");
  SetPAMParkingGuide_drivePathParams(packetHandle, value.drivePath, newPath);
  result = CheckLastError("PAM", gkFuncRefGet, result);

  snprintf(newPath, elcount(newPath), "%s.%s", oldPath, "targetParkingSlot");
  if(value.targetParkingSlot.isValidFlag==1)
  {
    C2xSetTokenInt(packetHandle, "PAM", newPath, value.targetParkingSlot.value);
    result = CheckLastError("PAM", gkFuncRefGet, result);
  }
  else
  {
    if( C2xIsTokenAvailable(packetHandle, "PAM", newPath) )
    {
      C2xRemoveToken(packetHandle, "PAM", newPath);
    }
  }

  return result;
}

int GetPAMPAMData_parkingAreaGuidanceParams(LONG packetHandle, struct PAMPAMData_parkingAreaGuidance value, char oldPath[])
{
  char newPath[300]; 
  int i;
  int result;

  result = 0;

  value.length = C2xGetTokenInt(packetHandle, "PAM", oldPath);
  if((result = CheckLastError("PAM", gkFuncRefGet, result))==0)
  {
    for(i=0; i<value.length; i++)
    {
      snprintf(newPath, elcount(newPath), "%s[%d]", oldPath, i);
      GetPAMParkingGuideParams(packetHandle, value.arrayValue[i], newPath);
      result = CheckLastError("PAM", gkFuncRefGet, result);
    }
  }
  return result;
}

int SetPAMPAMData_parkingAreaGuidanceParams(LONG packetHandle, struct PAMPAMData_parkingAreaGuidance value, char oldPath[])
{
  char newPath[300]; 
  int i;
  int result;

  result = 0;

  C2xRemoveToken(packetHandle, "PAM", oldPath);
  for(i=0; i<value.length; i++)
  {
    snprintf(newPath, elcount(newPath), "%s[%d]", oldPath, i);
    SetPAMParkingGuideParams(packetHandle, value.arrayValue[i], newPath);
    result = CheckLastError("PAM", gkFuncRefGet, result);
  }
  return result;
}

int GetPAMPAM_PAMDataParams(LONG packetHandle, struct PAMPAM_PAMData value, char oldPath[])
{
  char newPath[300];
  int result;

  result = 0;

  snprintf(newPath, elcount(newPath), "%s.%s", oldPath, "msgCnt");
  value.msgCnt = C2xGetTokenInt(packetHandle, "PAM", newPath);
  result = CheckLastError("PAM", gkFuncRefGet, result);

  snprintf(newPath, elcount(newPath), "%s.%s", oldPath, "timeStamp");
  value.timeStamp.isValidFlag = C2xIsTokenAvailable(packetHandle, "PAM", newPath);
  if(value.timeStamp.isValidFlag==1)
  {
    value.timeStamp.value = C2xGetTokenInt(packetHandle, "PAM", newPath);
    result = CheckLastError("PAM", gkFuncRefGet, result);
  }
  snprintf(newPath, elcount(newPath), "%s.%s", oldPath, "parkingLotInfo");
  GetPAMParkingLotInfoParams(packetHandle, value.parkingLotInfo, newPath);
  result = CheckLastError("PAM", gkFuncRefGet, result);

  snprintf(newPath, elcount(newPath), "%s.%s", oldPath, "pamNodes");
  GetPAMPAMNodeListParams(packetHandle, value.pamNodes, newPath);
  result = CheckLastError("PAM", gkFuncRefGet, result);

  snprintf(newPath, elcount(newPath), "%s.%s", oldPath, "parkingAreaGuidance");
  value.parkingAreaGuidance.isValidFlag = C2xIsTokenAvailable(packetHandle, "PAM", newPath);
  if(value.parkingAreaGuidance.isValidFlag==1)
  {
    GetPAMPAMData_parkingAreaGuidanceParams(packetHandle, value.parkingAreaGuidance, newPath);
    result = CheckLastError("PAM", gkFuncRefGet, result);
  }
  return result;
}

int SetPAMPAM_PAMDataParams(LONG packetHandle, struct PAMPAM_PAMData value, char oldPath[])
{
  char newPath[300];
  int result;

  result = 0;

  snprintf(newPath, elcount(newPath), "%s.%s", oldPath, "msgCnt");
  C2xSetTokenInt(packetHandle, "PAM", newPath, value.msgCnt);
  result = CheckLastError("PAM", gkFuncRefGet, result);

  snprintf(newPath, elcount(newPath), "%s.%s", oldPath, "timeStamp");
  if(value.timeStamp.isValidFlag==1)
  {
    C2xSetTokenInt(packetHandle, "PAM", newPath, value.timeStamp.value);
    result = CheckLastError("PAM", gkFuncRefGet, result);
  }
  else
  {
    if( C2xIsTokenAvailable(packetHandle, "PAM", newPath) )
    {
      C2xRemoveToken(packetHandle, "PAM", newPath);
    }
  }

  snprintf(newPath, elcount(newPath), "%s.%s", oldPath, "parkingLotInfo");
  SetPAMParkingLotInfoParams(packetHandle, value.parkingLotInfo, newPath);
  result = CheckLastError("PAM", gkFuncRefGet, result);

  snprintf(newPath, elcount(newPath), "%s.%s", oldPath, "pamNodes");
  SetPAMPAMNodeListParams(packetHandle, value.pamNodes, newPath);
  result = CheckLastError("PAM", gkFuncRefGet, result);

  snprintf(newPath, elcount(newPath), "%s.%s", oldPath, "parkingAreaGuidance");
  if(value.parkingAreaGuidance.isValidFlag==1)
  {
    SetPAMPAMData_parkingAreaGuidanceParams(packetHandle, value.parkingAreaGuidance, newPath);
    result = CheckLastError("PAM", gkFuncRefGet, result);
  }
  else
  {
    if( C2xIsTokenAvailable(packetHandle, "PAM", newPath) )
    {
      C2xRemoveToken(packetHandle, "PAM", newPath);
    }
  }

  return result;
}

int GetPAMMessageTypesParams(LONG packetHandle, WORD tableKey, struct PAMMessageTypes value, char oldPath[])
{
  char newPath[300];
  int result;

  result = 0;

  switch(tableKey)
  {
    case 14:
    {
      snprintf(newPath, elcount(newPath), "%s.%s", oldPath, "pamData");
      GetPAMPAM_PAMDataParams(packetHandle, value.pamData, newPath);
      result = CheckLastError("PAM", gkFuncRefGet, result);
    }
    break;
  }
  return result;
}

int SetPAMMessageTypesParams(LONG packetHandle, WORD tableKey, struct PAMMessageTypes value, char oldPath[])
{
  char newPath[300];
  int result;

  result = 0;

  switch(tableKey)
  {
    case 14:
    {
      snprintf(newPath, elcount(newPath), "%s.%s", oldPath, "pamData");
      SetPAMPAM_PAMDataParams(packetHandle, value.pamData, newPath);
      result = CheckLastError("PAM", gkFuncRefGet, result);
    }
    break;
  }
  return result;
}

int GetPAMMessageFrameExtParams(LONG packetHandle, struct PAMMessageFrameExt value, char oldPath[])
{
  char newPath[300];
  int result;

  result = 0;

  snprintf(newPath, elcount(newPath), "%s.%s", oldPath, "messageId");
  value.messageId = C2xGetTokenInt(packetHandle, "PAM", newPath);
  result = CheckLastError("PAM", gkFuncRefGet, result);

  snprintf(newPath, elcount(newPath), "%s.%s", oldPath, "value");
  GetPAMMessageTypesParams(packetHandle, value.messageId, value.value, newPath);
  result = CheckLastError("PAM", gkFuncRefGet, result);

  return result;
}

int SetPAMMessageFrameExtParams(LONG packetHandle, struct PAMMessageFrameExt value, char oldPath[])
{
  char newPath[300];
  int result;

  result = 0;


  snprintf(newPath, elcount(newPath), "%s.%s", oldPath, "value");
  SetPAMMessageTypesParams(packetHandle, value.messageId, value.value, newPath);
  result = CheckLastError("PAM", gkFuncRefGet, result);

  return result;
}

int API_GetPAMParams(LONG packetHandle, struct PAM value)
{
  int result;
  result = 0;

  value.msgFrameExt.isValidFlag = 1;
  GetPAMMessageFrameExtParams(packetHandle, value.msgFrameExt, "msgFrameExt");
  result = CheckLastError("PAM", gkFuncRefGet, result);

  return result;
}

int API_SetPAMParams(LONG packetHandle, struct PAM value)
{
  int result;
  result = 0;

  SetPAMMessageFrameExtParams(packetHandle, value.msgFrameExt, "msgFrameExt");
  result = CheckLastError("PAM", gkFuncRefGet, result);

  return result;
}

