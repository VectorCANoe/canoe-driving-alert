/*@!Encoding:1252*/
/*
//  (c) Vector Informatik GmbH. All rights reserved.
//
//  This file contains definitions of structs and methods that may be used
//  to set and get the values of an ASN.1 defined packet's payload.
//
//  //This example demonstrates how to set a packet's payload:
//  LONG packetHandle;
//  struct RoadSideInformation payload;
//  //you need to set the values of the variable "payload" yourself
//  packetHandle = API_InitRoadSideInformationPacket();
//  if (packetHandle!=0) {
//    if (API_SetRoadSideInformationParams(packetHandle, payload)==0) {
//      if (C2xCompletePacket(packetHandle)==0) {
//        C2xOutputPacket(packetHandle);
//      }
//    }
//  }
//                                                                             */
includes
{
}
variables
{
    struct RoadSideInformationRoadSideInformation_id {
        INT isValidFlag;   // necessary if this struct is used as an optional field of a SEQUENCE
        CHAR string[9];
        INT  stringLength;
    };
    
    struct RoadSideInformationPosition3D {
        INT isValidFlag;   // necessary if this struct is used as an optional field of a SEQUENCE
        LONG lat;  // INTEGER, -900000000..900000001;
        LONG lon;  // INTEGER, -1799999999..1800000001;
        struct OPT_LONG_ASN elevation;  // INTEGER, OPTIONAL, -4096..61439;
    };
    
    struct RoadSideInformationPosition_LL_24B {
        INT isValidFlag;   // necessary if this struct is used as an optional field of a SEQUENCE
        INT lon;  // INTEGER, -2048..2047;
        INT lat;  // INTEGER, -2048..2047;
    };
    
    struct RoadSideInformationPosition_LL_28B {
        INT isValidFlag;   // necessary if this struct is used as an optional field of a SEQUENCE
        INT lon;  // INTEGER, -8192..8191;
        INT lat;  // INTEGER, -8192..8191;
    };
    
    struct RoadSideInformationPosition_LL_32B {
        INT isValidFlag;   // necessary if this struct is used as an optional field of a SEQUENCE
        INT lon;  // INTEGER, -32768..32767;
        INT lat;  // INTEGER, -32768..32767;
    };
    
    struct RoadSideInformationPosition_LL_36B {
        INT isValidFlag;   // necessary if this struct is used as an optional field of a SEQUENCE
        LONG lon;  // INTEGER, -131072..131071;
        LONG lat;  // INTEGER, -131072..131071;
    };
    
    struct RoadSideInformationPosition_LL_44B {
        INT isValidFlag;   // necessary if this struct is used as an optional field of a SEQUENCE
        LONG lon;  // INTEGER, -2097152..2097151;
        LONG lat;  // INTEGER, -2097152..2097151;
    };
    
    struct RoadSideInformationPosition_LL_48B {
        INT isValidFlag;   // necessary if this struct is used as an optional field of a SEQUENCE
        LONG lon;  // INTEGER, -8388608..8388607;
        LONG lat;  // INTEGER, -8388608..8388607;
    };
    
    struct RoadSideInformationPosition_LLmD_64b {
        INT isValidFlag;   // necessary if this struct is used as an optional field of a SEQUENCE
        LONG lon;  // INTEGER, -1799999999..1800000001;
        LONG lat;  // INTEGER, -900000000..900000001;
    };
    
    struct RoadSideInformationPositionOffsetLL {
        INT isValidFlag;   // necessary if this struct is used as an optional field of a SEQUENCE
        INT choice;
        struct RoadSideInformationPosition_LL_24B position_LL1;  // SEQUENCE;
        struct RoadSideInformationPosition_LL_28B position_LL2;  // SEQUENCE;
        struct RoadSideInformationPosition_LL_32B position_LL3;  // SEQUENCE;
        struct RoadSideInformationPosition_LL_36B position_LL4;  // SEQUENCE;
        struct RoadSideInformationPosition_LL_44B position_LL5;  // SEQUENCE;
        struct RoadSideInformationPosition_LL_48B position_LL6;  // SEQUENCE;
        struct RoadSideInformationPosition_LLmD_64b position_LatLon;  // SEQUENCE;
    };
    
    struct RoadSideInformationVerticalOffset {
        INT isValidFlag;   // necessary if this struct is used as an optional field of a SEQUENCE
        INT choice;
        INT offset1;  // INTEGER, -64..63;
        INT offset2;  // INTEGER, -128..127;
        INT offset3;  // INTEGER, -256..255;
        INT offset4;  // INTEGER, -512..511;
        INT offset5;  // INTEGER, -1024..1023;
        INT offset6;  // INTEGER, -2048..2047;
        LONG elevation;  // INTEGER, -4096..61439;
    };
    
    struct RoadSideInformationPositionOffsetLLV {
        INT isValidFlag;   // necessary if this struct is used as an optional field of a SEQUENCE
        struct RoadSideInformationPositionOffsetLL offsetLL;  // CHOICE;
        struct RoadSideInformationVerticalOffset offsetV;  // CHOICE, OPTIONAL;
    };
    
    struct RoadSideInformationDescription_textString {
        INT isValidFlag;   // necessary if this struct is used as an optional field of a SEQUENCE
        CHAR string[513];
        INT  stringLength;
    };
    
    struct RoadSideInformationDescription_textGB2312 {
        INT isValidFlag;   // necessary if this struct is used as an optional field of a SEQUENCE
        CHAR string[513];
        INT  stringLength;
    };
    
    struct RoadSideInformationDescription {
        INT isValidFlag;   // necessary if this struct is used as an optional field of a SEQUENCE
        INT choice;
        struct RoadSideInformationDescription_textString textString;  // IA5STRING;
        struct RoadSideInformationDescription_textGB2312 textGB2312;  // OCTETSTRING;
    };
    
    struct RoadSideInformationRSITimeDetails {
        INT isValidFlag;   // necessary if this struct is used as an optional field of a SEQUENCE
        struct OPT_DWORD_ASN startTime;  // INTEGER, OPTIONAL, 0..527040;
        struct OPT_DWORD_ASN endTime;  // INTEGER, OPTIONAL, 0..527040;
        struct OPT_ENUM_ASN endTimeConfidence;  // ENUMERATED, OPTIONAL, unavailable(0), time_100_000(1), time_050_000(2), time_020_000(3), time_010_000(4), time_002_000(5), time_001_000(6), time_000_500(7), time_000_200(8), time_000_100(9), time_000_050(10), time_000_020(11), time_000_010(12), time_000_005(13), time_000_002(14), time_000_001(15), time_000_000_5(16), time_000_000_2(17), time_000_000_1(18), time_000_000_05(19), time_000_000_02(20), time_000_000_01(21), time_000_000_005(22), time_000_000_002(23), time_000_000_001(24), time_000_000_000_5(25), time_000_000_000_2(26), time_000_000_000_1(27), time_000_000_000_05(28), time_000_000_000_02(29), time_000_000_000_01(30), time_000_000_000_005(31), time_000_000_000_002(32), time_000_000_000_001(33), time_000_000_000_000_5(34), time_000_000_000_000_2(35), time_000_000_000_000_1(36), time_000_000_000_000_05(37), time_000_000_000_000_02(38), time_000_000_000_000_01(39);
    };
    
    struct RoadSideInformationRSIPriority {
        INT isValidFlag;   // necessary if this struct is used as an optional field of a SEQUENCE
        CHAR string[2];
        INT  stringLength;
    };
    
    struct RoadSideInformationPathPointList {
        INT isValidFlag;   // necessary if this struct is used as an optional field of a SEQUENCE
        INT length;
        struct RoadSideInformationPositionOffsetLLV arrayValue[32];  // SEQUENCE;
    };
    
    struct RoadSideInformationReferencePath {
        INT isValidFlag;   // necessary if this struct is used as an optional field of a SEQUENCE
        struct RoadSideInformationPathPointList activePath;  // SEQUENCEOF;
        WORD pathRadius;  // INTEGER, 0..65535;
    };
    
    struct RoadSideInformationReferencePathList {
        INT isValidFlag;   // necessary if this struct is used as an optional field of a SEQUENCE
        INT length;
        struct RoadSideInformationReferencePath arrayValue[8];  // SEQUENCE;
    };
    
    struct RoadSideInformationNodeReferenceID {
        INT isValidFlag;   // necessary if this struct is used as an optional field of a SEQUENCE
        struct OPT_WORD_ASN region;  // INTEGER, OPTIONAL, 0..65535;
        WORD id;  // INTEGER, 0..65535;
    };
    
    struct RoadSideInformationReferenceLanes {
        INT isValidFlag;   // necessary if this struct is used as an optional field of a SEQUENCE
        CHAR string[17];
        INT  stringLength;
    };
    
    struct RoadSideInformationReferenceLink {
        INT isValidFlag;   // necessary if this struct is used as an optional field of a SEQUENCE
        struct RoadSideInformationNodeReferenceID upstreamNodeId;  // SEQUENCE;
        struct RoadSideInformationNodeReferenceID downstreamNodeId;  // SEQUENCE;
        struct RoadSideInformationReferenceLanes referenceLanes;  // BITSTRING, OPTIONAL;
    };
    
    struct RoadSideInformationReferenceLinkList {
        INT isValidFlag;   // necessary if this struct is used as an optional field of a SEQUENCE
        INT length;
        struct RoadSideInformationReferenceLink arrayValue[16];  // SEQUENCE;
    };
    
    struct RoadSideInformationRTEData {
        INT isValidFlag;   // necessary if this struct is used as an optional field of a SEQUENCE
        BYTE rteId;  // INTEGER, 0..255;
        WORD eventType;  // INTEGER, 0..65535;
        INT eventSource;  // ENUMERATED, unknown(0), police(1), government(2), meteorological(3), internet(4), detection(5);
        struct RoadSideInformationPositionOffsetLLV eventPos;  // SEQUENCE, OPTIONAL;
        struct OPT_WORD_ASN eventRadius;  // INTEGER, OPTIONAL, 0..65535;
        struct RoadSideInformationDescription description;  // CHOICE, OPTIONAL;
        struct RoadSideInformationRSITimeDetails timeDetails;  // SEQUENCE, OPTIONAL;
        struct RoadSideInformationRSIPriority priority;  // OCTETSTRING, OPTIONAL;
        struct RoadSideInformationReferencePathList referencePaths;  // SEQUENCEOF, OPTIONAL;
        struct RoadSideInformationReferenceLinkList referenceLinks;  // SEQUENCEOF, OPTIONAL;
        struct OPT_BYTE_ASN eventConfidence;  // INTEGER, OPTIONAL, 0..200;
    };
    
    struct RoadSideInformationRTEList {
        INT isValidFlag;   // necessary if this struct is used as an optional field of a SEQUENCE
        INT length;
        struct RoadSideInformationRTEData arrayValue[8];  // SEQUENCE;
    };
    
    struct RoadSideInformationAuxiliarySignVehicleType {
        INT isValidFlag;   // necessary if this struct is used as an optional field of a SEQUENCE
        CHAR string[6];
        INT  stringLength;
    };
    
    struct RoadSideInformationAuxiliarySign {
        INT isValidFlag;   // necessary if this struct is used as an optional field of a SEQUENCE
        struct RoadSideInformationAuxiliarySignVehicleType signWithVehicleType;  // BITSTRING, OPTIONAL;
        struct OPT_ENUM_ASN signDirection;  // ENUMERATED, OPTIONAL, straight(0), leftAndRight(1), right(2), left(3), leftFrontTurn(4), rightFronTurn(5), rightRearTurn(6), leftRearTurn(7);
    };
    
    struct RoadSideInformationRTSData {
        INT isValidFlag;   // necessary if this struct is used as an optional field of a SEQUENCE
        BYTE rtsId;  // INTEGER, 0..255;
        WORD signType;  // INTEGER, 0..65535;
        struct RoadSideInformationPositionOffsetLLV signPos;  // SEQUENCE, OPTIONAL;
        struct RoadSideInformationDescription description;  // CHOICE, OPTIONAL;
        struct RoadSideInformationRSITimeDetails timeDetails;  // SEQUENCE, OPTIONAL;
        struct RoadSideInformationRSIPriority priority;  // OCTETSTRING, OPTIONAL;
        struct RoadSideInformationReferencePathList referencePaths;  // SEQUENCEOF, OPTIONAL;
        struct RoadSideInformationReferenceLinkList referenceLinks;  // SEQUENCEOF, OPTIONAL;
        struct RoadSideInformationAuxiliarySign auxiliarySign;  // SEQUENCE, OPTIONAL;
    };
    
    struct RoadSideInformationRTSList {
        INT isValidFlag;   // necessary if this struct is used as an optional field of a SEQUENCE
        INT length;
        struct RoadSideInformationRTSData arrayValue[16];  // SEQUENCE;
    };
    
    struct RoadSideInformationRSIFrame {
        INT isValidFlag;   // necessary if this struct is used as an optional field of a SEQUENCE
        BYTE msgCnt;  // INTEGER, 0..127;
        struct OPT_DWORD_ASN moy;  // INTEGER, OPTIONAL, 0..527040;
        struct RoadSideInformationRoadSideInformation_id id;  // OCTETSTRING;
        struct RoadSideInformationPosition3D refPos;  // SEQUENCE;
        struct RoadSideInformationRTEList rtes;  // SEQUENCEOF, OPTIONAL;
        struct RoadSideInformationRTSList rtss;  // SEQUENCEOF, OPTIONAL;
    };
    
    struct RoadSideInformation {
        INT isValidFlag;   // necessary if this struct is used as an optional field of a SEQUENCE
        BYTE frameType;  // INTEGER, 0..15, rsiFrame(4);
        struct RoadSideInformationRSIFrame rsiFrame;  // SEQUENCE;
    };
    
}

/*
// init function to create a simple packet handle
*/ 
LONG API_InitRoadSideInformationPacket()
{
  return C2xInitPacket("RoadSideInformation"); 
}

/*
// init function to create a simple packet handle and
// initialize the struct with valid data
*/ 
LONG API_InitRoadSideInformationPacket(struct RoadSideInformation msgStruct)
{
  long pktHandle;

  pktHandle = API_InitRoadSideInformationPacket();

  if (pktHandle != 0)
  {
    // create valid message and application data
    if (C2xCompletePacket(pktHandle) == 0) 
    {
      API_GetRoadSideInformationParams(pktHandle, msgStruct);
    }
  }
  return pktHandle;
}

/*
// init function to create a packet with security layer and
// initialize the struct with valid data
*/ 
LONG API_InitRoadSideInformationPacket(struct RoadSideInformation msgStruct, char packetTypeDesignator[], char certificateName[])
{
  long pktHandle, certHdl;

  // initialize the packet
  pktHandle = C2xInitPacket("RoadSideInformation", packetTypeDesignator);

  if (pktHandle != 0)
  {
    certHdl = C2xSecCertificateGetHandle(certificateName);  // get the certificate handle for the cert with name "certificateName"
    if (certHdl != 0) 
    {
      C2xSecPacketSetSignerHandle(pktHandle, certHdl); // set the certHdl to the packet
    }

    // create valid message and application data
    if (C2xCompletePacket(pktHandle) == 0) 
    {
      // copy application data to the application structure
      API_GetRoadSideInformationParams(pktHandle, msgStruct);
    }
  }
  return pktHandle;
}
    

int GetRoadSideInformationPosition3DParams(LONG packetHandle, struct RoadSideInformationPosition3D value, char oldPath[])
{
  char newPath[300];
  int result;

  result = 0;

  snprintf(newPath, elcount(newPath), "%s.%s", oldPath, "lat");
  value.lat = C2xGetTokenInt(packetHandle, "RoadSideInformation", newPath);
  result = CheckLastError("RoadSideInformation", gkFuncRefGet, result);

  snprintf(newPath, elcount(newPath), "%s.%s", oldPath, "lon");
  value.lon = C2xGetTokenInt(packetHandle, "RoadSideInformation", newPath);
  result = CheckLastError("RoadSideInformation", gkFuncRefGet, result);

  snprintf(newPath, elcount(newPath), "%s.%s", oldPath, "elevation");
  value.elevation.isValidFlag = C2xIsTokenAvailable(packetHandle, "RoadSideInformation", newPath);
  if(value.elevation.isValidFlag==1)
  {
    value.elevation.value = C2xGetTokenInt(packetHandle, "RoadSideInformation", newPath);
    result = CheckLastError("RoadSideInformation", gkFuncRefGet, result);
  }
  return result;
}

int SetRoadSideInformationPosition3DParams(LONG packetHandle, struct RoadSideInformationPosition3D value, char oldPath[])
{
  char newPath[300];
  int result;

  result = 0;

  snprintf(newPath, elcount(newPath), "%s.%s", oldPath, "lat");
  C2xSetTokenInt(packetHandle, "RoadSideInformation", newPath, value.lat);
  result = CheckLastError("RoadSideInformation", gkFuncRefGet, result);

  snprintf(newPath, elcount(newPath), "%s.%s", oldPath, "lon");
  C2xSetTokenInt(packetHandle, "RoadSideInformation", newPath, value.lon);
  result = CheckLastError("RoadSideInformation", gkFuncRefGet, result);

  snprintf(newPath, elcount(newPath), "%s.%s", oldPath, "elevation");
  if(value.elevation.isValidFlag==1)
  {
    C2xSetTokenInt(packetHandle, "RoadSideInformation", newPath, value.elevation.value);
    result = CheckLastError("RoadSideInformation", gkFuncRefGet, result);
  }
  else
  {
    if( C2xIsTokenAvailable(packetHandle, "RoadSideInformation", newPath) )
    {
      C2xRemoveToken(packetHandle, "RoadSideInformation", newPath);
    }
  }

  return result;
}

int GetRoadSideInformationPosition_LL_24BParams(LONG packetHandle, struct RoadSideInformationPosition_LL_24B value, char oldPath[])
{
  char newPath[300];
  int result;

  result = 0;

  snprintf(newPath, elcount(newPath), "%s.%s", oldPath, "lon");
  value.lon = C2xGetTokenInt(packetHandle, "RoadSideInformation", newPath);
  result = CheckLastError("RoadSideInformation", gkFuncRefGet, result);

  snprintf(newPath, elcount(newPath), "%s.%s", oldPath, "lat");
  value.lat = C2xGetTokenInt(packetHandle, "RoadSideInformation", newPath);
  result = CheckLastError("RoadSideInformation", gkFuncRefGet, result);

  return result;
}

int SetRoadSideInformationPosition_LL_24BParams(LONG packetHandle, struct RoadSideInformationPosition_LL_24B value, char oldPath[])
{
  char newPath[300];
  int result;

  result = 0;

  snprintf(newPath, elcount(newPath), "%s.%s", oldPath, "lon");
  C2xSetTokenInt(packetHandle, "RoadSideInformation", newPath, value.lon);
  result = CheckLastError("RoadSideInformation", gkFuncRefGet, result);

  snprintf(newPath, elcount(newPath), "%s.%s", oldPath, "lat");
  C2xSetTokenInt(packetHandle, "RoadSideInformation", newPath, value.lat);
  result = CheckLastError("RoadSideInformation", gkFuncRefGet, result);

  return result;
}

int GetRoadSideInformationPosition_LL_28BParams(LONG packetHandle, struct RoadSideInformationPosition_LL_28B value, char oldPath[])
{
  char newPath[300];
  int result;

  result = 0;

  snprintf(newPath, elcount(newPath), "%s.%s", oldPath, "lon");
  value.lon = C2xGetTokenInt(packetHandle, "RoadSideInformation", newPath);
  result = CheckLastError("RoadSideInformation", gkFuncRefGet, result);

  snprintf(newPath, elcount(newPath), "%s.%s", oldPath, "lat");
  value.lat = C2xGetTokenInt(packetHandle, "RoadSideInformation", newPath);
  result = CheckLastError("RoadSideInformation", gkFuncRefGet, result);

  return result;
}

int SetRoadSideInformationPosition_LL_28BParams(LONG packetHandle, struct RoadSideInformationPosition_LL_28B value, char oldPath[])
{
  char newPath[300];
  int result;

  result = 0;

  snprintf(newPath, elcount(newPath), "%s.%s", oldPath, "lon");
  C2xSetTokenInt(packetHandle, "RoadSideInformation", newPath, value.lon);
  result = CheckLastError("RoadSideInformation", gkFuncRefGet, result);

  snprintf(newPath, elcount(newPath), "%s.%s", oldPath, "lat");
  C2xSetTokenInt(packetHandle, "RoadSideInformation", newPath, value.lat);
  result = CheckLastError("RoadSideInformation", gkFuncRefGet, result);

  return result;
}

int GetRoadSideInformationPosition_LL_32BParams(LONG packetHandle, struct RoadSideInformationPosition_LL_32B value, char oldPath[])
{
  char newPath[300];
  int result;

  result = 0;

  snprintf(newPath, elcount(newPath), "%s.%s", oldPath, "lon");
  value.lon = C2xGetTokenInt(packetHandle, "RoadSideInformation", newPath);
  result = CheckLastError("RoadSideInformation", gkFuncRefGet, result);

  snprintf(newPath, elcount(newPath), "%s.%s", oldPath, "lat");
  value.lat = C2xGetTokenInt(packetHandle, "RoadSideInformation", newPath);
  result = CheckLastError("RoadSideInformation", gkFuncRefGet, result);

  return result;
}

int SetRoadSideInformationPosition_LL_32BParams(LONG packetHandle, struct RoadSideInformationPosition_LL_32B value, char oldPath[])
{
  char newPath[300];
  int result;

  result = 0;

  snprintf(newPath, elcount(newPath), "%s.%s", oldPath, "lon");
  C2xSetTokenInt(packetHandle, "RoadSideInformation", newPath, value.lon);
  result = CheckLastError("RoadSideInformation", gkFuncRefGet, result);

  snprintf(newPath, elcount(newPath), "%s.%s", oldPath, "lat");
  C2xSetTokenInt(packetHandle, "RoadSideInformation", newPath, value.lat);
  result = CheckLastError("RoadSideInformation", gkFuncRefGet, result);

  return result;
}

int GetRoadSideInformationPosition_LL_36BParams(LONG packetHandle, struct RoadSideInformationPosition_LL_36B value, char oldPath[])
{
  char newPath[300];
  int result;

  result = 0;

  snprintf(newPath, elcount(newPath), "%s.%s", oldPath, "lon");
  value.lon = C2xGetTokenInt(packetHandle, "RoadSideInformation", newPath);
  result = CheckLastError("RoadSideInformation", gkFuncRefGet, result);

  snprintf(newPath, elcount(newPath), "%s.%s", oldPath, "lat");
  value.lat = C2xGetTokenInt(packetHandle, "RoadSideInformation", newPath);
  result = CheckLastError("RoadSideInformation", gkFuncRefGet, result);

  return result;
}

int SetRoadSideInformationPosition_LL_36BParams(LONG packetHandle, struct RoadSideInformationPosition_LL_36B value, char oldPath[])
{
  char newPath[300];
  int result;

  result = 0;

  snprintf(newPath, elcount(newPath), "%s.%s", oldPath, "lon");
  C2xSetTokenInt(packetHandle, "RoadSideInformation", newPath, value.lon);
  result = CheckLastError("RoadSideInformation", gkFuncRefGet, result);

  snprintf(newPath, elcount(newPath), "%s.%s", oldPath, "lat");
  C2xSetTokenInt(packetHandle, "RoadSideInformation", newPath, value.lat);
  result = CheckLastError("RoadSideInformation", gkFuncRefGet, result);

  return result;
}

int GetRoadSideInformationPosition_LL_44BParams(LONG packetHandle, struct RoadSideInformationPosition_LL_44B value, char oldPath[])
{
  char newPath[300];
  int result;

  result = 0;

  snprintf(newPath, elcount(newPath), "%s.%s", oldPath, "lon");
  value.lon = C2xGetTokenInt(packetHandle, "RoadSideInformation", newPath);
  result = CheckLastError("RoadSideInformation", gkFuncRefGet, result);

  snprintf(newPath, elcount(newPath), "%s.%s", oldPath, "lat");
  value.lat = C2xGetTokenInt(packetHandle, "RoadSideInformation", newPath);
  result = CheckLastError("RoadSideInformation", gkFuncRefGet, result);

  return result;
}

int SetRoadSideInformationPosition_LL_44BParams(LONG packetHandle, struct RoadSideInformationPosition_LL_44B value, char oldPath[])
{
  char newPath[300];
  int result;

  result = 0;

  snprintf(newPath, elcount(newPath), "%s.%s", oldPath, "lon");
  C2xSetTokenInt(packetHandle, "RoadSideInformation", newPath, value.lon);
  result = CheckLastError("RoadSideInformation", gkFuncRefGet, result);

  snprintf(newPath, elcount(newPath), "%s.%s", oldPath, "lat");
  C2xSetTokenInt(packetHandle, "RoadSideInformation", newPath, value.lat);
  result = CheckLastError("RoadSideInformation", gkFuncRefGet, result);

  return result;
}

int GetRoadSideInformationPosition_LL_48BParams(LONG packetHandle, struct RoadSideInformationPosition_LL_48B value, char oldPath[])
{
  char newPath[300];
  int result;

  result = 0;

  snprintf(newPath, elcount(newPath), "%s.%s", oldPath, "lon");
  value.lon = C2xGetTokenInt(packetHandle, "RoadSideInformation", newPath);
  result = CheckLastError("RoadSideInformation", gkFuncRefGet, result);

  snprintf(newPath, elcount(newPath), "%s.%s", oldPath, "lat");
  value.lat = C2xGetTokenInt(packetHandle, "RoadSideInformation", newPath);
  result = CheckLastError("RoadSideInformation", gkFuncRefGet, result);

  return result;
}

int SetRoadSideInformationPosition_LL_48BParams(LONG packetHandle, struct RoadSideInformationPosition_LL_48B value, char oldPath[])
{
  char newPath[300];
  int result;

  result = 0;

  snprintf(newPath, elcount(newPath), "%s.%s", oldPath, "lon");
  C2xSetTokenInt(packetHandle, "RoadSideInformation", newPath, value.lon);
  result = CheckLastError("RoadSideInformation", gkFuncRefGet, result);

  snprintf(newPath, elcount(newPath), "%s.%s", oldPath, "lat");
  C2xSetTokenInt(packetHandle, "RoadSideInformation", newPath, value.lat);
  result = CheckLastError("RoadSideInformation", gkFuncRefGet, result);

  return result;
}

int GetRoadSideInformationPosition_LLmD_64bParams(LONG packetHandle, struct RoadSideInformationPosition_LLmD_64b value, char oldPath[])
{
  char newPath[300];
  int result;

  result = 0;

  snprintf(newPath, elcount(newPath), "%s.%s", oldPath, "lon");
  value.lon = C2xGetTokenInt(packetHandle, "RoadSideInformation", newPath);
  result = CheckLastError("RoadSideInformation", gkFuncRefGet, result);

  snprintf(newPath, elcount(newPath), "%s.%s", oldPath, "lat");
  value.lat = C2xGetTokenInt(packetHandle, "RoadSideInformation", newPath);
  result = CheckLastError("RoadSideInformation", gkFuncRefGet, result);

  return result;
}

int SetRoadSideInformationPosition_LLmD_64bParams(LONG packetHandle, struct RoadSideInformationPosition_LLmD_64b value, char oldPath[])
{
  char newPath[300];
  int result;

  result = 0;

  snprintf(newPath, elcount(newPath), "%s.%s", oldPath, "lon");
  C2xSetTokenInt(packetHandle, "RoadSideInformation", newPath, value.lon);
  result = CheckLastError("RoadSideInformation", gkFuncRefGet, result);

  snprintf(newPath, elcount(newPath), "%s.%s", oldPath, "lat");
  C2xSetTokenInt(packetHandle, "RoadSideInformation", newPath, value.lat);
  result = CheckLastError("RoadSideInformation", gkFuncRefGet, result);

  return result;
}

int GetRoadSideInformationPositionOffsetLLParams(LONG packetHandle, struct RoadSideInformationPositionOffsetLL value, char oldPath[])
{
  char newPath[300];
  int result;

  result = 0;

  value.choice = C2xGetTokenInt(packetHandle, "RoadSideInformation", oldPath);

  switch(value.choice)
  {
    case 0:
    {
      snprintf(newPath, elcount(newPath), "%s.%s", oldPath, "position_LL1");
      GetRoadSideInformationPosition_LL_24BParams(packetHandle, value.position_LL1, newPath);
      result = CheckLastError("RoadSideInformation", gkFuncRefGet, result);
    }
    break;
    case 1:
    {
      snprintf(newPath, elcount(newPath), "%s.%s", oldPath, "position_LL2");
      GetRoadSideInformationPosition_LL_28BParams(packetHandle, value.position_LL2, newPath);
      result = CheckLastError("RoadSideInformation", gkFuncRefGet, result);
    }
    break;
    case 2:
    {
      snprintf(newPath, elcount(newPath), "%s.%s", oldPath, "position_LL3");
      GetRoadSideInformationPosition_LL_32BParams(packetHandle, value.position_LL3, newPath);
      result = CheckLastError("RoadSideInformation", gkFuncRefGet, result);
    }
    break;
    case 3:
    {
      snprintf(newPath, elcount(newPath), "%s.%s", oldPath, "position_LL4");
      GetRoadSideInformationPosition_LL_36BParams(packetHandle, value.position_LL4, newPath);
      result = CheckLastError("RoadSideInformation", gkFuncRefGet, result);
    }
    break;
    case 4:
    {
      snprintf(newPath, elcount(newPath), "%s.%s", oldPath, "position_LL5");
      GetRoadSideInformationPosition_LL_44BParams(packetHandle, value.position_LL5, newPath);
      result = CheckLastError("RoadSideInformation", gkFuncRefGet, result);
    }
    break;
    case 5:
    {
      snprintf(newPath, elcount(newPath), "%s.%s", oldPath, "position_LL6");
      GetRoadSideInformationPosition_LL_48BParams(packetHandle, value.position_LL6, newPath);
      result = CheckLastError("RoadSideInformation", gkFuncRefGet, result);
    }
    break;
    case 6:
    {
      snprintf(newPath, elcount(newPath), "%s.%s", oldPath, "position_LatLon");
      GetRoadSideInformationPosition_LLmD_64bParams(packetHandle, value.position_LatLon, newPath);
      result = CheckLastError("RoadSideInformation", gkFuncRefGet, result);
    }
    break;
  }
  return result;
}

int SetRoadSideInformationPositionOffsetLLParams(LONG packetHandle, struct RoadSideInformationPositionOffsetLL value, char oldPath[])
{
  char newPath[300];
  int result;

  result = 0;

  switch(value.choice)
  {
    case 0:
    {
      snprintf(newPath, elcount(newPath), "%s.%s", oldPath, "position_LL1");
      SetRoadSideInformationPosition_LL_24BParams(packetHandle, value.position_LL1, newPath);
      result = CheckLastError("RoadSideInformation", gkFuncRefGet, result);
    }
    break;
    case 1:
    {
      snprintf(newPath, elcount(newPath), "%s.%s", oldPath, "position_LL2");
      SetRoadSideInformationPosition_LL_28BParams(packetHandle, value.position_LL2, newPath);
      result = CheckLastError("RoadSideInformation", gkFuncRefGet, result);
    }
    break;
    case 2:
    {
      snprintf(newPath, elcount(newPath), "%s.%s", oldPath, "position_LL3");
      SetRoadSideInformationPosition_LL_32BParams(packetHandle, value.position_LL3, newPath);
      result = CheckLastError("RoadSideInformation", gkFuncRefGet, result);
    }
    break;
    case 3:
    {
      snprintf(newPath, elcount(newPath), "%s.%s", oldPath, "position_LL4");
      SetRoadSideInformationPosition_LL_36BParams(packetHandle, value.position_LL4, newPath);
      result = CheckLastError("RoadSideInformation", gkFuncRefGet, result);
    }
    break;
    case 4:
    {
      snprintf(newPath, elcount(newPath), "%s.%s", oldPath, "position_LL5");
      SetRoadSideInformationPosition_LL_44BParams(packetHandle, value.position_LL5, newPath);
      result = CheckLastError("RoadSideInformation", gkFuncRefGet, result);
    }
    break;
    case 5:
    {
      snprintf(newPath, elcount(newPath), "%s.%s", oldPath, "position_LL6");
      SetRoadSideInformationPosition_LL_48BParams(packetHandle, value.position_LL6, newPath);
      result = CheckLastError("RoadSideInformation", gkFuncRefGet, result);
    }
    break;
    case 6:
    {
      snprintf(newPath, elcount(newPath), "%s.%s", oldPath, "position_LatLon");
      SetRoadSideInformationPosition_LLmD_64bParams(packetHandle, value.position_LatLon, newPath);
      result = CheckLastError("RoadSideInformation", gkFuncRefGet, result);
    }
    break;
  }
  return result;
}

int GetRoadSideInformationVerticalOffsetParams(LONG packetHandle, struct RoadSideInformationVerticalOffset value, char oldPath[])
{
  char newPath[300];
  int result;

  result = 0;

  value.choice = C2xGetTokenInt(packetHandle, "RoadSideInformation", oldPath);

  switch(value.choice)
  {
    case 0:
    {
      snprintf(newPath, elcount(newPath), "%s.%s", oldPath, "offset1");
      value.offset1 = C2xGetTokenInt(packetHandle, "RoadSideInformation", newPath);
      result = CheckLastError("RoadSideInformation", gkFuncRefGet, result);
    }
    break;
    case 1:
    {
      snprintf(newPath, elcount(newPath), "%s.%s", oldPath, "offset2");
      value.offset2 = C2xGetTokenInt(packetHandle, "RoadSideInformation", newPath);
      result = CheckLastError("RoadSideInformation", gkFuncRefGet, result);
    }
    break;
    case 2:
    {
      snprintf(newPath, elcount(newPath), "%s.%s", oldPath, "offset3");
      value.offset3 = C2xGetTokenInt(packetHandle, "RoadSideInformation", newPath);
      result = CheckLastError("RoadSideInformation", gkFuncRefGet, result);
    }
    break;
    case 3:
    {
      snprintf(newPath, elcount(newPath), "%s.%s", oldPath, "offset4");
      value.offset4 = C2xGetTokenInt(packetHandle, "RoadSideInformation", newPath);
      result = CheckLastError("RoadSideInformation", gkFuncRefGet, result);
    }
    break;
    case 4:
    {
      snprintf(newPath, elcount(newPath), "%s.%s", oldPath, "offset5");
      value.offset5 = C2xGetTokenInt(packetHandle, "RoadSideInformation", newPath);
      result = CheckLastError("RoadSideInformation", gkFuncRefGet, result);
    }
    break;
    case 5:
    {
      snprintf(newPath, elcount(newPath), "%s.%s", oldPath, "offset6");
      value.offset6 = C2xGetTokenInt(packetHandle, "RoadSideInformation", newPath);
      result = CheckLastError("RoadSideInformation", gkFuncRefGet, result);
    }
    break;
    case 6:
    {
      snprintf(newPath, elcount(newPath), "%s.%s", oldPath, "elevation");
      value.elevation = C2xGetTokenInt(packetHandle, "RoadSideInformation", newPath);
      result = CheckLastError("RoadSideInformation", gkFuncRefGet, result);
    }
    break;
  }
  return result;
}

int SetRoadSideInformationVerticalOffsetParams(LONG packetHandle, struct RoadSideInformationVerticalOffset value, char oldPath[])
{
  char newPath[300];
  int result;

  result = 0;

  switch(value.choice)
  {
    case 0:
    {
      snprintf(newPath, elcount(newPath), "%s.%s", oldPath, "offset1");
      C2xSetTokenInt(packetHandle, "RoadSideInformation", newPath, value.offset1);
      result = CheckLastError("RoadSideInformation", gkFuncRefGet, result);
    }
    break;
    case 1:
    {
      snprintf(newPath, elcount(newPath), "%s.%s", oldPath, "offset2");
      C2xSetTokenInt(packetHandle, "RoadSideInformation", newPath, value.offset2);
      result = CheckLastError("RoadSideInformation", gkFuncRefGet, result);
    }
    break;
    case 2:
    {
      snprintf(newPath, elcount(newPath), "%s.%s", oldPath, "offset3");
      C2xSetTokenInt(packetHandle, "RoadSideInformation", newPath, value.offset3);
      result = CheckLastError("RoadSideInformation", gkFuncRefGet, result);
    }
    break;
    case 3:
    {
      snprintf(newPath, elcount(newPath), "%s.%s", oldPath, "offset4");
      C2xSetTokenInt(packetHandle, "RoadSideInformation", newPath, value.offset4);
      result = CheckLastError("RoadSideInformation", gkFuncRefGet, result);
    }
    break;
    case 4:
    {
      snprintf(newPath, elcount(newPath), "%s.%s", oldPath, "offset5");
      C2xSetTokenInt(packetHandle, "RoadSideInformation", newPath, value.offset5);
      result = CheckLastError("RoadSideInformation", gkFuncRefGet, result);
    }
    break;
    case 5:
    {
      snprintf(newPath, elcount(newPath), "%s.%s", oldPath, "offset6");
      C2xSetTokenInt(packetHandle, "RoadSideInformation", newPath, value.offset6);
      result = CheckLastError("RoadSideInformation", gkFuncRefGet, result);
    }
    break;
    case 6:
    {
      snprintf(newPath, elcount(newPath), "%s.%s", oldPath, "elevation");
      C2xSetTokenInt(packetHandle, "RoadSideInformation", newPath, value.elevation);
      result = CheckLastError("RoadSideInformation", gkFuncRefGet, result);
    }
    break;
  }
  return result;
}

int GetRoadSideInformationPositionOffsetLLVParams(LONG packetHandle, struct RoadSideInformationPositionOffsetLLV value, char oldPath[])
{
  char newPath[300];
  int result;

  result = 0;

  snprintf(newPath, elcount(newPath), "%s.%s", oldPath, "offsetLL");
  GetRoadSideInformationPositionOffsetLLParams(packetHandle, value.offsetLL, newPath);
  result = CheckLastError("RoadSideInformation", gkFuncRefGet, result);

  snprintf(newPath, elcount(newPath), "%s.%s", oldPath, "offsetV");
  value.offsetV.isValidFlag = C2xIsTokenAvailable(packetHandle, "RoadSideInformation", newPath);
  if(value.offsetV.isValidFlag==1)
  {
    GetRoadSideInformationVerticalOffsetParams(packetHandle, value.offsetV, newPath);
    result = CheckLastError("RoadSideInformation", gkFuncRefGet, result);
  }
  return result;
}

int SetRoadSideInformationPositionOffsetLLVParams(LONG packetHandle, struct RoadSideInformationPositionOffsetLLV value, char oldPath[])
{
  char newPath[300];
  int result;

  result = 0;

  snprintf(newPath, elcount(newPath), "%s.%s", oldPath, "offsetLL");
  SetRoadSideInformationPositionOffsetLLParams(packetHandle, value.offsetLL, newPath);
  result = CheckLastError("RoadSideInformation", gkFuncRefGet, result);

  snprintf(newPath, elcount(newPath), "%s.%s", oldPath, "offsetV");
  if(value.offsetV.isValidFlag==1)
  {
    SetRoadSideInformationVerticalOffsetParams(packetHandle, value.offsetV, newPath);
    result = CheckLastError("RoadSideInformation", gkFuncRefGet, result);
  }
  else
  {
    if( C2xIsTokenAvailable(packetHandle, "RoadSideInformation", newPath) )
    {
      C2xRemoveToken(packetHandle, "RoadSideInformation", newPath);
    }
  }

  return result;
}

int GetRoadSideInformationDescriptionParams(LONG packetHandle, struct RoadSideInformationDescription value, char oldPath[])
{
  char newPath[300];
  int result;

  result = 0;

  value.choice = C2xGetTokenInt(packetHandle, "RoadSideInformation", oldPath);

  switch(value.choice)
  {
    case 0:
    {
      snprintf(newPath, elcount(newPath), "%s.%s", oldPath, "textString");
      value.textString.stringLength = C2xGetTokenData(packetHandle, "RoadSideInformation", newPath, elcount(value.textString.string), value.textString.string);
      result = CheckLastError("RoadSideInformation", gkFuncRefGet, result);
    }
    break;
    case 1:
    {
      snprintf(newPath, elcount(newPath), "%s.%s", oldPath, "textGB2312");
      value.textGB2312.stringLength = C2xGetTokenData(packetHandle, "RoadSideInformation", newPath, elcount(value.textGB2312.string), value.textGB2312.string);
      result = CheckLastError("RoadSideInformation", gkFuncRefGet, result);
    }
    break;
  }
  return result;
}

int SetRoadSideInformationDescriptionParams(LONG packetHandle, struct RoadSideInformationDescription value, char oldPath[])
{
  char newPath[300];
  int result;

  result = 0;

  switch(value.choice)
  {
    case 0:
    {
      snprintf(newPath, elcount(newPath), "%s.%s", oldPath, "textString");
      C2xSetTokenData(packetHandle, "RoadSideInformation", newPath, value.textString.stringLength, value.textString.string);
      result = CheckLastError("RoadSideInformation", gkFuncRefGet, result);
    }
    break;
    case 1:
    {
      snprintf(newPath, elcount(newPath), "%s.%s", oldPath, "textGB2312");
      C2xSetTokenData(packetHandle, "RoadSideInformation", newPath, value.textGB2312.stringLength, value.textGB2312.string);
      result = CheckLastError("RoadSideInformation", gkFuncRefGet, result);
    }
    break;
  }
  return result;
}

int GetRoadSideInformationRSITimeDetailsParams(LONG packetHandle, struct RoadSideInformationRSITimeDetails value, char oldPath[])
{
  char newPath[300];
  int result;

  result = 0;

  snprintf(newPath, elcount(newPath), "%s.%s", oldPath, "startTime");
  value.startTime.isValidFlag = C2xIsTokenAvailable(packetHandle, "RoadSideInformation", newPath);
  if(value.startTime.isValidFlag==1)
  {
    value.startTime.value = C2xGetTokenInt(packetHandle, "RoadSideInformation", newPath);
    result = CheckLastError("RoadSideInformation", gkFuncRefGet, result);
  }
  snprintf(newPath, elcount(newPath), "%s.%s", oldPath, "endTime");
  value.endTime.isValidFlag = C2xIsTokenAvailable(packetHandle, "RoadSideInformation", newPath);
  if(value.endTime.isValidFlag==1)
  {
    value.endTime.value = C2xGetTokenInt(packetHandle, "RoadSideInformation", newPath);
    result = CheckLastError("RoadSideInformation", gkFuncRefGet, result);
  }
  snprintf(newPath, elcount(newPath), "%s.%s", oldPath, "endTimeConfidence");
  value.endTimeConfidence.isValidFlag = C2xIsTokenAvailable(packetHandle, "RoadSideInformation", newPath);
  if(value.endTimeConfidence.isValidFlag==1)
  {
    value.endTimeConfidence.value = C2xGetTokenInt(packetHandle, "RoadSideInformation", newPath);
    result = CheckLastError("RoadSideInformation", gkFuncRefGet, result);
  }
  return result;
}

int SetRoadSideInformationRSITimeDetailsParams(LONG packetHandle, struct RoadSideInformationRSITimeDetails value, char oldPath[])
{
  char newPath[300];
  int result;

  result = 0;

  snprintf(newPath, elcount(newPath), "%s.%s", oldPath, "startTime");
  if(value.startTime.isValidFlag==1)
  {
    C2xSetTokenInt(packetHandle, "RoadSideInformation", newPath, value.startTime.value);
    result = CheckLastError("RoadSideInformation", gkFuncRefGet, result);
  }
  else
  {
    if( C2xIsTokenAvailable(packetHandle, "RoadSideInformation", newPath) )
    {
      C2xRemoveToken(packetHandle, "RoadSideInformation", newPath);
    }
  }

  snprintf(newPath, elcount(newPath), "%s.%s", oldPath, "endTime");
  if(value.endTime.isValidFlag==1)
  {
    C2xSetTokenInt(packetHandle, "RoadSideInformation", newPath, value.endTime.value);
    result = CheckLastError("RoadSideInformation", gkFuncRefGet, result);
  }
  else
  {
    if( C2xIsTokenAvailable(packetHandle, "RoadSideInformation", newPath) )
    {
      C2xRemoveToken(packetHandle, "RoadSideInformation", newPath);
    }
  }

  snprintf(newPath, elcount(newPath), "%s.%s", oldPath, "endTimeConfidence");
  if(value.endTimeConfidence.isValidFlag==1)
  {
    C2xSetTokenInt(packetHandle, "RoadSideInformation", newPath, value.endTimeConfidence.value);
    result = CheckLastError("RoadSideInformation", gkFuncRefGet, result);
  }
  else
  {
    if( C2xIsTokenAvailable(packetHandle, "RoadSideInformation", newPath) )
    {
      C2xRemoveToken(packetHandle, "RoadSideInformation", newPath);
    }
  }

  return result;
}

int GetRoadSideInformationPathPointListParams(LONG packetHandle, struct RoadSideInformationPathPointList value, char oldPath[])
{
  char newPath[300]; 
  int i;
  int result;

  result = 0;

  value.length = C2xGetTokenInt(packetHandle, "RoadSideInformation", oldPath);
  if((result = CheckLastError("RoadSideInformation", gkFuncRefGet, result))==0)
  {
    for(i=0; i<value.length; i++)
    {
      snprintf(newPath, elcount(newPath), "%s[%d]", oldPath, i);
      GetRoadSideInformationPositionOffsetLLVParams(packetHandle, value.arrayValue[i], newPath);
      result = CheckLastError("RoadSideInformation", gkFuncRefGet, result);
    }
  }
  return result;
}

int SetRoadSideInformationPathPointListParams(LONG packetHandle, struct RoadSideInformationPathPointList value, char oldPath[])
{
  char newPath[300]; 
  int i;
  int result;

  result = 0;

  C2xRemoveToken(packetHandle, "RoadSideInformation", oldPath);
  for(i=0; i<value.length; i++)
  {
    snprintf(newPath, elcount(newPath), "%s[%d]", oldPath, i);
    SetRoadSideInformationPositionOffsetLLVParams(packetHandle, value.arrayValue[i], newPath);
    result = CheckLastError("RoadSideInformation", gkFuncRefGet, result);
  }
  return result;
}

int GetRoadSideInformationReferencePathParams(LONG packetHandle, struct RoadSideInformationReferencePath value, char oldPath[])
{
  char newPath[300];
  int result;

  result = 0;

  snprintf(newPath, elcount(newPath), "%s.%s", oldPath, "activePath");
  GetRoadSideInformationPathPointListParams(packetHandle, value.activePath, newPath);
  result = CheckLastError("RoadSideInformation", gkFuncRefGet, result);

  snprintf(newPath, elcount(newPath), "%s.%s", oldPath, "pathRadius");
  value.pathRadius = C2xGetTokenInt(packetHandle, "RoadSideInformation", newPath);
  result = CheckLastError("RoadSideInformation", gkFuncRefGet, result);

  return result;
}

int SetRoadSideInformationReferencePathParams(LONG packetHandle, struct RoadSideInformationReferencePath value, char oldPath[])
{
  char newPath[300];
  int result;

  result = 0;

  snprintf(newPath, elcount(newPath), "%s.%s", oldPath, "activePath");
  SetRoadSideInformationPathPointListParams(packetHandle, value.activePath, newPath);
  result = CheckLastError("RoadSideInformation", gkFuncRefGet, result);

  snprintf(newPath, elcount(newPath), "%s.%s", oldPath, "pathRadius");
  C2xSetTokenInt(packetHandle, "RoadSideInformation", newPath, value.pathRadius);
  result = CheckLastError("RoadSideInformation", gkFuncRefGet, result);

  return result;
}

int GetRoadSideInformationReferencePathListParams(LONG packetHandle, struct RoadSideInformationReferencePathList value, char oldPath[])
{
  char newPath[300]; 
  int i;
  int result;

  result = 0;

  value.length = C2xGetTokenInt(packetHandle, "RoadSideInformation", oldPath);
  if((result = CheckLastError("RoadSideInformation", gkFuncRefGet, result))==0)
  {
    for(i=0; i<value.length; i++)
    {
      snprintf(newPath, elcount(newPath), "%s[%d]", oldPath, i);
      GetRoadSideInformationReferencePathParams(packetHandle, value.arrayValue[i], newPath);
      result = CheckLastError("RoadSideInformation", gkFuncRefGet, result);
    }
  }
  return result;
}

int SetRoadSideInformationReferencePathListParams(LONG packetHandle, struct RoadSideInformationReferencePathList value, char oldPath[])
{
  char newPath[300]; 
  int i;
  int result;

  result = 0;

  C2xRemoveToken(packetHandle, "RoadSideInformation", oldPath);
  for(i=0; i<value.length; i++)
  {
    snprintf(newPath, elcount(newPath), "%s[%d]", oldPath, i);
    SetRoadSideInformationReferencePathParams(packetHandle, value.arrayValue[i], newPath);
    result = CheckLastError("RoadSideInformation", gkFuncRefGet, result);
  }
  return result;
}

int GetRoadSideInformationNodeReferenceIDParams(LONG packetHandle, struct RoadSideInformationNodeReferenceID value, char oldPath[])
{
  char newPath[300];
  int result;

  result = 0;

  snprintf(newPath, elcount(newPath), "%s.%s", oldPath, "region");
  value.region.isValidFlag = C2xIsTokenAvailable(packetHandle, "RoadSideInformation", newPath);
  if(value.region.isValidFlag==1)
  {
    value.region.value = C2xGetTokenInt(packetHandle, "RoadSideInformation", newPath);
    result = CheckLastError("RoadSideInformation", gkFuncRefGet, result);
  }
  snprintf(newPath, elcount(newPath), "%s.%s", oldPath, "id");
  value.id = C2xGetTokenInt(packetHandle, "RoadSideInformation", newPath);
  result = CheckLastError("RoadSideInformation", gkFuncRefGet, result);

  return result;
}

int SetRoadSideInformationNodeReferenceIDParams(LONG packetHandle, struct RoadSideInformationNodeReferenceID value, char oldPath[])
{
  char newPath[300];
  int result;

  result = 0;

  snprintf(newPath, elcount(newPath), "%s.%s", oldPath, "region");
  if(value.region.isValidFlag==1)
  {
    C2xSetTokenInt(packetHandle, "RoadSideInformation", newPath, value.region.value);
    result = CheckLastError("RoadSideInformation", gkFuncRefGet, result);
  }
  else
  {
    if( C2xIsTokenAvailable(packetHandle, "RoadSideInformation", newPath) )
    {
      C2xRemoveToken(packetHandle, "RoadSideInformation", newPath);
    }
  }

  snprintf(newPath, elcount(newPath), "%s.%s", oldPath, "id");
  C2xSetTokenInt(packetHandle, "RoadSideInformation", newPath, value.id);
  result = CheckLastError("RoadSideInformation", gkFuncRefGet, result);

  return result;
}

int GetRoadSideInformationReferenceLinkParams(LONG packetHandle, struct RoadSideInformationReferenceLink value, char oldPath[])
{
  char newPath[300]; 
  int j; 
  int k;
  int result;

  result = 0;

  snprintf(newPath, elcount(newPath), "%s.%s", oldPath, "upstreamNodeId");
  GetRoadSideInformationNodeReferenceIDParams(packetHandle, value.upstreamNodeId, newPath);
  result = CheckLastError("RoadSideInformation", gkFuncRefGet, result);

  snprintf(newPath, elcount(newPath), "%s.%s", oldPath, "downstreamNodeId");
  GetRoadSideInformationNodeReferenceIDParams(packetHandle, value.downstreamNodeId, newPath);
  result = CheckLastError("RoadSideInformation", gkFuncRefGet, result);

  snprintf(newPath, elcount(newPath), "%s.%s", oldPath, "referenceLanes");
  value.referenceLanes.isValidFlag = C2xIsTokenAvailable(packetHandle, "RoadSideInformation", newPath);
  if(value.referenceLanes.isValidFlag==1)
  {
    value.referenceLanes.isValidFlag = 1;
    value.referenceLanes.stringLength = C2xGetTokenLengthBit(packetHandle, "RoadSideInformation", newPath);
    if ((result = CheckLastError("RoadSideInformation", gkFuncRefGet, result))==0)
    {
      if(value.referenceLanes.stringLength > 0)
      {
        for(j=0; j<value.referenceLanes.stringLength; j++)
        {
          if(C2xGetTokenBitOfBitString(packetHandle, "RoadSideInformation", newPath, j) == 0)
          {
            value.referenceLanes.string[j] = '0';
          }
          else if(C2xGetTokenBitOfBitString(packetHandle, "RoadSideInformation", newPath, j) == 1)
          {
            value.referenceLanes.string[j] = '1';
          }

          if(value.referenceLanes.stringLength == 1)
          {
            value.referenceLanes.string[1] = '0';
          }
          result = CheckLastError("RoadSideInformation", gkFuncRefGet, result);
        }
      }
      else
      {
        for(k = value.referenceLanes.stringLength+1; k > -1; k--)
        {
          if(value.referenceLanes.string[k] == '1')
          {
            value.referenceLanes.string[k] = '0';
          }
        }
      }
    }

  }
  return result;
}

int SetRoadSideInformationReferenceLinkParams(LONG packetHandle, struct RoadSideInformationReferenceLink value, char oldPath[])
{
  char newPath[300]; 
  int j;
  int result;

  result = 0;

  snprintf(newPath, elcount(newPath), "%s.%s", oldPath, "upstreamNodeId");
  SetRoadSideInformationNodeReferenceIDParams(packetHandle, value.upstreamNodeId, newPath);
  result = CheckLastError("RoadSideInformation", gkFuncRefGet, result);

  snprintf(newPath, elcount(newPath), "%s.%s", oldPath, "downstreamNodeId");
  SetRoadSideInformationNodeReferenceIDParams(packetHandle, value.downstreamNodeId, newPath);
  result = CheckLastError("RoadSideInformation", gkFuncRefGet, result);

  snprintf(newPath, elcount(newPath), "%s.%s", oldPath, "referenceLanes");
  if(value.referenceLanes.isValidFlag==1)
  {
      for(j=0; j<value.referenceLanes.stringLength; j++)
      {
        if(value.referenceLanes.string[j] == '0')
        {
          C2xSetTokenBitOfBitString(packetHandle, "RoadSideInformation", newPath, j, 0);
        }
        else
        {
          C2xSetTokenBitOfBitString(packetHandle, "RoadSideInformation", newPath, j, 1);
        }
        result = CheckLastError("RoadSideInformation", gkFuncRefGet, result);
      }
  }
  else
  {
    if( C2xIsTokenAvailable(packetHandle, "RoadSideInformation", newPath) )
    {
      C2xRemoveToken(packetHandle, "RoadSideInformation", newPath);
    }
  }

  return result;
}

int GetRoadSideInformationReferenceLinkListParams(LONG packetHandle, struct RoadSideInformationReferenceLinkList value, char oldPath[])
{
  char newPath[300]; 
  int i;
  int result;

  result = 0;

  value.length = C2xGetTokenInt(packetHandle, "RoadSideInformation", oldPath);
  if((result = CheckLastError("RoadSideInformation", gkFuncRefGet, result))==0)
  {
    for(i=0; i<value.length; i++)
    {
      snprintf(newPath, elcount(newPath), "%s[%d]", oldPath, i);
      GetRoadSideInformationReferenceLinkParams(packetHandle, value.arrayValue[i], newPath);
      result = CheckLastError("RoadSideInformation", gkFuncRefGet, result);
    }
  }
  return result;
}

int SetRoadSideInformationReferenceLinkListParams(LONG packetHandle, struct RoadSideInformationReferenceLinkList value, char oldPath[])
{
  char newPath[300]; 
  int i;
  int result;

  result = 0;

  C2xRemoveToken(packetHandle, "RoadSideInformation", oldPath);
  for(i=0; i<value.length; i++)
  {
    snprintf(newPath, elcount(newPath), "%s[%d]", oldPath, i);
    SetRoadSideInformationReferenceLinkParams(packetHandle, value.arrayValue[i], newPath);
    result = CheckLastError("RoadSideInformation", gkFuncRefGet, result);
  }
  return result;
}

int GetRoadSideInformationRTEDataParams(LONG packetHandle, struct RoadSideInformationRTEData value, char oldPath[])
{
  char newPath[300];
  int result;

  result = 0;

  snprintf(newPath, elcount(newPath), "%s.%s", oldPath, "rteId");
  value.rteId = C2xGetTokenInt(packetHandle, "RoadSideInformation", newPath);
  result = CheckLastError("RoadSideInformation", gkFuncRefGet, result);

  snprintf(newPath, elcount(newPath), "%s.%s", oldPath, "eventType");
  value.eventType = C2xGetTokenInt(packetHandle, "RoadSideInformation", newPath);
  result = CheckLastError("RoadSideInformation", gkFuncRefGet, result);

  snprintf(newPath, elcount(newPath), "%s.%s", oldPath, "eventSource");
  value.eventSource = C2xGetTokenInt(packetHandle, "RoadSideInformation", newPath);
  result = CheckLastError("RoadSideInformation", gkFuncRefGet, result);

  snprintf(newPath, elcount(newPath), "%s.%s", oldPath, "eventPos");
  value.eventPos.isValidFlag = C2xIsTokenAvailable(packetHandle, "RoadSideInformation", newPath);
  if(value.eventPos.isValidFlag==1)
  {
    GetRoadSideInformationPositionOffsetLLVParams(packetHandle, value.eventPos, newPath);
    result = CheckLastError("RoadSideInformation", gkFuncRefGet, result);
  }
  snprintf(newPath, elcount(newPath), "%s.%s", oldPath, "eventRadius");
  value.eventRadius.isValidFlag = C2xIsTokenAvailable(packetHandle, "RoadSideInformation", newPath);
  if(value.eventRadius.isValidFlag==1)
  {
    value.eventRadius.value = C2xGetTokenInt(packetHandle, "RoadSideInformation", newPath);
    result = CheckLastError("RoadSideInformation", gkFuncRefGet, result);
  }
  snprintf(newPath, elcount(newPath), "%s.%s", oldPath, "description");
  value.description.isValidFlag = C2xIsTokenAvailable(packetHandle, "RoadSideInformation", newPath);
  if(value.description.isValidFlag==1)
  {
    GetRoadSideInformationDescriptionParams(packetHandle, value.description, newPath);
    result = CheckLastError("RoadSideInformation", gkFuncRefGet, result);
  }
  snprintf(newPath, elcount(newPath), "%s.%s", oldPath, "timeDetails");
  value.timeDetails.isValidFlag = C2xIsTokenAvailable(packetHandle, "RoadSideInformation", newPath);
  if(value.timeDetails.isValidFlag==1)
  {
    GetRoadSideInformationRSITimeDetailsParams(packetHandle, value.timeDetails, newPath);
    result = CheckLastError("RoadSideInformation", gkFuncRefGet, result);
  }
  snprintf(newPath, elcount(newPath), "%s.%s", oldPath, "priority");
  value.priority.isValidFlag = C2xIsTokenAvailable(packetHandle, "RoadSideInformation", newPath);
  if(value.priority.isValidFlag==1)
  {
    value.priority.isValidFlag = 1;
    value.priority.stringLength = C2xGetTokenData(packetHandle, "RoadSideInformation", newPath, elcount(value.priority.string), value.priority.string);
  }
  snprintf(newPath, elcount(newPath), "%s.%s", oldPath, "referencePaths");
  value.referencePaths.isValidFlag = C2xIsTokenAvailable(packetHandle, "RoadSideInformation", newPath);
  if(value.referencePaths.isValidFlag==1)
  {
    GetRoadSideInformationReferencePathListParams(packetHandle, value.referencePaths, newPath);
    result = CheckLastError("RoadSideInformation", gkFuncRefGet, result);
  }
  snprintf(newPath, elcount(newPath), "%s.%s", oldPath, "referenceLinks");
  value.referenceLinks.isValidFlag = C2xIsTokenAvailable(packetHandle, "RoadSideInformation", newPath);
  if(value.referenceLinks.isValidFlag==1)
  {
    GetRoadSideInformationReferenceLinkListParams(packetHandle, value.referenceLinks, newPath);
    result = CheckLastError("RoadSideInformation", gkFuncRefGet, result);
  }
  snprintf(newPath, elcount(newPath), "%s.%s", oldPath, "eventConfidence");
  value.eventConfidence.isValidFlag = C2xIsTokenAvailable(packetHandle, "RoadSideInformation", newPath);
  if(value.eventConfidence.isValidFlag==1)
  {
    value.eventConfidence.value = C2xGetTokenInt(packetHandle, "RoadSideInformation", newPath);
    result = CheckLastError("RoadSideInformation", gkFuncRefGet, result);
  }
  return result;
}

int SetRoadSideInformationRTEDataParams(LONG packetHandle, struct RoadSideInformationRTEData value, char oldPath[])
{
  char newPath[300];
  int result;

  result = 0;

  snprintf(newPath, elcount(newPath), "%s.%s", oldPath, "rteId");
  C2xSetTokenInt(packetHandle, "RoadSideInformation", newPath, value.rteId);
  result = CheckLastError("RoadSideInformation", gkFuncRefGet, result);

  snprintf(newPath, elcount(newPath), "%s.%s", oldPath, "eventType");
  C2xSetTokenInt(packetHandle, "RoadSideInformation", newPath, value.eventType);
  result = CheckLastError("RoadSideInformation", gkFuncRefGet, result);

  snprintf(newPath, elcount(newPath), "%s.%s", oldPath, "eventSource");
  C2xSetTokenInt(packetHandle, "RoadSideInformation", newPath, value.eventSource);
  result = CheckLastError("RoadSideInformation", gkFuncRefGet, result);

  snprintf(newPath, elcount(newPath), "%s.%s", oldPath, "eventPos");
  if(value.eventPos.isValidFlag==1)
  {
    SetRoadSideInformationPositionOffsetLLVParams(packetHandle, value.eventPos, newPath);
    result = CheckLastError("RoadSideInformation", gkFuncRefGet, result);
  }
  else
  {
    if( C2xIsTokenAvailable(packetHandle, "RoadSideInformation", newPath) )
    {
      C2xRemoveToken(packetHandle, "RoadSideInformation", newPath);
    }
  }

  snprintf(newPath, elcount(newPath), "%s.%s", oldPath, "eventRadius");
  if(value.eventRadius.isValidFlag==1)
  {
    C2xSetTokenInt(packetHandle, "RoadSideInformation", newPath, value.eventRadius.value);
    result = CheckLastError("RoadSideInformation", gkFuncRefGet, result);
  }
  else
  {
    if( C2xIsTokenAvailable(packetHandle, "RoadSideInformation", newPath) )
    {
      C2xRemoveToken(packetHandle, "RoadSideInformation", newPath);
    }
  }

  snprintf(newPath, elcount(newPath), "%s.%s", oldPath, "description");
  if(value.description.isValidFlag==1)
  {
    SetRoadSideInformationDescriptionParams(packetHandle, value.description, newPath);
    result = CheckLastError("RoadSideInformation", gkFuncRefGet, result);
  }
  else
  {
    if( C2xIsTokenAvailable(packetHandle, "RoadSideInformation", newPath) )
    {
      C2xRemoveToken(packetHandle, "RoadSideInformation", newPath);
    }
  }

  snprintf(newPath, elcount(newPath), "%s.%s", oldPath, "timeDetails");
  if(value.timeDetails.isValidFlag==1)
  {
    SetRoadSideInformationRSITimeDetailsParams(packetHandle, value.timeDetails, newPath);
    result = CheckLastError("RoadSideInformation", gkFuncRefGet, result);
  }
  else
  {
    if( C2xIsTokenAvailable(packetHandle, "RoadSideInformation", newPath) )
    {
      C2xRemoveToken(packetHandle, "RoadSideInformation", newPath);
    }
  }

  snprintf(newPath, elcount(newPath), "%s.%s", oldPath, "priority");
  if(value.priority.isValidFlag==1)
  {
    C2xSetTokenData(packetHandle, "RoadSideInformation", newPath, value.priority.stringLength, value.priority.string);
  }
  else
  {
    if( C2xIsTokenAvailable(packetHandle, "RoadSideInformation", newPath) )
    {
      C2xRemoveToken(packetHandle, "RoadSideInformation", newPath);
    }
  }

  snprintf(newPath, elcount(newPath), "%s.%s", oldPath, "referencePaths");
  if(value.referencePaths.isValidFlag==1)
  {
    SetRoadSideInformationReferencePathListParams(packetHandle, value.referencePaths, newPath);
    result = CheckLastError("RoadSideInformation", gkFuncRefGet, result);
  }
  else
  {
    if( C2xIsTokenAvailable(packetHandle, "RoadSideInformation", newPath) )
    {
      C2xRemoveToken(packetHandle, "RoadSideInformation", newPath);
    }
  }

  snprintf(newPath, elcount(newPath), "%s.%s", oldPath, "referenceLinks");
  if(value.referenceLinks.isValidFlag==1)
  {
    SetRoadSideInformationReferenceLinkListParams(packetHandle, value.referenceLinks, newPath);
    result = CheckLastError("RoadSideInformation", gkFuncRefGet, result);
  }
  else
  {
    if( C2xIsTokenAvailable(packetHandle, "RoadSideInformation", newPath) )
    {
      C2xRemoveToken(packetHandle, "RoadSideInformation", newPath);
    }
  }

  snprintf(newPath, elcount(newPath), "%s.%s", oldPath, "eventConfidence");
  if(value.eventConfidence.isValidFlag==1)
  {
    C2xSetTokenInt(packetHandle, "RoadSideInformation", newPath, value.eventConfidence.value);
    result = CheckLastError("RoadSideInformation", gkFuncRefGet, result);
  }
  else
  {
    if( C2xIsTokenAvailable(packetHandle, "RoadSideInformation", newPath) )
    {
      C2xRemoveToken(packetHandle, "RoadSideInformation", newPath);
    }
  }

  return result;
}

int GetRoadSideInformationRTEListParams(LONG packetHandle, struct RoadSideInformationRTEList value, char oldPath[])
{
  char newPath[300]; 
  int i;
  int result;

  result = 0;

  value.length = C2xGetTokenInt(packetHandle, "RoadSideInformation", oldPath);
  if((result = CheckLastError("RoadSideInformation", gkFuncRefGet, result))==0)
  {
    for(i=0; i<value.length; i++)
    {
      snprintf(newPath, elcount(newPath), "%s[%d]", oldPath, i);
      GetRoadSideInformationRTEDataParams(packetHandle, value.arrayValue[i], newPath);
      result = CheckLastError("RoadSideInformation", gkFuncRefGet, result);
    }
  }
  return result;
}

int SetRoadSideInformationRTEListParams(LONG packetHandle, struct RoadSideInformationRTEList value, char oldPath[])
{
  char newPath[300]; 
  int i;
  int result;

  result = 0;

  C2xRemoveToken(packetHandle, "RoadSideInformation", oldPath);
  for(i=0; i<value.length; i++)
  {
    snprintf(newPath, elcount(newPath), "%s[%d]", oldPath, i);
    SetRoadSideInformationRTEDataParams(packetHandle, value.arrayValue[i], newPath);
    result = CheckLastError("RoadSideInformation", gkFuncRefGet, result);
  }
  return result;
}

int GetRoadSideInformationAuxiliarySignParams(LONG packetHandle, struct RoadSideInformationAuxiliarySign value, char oldPath[])
{
  char newPath[300]; 
  int j; 
  int k;
  int result;

  result = 0;

  snprintf(newPath, elcount(newPath), "%s.%s", oldPath, "signWithVehicleType");
  value.signWithVehicleType.isValidFlag = C2xIsTokenAvailable(packetHandle, "RoadSideInformation", newPath);
  if(value.signWithVehicleType.isValidFlag==1)
  {
    value.signWithVehicleType.isValidFlag = 1;
    value.signWithVehicleType.stringLength = C2xGetTokenLengthBit(packetHandle, "RoadSideInformation", newPath);
    if ((result = CheckLastError("RoadSideInformation", gkFuncRefGet, result))==0)
    {
      if(value.signWithVehicleType.stringLength > 0)
      {
        for(j=0; j<value.signWithVehicleType.stringLength; j++)
        {
          if(C2xGetTokenBitOfBitString(packetHandle, "RoadSideInformation", newPath, j) == 0)
          {
            value.signWithVehicleType.string[j] = '0';
          }
          else if(C2xGetTokenBitOfBitString(packetHandle, "RoadSideInformation", newPath, j) == 1)
          {
            value.signWithVehicleType.string[j] = '1';
          }

          if(value.signWithVehicleType.stringLength == 1)
          {
            value.signWithVehicleType.string[1] = '0';
          }
          result = CheckLastError("RoadSideInformation", gkFuncRefGet, result);
        }
      }
      else
      {
        for(k = value.signWithVehicleType.stringLength+1; k > -1; k--)
        {
          if(value.signWithVehicleType.string[k] == '1')
          {
            value.signWithVehicleType.string[k] = '0';
          }
        }
      }
    }

  }
  snprintf(newPath, elcount(newPath), "%s.%s", oldPath, "signDirection");
  value.signDirection.isValidFlag = C2xIsTokenAvailable(packetHandle, "RoadSideInformation", newPath);
  if(value.signDirection.isValidFlag==1)
  {
    value.signDirection.value = C2xGetTokenInt(packetHandle, "RoadSideInformation", newPath);
    result = CheckLastError("RoadSideInformation", gkFuncRefGet, result);
  }
  return result;
}

int SetRoadSideInformationAuxiliarySignParams(LONG packetHandle, struct RoadSideInformationAuxiliarySign value, char oldPath[])
{
  char newPath[300]; 
  int j;
  int result;

  result = 0;

  snprintf(newPath, elcount(newPath), "%s.%s", oldPath, "signWithVehicleType");
  if(value.signWithVehicleType.isValidFlag==1)
  {
      for(j=0; j<value.signWithVehicleType.stringLength; j++)
      {
        if(value.signWithVehicleType.string[j] == '0')
        {
          C2xSetTokenBitOfBitString(packetHandle, "RoadSideInformation", newPath, j, 0);
        }
        else
        {
          C2xSetTokenBitOfBitString(packetHandle, "RoadSideInformation", newPath, j, 1);
        }
        result = CheckLastError("RoadSideInformation", gkFuncRefGet, result);
      }
  }
  else
  {
    if( C2xIsTokenAvailable(packetHandle, "RoadSideInformation", newPath) )
    {
      C2xRemoveToken(packetHandle, "RoadSideInformation", newPath);
    }
  }

  snprintf(newPath, elcount(newPath), "%s.%s", oldPath, "signDirection");
  if(value.signDirection.isValidFlag==1)
  {
    C2xSetTokenInt(packetHandle, "RoadSideInformation", newPath, value.signDirection.value);
    result = CheckLastError("RoadSideInformation", gkFuncRefGet, result);
  }
  else
  {
    if( C2xIsTokenAvailable(packetHandle, "RoadSideInformation", newPath) )
    {
      C2xRemoveToken(packetHandle, "RoadSideInformation", newPath);
    }
  }

  return result;
}

int GetRoadSideInformationRTSDataParams(LONG packetHandle, struct RoadSideInformationRTSData value, char oldPath[])
{
  char newPath[300];
  int result;

  result = 0;

  snprintf(newPath, elcount(newPath), "%s.%s", oldPath, "rtsId");
  value.rtsId = C2xGetTokenInt(packetHandle, "RoadSideInformation", newPath);
  result = CheckLastError("RoadSideInformation", gkFuncRefGet, result);

  snprintf(newPath, elcount(newPath), "%s.%s", oldPath, "signType");
  value.signType = C2xGetTokenInt(packetHandle, "RoadSideInformation", newPath);
  result = CheckLastError("RoadSideInformation", gkFuncRefGet, result);

  snprintf(newPath, elcount(newPath), "%s.%s", oldPath, "signPos");
  value.signPos.isValidFlag = C2xIsTokenAvailable(packetHandle, "RoadSideInformation", newPath);
  if(value.signPos.isValidFlag==1)
  {
    GetRoadSideInformationPositionOffsetLLVParams(packetHandle, value.signPos, newPath);
    result = CheckLastError("RoadSideInformation", gkFuncRefGet, result);
  }
  snprintf(newPath, elcount(newPath), "%s.%s", oldPath, "description");
  value.description.isValidFlag = C2xIsTokenAvailable(packetHandle, "RoadSideInformation", newPath);
  if(value.description.isValidFlag==1)
  {
    GetRoadSideInformationDescriptionParams(packetHandle, value.description, newPath);
    result = CheckLastError("RoadSideInformation", gkFuncRefGet, result);
  }
  snprintf(newPath, elcount(newPath), "%s.%s", oldPath, "timeDetails");
  value.timeDetails.isValidFlag = C2xIsTokenAvailable(packetHandle, "RoadSideInformation", newPath);
  if(value.timeDetails.isValidFlag==1)
  {
    GetRoadSideInformationRSITimeDetailsParams(packetHandle, value.timeDetails, newPath);
    result = CheckLastError("RoadSideInformation", gkFuncRefGet, result);
  }
  snprintf(newPath, elcount(newPath), "%s.%s", oldPath, "priority");
  value.priority.isValidFlag = C2xIsTokenAvailable(packetHandle, "RoadSideInformation", newPath);
  if(value.priority.isValidFlag==1)
  {
    value.priority.isValidFlag = 1;
    value.priority.stringLength = C2xGetTokenData(packetHandle, "RoadSideInformation", newPath, elcount(value.priority.string), value.priority.string);
  }
  snprintf(newPath, elcount(newPath), "%s.%s", oldPath, "referencePaths");
  value.referencePaths.isValidFlag = C2xIsTokenAvailable(packetHandle, "RoadSideInformation", newPath);
  if(value.referencePaths.isValidFlag==1)
  {
    GetRoadSideInformationReferencePathListParams(packetHandle, value.referencePaths, newPath);
    result = CheckLastError("RoadSideInformation", gkFuncRefGet, result);
  }
  snprintf(newPath, elcount(newPath), "%s.%s", oldPath, "referenceLinks");
  value.referenceLinks.isValidFlag = C2xIsTokenAvailable(packetHandle, "RoadSideInformation", newPath);
  if(value.referenceLinks.isValidFlag==1)
  {
    GetRoadSideInformationReferenceLinkListParams(packetHandle, value.referenceLinks, newPath);
    result = CheckLastError("RoadSideInformation", gkFuncRefGet, result);
  }
  snprintf(newPath, elcount(newPath), "%s.%s", oldPath, "auxiliarySign");
  value.auxiliarySign.isValidFlag = C2xIsTokenAvailable(packetHandle, "RoadSideInformation", newPath);
  if(value.auxiliarySign.isValidFlag==1)
  {
    GetRoadSideInformationAuxiliarySignParams(packetHandle, value.auxiliarySign, newPath);
    result = CheckLastError("RoadSideInformation", gkFuncRefGet, result);
  }
  return result;
}

int SetRoadSideInformationRTSDataParams(LONG packetHandle, struct RoadSideInformationRTSData value, char oldPath[])
{
  char newPath[300];
  int result;

  result = 0;

  snprintf(newPath, elcount(newPath), "%s.%s", oldPath, "rtsId");
  C2xSetTokenInt(packetHandle, "RoadSideInformation", newPath, value.rtsId);
  result = CheckLastError("RoadSideInformation", gkFuncRefGet, result);

  snprintf(newPath, elcount(newPath), "%s.%s", oldPath, "signType");
  C2xSetTokenInt(packetHandle, "RoadSideInformation", newPath, value.signType);
  result = CheckLastError("RoadSideInformation", gkFuncRefGet, result);

  snprintf(newPath, elcount(newPath), "%s.%s", oldPath, "signPos");
  if(value.signPos.isValidFlag==1)
  {
    SetRoadSideInformationPositionOffsetLLVParams(packetHandle, value.signPos, newPath);
    result = CheckLastError("RoadSideInformation", gkFuncRefGet, result);
  }
  else
  {
    if( C2xIsTokenAvailable(packetHandle, "RoadSideInformation", newPath) )
    {
      C2xRemoveToken(packetHandle, "RoadSideInformation", newPath);
    }
  }

  snprintf(newPath, elcount(newPath), "%s.%s", oldPath, "description");
  if(value.description.isValidFlag==1)
  {
    SetRoadSideInformationDescriptionParams(packetHandle, value.description, newPath);
    result = CheckLastError("RoadSideInformation", gkFuncRefGet, result);
  }
  else
  {
    if( C2xIsTokenAvailable(packetHandle, "RoadSideInformation", newPath) )
    {
      C2xRemoveToken(packetHandle, "RoadSideInformation", newPath);
    }
  }

  snprintf(newPath, elcount(newPath), "%s.%s", oldPath, "timeDetails");
  if(value.timeDetails.isValidFlag==1)
  {
    SetRoadSideInformationRSITimeDetailsParams(packetHandle, value.timeDetails, newPath);
    result = CheckLastError("RoadSideInformation", gkFuncRefGet, result);
  }
  else
  {
    if( C2xIsTokenAvailable(packetHandle, "RoadSideInformation", newPath) )
    {
      C2xRemoveToken(packetHandle, "RoadSideInformation", newPath);
    }
  }

  snprintf(newPath, elcount(newPath), "%s.%s", oldPath, "priority");
  if(value.priority.isValidFlag==1)
  {
    C2xSetTokenData(packetHandle, "RoadSideInformation", newPath, value.priority.stringLength, value.priority.string);
  }
  else
  {
    if( C2xIsTokenAvailable(packetHandle, "RoadSideInformation", newPath) )
    {
      C2xRemoveToken(packetHandle, "RoadSideInformation", newPath);
    }
  }

  snprintf(newPath, elcount(newPath), "%s.%s", oldPath, "referencePaths");
  if(value.referencePaths.isValidFlag==1)
  {
    SetRoadSideInformationReferencePathListParams(packetHandle, value.referencePaths, newPath);
    result = CheckLastError("RoadSideInformation", gkFuncRefGet, result);
  }
  else
  {
    if( C2xIsTokenAvailable(packetHandle, "RoadSideInformation", newPath) )
    {
      C2xRemoveToken(packetHandle, "RoadSideInformation", newPath);
    }
  }

  snprintf(newPath, elcount(newPath), "%s.%s", oldPath, "referenceLinks");
  if(value.referenceLinks.isValidFlag==1)
  {
    SetRoadSideInformationReferenceLinkListParams(packetHandle, value.referenceLinks, newPath);
    result = CheckLastError("RoadSideInformation", gkFuncRefGet, result);
  }
  else
  {
    if( C2xIsTokenAvailable(packetHandle, "RoadSideInformation", newPath) )
    {
      C2xRemoveToken(packetHandle, "RoadSideInformation", newPath);
    }
  }

  snprintf(newPath, elcount(newPath), "%s.%s", oldPath, "auxiliarySign");
  if(value.auxiliarySign.isValidFlag==1)
  {
    SetRoadSideInformationAuxiliarySignParams(packetHandle, value.auxiliarySign, newPath);
    result = CheckLastError("RoadSideInformation", gkFuncRefGet, result);
  }
  else
  {
    if( C2xIsTokenAvailable(packetHandle, "RoadSideInformation", newPath) )
    {
      C2xRemoveToken(packetHandle, "RoadSideInformation", newPath);
    }
  }

  return result;
}

int GetRoadSideInformationRTSListParams(LONG packetHandle, struct RoadSideInformationRTSList value, char oldPath[])
{
  char newPath[300]; 
  int i;
  int result;

  result = 0;

  value.length = C2xGetTokenInt(packetHandle, "RoadSideInformation", oldPath);
  if((result = CheckLastError("RoadSideInformation", gkFuncRefGet, result))==0)
  {
    for(i=0; i<value.length; i++)
    {
      snprintf(newPath, elcount(newPath), "%s[%d]", oldPath, i);
      GetRoadSideInformationRTSDataParams(packetHandle, value.arrayValue[i], newPath);
      result = CheckLastError("RoadSideInformation", gkFuncRefGet, result);
    }
  }
  return result;
}

int SetRoadSideInformationRTSListParams(LONG packetHandle, struct RoadSideInformationRTSList value, char oldPath[])
{
  char newPath[300]; 
  int i;
  int result;

  result = 0;

  C2xRemoveToken(packetHandle, "RoadSideInformation", oldPath);
  for(i=0; i<value.length; i++)
  {
    snprintf(newPath, elcount(newPath), "%s[%d]", oldPath, i);
    SetRoadSideInformationRTSDataParams(packetHandle, value.arrayValue[i], newPath);
    result = CheckLastError("RoadSideInformation", gkFuncRefGet, result);
  }
  return result;
}

int GetRoadSideInformationRSIFrameParams(LONG packetHandle, struct RoadSideInformationRSIFrame value, char oldPath[])
{
  char newPath[300];
  int result;

  result = 0;

  snprintf(newPath, elcount(newPath), "%s.%s", oldPath, "msgCnt");
  value.msgCnt = C2xGetTokenInt(packetHandle, "RoadSideInformation", newPath);
  result = CheckLastError("RoadSideInformation", gkFuncRefGet, result);

  snprintf(newPath, elcount(newPath), "%s.%s", oldPath, "moy");
  value.moy.isValidFlag = C2xIsTokenAvailable(packetHandle, "RoadSideInformation", newPath);
  if(value.moy.isValidFlag==1)
  {
    value.moy.value = C2xGetTokenInt(packetHandle, "RoadSideInformation", newPath);
    result = CheckLastError("RoadSideInformation", gkFuncRefGet, result);
  }
  snprintf(newPath, elcount(newPath), "%s.%s", oldPath, "id");
  value.id.stringLength = C2xGetTokenData(packetHandle, "RoadSideInformation", newPath, elcount(value.id.string), value.id.string);
  snprintf(newPath, elcount(newPath), "%s.%s", oldPath, "refPos");
  GetRoadSideInformationPosition3DParams(packetHandle, value.refPos, newPath);
  result = CheckLastError("RoadSideInformation", gkFuncRefGet, result);

  snprintf(newPath, elcount(newPath), "%s.%s", oldPath, "rtes");
  value.rtes.isValidFlag = C2xIsTokenAvailable(packetHandle, "RoadSideInformation", newPath);
  if(value.rtes.isValidFlag==1)
  {
    GetRoadSideInformationRTEListParams(packetHandle, value.rtes, newPath);
    result = CheckLastError("RoadSideInformation", gkFuncRefGet, result);
  }
  snprintf(newPath, elcount(newPath), "%s.%s", oldPath, "rtss");
  value.rtss.isValidFlag = C2xIsTokenAvailable(packetHandle, "RoadSideInformation", newPath);
  if(value.rtss.isValidFlag==1)
  {
    GetRoadSideInformationRTSListParams(packetHandle, value.rtss, newPath);
    result = CheckLastError("RoadSideInformation", gkFuncRefGet, result);
  }
  return result;
}

int SetRoadSideInformationRSIFrameParams(LONG packetHandle, struct RoadSideInformationRSIFrame value, char oldPath[])
{
  char newPath[300];
  int result;

  result = 0;

  snprintf(newPath, elcount(newPath), "%s.%s", oldPath, "msgCnt");
  C2xSetTokenInt(packetHandle, "RoadSideInformation", newPath, value.msgCnt);
  result = CheckLastError("RoadSideInformation", gkFuncRefGet, result);

  snprintf(newPath, elcount(newPath), "%s.%s", oldPath, "moy");
  if(value.moy.isValidFlag==1)
  {
    C2xSetTokenInt(packetHandle, "RoadSideInformation", newPath, value.moy.value);
    result = CheckLastError("RoadSideInformation", gkFuncRefGet, result);
  }
  else
  {
    if( C2xIsTokenAvailable(packetHandle, "RoadSideInformation", newPath) )
    {
      C2xRemoveToken(packetHandle, "RoadSideInformation", newPath);
    }
  }

  if(value.id.stringLength == 0)
  {
    value.id.stringLength = 8;
    memcpy(value.id.string, "00000000", value.id.stringLength);
  }

  snprintf(newPath, elcount(newPath), "%s.%s", oldPath, "id");
  C2xSetTokenData(packetHandle, "RoadSideInformation", newPath, value.id.stringLength, value.id.string);

  snprintf(newPath, elcount(newPath), "%s.%s", oldPath, "refPos");
  SetRoadSideInformationPosition3DParams(packetHandle, value.refPos, newPath);
  result = CheckLastError("RoadSideInformation", gkFuncRefGet, result);

  snprintf(newPath, elcount(newPath), "%s.%s", oldPath, "rtes");
  if(value.rtes.isValidFlag==1)
  {
    SetRoadSideInformationRTEListParams(packetHandle, value.rtes, newPath);
    result = CheckLastError("RoadSideInformation", gkFuncRefGet, result);
  }
  else
  {
    if( C2xIsTokenAvailable(packetHandle, "RoadSideInformation", newPath) )
    {
      C2xRemoveToken(packetHandle, "RoadSideInformation", newPath);
    }
  }

  snprintf(newPath, elcount(newPath), "%s.%s", oldPath, "rtss");
  if(value.rtss.isValidFlag==1)
  {
    SetRoadSideInformationRTSListParams(packetHandle, value.rtss, newPath);
    result = CheckLastError("RoadSideInformation", gkFuncRefGet, result);
  }
  else
  {
    if( C2xIsTokenAvailable(packetHandle, "RoadSideInformation", newPath) )
    {
      C2xRemoveToken(packetHandle, "RoadSideInformation", newPath);
    }
  }

  return result;
}

int API_GetRoadSideInformationParams(LONG packetHandle, struct RoadSideInformation value)
{
  int result;
  result = 0;

  value.frameType = C2xGetTokenInt(packetHandle, "RoadSideInformation", "frameType");
  result = CheckLastError("RoadSideInformation", gkFuncRefGet, result);

  value.rsiFrame.isValidFlag = 1;
  GetRoadSideInformationRSIFrameParams(packetHandle, value.rsiFrame, "rsiFrame");
  result = CheckLastError("RoadSideInformation", gkFuncRefGet, result);

  return result;
}

int API_SetRoadSideInformationParams(LONG packetHandle, struct RoadSideInformation value)
{
  int result;
  result = 0;

  value.frameType = 4;

  C2xSetTokenInt(packetHandle, "RoadSideInformation", "frameType", value.frameType);
  result = CheckLastError("RoadSideInformation", gkFuncRefGet, result);

  SetRoadSideInformationRSIFrameParams(packetHandle, value.rsiFrame, "rsiFrame");
  result = CheckLastError("RoadSideInformation", gkFuncRefGet, result);

  return result;
}

