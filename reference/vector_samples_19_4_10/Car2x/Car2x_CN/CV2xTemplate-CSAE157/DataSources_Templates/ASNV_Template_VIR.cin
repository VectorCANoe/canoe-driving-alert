/*@!Encoding:1252*/
/*
//  (c) Vector Informatik GmbH. All rights reserved.
//
//  This file contains definitions of structs and methods that may be used
//  to set and get the values of an ASN.1 defined packet's payload.
//
//  //This example demonstrates how to set a packet's payload:
//  LONG packetHandle;
//  struct VIR payload;
//  //you need to set the values of the variable "payload" yourself
//  packetHandle = API_InitVIRPacket();
//  if (packetHandle!=0) {
//    if (API_SetVIRParams(packetHandle, payload)==0) {
//      if (C2xCompletePacket(packetHandle)==0) {
//        C2xOutputPacket(packetHandle);
//      }
//    }
//  }
//                                                                             */
includes
{
}
variables
{
    struct VIRVehIntentionAndRequest_id {
        INT isValidFlag;   // necessary if this struct is used as an optional field of a SEQUENCE
        CHAR string[9];
        INT  stringLength;
    };
    
    struct VIRPosition3D {
        INT isValidFlag;   // necessary if this struct is used as an optional field of a SEQUENCE
        LONG lat;  // INTEGER, -900000000..900000001;
        LONG lon;  // INTEGER, -1799999999..1800000001;
        struct OPT_LONG_ASN elevation;  // INTEGER, OPTIONAL, -4096..61439;
    };
    
    struct VIRNodeReferenceID {
        INT isValidFlag;   // necessary if this struct is used as an optional field of a SEQUENCE
        struct OPT_WORD_ASN region;  // INTEGER, OPTIONAL, 0..65535;
        WORD id;  // INTEGER, 0..65535;
    };
    
    struct VIRReferenceLanes {
        INT isValidFlag;   // necessary if this struct is used as an optional field of a SEQUENCE
        CHAR string[17];
        INT  stringLength;
    };
    
    struct VIRReferenceLink {
        INT isValidFlag;   // necessary if this struct is used as an optional field of a SEQUENCE
        struct VIRNodeReferenceID upstreamNodeId;  // SEQUENCE;
        struct VIRNodeReferenceID downstreamNodeId;  // SEQUENCE;
        struct VIRReferenceLanes referenceLanes;  // BITSTRING, OPTIONAL;
    };
    
    struct VIRPosition_LL_24B {
        INT isValidFlag;   // necessary if this struct is used as an optional field of a SEQUENCE
        INT lon;  // INTEGER, -2048..2047;
        INT lat;  // INTEGER, -2048..2047;
    };
    
    struct VIRPosition_LL_28B {
        INT isValidFlag;   // necessary if this struct is used as an optional field of a SEQUENCE
        INT lon;  // INTEGER, -8192..8191;
        INT lat;  // INTEGER, -8192..8191;
    };
    
    struct VIRPosition_LL_32B {
        INT isValidFlag;   // necessary if this struct is used as an optional field of a SEQUENCE
        INT lon;  // INTEGER, -32768..32767;
        INT lat;  // INTEGER, -32768..32767;
    };
    
    struct VIRPosition_LL_36B {
        INT isValidFlag;   // necessary if this struct is used as an optional field of a SEQUENCE
        LONG lon;  // INTEGER, -131072..131071;
        LONG lat;  // INTEGER, -131072..131071;
    };
    
    struct VIRPosition_LL_44B {
        INT isValidFlag;   // necessary if this struct is used as an optional field of a SEQUENCE
        LONG lon;  // INTEGER, -2097152..2097151;
        LONG lat;  // INTEGER, -2097152..2097151;
    };
    
    struct VIRPosition_LL_48B {
        INT isValidFlag;   // necessary if this struct is used as an optional field of a SEQUENCE
        LONG lon;  // INTEGER, -8388608..8388607;
        LONG lat;  // INTEGER, -8388608..8388607;
    };
    
    struct VIRPosition_LLmD_64b {
        INT isValidFlag;   // necessary if this struct is used as an optional field of a SEQUENCE
        LONG lon;  // INTEGER, -1799999999..1800000001;
        LONG lat;  // INTEGER, -900000000..900000001;
    };
    
    struct VIRPositionOffsetLL {
        INT isValidFlag;   // necessary if this struct is used as an optional field of a SEQUENCE
        INT choice;
        struct VIRPosition_LL_24B position_LL1;  // SEQUENCE;
        struct VIRPosition_LL_28B position_LL2;  // SEQUENCE;
        struct VIRPosition_LL_32B position_LL3;  // SEQUENCE;
        struct VIRPosition_LL_36B position_LL4;  // SEQUENCE;
        struct VIRPosition_LL_44B position_LL5;  // SEQUENCE;
        struct VIRPosition_LL_48B position_LL6;  // SEQUENCE;
        struct VIRPosition_LLmD_64b position_LatLon;  // SEQUENCE;
    };
    
    struct VIRVerticalOffset {
        INT isValidFlag;   // necessary if this struct is used as an optional field of a SEQUENCE
        INT choice;
        INT offset1;  // INTEGER, -64..63;
        INT offset2;  // INTEGER, -128..127;
        INT offset3;  // INTEGER, -256..255;
        INT offset4;  // INTEGER, -512..511;
        INT offset5;  // INTEGER, -1024..1023;
        INT offset6;  // INTEGER, -2048..2047;
        LONG elevation;  // INTEGER, -4096..61439;
    };
    
    struct VIRPositionOffsetLLV {
        INT isValidFlag;   // necessary if this struct is used as an optional field of a SEQUENCE
        struct VIRPositionOffsetLL offsetLL;  // CHOICE;
        struct VIRVerticalOffset offsetV;  // CHOICE, OPTIONAL;
    };
    
    struct VIRPositionConfidenceSet {
        INT isValidFlag;   // necessary if this struct is used as an optional field of a SEQUENCE
        INT pos;  // ENUMERATED, unavailable(0), a500m(1), a200m(2), a100m(3), a50m(4), a20m(5), a10m(6), a5m(7), a2m(8), a1m(9), a50cm(10), a20cm(11), a10cm(12), a5cm(13), a2cm(14), a1cm(15);
        struct OPT_ENUM_ASN elevation;  // ENUMERATED, OPTIONAL, unavailable(0), elev_500_00(1), elev_200_00(2), elev_100_00(3), elev_050_00(4), elev_020_00(5), elev_010_00(6), elev_005_00(7), elev_002_00(8), elev_001_00(9), elev_000_50(10), elev_000_20(11), elev_000_10(12), elev_000_05(13), elev_000_02(14), elev_000_01(15);
    };
    
    struct VIRAccelerationSet4Way {
        INT isValidFlag;   // necessary if this struct is used as an optional field of a SEQUENCE
        INT lon;  // INTEGER, -2000..2001;
        INT lat;  // INTEGER, -2000..2001;
        INT vert;  // INTEGER, -127..127;
        INT yaw;  // INTEGER, -32767..32767;
    };
    
    struct VIRAccSet4WayConfidence {
        INT isValidFlag;   // necessary if this struct is used as an optional field of a SEQUENCE
        INT lonAccConfidence;  // ENUMERATED, unavailable(0), prec100deg(1), prec10deg(2), prec5deg(3), prec1deg(4), prec0_1deg(5), prec0_05deg(6), prec0_01deg(7);
        INT latAccConfidence;  // ENUMERATED, unavailable(0), prec100deg(1), prec10deg(2), prec5deg(3), prec1deg(4), prec0_1deg(5), prec0_05deg(6), prec0_01deg(7);
        INT vertAccConfidence;  // ENUMERATED, unavailable(0), prec100deg(1), prec10deg(2), prec5deg(3), prec1deg(4), prec0_1deg(5), prec0_05deg(6), prec0_01deg(7);
        INT yawRateCon;  // ENUMERATED, unavailable(0), prec100deg(1), prec10deg(2), prec5deg(3), prec1deg(4), prec0_1deg(5), prec0_05deg(6), prec0_01deg(7);
    };
    
    struct VIRPathPlanningPoint {
        INT isValidFlag;   // necessary if this struct is used as an optional field of a SEQUENCE
        struct VIRReferenceLink posInMap;  // SEQUENCE, OPTIONAL;
        struct VIRPositionOffsetLLV pos;  // SEQUENCE;
        struct VIRPositionConfidenceSet posAccuracy;  // SEQUENCE, OPTIONAL;
        struct OPT_WORD_ASN speed;  // INTEGER, OPTIONAL, 0..8191;
        struct OPT_ENUM_ASN speedCfd;  // ENUMERATED, OPTIONAL, unavailable(0), prec100ms(1), prec10ms(2), prec5ms(3), prec1ms(4), prec0_1ms(5), prec0_05ms(6), prec0_01ms(7);
        struct OPT_WORD_ASN heading;  // INTEGER, OPTIONAL, 0..28800;
        struct OPT_ENUM_ASN headingCfd;  // ENUMERATED, OPTIONAL, unavailable(0), prec10deg(1), prec05deg(2), prec01deg(3), prec0_1deg(4), prec0_05deg(5), prec0_01deg(6), prec0_0125deg(7);
        struct VIRAccelerationSet4Way accelSet;  // SEQUENCE, OPTIONAL;
        struct VIRAccSet4WayConfidence acc4WayConfidence;  // SEQUENCE, OPTIONAL;
        struct OPT_WORD_ASN estimatedTime;  // INTEGER, OPTIONAL, 1..65535;
        struct OPT_BYTE_ASN timeConfidence;  // INTEGER, OPTIONAL, 0..200;
    };
    
    struct VIRPathPlanning {
        INT isValidFlag;   // necessary if this struct is used as an optional field of a SEQUENCE
        INT length;
        struct VIRPathPlanningPoint arrayValue[100];  // SEQUENCE;
    };
    
    struct VIRDriveBehavior {
        INT isValidFlag;   // necessary if this struct is used as an optional field of a SEQUENCE
        CHAR string[15];
        INT  stringLength;
    };
    
    struct VIRDriveRequest_reqPriority {
        INT isValidFlag;   // necessary if this struct is used as an optional field of a SEQUENCE
        CHAR string[2];
        INT  stringLength;
    };
    
    struct VIRDriveRequest_targetVeh {
        INT isValidFlag;   // necessary if this struct is used as an optional field of a SEQUENCE
        CHAR string[9];
        INT  stringLength;
    };
    
    struct VIRDriveRequest_targetRSU {
        INT isValidFlag;   // necessary if this struct is used as an optional field of a SEQUENCE
        CHAR string[9];
        INT  stringLength;
    };
    
    struct VIRReq_LaneChange {
        INT isValidFlag;   // necessary if this struct is used as an optional field of a SEQUENCE
        struct VIRNodeReferenceID upstreamNode;  // SEQUENCE;
        struct VIRNodeReferenceID downstreamNode;  // SEQUENCE;
        BYTE targetLane;  // INTEGER, 0..255;
    };
    
    struct VIRPathPointList {
        INT isValidFlag;   // necessary if this struct is used as an optional field of a SEQUENCE
        INT length;
        struct VIRPositionOffsetLLV arrayValue[32];  // SEQUENCE;
    };
    
    struct VIRReferencePath {
        INT isValidFlag;   // necessary if this struct is used as an optional field of a SEQUENCE
        struct VIRPathPointList activePath;  // SEQUENCEOF;
        WORD pathRadius;  // INTEGER, 0..65535;
    };
    
    struct VIRDDateTime {
        INT isValidFlag;   // necessary if this struct is used as an optional field of a SEQUENCE
        struct OPT_WORD_ASN year;  // INTEGER, OPTIONAL, 0..4095;
        struct OPT_BYTE_ASN month;  // INTEGER, OPTIONAL, 0..12;
        struct OPT_BYTE_ASN day;  // INTEGER, OPTIONAL, 0..31;
        struct OPT_BYTE_ASN hour;  // INTEGER, OPTIONAL, 0..24;
        struct OPT_BYTE_ASN minute;  // INTEGER, OPTIONAL, 0..60;
        struct OPT_WORD_ASN second;  // INTEGER, OPTIONAL, 0..65535;
        struct OPT_INT_ASN offset;  // INTEGER, OPTIONAL, -720..721;
    };
    
    struct VIRReq_ClearTheWay {
        INT isValidFlag;   // necessary if this struct is used as an optional field of a SEQUENCE
        struct VIRNodeReferenceID upstreamNode;  // SEQUENCE;
        struct VIRNodeReferenceID downstreamNode;  // SEQUENCE;
        BYTE targetLane;  // INTEGER, 0..255;
        struct VIRReferencePath relatedPath;  // SEQUENCE, OPTIONAL;
        struct VIRDDateTime tBegin;  // SEQUENCE, OPTIONAL;
        struct VIRDDateTime tEnd;  // SEQUENCE, OPTIONAL;
    };
    
    struct VIRMovementEx {
        INT isValidFlag;   // necessary if this struct is used as an optional field of a SEQUENCE
        struct VIRNodeReferenceID remoteIntersection;  // SEQUENCE;
        struct OPT_BYTE_ASN phaseId;  // INTEGER, OPTIONAL, 0..255;
        struct OPT_ENUM_ASN turn_direction;  // ENUMERATED, OPTIONAL, maneuverStraight(0), maneuverLeftTurn(1), maneuverRightTurn(2), maneuverUTurn(3);
    };
    
    struct VIRReq_SignalPriority {
        INT isValidFlag;   // necessary if this struct is used as an optional field of a SEQUENCE
        struct VIRNodeReferenceID intersectionId;  // SEQUENCE;
        struct VIRMovementEx requiredMov;  // SEQUENCE;
        struct OPT_WORD_ASN estimatedArrivalTime;  // INTEGER, OPTIONAL, 1..65535;
        struct OPT_WORD_ASN distance2Intersection;  // INTEGER, OPTIONAL, 0..10000;
    };
    
    struct VIRReferencePathList {
        INT isValidFlag;   // necessary if this struct is used as an optional field of a SEQUENCE
        INT length;
        struct VIRReferencePath arrayValue[8];  // SEQUENCE;
    };
    
    struct VIRReq_SensorSharing {
        INT isValidFlag;   // necessary if this struct is used as an optional field of a SEQUENCE
        struct VIRReferencePathList detectArea;  // SEQUENCEOF;
    };
    
    struct VIRVehicleClassification {
        INT isValidFlag;   // necessary if this struct is used as an optional field of a SEQUENCE
        BYTE classification;  // INTEGER, 0..255, unknownVehicleClass(0), specialVehicleClass(1), passenger_Vehicle_TypeUnknown(10), passenger_Vehicle_TypeOther(11), lightTruck_Vehicle_TypeUnknown(20), lightTruck_Vehicle_TypeOther(21), truck_Vehicle_TypeUnknown(25), truck_Vehicle_TypeOther(26), truck_axleCnt2(27), truck_axleCnt3(28), truck_axleCnt4(29), truck_axleCnt4Trailer(30), truck_axleCnt5Trailer(31), truck_axleCnt6Trailer(32), truck_axleCnt5MultiTrailer(33), truck_axleCnt6MultiTrailer(34), truck_axleCnt7MultiTrailer(35), motorcycle_TypeUnknown(40), motorcycle_TypeOther(41), motorcycle_Cruiser_Standard(42), motorcycle_SportUnclad(43), motorcycle_SportTouring(44), motorcycle_SuperSport(45), motorcycle_Touring(46), motorcycle_Trike(47), motorcycle_wPassengers(48), transit_TypeUnknown(50), transit_TypeOther(51), transit_BRT(52), transit_ExpressBus(53), transit_LocalBus(54), transit_SchoolBus(55), transit_FixedGuideway(56), transit_Paratransit(57), transit_Paratransit_Ambulance(58), emergency_TypeUnknown(60), emergency_TypeOther(61), emergency_Fire_Light_Vehicle(62), emergency_Fire_Heavy_Vehicle(63), emergency_Fire_Paramedic_Vehicle(64), emergency_Fire_Ambulance_Vehicle(65), emergency_Police_Light_Vehicle(66), emergency_Police_Heavy_Vehicle(67), emergency_Other_Responder(68), emergency_Other_Ambulance(69), otherTraveler_TypeUnknown(80), otherTraveler_TypeOther(81), otherTraveler_Pedestrian(82), otherTraveler_Visually_Disabled(83), otherTraveler_Physically_Disabled(84), otherTraveler_Bicycle(85), otherTraveler_Vulnerable_Roadworker(86), infrastructure_TypeUnknown(90), infrastructure_Fixed(91), infrastructure_Movable(92), equipped_CargoTrailer(93);
        struct OPT_BYTE_ASN fuelType;  // INTEGER, OPTIONAL, 0..15, unknownFuel(0), gasoline(1), ethanol(2), diesel(3), electric(4), hybrid(5), hydrogen(6), natGasLiquid(7), natGasComp(8), propane(9);
    };
    
    struct VIRParkingRequest {
        INT isValidFlag;   // necessary if this struct is used as an optional field of a SEQUENCE
        CHAR string[13];
        INT  stringLength;
    };
    
    struct VIRParkingType {
        INT isValidFlag;   // necessary if this struct is used as an optional field of a SEQUENCE
        CHAR string[11];
        INT  stringLength;
    };
    
    struct VIRReq_ParkingArea {
        INT isValidFlag;   // necessary if this struct is used as an optional field of a SEQUENCE
        struct VIRVehicleClassification vehicleClass;  // SEQUENCE;
        struct VIRParkingRequest req;  // BITSTRING;
        struct VIRParkingType parkingType;  // BITSTRING, OPTIONAL;
        struct OPT_WORD_ASN expectedParkingSlotID;  // INTEGER, OPTIONAL, 0..65535;
    };
    
    struct VIRReqInfo {
        INT isValidFlag;   // necessary if this struct is used as an optional field of a SEQUENCE
        INT choice;
        struct VIRReq_LaneChange laneChange;  // SEQUENCE;
        struct VIRReq_ClearTheWay clearTheWay;  // SEQUENCE;
        struct VIRReq_SignalPriority signalPriority;  // SEQUENCE;
        struct VIRReq_SensorSharing sensorSharing;  // SEQUENCE;
        struct VIRReq_ParkingArea parking;  // SEQUENCE;
    };
    
    struct VIRDriveRequest {
        INT isValidFlag;   // necessary if this struct is used as an optional field of a SEQUENCE
        BYTE reqID;  // INTEGER, 0..255;
        INT status;  // ENUMERATED, unknown(0), request(1), comfirmed(2), cancel(3), complete(4);
        struct VIRDriveRequest_reqPriority reqPriority;  // OCTETSTRING, OPTIONAL;
        struct VIRDriveRequest_targetVeh targetVeh;  // OCTETSTRING, OPTIONAL;
        struct VIRDriveRequest_targetRSU targetRSU;  // OCTETSTRING, OPTIONAL;
        struct VIRReqInfo info;  // CHOICE, OPTIONAL;
        struct OPT_WORD_ASN lifeTime;  // INTEGER, OPTIONAL, 1..65535;
    };
    
    struct VIRIARData_reqs {
        INT isValidFlag;   // necessary if this struct is used as an optional field of a SEQUENCE
        INT length;
        struct VIRDriveRequest arrayValue[8];  // SEQUENCE;
    };
    
    struct VIRIARData {
        INT isValidFlag;   // necessary if this struct is used as an optional field of a SEQUENCE
        struct VIRPathPlanningPoint currentPos;  // SEQUENCE, OPTIONAL;
        struct VIRPathPlanning path_Planning;  // SEQUENCEOF, OPTIONAL;
        struct VIRDriveBehavior currentBehavior;  // BITSTRING, OPTIONAL;
        struct VIRIARData_reqs reqs;  // SEQUENCEOF, OPTIONAL;
    };
    
    struct VIRVehIntentionAndRequest {
        INT isValidFlag;   // necessary if this struct is used as an optional field of a SEQUENCE
        BYTE msgCnt;  // INTEGER, 0..127;
        struct VIRVehIntentionAndRequest_id id;  // OCTETSTRING;
        WORD secMark;  // INTEGER, 0..65535;
        struct VIRPosition3D refPos;  // SEQUENCE;
        struct VIRIARData intAndReq;  // SEQUENCE;
    };
    
    struct VIRMessageTypes {
        struct VIRVehIntentionAndRequest virData;  // SEQUENCE;
    };
    
    struct VIRMessageFrameExt {
        INT isValidFlag;   // necessary if this struct is used as an optional field of a SEQUENCE
        WORD messageId;  // INTEGER, 0..32767;
        struct VIRMessageTypes value;  // TABLE;
    };
    
    struct VIR {
        INT isValidFlag;   // necessary if this struct is used as an optional field of a SEQUENCE
        INT choice;
        struct VIRMessageFrameExt msgFrameExt;  // SEQUENCE;
    };
    
}

/*
// init function to create a simple packet handle
*/ 
LONG API_InitVIRPacket()
{
  return C2xInitPacket("VIR"); 
}

/*
// init function to create a simple packet handle and
// initialize the struct with valid data
*/ 
LONG API_InitVIRPacket(struct VIR msgStruct)
{
  long pktHandle;

  pktHandle = API_InitVIRPacket();

  if (pktHandle != 0)
  {
    // create valid message and application data
    if (C2xCompletePacket(pktHandle) == 0) 
    {
      API_GetVIRParams(pktHandle, msgStruct);
    }
  }
  return pktHandle;
}

/*
// init function to create a packet with security layer and
// initialize the struct with valid data
*/ 
LONG API_InitVIRPacket(struct VIR msgStruct, char packetTypeDesignator[], char certificateName[])
{
  long pktHandle, certHdl;

  // initialize the packet
  pktHandle = C2xInitPacket("VIR", packetTypeDesignator);

  if (pktHandle != 0)
  {
    certHdl = C2xSecCertificateGetHandle(certificateName);  // get the certificate handle for the cert with name "certificateName"
    if (certHdl != 0) 
    {
      C2xSecPacketSetSignerHandle(pktHandle, certHdl); // set the certHdl to the packet
    }

    // create valid message and application data
    if (C2xCompletePacket(pktHandle) == 0) 
    {
      // copy application data to the application structure
      API_GetVIRParams(pktHandle, msgStruct);
    }
  }
  return pktHandle;
}
    

int GetVIRPosition3DParams(LONG packetHandle, struct VIRPosition3D value, char oldPath[])
{
  char newPath[300];
  int result;

  result = 0;

  snprintf(newPath, elcount(newPath), "%s.%s", oldPath, "lat");
  value.lat = C2xGetTokenInt(packetHandle, "VIR", newPath);
  result = CheckLastError("VIR", gkFuncRefGet, result);

  snprintf(newPath, elcount(newPath), "%s.%s", oldPath, "lon");
  value.lon = C2xGetTokenInt(packetHandle, "VIR", newPath);
  result = CheckLastError("VIR", gkFuncRefGet, result);

  snprintf(newPath, elcount(newPath), "%s.%s", oldPath, "elevation");
  value.elevation.isValidFlag = C2xIsTokenAvailable(packetHandle, "VIR", newPath);
  if(value.elevation.isValidFlag==1)
  {
    value.elevation.value = C2xGetTokenInt(packetHandle, "VIR", newPath);
    result = CheckLastError("VIR", gkFuncRefGet, result);
  }
  return result;
}

int SetVIRPosition3DParams(LONG packetHandle, struct VIRPosition3D value, char oldPath[])
{
  char newPath[300];
  int result;

  result = 0;

  snprintf(newPath, elcount(newPath), "%s.%s", oldPath, "lat");
  C2xSetTokenInt(packetHandle, "VIR", newPath, value.lat);
  result = CheckLastError("VIR", gkFuncRefGet, result);

  snprintf(newPath, elcount(newPath), "%s.%s", oldPath, "lon");
  C2xSetTokenInt(packetHandle, "VIR", newPath, value.lon);
  result = CheckLastError("VIR", gkFuncRefGet, result);

  snprintf(newPath, elcount(newPath), "%s.%s", oldPath, "elevation");
  if(value.elevation.isValidFlag==1)
  {
    C2xSetTokenInt(packetHandle, "VIR", newPath, value.elevation.value);
    result = CheckLastError("VIR", gkFuncRefGet, result);
  }
  else
  {
    if( C2xIsTokenAvailable(packetHandle, "VIR", newPath) )
    {
      C2xRemoveToken(packetHandle, "VIR", newPath);
    }
  }

  return result;
}

int GetVIRNodeReferenceIDParams(LONG packetHandle, struct VIRNodeReferenceID value, char oldPath[])
{
  char newPath[300];
  int result;

  result = 0;

  snprintf(newPath, elcount(newPath), "%s.%s", oldPath, "region");
  value.region.isValidFlag = C2xIsTokenAvailable(packetHandle, "VIR", newPath);
  if(value.region.isValidFlag==1)
  {
    value.region.value = C2xGetTokenInt(packetHandle, "VIR", newPath);
    result = CheckLastError("VIR", gkFuncRefGet, result);
  }
  snprintf(newPath, elcount(newPath), "%s.%s", oldPath, "id");
  value.id = C2xGetTokenInt(packetHandle, "VIR", newPath);
  result = CheckLastError("VIR", gkFuncRefGet, result);

  return result;
}

int SetVIRNodeReferenceIDParams(LONG packetHandle, struct VIRNodeReferenceID value, char oldPath[])
{
  char newPath[300];
  int result;

  result = 0;

  snprintf(newPath, elcount(newPath), "%s.%s", oldPath, "region");
  if(value.region.isValidFlag==1)
  {
    C2xSetTokenInt(packetHandle, "VIR", newPath, value.region.value);
    result = CheckLastError("VIR", gkFuncRefGet, result);
  }
  else
  {
    if( C2xIsTokenAvailable(packetHandle, "VIR", newPath) )
    {
      C2xRemoveToken(packetHandle, "VIR", newPath);
    }
  }

  snprintf(newPath, elcount(newPath), "%s.%s", oldPath, "id");
  C2xSetTokenInt(packetHandle, "VIR", newPath, value.id);
  result = CheckLastError("VIR", gkFuncRefGet, result);

  return result;
}

int GetVIRReferenceLinkParams(LONG packetHandle, struct VIRReferenceLink value, char oldPath[])
{
  char newPath[300]; 
  int j; 
  int k;
  int result;

  result = 0;

  snprintf(newPath, elcount(newPath), "%s.%s", oldPath, "upstreamNodeId");
  GetVIRNodeReferenceIDParams(packetHandle, value.upstreamNodeId, newPath);
  result = CheckLastError("VIR", gkFuncRefGet, result);

  snprintf(newPath, elcount(newPath), "%s.%s", oldPath, "downstreamNodeId");
  GetVIRNodeReferenceIDParams(packetHandle, value.downstreamNodeId, newPath);
  result = CheckLastError("VIR", gkFuncRefGet, result);

  snprintf(newPath, elcount(newPath), "%s.%s", oldPath, "referenceLanes");
  value.referenceLanes.isValidFlag = C2xIsTokenAvailable(packetHandle, "VIR", newPath);
  if(value.referenceLanes.isValidFlag==1)
  {
    value.referenceLanes.isValidFlag = 1;
    value.referenceLanes.stringLength = C2xGetTokenLengthBit(packetHandle, "VIR", newPath);
    if ((result = CheckLastError("VIR", gkFuncRefGet, result))==0)
    {
      if(value.referenceLanes.stringLength > 0)
      {
        for(j=0; j<value.referenceLanes.stringLength; j++)
        {
          if(C2xGetTokenBitOfBitString(packetHandle, "VIR", newPath, j) == 0)
          {
            value.referenceLanes.string[j] = '0';
          }
          else if(C2xGetTokenBitOfBitString(packetHandle, "VIR", newPath, j) == 1)
          {
            value.referenceLanes.string[j] = '1';
          }

          if(value.referenceLanes.stringLength == 1)
          {
            value.referenceLanes.string[1] = '0';
          }
          result = CheckLastError("VIR", gkFuncRefGet, result);
        }
      }
      else
      {
        for(k = value.referenceLanes.stringLength+1; k > -1; k--)
        {
          if(value.referenceLanes.string[k] == '1')
          {
            value.referenceLanes.string[k] = '0';
          }
        }
      }
    }

  }
  return result;
}

int SetVIRReferenceLinkParams(LONG packetHandle, struct VIRReferenceLink value, char oldPath[])
{
  char newPath[300]; 
  int j;
  int result;

  result = 0;

  snprintf(newPath, elcount(newPath), "%s.%s", oldPath, "upstreamNodeId");
  SetVIRNodeReferenceIDParams(packetHandle, value.upstreamNodeId, newPath);
  result = CheckLastError("VIR", gkFuncRefGet, result);

  snprintf(newPath, elcount(newPath), "%s.%s", oldPath, "downstreamNodeId");
  SetVIRNodeReferenceIDParams(packetHandle, value.downstreamNodeId, newPath);
  result = CheckLastError("VIR", gkFuncRefGet, result);

  snprintf(newPath, elcount(newPath), "%s.%s", oldPath, "referenceLanes");
  if(value.referenceLanes.isValidFlag==1)
  {
      for(j=0; j<value.referenceLanes.stringLength; j++)
      {
        if(value.referenceLanes.string[j] == '0')
        {
          C2xSetTokenBitOfBitString(packetHandle, "VIR", newPath, j, 0);
        }
        else
        {
          C2xSetTokenBitOfBitString(packetHandle, "VIR", newPath, j, 1);
        }
        result = CheckLastError("VIR", gkFuncRefGet, result);
      }
  }
  else
  {
    if( C2xIsTokenAvailable(packetHandle, "VIR", newPath) )
    {
      C2xRemoveToken(packetHandle, "VIR", newPath);
    }
  }

  return result;
}

int GetVIRPosition_LL_24BParams(LONG packetHandle, struct VIRPosition_LL_24B value, char oldPath[])
{
  char newPath[300];
  int result;

  result = 0;

  snprintf(newPath, elcount(newPath), "%s.%s", oldPath, "lon");
  value.lon = C2xGetTokenInt(packetHandle, "VIR", newPath);
  result = CheckLastError("VIR", gkFuncRefGet, result);

  snprintf(newPath, elcount(newPath), "%s.%s", oldPath, "lat");
  value.lat = C2xGetTokenInt(packetHandle, "VIR", newPath);
  result = CheckLastError("VIR", gkFuncRefGet, result);

  return result;
}

int SetVIRPosition_LL_24BParams(LONG packetHandle, struct VIRPosition_LL_24B value, char oldPath[])
{
  char newPath[300];
  int result;

  result = 0;

  snprintf(newPath, elcount(newPath), "%s.%s", oldPath, "lon");
  C2xSetTokenInt(packetHandle, "VIR", newPath, value.lon);
  result = CheckLastError("VIR", gkFuncRefGet, result);

  snprintf(newPath, elcount(newPath), "%s.%s", oldPath, "lat");
  C2xSetTokenInt(packetHandle, "VIR", newPath, value.lat);
  result = CheckLastError("VIR", gkFuncRefGet, result);

  return result;
}

int GetVIRPosition_LL_28BParams(LONG packetHandle, struct VIRPosition_LL_28B value, char oldPath[])
{
  char newPath[300];
  int result;

  result = 0;

  snprintf(newPath, elcount(newPath), "%s.%s", oldPath, "lon");
  value.lon = C2xGetTokenInt(packetHandle, "VIR", newPath);
  result = CheckLastError("VIR", gkFuncRefGet, result);

  snprintf(newPath, elcount(newPath), "%s.%s", oldPath, "lat");
  value.lat = C2xGetTokenInt(packetHandle, "VIR", newPath);
  result = CheckLastError("VIR", gkFuncRefGet, result);

  return result;
}

int SetVIRPosition_LL_28BParams(LONG packetHandle, struct VIRPosition_LL_28B value, char oldPath[])
{
  char newPath[300];
  int result;

  result = 0;

  snprintf(newPath, elcount(newPath), "%s.%s", oldPath, "lon");
  C2xSetTokenInt(packetHandle, "VIR", newPath, value.lon);
  result = CheckLastError("VIR", gkFuncRefGet, result);

  snprintf(newPath, elcount(newPath), "%s.%s", oldPath, "lat");
  C2xSetTokenInt(packetHandle, "VIR", newPath, value.lat);
  result = CheckLastError("VIR", gkFuncRefGet, result);

  return result;
}

int GetVIRPosition_LL_32BParams(LONG packetHandle, struct VIRPosition_LL_32B value, char oldPath[])
{
  char newPath[300];
  int result;

  result = 0;

  snprintf(newPath, elcount(newPath), "%s.%s", oldPath, "lon");
  value.lon = C2xGetTokenInt(packetHandle, "VIR", newPath);
  result = CheckLastError("VIR", gkFuncRefGet, result);

  snprintf(newPath, elcount(newPath), "%s.%s", oldPath, "lat");
  value.lat = C2xGetTokenInt(packetHandle, "VIR", newPath);
  result = CheckLastError("VIR", gkFuncRefGet, result);

  return result;
}

int SetVIRPosition_LL_32BParams(LONG packetHandle, struct VIRPosition_LL_32B value, char oldPath[])
{
  char newPath[300];
  int result;

  result = 0;

  snprintf(newPath, elcount(newPath), "%s.%s", oldPath, "lon");
  C2xSetTokenInt(packetHandle, "VIR", newPath, value.lon);
  result = CheckLastError("VIR", gkFuncRefGet, result);

  snprintf(newPath, elcount(newPath), "%s.%s", oldPath, "lat");
  C2xSetTokenInt(packetHandle, "VIR", newPath, value.lat);
  result = CheckLastError("VIR", gkFuncRefGet, result);

  return result;
}

int GetVIRPosition_LL_36BParams(LONG packetHandle, struct VIRPosition_LL_36B value, char oldPath[])
{
  char newPath[300];
  int result;

  result = 0;

  snprintf(newPath, elcount(newPath), "%s.%s", oldPath, "lon");
  value.lon = C2xGetTokenInt(packetHandle, "VIR", newPath);
  result = CheckLastError("VIR", gkFuncRefGet, result);

  snprintf(newPath, elcount(newPath), "%s.%s", oldPath, "lat");
  value.lat = C2xGetTokenInt(packetHandle, "VIR", newPath);
  result = CheckLastError("VIR", gkFuncRefGet, result);

  return result;
}

int SetVIRPosition_LL_36BParams(LONG packetHandle, struct VIRPosition_LL_36B value, char oldPath[])
{
  char newPath[300];
  int result;

  result = 0;

  snprintf(newPath, elcount(newPath), "%s.%s", oldPath, "lon");
  C2xSetTokenInt(packetHandle, "VIR", newPath, value.lon);
  result = CheckLastError("VIR", gkFuncRefGet, result);

  snprintf(newPath, elcount(newPath), "%s.%s", oldPath, "lat");
  C2xSetTokenInt(packetHandle, "VIR", newPath, value.lat);
  result = CheckLastError("VIR", gkFuncRefGet, result);

  return result;
}

int GetVIRPosition_LL_44BParams(LONG packetHandle, struct VIRPosition_LL_44B value, char oldPath[])
{
  char newPath[300];
  int result;

  result = 0;

  snprintf(newPath, elcount(newPath), "%s.%s", oldPath, "lon");
  value.lon = C2xGetTokenInt(packetHandle, "VIR", newPath);
  result = CheckLastError("VIR", gkFuncRefGet, result);

  snprintf(newPath, elcount(newPath), "%s.%s", oldPath, "lat");
  value.lat = C2xGetTokenInt(packetHandle, "VIR", newPath);
  result = CheckLastError("VIR", gkFuncRefGet, result);

  return result;
}

int SetVIRPosition_LL_44BParams(LONG packetHandle, struct VIRPosition_LL_44B value, char oldPath[])
{
  char newPath[300];
  int result;

  result = 0;

  snprintf(newPath, elcount(newPath), "%s.%s", oldPath, "lon");
  C2xSetTokenInt(packetHandle, "VIR", newPath, value.lon);
  result = CheckLastError("VIR", gkFuncRefGet, result);

  snprintf(newPath, elcount(newPath), "%s.%s", oldPath, "lat");
  C2xSetTokenInt(packetHandle, "VIR", newPath, value.lat);
  result = CheckLastError("VIR", gkFuncRefGet, result);

  return result;
}

int GetVIRPosition_LL_48BParams(LONG packetHandle, struct VIRPosition_LL_48B value, char oldPath[])
{
  char newPath[300];
  int result;

  result = 0;

  snprintf(newPath, elcount(newPath), "%s.%s", oldPath, "lon");
  value.lon = C2xGetTokenInt(packetHandle, "VIR", newPath);
  result = CheckLastError("VIR", gkFuncRefGet, result);

  snprintf(newPath, elcount(newPath), "%s.%s", oldPath, "lat");
  value.lat = C2xGetTokenInt(packetHandle, "VIR", newPath);
  result = CheckLastError("VIR", gkFuncRefGet, result);

  return result;
}

int SetVIRPosition_LL_48BParams(LONG packetHandle, struct VIRPosition_LL_48B value, char oldPath[])
{
  char newPath[300];
  int result;

  result = 0;

  snprintf(newPath, elcount(newPath), "%s.%s", oldPath, "lon");
  C2xSetTokenInt(packetHandle, "VIR", newPath, value.lon);
  result = CheckLastError("VIR", gkFuncRefGet, result);

  snprintf(newPath, elcount(newPath), "%s.%s", oldPath, "lat");
  C2xSetTokenInt(packetHandle, "VIR", newPath, value.lat);
  result = CheckLastError("VIR", gkFuncRefGet, result);

  return result;
}

int GetVIRPosition_LLmD_64bParams(LONG packetHandle, struct VIRPosition_LLmD_64b value, char oldPath[])
{
  char newPath[300];
  int result;

  result = 0;

  snprintf(newPath, elcount(newPath), "%s.%s", oldPath, "lon");
  value.lon = C2xGetTokenInt(packetHandle, "VIR", newPath);
  result = CheckLastError("VIR", gkFuncRefGet, result);

  snprintf(newPath, elcount(newPath), "%s.%s", oldPath, "lat");
  value.lat = C2xGetTokenInt(packetHandle, "VIR", newPath);
  result = CheckLastError("VIR", gkFuncRefGet, result);

  return result;
}

int SetVIRPosition_LLmD_64bParams(LONG packetHandle, struct VIRPosition_LLmD_64b value, char oldPath[])
{
  char newPath[300];
  int result;

  result = 0;

  snprintf(newPath, elcount(newPath), "%s.%s", oldPath, "lon");
  C2xSetTokenInt(packetHandle, "VIR", newPath, value.lon);
  result = CheckLastError("VIR", gkFuncRefGet, result);

  snprintf(newPath, elcount(newPath), "%s.%s", oldPath, "lat");
  C2xSetTokenInt(packetHandle, "VIR", newPath, value.lat);
  result = CheckLastError("VIR", gkFuncRefGet, result);

  return result;
}

int GetVIRPositionOffsetLLParams(LONG packetHandle, struct VIRPositionOffsetLL value, char oldPath[])
{
  char newPath[300];
  int result;

  result = 0;

  value.choice = C2xGetTokenInt(packetHandle, "VIR", oldPath);

  switch(value.choice)
  {
    case 0:
    {
      snprintf(newPath, elcount(newPath), "%s.%s", oldPath, "position_LL1");
      GetVIRPosition_LL_24BParams(packetHandle, value.position_LL1, newPath);
      result = CheckLastError("VIR", gkFuncRefGet, result);
    }
    break;
    case 1:
    {
      snprintf(newPath, elcount(newPath), "%s.%s", oldPath, "position_LL2");
      GetVIRPosition_LL_28BParams(packetHandle, value.position_LL2, newPath);
      result = CheckLastError("VIR", gkFuncRefGet, result);
    }
    break;
    case 2:
    {
      snprintf(newPath, elcount(newPath), "%s.%s", oldPath, "position_LL3");
      GetVIRPosition_LL_32BParams(packetHandle, value.position_LL3, newPath);
      result = CheckLastError("VIR", gkFuncRefGet, result);
    }
    break;
    case 3:
    {
      snprintf(newPath, elcount(newPath), "%s.%s", oldPath, "position_LL4");
      GetVIRPosition_LL_36BParams(packetHandle, value.position_LL4, newPath);
      result = CheckLastError("VIR", gkFuncRefGet, result);
    }
    break;
    case 4:
    {
      snprintf(newPath, elcount(newPath), "%s.%s", oldPath, "position_LL5");
      GetVIRPosition_LL_44BParams(packetHandle, value.position_LL5, newPath);
      result = CheckLastError("VIR", gkFuncRefGet, result);
    }
    break;
    case 5:
    {
      snprintf(newPath, elcount(newPath), "%s.%s", oldPath, "position_LL6");
      GetVIRPosition_LL_48BParams(packetHandle, value.position_LL6, newPath);
      result = CheckLastError("VIR", gkFuncRefGet, result);
    }
    break;
    case 6:
    {
      snprintf(newPath, elcount(newPath), "%s.%s", oldPath, "position_LatLon");
      GetVIRPosition_LLmD_64bParams(packetHandle, value.position_LatLon, newPath);
      result = CheckLastError("VIR", gkFuncRefGet, result);
    }
    break;
  }
  return result;
}

int SetVIRPositionOffsetLLParams(LONG packetHandle, struct VIRPositionOffsetLL value, char oldPath[])
{
  char newPath[300];
  int result;

  result = 0;

  switch(value.choice)
  {
    case 0:
    {
      snprintf(newPath, elcount(newPath), "%s.%s", oldPath, "position_LL1");
      SetVIRPosition_LL_24BParams(packetHandle, value.position_LL1, newPath);
      result = CheckLastError("VIR", gkFuncRefGet, result);
    }
    break;
    case 1:
    {
      snprintf(newPath, elcount(newPath), "%s.%s", oldPath, "position_LL2");
      SetVIRPosition_LL_28BParams(packetHandle, value.position_LL2, newPath);
      result = CheckLastError("VIR", gkFuncRefGet, result);
    }
    break;
    case 2:
    {
      snprintf(newPath, elcount(newPath), "%s.%s", oldPath, "position_LL3");
      SetVIRPosition_LL_32BParams(packetHandle, value.position_LL3, newPath);
      result = CheckLastError("VIR", gkFuncRefGet, result);
    }
    break;
    case 3:
    {
      snprintf(newPath, elcount(newPath), "%s.%s", oldPath, "position_LL4");
      SetVIRPosition_LL_36BParams(packetHandle, value.position_LL4, newPath);
      result = CheckLastError("VIR", gkFuncRefGet, result);
    }
    break;
    case 4:
    {
      snprintf(newPath, elcount(newPath), "%s.%s", oldPath, "position_LL5");
      SetVIRPosition_LL_44BParams(packetHandle, value.position_LL5, newPath);
      result = CheckLastError("VIR", gkFuncRefGet, result);
    }
    break;
    case 5:
    {
      snprintf(newPath, elcount(newPath), "%s.%s", oldPath, "position_LL6");
      SetVIRPosition_LL_48BParams(packetHandle, value.position_LL6, newPath);
      result = CheckLastError("VIR", gkFuncRefGet, result);
    }
    break;
    case 6:
    {
      snprintf(newPath, elcount(newPath), "%s.%s", oldPath, "position_LatLon");
      SetVIRPosition_LLmD_64bParams(packetHandle, value.position_LatLon, newPath);
      result = CheckLastError("VIR", gkFuncRefGet, result);
    }
    break;
  }
  return result;
}

int GetVIRVerticalOffsetParams(LONG packetHandle, struct VIRVerticalOffset value, char oldPath[])
{
  char newPath[300];
  int result;

  result = 0;

  value.choice = C2xGetTokenInt(packetHandle, "VIR", oldPath);

  switch(value.choice)
  {
    case 0:
    {
      snprintf(newPath, elcount(newPath), "%s.%s", oldPath, "offset1");
      value.offset1 = C2xGetTokenInt(packetHandle, "VIR", newPath);
      result = CheckLastError("VIR", gkFuncRefGet, result);
    }
    break;
    case 1:
    {
      snprintf(newPath, elcount(newPath), "%s.%s", oldPath, "offset2");
      value.offset2 = C2xGetTokenInt(packetHandle, "VIR", newPath);
      result = CheckLastError("VIR", gkFuncRefGet, result);
    }
    break;
    case 2:
    {
      snprintf(newPath, elcount(newPath), "%s.%s", oldPath, "offset3");
      value.offset3 = C2xGetTokenInt(packetHandle, "VIR", newPath);
      result = CheckLastError("VIR", gkFuncRefGet, result);
    }
    break;
    case 3:
    {
      snprintf(newPath, elcount(newPath), "%s.%s", oldPath, "offset4");
      value.offset4 = C2xGetTokenInt(packetHandle, "VIR", newPath);
      result = CheckLastError("VIR", gkFuncRefGet, result);
    }
    break;
    case 4:
    {
      snprintf(newPath, elcount(newPath), "%s.%s", oldPath, "offset5");
      value.offset5 = C2xGetTokenInt(packetHandle, "VIR", newPath);
      result = CheckLastError("VIR", gkFuncRefGet, result);
    }
    break;
    case 5:
    {
      snprintf(newPath, elcount(newPath), "%s.%s", oldPath, "offset6");
      value.offset6 = C2xGetTokenInt(packetHandle, "VIR", newPath);
      result = CheckLastError("VIR", gkFuncRefGet, result);
    }
    break;
    case 6:
    {
      snprintf(newPath, elcount(newPath), "%s.%s", oldPath, "elevation");
      value.elevation = C2xGetTokenInt(packetHandle, "VIR", newPath);
      result = CheckLastError("VIR", gkFuncRefGet, result);
    }
    break;
  }
  return result;
}

int SetVIRVerticalOffsetParams(LONG packetHandle, struct VIRVerticalOffset value, char oldPath[])
{
  char newPath[300];
  int result;

  result = 0;

  switch(value.choice)
  {
    case 0:
    {
      snprintf(newPath, elcount(newPath), "%s.%s", oldPath, "offset1");
      C2xSetTokenInt(packetHandle, "VIR", newPath, value.offset1);
      result = CheckLastError("VIR", gkFuncRefGet, result);
    }
    break;
    case 1:
    {
      snprintf(newPath, elcount(newPath), "%s.%s", oldPath, "offset2");
      C2xSetTokenInt(packetHandle, "VIR", newPath, value.offset2);
      result = CheckLastError("VIR", gkFuncRefGet, result);
    }
    break;
    case 2:
    {
      snprintf(newPath, elcount(newPath), "%s.%s", oldPath, "offset3");
      C2xSetTokenInt(packetHandle, "VIR", newPath, value.offset3);
      result = CheckLastError("VIR", gkFuncRefGet, result);
    }
    break;
    case 3:
    {
      snprintf(newPath, elcount(newPath), "%s.%s", oldPath, "offset4");
      C2xSetTokenInt(packetHandle, "VIR", newPath, value.offset4);
      result = CheckLastError("VIR", gkFuncRefGet, result);
    }
    break;
    case 4:
    {
      snprintf(newPath, elcount(newPath), "%s.%s", oldPath, "offset5");
      C2xSetTokenInt(packetHandle, "VIR", newPath, value.offset5);
      result = CheckLastError("VIR", gkFuncRefGet, result);
    }
    break;
    case 5:
    {
      snprintf(newPath, elcount(newPath), "%s.%s", oldPath, "offset6");
      C2xSetTokenInt(packetHandle, "VIR", newPath, value.offset6);
      result = CheckLastError("VIR", gkFuncRefGet, result);
    }
    break;
    case 6:
    {
      snprintf(newPath, elcount(newPath), "%s.%s", oldPath, "elevation");
      C2xSetTokenInt(packetHandle, "VIR", newPath, value.elevation);
      result = CheckLastError("VIR", gkFuncRefGet, result);
    }
    break;
  }
  return result;
}

int GetVIRPositionOffsetLLVParams(LONG packetHandle, struct VIRPositionOffsetLLV value, char oldPath[])
{
  char newPath[300];
  int result;

  result = 0;

  snprintf(newPath, elcount(newPath), "%s.%s", oldPath, "offsetLL");
  GetVIRPositionOffsetLLParams(packetHandle, value.offsetLL, newPath);
  result = CheckLastError("VIR", gkFuncRefGet, result);

  snprintf(newPath, elcount(newPath), "%s.%s", oldPath, "offsetV");
  value.offsetV.isValidFlag = C2xIsTokenAvailable(packetHandle, "VIR", newPath);
  if(value.offsetV.isValidFlag==1)
  {
    GetVIRVerticalOffsetParams(packetHandle, value.offsetV, newPath);
    result = CheckLastError("VIR", gkFuncRefGet, result);
  }
  return result;
}

int SetVIRPositionOffsetLLVParams(LONG packetHandle, struct VIRPositionOffsetLLV value, char oldPath[])
{
  char newPath[300];
  int result;

  result = 0;

  snprintf(newPath, elcount(newPath), "%s.%s", oldPath, "offsetLL");
  SetVIRPositionOffsetLLParams(packetHandle, value.offsetLL, newPath);
  result = CheckLastError("VIR", gkFuncRefGet, result);

  snprintf(newPath, elcount(newPath), "%s.%s", oldPath, "offsetV");
  if(value.offsetV.isValidFlag==1)
  {
    SetVIRVerticalOffsetParams(packetHandle, value.offsetV, newPath);
    result = CheckLastError("VIR", gkFuncRefGet, result);
  }
  else
  {
    if( C2xIsTokenAvailable(packetHandle, "VIR", newPath) )
    {
      C2xRemoveToken(packetHandle, "VIR", newPath);
    }
  }

  return result;
}

int GetVIRPositionConfidenceSetParams(LONG packetHandle, struct VIRPositionConfidenceSet value, char oldPath[])
{
  char newPath[300];
  int result;

  result = 0;

  snprintf(newPath, elcount(newPath), "%s.%s", oldPath, "pos");
  value.pos = C2xGetTokenInt(packetHandle, "VIR", newPath);
  result = CheckLastError("VIR", gkFuncRefGet, result);

  snprintf(newPath, elcount(newPath), "%s.%s", oldPath, "elevation");
  value.elevation.isValidFlag = C2xIsTokenAvailable(packetHandle, "VIR", newPath);
  if(value.elevation.isValidFlag==1)
  {
    value.elevation.value = C2xGetTokenInt(packetHandle, "VIR", newPath);
    result = CheckLastError("VIR", gkFuncRefGet, result);
  }
  return result;
}

int SetVIRPositionConfidenceSetParams(LONG packetHandle, struct VIRPositionConfidenceSet value, char oldPath[])
{
  char newPath[300];
  int result;

  result = 0;

  snprintf(newPath, elcount(newPath), "%s.%s", oldPath, "pos");
  C2xSetTokenInt(packetHandle, "VIR", newPath, value.pos);
  result = CheckLastError("VIR", gkFuncRefGet, result);

  snprintf(newPath, elcount(newPath), "%s.%s", oldPath, "elevation");
  if(value.elevation.isValidFlag==1)
  {
    C2xSetTokenInt(packetHandle, "VIR", newPath, value.elevation.value);
    result = CheckLastError("VIR", gkFuncRefGet, result);
  }
  else
  {
    if( C2xIsTokenAvailable(packetHandle, "VIR", newPath) )
    {
      C2xRemoveToken(packetHandle, "VIR", newPath);
    }
  }

  return result;
}

int GetVIRAccelerationSet4WayParams(LONG packetHandle, struct VIRAccelerationSet4Way value, char oldPath[])
{
  char newPath[300];
  int result;

  result = 0;

  snprintf(newPath, elcount(newPath), "%s.%s", oldPath, "lon");
  value.lon = C2xGetTokenInt(packetHandle, "VIR", newPath);
  result = CheckLastError("VIR", gkFuncRefGet, result);

  snprintf(newPath, elcount(newPath), "%s.%s", oldPath, "lat");
  value.lat = C2xGetTokenInt(packetHandle, "VIR", newPath);
  result = CheckLastError("VIR", gkFuncRefGet, result);

  snprintf(newPath, elcount(newPath), "%s.%s", oldPath, "vert");
  value.vert = C2xGetTokenInt(packetHandle, "VIR", newPath);
  result = CheckLastError("VIR", gkFuncRefGet, result);

  snprintf(newPath, elcount(newPath), "%s.%s", oldPath, "yaw");
  value.yaw = C2xGetTokenInt(packetHandle, "VIR", newPath);
  result = CheckLastError("VIR", gkFuncRefGet, result);

  return result;
}

int SetVIRAccelerationSet4WayParams(LONG packetHandle, struct VIRAccelerationSet4Way value, char oldPath[])
{
  char newPath[300];
  int result;

  result = 0;

  snprintf(newPath, elcount(newPath), "%s.%s", oldPath, "lon");
  C2xSetTokenInt(packetHandle, "VIR", newPath, value.lon);
  result = CheckLastError("VIR", gkFuncRefGet, result);

  snprintf(newPath, elcount(newPath), "%s.%s", oldPath, "lat");
  C2xSetTokenInt(packetHandle, "VIR", newPath, value.lat);
  result = CheckLastError("VIR", gkFuncRefGet, result);

  snprintf(newPath, elcount(newPath), "%s.%s", oldPath, "vert");
  C2xSetTokenInt(packetHandle, "VIR", newPath, value.vert);
  result = CheckLastError("VIR", gkFuncRefGet, result);

  snprintf(newPath, elcount(newPath), "%s.%s", oldPath, "yaw");
  C2xSetTokenInt(packetHandle, "VIR", newPath, value.yaw);
  result = CheckLastError("VIR", gkFuncRefGet, result);

  return result;
}

int GetVIRAccSet4WayConfidenceParams(LONG packetHandle, struct VIRAccSet4WayConfidence value, char oldPath[])
{
  char newPath[300];
  int result;

  result = 0;

  snprintf(newPath, elcount(newPath), "%s.%s", oldPath, "lonAccConfidence");
  value.lonAccConfidence = C2xGetTokenInt(packetHandle, "VIR", newPath);
  result = CheckLastError("VIR", gkFuncRefGet, result);

  snprintf(newPath, elcount(newPath), "%s.%s", oldPath, "latAccConfidence");
  value.latAccConfidence = C2xGetTokenInt(packetHandle, "VIR", newPath);
  result = CheckLastError("VIR", gkFuncRefGet, result);

  snprintf(newPath, elcount(newPath), "%s.%s", oldPath, "vertAccConfidence");
  value.vertAccConfidence = C2xGetTokenInt(packetHandle, "VIR", newPath);
  result = CheckLastError("VIR", gkFuncRefGet, result);

  snprintf(newPath, elcount(newPath), "%s.%s", oldPath, "yawRateCon");
  value.yawRateCon = C2xGetTokenInt(packetHandle, "VIR", newPath);
  result = CheckLastError("VIR", gkFuncRefGet, result);

  return result;
}

int SetVIRAccSet4WayConfidenceParams(LONG packetHandle, struct VIRAccSet4WayConfidence value, char oldPath[])
{
  char newPath[300];
  int result;

  result = 0;

  snprintf(newPath, elcount(newPath), "%s.%s", oldPath, "lonAccConfidence");
  C2xSetTokenInt(packetHandle, "VIR", newPath, value.lonAccConfidence);
  result = CheckLastError("VIR", gkFuncRefGet, result);

  snprintf(newPath, elcount(newPath), "%s.%s", oldPath, "latAccConfidence");
  C2xSetTokenInt(packetHandle, "VIR", newPath, value.latAccConfidence);
  result = CheckLastError("VIR", gkFuncRefGet, result);

  snprintf(newPath, elcount(newPath), "%s.%s", oldPath, "vertAccConfidence");
  C2xSetTokenInt(packetHandle, "VIR", newPath, value.vertAccConfidence);
  result = CheckLastError("VIR", gkFuncRefGet, result);

  snprintf(newPath, elcount(newPath), "%s.%s", oldPath, "yawRateCon");
  C2xSetTokenInt(packetHandle, "VIR", newPath, value.yawRateCon);
  result = CheckLastError("VIR", gkFuncRefGet, result);

  return result;
}

int GetVIRPathPlanningPointParams(LONG packetHandle, struct VIRPathPlanningPoint value, char oldPath[])
{
  char newPath[300];
  int result;

  result = 0;

  snprintf(newPath, elcount(newPath), "%s.%s", oldPath, "posInMap");
  value.posInMap.isValidFlag = C2xIsTokenAvailable(packetHandle, "VIR", newPath);
  if(value.posInMap.isValidFlag==1)
  {
    GetVIRReferenceLinkParams(packetHandle, value.posInMap, newPath);
    result = CheckLastError("VIR", gkFuncRefGet, result);
  }
  snprintf(newPath, elcount(newPath), "%s.%s", oldPath, "pos");
  GetVIRPositionOffsetLLVParams(packetHandle, value.pos, newPath);
  result = CheckLastError("VIR", gkFuncRefGet, result);

  snprintf(newPath, elcount(newPath), "%s.%s", oldPath, "posAccuracy");
  value.posAccuracy.isValidFlag = C2xIsTokenAvailable(packetHandle, "VIR", newPath);
  if(value.posAccuracy.isValidFlag==1)
  {
    GetVIRPositionConfidenceSetParams(packetHandle, value.posAccuracy, newPath);
    result = CheckLastError("VIR", gkFuncRefGet, result);
  }
  snprintf(newPath, elcount(newPath), "%s.%s", oldPath, "speed");
  value.speed.isValidFlag = C2xIsTokenAvailable(packetHandle, "VIR", newPath);
  if(value.speed.isValidFlag==1)
  {
    value.speed.value = C2xGetTokenInt(packetHandle, "VIR", newPath);
    result = CheckLastError("VIR", gkFuncRefGet, result);
  }
  snprintf(newPath, elcount(newPath), "%s.%s", oldPath, "speedCfd");
  value.speedCfd.isValidFlag = C2xIsTokenAvailable(packetHandle, "VIR", newPath);
  if(value.speedCfd.isValidFlag==1)
  {
    value.speedCfd.value = C2xGetTokenInt(packetHandle, "VIR", newPath);
    result = CheckLastError("VIR", gkFuncRefGet, result);
  }
  snprintf(newPath, elcount(newPath), "%s.%s", oldPath, "heading");
  value.heading.isValidFlag = C2xIsTokenAvailable(packetHandle, "VIR", newPath);
  if(value.heading.isValidFlag==1)
  {
    value.heading.value = C2xGetTokenInt(packetHandle, "VIR", newPath);
    result = CheckLastError("VIR", gkFuncRefGet, result);
  }
  snprintf(newPath, elcount(newPath), "%s.%s", oldPath, "headingCfd");
  value.headingCfd.isValidFlag = C2xIsTokenAvailable(packetHandle, "VIR", newPath);
  if(value.headingCfd.isValidFlag==1)
  {
    value.headingCfd.value = C2xGetTokenInt(packetHandle, "VIR", newPath);
    result = CheckLastError("VIR", gkFuncRefGet, result);
  }
  snprintf(newPath, elcount(newPath), "%s.%s", oldPath, "accelSet");
  value.accelSet.isValidFlag = C2xIsTokenAvailable(packetHandle, "VIR", newPath);
  if(value.accelSet.isValidFlag==1)
  {
    GetVIRAccelerationSet4WayParams(packetHandle, value.accelSet, newPath);
    result = CheckLastError("VIR", gkFuncRefGet, result);
  }
  snprintf(newPath, elcount(newPath), "%s.%s", oldPath, "acc4WayConfidence");
  value.acc4WayConfidence.isValidFlag = C2xIsTokenAvailable(packetHandle, "VIR", newPath);
  if(value.acc4WayConfidence.isValidFlag==1)
  {
    GetVIRAccSet4WayConfidenceParams(packetHandle, value.acc4WayConfidence, newPath);
    result = CheckLastError("VIR", gkFuncRefGet, result);
  }
  snprintf(newPath, elcount(newPath), "%s.%s", oldPath, "estimatedTime");
  value.estimatedTime.isValidFlag = C2xIsTokenAvailable(packetHandle, "VIR", newPath);
  if(value.estimatedTime.isValidFlag==1)
  {
    value.estimatedTime.value = C2xGetTokenInt(packetHandle, "VIR", newPath);
    result = CheckLastError("VIR", gkFuncRefGet, result);
  }
  snprintf(newPath, elcount(newPath), "%s.%s", oldPath, "timeConfidence");
  value.timeConfidence.isValidFlag = C2xIsTokenAvailable(packetHandle, "VIR", newPath);
  if(value.timeConfidence.isValidFlag==1)
  {
    value.timeConfidence.value = C2xGetTokenInt(packetHandle, "VIR", newPath);
    result = CheckLastError("VIR", gkFuncRefGet, result);
  }
  return result;
}

int SetVIRPathPlanningPointParams(LONG packetHandle, struct VIRPathPlanningPoint value, char oldPath[])
{
  char newPath[300];
  int result;

  result = 0;

  snprintf(newPath, elcount(newPath), "%s.%s", oldPath, "posInMap");
  if(value.posInMap.isValidFlag==1)
  {
    SetVIRReferenceLinkParams(packetHandle, value.posInMap, newPath);
    result = CheckLastError("VIR", gkFuncRefGet, result);
  }
  else
  {
    if( C2xIsTokenAvailable(packetHandle, "VIR", newPath) )
    {
      C2xRemoveToken(packetHandle, "VIR", newPath);
    }
  }

  snprintf(newPath, elcount(newPath), "%s.%s", oldPath, "pos");
  SetVIRPositionOffsetLLVParams(packetHandle, value.pos, newPath);
  result = CheckLastError("VIR", gkFuncRefGet, result);

  snprintf(newPath, elcount(newPath), "%s.%s", oldPath, "posAccuracy");
  if(value.posAccuracy.isValidFlag==1)
  {
    SetVIRPositionConfidenceSetParams(packetHandle, value.posAccuracy, newPath);
    result = CheckLastError("VIR", gkFuncRefGet, result);
  }
  else
  {
    if( C2xIsTokenAvailable(packetHandle, "VIR", newPath) )
    {
      C2xRemoveToken(packetHandle, "VIR", newPath);
    }
  }

  snprintf(newPath, elcount(newPath), "%s.%s", oldPath, "speed");
  if(value.speed.isValidFlag==1)
  {
    C2xSetTokenInt(packetHandle, "VIR", newPath, value.speed.value);
    result = CheckLastError("VIR", gkFuncRefGet, result);
  }
  else
  {
    if( C2xIsTokenAvailable(packetHandle, "VIR", newPath) )
    {
      C2xRemoveToken(packetHandle, "VIR", newPath);
    }
  }

  snprintf(newPath, elcount(newPath), "%s.%s", oldPath, "speedCfd");
  if(value.speedCfd.isValidFlag==1)
  {
    C2xSetTokenInt(packetHandle, "VIR", newPath, value.speedCfd.value);
    result = CheckLastError("VIR", gkFuncRefGet, result);
  }
  else
  {
    if( C2xIsTokenAvailable(packetHandle, "VIR", newPath) )
    {
      C2xRemoveToken(packetHandle, "VIR", newPath);
    }
  }

  snprintf(newPath, elcount(newPath), "%s.%s", oldPath, "heading");
  if(value.heading.isValidFlag==1)
  {
    C2xSetTokenInt(packetHandle, "VIR", newPath, value.heading.value);
    result = CheckLastError("VIR", gkFuncRefGet, result);
  }
  else
  {
    if( C2xIsTokenAvailable(packetHandle, "VIR", newPath) )
    {
      C2xRemoveToken(packetHandle, "VIR", newPath);
    }
  }

  snprintf(newPath, elcount(newPath), "%s.%s", oldPath, "headingCfd");
  if(value.headingCfd.isValidFlag==1)
  {
    C2xSetTokenInt(packetHandle, "VIR", newPath, value.headingCfd.value);
    result = CheckLastError("VIR", gkFuncRefGet, result);
  }
  else
  {
    if( C2xIsTokenAvailable(packetHandle, "VIR", newPath) )
    {
      C2xRemoveToken(packetHandle, "VIR", newPath);
    }
  }

  snprintf(newPath, elcount(newPath), "%s.%s", oldPath, "accelSet");
  if(value.accelSet.isValidFlag==1)
  {
    SetVIRAccelerationSet4WayParams(packetHandle, value.accelSet, newPath);
    result = CheckLastError("VIR", gkFuncRefGet, result);
  }
  else
  {
    if( C2xIsTokenAvailable(packetHandle, "VIR", newPath) )
    {
      C2xRemoveToken(packetHandle, "VIR", newPath);
    }
  }

  snprintf(newPath, elcount(newPath), "%s.%s", oldPath, "acc4WayConfidence");
  if(value.acc4WayConfidence.isValidFlag==1)
  {
    SetVIRAccSet4WayConfidenceParams(packetHandle, value.acc4WayConfidence, newPath);
    result = CheckLastError("VIR", gkFuncRefGet, result);
  }
  else
  {
    if( C2xIsTokenAvailable(packetHandle, "VIR", newPath) )
    {
      C2xRemoveToken(packetHandle, "VIR", newPath);
    }
  }

  snprintf(newPath, elcount(newPath), "%s.%s", oldPath, "estimatedTime");
  if(value.estimatedTime.isValidFlag==1)
  {
    if (value.estimatedTime.value < 1)
    {
        C2xSetTokenInt(packetHandle, "VIR", newPath, 1);
    }
    else if (value.estimatedTime.value > 65535)
    {
        C2xSetTokenInt(packetHandle, "VIR", newPath, 65535);
    }
    else
    {
        C2xSetTokenInt(packetHandle, "VIR", newPath, value.estimatedTime.value);
    }
    result = CheckLastError("VIR", gkFuncRefGet, result);
  }
  else
  {
    if( C2xIsTokenAvailable(packetHandle, "VIR", newPath) )
    {
      C2xRemoveToken(packetHandle, "VIR", newPath);
    }
  }

  snprintf(newPath, elcount(newPath), "%s.%s", oldPath, "timeConfidence");
  if(value.timeConfidence.isValidFlag==1)
  {
    C2xSetTokenInt(packetHandle, "VIR", newPath, value.timeConfidence.value);
    result = CheckLastError("VIR", gkFuncRefGet, result);
  }
  else
  {
    if( C2xIsTokenAvailable(packetHandle, "VIR", newPath) )
    {
      C2xRemoveToken(packetHandle, "VIR", newPath);
    }
  }

  return result;
}

int GetVIRPathPlanningParams(LONG packetHandle, struct VIRPathPlanning value, char oldPath[])
{
  char newPath[300]; 
  int i;
  int result;

  result = 0;

  value.length = C2xGetTokenInt(packetHandle, "VIR", oldPath);
  if((result = CheckLastError("VIR", gkFuncRefGet, result))==0)
  {
    for(i=0; i<value.length; i++)
    {
      snprintf(newPath, elcount(newPath), "%s[%d]", oldPath, i);
      GetVIRPathPlanningPointParams(packetHandle, value.arrayValue[i], newPath);
      result = CheckLastError("VIR", gkFuncRefGet, result);
    }
  }
  return result;
}

int SetVIRPathPlanningParams(LONG packetHandle, struct VIRPathPlanning value, char oldPath[])
{
  char newPath[300]; 
  int i;
  int result;

  result = 0;

  C2xRemoveToken(packetHandle, "VIR", oldPath);
  for(i=0; i<value.length; i++)
  {
    snprintf(newPath, elcount(newPath), "%s[%d]", oldPath, i);
    SetVIRPathPlanningPointParams(packetHandle, value.arrayValue[i], newPath);
    result = CheckLastError("VIR", gkFuncRefGet, result);
  }
  return result;
}

int GetVIRReq_LaneChangeParams(LONG packetHandle, struct VIRReq_LaneChange value, char oldPath[])
{
  char newPath[300];
  int result;

  result = 0;

  snprintf(newPath, elcount(newPath), "%s.%s", oldPath, "upstreamNode");
  GetVIRNodeReferenceIDParams(packetHandle, value.upstreamNode, newPath);
  result = CheckLastError("VIR", gkFuncRefGet, result);

  snprintf(newPath, elcount(newPath), "%s.%s", oldPath, "downstreamNode");
  GetVIRNodeReferenceIDParams(packetHandle, value.downstreamNode, newPath);
  result = CheckLastError("VIR", gkFuncRefGet, result);

  snprintf(newPath, elcount(newPath), "%s.%s", oldPath, "targetLane");
  value.targetLane = C2xGetTokenInt(packetHandle, "VIR", newPath);
  result = CheckLastError("VIR", gkFuncRefGet, result);

  return result;
}

int SetVIRReq_LaneChangeParams(LONG packetHandle, struct VIRReq_LaneChange value, char oldPath[])
{
  char newPath[300];
  int result;

  result = 0;

  snprintf(newPath, elcount(newPath), "%s.%s", oldPath, "upstreamNode");
  SetVIRNodeReferenceIDParams(packetHandle, value.upstreamNode, newPath);
  result = CheckLastError("VIR", gkFuncRefGet, result);

  snprintf(newPath, elcount(newPath), "%s.%s", oldPath, "downstreamNode");
  SetVIRNodeReferenceIDParams(packetHandle, value.downstreamNode, newPath);
  result = CheckLastError("VIR", gkFuncRefGet, result);

  snprintf(newPath, elcount(newPath), "%s.%s", oldPath, "targetLane");
  C2xSetTokenInt(packetHandle, "VIR", newPath, value.targetLane);
  result = CheckLastError("VIR", gkFuncRefGet, result);

  return result;
}

int GetVIRPathPointListParams(LONG packetHandle, struct VIRPathPointList value, char oldPath[])
{
  char newPath[300]; 
  int i;
  int result;

  result = 0;

  value.length = C2xGetTokenInt(packetHandle, "VIR", oldPath);
  if((result = CheckLastError("VIR", gkFuncRefGet, result))==0)
  {
    for(i=0; i<value.length; i++)
    {
      snprintf(newPath, elcount(newPath), "%s[%d]", oldPath, i);
      GetVIRPositionOffsetLLVParams(packetHandle, value.arrayValue[i], newPath);
      result = CheckLastError("VIR", gkFuncRefGet, result);
    }
  }
  return result;
}

int SetVIRPathPointListParams(LONG packetHandle, struct VIRPathPointList value, char oldPath[])
{
  char newPath[300]; 
  int i;
  int result;

  result = 0;

  C2xRemoveToken(packetHandle, "VIR", oldPath);
  for(i=0; i<value.length; i++)
  {
    snprintf(newPath, elcount(newPath), "%s[%d]", oldPath, i);
    SetVIRPositionOffsetLLVParams(packetHandle, value.arrayValue[i], newPath);
    result = CheckLastError("VIR", gkFuncRefGet, result);
  }
  return result;
}

int GetVIRReferencePathParams(LONG packetHandle, struct VIRReferencePath value, char oldPath[])
{
  char newPath[300];
  int result;

  result = 0;

  snprintf(newPath, elcount(newPath), "%s.%s", oldPath, "activePath");
  GetVIRPathPointListParams(packetHandle, value.activePath, newPath);
  result = CheckLastError("VIR", gkFuncRefGet, result);

  snprintf(newPath, elcount(newPath), "%s.%s", oldPath, "pathRadius");
  value.pathRadius = C2xGetTokenInt(packetHandle, "VIR", newPath);
  result = CheckLastError("VIR", gkFuncRefGet, result);

  return result;
}

int SetVIRReferencePathParams(LONG packetHandle, struct VIRReferencePath value, char oldPath[])
{
  char newPath[300];
  int result;

  result = 0;

  snprintf(newPath, elcount(newPath), "%s.%s", oldPath, "activePath");
  SetVIRPathPointListParams(packetHandle, value.activePath, newPath);
  result = CheckLastError("VIR", gkFuncRefGet, result);

  snprintf(newPath, elcount(newPath), "%s.%s", oldPath, "pathRadius");
  C2xSetTokenInt(packetHandle, "VIR", newPath, value.pathRadius);
  result = CheckLastError("VIR", gkFuncRefGet, result);

  return result;
}

int GetVIRDDateTimeParams(LONG packetHandle, struct VIRDDateTime value, char oldPath[])
{
  char newPath[300];
  int result;

  result = 0;

  snprintf(newPath, elcount(newPath), "%s.%s", oldPath, "year");
  value.year.isValidFlag = C2xIsTokenAvailable(packetHandle, "VIR", newPath);
  if(value.year.isValidFlag==1)
  {
    value.year.value = C2xGetTokenInt(packetHandle, "VIR", newPath);
    result = CheckLastError("VIR", gkFuncRefGet, result);
  }
  snprintf(newPath, elcount(newPath), "%s.%s", oldPath, "month");
  value.month.isValidFlag = C2xIsTokenAvailable(packetHandle, "VIR", newPath);
  if(value.month.isValidFlag==1)
  {
    value.month.value = C2xGetTokenInt(packetHandle, "VIR", newPath);
    result = CheckLastError("VIR", gkFuncRefGet, result);
  }
  snprintf(newPath, elcount(newPath), "%s.%s", oldPath, "day");
  value.day.isValidFlag = C2xIsTokenAvailable(packetHandle, "VIR", newPath);
  if(value.day.isValidFlag==1)
  {
    value.day.value = C2xGetTokenInt(packetHandle, "VIR", newPath);
    result = CheckLastError("VIR", gkFuncRefGet, result);
  }
  snprintf(newPath, elcount(newPath), "%s.%s", oldPath, "hour");
  value.hour.isValidFlag = C2xIsTokenAvailable(packetHandle, "VIR", newPath);
  if(value.hour.isValidFlag==1)
  {
    value.hour.value = C2xGetTokenInt(packetHandle, "VIR", newPath);
    result = CheckLastError("VIR", gkFuncRefGet, result);
  }
  snprintf(newPath, elcount(newPath), "%s.%s", oldPath, "minute");
  value.minute.isValidFlag = C2xIsTokenAvailable(packetHandle, "VIR", newPath);
  if(value.minute.isValidFlag==1)
  {
    value.minute.value = C2xGetTokenInt(packetHandle, "VIR", newPath);
    result = CheckLastError("VIR", gkFuncRefGet, result);
  }
  snprintf(newPath, elcount(newPath), "%s.%s", oldPath, "second");
  value.second.isValidFlag = C2xIsTokenAvailable(packetHandle, "VIR", newPath);
  if(value.second.isValidFlag==1)
  {
    value.second.value = C2xGetTokenInt(packetHandle, "VIR", newPath);
    result = CheckLastError("VIR", gkFuncRefGet, result);
  }
  snprintf(newPath, elcount(newPath), "%s.%s", oldPath, "offset");
  value.offset.isValidFlag = C2xIsTokenAvailable(packetHandle, "VIR", newPath);
  if(value.offset.isValidFlag==1)
  {
    value.offset.value = C2xGetTokenInt(packetHandle, "VIR", newPath);
    result = CheckLastError("VIR", gkFuncRefGet, result);
  }
  return result;
}

int SetVIRDDateTimeParams(LONG packetHandle, struct VIRDDateTime value, char oldPath[])
{
  char newPath[300];
  int result;

  result = 0;

  snprintf(newPath, elcount(newPath), "%s.%s", oldPath, "year");
  if(value.year.isValidFlag==1)
  {
    C2xSetTokenInt(packetHandle, "VIR", newPath, value.year.value);
    result = CheckLastError("VIR", gkFuncRefGet, result);
  }
  else
  {
    if( C2xIsTokenAvailable(packetHandle, "VIR", newPath) )
    {
      C2xRemoveToken(packetHandle, "VIR", newPath);
    }
  }

  snprintf(newPath, elcount(newPath), "%s.%s", oldPath, "month");
  if(value.month.isValidFlag==1)
  {
    C2xSetTokenInt(packetHandle, "VIR", newPath, value.month.value);
    result = CheckLastError("VIR", gkFuncRefGet, result);
  }
  else
  {
    if( C2xIsTokenAvailable(packetHandle, "VIR", newPath) )
    {
      C2xRemoveToken(packetHandle, "VIR", newPath);
    }
  }

  snprintf(newPath, elcount(newPath), "%s.%s", oldPath, "day");
  if(value.day.isValidFlag==1)
  {
    C2xSetTokenInt(packetHandle, "VIR", newPath, value.day.value);
    result = CheckLastError("VIR", gkFuncRefGet, result);
  }
  else
  {
    if( C2xIsTokenAvailable(packetHandle, "VIR", newPath) )
    {
      C2xRemoveToken(packetHandle, "VIR", newPath);
    }
  }

  snprintf(newPath, elcount(newPath), "%s.%s", oldPath, "hour");
  if(value.hour.isValidFlag==1)
  {
    C2xSetTokenInt(packetHandle, "VIR", newPath, value.hour.value);
    result = CheckLastError("VIR", gkFuncRefGet, result);
  }
  else
  {
    if( C2xIsTokenAvailable(packetHandle, "VIR", newPath) )
    {
      C2xRemoveToken(packetHandle, "VIR", newPath);
    }
  }

  snprintf(newPath, elcount(newPath), "%s.%s", oldPath, "minute");
  if(value.minute.isValidFlag==1)
  {
    C2xSetTokenInt(packetHandle, "VIR", newPath, value.minute.value);
    result = CheckLastError("VIR", gkFuncRefGet, result);
  }
  else
  {
    if( C2xIsTokenAvailable(packetHandle, "VIR", newPath) )
    {
      C2xRemoveToken(packetHandle, "VIR", newPath);
    }
  }

  snprintf(newPath, elcount(newPath), "%s.%s", oldPath, "second");
  if(value.second.isValidFlag==1)
  {
    C2xSetTokenInt(packetHandle, "VIR", newPath, value.second.value);
    result = CheckLastError("VIR", gkFuncRefGet, result);
  }
  else
  {
    if( C2xIsTokenAvailable(packetHandle, "VIR", newPath) )
    {
      C2xRemoveToken(packetHandle, "VIR", newPath);
    }
  }

  snprintf(newPath, elcount(newPath), "%s.%s", oldPath, "offset");
  if(value.offset.isValidFlag==1)
  {
    C2xSetTokenInt(packetHandle, "VIR", newPath, value.offset.value);
    result = CheckLastError("VIR", gkFuncRefGet, result);
  }
  else
  {
    if( C2xIsTokenAvailable(packetHandle, "VIR", newPath) )
    {
      C2xRemoveToken(packetHandle, "VIR", newPath);
    }
  }

  return result;
}

int GetVIRReq_ClearTheWayParams(LONG packetHandle, struct VIRReq_ClearTheWay value, char oldPath[])
{
  char newPath[300];
  int result;

  result = 0;

  snprintf(newPath, elcount(newPath), "%s.%s", oldPath, "upstreamNode");
  GetVIRNodeReferenceIDParams(packetHandle, value.upstreamNode, newPath);
  result = CheckLastError("VIR", gkFuncRefGet, result);

  snprintf(newPath, elcount(newPath), "%s.%s", oldPath, "downstreamNode");
  GetVIRNodeReferenceIDParams(packetHandle, value.downstreamNode, newPath);
  result = CheckLastError("VIR", gkFuncRefGet, result);

  snprintf(newPath, elcount(newPath), "%s.%s", oldPath, "targetLane");
  value.targetLane = C2xGetTokenInt(packetHandle, "VIR", newPath);
  result = CheckLastError("VIR", gkFuncRefGet, result);

  snprintf(newPath, elcount(newPath), "%s.%s", oldPath, "relatedPath");
  value.relatedPath.isValidFlag = C2xIsTokenAvailable(packetHandle, "VIR", newPath);
  if(value.relatedPath.isValidFlag==1)
  {
    GetVIRReferencePathParams(packetHandle, value.relatedPath, newPath);
    result = CheckLastError("VIR", gkFuncRefGet, result);
  }
  snprintf(newPath, elcount(newPath), "%s.%s", oldPath, "tBegin");
  value.tBegin.isValidFlag = C2xIsTokenAvailable(packetHandle, "VIR", newPath);
  if(value.tBegin.isValidFlag==1)
  {
    GetVIRDDateTimeParams(packetHandle, value.tBegin, newPath);
    result = CheckLastError("VIR", gkFuncRefGet, result);
  }
  snprintf(newPath, elcount(newPath), "%s.%s", oldPath, "tEnd");
  value.tEnd.isValidFlag = C2xIsTokenAvailable(packetHandle, "VIR", newPath);
  if(value.tEnd.isValidFlag==1)
  {
    GetVIRDDateTimeParams(packetHandle, value.tEnd, newPath);
    result = CheckLastError("VIR", gkFuncRefGet, result);
  }
  return result;
}

int SetVIRReq_ClearTheWayParams(LONG packetHandle, struct VIRReq_ClearTheWay value, char oldPath[])
{
  char newPath[300];
  int result;

  result = 0;

  snprintf(newPath, elcount(newPath), "%s.%s", oldPath, "upstreamNode");
  SetVIRNodeReferenceIDParams(packetHandle, value.upstreamNode, newPath);
  result = CheckLastError("VIR", gkFuncRefGet, result);

  snprintf(newPath, elcount(newPath), "%s.%s", oldPath, "downstreamNode");
  SetVIRNodeReferenceIDParams(packetHandle, value.downstreamNode, newPath);
  result = CheckLastError("VIR", gkFuncRefGet, result);

  snprintf(newPath, elcount(newPath), "%s.%s", oldPath, "targetLane");
  C2xSetTokenInt(packetHandle, "VIR", newPath, value.targetLane);
  result = CheckLastError("VIR", gkFuncRefGet, result);

  snprintf(newPath, elcount(newPath), "%s.%s", oldPath, "relatedPath");
  if(value.relatedPath.isValidFlag==1)
  {
    SetVIRReferencePathParams(packetHandle, value.relatedPath, newPath);
    result = CheckLastError("VIR", gkFuncRefGet, result);
  }
  else
  {
    if( C2xIsTokenAvailable(packetHandle, "VIR", newPath) )
    {
      C2xRemoveToken(packetHandle, "VIR", newPath);
    }
  }

  snprintf(newPath, elcount(newPath), "%s.%s", oldPath, "tBegin");
  if(value.tBegin.isValidFlag==1)
  {
    SetVIRDDateTimeParams(packetHandle, value.tBegin, newPath);
    result = CheckLastError("VIR", gkFuncRefGet, result);
  }
  else
  {
    if( C2xIsTokenAvailable(packetHandle, "VIR", newPath) )
    {
      C2xRemoveToken(packetHandle, "VIR", newPath);
    }
  }

  snprintf(newPath, elcount(newPath), "%s.%s", oldPath, "tEnd");
  if(value.tEnd.isValidFlag==1)
  {
    SetVIRDDateTimeParams(packetHandle, value.tEnd, newPath);
    result = CheckLastError("VIR", gkFuncRefGet, result);
  }
  else
  {
    if( C2xIsTokenAvailable(packetHandle, "VIR", newPath) )
    {
      C2xRemoveToken(packetHandle, "VIR", newPath);
    }
  }

  return result;
}

int GetVIRMovementExParams(LONG packetHandle, struct VIRMovementEx value, char oldPath[])
{
  char newPath[300];
  int result;

  result = 0;

  snprintf(newPath, elcount(newPath), "%s.%s", oldPath, "remoteIntersection");
  GetVIRNodeReferenceIDParams(packetHandle, value.remoteIntersection, newPath);
  result = CheckLastError("VIR", gkFuncRefGet, result);

  snprintf(newPath, elcount(newPath), "%s.%s", oldPath, "phaseId");
  value.phaseId.isValidFlag = C2xIsTokenAvailable(packetHandle, "VIR", newPath);
  if(value.phaseId.isValidFlag==1)
  {
    value.phaseId.value = C2xGetTokenInt(packetHandle, "VIR", newPath);
    result = CheckLastError("VIR", gkFuncRefGet, result);
  }
  snprintf(newPath, elcount(newPath), "%s.%s", oldPath, "turn_direction");
  value.turn_direction.isValidFlag = C2xIsTokenAvailable(packetHandle, "VIR", newPath);
  if(value.turn_direction.isValidFlag==1)
  {
    value.turn_direction.value = C2xGetTokenInt(packetHandle, "VIR", newPath);
    result = CheckLastError("VIR", gkFuncRefGet, result);
  }
  return result;
}

int SetVIRMovementExParams(LONG packetHandle, struct VIRMovementEx value, char oldPath[])
{
  char newPath[300];
  int result;

  result = 0;

  snprintf(newPath, elcount(newPath), "%s.%s", oldPath, "remoteIntersection");
  SetVIRNodeReferenceIDParams(packetHandle, value.remoteIntersection, newPath);
  result = CheckLastError("VIR", gkFuncRefGet, result);

  snprintf(newPath, elcount(newPath), "%s.%s", oldPath, "phaseId");
  if(value.phaseId.isValidFlag==1)
  {
    C2xSetTokenInt(packetHandle, "VIR", newPath, value.phaseId.value);
    result = CheckLastError("VIR", gkFuncRefGet, result);
  }
  else
  {
    if( C2xIsTokenAvailable(packetHandle, "VIR", newPath) )
    {
      C2xRemoveToken(packetHandle, "VIR", newPath);
    }
  }

  snprintf(newPath, elcount(newPath), "%s.%s", oldPath, "turn_direction");
  if(value.turn_direction.isValidFlag==1)
  {
    C2xSetTokenInt(packetHandle, "VIR", newPath, value.turn_direction.value);
    result = CheckLastError("VIR", gkFuncRefGet, result);
  }
  else
  {
    if( C2xIsTokenAvailable(packetHandle, "VIR", newPath) )
    {
      C2xRemoveToken(packetHandle, "VIR", newPath);
    }
  }

  return result;
}

int GetVIRReq_SignalPriorityParams(LONG packetHandle, struct VIRReq_SignalPriority value, char oldPath[])
{
  char newPath[300];
  int result;

  result = 0;

  snprintf(newPath, elcount(newPath), "%s.%s", oldPath, "intersectionId");
  GetVIRNodeReferenceIDParams(packetHandle, value.intersectionId, newPath);
  result = CheckLastError("VIR", gkFuncRefGet, result);

  snprintf(newPath, elcount(newPath), "%s.%s", oldPath, "requiredMov");
  GetVIRMovementExParams(packetHandle, value.requiredMov, newPath);
  result = CheckLastError("VIR", gkFuncRefGet, result);

  snprintf(newPath, elcount(newPath), "%s.%s", oldPath, "estimatedArrivalTime");
  value.estimatedArrivalTime.isValidFlag = C2xIsTokenAvailable(packetHandle, "VIR", newPath);
  if(value.estimatedArrivalTime.isValidFlag==1)
  {
    value.estimatedArrivalTime.value = C2xGetTokenInt(packetHandle, "VIR", newPath);
    result = CheckLastError("VIR", gkFuncRefGet, result);
  }
  snprintf(newPath, elcount(newPath), "%s.%s", oldPath, "distance2Intersection");
  value.distance2Intersection.isValidFlag = C2xIsTokenAvailable(packetHandle, "VIR", newPath);
  if(value.distance2Intersection.isValidFlag==1)
  {
    value.distance2Intersection.value = C2xGetTokenInt(packetHandle, "VIR", newPath);
    result = CheckLastError("VIR", gkFuncRefGet, result);
  }
  return result;
}

int SetVIRReq_SignalPriorityParams(LONG packetHandle, struct VIRReq_SignalPriority value, char oldPath[])
{
  char newPath[300];
  int result;

  result = 0;

  snprintf(newPath, elcount(newPath), "%s.%s", oldPath, "intersectionId");
  SetVIRNodeReferenceIDParams(packetHandle, value.intersectionId, newPath);
  result = CheckLastError("VIR", gkFuncRefGet, result);

  snprintf(newPath, elcount(newPath), "%s.%s", oldPath, "requiredMov");
  SetVIRMovementExParams(packetHandle, value.requiredMov, newPath);
  result = CheckLastError("VIR", gkFuncRefGet, result);

  snprintf(newPath, elcount(newPath), "%s.%s", oldPath, "estimatedArrivalTime");
  if(value.estimatedArrivalTime.isValidFlag==1)
  {
    if (value.estimatedArrivalTime.value < 1)
    {
        C2xSetTokenInt(packetHandle, "VIR", newPath, 1);
    }
    else if (value.estimatedArrivalTime.value > 65535)
    {
        C2xSetTokenInt(packetHandle, "VIR", newPath, 65535);
    }
    else
    {
        C2xSetTokenInt(packetHandle, "VIR", newPath, value.estimatedArrivalTime.value);
    }
    result = CheckLastError("VIR", gkFuncRefGet, result);
  }
  else
  {
    if( C2xIsTokenAvailable(packetHandle, "VIR", newPath) )
    {
      C2xRemoveToken(packetHandle, "VIR", newPath);
    }
  }

  snprintf(newPath, elcount(newPath), "%s.%s", oldPath, "distance2Intersection");
  if(value.distance2Intersection.isValidFlag==1)
  {
    C2xSetTokenInt(packetHandle, "VIR", newPath, value.distance2Intersection.value);
    result = CheckLastError("VIR", gkFuncRefGet, result);
  }
  else
  {
    if( C2xIsTokenAvailable(packetHandle, "VIR", newPath) )
    {
      C2xRemoveToken(packetHandle, "VIR", newPath);
    }
  }

  return result;
}

int GetVIRReferencePathListParams(LONG packetHandle, struct VIRReferencePathList value, char oldPath[])
{
  char newPath[300]; 
  int i;
  int result;

  result = 0;

  value.length = C2xGetTokenInt(packetHandle, "VIR", oldPath);
  if((result = CheckLastError("VIR", gkFuncRefGet, result))==0)
  {
    for(i=0; i<value.length; i++)
    {
      snprintf(newPath, elcount(newPath), "%s[%d]", oldPath, i);
      GetVIRReferencePathParams(packetHandle, value.arrayValue[i], newPath);
      result = CheckLastError("VIR", gkFuncRefGet, result);
    }
  }
  return result;
}

int SetVIRReferencePathListParams(LONG packetHandle, struct VIRReferencePathList value, char oldPath[])
{
  char newPath[300]; 
  int i;
  int result;

  result = 0;

  C2xRemoveToken(packetHandle, "VIR", oldPath);
  for(i=0; i<value.length; i++)
  {
    snprintf(newPath, elcount(newPath), "%s[%d]", oldPath, i);
    SetVIRReferencePathParams(packetHandle, value.arrayValue[i], newPath);
    result = CheckLastError("VIR", gkFuncRefGet, result);
  }
  return result;
}

int GetVIRReq_SensorSharingParams(LONG packetHandle, struct VIRReq_SensorSharing value, char oldPath[])
{
  char newPath[300];
  int result;

  result = 0;

  snprintf(newPath, elcount(newPath), "%s.%s", oldPath, "detectArea");
  GetVIRReferencePathListParams(packetHandle, value.detectArea, newPath);
  result = CheckLastError("VIR", gkFuncRefGet, result);

  return result;
}

int SetVIRReq_SensorSharingParams(LONG packetHandle, struct VIRReq_SensorSharing value, char oldPath[])
{
  char newPath[300];
  int result;

  result = 0;

  snprintf(newPath, elcount(newPath), "%s.%s", oldPath, "detectArea");
  SetVIRReferencePathListParams(packetHandle, value.detectArea, newPath);
  result = CheckLastError("VIR", gkFuncRefGet, result);

  return result;
}

int GetVIRVehicleClassificationParams(LONG packetHandle, struct VIRVehicleClassification value, char oldPath[])
{
  char newPath[300];
  int result;

  result = 0;

  snprintf(newPath, elcount(newPath), "%s.%s", oldPath, "classification");
  value.classification = C2xGetTokenInt(packetHandle, "VIR", newPath);
  result = CheckLastError("VIR", gkFuncRefGet, result);

  snprintf(newPath, elcount(newPath), "%s.%s", oldPath, "fuelType");
  value.fuelType.isValidFlag = C2xIsTokenAvailable(packetHandle, "VIR", newPath);
  if(value.fuelType.isValidFlag==1)
  {
    value.fuelType.value = C2xGetTokenInt(packetHandle, "VIR", newPath);
    result = CheckLastError("VIR", gkFuncRefGet, result);
  }
  return result;
}

int SetVIRVehicleClassificationParams(LONG packetHandle, struct VIRVehicleClassification value, char oldPath[])
{
  char newPath[300];
  int result;

  result = 0;

  snprintf(newPath, elcount(newPath), "%s.%s", oldPath, "classification");
  C2xSetTokenInt(packetHandle, "VIR", newPath, value.classification);
  result = CheckLastError("VIR", gkFuncRefGet, result);

  snprintf(newPath, elcount(newPath), "%s.%s", oldPath, "fuelType");
  if(value.fuelType.isValidFlag==1)
  {
    C2xSetTokenInt(packetHandle, "VIR", newPath, value.fuelType.value);
    result = CheckLastError("VIR", gkFuncRefGet, result);
  }
  else
  {
    if( C2xIsTokenAvailable(packetHandle, "VIR", newPath) )
    {
      C2xRemoveToken(packetHandle, "VIR", newPath);
    }
  }

  return result;
}

int GetVIRReq_ParkingAreaParams(LONG packetHandle, struct VIRReq_ParkingArea value, char oldPath[])
{
  char newPath[300]; 
  int j; 
  int k;
  int result;

  result = 0;

  snprintf(newPath, elcount(newPath), "%s.%s", oldPath, "vehicleClass");
  GetVIRVehicleClassificationParams(packetHandle, value.vehicleClass, newPath);
  result = CheckLastError("VIR", gkFuncRefGet, result);

  snprintf(newPath, elcount(newPath), "%s.%s", oldPath, "req");
  value.req.isValidFlag = 1;
  value.req.stringLength = C2xGetTokenLengthBit(packetHandle, "VIR", newPath);
  if ((result = CheckLastError("VIR", gkFuncRefGet, result))==0)
  {
    if(value.req.stringLength > 0)
    {
      for(j=0; j<value.req.stringLength; j++)
      {
        if(C2xGetTokenBitOfBitString(packetHandle, "VIR", newPath, j) == 0)
        {
          value.req.string[j] = '0';
        }
        else if(C2xGetTokenBitOfBitString(packetHandle, "VIR", newPath, j) == 1)
        {
          value.req.string[j] = '1';
        }

        if(value.req.stringLength == 1)
        {
          value.req.string[1] = '0';
        }
        result = CheckLastError("VIR", gkFuncRefGet, result);
      }
    }
    else
    {
      for(k = value.req.stringLength+1; k > -1; k--)
      {
        if(value.req.string[k] == '1')
        {
          value.req.string[k] = '0';
        }
      }
    }
  }

  snprintf(newPath, elcount(newPath), "%s.%s", oldPath, "parkingType");
  value.parkingType.isValidFlag = C2xIsTokenAvailable(packetHandle, "VIR", newPath);
  if(value.parkingType.isValidFlag==1)
  {
    value.parkingType.isValidFlag = 1;
    value.parkingType.stringLength = C2xGetTokenLengthBit(packetHandle, "VIR", newPath);
    if ((result = CheckLastError("VIR", gkFuncRefGet, result))==0)
    {
      if(value.parkingType.stringLength > 0)
      {
        for(j=0; j<value.parkingType.stringLength; j++)
        {
          if(C2xGetTokenBitOfBitString(packetHandle, "VIR", newPath, j) == 0)
          {
            value.parkingType.string[j] = '0';
          }
          else if(C2xGetTokenBitOfBitString(packetHandle, "VIR", newPath, j) == 1)
          {
            value.parkingType.string[j] = '1';
          }

          if(value.parkingType.stringLength == 1)
          {
            value.parkingType.string[1] = '0';
          }
          result = CheckLastError("VIR", gkFuncRefGet, result);
        }
      }
      else
      {
        for(k = value.parkingType.stringLength+1; k > -1; k--)
        {
          if(value.parkingType.string[k] == '1')
          {
            value.parkingType.string[k] = '0';
          }
        }
      }
    }

  }
  snprintf(newPath, elcount(newPath), "%s.%s", oldPath, "expectedParkingSlotID");
  value.expectedParkingSlotID.isValidFlag = C2xIsTokenAvailable(packetHandle, "VIR", newPath);
  if(value.expectedParkingSlotID.isValidFlag==1)
  {
    value.expectedParkingSlotID.value = C2xGetTokenInt(packetHandle, "VIR", newPath);
    result = CheckLastError("VIR", gkFuncRefGet, result);
  }
  return result;
}

int SetVIRReq_ParkingAreaParams(LONG packetHandle, struct VIRReq_ParkingArea value, char oldPath[])
{
  char newPath[300]; 
  int j;
  int result;

  result = 0;

  snprintf(newPath, elcount(newPath), "%s.%s", oldPath, "vehicleClass");
  SetVIRVehicleClassificationParams(packetHandle, value.vehicleClass, newPath);
  result = CheckLastError("VIR", gkFuncRefGet, result);

  snprintf(newPath, elcount(newPath), "%s.%s", oldPath, "req");
    for(j=0; j<value.req.stringLength; j++)
    {
      if(value.req.string[j] == '0')
      {
        C2xSetTokenBitOfBitString(packetHandle, "VIR", newPath, j, 0);
      }
      else
      {
        C2xSetTokenBitOfBitString(packetHandle, "VIR", newPath, j, 1);
      }
      result = CheckLastError("VIR", gkFuncRefGet, result);
    }

  snprintf(newPath, elcount(newPath), "%s.%s", oldPath, "parkingType");
  if(value.parkingType.isValidFlag==1)
  {
      for(j=0; j<value.parkingType.stringLength; j++)
      {
        if(value.parkingType.string[j] == '0')
        {
          C2xSetTokenBitOfBitString(packetHandle, "VIR", newPath, j, 0);
        }
        else
        {
          C2xSetTokenBitOfBitString(packetHandle, "VIR", newPath, j, 1);
        }
        result = CheckLastError("VIR", gkFuncRefGet, result);
      }
  }
  else
  {
    if( C2xIsTokenAvailable(packetHandle, "VIR", newPath) )
    {
      C2xRemoveToken(packetHandle, "VIR", newPath);
    }
  }

  snprintf(newPath, elcount(newPath), "%s.%s", oldPath, "expectedParkingSlotID");
  if(value.expectedParkingSlotID.isValidFlag==1)
  {
    C2xSetTokenInt(packetHandle, "VIR", newPath, value.expectedParkingSlotID.value);
    result = CheckLastError("VIR", gkFuncRefGet, result);
  }
  else
  {
    if( C2xIsTokenAvailable(packetHandle, "VIR", newPath) )
    {
      C2xRemoveToken(packetHandle, "VIR", newPath);
    }
  }

  return result;
}

int GetVIRReqInfoParams(LONG packetHandle, struct VIRReqInfo value, char oldPath[])
{
  char newPath[300];
  int result;

  result = 0;

  value.choice = C2xGetTokenInt(packetHandle, "VIR", oldPath);

  switch(value.choice)
  {
    case 0:
    {
      snprintf(newPath, elcount(newPath), "%s.%s", oldPath, "laneChange");
      GetVIRReq_LaneChangeParams(packetHandle, value.laneChange, newPath);
      result = CheckLastError("VIR", gkFuncRefGet, result);
    }
    break;
    case 1:
    {
      snprintf(newPath, elcount(newPath), "%s.%s", oldPath, "clearTheWay");
      GetVIRReq_ClearTheWayParams(packetHandle, value.clearTheWay, newPath);
      result = CheckLastError("VIR", gkFuncRefGet, result);
    }
    break;
    case 2:
    {
      snprintf(newPath, elcount(newPath), "%s.%s", oldPath, "signalPriority");
      GetVIRReq_SignalPriorityParams(packetHandle, value.signalPriority, newPath);
      result = CheckLastError("VIR", gkFuncRefGet, result);
    }
    break;
    case 3:
    {
      snprintf(newPath, elcount(newPath), "%s.%s", oldPath, "sensorSharing");
      GetVIRReq_SensorSharingParams(packetHandle, value.sensorSharing, newPath);
      result = CheckLastError("VIR", gkFuncRefGet, result);
    }
    break;
    case 4:
    {
      snprintf(newPath, elcount(newPath), "%s.%s", oldPath, "parking");
      GetVIRReq_ParkingAreaParams(packetHandle, value.parking, newPath);
      result = CheckLastError("VIR", gkFuncRefGet, result);
    }
    break;
  }
  return result;
}

int SetVIRReqInfoParams(LONG packetHandle, struct VIRReqInfo value, char oldPath[])
{
  char newPath[300];
  int result;

  result = 0;

  switch(value.choice)
  {
    case 0:
    {
      snprintf(newPath, elcount(newPath), "%s.%s", oldPath, "laneChange");
      SetVIRReq_LaneChangeParams(packetHandle, value.laneChange, newPath);
      result = CheckLastError("VIR", gkFuncRefGet, result);
    }
    break;
    case 1:
    {
      snprintf(newPath, elcount(newPath), "%s.%s", oldPath, "clearTheWay");
      SetVIRReq_ClearTheWayParams(packetHandle, value.clearTheWay, newPath);
      result = CheckLastError("VIR", gkFuncRefGet, result);
    }
    break;
    case 2:
    {
      snprintf(newPath, elcount(newPath), "%s.%s", oldPath, "signalPriority");
      SetVIRReq_SignalPriorityParams(packetHandle, value.signalPriority, newPath);
      result = CheckLastError("VIR", gkFuncRefGet, result);
    }
    break;
    case 3:
    {
      snprintf(newPath, elcount(newPath), "%s.%s", oldPath, "sensorSharing");
      SetVIRReq_SensorSharingParams(packetHandle, value.sensorSharing, newPath);
      result = CheckLastError("VIR", gkFuncRefGet, result);
    }
    break;
    case 4:
    {
      snprintf(newPath, elcount(newPath), "%s.%s", oldPath, "parking");
      SetVIRReq_ParkingAreaParams(packetHandle, value.parking, newPath);
      result = CheckLastError("VIR", gkFuncRefGet, result);
    }
    break;
  }
  return result;
}

int GetVIRDriveRequestParams(LONG packetHandle, struct VIRDriveRequest value, char oldPath[])
{
  char newPath[300];
  int result;

  result = 0;

  snprintf(newPath, elcount(newPath), "%s.%s", oldPath, "reqID");
  value.reqID = C2xGetTokenInt(packetHandle, "VIR", newPath);
  result = CheckLastError("VIR", gkFuncRefGet, result);

  snprintf(newPath, elcount(newPath), "%s.%s", oldPath, "status");
  value.status = C2xGetTokenInt(packetHandle, "VIR", newPath);
  result = CheckLastError("VIR", gkFuncRefGet, result);

  snprintf(newPath, elcount(newPath), "%s.%s", oldPath, "reqPriority");
  value.reqPriority.isValidFlag = C2xIsTokenAvailable(packetHandle, "VIR", newPath);
  if(value.reqPriority.isValidFlag==1)
  {
    value.reqPriority.isValidFlag = 1;
    value.reqPriority.stringLength = C2xGetTokenData(packetHandle, "VIR", newPath, elcount(value.reqPriority.string), value.reqPriority.string);
  }
  snprintf(newPath, elcount(newPath), "%s.%s", oldPath, "targetVeh");
  value.targetVeh.isValidFlag = C2xIsTokenAvailable(packetHandle, "VIR", newPath);
  if(value.targetVeh.isValidFlag==1)
  {
    value.targetVeh.isValidFlag = 1;
    value.targetVeh.stringLength = C2xGetTokenData(packetHandle, "VIR", newPath, elcount(value.targetVeh.string), value.targetVeh.string);
  }
  snprintf(newPath, elcount(newPath), "%s.%s", oldPath, "targetRSU");
  value.targetRSU.isValidFlag = C2xIsTokenAvailable(packetHandle, "VIR", newPath);
  if(value.targetRSU.isValidFlag==1)
  {
    value.targetRSU.isValidFlag = 1;
    value.targetRSU.stringLength = C2xGetTokenData(packetHandle, "VIR", newPath, elcount(value.targetRSU.string), value.targetRSU.string);
  }
  snprintf(newPath, elcount(newPath), "%s.%s", oldPath, "info");
  value.info.isValidFlag = C2xIsTokenAvailable(packetHandle, "VIR", newPath);
  if(value.info.isValidFlag==1)
  {
    GetVIRReqInfoParams(packetHandle, value.info, newPath);
    result = CheckLastError("VIR", gkFuncRefGet, result);
  }
  snprintf(newPath, elcount(newPath), "%s.%s", oldPath, "lifeTime");
  value.lifeTime.isValidFlag = C2xIsTokenAvailable(packetHandle, "VIR", newPath);
  if(value.lifeTime.isValidFlag==1)
  {
    value.lifeTime.value = C2xGetTokenInt(packetHandle, "VIR", newPath);
    result = CheckLastError("VIR", gkFuncRefGet, result);
  }
  return result;
}

int SetVIRDriveRequestParams(LONG packetHandle, struct VIRDriveRequest value, char oldPath[])
{
  char newPath[300];
  int result;

  result = 0;

  snprintf(newPath, elcount(newPath), "%s.%s", oldPath, "reqID");
  C2xSetTokenInt(packetHandle, "VIR", newPath, value.reqID);
  result = CheckLastError("VIR", gkFuncRefGet, result);

  snprintf(newPath, elcount(newPath), "%s.%s", oldPath, "status");
  C2xSetTokenInt(packetHandle, "VIR", newPath, value.status);
  result = CheckLastError("VIR", gkFuncRefGet, result);

  snprintf(newPath, elcount(newPath), "%s.%s", oldPath, "reqPriority");
  if(value.reqPriority.isValidFlag==1)
  {
    C2xSetTokenData(packetHandle, "VIR", newPath, value.reqPriority.stringLength, value.reqPriority.string);
  }
  else
  {
    if( C2xIsTokenAvailable(packetHandle, "VIR", newPath) )
    {
      C2xRemoveToken(packetHandle, "VIR", newPath);
    }
  }

  snprintf(newPath, elcount(newPath), "%s.%s", oldPath, "targetVeh");
  if(value.targetVeh.isValidFlag==1)
  {
    C2xSetTokenData(packetHandle, "VIR", newPath, value.targetVeh.stringLength, value.targetVeh.string);
  }
  else
  {
    if( C2xIsTokenAvailable(packetHandle, "VIR", newPath) )
    {
      C2xRemoveToken(packetHandle, "VIR", newPath);
    }
  }

  snprintf(newPath, elcount(newPath), "%s.%s", oldPath, "targetRSU");
  if(value.targetRSU.isValidFlag==1)
  {
    C2xSetTokenData(packetHandle, "VIR", newPath, value.targetRSU.stringLength, value.targetRSU.string);
  }
  else
  {
    if( C2xIsTokenAvailable(packetHandle, "VIR", newPath) )
    {
      C2xRemoveToken(packetHandle, "VIR", newPath);
    }
  }

  snprintf(newPath, elcount(newPath), "%s.%s", oldPath, "info");
  if(value.info.isValidFlag==1)
  {
    SetVIRReqInfoParams(packetHandle, value.info, newPath);
    result = CheckLastError("VIR", gkFuncRefGet, result);
  }
  else
  {
    if( C2xIsTokenAvailable(packetHandle, "VIR", newPath) )
    {
      C2xRemoveToken(packetHandle, "VIR", newPath);
    }
  }

  snprintf(newPath, elcount(newPath), "%s.%s", oldPath, "lifeTime");
  if(value.lifeTime.isValidFlag==1)
  {
    if (value.lifeTime.value < 1)
    {
        C2xSetTokenInt(packetHandle, "VIR", newPath, 1);
    }
    else if (value.lifeTime.value > 65535)
    {
        C2xSetTokenInt(packetHandle, "VIR", newPath, 65535);
    }
    else
    {
        C2xSetTokenInt(packetHandle, "VIR", newPath, value.lifeTime.value);
    }
    result = CheckLastError("VIR", gkFuncRefGet, result);
  }
  else
  {
    if( C2xIsTokenAvailable(packetHandle, "VIR", newPath) )
    {
      C2xRemoveToken(packetHandle, "VIR", newPath);
    }
  }

  return result;
}

int GetVIRIARData_reqsParams(LONG packetHandle, struct VIRIARData_reqs value, char oldPath[])
{
  char newPath[300]; 
  int i;
  int result;

  result = 0;

  value.length = C2xGetTokenInt(packetHandle, "VIR", oldPath);
  if((result = CheckLastError("VIR", gkFuncRefGet, result))==0)
  {
    for(i=0; i<value.length; i++)
    {
      snprintf(newPath, elcount(newPath), "%s[%d]", oldPath, i);
      GetVIRDriveRequestParams(packetHandle, value.arrayValue[i], newPath);
      result = CheckLastError("VIR", gkFuncRefGet, result);
    }
  }
  return result;
}

int SetVIRIARData_reqsParams(LONG packetHandle, struct VIRIARData_reqs value, char oldPath[])
{
  char newPath[300]; 
  int i;
  int result;

  result = 0;

  C2xRemoveToken(packetHandle, "VIR", oldPath);
  for(i=0; i<value.length; i++)
  {
    snprintf(newPath, elcount(newPath), "%s[%d]", oldPath, i);
    SetVIRDriveRequestParams(packetHandle, value.arrayValue[i], newPath);
    result = CheckLastError("VIR", gkFuncRefGet, result);
  }
  return result;
}

int GetVIRIARDataParams(LONG packetHandle, struct VIRIARData value, char oldPath[])
{
  char newPath[300]; 
  int j; 
  int k;
  int result;

  result = 0;

  snprintf(newPath, elcount(newPath), "%s.%s", oldPath, "currentPos");
  value.currentPos.isValidFlag = C2xIsTokenAvailable(packetHandle, "VIR", newPath);
  if(value.currentPos.isValidFlag==1)
  {
    GetVIRPathPlanningPointParams(packetHandle, value.currentPos, newPath);
    result = CheckLastError("VIR", gkFuncRefGet, result);
  }
  snprintf(newPath, elcount(newPath), "%s.%s", oldPath, "path_Planning");
  value.path_Planning.isValidFlag = C2xIsTokenAvailable(packetHandle, "VIR", newPath);
  if(value.path_Planning.isValidFlag==1)
  {
    GetVIRPathPlanningParams(packetHandle, value.path_Planning, newPath);
    result = CheckLastError("VIR", gkFuncRefGet, result);
  }
  snprintf(newPath, elcount(newPath), "%s.%s", oldPath, "currentBehavior");
  value.currentBehavior.isValidFlag = C2xIsTokenAvailable(packetHandle, "VIR", newPath);
  if(value.currentBehavior.isValidFlag==1)
  {
    value.currentBehavior.isValidFlag = 1;
    value.currentBehavior.stringLength = C2xGetTokenLengthBit(packetHandle, "VIR", newPath);
    if ((result = CheckLastError("VIR", gkFuncRefGet, result))==0)
    {
      if(value.currentBehavior.stringLength > 0)
      {
        for(j=0; j<value.currentBehavior.stringLength; j++)
        {
          if(C2xGetTokenBitOfBitString(packetHandle, "VIR", newPath, j) == 0)
          {
            value.currentBehavior.string[j] = '0';
          }
          else if(C2xGetTokenBitOfBitString(packetHandle, "VIR", newPath, j) == 1)
          {
            value.currentBehavior.string[j] = '1';
          }

          if(value.currentBehavior.stringLength == 1)
          {
            value.currentBehavior.string[1] = '0';
          }
          result = CheckLastError("VIR", gkFuncRefGet, result);
        }
      }
      else
      {
        for(k = value.currentBehavior.stringLength+1; k > -1; k--)
        {
          if(value.currentBehavior.string[k] == '1')
          {
            value.currentBehavior.string[k] = '0';
          }
        }
      }
    }

  }
  snprintf(newPath, elcount(newPath), "%s.%s", oldPath, "reqs");
  value.reqs.isValidFlag = C2xIsTokenAvailable(packetHandle, "VIR", newPath);
  if(value.reqs.isValidFlag==1)
  {
    GetVIRIARData_reqsParams(packetHandle, value.reqs, newPath);
    result = CheckLastError("VIR", gkFuncRefGet, result);
  }
  return result;
}

int SetVIRIARDataParams(LONG packetHandle, struct VIRIARData value, char oldPath[])
{
  char newPath[300]; 
  int j;
  int result;

  result = 0;

  snprintf(newPath, elcount(newPath), "%s.%s", oldPath, "currentPos");
  if(value.currentPos.isValidFlag==1)
  {
    SetVIRPathPlanningPointParams(packetHandle, value.currentPos, newPath);
    result = CheckLastError("VIR", gkFuncRefGet, result);
  }
  else
  {
    if( C2xIsTokenAvailable(packetHandle, "VIR", newPath) )
    {
      C2xRemoveToken(packetHandle, "VIR", newPath);
    }
  }

  snprintf(newPath, elcount(newPath), "%s.%s", oldPath, "path_Planning");
  if(value.path_Planning.isValidFlag==1)
  {
    SetVIRPathPlanningParams(packetHandle, value.path_Planning, newPath);
    result = CheckLastError("VIR", gkFuncRefGet, result);
  }
  else
  {
    if( C2xIsTokenAvailable(packetHandle, "VIR", newPath) )
    {
      C2xRemoveToken(packetHandle, "VIR", newPath);
    }
  }

  snprintf(newPath, elcount(newPath), "%s.%s", oldPath, "currentBehavior");
  if(value.currentBehavior.isValidFlag==1)
  {
      for(j=0; j<value.currentBehavior.stringLength; j++)
      {
        if(value.currentBehavior.string[j] == '0')
        {
          C2xSetTokenBitOfBitString(packetHandle, "VIR", newPath, j, 0);
        }
        else
        {
          C2xSetTokenBitOfBitString(packetHandle, "VIR", newPath, j, 1);
        }
        result = CheckLastError("VIR", gkFuncRefGet, result);
      }
  }
  else
  {
    if( C2xIsTokenAvailable(packetHandle, "VIR", newPath) )
    {
      C2xRemoveToken(packetHandle, "VIR", newPath);
    }
  }

  snprintf(newPath, elcount(newPath), "%s.%s", oldPath, "reqs");
  if(value.reqs.isValidFlag==1)
  {
    SetVIRIARData_reqsParams(packetHandle, value.reqs, newPath);
    result = CheckLastError("VIR", gkFuncRefGet, result);
  }
  else
  {
    if( C2xIsTokenAvailable(packetHandle, "VIR", newPath) )
    {
      C2xRemoveToken(packetHandle, "VIR", newPath);
    }
  }

  return result;
}

int GetVIRVehIntentionAndRequestParams(LONG packetHandle, struct VIRVehIntentionAndRequest value, char oldPath[])
{
  char newPath[300];
  int result;

  result = 0;

  snprintf(newPath, elcount(newPath), "%s.%s", oldPath, "msgCnt");
  value.msgCnt = C2xGetTokenInt(packetHandle, "VIR", newPath);
  result = CheckLastError("VIR", gkFuncRefGet, result);

  snprintf(newPath, elcount(newPath), "%s.%s", oldPath, "id");
  value.id.stringLength = C2xGetTokenData(packetHandle, "VIR", newPath, elcount(value.id.string), value.id.string);
  snprintf(newPath, elcount(newPath), "%s.%s", oldPath, "secMark");
  value.secMark = C2xGetTokenInt(packetHandle, "VIR", newPath);
  result = CheckLastError("VIR", gkFuncRefGet, result);

  snprintf(newPath, elcount(newPath), "%s.%s", oldPath, "refPos");
  GetVIRPosition3DParams(packetHandle, value.refPos, newPath);
  result = CheckLastError("VIR", gkFuncRefGet, result);

  snprintf(newPath, elcount(newPath), "%s.%s", oldPath, "intAndReq");
  GetVIRIARDataParams(packetHandle, value.intAndReq, newPath);
  result = CheckLastError("VIR", gkFuncRefGet, result);

  return result;
}

int SetVIRVehIntentionAndRequestParams(LONG packetHandle, struct VIRVehIntentionAndRequest value, char oldPath[])
{
  char newPath[300];
  int result;

  result = 0;

  snprintf(newPath, elcount(newPath), "%s.%s", oldPath, "msgCnt");
  C2xSetTokenInt(packetHandle, "VIR", newPath, value.msgCnt);
  result = CheckLastError("VIR", gkFuncRefGet, result);

  if(value.id.stringLength == 0)
  {
    value.id.stringLength = 8;
    memcpy(value.id.string, "00000000", value.id.stringLength);
  }

  snprintf(newPath, elcount(newPath), "%s.%s", oldPath, "id");
  C2xSetTokenData(packetHandle, "VIR", newPath, value.id.stringLength, value.id.string);

  snprintf(newPath, elcount(newPath), "%s.%s", oldPath, "secMark");
  C2xSetTokenInt(packetHandle, "VIR", newPath, value.secMark);
  result = CheckLastError("VIR", gkFuncRefGet, result);

  snprintf(newPath, elcount(newPath), "%s.%s", oldPath, "refPos");
  SetVIRPosition3DParams(packetHandle, value.refPos, newPath);
  result = CheckLastError("VIR", gkFuncRefGet, result);

  snprintf(newPath, elcount(newPath), "%s.%s", oldPath, "intAndReq");
  SetVIRIARDataParams(packetHandle, value.intAndReq, newPath);
  result = CheckLastError("VIR", gkFuncRefGet, result);

  return result;
}

int GetVIRMessageTypesParams(LONG packetHandle, WORD tableKey, struct VIRMessageTypes value, char oldPath[])
{
  char newPath[300];
  int result;

  result = 0;

  switch(tableKey)
  {
    case 13:
    {
      snprintf(newPath, elcount(newPath), "%s.%s", oldPath, "virData");
      GetVIRVehIntentionAndRequestParams(packetHandle, value.virData, newPath);
      result = CheckLastError("VIR", gkFuncRefGet, result);
    }
    break;
  }
  return result;
}

int SetVIRMessageTypesParams(LONG packetHandle, WORD tableKey, struct VIRMessageTypes value, char oldPath[])
{
  char newPath[300];
  int result;

  result = 0;

  switch(tableKey)
  {
    case 13:
    {
      snprintf(newPath, elcount(newPath), "%s.%s", oldPath, "virData");
      SetVIRVehIntentionAndRequestParams(packetHandle, value.virData, newPath);
      result = CheckLastError("VIR", gkFuncRefGet, result);
    }
    break;
  }
  return result;
}

int GetVIRMessageFrameExtParams(LONG packetHandle, struct VIRMessageFrameExt value, char oldPath[])
{
  char newPath[300];
  int result;

  result = 0;

  snprintf(newPath, elcount(newPath), "%s.%s", oldPath, "messageId");
  value.messageId = C2xGetTokenInt(packetHandle, "VIR", newPath);
  result = CheckLastError("VIR", gkFuncRefGet, result);

  snprintf(newPath, elcount(newPath), "%s.%s", oldPath, "value");
  GetVIRMessageTypesParams(packetHandle, value.messageId, value.value, newPath);
  result = CheckLastError("VIR", gkFuncRefGet, result);

  return result;
}

int SetVIRMessageFrameExtParams(LONG packetHandle, struct VIRMessageFrameExt value, char oldPath[])
{
  char newPath[300];
  int result;

  result = 0;


  snprintf(newPath, elcount(newPath), "%s.%s", oldPath, "value");
  SetVIRMessageTypesParams(packetHandle, value.messageId, value.value, newPath);
  result = CheckLastError("VIR", gkFuncRefGet, result);

  return result;
}

int API_GetVIRParams(LONG packetHandle, struct VIR value)
{
  int result;
  result = 0;

  value.msgFrameExt.isValidFlag = 1;
  GetVIRMessageFrameExtParams(packetHandle, value.msgFrameExt, "msgFrameExt");
  result = CheckLastError("VIR", gkFuncRefGet, result);

  return result;
}

int API_SetVIRParams(LONG packetHandle, struct VIR value)
{
  int result;
  result = 0;

  SetVIRMessageFrameExtParams(packetHandle, value.msgFrameExt, "msgFrameExt");
  result = CheckLastError("VIR", gkFuncRefGet, result);

  return result;
}

