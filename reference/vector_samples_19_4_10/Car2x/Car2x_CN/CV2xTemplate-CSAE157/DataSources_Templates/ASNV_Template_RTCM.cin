/*@!Encoding:1252*/
/*
//  (c) Vector Informatik GmbH. All rights reserved.
//
//  This file contains definitions of structs and methods that may be used
//  to set and get the values of an ASN.1 defined packet's payload.
//
//  //This example demonstrates how to set a packet's payload:
//  LONG packetHandle;
//  struct RTCM payload;
//  //you need to set the values of the variable "payload" yourself
//  packetHandle = API_InitRTCMPacket();
//  if (packetHandle!=0) {
//    if (API_SetRTCMParams(packetHandle, payload)==0) {
//      if (C2xCompletePacket(packetHandle)==0) {
//        C2xOutputPacket(packetHandle);
//      }
//    }
//  }
//                                                                             */
includes
{
}
variables
{
    struct RTCMRTCM_Payload {
        INT isValidFlag;   // necessary if this struct is used as an optional field of a SEQUENCE
        CHAR string[1024];
        INT  stringLength;
    };
    
    struct RTCMRTCMmsg {
        INT isValidFlag;   // necessary if this struct is used as an optional field of a SEQUENCE
        struct OPT_ENUM_ASN rev;  // ENUMERATED, OPTIONAL, unknown(0), reserved(1), rtcmCMR(2), rtcmCMR_Plus(3), rtcmSAPOS(4), rtcmSAPOS_Adv(5), rtcmRTCA(6), rtcmRAW(7), rtcmRINEX(8), rtcmSP3(9), rtcmBINEX(10), rtcmRev2_x(19), rtcmRev2_0(20), rtcmRev2_1(21), rtcmRev2_3(23), rtcmRev3_0(30), rtcmRev3_1(31), rtcmRev3_2(32);
        struct OPT_WORD_ASN rtcmID;  // INTEGER, OPTIONAL, 0..32767;
        struct RTCMRTCM_Payload payload;  // OCTETSTRING;
    };
    
    struct RTCMRTCMcorrections_corrections {
        INT isValidFlag;   // necessary if this struct is used as an optional field of a SEQUENCE
        INT length;
        struct RTCMRTCMmsg arrayValue[5];  // SEQUENCE;
    };
    
    struct RTCMRTCMcorrections {
        INT isValidFlag;   // necessary if this struct is used as an optional field of a SEQUENCE
        BYTE msgCnt;  // INTEGER, 0..127;
        struct RTCMRTCMcorrections_corrections corrections;  // SEQUENCEOF;
    };
    
    struct RTCMMessageTypes {
        struct RTCMRTCMcorrections rtcmData;  // SEQUENCE;
    };
    
    struct RTCMMessageFrameExt {
        INT isValidFlag;   // necessary if this struct is used as an optional field of a SEQUENCE
        WORD messageId;  // INTEGER, 0..32767;
        struct RTCMMessageTypes value;  // TABLE;
    };
    
    struct RTCM {
        INT isValidFlag;   // necessary if this struct is used as an optional field of a SEQUENCE
        INT choice;
        struct RTCMMessageFrameExt msgFrameExt;  // SEQUENCE;
    };
    
}

/*
// init function to create a simple packet handle
*/ 
LONG API_InitRTCMPacket()
{
  return C2xInitPacket("RTCM"); 
}

/*
// init function to create a simple packet handle and
// initialize the struct with valid data
*/ 
LONG API_InitRTCMPacket(struct RTCM msgStruct)
{
  long pktHandle;

  pktHandle = API_InitRTCMPacket();

  if (pktHandle != 0)
  {
    // create valid message and application data
    if (C2xCompletePacket(pktHandle) == 0) 
    {
      API_GetRTCMParams(pktHandle, msgStruct);
    }
  }
  return pktHandle;
}

/*
// init function to create a packet with security layer and
// initialize the struct with valid data
*/ 
LONG API_InitRTCMPacket(struct RTCM msgStruct, char packetTypeDesignator[], char certificateName[])
{
  long pktHandle, certHdl;

  // initialize the packet
  pktHandle = C2xInitPacket("RTCM", packetTypeDesignator);

  if (pktHandle != 0)
  {
    certHdl = C2xSecCertificateGetHandle(certificateName);  // get the certificate handle for the cert with name "certificateName"
    if (certHdl != 0) 
    {
      C2xSecPacketSetSignerHandle(pktHandle, certHdl); // set the certHdl to the packet
    }

    // create valid message and application data
    if (C2xCompletePacket(pktHandle) == 0) 
    {
      // copy application data to the application structure
      API_GetRTCMParams(pktHandle, msgStruct);
    }
  }
  return pktHandle;
}
    

int GetRTCMRTCMmsgParams(LONG packetHandle, struct RTCMRTCMmsg value, char oldPath[])
{
  char newPath[300];
  int result;

  result = 0;

  snprintf(newPath, elcount(newPath), "%s.%s", oldPath, "rev");
  value.rev.isValidFlag = C2xIsTokenAvailable(packetHandle, "RTCM", newPath);
  if(value.rev.isValidFlag==1)
  {
    value.rev.value = C2xGetTokenInt(packetHandle, "RTCM", newPath);
    result = CheckLastError("RTCM", gkFuncRefGet, result);
  }
  snprintf(newPath, elcount(newPath), "%s.%s", oldPath, "rtcmID");
  value.rtcmID.isValidFlag = C2xIsTokenAvailable(packetHandle, "RTCM", newPath);
  if(value.rtcmID.isValidFlag==1)
  {
    value.rtcmID.value = C2xGetTokenInt(packetHandle, "RTCM", newPath);
    result = CheckLastError("RTCM", gkFuncRefGet, result);
  }
  snprintf(newPath, elcount(newPath), "%s.%s", oldPath, "payload");
  value.payload.stringLength = C2xGetTokenData(packetHandle, "RTCM", newPath, elcount(value.payload.string), value.payload.string);
  return result;
}

int SetRTCMRTCMmsgParams(LONG packetHandle, struct RTCMRTCMmsg value, char oldPath[])
{
  char newPath[300];
  int result;

  result = 0;

  snprintf(newPath, elcount(newPath), "%s.%s", oldPath, "rev");
  if(value.rev.isValidFlag==1)
  {
    C2xSetTokenInt(packetHandle, "RTCM", newPath, value.rev.value);
    result = CheckLastError("RTCM", gkFuncRefGet, result);
  }
  else
  {
    if( C2xIsTokenAvailable(packetHandle, "RTCM", newPath) )
    {
      C2xRemoveToken(packetHandle, "RTCM", newPath);
    }
  }

  snprintf(newPath, elcount(newPath), "%s.%s", oldPath, "rtcmID");
  if(value.rtcmID.isValidFlag==1)
  {
    C2xSetTokenInt(packetHandle, "RTCM", newPath, value.rtcmID.value);
    result = CheckLastError("RTCM", gkFuncRefGet, result);
  }
  else
  {
    if( C2xIsTokenAvailable(packetHandle, "RTCM", newPath) )
    {
      C2xRemoveToken(packetHandle, "RTCM", newPath);
    }
  }

  snprintf(newPath, elcount(newPath), "%s.%s", oldPath, "payload");
  C2xSetTokenData(packetHandle, "RTCM", newPath, value.payload.stringLength, value.payload.string);

  return result;
}

int GetRTCMRTCMcorrections_correctionsParams(LONG packetHandle, struct RTCMRTCMcorrections_corrections value, char oldPath[])
{
  char newPath[300]; 
  int i;
  int result;

  result = 0;

  value.length = C2xGetTokenInt(packetHandle, "RTCM", oldPath);
  if((result = CheckLastError("RTCM", gkFuncRefGet, result))==0)
  {
    for(i=0; i<value.length; i++)
    {
      snprintf(newPath, elcount(newPath), "%s[%d]", oldPath, i);
      GetRTCMRTCMmsgParams(packetHandle, value.arrayValue[i], newPath);
      result = CheckLastError("RTCM", gkFuncRefGet, result);
    }
  }
  return result;
}

int SetRTCMRTCMcorrections_correctionsParams(LONG packetHandle, struct RTCMRTCMcorrections_corrections value, char oldPath[])
{
  char newPath[300]; 
  int i;
  int result;

  result = 0;

  C2xRemoveToken(packetHandle, "RTCM", oldPath);
  for(i=0; i<value.length; i++)
  {
    snprintf(newPath, elcount(newPath), "%s[%d]", oldPath, i);
    SetRTCMRTCMmsgParams(packetHandle, value.arrayValue[i], newPath);
    result = CheckLastError("RTCM", gkFuncRefGet, result);
  }
  return result;
}

int GetRTCMRTCMcorrectionsParams(LONG packetHandle, struct RTCMRTCMcorrections value, char oldPath[])
{
  char newPath[300];
  int result;

  result = 0;

  snprintf(newPath, elcount(newPath), "%s.%s", oldPath, "msgCnt");
  value.msgCnt = C2xGetTokenInt(packetHandle, "RTCM", newPath);
  result = CheckLastError("RTCM", gkFuncRefGet, result);

  snprintf(newPath, elcount(newPath), "%s.%s", oldPath, "corrections");
  GetRTCMRTCMcorrections_correctionsParams(packetHandle, value.corrections, newPath);
  result = CheckLastError("RTCM", gkFuncRefGet, result);

  return result;
}

int SetRTCMRTCMcorrectionsParams(LONG packetHandle, struct RTCMRTCMcorrections value, char oldPath[])
{
  char newPath[300];
  int result;

  result = 0;

  snprintf(newPath, elcount(newPath), "%s.%s", oldPath, "msgCnt");
  C2xSetTokenInt(packetHandle, "RTCM", newPath, value.msgCnt);
  result = CheckLastError("RTCM", gkFuncRefGet, result);

  snprintf(newPath, elcount(newPath), "%s.%s", oldPath, "corrections");
  SetRTCMRTCMcorrections_correctionsParams(packetHandle, value.corrections, newPath);
  result = CheckLastError("RTCM", gkFuncRefGet, result);

  return result;
}

int GetRTCMMessageTypesParams(LONG packetHandle, WORD tableKey, struct RTCMMessageTypes value, char oldPath[])
{
  char newPath[300];
  int result;

  result = 0;

  switch(tableKey)
  {
    case 10:
    {
      snprintf(newPath, elcount(newPath), "%s.%s", oldPath, "rtcmData");
      GetRTCMRTCMcorrectionsParams(packetHandle, value.rtcmData, newPath);
      result = CheckLastError("RTCM", gkFuncRefGet, result);
    }
    break;
  }
  return result;
}

int SetRTCMMessageTypesParams(LONG packetHandle, WORD tableKey, struct RTCMMessageTypes value, char oldPath[])
{
  char newPath[300];
  int result;

  result = 0;

  switch(tableKey)
  {
    case 10:
    {
      snprintf(newPath, elcount(newPath), "%s.%s", oldPath, "rtcmData");
      SetRTCMRTCMcorrectionsParams(packetHandle, value.rtcmData, newPath);
      result = CheckLastError("RTCM", gkFuncRefGet, result);
    }
    break;
  }
  return result;
}

int GetRTCMMessageFrameExtParams(LONG packetHandle, struct RTCMMessageFrameExt value, char oldPath[])
{
  char newPath[300];
  int result;

  result = 0;

  snprintf(newPath, elcount(newPath), "%s.%s", oldPath, "messageId");
  value.messageId = C2xGetTokenInt(packetHandle, "RTCM", newPath);
  result = CheckLastError("RTCM", gkFuncRefGet, result);

  snprintf(newPath, elcount(newPath), "%s.%s", oldPath, "value");
  GetRTCMMessageTypesParams(packetHandle, value.messageId, value.value, newPath);
  result = CheckLastError("RTCM", gkFuncRefGet, result);

  return result;
}

int SetRTCMMessageFrameExtParams(LONG packetHandle, struct RTCMMessageFrameExt value, char oldPath[])
{
  char newPath[300];
  int result;

  result = 0;


  snprintf(newPath, elcount(newPath), "%s.%s", oldPath, "value");
  SetRTCMMessageTypesParams(packetHandle, value.messageId, value.value, newPath);
  result = CheckLastError("RTCM", gkFuncRefGet, result);

  return result;
}

int API_GetRTCMParams(LONG packetHandle, struct RTCM value)
{
  int result;
  result = 0;

  value.msgFrameExt.isValidFlag = 1;
  GetRTCMMessageFrameExtParams(packetHandle, value.msgFrameExt, "msgFrameExt");
  result = CheckLastError("RTCM", gkFuncRefGet, result);

  return result;
}

int API_SetRTCMParams(LONG packetHandle, struct RTCM value)
{
  int result;
  result = 0;

  SetRTCMMessageFrameExtParams(packetHandle, value.msgFrameExt, "msgFrameExt");
  result = CheckLastError("RTCM", gkFuncRefGet, result);

  return result;
}

