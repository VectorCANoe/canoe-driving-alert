/*@!Encoding:1252*/
/*
//  (c) Vector Informatik GmbH. All rights reserved.
//
//  This file contains definitions of structs and methods that may be used
//  to set and get the values of an ASN.1 defined packet's payload.
//
//  //This example demonstrates how to set a packet's payload:
//  LONG packetHandle;
//  struct CLPMM payload;
//  //you need to set the values of the variable "payload" yourself
//  packetHandle = API_InitCLPMMPacket();
//  if (packetHandle!=0) {
//    if (API_SetCLPMMParams(packetHandle, payload)==0) {
//      if (C2xCompletePacket(packetHandle)==0) {
//        C2xOutputPacket(packetHandle);
//      }
//    }
//  }
//                                                                             */
includes
{
}
variables
{
    struct CLPMMCLPMM_id {
        INT isValidFlag;   // necessary if this struct is used as an optional field of a SEQUENCE
        CHAR string[9];
        INT  stringLength;
    };
    
    struct CLPMMCLPMM_pid {
        INT isValidFlag;   // necessary if this struct is used as an optional field of a SEQUENCE
        CHAR string[18];
        INT  stringLength;
    };
    
    struct CLPMMMemberNode_vid {
        INT isValidFlag;   // necessary if this struct is used as an optional field of a SEQUENCE
        CHAR string[9];
        INT  stringLength;
    };
    
    struct CLPMMMemberNode {
        INT isValidFlag;   // necessary if this struct is used as an optional field of a SEQUENCE
        struct CLPMMMemberNode_vid vid;  // OCTETSTRING;
    };
    
    struct CLPMMMemberList {
        INT isValidFlag;   // necessary if this struct is used as an optional field of a SEQUENCE
        INT length;
        struct CLPMMMemberNode arrayValue[32];  // SEQUENCE;
    };
    
    struct CLPMMMemberManagement {
        INT isValidFlag;   // necessary if this struct is used as an optional field of a SEQUENCE
        struct CLPMMMemberList memberList;  // SEQUENCEOF;
        struct CLPMMMemberList joiningList;  // SEQUENCEOF, OPTIONAL;
        struct CLPMMMemberList leavingList;  // SEQUENCEOF, OPTIONAL;
        BYTE capacity;  // INTEGER, 1..32;
        INT openToJoin;  // BOOLEAN;
    };
    
    struct CLPMMPlatooning_CLPMM {
        INT isValidFlag;   // necessary if this struct is used as an optional field of a SEQUENCE
        BYTE msgCnt;  // INTEGER, 0..127;
        struct CLPMMCLPMM_id id;  // OCTETSTRING;
        WORD secMark;  // INTEGER, 0..65535;
        struct CLPMMCLPMM_pid pid;  // OCTETSTRING;
        INT role;  // ENUMERATED, leader(0), follower(1), tail(2), free_vehicle(3);
        INT status;  // ENUMERATED, navigating(0), beginToDissmiss(1), askForJoining(2), joining(3), following(4), askForLeaving(5), leaving(6);
        struct CLPMMMemberManagement leadingExt;  // SEQUENCE, OPTIONAL;
    };
    
    struct CLPMMMessageTypes {
        struct CLPMMPlatooning_CLPMM clpmmData;  // SEQUENCE;
    };
    
    struct CLPMMMessageFrameExt {
        INT isValidFlag;   // necessary if this struct is used as an optional field of a SEQUENCE
        WORD messageId;  // INTEGER, 0..32767;
        struct CLPMMMessageTypes value;  // TABLE;
    };
    
    struct CLPMM {
        INT isValidFlag;   // necessary if this struct is used as an optional field of a SEQUENCE
        INT choice;
        struct CLPMMMessageFrameExt msgFrameExt;  // SEQUENCE;
    };
    
}

/*
// init function to create a simple packet handle
*/ 
LONG API_InitCLPMMPacket()
{
  return C2xInitPacket("CLPMM"); 
}

/*
// init function to create a simple packet handle and
// initialize the struct with valid data
*/ 
LONG API_InitCLPMMPacket(struct CLPMM msgStruct)
{
  long pktHandle;

  pktHandle = API_InitCLPMMPacket();

  if (pktHandle != 0)
  {
    // create valid message and application data
    if (C2xCompletePacket(pktHandle) == 0) 
    {
      API_GetCLPMMParams(pktHandle, msgStruct);
    }
  }
  return pktHandle;
}

/*
// init function to create a packet with security layer and
// initialize the struct with valid data
*/ 
LONG API_InitCLPMMPacket(struct CLPMM msgStruct, char packetTypeDesignator[], char certificateName[])
{
  long pktHandle, certHdl;

  // initialize the packet
  pktHandle = C2xInitPacket("CLPMM", packetTypeDesignator);

  if (pktHandle != 0)
  {
    certHdl = C2xSecCertificateGetHandle(certificateName);  // get the certificate handle for the cert with name "certificateName"
    if (certHdl != 0) 
    {
      C2xSecPacketSetSignerHandle(pktHandle, certHdl); // set the certHdl to the packet
    }

    // create valid message and application data
    if (C2xCompletePacket(pktHandle) == 0) 
    {
      // copy application data to the application structure
      API_GetCLPMMParams(pktHandle, msgStruct);
    }
  }
  return pktHandle;
}
    

int GetCLPMMMemberNodeParams(LONG packetHandle, struct CLPMMMemberNode value, char oldPath[])
{
  char newPath[300];
  char buffer[300];
  int result;

  result = 0;

  snprintf(newPath, elcount(newPath), "%s.%s", oldPath, "vid");
  value.vid.stringLength = C2xGetTokenData(packetHandle, "CLPMM", newPath, elcount(value.vid.string), value.vid.string);
  return result;
}

int SetCLPMMMemberNodeParams(LONG packetHandle, struct CLPMMMemberNode value, char oldPath[])
{
  char newPath[300];
  char buffer[300];
  int result;

  result = 0;

  snprintf(newPath, elcount(newPath), "%s.%s", oldPath, "vid");
  C2xSetTokenData(packetHandle, "CLPMM", newPath, value.vid.stringLength, value.vid.string);

  return result;
}

int GetCLPMMMemberListParams(LONG packetHandle, struct CLPMMMemberList value, char oldPath[])
{
  char newPath[300]; 
  int i;
  int result;

  result = 0;

  value.length = C2xGetTokenInt(packetHandle, "CLPMM", oldPath);
  if((result = CheckLastError("CLPMM", gkFuncRefGet, result))==0)
  {
    for(i=0; i<value.length; i++)
    {
      snprintf(newPath, elcount(newPath), "%s[%d]", oldPath, i);
      GetCLPMMMemberNodeParams(packetHandle, value.arrayValue[i], newPath);
      result = CheckLastError("CLPMM", gkFuncRefGet, result);
    }
  }
  return result;
}

int SetCLPMMMemberListParams(LONG packetHandle, struct CLPMMMemberList value, char oldPath[])
{
  char newPath[300]; 
  int i;
  int result;

  result = 0;

  C2xRemoveToken(packetHandle, "CLPMM", oldPath);
  for(i=0; i<value.length; i++)
  {
    snprintf(newPath, elcount(newPath), "%s[%d]", oldPath, i);
    SetCLPMMMemberNodeParams(packetHandle, value.arrayValue[i], newPath);
    result = CheckLastError("CLPMM", gkFuncRefGet, result);
  }
  return result;
}

int GetCLPMMMemberManagementParams(LONG packetHandle, struct CLPMMMemberManagement value, char oldPath[])
{
  char newPath[300];
  int result;

  result = 0;

  snprintf(newPath, elcount(newPath), "%s.%s", oldPath, "memberList");
  GetCLPMMMemberListParams(packetHandle, value.memberList, newPath);
  result = CheckLastError("CLPMM", gkFuncRefGet, result);

  snprintf(newPath, elcount(newPath), "%s.%s", oldPath, "joiningList");
  value.joiningList.isValidFlag = C2xIsTokenAvailable(packetHandle, "CLPMM", newPath);
  if(value.joiningList.isValidFlag==1)
  {
    GetCLPMMMemberListParams(packetHandle, value.joiningList, newPath);
    result = CheckLastError("CLPMM", gkFuncRefGet, result);
  }
  snprintf(newPath, elcount(newPath), "%s.%s", oldPath, "leavingList");
  value.leavingList.isValidFlag = C2xIsTokenAvailable(packetHandle, "CLPMM", newPath);
  if(value.leavingList.isValidFlag==1)
  {
    GetCLPMMMemberListParams(packetHandle, value.leavingList, newPath);
    result = CheckLastError("CLPMM", gkFuncRefGet, result);
  }
  snprintf(newPath, elcount(newPath), "%s.%s", oldPath, "capacity");
  value.capacity = C2xGetTokenInt(packetHandle, "CLPMM", newPath);
  result = CheckLastError("CLPMM", gkFuncRefGet, result);

  snprintf(newPath, elcount(newPath), "%s.%s", oldPath, "openToJoin");
  value.openToJoin = C2xGetTokenInt64(packetHandle, "CLPMM", newPath);
  result = CheckLastError("CLPMM", gkFuncRefGet, result);

  return result;
}

int SetCLPMMMemberManagementParams(LONG packetHandle, struct CLPMMMemberManagement value, char oldPath[])
{
  char newPath[300];
  int result;

  result = 0;

  snprintf(newPath, elcount(newPath), "%s.%s", oldPath, "memberList");
  SetCLPMMMemberListParams(packetHandle, value.memberList, newPath);
  result = CheckLastError("CLPMM", gkFuncRefGet, result);

  snprintf(newPath, elcount(newPath), "%s.%s", oldPath, "joiningList");
  if(value.joiningList.isValidFlag==1)
  {
    SetCLPMMMemberListParams(packetHandle, value.joiningList, newPath);
    result = CheckLastError("CLPMM", gkFuncRefGet, result);
  }
  else
  {
    if( C2xIsTokenAvailable(packetHandle, "CLPMM", newPath) )
    {
      C2xRemoveToken(packetHandle, "CLPMM", newPath);
    }
  }

  snprintf(newPath, elcount(newPath), "%s.%s", oldPath, "leavingList");
  if(value.leavingList.isValidFlag==1)
  {
    SetCLPMMMemberListParams(packetHandle, value.leavingList, newPath);
    result = CheckLastError("CLPMM", gkFuncRefGet, result);
  }
  else
  {
    if( C2xIsTokenAvailable(packetHandle, "CLPMM", newPath) )
    {
      C2xRemoveToken(packetHandle, "CLPMM", newPath);
    }
  }

  snprintf(newPath, elcount(newPath), "%s.%s", oldPath, "capacity");
  if (value.capacity < 1)
  {
    C2xSetTokenInt(packetHandle, "CLPMM", newPath, 1);
  }
  else if (value.capacity > 32)
  {
    C2xSetTokenInt(packetHandle, "CLPMM", newPath, 32);
  }
  else
  {
    C2xSetTokenInt(packetHandle, "CLPMM", newPath, value.capacity);
  }
  result = CheckLastError("CLPMM", gkFuncRefGet, result);

  snprintf(newPath, elcount(newPath), "%s.%s", oldPath, "openToJoin");
  C2xSetTokenInt64(packetHandle, "CLPMM", newPath, value.openToJoin);
  result = CheckLastError("CLPMM", gkFuncRefGet, result);

  return result;
}

int GetCLPMMPlatooning_CLPMMParams(LONG packetHandle, struct CLPMMPlatooning_CLPMM value, char oldPath[])
{
  char newPath[300];
  int result;

  result = 0;

  snprintf(newPath, elcount(newPath), "%s.%s", oldPath, "msgCnt");
  value.msgCnt = C2xGetTokenInt(packetHandle, "CLPMM", newPath);
  result = CheckLastError("CLPMM", gkFuncRefGet, result);

  snprintf(newPath, elcount(newPath), "%s.%s", oldPath, "id");
  value.id.stringLength = C2xGetTokenData(packetHandle, "CLPMM", newPath, elcount(value.id.string), value.id.string);
  snprintf(newPath, elcount(newPath), "%s.%s", oldPath, "secMark");
  value.secMark = C2xGetTokenInt(packetHandle, "CLPMM", newPath);
  result = CheckLastError("CLPMM", gkFuncRefGet, result);

  snprintf(newPath, elcount(newPath), "%s.%s", oldPath, "pid");
  value.pid.stringLength = C2xGetTokenData(packetHandle, "CLPMM", newPath, elcount(value.pid.string), value.pid.string);
  snprintf(newPath, elcount(newPath), "%s.%s", oldPath, "role");
  value.role = C2xGetTokenInt(packetHandle, "CLPMM", newPath);
  result = CheckLastError("CLPMM", gkFuncRefGet, result);

  snprintf(newPath, elcount(newPath), "%s.%s", oldPath, "status");
  value.status = C2xGetTokenInt(packetHandle, "CLPMM", newPath);
  result = CheckLastError("CLPMM", gkFuncRefGet, result);

  snprintf(newPath, elcount(newPath), "%s.%s", oldPath, "leadingExt");
  value.leadingExt.isValidFlag = C2xIsTokenAvailable(packetHandle, "CLPMM", newPath);
  if(value.leadingExt.isValidFlag==1)
  {
    GetCLPMMMemberManagementParams(packetHandle, value.leadingExt, newPath);
    result = CheckLastError("CLPMM", gkFuncRefGet, result);
  }
  return result;
}

int SetCLPMMPlatooning_CLPMMParams(LONG packetHandle, struct CLPMMPlatooning_CLPMM value, char oldPath[])
{
  char newPath[300];
  int result;

  result = 0;

  snprintf(newPath, elcount(newPath), "%s.%s", oldPath, "msgCnt");
  C2xSetTokenInt(packetHandle, "CLPMM", newPath, value.msgCnt);
  result = CheckLastError("CLPMM", gkFuncRefGet, result);

  if(value.id.stringLength == 0)
  {
    value.id.stringLength = 8;
    memcpy(value.id.string, "00000000", value.id.stringLength);
  }

  snprintf(newPath, elcount(newPath), "%s.%s", oldPath, "id");
  C2xSetTokenData(packetHandle, "CLPMM", newPath, value.id.stringLength, value.id.string);

  snprintf(newPath, elcount(newPath), "%s.%s", oldPath, "secMark");
  C2xSetTokenInt(packetHandle, "CLPMM", newPath, value.secMark);
  result = CheckLastError("CLPMM", gkFuncRefGet, result);

  snprintf(newPath, elcount(newPath), "%s.%s", oldPath, "pid");
  C2xSetTokenData(packetHandle, "CLPMM", newPath, value.pid.stringLength, value.pid.string);

  snprintf(newPath, elcount(newPath), "%s.%s", oldPath, "role");
  C2xSetTokenInt(packetHandle, "CLPMM", newPath, value.role);
  result = CheckLastError("CLPMM", gkFuncRefGet, result);

  snprintf(newPath, elcount(newPath), "%s.%s", oldPath, "status");
  C2xSetTokenInt(packetHandle, "CLPMM", newPath, value.status);
  result = CheckLastError("CLPMM", gkFuncRefGet, result);

  snprintf(newPath, elcount(newPath), "%s.%s", oldPath, "leadingExt");
  if(value.leadingExt.isValidFlag==1)
  {
    SetCLPMMMemberManagementParams(packetHandle, value.leadingExt, newPath);
    result = CheckLastError("CLPMM", gkFuncRefGet, result);
  }
  else
  {
    if( C2xIsTokenAvailable(packetHandle, "CLPMM", newPath) )
    {
      C2xRemoveToken(packetHandle, "CLPMM", newPath);
    }
  }

  return result;
}

int GetCLPMMMessageTypesParams(LONG packetHandle, WORD tableKey, struct CLPMMMessageTypes value, char oldPath[])
{
  char newPath[300];
  int result;

  result = 0;

  switch(tableKey)
  {
    case 16:
    {
      snprintf(newPath, elcount(newPath), "%s.%s", oldPath, "clpmmData");
      GetCLPMMPlatooning_CLPMMParams(packetHandle, value.clpmmData, newPath);
      result = CheckLastError("CLPMM", gkFuncRefGet, result);
    }
    break;
  }
  return result;
}

int SetCLPMMMessageTypesParams(LONG packetHandle, WORD tableKey, struct CLPMMMessageTypes value, char oldPath[])
{
  char newPath[300];
  int result;

  result = 0;

  switch(tableKey)
  {
    case 16:
    {
      snprintf(newPath, elcount(newPath), "%s.%s", oldPath, "clpmmData");
      SetCLPMMPlatooning_CLPMMParams(packetHandle, value.clpmmData, newPath);
      result = CheckLastError("CLPMM", gkFuncRefGet, result);
    }
    break;
  }
  return result;
}

int GetCLPMMMessageFrameExtParams(LONG packetHandle, struct CLPMMMessageFrameExt value, char oldPath[])
{
  char newPath[300];
  int result;

  result = 0;

  snprintf(newPath, elcount(newPath), "%s.%s", oldPath, "messageId");
  value.messageId = C2xGetTokenInt(packetHandle, "CLPMM", newPath);
  result = CheckLastError("CLPMM", gkFuncRefGet, result);

  snprintf(newPath, elcount(newPath), "%s.%s", oldPath, "value");
  GetCLPMMMessageTypesParams(packetHandle, value.messageId, value.value, newPath);
  result = CheckLastError("CLPMM", gkFuncRefGet, result);

  return result;
}

int SetCLPMMMessageFrameExtParams(LONG packetHandle, struct CLPMMMessageFrameExt value, char oldPath[])
{
  char newPath[300];
  int result;

  result = 0;


  snprintf(newPath, elcount(newPath), "%s.%s", oldPath, "value");
  SetCLPMMMessageTypesParams(packetHandle, value.messageId, value.value, newPath);
  result = CheckLastError("CLPMM", gkFuncRefGet, result);

  return result;
}

int API_GetCLPMMParams(LONG packetHandle, struct CLPMM value)
{
  int result;
  result = 0;

  value.msgFrameExt.isValidFlag = 1;
  GetCLPMMMessageFrameExtParams(packetHandle, value.msgFrameExt, "msgFrameExt");
  result = CheckLastError("CLPMM", gkFuncRefGet, result);

  return result;
}

int API_SetCLPMMParams(LONG packetHandle, struct CLPMM value)
{
  int result;
  result = 0;

  SetCLPMMMessageFrameExtParams(packetHandle, value.msgFrameExt, "msgFrameExt");
  result = CheckLastError("CLPMM", gkFuncRefGet, result);

  return result;
}

