/*@!Encoding:1252*/
includes
{
  #include "..\DataSources_Templates\ASNV_Template_BaseDatatypes.cin"
  #include "..\DataSources_Templates\ASNV_Template_MAP.cin"
  #include "..\DataSources_Templates\ASNV_Template_SPAT.cin"

  #include "Car2xAPI.cin"
  #include "SimRsuTL.cin"
}

////////////////////////////////////////////////////////////////////////////////
// Variables
////////////////////////////////////////////////////////////////////////////////
variables
{
  byte gFirstMap = 1;
  byte gFirstSpat = 1;
  
  long gTimeSinceLastSpat = 0;
  msTimer spatTimer;
  
  double IntersectionGeoLatitude = 48.8251459;
  double IntersectionGeoLongitude = 9.0962190;
}

////////////////////////////////////////////////////////////////////////////////
// start / init packet
////////////////////////////////////////////////////////////////////////////////
on start
{
  C2xRegisterCallback(kRxIndication   , "OnRx");
  C2xRegisterCallback(kPreTxIndication, "OnTxSPAT", "SPAT") ;
  
  setTimerCyclic(spatTimer, 1000);
  
  DisableIntersection();
}

void OnScenarioStateChanged(long newState)
{
  if(newState == 3) // Completed
  {
    gFirstMap = 1;
    gFirstSpat = 1;
  }
}

////////////////////////////////////////////////////////////////////////////////
// On Rx
////////////////////////////////////////////////////////////////////////////////
void OnRx(LONG channel, LONG dir, LONG radioChannel, LONG signalStrength, LONG sigQuality, LONG packet)
{
  struct Pos2D pos2d;
  // station info
  long stationHdl ;
  char stationName[128] ;

  stationHdl = C2xGetStationHandle(packet) ;
  C2xGetStationName(stationHdl, elcount(stationName), stationName) ;

  if ((dir == RX) &&
      !strncmp(stationName, "DuT", elcount(stationName))) // received from DUT
  {
    pos2d.latitude = IntersectionGeoLatitude;
    pos2d.longitude = IntersectionGeoLongitude;

    if (API_PosCalcDistance(packet, pos2d) <= @sysVar::DUT::Horizont)
    {
      C2xEnableMsg("MAP") ;
      c2xEnableMsg("SPAT") ;
    }
    else
    {
      DisableIntersection();
    }
  }
}

////////////////////////////////////////////////////////////////////////////////
// SPAT
////////////////////////////////////////////////////////////////////////////////

void OnTxSPAT(long packet)
{
  struct SPAT spatPdu ;
  
  gTimeSinceLastSpat = 0;

  API_GetSPATParams(packet, spatPdu) ;

  UpdateSpat(spatPdu, 5, 0, signalGroup_1);
  UpdateSpat(spatPdu, 4, 1, signalGroup_2);

  API_SetSPATParams(packet, spatPdu) ;
  
  UpdateTrafficLightPanel(0);
}

on timer spatTimer
{
  if (gTimeSinceLastSpat++ > 3)
  {
    UpdateTrafficLightPanel(1);
  }
}

void UpdateTrafficLightPanel(byte timeoutReached)
{
  int signalGroup;
  signalGroup = @sysvar::RSU_TrafficLight::SignalGroup - 1;
  
  if (timeoutReached)
  {
    @sysvar::RSU_TrafficLight::State = -1;
    @sysvar::RSU_TrafficLight::TimeToSwitch = 0.0;
  }
  else if (@sysvar::RSU_TrafficLight::Intersection == 1)
  {
    @sysvar::RSU_TrafficLight::State = signalGroup_1[signalGroup].states[signalGroup_1[signalGroup].currentStateIndex];
    @sysvar::RSU_TrafficLight::TimeToSwitch = (double)signalGroup_1[signalGroup].nextStateChange / 10;
  }
  else if (@sysvar::RSU_TrafficLight::Intersection == 2)
  {
    if (@sysvar::RSU_TrafficLight::SignalGroup < 5)
    {
      @sysvar::RSU_TrafficLight::State = signalGroup_2[signalGroup].states[signalGroup_2[signalGroup].currentStateIndex];
      @sysvar::RSU_TrafficLight::TimeToSwitch = (double)signalGroup_2[signalGroup].nextStateChange / 10;
    }
    else
    {
      @sysvar::RSU_TrafficLight::State = -1;
      @sysvar::RSU_TrafficLight::TimeToSwitch = 0.0;
    }
  }
}

////////////////////////////////////////////////////////////////////////////////
// EOF
////////////////////////////////////////////////////////////////////////////////
