/*@!Encoding:1252*/
includes
{
  #include "Car2xAPI.cin"
  #include "..\DataSources_Templates\ASNV_Template_BaseDatatypes.cin"
  #include "..\DataSources_Templates\ASNV_Template_DENM.cin"
}

////////////////////////////////////////////////////////////////////////////////
// Variables
////////////////////////////////////////////////////////////////////////////////
variables
{
  struct RSU_RWW_T
  {
    double Latitude;
    double Longitude;
    double Elevation;
    long Heading;
    long Speed;
  };

  struct RSU_RWW_T RSU_RWW_Ctx =
  {
    /* Latitude */ 48.824975,
    /* Longitude */ 9.103284,
    /* Elevation */ 301.4,
    /* Heading */ 0,
    /* Speed */ 0
  };
}

////////////////////////////////////////////////////////////////////////////////
// start / init packet
////////////////////////////////////////////////////////////////////////////////
on start
{
  C2xRegisterCallback(kRxIndication   , "OnRx");
  C2xRegisterCallback(kPreTxIndication, "OnPreTxDENM" , "DENM" ) ;
}

////////////////////////////////////////////////////////////////////////////////
// On Rx
////////////////////////////////////////////////////////////////////////////////
void OnRx(LONG channel, LONG dir, LONG radioChannel, LONG signalStrength, LONG sigQuality, LONG packet)
{
  struct Pos2D pos2d;
  long stationHdl ;
  char stationName[128] ;

  stationHdl = C2xGetStationHandle(packet) ;
  C2xGetStationName(stationHdl, elcount(stationName), stationName) ;

  if ((dir == RX) &&
      !strncmp(stationName, "DuT", elcount(stationName))) // received from DuT
  {
    pos2d.latitude  = RSU_RWW_Ctx.Latitude ;
    pos2d.longitude = RSU_RWW_Ctx.Longitude;

    if (API_PosCalcDistance(packet, pos2d) <= @sysVar::DUT::Horizont)
    {
      If(!C2xIsMsgEnabled("DENM"))
      {
        C2xEnableMsg("DENM") ;
      }
    }
    else
    {
      if(C2xIsMsgEnabled("DENM"))
      {
        C2xDisableMsg("DENM") ;
      }
    }
  }
}

////////////////////////////////////////////////////////////////////////////////
// DENM
////////////////////////////////////////////////////////////////////////////////
void OnPreTxDENM(long packet)
{ 
  struct DENM denm;
  int relevanceArea = 0;
  
  // GEO-CH
  C2xSetTokenInt(packet, "geo_ch", "flags", 0);
  
  // GEO-EH
  C2xSetTokenInt64(packet, "geo_eh", "lpvTimeStamp", C2xConvertTimeToMSSinceUTC(C2xGetITSTimestamp(), 0));
  
  C2xSetTokenInt(packet, "geo_eh", "lpvGNAddrStationType", 15);
  
  C2xSetTokenInt64(packet, "geo_eh", "lpvLatitude", RSU_RWW_Ctx.Latitude *1e7);
  C2xSetTokenInt64(packet, "geo_eh", "lpvLongitude", RSU_RWW_Ctx.Longitude *1e7);
  
  switch(@sysvar::RSU_RoadWorksWarning::RelevanceDistance)
  {
    case 0: relevanceArea =    50; break;
    case 1: relevanceArea =   100; break;
    case 2: relevanceArea =   200; break;
    case 3: relevanceArea =   500; break;
    case 4: relevanceArea =  1000; break;
    case 5: relevanceArea =  5000; break;
    case 6: relevanceArea = 10000; break;
    case 7: relevanceArea = 15000; break;
  }
  
  C2xSetTokenInt(packet, "geo_eh", "distanceA", relevanceArea);
  
  // DENM
  API_GetDENMParams(packet, denm);
  
  // DENM - Management
  denm.denm.management.relevanceDistance.value = @sysvar::RSU_RoadWorksWarning::RelevanceDistance;
  denm.denm.management.relevanceTrafficDirection.value = @sysvar::RSU_RoadWorksWarning::RelevanceDirection;
  
  // DENM - Situation
  denm.denm.situation.eventType.subCauseCode = @sysvar::RSU_RoadWorksWarning::SubCauseCode;
  
  // DENM - AlaCarte
  denm.denm.alacarte.isValidFlag = 1;
  denm.denm.alacarte.roadWorks.isValidFlag = 1;
  denm.denm.alacarte.roadWorks.trafficFlowRule.isValidFlag = 1;
  denm.denm.alacarte.roadWorks.trafficFlowRule.value = @sysvar::RSU_RoadWorksWarning::TrafficFlowRule;
  
  API_SetDENMParams(packet, denm);
}

////////////////////////////////////////////////////////////////////////////////
// EOF
////////////////////////////////////////////////////////////////////////////////
