/*@!Encoding:1252*/
includes
{
  #include "ProtocolAnalyzerTestReporting.cin"
}

variables
{
  mstimer sendTimerCAN;
  float gSpeed;
  float gAcceleration;
  int64 gBrakeActive;
}


export LoadAndStartScenario(char scenarioName[])
{
  if(C2xLoadScenario(scenarioName))
  {
    testStepPass("Scenario loaded");
  }
  else
  {
    testStepFail("Loading Scenario failed");
  }
  
  if(C2xStartScenario())
  {
    testStepPass("Scenario started");
  }
  else
  {
    testStepFail("Starting Scenario failed");
  }
}

export TC_EEBL_TestWaitForMessage(float lSpeed, float lAcceleration, int64 lEEBLExpected)
{
  long packet;
  C2xDisableMsg("DENM","DUT");
  gAcceleration = lAcceleration;
  gSpeed = lSpeed;
  setTimer(sendTimerCAN, 50); //Send CAM Message in 50 ms
  if(C2xTestWaitForMessage("DENM", "DUT", 100))
  {
    if(lEEBLExpected)
    {
      testStepPass("DENM received");
      if(C2xTestGetWaitForMessage(packet)== 0)
      {
        if(C2xGetTokenInt(packet,"DENM", "denm.situation.eventType.causeCode") == 99 && 
          C2xGetTokenInt(packet,"DENM", "denm.situation.eventType.subCauseCode") == 1)
        {
          testStepPass("DENM causecode is correct");
        }
        else
        {
          testStepFail("DENM causecode is  not correct");
        }
      }
      else
      {
        testStepFail("Failed to retrieve waited message");
      }
    }
    else
    {
      testStepFail("DENM received, but no DENM expected");
    }
  }
  else
  {
    if(lEEBLExpected)
    {
      testStepFail("DENM expected, but no DENM received");
    }
    else
    {
      testStepPass("No DENM expected and no DENM received");
    }
  }
}

export TC_EEBL_TestWaitForSignal(float lSpeed, float lAcceleration, int64 lEEBLExpected)
{
  long packet;
  gAcceleration = lAcceleration;
  gSpeed = lSpeed;
  setTimer(sendTimerCAN, 50); //Send CAN Message in 50 ms
  if(C2xTestWaitForSignalMatch("DENM","denm.situation.eventType.causeCode", 99,"DUT", 100))
  {
    if(lEEBLExpected)
    {
      testStepPass("DENM with right causecode is received");
    }
    else
    {
       testStepFail(" No DENM with right causecode was received");
    }
  }
  else
  {
    if(lEEBLExpected)
    {
      testStepFail("DENM expected, but no DENM  with right causecode was received");
    }
    else
    {
      testStepPass("No DENM expected and no DENM with right causecode received");
    }
  }
}

export TC_Scenario_CAM_DENM_TestJoinMessage()
{
  long packet;
  long index;
  C2xTestJoinMessage("CAM", "DUT");
  index = C2xTestJoinMessage("DENM", "DUT");
  if(testWaitForAllJoinedEvents(2000))
  {
    testStepPass("DUT sends DENM and CAM.");
    if(C2xTestGetWaitForMessage(index, packet)==0)
    {
      if(C2xGetTokenInt(packet,"DENM", "denm.situation.eventType.causeCode") == 91 && 
          C2xGetTokenInt(packet,"DENM", "denm.situation.eventType.subCauseCode") == 1)
        {
          testStepPass("DENM causecode is correct");
        }
        else
        {
          testStepFail("DENM causecode is  not correct");
        }
    }
    else
    {
      testStepFail("Failed to retrieve DENM");
    }
  }
  else
  {
    testStepFail("DUT sends no DENM or no CAM.");
  }
}

export TC_Scenario_Positions_TestJoinSignals()
{
  C2xTestJoinSignalInRange("geo_eh","lpvLatitude",48.8246 *10000000, 48.825 *10000000, "DUT");
  C2xTestJoinSignalInRange("geo_eh","lpvLongitude",9.09 *10000000, 9.1 *10000000, "DUT");
  
  C2xTestJoinSignalInRange("geo_eh","lpvLatitude",48.8246 *10000000, 48.825 *10000000, "Station1");
  C2xTestJoinSignalInRange("geo_eh","lpvLongitude",9.09 *10000000, 9.1 *10000000, "Station1");
  
  C2xTestJoinSignalInRange("geo_eh","lpvLatitude",48.8246 *10000000, 48.825 *10000000, "Station2");
  C2xTestJoinSignalInRange("geo_eh","lpvLongitude",9.09 *10000000, 9.1 *10000000, "Station2");

  if(testWaitForAllJoinedEvents(30000))
  {
    testStepPass("All Stations have the right Position");
  }
  else
  {
    testStepFail("Atleast one station has a wrong Position");
  }
}

on timer sendTimerCAN
{
  message StatusInfo msg;
  message BrakeInfo msg2;
  msg.Acceleration = gAcceleration;
  msg.Speed = gSpeed;
  output(msg);
}

on sysvar ShowPAErrorsInTestReport
{
  ProtocolAnalyzerEnableTestReporting(@this);
}

export ConfigureProtocolAnalyzerOutput()
{
  ProtocolAnalyzerEnableTestReporting(@ShowPAErrorsInTestReport);
  TestReportAddProtocolAnalyzerRuleList();
}