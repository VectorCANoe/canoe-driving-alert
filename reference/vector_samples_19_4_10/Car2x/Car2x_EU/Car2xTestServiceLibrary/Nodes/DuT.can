/*@!Encoding:1252*/
variables
{
  // Vector HQ
  long lat = 48.825227 * 10000000;
  long lon = 9.095847 * 10000000;
}

on start
{
  enum CallbackType { OnRx, PreTx };
  C2xRegisterCallback(PreTx, "OnPreTxCAM", "CAM");
  C2xRegisterCallback(PreTx, "OnPreTxDENM", "DENM");
}

void OnPreTxCAM(LONG packet)
{
  if(!C2xIsScenarioStarted())
  {
    C2xSetTokenInt(packet, "geo_eh", "lpvLatitude", lat);
    C2xSetTokenInt(packet, "geo_eh", "lpvLongitude", lon);
    C2xSetTokenInt64(packet, "CAM", "cam.camParameters.basicContainer.referencePosition.latitude", lat);
    C2xSetTokenInt64(packet, "CAM","cam.camParameters.basicContainer.referencePosition.longitude", lon);
  

  }
}

void OnPreTxDENM(LONG packet)
{
  if(!C2xIsScenarioStarted())
  {
    C2xSetTokenInt(packet, "geo_ch", "tcID", 0);

    C2xSetTokenInt(packet, "geo_eh", "distanceA", 500);
    C2xSetTokenInt(packet, "geo_eh", "lpvLatitude", lat);
    C2xSetTokenInt(packet, "geo_eh", "lpvLongitude", lon);
    C2xSetTokenInt(packet, "geo_eh", "areaPosLatitude", lat);
    C2xSetTokenInt(packet, "geo_eh", "areaPosLongitude", lon);    

    C2xSetTokenInt64(packet, "DENM", "denm.management.eventPosition.latitude", lat);
    C2xSetTokenInt64(packet, "DENM","denm.management.eventPosition.longitude", lon);
    C2xSetTokenInt64(packet, "DENM","denm.management.validityDuration", 2);
    C2xSetTokenInt64(packet, "DENM","denm.management.relevanceDistance", 3);
                     
    C2xSetTokenInt64(packet, "DENM", "denm.situation.eventType.causeCode", 99);      // Dangerous Situation
    C2xSetTokenInt64(packet, "DENM", "denm.situation.eventType.subCauseCode", 1);    // Emergency Electronic Brake Light
  }
}

void OnScenarioStateChanged(long newState)
{
  //Sceanrio is completed or stopped
  if(newState == 2 || newState == 3)
  {
    C2xStopNode();
  }
}

//Handle incoming CAN
on message StatusInfo
{
  if (this.Speed > 5.55 && this.Acceleration < -7)                      // 5.55 m/s = ~ 20 km/h
  {
    C2xEnableMsg("DENM");
  }
  else
  {
    C2xDisableMsg("DENM");
  }
}

