VERSION ""

NS_ :

BS_:

BU_:

BO_ 257 StatusInfo: 8 Vector__XXX
 SG_ Acceleration : 32|32@1- (1,0) [0|0] "" Vector__XXX
 SG_ Speed : 0|32@1- (1,0) [0|0] "" Vector__XXX

BO_ 256 BrakeInfo: 1 Vector__XXX
 SG_ BrakeActive : 0|8@1+ (1,0) [0|0] "" Vector__XXX

BA_DEF_  "BusType" STRING ;
BA_DEF_DEF_  "BusType" "CAN";
SIG_VALTYPE_ 257 Acceleration : 1;
SIG_VALTYPE_ 257 Speed : 1;
