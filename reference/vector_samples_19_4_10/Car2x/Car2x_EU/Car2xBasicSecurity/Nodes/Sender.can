/*@!Encoding:1252*/
includes
{
  
}

variables
{
  long pktCamHdl;      // CAM message
  long pktDenmHdl;     // DENM message
  
  long certValidHdl;   // valid certificate
  long certInvalidHdl; // invalid certificate

  long shVersion ;          // either 111                or 121                         or 131
  char shPcolDesc[16] ;     // either "geo_sh"           or "geo_sh_121"                or "wssv3"
  char shPcolAttrCam[32]  ; // either "BTP-B|TSB-SHB|SH" or "BTP-B|TSB-SHB|SH_121"      or "BTP-B|TSB-SHB|WSS_V3"
  char shPcolAttrDenm[32] ; // either "BTP-A|GBC|SH"     or "BTP-A|GBC|SH_121"          or "BTP-A|GBC|WSS_V3"
}


on start
{
  //Set parameters for security
  shVersion = 131 ;
  strncpy(shPcolDesc    , "wssv3"          , elcount(shPcolDesc    )) ;
  strncpy(shPcolAttrCam , "BTP-B|TSB-SHB|WSS_V3", elcount(shPcolAttrCam )) ;
  strncpy(shPcolAttrDenm, "BTP-A|GBC|WSS_V3"    , elcount(shPcolAttrDenm)) ;
  SysSetVariableString(sysvar::ShVersion, "ETSI 103 097 1.3.1") ;
  
  // initialize CAM, DENM message
  pktCamHdl  = C2xInitPacket("CAM",  shPcolAttrCam );
  pktDenmHdl = C2xInitPacket("DENM", shPcolAttrDenm);
  
  // get certificates
  certValidHdl   = C2xSecCertificateGetHandle("OBU (1)");
  certInvalidHdl = C2xSecCertificateGetHandle("Vector Demo ITS PC Invalid");
}


on sysvar CAM::Send
{
  long certHdl;
  
  if (@this)
  {
    // set signer certificate and signer type
    certHdl = (@CAM::Certificate == @CAM::Certificate::Valid) ? certValidHdl : certInvalidHdl ;
    C2xSecPacketSetSignerHandle(pktCamHdl, certHdl);
    C2xSetTokenInt(pktCamHdl, shPcolDesc, "signerType", @CAM::Type);
    
    // set station ID
    C2xSetTokenInt(pktCamHdl, "CAM", "header.stationID", 1);

    // set fields mandatory for CAM security profile
    C2xSetTokenInt64(pktCamHdl, shPcolDesc, "generationTime", C2xConvertTimeToMSSinceUTC(C2xGetITSTimestamp(), 0)*1000); 
    C2xSetTokenInt(pktCamHdl, shPcolDesc, "psid", 0x24) ;

    
    // encode, sign and output message
    C2xCompletePacket(pktCamHdl);
    C2xOutputPacket(pktCamHdl);
  }
}


on sysvar DENM::Send
{
  long certHdl;
  
  if (@this)
  {
    // set signer certificate and signer type
    certHdl = (@DENM::Certificate == @DENM::Certificate::Valid) ? certValidHdl : certInvalidHdl ;
    C2xSecPacketSetSignerHandle(pktDenmHdl, certHdl);
    C2xSetTokenInt(pktDenmHdl, shPcolDesc, "signerType", @DENM::Type);
    
    // set station ID
    C2xSetTokenInt(pktDenmHdl, "DENM", "header.stationID", 1);
    
    // set fields mandatory for DENM security profile
    C2xSetTokenInt64(pktDenmHdl, shPcolDesc, "generationTime", C2xConvertTimeToMSSinceUTC(C2xGetITSTimestamp(), 0)*1000); 
    C2xSetTokenInt(pktDenmHdl, shPcolDesc, "psid", 0x25) ;
 
    
    // encode, sign and output message
    C2xCompletePacket(pktDenmHdl);
    C2xOutputPacket(pktDenmHdl);
  }
}

