/*@!Encoding:1252*/
includes
{
  #include "DataSources_Templates\ASNV_Template_BaseDatatypes.cin"
  #include "DataSources_Templates\ASNV_Template_CAM.cin"
  #include "DataSources_Templates\ASNV_Template_DENM.cin"
}

variables
{
  char testerName[50] = "DuT";
  msTimer DENMtimer;
  msTimer stopTestTimer;
  long gStationHandle;
  
  int cycleTime95 = 275;
  int cycleTime15 = 1100;
}

/** used PA customRules:
60001, "Wrong IncidentIndication"
60002, "Wrong VehicleRole"
60003, "IncidentIndication missing."
60004, "Wrong DENM cycle time"
60005, "Wrong DENM cycle time" - Specific CC/SCC
60006, "Changed VehicleRole"
60007, "SpecialVehicleContainer missing"
60008, "Wrong InformationQuality"
**/
on preStart
{
  enum CallbackType { OnRx };
  
  C2xRegisterCallback(OnRx,  "OnRxCAM",    "CAM");
  C2xRegisterCallback(OnRx,  "OnRxDENM",    "DENM");
}

on timer DENMtimer
{
  char buffer[100];
  int cycleTime;
  if (@DENM::InitialCC == 95)
  {
    cycleTime = cycleTime95;
  }
  else
  {
    cycleTime = cycleTime15;
  }
  snprintf(buffer,elcount(buffer), "DENM expected after %i ms, but none received.", cycleTime);
  C2xReportProtocolViolation(gStationHandle, 1, "SpecialVehicle|DENM|CustomRules", 60004, "Wrong DENM cycle time", "Wrong DENM cycle time", buffer); 
}

void CheckTooEarlyDENM()
{
  char buffer[100];
  int maxTimeToElapse, cycleTime, actualCycleTime;
  if (@DENM::InitialCC == 95)
  {
    cycleTime = cycleTime95;
  }
  else
  {
    cycleTime = cycleTime15;
  }
  maxTimeToElapse = 0.1 * cycleTime;
  actualCycleTime = cycleTime - DENMtimer.timeToElapse();
  
  if (DENMtimer.timeToElapse() > maxTimeToElapse)
  {
    snprintf(buffer,elcount(buffer), "DENM expected after minimal %i ms, but received after %i ms.", 0.9 * cycleTime, actualCycleTime);
    C2xReportProtocolViolation(gStationHandle, 1, "SpecialVehicle|DENM|CustomRules", 60004, "Wrong DENM cycle time", "Wrong DENM cycle time", buffer); 
  }
}

on timer stopTestTimer
{
  @TestConfiguration::StopTest_Called = 1;
  @TestConfiguration::StopType = 3;
}

// Callback function on receiving DENM messages
void OnRxDENM(long channel, long dir, long radioChannel, long signalStrength, long signalQuality, long packet)
{
  char stationName[100];
  char buffer[100];
  struct DENM myDENM;
  long stationHandle;
  
  if (@TestConfiguration::TestState != 2)
  {
    return;
  }
  stationHandle = C2xGetStationHandle(packet);

  if (stationHandle > 0)
  {
    C2xGetStationName(stationHandle, elcount(stationName), stationName);

    if (strncmp(stationName, testerName, elcount(testerName) + 1) == 0)
    {    
      API_GetDENMParams(packet, myDENM);
      TestInformationQuality();
      // CC, sCC, stationtype
      if (myDENM.denm.situation.eventType.causeCode == @DENM::InitialCC && myDENM.denm.situation.eventType.causeCode == @DENM::InitialSCC)
      {
        if (DENMtimer.isRunning())
        {
          CheckTooEarlyDENM();
        }
        if (@DENM::InitialCC == 95)
        {
          cancelTimer(DENMtimer);
          setTimer(DENMtimer, cycleTime95);
        }
        else
        {
          cancelTimer(DENMtimer);
          setTimer(DENMtimer, cycleTime15);
        }
      }
      // stop test if 3s no DENM
      cancelTimer(stopTestTimer);
      setTimer(stopTestTimer, 3000);
    }
  }
}

// Callback function on receiving CAM messages
void OnRxCAM(long channel, long dir, long radioChannel, long signalStrength, long signalQuality, long packet)
{
  char stationName[100];
  struct CAM myCAM;
  long stationHandle;
  if (@TestConfiguration::TestState != 2)
  {
    return;
  }
  
  gStationHandle = C2xGetStationHandle(packet);
  if (gStationHandle > 0)
  {
    C2xGetStationName(gStationHandle, elcount(stationName), stationName);

    if (strncmp(stationName, testerName, elcount(testerName) + 1) == 0)
    {
      API_GetCAMParams(packet, myCAM);  
      if (myCAM.cam.camParameters.lowFrequencyContainer.isValidFlag == 1)
      {
        if (myCAM.cam.camParameters.lowFrequencyContainer.basicVehicleContainerLowFrequency.vehicleRole != @DENM::lnitialVehicleRole)
        {
          ReportChangedVehicleRole(myCAM.cam.camParameters.lowFrequencyContainer.basicVehicleContainerLowFrequency.vehicleRole);
        }
        
        if (myCAM.cam.camParameters.specialVehicleContainer.isValidFlag == 0)
        {
           C2xReportProtocolViolation(gStationHandle, 1, "SpecialVehicle|DENM|CustomRules", 60007, "SpecialVehicleContainer missing", "SpecialVehicleContainer missing", "SpecialVehicleContainer expected with LowFrequencyContainer, but missing");
        }
      }
      if (@DENMvalues::CauseCode != -1)
      {
        TestSpecialVehicleInformation(myCAM);
      }
    }
  }
}

void TestInformationQuality()
{
  int expectedIQ;
  char buffer[100];
  if (@DENMvalues::CauseCode != 95)
  {
    // skip this check
    return;
  }

  if (@CAMValues::SirenInUse == 0)
  {
    if (@DENMvalues::EventSpeed <= 1.5)
    {
      expectedIQ = 1;
    }
    else
    {
      expectedIQ = 3;
    }
  }
  else
  {
    if (@DENMvalues::EventSpeed <= 1.5)
    {
      expectedIQ = 2;
    }
    else
    {
      expectedIQ = 4;
    }
  }

  if (expectedIQ != @DENMvalues::InformationQuality)
  {
    snprintf(buffer,elcount(buffer), "InformationQuality with SirenInUse=%i and EventSpeed=%f is expected to be %i, but is %i.", @CAMValues::SirenInUse, @DENMvalues::EventSpeed, expectedIQ, @DENMvalues::InformationQuality);
    C2xReportProtocolViolation(gStationHandle, 1, "SpecialVehicle|DENM|CustomRules", 60008, "Wrong InformationQuality", "Wrong InformationQuality", buffer); 
  }
}

void TestSpecialVehicleInformation(struct CAM myCAM)
{
  char buffer[100];
  char vehicleRole[100];
  char vehicleRoleDescription[100];
 
  if (@CAMValues::VehicleRole != 5)
  {
    if (@CAMValues::IncidentSCC == -1 || @CAMValues::IncidentCC == -1)
    {
      ReportIncidentIndicationMissing();
    }
    else if (@DENMvalues::CauseCode != @CAMValues::IncidentCC || @DENMvalues::SubCauseCode != @CAMValues::IncidentSCC)
    {
      ReportWrongIncidentIndication();
    }
  }
  
  // emergencyVehicle
  if (@DENMvalues::SubCauseCode == 1)
  {
    if (@CAMValues::VehicleRole != 6)
    {
      ReportWrongVehicleRole(6);
    }
  }
  // safetyCar / rescue
  else if (@DENMvalues::SubCauseCode == 0)
  {
    if (@DENMvalues::CauseCode == 95 && @CAMValues::VehicleRole != 7)
    {
      ReportWrongVehicleRole(7);
    }
    else if (@CAMValues::VehicleRole != 7 && @CAMValues::VehicleRole != 5)
    {
      sysGetVariableDescriptionForValue("CAMValues", "VehicleRole", @CAMValues::VehicleRole, vehicleRoleDescription, elcount(vehicleRoleDescription));
    
      snprintf(buffer,elcount(buffer), "VehicleRole should be 5(rescue) or 7(safetyCar), but is %i(%s)", @CAMValues::VehicleRole, vehicleRoleDescription);
      C2xReportProtocolViolation(gStationHandle, 0, "SpecialVehicle|DENM|CustomRules", 60002, "Wrong VehicleRole", "Wrong VehicleRole", buffer); 
    }
  }
}

// Incident Indication
void ReportWrongIncidentIndication()
{
  char buffer[100];
  snprintf(buffer,elcount(buffer), "IncidentIndication should be %i / %i, but is %i / %i", @DENMvalues::CauseCode, @DENMvalues::SubCauseCode, @CAMValues::IncidentCC, @CAMValues::IncidentSCC);
  C2xReportProtocolViolation(gStationHandle, 1, "SpecialVehicle|DENM|CustomRules", 60001, "Wrong IncidentIndication", "Wrong IncidentIndication", buffer);     
}
void ReportIncidentIndicationMissing()
{
  char buffer[100];
  C2xReportProtocolViolation(gStationHandle, 1, "SpecialVehicle|DENM|CustomRules", 60003, "IncidentIndication missing.", "IncidentIndication expected, but missing.", "IncidentIndication including CauseCode and SubCauseCode expected in SpecialVehicleContainer, but missing.");     
}

// VehicleRole
void ReportWrongVehicleRole(long expectedRole)
{
  char buffer[100];
  char vehicleRoleDescription[100];
  char expectedVehicleRoleDescr[100];
  
  sysGetVariableDescriptionForValue("CAMValues", "VehicleRole", @CAMValues::VehicleRole, vehicleRoleDescription, elcount(vehicleRoleDescription));
  sysGetVariableDescriptionForValue("CAMValues", "VehicleRole", expectedRole, expectedVehicleRoleDescr, elcount(expectedVehicleRoleDescr));

  snprintf(buffer,elcount(buffer), "VehicleRole should be %i(%s), but is %i(%s)", expectedRole, expectedVehicleRoleDescr, @CAMValues::VehicleRole, vehicleRoleDescription);
  C2xReportProtocolViolation(gStationHandle, 0, "SpecialVehicle|DENM|CustomRules", 60002, "Wrong VehicleRole", "Wrong VehicleRole", buffer); 
}

void ReportChangedVehicleRole(long currentRole)
{
  char buffer[100];
  char vehicleRoleDescription[100];
  char currentRoleDescr[100];
  
  sysGetVariableDescriptionForValue("CAMValues", "VehicleRole", @DENM::lnitialVehicleRole, vehicleRoleDescription, elcount(vehicleRoleDescription));
  sysGetVariableDescriptionForValue("CAMValues", "VehicleRole", currentRole, currentRoleDescr, elcount(currentRoleDescr));

  snprintf(buffer,elcount(buffer), "VehicleRole was %i(%s), but is now %i(%s)", @DENM::lnitialVehicleRole, vehicleRoleDescription, currentRole, currentRoleDescr);
  C2xReportProtocolViolation(gStationHandle, 1, "SpecialVehicle|DENM|CustomRules", 60006, "Changed VehicleRole", "Changed VehicleRole", buffer);   
}

