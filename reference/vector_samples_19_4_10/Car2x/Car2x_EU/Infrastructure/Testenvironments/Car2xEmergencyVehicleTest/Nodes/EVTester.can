/*@!Encoding:1252*/
includes
{
  #include "..\DataSources_Templates\ASNV_Template_BaseDatatypes.cin"
  #include "..\DataSources_Templates\ASNV_Template_CAM.cin"
  #include "..\DataSources_Templates\ASNV_Template_DENM.cin"
  #include "Car2xAPI.cin"
}

variables
{
  long gStationHandle;
  char testerName[50] = "DuT";
  char panelName[50] = "Visualization";
  long red, yellow, green, grey, blue, white;
  int firstDENMReceived;
}

// On start, callback functions for the most common application messages CAM and DENM are registered.
// It is possible to do the same with the other application messages if needed.
on start
{
  enum CallbackType { OnRx };
  C2xRegisterCallback(OnRx,  "OnRxCAM",    "CAM");
  C2xRegisterCallback(OnRx,  "OnRxDENM",    "DENM");

  red = makeRGB(255,0,0);
  yellow = makeRGB(255,255,0);
  green = makeRGB(0,255,0);
  grey = MakeRGB(242, 242, 242);
  blue = makeRGB(0,0,255);
  white = makeRGB(255,255,255);
  
  firstDENMReceived = 0;
}

// Callback function on receiving CAM messages
void OnRxCAM(long channel, long dir, long radioChannel, long signalStrength, long signalQuality, long packet)
{
  char stationName[100];
  long stationHandle;
  struct CAM myCAM;

  stationHandle = C2xGetStationHandle(packet);
  if (C2xGetStationName(stationHandle, elcount(stationName), stationName) == -1)
  {
    return;
  }
  if (strncmp(stationName, testerName, elcount(testerName) + 1) == 0)
  {
    API_GetCAMParams(packet, myCAM);
    // set GPS for GSP Track
    @GPS::GPS1.Latitude = myCAM.cam.camParameters.basicContainer.referencePosition.latitude * 1e-7;
    @GPS::GPS1.Longitude = myCAM.cam.camParameters.basicContainer.referencePosition.longitude * 1e-7;
    @GPS::GPS1.Direction = myCAM.cam.camParameters.highFrequencyContainer.basicVehicleContainerHighFrequency.heading.headingValue * 1e-1;
    
    // get CAM calues
    if (myCAM.cam.camParameters.lowFrequencyContainer.isValidFlag == 1)
    {
      @CAMValues::HasLFC = 1;
      @CAMValues::VehicleRole = myCAM.cam.camParameters.lowFrequencyContainer.basicVehicleContainerLowFrequency.vehicleRole;
    }
    else
    {
      @CAMValues::HasLFC = 0;
    }
    GetSpecialVehicleContainer(myCAM);
  }
}

void GetSpecialVehicleContainer(struct CAM myCAM)
{
  char lightBarSirenInUse[10];
  int specialVehicleContainer;
  
  if (myCAM.cam.camParameters.specialVehicleContainer.isValidFlag == 0)
  {
    // no specialVehicleContainer given, return
    return;
  }
  specialVehicleContainer = myCAM.cam.camParameters.specialVehicleContainer.choice;
  
  if (@CAMValues::VehicleRole == 6 && specialVehicleContainer == 5)
  {
      strncpy(lightBarSirenInUse, myCAM.cam.camParameters.specialVehicleContainer.emergencyContainer.lightBarSirenInUse.string, elcount(lightBarSirenInUse));
      if (myCAM.cam.camParameters.specialVehicleContainer.emergencyContainer.incidentIndication.isValidFlag == 1)
      {
        @CAMValues::IncidentCC = myCAM.cam.camParameters.specialVehicleContainer.emergencyContainer.incidentIndication.causeCode;
        @CAMValues::IncidentSCC = myCAM.cam.camParameters.specialVehicleContainer.emergencyContainer.incidentIndication.subCauseCode;
      }
  }
  else if (@CAMValues::VehicleRole == 5 && specialVehicleContainer == 4)
  {
    strncpy(lightBarSirenInUse, myCAM.cam.camParameters.specialVehicleContainer.rescueContainer.lightBarSirenInUse.string, elcount(lightBarSirenInUse));
    @CAMValues::IncidentCC = -1;
    @CAMValues::IncidentSCC = -1;
  }
  else if (@CAMValues::VehicleRole == 7 && specialVehicleContainer == 6)
  {
      strncpy(lightBarSirenInUse, myCAM.cam.camParameters.specialVehicleContainer.safetyCarContainer.lightBarSirenInUse.string, elcount(lightBarSirenInUse)); 
      if (myCAM.cam.camParameters.specialVehicleContainer.safetyCarContainer.incidentIndication.isValidFlag == 1)
      {
        @CAMValues::IncidentCC = myCAM.cam.camParameters.specialVehicleContainer.safetyCarContainer.incidentIndication.causeCode;
        @CAMValues::IncidentSCC = myCAM.cam.camParameters.specialVehicleContainer.safetyCarContainer.incidentIndication.subCauseCode;
      }
  }
  else
  {
    @CAMValues::LightBarInUse = 0;
    @CAMValues::SirenInUse = 0;   
  }
  
  // check if lightbar is on
  if (lightBarSirenInUse[0] == '1')
  {
    @CAMValues::LightBarInUse = 1;
  }
  else
  {
    @CAMValues::LightBarInUse = 0;
  }
  // check if siren is on
  if (lightBarSirenInUse[1] == '1')
  {
    @CAMValues::SirenInUse = 1;
  }
  else
  {
    @CAMValues::SirenInUse = 0;
  }
  
  ColorLightBar();
}

// Callback function on receiving DENM messages
void OnRxDENM(long channel, long dir, long radioChannel, long signalStrength, long signalQuality, long packet)
{
  char stationName[100];
  struct DENM myDENM;
  long oldStationHandle;
  gStationHandle = C2xGetStationHandle(packet);
  
  if (C2xGetStationName(gStationHandle, elcount(stationName), stationName) == -1)
  {
    return;
  }
  API_GetDENMParams(packet, myDENM);
  if (strncmp(stationName, testerName, elcount(testerName) + 1) == 0)
  {   
    // only consider DENM with CC 95 or 15
    
      // CC, sCC, stationtype
      @DENMvalues::CauseCode = myDENM.denm.situation.eventType.causeCode;
      @DENMvalues::SubCauseCode = myDENM.denm.situation.eventType.subCauseCode;
      @DENMvalues::StationType = myDENM.denm.management.stationType;
      @DENMvalues::InformationQuality = myDENM.denm.situation.informationQuality;
  
      // validityDuration
      if (myDENM.denm.management.validityDuration.isValidFlag == 1)
      {
        @DENMvalues::ValidityDuration = myDENM.denm.management.validityDuration.value;
        CheckValidityDuration();
      }
      // relevanceDistance
      if (myDENM.denm.management.relevanceDistance.isValidFlag == 1)
      {
        @DENMvalues::RelevanceDistance = myDENM.denm.management.relevanceDistance.value;
      }
      // relevanceTrafficDirection
      if (myDENM.denm.management.relevanceTrafficDirection.isValidFlag == 1)
      {
        @DENMvalues::RelevanceTrafficDirection = myDENM.denm.management.relevanceTrafficDirection.value;
      }
      
      // eventSpeed
      @DENMvalues::EventSpeed = myDENM.denm.location.eventSpeed.speedValue * 0.01; 
      
      // eventHeading
      @DENMvalues::EventPositionHeading = myDENM.denm.location.eventPositionHeading.headingValue * 0.1;
      
      if (myDENM.denm.alacarte.lanePosition.isValidFlag == 1)
      {
        @DENMvalues::LanePosition = myDENM.denm.alacarte.lanePosition.value;
      }
      
      // check vehicle type specific
      if (@DENMvalues::SubCauseCode == 1)
      {
        CheckEmergencyVehicle();
      }
      else if (@DENMvalues::SubCauseCode == 0)
      {
        if (@DENMvalues::CauseCode == 95)
        {
          CheckSpecialVehicle();
        }
        else if (@DENMvalues::CauseCode == 15)
        {
          if (@CAMValues::VehicleRole == 5)
          {
            CheckRescueVehicle();
          }
          else
          {
            CheckSpecialVehicle();
          }
        }
      }
      
      CheckValidityDuration();
    }
  else if (myDENM.denm.situation.eventType.causeCode == 95 || myDENM.denm.situation.eventType.causeCode == 15)
  {
      // check if this is the first DENM with correct CC, then assign node to station
      if (firstDENMReceived == 0)
      {
        C2xAssignNodeToStation(gStationHandle, "EU_ApplMsg", "DuT");
        firstDENMReceived = 1;
      }
  }
}

void CheckEmergencyVehicle()
{
  if (@CAMValues::VehicleRole == 6) // EmergencyVehicle
  {
    SetControlBackColor(panelName, "VehicleRole", green);
  }
  else
  {
    SetControlBackColor(panelName, "VehicleRole", red);
  }
}

void CheckSpecialVehicle()
{
  if (@CAMValues::VehicleRole == 7) // SpecialVehicle
  {
    SetControlColors(panelName, "VehicleRole", green, makeRGB(0,0,0));
  }
  else
  {
    SetControlBackColor(panelName, "VehicleRole", red);
  }
}

void CheckRescueVehicle()
{
  if (@CAMValues::VehicleRole == 5) // RescueVehicle
  {
    SetControlColors(panelName, "VehicleRole", green, makeRGB(0,0,0));
  }
  else
  {
    SetControlBackColor(panelName, "VehicleRole", red);
  }
}

void CheckValidityDuration()
{
  // ValidityDuration
  if (@DENMvalues::CauseCode == 15)
  {
    if (@DENMvalues::ValidityDuration == 30) 
    {
      SetControlBackColor(panelName, "ValidityDuration", green);
    }
    else
    {
      SetControlBackColor(panelName, "ValidityDuration", red);
    }
  }
  else if (@DENMvalues::CauseCode == 95)
  {
    if (@DENMvalues::ValidityDuration == 2)
    {
      SetControlBackColor(panelName, "ValidityDuration", green);
    }
    else
    {
      SetControlBackColor(panelName, "ValidityDuration", red);
    }
  }
}

void ColorLightBar()
{
  long color, textColor;
  color = white;
  textColor = makeRGB(0,0,0);
  if (@CAMValues::LightBarInUse == 1)
  {
    // vehicleRole 5 - orange
    if (@CAMValues::VehicleRole == 5)
    {
      color = makeRGB(239,124,0);
      textColor = white;
    }
    // vehicleRole 6 - blue
    else if (@CAMValues::VehicleRole == 6)
    {
      color = blue;
      textColor = white;
    }
    // vehicleRole 7 - red
    else if (@CAMValues::VehicleRole == 7)
    {
      color = red;
      textColor = white;
    }
  }
  
  setControlColors(panelName, "LightBar", color, textColor);
}