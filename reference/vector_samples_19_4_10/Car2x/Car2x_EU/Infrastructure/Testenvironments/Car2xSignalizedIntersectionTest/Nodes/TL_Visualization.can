/*@!Encoding:1252*/
includes
{
}

variables
{
  const int gMaxSvArray = 255;
  enum ArrayResetType { ART_All, ART_Used, ART_EventStates, ART_Specific };
  
  msTimer SPAT_Reset_Timer;
  
  long gCircleHandle[int64];
  long gTextHandle[int64];
  
  float xMin[int64];
  float xMax[int64];
  float yMin[int64];
  float yMax[int64];
  int64 lanes[int64];

  int firstMessage = 0;
  int allLayersReceived = 0;
  
  int gMAPArrayIndex = -1;
}

on start
{
  enum CallbackType { OnRx, PreTx };
  
  C2xRegisterCallback(OnRx, "OnRxMAP",  "MAP");
  C2xRegisterCallback(OnRx, "OnRxSPAT", "SPAT");
  
  // reset all
  @sysvar::ApproachID::Value = -1;
  @sysvar::TL_Panel::svNbrVehicleIngressLanes = 0;
  @sysvar::TL_Panel::svNbrSignalGroupsSPAT = 0;
  ResetTlArray(ART_All, 0);
}

on sysvar_update ExpectedValues::IntersectionID
{  
  xMin.clear();
  xMax.clear();
  yMin.clear();
  yMax.clear();
  lanes.clear();
  for (int64 aKey: gCircleHandle)
  {
    DeleteMapObject(gCircleHandle[aKey]);
  }
  for (int64 aKey: gTextHandle)
  {
    DeleteMapObject(gTextHandle[aKey]);
  }
  gCircleHandle.clear();
  gTextHandle.clear();
  firstMessage = 0;
  @ApproachID::Value = -1;
}

// Panel Control
on sysvar sysvar::ApproachID::Value
{
  // reset all values
  ResetTlArray(ART_All, 0);
  @sysvar::TL_Panel::svNbrVehicleIngressLanes = 0;
  @sysvar::TL_Panel::svNbrSignalGroupsSPAT = 0;
  
  // paint in Map Window
  if (gCircleHandle.containsKey(@this))
  {
    for (int64 aKey: gCircleHandle)
    {
      SetMapObjectLineColor(gCircleHandle[aKey], makeRGB( 132,139,142));
      DrawMapObject(gCircleHandle[aKey]);
    }
    SetMapObjectLineColor(gCircleHandle[@this], makeRGB( 0, 0, 0));
    DrawMapObject(gCircleHandle[@this]);
  }
  else
  {
    paintApproachID(@this);    
  }
}


// Callback function on receiving MAP messages
void OnRxMAP(long channel, long dir, long radioChannel, long signalStrength, long signalQuality, long packet)
{
  char pathIntersection[1000];
  char ingressApproach[1000];
  stack char buffer[1000];
  int intersectionIdx, laneIdx;
  int tokenExists;
  long stationHandle;
  int arrayIndex;
  int connectionIdx;
  int laneID;
  int idx;
  int multipleValues;
  int laneType;
  
  intersectionIdx=0;
  
  if (C2xGetTokenInt64(packet, "geo_ch", "maximumHopLimit") != C2xGetTokenInt64(packet, "geo_bh", "remainingHopLimit"))
  {
    // skip hopped messages
    return;
  }
  snprintf(pathIntersection, elcount(pathIntersection), "map.intersections.[%d].id.id", intersectionIdx);
  tokenExists =  C2xIsTokenAvailable(packet, "MAP", pathIntersection);
  while (tokenExists == 1)
  {
    // is correct intersectionID
    if (C2xGetTokenInt64(packet, "MAP", pathIntersection) == @ExpectedValues::IntersectionID)
    {
      gMAPArrayIndex = intersectionIdx;
      // set approachIDs
      if (firstMessage == 0 || allLayersReceived == 0)
      {
        checkApproachID(packet);
        firstMessage = 1;
        allLayersReceived = (@MAPmessage::Multilayered == @MAPmessage::Layers_Received);
      }
      
      arrayIndex= 0;
      laneIdx = 0;
      snprintf(buffer, elcount(buffer), "map.intersections.[%d].laneSet.[%d]", intersectionIdx, laneIdx);
      // while intersection has lanes
      while (C2xIsTokenAvailable(packet, "MAP", buffer))
      {
        // get ingressApproach
        snprintf(ingressApproach, elcount(ingressApproach), "map.intersections.[%d].laneSet.[%d].ingressApproach", intersectionIdx, laneIdx);
            
        // get the value of the approachID
        if (C2xIsTokenAvailable(packet, "MAP", ingressApproach))
        {
          // is specified approachID
          if (C2xGetTokenInt64(packet, "MAP", ingressApproach) == @ApproachID::Value)
          {
            // get lane ID
            snprintf(buffer, elcount(buffer), "map.intersections.[%d].laneSet.[%d].laneID", intersectionIdx, laneIdx);
            laneID = C2xGetTokenInt(packet, "MAP", buffer);
            // get laneType
            snprintf(buffer, elcount(buffer), "map.intersections.[%d].laneSet.[%d].laneAttributes.laneType", intersectionIdx, laneIdx);
            laneType = C2xGetTokenInt(packet, "MAP", buffer);
            // get sharedWith
            snprintf(buffer, elcount(buffer), "map.intersections.[%d].laneSet.[%d].laneAttributes.sharedWith", intersectionIdx, laneIdx);
            multipleValues = 0;
            for (idx = 0; idx < 9; idx++)
            {
              if (C2xGetTokenBitOfBitString(packet, "MAP", buffer, idx) == 1)
              {
                if (multipleValues == 0)
                {
                  if ((laneType == 0 && idx == 3) || (laneType == 2 && idx == 7)) // vehicleType & individualMotorizedVeh.
                  {
                    // ignore
                  }
                  else
                  {
                    @sysvarMember::TL_Panel::svArrSharedWith[arrayIndex] = idx; // set sharedWith
                    multipleValues = 1;
                  }
                }
                else
                {
                  @sysvarMember::TL_Panel::svArrSharedWith[arrayIndex] = 10; // multiple sharedWith set
                }  
              }
            }
            // get connectingLane
            connectionIdx = 0;
            snprintf(buffer, elcount(buffer), "map.intersections.[%d].laneSet.[%d].connectsTo.[%d].connectingLane.lane", intersectionIdx, laneIdx,connectionIdx);
            while (C2xIsTokenAvailable(packet, "MAP", buffer))
            {
              @sysvarMember::TL_Panel::svArrElementUsed[arrayIndex] = 1;
              @sysvarMember::TL_Panel::svArrLane[arrayIndex] = laneID;
              @sysvarMember::TL_Panel::svArrLaneType[arrayIndex] = laneType;
              @sysvarMember::TL_Panel::svArrayConnLane[arrayIndex] = C2xGetTokenInt(packet, "MAP", buffer);
              
              // get signalgroup
              snprintf(buffer, elcount(buffer), "map.intersections.[%d].laneSet.[%d].connectsTo.[%d].signalGroup", intersectionIdx, laneIdx, connectionIdx);
              if (C2xIsTokenAvailable(packet, "MAP", buffer))
              {
                @sysvarMember::TL_Panel::svArrSignalGroup[arrayIndex] = C2xGetTokenInt(packet, "MAP", buffer);
              }
              // get connectionID
              snprintf(buffer, elcount(buffer), "map.intersections.[%d].laneSet.[%d].connectsTo.[%d].connectionID", intersectionIdx, laneIdx, connectionIdx);
              if (C2xIsTokenAvailable(packet, "MAP", buffer))
              {
                @sysvarMember::TL_Panel::svArrConnectionID[arrayIndex] = C2xGetTokenInt(packet, "MAP", buffer);
              }
              
              // get maneuver
              snprintf(buffer, elcount(buffer), "map.intersections.[%d].laneSet.[%d].connectsTo.[%d].connectingLane.maneuver", intersectionIdx, laneIdx);
              multipleValues = 0;
              for (idx = 0; idx < 4; idx++)
              {
                if (C2xGetTokenBitOfBitString(packet, "MAP", buffer, idx) == 1)
                {
                  if (multipleValues == 0)
                  {
                    @sysvarMember::TL_Panel::svArrManeuver[arrayIndex] = idx; // set maneuver state
                    multipleValues = 1;
                  }
                  else
                  {
                    @sysvarMember::TL_Panel::svArrManeuver[arrayIndex] = 4; // multiple maneuver set
                  }
                }
              }
              // go to next connectingLane
              arrayIndex++;
              connectionIdx++;
              snprintf(buffer, elcount(buffer), "map.intersections.[%d].laneSet.[%d].connectsTo.[%d].connectingLane.lane", intersectionIdx, laneIdx, connectionIdx);
            }
          }
        }
        // go to next lane
        laneIdx++;
        snprintf(buffer, elcount(buffer), "map.intersections.[%d].laneSet.[%d]", intersectionIdx, laneIdx);
      }
    }
    
    intersectionIdx++;
    snprintf(pathIntersection, elcount(pathIntersection), "map.intersections.[%d].id.id", intersectionIdx);
    tokenExists =  C2xIsTokenAvailable(packet, "MAP", pathIntersection);
  }
  @sysvar::TL_Panel::svNbrVehicleIngressLanes = arrayIndex;
}

// Callback function on receiving SPAT messages
void OnRxSPAT(long channel, long dir, long radioChannel, long signalStrength, long signalQuality, long packet)
{
  char pathIntersection[1000];
  char buffer[1000];
  int stateIdx;
  int tokenExists;
  int intersectionIdx, laneIdx;
  int arrayIndex;
  int signalGroup;
  
  if (C2xGetTokenInt64(packet, "geo_ch", "maximumHopLimit") != C2xGetTokenInt64(packet, "geo_bh", "remainingHopLimit"))
  {
    // skip hopped messages
    return;
  }

  intersectionIdx=0;
  stateIdx = 0;
  arrayIndex= 0;

  snprintf(pathIntersection, elcount(pathIntersection), "spat.intersections.[%d].id.id", intersectionIdx);
  tokenExists =  C2xIsTokenAvailable(packet, "SPAT", pathIntersection);
  while (tokenExists == 1)
  {
    if (C2xGetTokenInt64(packet, "SPAT", pathIntersection) == @ExpectedValues::IntersectionID)
    {
      
      for (arrayIndex = 0; arrayIndex < @SPATmessage::NumberSignalGroupIDs; arrayIndex++)
      {
        stateIdx = 0;
        snprintf(buffer, elcount(buffer), "spat.intersections.[%d].states.[%d].signalGroup", intersectionIdx, stateIdx);
        while (C2xIsTokenAvailable(packet, "SPAT", buffer))
        {
          signalGroup = C2xGetTokenInt64(packet, "SPAT", buffer);
          if (@sysvarMember::TL_Panel::svArrSignalGroup[arrayIndex] == signalGroup)
          {
            snprintf(buffer, elcount(buffer), "spat.intersections.[%d].states.[%d].state_time_speed.[0].eventState", intersectionIdx, stateIdx);
            @sysvarMember::TL_Panel::svArrEventState[arrayIndex] = C2xGetTokenInt64(packet, "SPAT", buffer);
            // permissive
            if (@sysvarMember::TL_Panel::svArrEventState[arrayIndex] == 5 || @sysvarMember::TL_Panel::svArrEventState[arrayIndex] == 7)
            {
              // check if other value was already given, then set mixed
              if (@sysvarMember::TL_Panel::svArrProtectedOrPermissive[arrayIndex] > 0 && @sysvarMember::TL_Panel::svArrProtectedOrPermissive[arrayIndex] != 1)
              {
                @sysvarMember::TL_Panel::svArrProtectedOrPermissive[arrayIndex] = 3;
              }
              else
              {
                @sysvarMember::TL_Panel::svArrProtectedOrPermissive[arrayIndex] = 1;
              }
            }
            //protected
            if (@sysvarMember::TL_Panel::svArrEventState[arrayIndex] == 6 || @sysvarMember::TL_Panel::svArrEventState[arrayIndex] == 8)
            {
              // check if other value was already given, then set mixed
              if (@sysvarMember::TL_Panel::svArrProtectedOrPermissive[arrayIndex] > 0 && @sysvarMember::TL_Panel::svArrProtectedOrPermissive[arrayIndex] != 2)
              {
                @sysvarMember::TL_Panel::svArrProtectedOrPermissive[arrayIndex] = 3;
              }
              else
              {
                @sysvarMember::TL_Panel::svArrProtectedOrPermissive[arrayIndex] = 2;
              }
            }
            break;
          }
          stateIdx++;
          snprintf(buffer, elcount(buffer), "spat.intersections.[%d].states.[%d].signalGroup", intersectionIdx, stateIdx);
        }
      }
      setTimer(SPAT_Reset_Timer, 1050);  // reset system variables if SPAT is not received any more
    }
    
    intersectionIdx++;
    snprintf(pathIntersection, elcount(pathIntersection), "spat.intersections.[%d].id.id", intersectionIdx);
    tokenExists =  C2xIsTokenAvailable(packet, "SPAT", pathIntersection);
  }
} 

on timer SPAT_Reset_Timer
{
  ResetTlArray(ART_EventStates, 0);
}

void ResetTlArray(int resetType, int index)
{
  int i;
  
  if (resetType == ART_Specific)
  {
    i = index;
    @sysvarMember::TL_Panel::svArrayConnLane[i] = -1;
    @sysvarMember::TL_Panel::svArrConnectionID[i] = -1;
    @sysvarMember::TL_Panel::svArrElementUsed[i] = 0;
    @sysvarMember::TL_Panel::svArrEventState[i] = -1;
    @sysvarMember::TL_Panel::svArrLane[i] = -1;
    @sysvarMember::TL_Panel::svArrLaneType[i] = -1;
    @sysvarMember::TL_Panel::svArrManeuver[i] = -1;
    @sysvarMember::TL_Panel::svArrMultipleSG[i] = 0;
    @sysvarMember::TL_Panel::svArrProtectedOrPermissive[i] = -1;
    @sysvarMember::TL_Panel::svArrSharedWith[i] = -1;
    @sysvarMember::TL_Panel::svArrSignalGroup[i] = -1;
  }
  else
  {
    for (i = 0; i < gMaxSvArray; i++)
    {
      if ( (resetType == ART_All) || ( (@sysvarMember::TL_Panel::svArrElementUsed[i] == 1) && (resetType == ART_Used) ) )
      {
        @sysvarMember::TL_Panel::svArrayConnLane[i] = -1;
        @sysvarMember::TL_Panel::svArrConnectionID[i] = -1;
        @sysvarMember::TL_Panel::svArrElementUsed[i] = 0;
        @sysvarMember::TL_Panel::svArrEventState[i] = -1;
        @sysvarMember::TL_Panel::svArrLane[i] = -1;
        @sysvarMember::TL_Panel::svArrLaneType[i] = -1;
        @sysvarMember::TL_Panel::svArrManeuver[i] = -1;
        @sysvarMember::TL_Panel::svArrMultipleSG[i] = 0;
        @sysvarMember::TL_Panel::svArrProtectedOrPermissive[i] = -1;
        @sysvarMember::TL_Panel::svArrSharedWith[i] = -1;
        @sysvarMember::TL_Panel::svArrSignalGroup[i] = -1;

        @sysvarMember::TL_Panel::svArrLane[i] = -1;

      }
      if (resetType == ART_EventStates)
      {
        @sysvarMember::TL_Panel::svArrEventState[i] = -1;
      }
    }
  }
}

// debug function
void OutputArray()
{
  write("Element Used: %d %d %d %d %d %d %d %d", @sysvarMember::TL_Panel::svArrElementUsed[0], @sysvarMember::TL_Panel::svArrElementUsed[1], @sysvarMember::TL_Panel::svArrElementUsed[2], @sysvarMember::TL_Panel::svArrElementUsed[3], @sysvarMember::TL_Panel::svArrElementUsed[4], @sysvarMember::TL_Panel::svArrElementUsed[5], @sysvarMember::TL_Panel::svArrElementUsed[6], @sysvarMember::TL_Panel::svArrElementUsed[7]);
  write("        Lane: %d %d %d %d %d %d %d %d", @sysvarMember::TL_Panel::svArrLane[0], @sysvarMember::TL_Panel::svArrLane[1], @sysvarMember::TL_Panel::svArrLane[2], @sysvarMember::TL_Panel::svArrLane[3], @sysvarMember::TL_Panel::svArrLane[4], @sysvarMember::TL_Panel::svArrLane[5], @sysvarMember::TL_Panel::svArrLane[6], @sysvarMember::TL_Panel::svArrLane[7]);
  write("Signal Group: %d %d %d %d %d %d %d %d", @sysvarMember::TL_Panel::svArrSignalGroup[0], @sysvarMember::TL_Panel::svArrSignalGroup[1], @sysvarMember::TL_Panel::svArrSignalGroup[2], @sysvarMember::TL_Panel::svArrSignalGroup[3], @sysvarMember::TL_Panel::svArrSignalGroup[4], @sysvarMember::TL_Panel::svArrSignalGroup[5], @sysvarMember::TL_Panel::svArrSignalGroup[6], @sysvarMember::TL_Panel::svArrSignalGroup[7]);
  write(" Event State: %d %d %d %d %d %d %d %d", @sysvarMember::TL_Panel::svArrEventState[0], @sysvarMember::TL_Panel::svArrEventState[1], @sysvarMember::TL_Panel::svArrEventState[2], @sysvarMember::TL_Panel::svArrEventState[3], @sysvarMember::TL_Panel::svArrEventState[4], @sysvarMember::TL_Panel::svArrEventState[5], @sysvarMember::TL_Panel::svArrEventState[6], @sysvarMember::TL_Panel::svArrEventState[7]);
  write(" Multipe SGs: %d %d %d %d %d %d %d %d", @sysvarMember::TL_Panel::svArrMultipleSG[0], @sysvarMember::TL_Panel::svArrMultipleSG[1], @sysvarMember::TL_Panel::svArrMultipleSG[2], @sysvarMember::TL_Panel::svArrMultipleSG[3], @sysvarMember::TL_Panel::svArrMultipleSG[4], @sysvarMember::TL_Panel::svArrMultipleSG[5], @sysvarMember::TL_Panel::svArrMultipleSG[6], @sysvarMember::TL_Panel::svArrMultipleSG[7]);
}

// set the min and max XY values for the approachID corners
void setApproachXY(int approachID, float x, float y)
{
    //xMax
    if (xMax.containsKey(approachID))
    {
      if (x > xMax[approachID])
      {
        xMax[approachID] = x;
      }
    }
    else
    {
      xMax[approachID] = x;
    }
    
    //yMax
    if (yMax.containsKey(approachID))
    {
      if (y > yMax[approachID])
      {
        yMax[approachID] = y;
      }
    }
    else
    {
      yMax[approachID] = y;
    }
    
    // xMin
    if (xMin.containsKey(approachID))
    {
      if (x < xMin[approachID])
      {
        xMin[approachID] = x;
      }
    }
    else
    {
      xMin[approachID] = x;
    }
    
    // yMin;
    if (yMin.containsKey(approachID))
    {
      if (y < yMin[approachID])
      {
        yMin[approachID] = y;
      }
    }
    else
    {
      yMin[approachID] = y;
    }
}

// show all approachIDs in the map window
on sysvar_update ApproachID::ShowAll
{
  if (@this == 1)
  {
    for (int64 aKey: lanes)
    {
      paintApproachID(aKey);
    }
  }
  if (@this == 0)
  {
    for (int64 aKey: gCircleHandle)
    {
      DeleteMapObject(gCircleHandle[aKey]);
      DeleteMapObject(gTextHandle[aKey]);
      gCircleHandle.remove(aKey);
      gTextHandle.remove(aKey);
    }
  }
}

void paintApproachID(int64 id)
{
    stack char buffer[1000];
    int approachID;
    long color;
    float latMin, latMax, lonMin, lonMax;
    float diff;
    float conversion = 6371000.8 * (pi/180.0);
    float heading;
    float distance;
    int64 aKey;
    
    if (!xMin.containsKey(id))
    {
      return;
    }
    
    if (!gCircleHandle.containsKey(id))
    {
        gTextHandle[id] = CreateMapObject( 8 );
        gCircleHandle[id] = CreateMapObject( 3 );
    }
  
    // get minimum node
    if (yMin[id] > 0)
    {
      heading = pi;
    }
    else
    {
      heading = 0;
    }
    
    heading = heading + pi + arctan((xMin[id])/(yMin[id]));
    distance = sqrt(xMin[id] * xMin[id] + yMin[id] * yMin[id]);
    diff = cos(heading) * distance;
    latMin = @MAPmessage::ReferenceLatitude + (diff / conversion);
    diff = sin(heading) * distance;
    lonMin = @MAPmessage::ReferenceLongitude + (diff / (conversion * cos(@MAPmessage::ReferenceLatitude * pi / 180.0)));
    
    // get maximum node
    if (yMax[id] > 0)
    {
      heading = pi;
    }
    else
    {
      heading = 0;
    }
    heading = heading + pi + arctan((xMax[id])/(yMax[id]));
    distance = sqrt(xMax[id] * xMax[id] + yMax[id] * yMax[id]);
    diff = cos(heading) * distance;
    latMax = @MAPmessage::ReferenceLatitude + (diff / conversion);
    diff = sin(heading) * distance;
    lonMax = @MAPmessage::ReferenceLongitude + (diff / (conversion * cos(@MAPmessage::ReferenceLatitude * pi / 180.0)));
       
    // draw circle around the lanes
    SetMapObjectPosition(gCircleHandle[id], (latMax+latMin)/2, (lonMax+lonMin)/2);
    SetMapObjectSize(gCircleHandle[id], 10, 10);
    SetMapObjectPenWidth(gCircleHandle[id], 2);
    SetMapObjectLineColor(gCircleHandle[id], makeRGB(  132,139,142));
    SetMapObjectFillColor(gCircleHandle[id], makeRGB(  132,139,142));
    DrawMapObject(gCircleHandle[id]);
      
    // Set ApproachID text
    SetMapObjectPosition(gTextHandle[id], (latMax+latMin)/2, (lonMax+lonMin)/2);
    snprintf(buffer, elcount(buffer), "A %i", id);
    SetMapObjectText(gTextHandle[id], buffer);
    SetMapObjectFillColor(gTextHandle[id], makeRGB(76,76,76));
    DrawMapObject(gTextHandle[id]);
}

void checkApproachID(long packet)
{
  char ingressApproach[1000];
  char egressApproach[1000];
  stack char buffer[1000];
  stack char buffer2[1000];
  int approachID;
  int i, tokenExists;
  int deltaValue;
  float x0, y0, x1, y1;
  
  i = 0;  
  snprintf(buffer, elcount(buffer), "map.intersections.[%d].laneSet.[%d]", gMAPArrayIndex, i);
  // while intersection has lanes
  while (C2xIsTokenAvailable(packet, "MAP", buffer))
  {
    // get ingressApproach or egressApproach
    snprintf(ingressApproach, elcount(ingressApproach), "map.intersections.[%d].laneSet.[%d].ingressApproach", gMAPArrayIndex, i);
    snprintf(egressApproach, elcount(egressApproach), "map.intersections.[%d].laneSet.[%d].egressApproach", gMAPArrayIndex, i);

    // get the value of the approachID
    if (C2xIsTokenAvailable(packet, "MAP", ingressApproach) && !C2xIsTokenAvailable(packet, "MAP", egressApproach))
    {
      approachID = C2xGetTokenInt64(packet, "MAP", ingressApproach);
    }
    else if (C2xIsTokenAvailable(packet, "MAP", egressApproach) && !C2xIsTokenAvailable(packet, "MAP", ingressApproach))
    {
      approachID = C2xGetTokenInt64(packet, "MAP", egressApproach);
    }
    else
    {
      // bot egress and ingress are available, skip this lane
      i++;
      snprintf(buffer, elcount(buffer), "map.intersections.[%d].laneSet.[%d]", gMAPArrayIndex, i);
      continue;
    }
    
    // get node0
    getLaneNode(packet, i, 0, x0, y0);
    setApproachXY(approachID, x0,y0);

    // get node1
    getLaneNode(packet, i, 1, x1, y1);
    x1 = x1 + x0;
    y1 = y1 + y0;
    setApproachXY(approachID, x1,y1);
    
    // next lane
    lanes[approachID] += 1;
    i++;
    snprintf(buffer, elcount(buffer), "map.intersections.[%d].laneSet.[%d]", gMAPArrayIndex, i);    
  }
  
  // paint approachIDs in map window
  if (@ApproachID::ShowAll == 1)
  {
    @ApproachID::ShowAll = 1;
  }
}


// get the x,y node with nodeID from lane laneID
void getLaneNode(long packet, int laneID, int nodeID, float& x, float&y)
{
  char buffer[1000], buffer2[1000];
  int deltaValue;
  
  snprintf(buffer, elcount(buffer), "map.intersections.[%d].laneSet.[%d].nodeList.nodes.[%d].delta", gMAPArrayIndex, laneID, nodeID);
  deltaValue = C2xGetTokenInt64(packet, "MAP", buffer);
  switch(deltaValue)
  {
    case 0:
      snprintf(buffer, elcount(buffer), "map.intersections.[%d].laneSet.[%d].nodeList.nodes.[%d].delta.node_XY1", gMAPArrayIndex, laneID, nodeID);
      break;
    case 1:
      snprintf(buffer, elcount(buffer), "map.intersections.[%d].laneSet.[%d].nodeList.nodes.[%d].delta.node_XY2", gMAPArrayIndex, laneID, nodeID);
      break;
    case 2:
      snprintf(buffer, elcount(buffer), "map.intersections.[%d].laneSet.[%d].nodeList.nodes.[%d].delta.node_XY3", gMAPArrayIndex, laneID, nodeID);
      break;
    case 3:
      snprintf(buffer, elcount(buffer), "map.intersections.[%d].laneSet.[%d].nodeList.nodes.[%d].delta.node_XY4", gMAPArrayIndex, laneID, nodeID);
      break;
    case 4:
      snprintf(buffer, elcount(buffer), "map.intersections.[%d].laneSet.[%d].nodeList.nodes.[%d].delta.node_XY5", gMAPArrayIndex, laneID, nodeID);
      break;
    case 5:
      snprintf(buffer, elcount(buffer), "map.intersections.[%d].laneSet.[%d].nodeList.nodes.[%d].delta.node_XY6", gMAPArrayIndex, laneID, nodeID);
      break;
  }
  strncpy(buffer2, buffer, elcount(buffer2));
  strncat(buffer, ".x", elcount(buffer) + 2);
  x = C2xGetTokenInt64(packet, "MAP", buffer) * 0.01;
  
  strncat(buffer2, ".y", elcount(buffer2) + 2);
  y = C2xGetTokenInt64(packet, "MAP", buffer2) * 0.01;
}