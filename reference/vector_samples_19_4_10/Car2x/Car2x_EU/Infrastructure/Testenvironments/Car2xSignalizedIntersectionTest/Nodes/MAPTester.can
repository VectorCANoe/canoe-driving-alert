/*@!Encoding:1252*/
includes
{
  #include "Car2xAPI.cin"
}

variables
{
  int gMAPArrayIndex = -1;

  char panelName[100] = "State Visualization";
  
  int layersReceived[int64];
  int signalGroupListMAP[int64];
  
  int nrVehicleLanes[int64];
  int nrCrosswalk[int64];
  int nrBikeLane[int64];
  int nrVehicleLanesBus[int64];
  int nrOther[int64];
}


// On start, callback functions for the most common application messages CAM and DENM are registered.
// It is possible to do the same with the other application messages if needed.
on start
{
  enum CallbackType { OnRx };
  
  C2xRegisterCallback(OnRx,  "OnRxMAP",    "MAP");
}


on sysvar_update ExpectedValues::IntersectionID
{  
  layersReceived.clear();
  signalGroupListMAP.clear();
}

// Callback function on receiving MAP messages
void OnRxMAP(long channel, long dir, long radioChannel, long signalStrength, long signalQuality, long packet)
{
  char pathIntersection[1000];
  int idx;
  int tokenExists;
  long stationHandle;
  
  idx=0;

  if (C2xGetTokenInt64(packet, "geo_ch", "maximumHopLimit") != C2xGetTokenInt64(packet, "geo_bh", "remainingHopLimit"))
  {
    // skip hopped messages
    return;
  }
  
  snprintf(pathIntersection, elcount(pathIntersection), "map.intersections.[%d].id.id", idx);
  tokenExists =  C2xIsTokenAvailable(packet, "MAP", pathIntersection);
  gMAPArrayIndex = -1;
  while (tokenExists == 1)
  {
    if (C2xGetTokenInt64(packet, "MAP", pathIntersection) == @ExpectedValues::IntersectionID)
    {
      stationHandle = C2xGetStationHandle(packet);
      C2xAssignNodeToStation(stationHandle, "EU_ApplMsg", "SIunderTest");
      @MAPmessage::IntersectionID = @ExpectedValues::IntersectionID;
      @MAPmessage::ReceivedState = 1;
      gMAPArrayIndex = idx;
      break;
    }
    
    idx++;
    snprintf(pathIntersection, elcount(pathIntersection), "map.intersections.[%d].id.id", idx);
    tokenExists =  C2xIsTokenAvailable(packet, "MAP", pathIntersection);
  }
  
  // check if MAP with intersectionID found
  if (gMAPArrayIndex != -1)
  {
    getMAPValues(packet);
  }
}

void getMAPValues(long packet)
{
  char pathIntersection[1000];
  char buffer[1000];
  int tokenExists;
  double mapLat, mapLon, rsuLat, rsuLon;
  byte macAddress[6];
  
  /*******************************************************************/ 
  // get MAC Adress
  C2xGetTokenData(packet, "geo_eh", "lpvGNAddrMID", elcount(macAddress), macAddress);
  sysSetVariableData(sysvar::MAPmessage::MACAdress, macAddress, elcount(macAddress));
  
  /*******************************************************************/ 
  // get regionID
  snprintf(pathIntersection, elcount(pathIntersection), "map.intersections.[%d].id.region", gMAPArrayIndex);
  if (C2xIsTokenAvailable(packet, "MAP", pathIntersection) == 1)
  {
    @MAPmessage::RegionID = C2xGetTokenInt64(packet, "MAP", pathIntersection);
  }
  
  /*******************************************************************/
  // get distance between RSU and MAP reference point
  checkDistanceRSUtoMAP(packet);  
  
  /*******************************************************************/
  // get revision
  snprintf(pathIntersection, elcount(pathIntersection), "map.intersections.[%d].revision", gMAPArrayIndex);
  @MAPmessage::Revision = C2xGetTokenInt64(packet, "MAP", pathIntersection);

  /*******************************************************************/ 
  // get intersectionName
  snprintf(pathIntersection, elcount(pathIntersection), "map.intersections.[%d].name", gMAPArrayIndex);
  if (C2xIsTokenAvailable(packet, "MAP", pathIntersection) == 1)
  {
    C2xGetTokenString(packet, "MAP", pathIntersection, elcount(buffer), buffer);
    sysSetVariableString(sysvar::MAPmessage::IntersectionName, buffer);
  }
  
  /*******************************************************************/ 
  // get lanewidth
  snprintf(pathIntersection, elcount(pathIntersection), "map.intersections.[%d].laneWidth", gMAPArrayIndex);
  if (C2xIsTokenAvailable(packet, "MAP", pathIntersection) == 1)
  {
    @MAPmessage::LaneWidth = C2xGetTokenInt64(packet, "MAP", pathIntersection) * 0.01;
  }

  /*******************************************************************/
  // count laneTypes
  countLaneTypes(packet);
  
  /*******************************************************************/
  // check if multilayered
  checkMAPMultilayer(packet);
  
  /*******************************************************************/
  // count number of signalGroupIDs
  countMAPSignalGroupIDs(packet);
}

void checkMAPMultilayer(long packet)
{
  char buffer[1000];
  int numLayer;
  
  // if token is available, MAP is multilayered
  if (C2xIsTokenAvailable(packet, "MAP", "map.layerID"))
  {
    numLayer = C2xGetTokenInt64(packet, "MAP", "map.layerID");
    
    // get current layer
    @MAPmessage::CurrentLayer = numLayer % 10;
    // get number of layers
    while (numLayer>=10)
    {
      numLayer = numLayer / 10;
    }
    
    // check if number of layers has changed
    if (@MAPmessage::Multilayered != numLayer && @MAPmessage::Multilayered != -1)
    {
      if (@MAPmessage::Multilayered == 0)
      {
        snprintf(buffer, elcount(buffer), "MAP was not multilayered, is now multilayered with %i Layers.", numLayer);
      }
      else
      {
        snprintf(buffer, elcount(buffer), "MAP was multilayered with %i Layers, is now multilayered with %i Layers.", @MAPmessage::Multilayered, numLayer);
      }
      C2xReportProtocolViolation(C2xGetStationHandle(packet), 1, "Custom Rules|EU|MAP", 60000, "MAP: Multilayered changed", buffer, "MAP multilayer behavior must be constant.");
    }
    
    // check if current layer is valid
    if (@MAPmessage::CurrentLayer == 0 | @MAPmessage::CurrentLayer > numLayer)
    {
      snprintf(buffer, elcount(buffer), "Unexpected value %i for layer recevied. Value must be larger than 0 and smaller or equal to number of layers, which is %i.", @MAPmessage::CurrentLayer, numLayer);
      C2xReportProtocolViolation(C2xGetStationHandle(packet), 1, "Custom Rules|EU|MAP", 60000, "MAP: Multilayered changed", buffer, "MAP layer must be larger than 0 and smaller or equal to number of layers.");
    }
    else
    {
      layersReceived[@MAPmessage::CurrentLayer] = 1;
    }
    @MAPmessage::Multilayered = numLayer;
    @MAPmessage::Layers_Received = layersReceived.size();
    SetControlBackColor(panelName, "multilayeredInfo", @Panel::Yellow);
  }
  else
  {
    // check if MAP has been multilayered previously
    if (@MAPmessage::Multilayered != 0 && @MAPmessage::Multilayered != -1)
    {
      snprintf(buffer, elcount(buffer), "MAP was multilayered with %i Layers, is now singlelayered.", @MAPmessage::Multilayered);
      C2xReportProtocolViolation(C2xGetStationHandle(packet), 1, "Custom Rules|EU|MAP", 60000, "MAP: Multilayered changed", buffer, "MAP multilayer behavior must be constant.");
    }
    @MAPmessage::Multilayered = 0;
    SetControlBackColor(panelName, "multilayeredInfo", makeRGB(255,255,255));
  }
}

void countMAPSignalGroupIDs(long packet)
{
  char buffer[1000];
  int i,j;
  int tokenExists;
  int signalGroupID;

  i = 0;

  snprintf(buffer, elcount(buffer), "map.intersections.[%d].laneSet.[%d]", gMAPArrayIndex,i);
  tokenExists = C2xIsTokenAvailable(packet, "MAP", buffer);
  while (tokenExists == 1)
  {
    // check if connectsTo exists for laneSet entry and get signalGroupID
    j = 0;
    snprintf(buffer, elcount(buffer), "map.intersections.[%d].laneSet.[%d].connectsTo.[%d].signalGroup", gMAPArrayIndex,i ,j);
    tokenExists = C2xIsTokenAvailable(packet, "MAP", buffer);
    while (tokenExists == 1)
    {
      signalGroupID = C2xGetTokenInt64(packet, "MAP", buffer);
      signalGroupListMAP[signalGroupID] += 1;
      j++;
      snprintf(buffer, elcount(buffer), "map.intersections.[%d].laneSet.[%d].connectsTo.[%d].signalGroup", gMAPArrayIndex,i ,j);
      tokenExists = C2xIsTokenAvailable(packet, "MAP", buffer);
    }
    i++;

    snprintf(buffer, elcount(buffer), "map.intersections.[%d].laneSet.[%d]", gMAPArrayIndex,i);
    tokenExists = C2xIsTokenAvailable(packet, "MAP", buffer);
  }
  
  @MAPmessage::NumberSignalGroupIDs = signalGroupListMAP.size();
}

void countLaneTypes(long packet)
{
  char buffer[1000];
  int tokenExists;
  int laneID, idx;
  int laneType;
  
  laneID = 0;
  idx=0;

  // get lane type from lane
  snprintf(buffer, elcount(buffer), "map.intersections.[%d].laneSet.[%d].laneAttributes.laneType", gMAPArrayIndex, idx);
  tokenExists = C2xIsTokenAvailable(packet, "MAP", buffer);
  while (tokenExists == 1)
  {
    laneType = C2xGetTokenInt64(packet, "MAP", buffer);
    // get laneID
    snprintf(buffer, elcount(buffer), "map.intersections.[%d].laneSet.[%d].laneID", gMAPArrayIndex, idx);
    laneID = C2xGetTokenInt64(packet, "MAP", buffer);
    
    // check laneType vehicle, crosswalk, bike or other
    switch (laneType)
    {
      case 0: 
        nrVehicleLanes[laneID] += 1;
        // bit 3 of vehicle: restrictedToBusUse
        snprintf(buffer, elcount(buffer), "map.intersections.[%d].laneSet.[%d].laneAttributes.laneType.vehicle", gMAPArrayIndex, idx);
        if (C2xGetTokenBitOfBitString(packet, "MAP", buffer, 3) == 1)
        {
          nrVehicleLanesBus[laneID] += 1;
        }
        break;
      case 1: 
        nrCrosswalk[laneID] += 1; 
        break;
      case 2: 
        nrBikeLane[laneID] += 1; 
        break;
      default: 
        nrOther[laneID] += 1;
        break;
    }
    
    idx++;
    snprintf(buffer, elcount(buffer), "map.intersections.[%d].laneSet.[%d].laneAttributes.laneType", gMAPArrayIndex, idx);
    tokenExists = C2xIsTokenAvailable(packet, "MAP", buffer);
  }
  
  // save number of lanes
  @NumberOfLanes::BikeLane = nrBikeLane.size();
  @NumberOfLanes::CrosswalkLanes = nrCrosswalk.size();
  @NumberOfLanes::VehicleForBusUseLanes = nrVehicleLanesBus.size();
  @NumberOfLanes::VehicleLanes = nrVehicleLanes.size();
  @NumberOfLanes::OtherLanes = nrOther.size();
}

void checkDistanceRSUtoMAP(long packet)
{
  char buffer[1000];

  // get map Reference position
  snprintf(buffer, elcount(buffer), "map.intersections.[%d].refPoint.lon", gMAPArrayIndex);
  @MAPmessage::ReferenceLongitude = C2xGetTokenInt64(packet, "MAP", buffer) * 1e-7;
  snprintf(buffer, elcount(buffer), "map.intersections.[%d].refPoint.lat", gMAPArrayIndex);
  @MAPmessage::ReferenceLatitude = C2xGetTokenInt64(packet, "MAP", buffer) * 1e-7;

  // get RSU header information
  @RSU::Latitude = C2xGetTokenInt64(packet, "geo_eh", "lpvLatitude") * 1e-7;
  @RSU::Longitude = C2xGetTokenInt64(packet, "geo_eh", "lpvLongitude") * 1e-7;
  @RSU::AreaLatitude = C2xGetTokenInt64(packet, "geo_eh", "areaPosLatitude") * 1e-7;
  @RSU::AreaLongitude = C2xGetTokenInt64(packet, "geo_eh", "areaPosLongitude") * 1e-7;
  @RSU::DistanceA = C2xGetTokenInt64(packet, "geo_eh", "distanceA");

  
  // calculate distance MAP reference to RSU position
  @RSU::DistanceToMAP = API_PosCalcDistance(@RSU::Latitude, @RSU::Longitude, @MAPmessage::ReferenceLatitude, @MAPmessage::ReferenceLongitude);
  if (@RSU::DistanceToMAP > 100)
  {
    SetControlBackColor(panelName, "RSUdistance", @Panel::Red);
  }
  else if (@RSU::DistanceToMAP > 50)
  {
    SetControlBackColor(panelName, "RSUdistance", @Panel::Yellow);
  }
  else
  {
    SetControlBackColor(panelName, "RSUdistance",  makeRGB(255,255,255));
  }
}

on sysvar MAPmessage::Layers_Received
{
  if (@this != @MAPmessage::Multilayered)
  {
    SetControlBackColor(panelName, "multilayeredReceived", @Panel::Yellow);
  }
  else
  {
    SetControlBackColor(panelName, "multilayeredReceived",  makeRGB(255,255,255));
  }
}