/*@!Encoding:1252*/
includes
{
  #include "Car2xAPI.cin"
}

variables
{  
  char panelName[100] = "State Visualization";
  long gCircleHandle, gCrossHandle;
}


on start
{    
  // init circle object
  gCircleHandle = CreateMapObject( 3 );
  gCrossHandle = CreateMapObject( 4 );
  
  @Panel::Red = makeRGB(255,0,0);
  @Panel::Yellow = makeRGB(255,255,0);
  @Panel::Green = makeRGB(0,255,0);
  @Panel::Grey = MakeRGB(255, 255, 255);
  
  if (@ExpectedValues::IntersectionID != 0)
  {
    @ExpectedValues::IntersectionID = @ExpectedValues::IntersectionID;
  }
}

on sysvar (MAPmessage::ReferenceLatitude | MAPmessage::ReferenceLongitude)
{
  SetMapPosition(@MAPmessage::ReferenceLatitude, @MAPmessage::ReferenceLongitude);
}

on sysvar_update (MAPmessage::Revision | SPATmessage::Revision)
{
  setRevisionState();
}

on sysvar_update ExpectedValues::IntersectionID
{
  SetControlVisibility("Input Values", "Arrow", 0);
  @SPATmessage::ReceivedState = 0;
  @MAPmessage::ReceivedState = 0;
  
  @RSU::DistanceToMAP = 0;
  @RSU::Latitude = 0;
  @RSU::Longitude = 0;
  @RSU::AreaLatitude = 0;
  @RSU::AreaLongitude = 0;
  @RSU::DistanceA = 0;
  
  @SPATmessage::LaneWidth = 0;
  @SPATmessage::Revision = 0;
  @SPATmessage::NumberSignalGroupIDs = 0;
  sysSetVariableString(sysvar::SPATmessage::IntersectionState, "");
  @MAPmessage::MovementStates = 0;
  
  @MAPmessage::Revision = 0;
  @MAPmessage::NumberSignalGroupIDs = 0;
  @MAPmessage::CurrentLayer = 0;
  @MAPmessage::LaneWidth = 0;
  @MAPmessage::Layers_Received = 0;
  @MAPmessage::MovementStates = 0;
  @MAPmessage::Multilayered = -1;
  @MAPmessage::ReferenceLatitude = 0;
  @MAPmessage::ReferenceLongitude = 0;
  @MAPmessage::RegionID = 0;
  sysSetVariableString(sysvar::MAPmessage::IntersectionName, "");
  
  
  @NumberOfLanes::BikeLane = 0;
  @NumberOfLanes::CrosswalkLanes = 0;
  @NumberOfLanes::OtherLanes = 0;
  @NumberOfLanes::VehicleForBusUseLanes = 0;
  @NumberOfLanes::VehicleLanes = 0;
}

void setRevisionState()
{
  char buffer[100];
  if (@MAPmessage::ReceivedState == 1 && @SPATmessage::ReceivedState == 1)
  {
    if (@MAPmessage::Revision == @SPATmessage::Revision)
    {
      snprintf(buffer, elcount(buffer), "%d", @MAPmessage::Revision);
      sysSetVariableString(sysvar::RevisionState, buffer);
      SetControlBackColor(panelName, "Revision", makeRGB(255,255,255));
    }
    else
    {
      sysSetVariableString(sysvar::RevisionState, "MISMATCH");
      SetControlBackColor(panelName, "Revision", @Panel::Red);
    }
  }
}

on sysvar (RSU::AreaLatitude | RSU::AreaLongitude)
{
  drawCircleAroundRSU();
}

on sysvar (MAPmessage::NumberSignalGroupIDs | SPATmessage::NumberSignalGroupIDs)
{
  if (@MAPmessage::NumberSignalGroupIDs != @SPATmessage::NumberSignalGroupIDs)
  {
    SetControlBackColor(panelName, "SPAT_SignalIDs", @Panel::Red);
    SetControlBackColor(panelName, "MAP_SignalIDs", @Panel::Red);

  }
  else
  {
    SetControlBackColor(panelName, "MAP_SignalIDs", makeRGB(255,255,255));
    SetControlBackColor(panelName, "SPAT_SignalIDs", makeRGB(255,255,255));
  }
}

void drawCircleAroundRSU()
{
  // set position to RSU position
  SetMapObjectPosition(gCircleHandle, @RSU::Latitude, @RSU::Longitude);

  // optional settings
  SetMapObjectHeading(gCircleHandle, 359);
  SetMapObjectSize(gCircleHandle, @RSU::DistanceA * 2, @RSU::DistanceA * 2);
  SetMapObjectLineColor(gCircleHandle, @Panel::Red);
  SetMapObjectPenWidth(gCircleHandle, 4);

  // draw object
  DrawMapObject(gCrossHandle);
  
    // set position to RSU position
  SetMapObjectPosition(gCrossHandle, @RSU::AreaLatitude, @RSU::AreaLongitude);

  // optional settings
  SetMapObjectHeading(gCrossHandle, 359);
  SetMapObjectSize(gCrossHandle, 25, 25);
  SetMapObjectLineColor(gCrossHandle, @Panel::Red);
  SetMapObjectPenWidth(gCrossHandle, 4);

  // draw object
  DrawMapObject(gCrossHandle);
}