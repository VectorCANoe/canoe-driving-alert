/*@!Encoding:1252*/
includes
{

}

variables
{
  char gOriginatorNode[1000]; 
  byte gMapData[3000];
  int gFirstMAP = 0;
  int gFirstSPAT = 0;
  int gSPATSignalGroups = 0;
  int spatArrayIndex = -1;
}

on preStart
{
  enum CallbackType { OnRx };
  
  C2xRegisterCallback(OnRx,  "OnRxSPAT",    "SPAT");
  C2xRegisterCallback(OnRx,  "OnRxMAP",    "MAP");
  
}

// Callback function on receiving SPAT messages
void OnRxMAP(long channel, long dir, long radioChannel, long signalStrength, long signalQuality, long packet)
{
  char pathIntersection[1000];
  int i;
  int tokenExists;
  int isFirstMAP;
  long handle;
  char originatorNode[1000];
  byte asn1Payload[3000];
  int intersectionFound;
  i=0;
  isFirstMAP = 0;
  intersectionFound = 0;
  
  if (@RunTests == 0)
  {
    return;
  }
  
  snprintf(pathIntersection, elcount(pathIntersection), "map.intersections.[%d].id.id", i);
  tokenExists =  C2xIsTokenAvailable(packet, "MAP", pathIntersection);
  while (tokenExists == 1)
  {
    if (C2xGetTokenInt64(packet, "MAP", pathIntersection) == @ExpectedValues::IntersectionID)
    {
      @SPATmessage::IntersectionID = @ExpectedValues::IntersectionID;
      intersectionFound = 1;
      break;
    }
    
    i++;
    snprintf(pathIntersection, elcount(pathIntersection), "map.intersections.[%d].id.id", i);
    tokenExists =  C2xIsTokenAvailable(packet, "MAP", pathIntersection);
  }
  
  if (intersectionFound == 1)
  {
    if (gFirstMAP == 0)
    {
      isFirstMAP = 1;
      gFirstMAP = 1;
    }

    handle = C2xGetStationHandle(packet);
    C2xGetStationName(handle, elcount(originatorNode), originatorNode);
    sysSetVariableString(sysvar::MAP::originatorNode, originatorNode);
    if (isFirstMAP ==  1)
    {
      gSPATSignalGroups = countSPATSignalGroupIDs(packet);
      strncpy(gOriginatorNode, originatorNode, elcount(originatorNode));
    }
    /*********************************************/
    // check if originator node stays the same
    if (elcount(originatorNode) != elcount(gOriginatorNode) || strncmp(gOriginatorNode, originatorNode, elcount(originatorNode)) != 0)
    {
      @MAP::originatorNodeError += 1;
    }
    
    /*********************************************/
    // check if map content stays the same
    if (C2xIsTokenAvailable(packet, "MAP", "map.layerID") == 1)
    {
      // if multilayered, not check of map content
      @MAP::isMultilayered = 1;
    }
    else
    {
      @MAP::isMultilayered = 0;
      C2xGetTokenData(packet, "btp", "data", elcount(asn1Payload), asn1Payload);
      if (isFirstMAP ==  1)
      {
        memcpy(gMapData, asn1Payload, elcount(asn1Payload));
      }

      if (memcmp(gMapData, asn1Payload, elcount(gMapData)) != 0)
      {
        @MAP::mapContentError += 1;
      }
    }
  }
}

// Callback function on receiving SPAT messages
void OnRxSPAT(long channel, long dir, long radioChannel, long signalStrength, long signalQuality, long packet)
{
  
  char pathIntersection[1000];
  int i;
  int tokenExists;
  long handle;
  int isFirstSPAT;
  char originatorNode[1000];
  int intersectionFound;
  i=0;
  isFirstSPAT = 0;
  intersectionFound = 0;
  if (@RunTests == 0)
  {
    return;
  }
  
  snprintf(pathIntersection, elcount(pathIntersection), "spat.intersections.[%d].id.id", i);
  tokenExists =  C2xIsTokenAvailable(packet, "SPAT", pathIntersection);
  while (tokenExists == 1)
  {
    if (C2xGetTokenInt64(packet, "SPAT", pathIntersection) == @ExpectedValues::IntersectionID)
    {
      @SPATmessage::IntersectionID = @ExpectedValues::IntersectionID;
      intersectionFound = 1;
      spatArrayIndex = i;
      break;
    }
    
    i++;
    snprintf(pathIntersection, elcount(pathIntersection), "spat.intersections.[%d].id.id", i);
    tokenExists =  C2xIsTokenAvailable(packet, "SPAT", pathIntersection);
  }
  
  if (intersectionFound == 1)
  {
    if (gFirstSPAT == 0)
    {
      isFirstSPAT = 1;
      gFirstSPAT = 1;
    }

    getSPATMovementStates(packet);
    
    handle = C2xGetStationHandle(packet);
    C2xGetStationName(handle, elcount(originatorNode), originatorNode);
    sysSetVariableString(sysvar::SPAT::originatorNode, originatorNode);
    if (isFirstSPAT ==  1)
    {
      gSPATSignalGroups = countSPATSignalGroupIDs(packet);
      strncpy(gOriginatorNode, originatorNode, elcount(originatorNode));
    }
    /*********************************************/
    // check if originator node stays the same
    if (elcount(originatorNode) != elcount(gOriginatorNode) || strncmp(gOriginatorNode, originatorNode, elcount(originatorNode)) != 0)
    {
      @SPAT::originatorNodeError += 1;
    }
    /*********************************************/
    // check if number of SPAT signal group IDS stays the same
    if (gSPATSignalGroups != countSPATSignalGroupIDs(packet))
    {
      @SPAT::signalGroupError += 1;
    }
  }
}

void getSPATMovementStates(long packet)
{
  char pathIntersection[1000];
  int i,j;
  int tokenExists;
  int64 movementState[int64];
  int eventState;
  int signalGroupID;
  int num;
  i=0;
  j=0;
  
  // Enumeration values for eventState: 
  // -------------------------------------------------------------
  // 0 : unavailable
  // 1 : dark
  // 2 : stop_Then_Proceed
  // 3 : stop_And_Remain
  // 4 : pre_Movement
  // 5 : permissive_Movement_Allowed
  // 6 : protected_Movement_Allowed
  // 7 : permissive_clearance
  // 8 : protected_clearance
  // 9 : caution_Conflicting_Traffic
  // -------------------------------------------------------------
  //.spat.intersections.arrayValue[0].states.arrayValue[0].state_time_speed.arrayValue[0].eventState = 0;

  snprintf(pathIntersection, elcount(pathIntersection), "spat.intersections.[%d].states.[%d].state_time_speed.[%d].eventState", spatArrayIndex,i,j);
  tokenExists =  C2xIsTokenAvailable(packet, "SPAT", pathIntersection);
  while (tokenExists == 1)
  {
    while (tokenExists == 1)
    {
      eventState = C2xGetTokenInt64(packet, "SPAT", pathIntersection);
      snprintf(pathIntersection, elcount(pathIntersection), "spat.intersections.[%d].states.[%d].signalGroup", spatArrayIndex,i);
      signalGroupID = C2xGetTokenInt64(packet, "SPAT", pathIntersection);
      if (movementState.containsKey(signalGroupID))
      {
        if (movementState[signalGroupID] == 3)
        {
          if (eventState == 5 || eventState == 6)
          {
            @SPAT::reasonableStateChange += 1;
          }
        }
      }
      if (eventState != 4)
      {
        movementState[signalGroupID] = eventState;
      }

      j++;
      snprintf(pathIntersection, elcount(pathIntersection),  "spat.intersections.[%d].states.[%d].state_time_speed.[%d].eventState", spatArrayIndex,i,j);
      tokenExists =  C2xIsTokenAvailable(packet, "SPAT", pathIntersection);  
    }
    
    j = 0;
    i++;
    snprintf(pathIntersection, elcount(pathIntersection),  "spat.intersections.[%d].states.[%d].state_time_speed.[%d].eventState", spatArrayIndex,i,j);
    tokenExists =  C2xIsTokenAvailable(packet, "SPAT", pathIntersection);
  }
}

int countSPATSignalGroupIDs(long packet)
{
  char pathIntersection[1000];
  char buffer[1000];
  char keyvalue[100];
  int i,j;
  int tokenExists;
  int signalGroupID;
  int signalGroupList[int64];
  
  i = 0;
  
  // .spat.intersections.arrayValue[0].states.arrayValue[0].signalGroup = 0;
  snprintf(pathIntersection, elcount(pathIntersection), "spat.intersections.[%d].states.[%d].signalGroup", spatArrayIndex,i);
  tokenExists = C2xIsTokenAvailable(packet, "SPAT", pathIntersection);
  while (tokenExists == 1)
  {
    signalGroupID = C2xGetTokenInt64(packet, "SPAT", pathIntersection);
    signalGroupList[signalGroupID] += 1;
    
    i++;
    snprintf(pathIntersection, elcount(pathIntersection), "spat.intersections.[%d].states.[%d].signalGroup", spatArrayIndex,i);
    tokenExists = C2xIsTokenAvailable(packet, "SPAT", pathIntersection);
  }
  
  return signalGroupList.size();
}