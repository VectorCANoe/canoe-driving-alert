/*@!Encoding:1252*/
includes
{
  
}

variables
{
  
}

export PrintData()
{
  long table = 0;
  char str[100];
  byte macAddress[6];
  long cnt;

  // begin table
  table = TestInfoTable("Signalized Intersection Data");

  // header
  TestInfoHeadingBegin(table, 0);
  TestInfoCell(table, "Message Status");
  TestInfoCell(table, "");
  TestInfoCell(table, "Result");
  TestInfoHeadingEnd(table);

  // MAP received
  TestInfoRow(table, 0);
  TestInfoCell(table, "MAP received");
  if (@MAPmessage::ReceivedState == 0)
  {
    TestInfoCell(table, "no");
    TestInfoCell(table, "fail");
  }
  else
  {
    TestInfoCell(table, "yes");
    TestInfoCell(table, "pass");
  }
  
  // SPAT received
  TestInfoRow(table, 0);
  TestInfoCell(table, "SPAT received");
  if (@SPATmessage::ReceivedState == 0)
  {
    TestInfoCell(table, "no");
    TestInfoCell(table, "fail");
  }
  else
  {
    TestInfoCell(table, "yes");
    TestInfoCell(table, "pass");
  }
  
  if (@MAPmessage::ReceivedState == 0 && @SPATmessage::ReceivedState == 0)
  {
    // output table
    TestStep(0, "Value output", table);
    return;
  }
  
  // Revision
  TestInfoRow(table, 0);
  TestInfoCell(table, "Revision");
  sysGetVariableString("", "RevisionState", str, elcount(str));

  if (@MAPmessage::Revision != @SPATmessage::Revision)
  {
    TestInfoCell(table, "MISMATCH");
    TestInfoCell(table, "fail");
  }
  else
  {
    TestInfoCell(table, str);
    TestInfoCell(table, "pass");
  }
  
  // header
  TestInfoHeadingBegin(table, 0);
  TestInfoCell(table, "Intersection Information");
  TestInfoCell(table, "");
  TestInfoCell(table, "Result");
  TestInfoHeadingEnd(table);

  // MAC Adress
  TestInfoRow(table, 0);
  TestInfoCell(table, "MAC Adress");
  sysGetVariableData("MAPmessage", "MACAdress", macAddress, cnt);
  snprintf(str, elcount(str), "%02X:%02X:%02X:%02X:%02X:%02X", macAddress[0], macAddress[1], macAddress[2], macAddress[3], macAddress[4], macAddress[5]);
  TestInfoCell(table, str);
  TestInfoCell(table, "");
  
  // Intersection Name
  TestInfoRow(table, 0);
  TestInfoCell(table, "Intersection Name");
  sysGetVariableString("MAPmessage", "IntersectionName", str, elcount(str));
  TestInfoCell(table, str);
  TestInfoCell(table, "");
  
  // Intersection ID
  TestInfoRow(table, 0);
  TestInfoCell(table, "Intersection ID");
  snprintf(str, elcount(str), "%d",  @MAPmessage::IntersectionID);
  TestInfoCell(table, str);
  TestInfoCell(table, "");
  
  // Region ID
  TestInfoRow(table, 0);
  TestInfoCell(table, "Region ID");
  snprintf(str, elcount(str), "%d",  @MAPmessage::RegionID);
  TestInfoCell(table, str);
  TestInfoCell(table, "");
  
  // intermediate header
  TestInfoHeadingBegin(table, 0);
  TestInfoCell(table, "Position information");
  TestInfoCell(table, "");
  TestInfoHeadingEnd(table);
  
  // RSU Position
  TestInfoRow(table, 0);
  TestInfoCell(table, "MAP Reference Point");
  snprintf(str, elcount(str), "(%f, %f)",  @MAPmessage::ReferenceLatitude, @MAPmessage::ReferenceLongitude);
  TestInfoCell(table, str);
  TestInfoCell(table, "");  
  
  // MAP Position
  TestInfoRow(table, 0);
  TestInfoCell(table, "RSU Position");
  snprintf(str, elcount(str), "(%f, %f)",  @RSU::Latitude, @RSU::Longitude);
  TestInfoCell(table, str);
  TestInfoCell(table, "");
  
  // distance between MAP Ref and RSU
  TestInfoRow(table, 0);
  TestInfoCell(table, "Distance RefPoint to RSU");
  snprintf(str, elcount(str), "%g m",  @RSU::DistanceToMAP);
  TestInfoCell(table, str);
  if (@RSU::DistanceToMAP > 100)
  {
    TestInfoCell(table, "fail");
  }
  else if (@RSU::DistanceToMAP > 50)
  {
    TestInfoCell(table, "warning");
  }
  else
  {
    TestInfoCell(table, "pass");
  }

  // output table
  TestStep(0, "Value output", table);
}

export AddScreenshots()
{   
  // add screenshots
  SetMapPosition(@MAPmessage::ReferenceLatitude, @MAPmessage::ReferenceLongitude); 
  TestWaitForMessageBox("Map position is set to show the Reference Point location. If possible, configure the Map window to additionally show the intersection. Click OK to take a screenshot for the TestReport.", 15000);
  testReportAddWindowCapture("Map Window", "", "Screenshot of Reference Point location");
  testReportAddWindowCapture("State Visualization", "", "Screenshot of State Visualization Panel");
  testReportAddWindowCapture("Intersection Data", "", "Screenshot of Intersection Data Window");
  testReportAddWindowCapture("State Tracker", "", "Screenshot of EventStates in State Tracker");
  testReportAddWindowCapture("Data - SignalGroup", "", "Screenshot of SignalGroups corresponding to the State Tracker");
  testReportAddWindowCapture("Car2x Certificate Explorer", "", "Screenshot of Certificate Explorer");
}

export testcase TC_CheckSPAT()
{
  testCaseTitle("TC SPAT", "Check SPAT messages");
  testCaseDescription("Checks that all SPAT messages were sent correctly.");
  if (@SPATmessage::ReceivedState == 0)
  {
    testStepFail("Check Message status", "No SPAT was received.");
    return;
  }
  
  // SPATSignalGroupIDs
  if (@MAPmessage::NumberSignalGroupIDs != @SPATmessage::NumberSignalGroupIDs)
  {
    testStepFail("Check SignalGroupIDs.", "SignalGroupIDs in SPAT and MAP message do not match.");
  }
  else
  {
    testStepPass("Check SignalGroupIDs.", "SignalGroupIDs in SPAT and MAP message match.");
  }
  
  // MovementPhaseState
  if (@SPAT::reasonableStateChange < 2)
  {
    testStepInconclusive("Check MovementPhaseStates.", "No reasonable state change detected.");
  }
  else
  {
    testStepPass("Check MovementPhaseStates.", "Reasonable state change detected.");
  }

  // SignalGroupError
  if (@SPAT::signalGroupError == 0)
  {
    testStepPass("Check SignalGroupdIDs", "Number of SPAT signal groups stays the same.");
  }
  else
  {
    testStepFail("Check SignalGroupdIDs", "Number of SPAT signal groups does not stay the same.");
  }
  // OriginatorNode
  if (@SPAT::originatorNodeError == 0)
  {
    testStepPass("Check OriginatorNode", "OriginatorNode of SPAT stays the same.");
  }
  else
  {
    testStepFail("Check OriginatorNode", "OriginatorNode of SPAT does not stay the same.");
  }
}

export testcase TC_CheckMAP()
{
  testCaseTitle("TC MAP", "Check MAP messages");
  testCaseDescription("Checks that all MAP messages were sent correctly.");

  if (@MAPmessage::ReceivedState == 0)
  {
    testStepFail("Check Message status", "No MAP was received.");
    return;
  }
  
  // OriginatorNode
  if (@MAP::originatorNodeError == 0)
  {
    testStepPass("Check OriginatorNode", "OriginatorNode of MAP stays the same.");
  }
  else
  {
    testStepFail("Check OriginatorNode", "OriginatorNode of MAP does not stays the same.");
  } 
  if (@MAP::isMultilayered == 1)
  {
    testStepWarning("Check that MAP content is always the same", "Cannot perform check, as MAP is multilayered.");
  }
  else
  {
    if (@MAP::mapContentError == 0)
    {
      testStepPass("Check that MAP content is always the same", "MAP content stays the same.");
    }
    else
    {
      testStepFail("Check that MAP content is always the same", "MAP content does not stay the same.");
    }
  }
}