/*@!Encoding:1252*/
includes
{
  
}

variables
{
  char testerName[1000] = "SIunderTest";
  char[2000] protocolViolation[int64];
  int protocolSeverity[int64];
  int protocolViolationCount[int64];
}

export TestReportAddProtocolAnalyzerViolations()
{
  char buffer[100];
  long table = 0;
  long fail = 0;
  
  if (protocolViolation.size() > 0)
  {  
    TestCaseDescription("Protocol Analyzer Violations.");
  
    // begin table
    table = TestInfoTable("Signalized Intersection Data");
    // header
    TestInfoHeadingBegin(table, 0);
    TestInfoCell(table, "Protocol Violation");
    TestInfoCell(table, "Count");
    TestInfoCell(table, "Result");
    TestInfoHeadingEnd(table);
    
    for (int64 ruleId : protocolViolation)
    {
      TestInfoRow(table, 0);
      TestInfoCell(table, protocolViolation[ruleId]);
      snprintf(buffer, elcount(buffer), "%i", protocolViolationCount[ruleId]);
      TestInfoCell(table, buffer);
      if (protocolSeverity[ruleId] == 0)
      {
        TestInfoCell(table, "fail");
        fail = 1;
      }
      else
      {
        TestInfoCell(table, "warning");
      }
    }
    
    if (fail == 0)
    {
      // output table
      testStepWarning(0, "Protocol Analyzer Violations.", table);
    }
    else
    {
      testStepFail(0, "Protocol Analyzer Violations.", table);
    }
  }
  else if (@MAPmessage::ReceivedState == 0 && @SPATmessage::ReceivedState == 0)
  {
    testStepInconclusive(0, "Protocol Analyzer Violations.", "No MAP or SPAT messages for the configured intersection were received.");
  }
  else
  {
    testStepPass(0, "Protocol Analyzer Violations.", "No violations found.");
  }
}

// This callback function is called each time Protocol Analyzer
// detects the violation of one of the predefined rules 
void OnProtocolViolation(long severity, long stationHandle, char scope[], long ruleId, char ruleName[],
  char violationDescription[], char ruleDescription[])
{
  char paMessage[2000];
  char stationName[100];

  if (stationHandle != 0)
  {
    C2xGetStationName(stationHandle, elcount(stationName), stationName);
    if (strncmp(stationName, testerName, elcount(testerName) + 1) == 0)
    {
      snprintf(paMessage,elcount(paMessage), "Scope: %s\nRule: %s \nViolation Descr.: %s \nRule Descr.: %s",
        scope, ruleName, violationDescription, ruleDescription);
      
      snprintf(protocolViolation[ruleId],elCount( protocolViolation[ruleId]), paMessage);
      protocolSeverity[ruleId] = severity;
      protocolViolationCount[ruleId] += 1;
    }
  }
}


export ConfigureProtocolAnalyzerOutput()
{
  TestReportAddProtocolAnalyzerRuleList();
}

void TestReportAddProtocolAnalyzerRuleList()
{
  char rules[40000], ruleline[1000];
  long offset, lineStartPos, lineEndPos;
  long table;
  offset = 0;
  lineEndPos = 0;
  lineStartPos = 0;
  //TestReportAddMiscInfoBlock("Protocol Analyzer rule list:");
  table = TestInfoTable("");
  
  if (C2xProtocolAnalyzerGetRuleList(elcount(rules), rules) == 0)
  {
        // header
    TestInfoHeadingBegin(table, 0);
    TestInfoCell(table, "Protocol Violation rule list");
    TestInfoHeadingEnd(table);
    
	  // Add Protocol Analyzer rule list to the test report line by line
    while (lineEndPos != -1)
    {
      lineEndPos = strstr_off(rules, offset, "\n");
      if (lineEndPos != -1)
      {
        TestInfoRow(table, 0);
        substr_cpy(ruleline, rules, lineStartPos, lineEndPos-lineStartPos, elcount(ruleline));
        offset = lineStartPos = lineEndPos + 1;
       // TestReportAddExtendedInfo("text", ruleline);
       TestInfoCell(table, ruleline);
      }
    }
    TestStep(0, "Protocol Analyzer rule list", table);
  }
}