/*@!Encoding:1252*/
includes
{
  #include "Car2xAPI.cin"
  #include "..\DataSources_Templates\ASNV_Template_BaseDatatypes.cin"
  #include "..\DataSources_Templates\ASNV_Template_CAM.cin"
  #include "..\DataSources_Templates\ASNV_Template_DENM.cin"
}

variables
{
  enum mapObjectType { Square = 1, Rectangle = 2, Ellipse = 3, Cross = 4, Triangle = 5, Line = 6, Bitmap = 7, Text = 8 };
  long gPacket;
  long gStationHandle;
  char rwwTesterName[11] = "DuT";
  float pathLat[int64];
  float pathLon[int64];
  long gHandles[41];
  int firstDENMReceived;
}

// On start, callback functions for the most common application messages CAM and DENM are registered.
// It is possible to do the same with the other application messages if needed.
on start
{
  enum CallbackType { OnRx };
 
  C2xRegisterCallback(OnRx, "OnRxDENM", "DENM");
  firstDENMReceived = 0;
}

on sysvar RWW_Configuration::Expected_TrafficFlow
{
  switch(@this)
  {
    case -1: setPictureBoxImage("SimRSU Road Works Warning", "pictureBoxExpectationRsuRww", "BMP\\RSU_RWW_NoTrafficRuleData.png"); break;
    case  0: setPictureBoxImage("SimRSU Road Works Warning", "pictureBoxExpectationRsuRww", "BMP\\RSU_RWW_NoPassing.png"); break;
    case  1: setPictureBoxImage("SimRSU Road Works Warning", "pictureBoxExpectationRsuRww", "BMP\\RSU_RWW_NoTrucksPassing.png"); break;
    case  2: setPictureBoxImage("SimRSU Road Works Warning", "pictureBoxExpectationRsuRww", "BMP\\RSU_RWW_PassRight.png"); break;
    case  3: setPictureBoxImage("SimRSU Road Works Warning", "pictureBoxExpectationRsuRww", "BMP\\RSU_RWW_PassLeft.png"); break;
  }    
}

// Callback function on receiving DENM messages
void OnRxDENM(long channel, long dir, long radioChannel, long signalStrength, long signalQuality, long packet)
{
  stack char stationName[100];
  struct DENM myDENM;

  API_GetDENMParams(packet, myDENM);
  gStationHandle = C2xGetStationHandle(packet);
  if (C2xGetStationName(gStationHandle, elcount(stationName), stationName) == -1)
  {
    return;
  }
  
  if (strncmp(stationName, rwwTesterName, elcount(rwwTesterName) + 1) == 0)
  {
    @RSU_RoadWorksWarning::StationID = myDENM.header.stationID;
    @RSU_RoadWorksWarning::StationType = myDENM.denm.management.stationType;
    
    @GPS::GPS1.Latitude  = C2xGetTokenInt(packet, "geo_eh", "lpvLatitude") * 1e-7;
    @GPS::GPS1.Longitude = C2xGetTokenInt(packet, "geo_eh", "lpvLongitude") * 1e-7;
    @GPS::GPS1.Direction = C2xGetTokenInt(packet, "geo_eh", "lpvHeading") * 1e-1;
    
    CheckRWWDENMMessage(packet);
    // draw closed lanes
    drawCloseLanes(packet);
  }
  // automatically assign station with DENM CauseCode 3 (RoadWorks)
  else if (myDENM.denm.situation.eventType.causeCode == 3)
  {
      // check if this is the first DENM with correct CC, then assign node to station
      if (firstDENMReceived == 0)
      {
        C2xAssignNodeToStation(gStationHandle, "EU_ApplMsg", "DuT");
        firstDENMReceived = 1;
      }
  }
}

void CheckRWWDENMMessage(long packet)
{
  struct DENM myDENM;
  long numb;
  
  API_GetDENMParams(packet, myDENM);
  gPacket = packet;

  CheckValidPathHistory();
  CheckRelevanceInfos(myDENM);
  CheckCauseCode(myDENM);
  CheckSubCauseCode(myDENM);
  CheckTrafficFlowRule(myDENM);
  GetIsMobile(packet);
  CheckInformationQuality(myDENM, packet);
  @EventInformation::EventLatitude = C2xGetTokenInt64(packet, "DENM", "denm.management.eventPosition.latitude") * 0.0000001;
  @EventInformation::EventLongitude = C2xGetTokenInt64(packet, "DENM", "denm.management.eventPosition.longitude") * 0.0000001;
  
  if (myDENM.denm.location.eventPositionHeading.isValidFlag == 1)
  { 
    @RSU_RoadWorksWarning::Heading = C2xGetTokenInt64(packet, "DENM", "denm.location.eventPositionHeading.headingValue") * 0.1;
  }

}

void GetIsMobile(long packet)
{
  char buffer[100];
  @RSU_RoadWorksWarning::isMobileFlag = C2xGetTokenInt(packet, "geo_ch", "glags");
  
  if (@RSU_RoadWorksWarning::isMobileFlag != @RWW_Configuration::Expected_IsMobile)
  {
    snprintf(buffer,elcount(buffer),"RWW isMobileFlag not as expected. Should be %i, but is %i.", @RWW_Configuration::Expected_IsMobile, @RSU_RoadWorksWarning::isMobileFlag);
    C2xReportProtocolViolation(gStationHandle, 1, "RWW|DENM|CustomRules", 50001, "RWW isMobile Flag not as expected", buffer, "Incorrect isMobile Flag");

  }
}

void CheckInformationQuality(struct DENM myDENM, long packet)
{
  char buffer[100];
  // Enumeration values for informationQuality: 
  // -------------------------------------------------------------
  // 0 : unavailable
  // 1 : lowest
  // 7 : highest
  // -------------------------------------------------------------
  @RSU_RoadWorksWarning::InformationQuality = myDENM.denm.situation.informationQuality;
  if (@RSU_RoadWorksWarning::InformationQuality != 2 && @RSU_RoadWorksWarning::InformationQuality != 4 && @RSU_RoadWorksWarning::InformationQuality != 6)
  {
    snprintf(buffer,elcount(buffer), "InformationQuality must be set to 2, 4 or 6, but is %i.", @RSU_RoadWorksWarning::InformationQuality);
    C2xReportProtocolViolation(gStationHandle, 1, "RWW|DENM|CustomRules", 60000, "RWW InformationQuality must be set to 2, 4 or 6", buffer, "Incorrect InformationQuality");
  }
}

/************************************************************/
void CheckRelevanceInfos(struct DENM myDENM)
{
  // Enumeration values for relevanceDistance: 
  // -------------------------------------------------------------
  // 0 : lessThan50m
  // 1 : lessThan100m
  // 2 : lessThan200m
  // 3 : lessThan500m
  // 4 : lessThan1000m
  // 5 : lessThan5km
  // 6 : lessThan10km
  // 7 : over10km
  // -------------------------------------------------------------
  @RSU_RoadWorksWarning::RelevanceDistance = myDENM.denm.management.relevanceDistance.value;
  
  // Enumeration values for relevanceTrafficDirection: 
  // -------------------------------------------------------------
  // 0 : allTrafficDirections
  // 1 : upstreamTraffic
  // 2 : downstreamTraffic
  // 3 : oppositeTraffic
  // -------------------------------------------------------------
  @RSU_RoadWorksWarning::RelevanceDirection =  myDENM.denm.management.relevanceTrafficDirection.value;
}

/************************************************************/
void CheckCauseCode(struct DENM myDENM)
{
  char buffer[100];
  if (myDENM.denm.situation.eventType.causeCode !=3 )
  {
    snprintf(buffer,elcount(buffer), "RWW CauseCode must be 3, but is %i", myDENM.denm.situation.eventType.causeCode);
    C2xReportProtocolViolation(gStationHandle, 0, "RWW|DENM|CustomRules", 60001, "RWW CauseCode must be 3.", "Incorrect CauseCode", buffer);
  }
  @RSU_RoadWorksWarning::SubCauseCode = myDENM.denm.situation.eventType.subCauseCode;
}

/************************************************************/
void CheckSubCauseCode(struct DENM myDENM)
{
  char buffer[100];
  @RSU_RoadWorksWarning::SubCauseCode = myDENM.denm.situation.eventType.subCauseCode;
  
  // RWW-LC: 0/4
  if (@RWW_Configuration::RWW_Usecase == 0)
  {
    CheckRWW_LC(myDENM);
    if (@RSU_RoadWorksWarning::SubCauseCode != 0 && @RSU_RoadWorksWarning::SubCauseCode != 4)
    {
      snprintf(buffer,elcount(buffer), "RWW-LC SubCauseCode must be 0 or 4, but is %i", myDENM.denm.situation.eventType.subCauseCode);
      C2xReportProtocolViolation(gStationHandle, 0, "RWW|DENM|CustomRules", 61000, "RWW-LC SubCauseCode must be 0 or 4.", "Incorrect SubCauseCode", buffer);     
    }
  }
  // RWW-RC: 1
  else if (@RWW_Configuration::RWW_Usecase == 1)
  {
    CheckRWW_RC(myDENM);
    if (@RSU_RoadWorksWarning::SubCauseCode != 1)
    {
      snprintf(buffer,elcount(buffer), "RWW-RC SubCauseCode must be 1, but is %i", myDENM.denm.situation.eventType.subCauseCode);
      C2xReportProtocolViolation(gStationHandle, 0, "RWW|DENM|CustomRules", 62000, "RWW-RC SubCauseCode must be 1.", "Incorrect SubCauseCode", buffer);     
    }
  }
  // RWW-RM: 0/3
  else if (@RWW_Configuration::RWW_Usecase == 2)
  {
    if (@RSU_RoadWorksWarning::SubCauseCode != 0 && @RSU_RoadWorksWarning::SubCauseCode != 3)
    {
      snprintf(buffer,elcount(buffer), "RWW-RM SubCauseCode must be 0 or 3, but is %i", myDENM.denm.situation.eventType.subCauseCode);
      C2xReportProtocolViolation(gStationHandle, 0, "RWW|DENM|CustomRules", 63000, "RWW-RM SubCauseCode must be 0 or 3.", "Incorrect SubCauseCode", buffer);     
    }
  }
}

/************************************************************/
void CheckRWW_LC(struct DENM myDENM)
{
  // Enumeration values for trafficFlowRule: 
  // -------------------------------------------------------------
  // 0 : noPassing
  // 1 : noPassingForTrucks
  // 2 : passToRight
  // 3 : passToLeft
  // -------------------------------------------------------------
  if (myDENM.denm.alacarte.roadWorks.trafficFlowRule.isValidFlag == 0 && myDENM.denm.alacarte.roadWorks.closedLanes.drivingLaneStatus.isValidFlag == 0)
  {
     C2xReportProtocolViolation(gStationHandle, 0, "RWW|DENM|CustomRules|RWW-LC", 61001, "Lane information must be given", "Lane information missing", "TrafficFlowRule or CloseLane must be given.");     
  }
}

/************************************************************/
void CheckRWW_RC(struct DENM myDENM)
{
  char laneStatus[13];
  int i;
  if (C2xIsTokenAvailable(gPacket, "DENM", "denm.alacarte.roadWorks.closedLanes.drivingLaneStatus"))
  {
    C2xGetTokenBitString(gPacket, "DENM", "denm.alacarte.roadWorks.closedLanes.drivingLaneStatus", 13, laneStatus);
    for (i=0; i<elcount(laneStatus);i++)
    {
      if (laneStatus[i] == '0')
      {
         C2xReportProtocolViolation(gStationHandle, 0, "RWW|DENM|CustomRules|RWW-RC", 62001, "All lanes must be closed.", "Not all lanes are closed.", "All lanes must be closed.");
        return;
      }
    }
  }
  else
  {
     C2xReportProtocolViolation(gStationHandle, 0, "RWW|DENM|CustomRules|RWW-RC", 62001, "All lanes must be closed.", "Not all lanes are closed.", "All lanes must be closed.");     
  }
}

/************************************************************/
void CheckTrafficFlowRule(struct DENM myDENM)
{
  // Enumeration values for trafficFlowRule: 
  // -------------------------------------------------------------
  // 0 : noPassing
  // 1 : noPassingForTrucks
  // 2 : passToRight
  // 3 : passToLeft
  // -------------------------------------------------------------
  if (myDENM.denm.alacarte.roadWorks.trafficFlowRule.isValidFlag == 1)
  {
    @RSU_RoadWorksWarning::TrafficFlowRule = myDENM.denm.alacarte.roadWorks.trafficFlowRule.value;
  }
  else
  {
    setPictureBoxImage("SimRSU Road Works Warning", "pictureBoxRsuRww", "BMP\\RSU_RWW_NoTrafficRuleData.png");
    @RSU_RoadWorksWarning::TrafficFlowRule = -1;
  }

}

/************************************************************/
on sysvar RSU_RoadWorksWarning::TrafficFlowRule
{
  switch(@sysvar::RSU_RoadWorksWarning::TrafficFlowRule)
  {
    case -1: setPictureBoxImage("SimRSU Road Works Warning", "pictureBoxRsuRww", "BMP\\RSU_RWW_NoTrafficRuleData.png"); break;
    case  0: setPictureBoxImage("SimRSU Road Works Warning", "pictureBoxRsuRww", "BMP\\RSU_RWW_NoPassing.png"); break;
    case  1: setPictureBoxImage("SimRSU Road Works Warning", "pictureBoxRsuRww", "BMP\\RSU_RWW_NoTrucksPassing.png"); break;
    case  2: setPictureBoxImage("SimRSU Road Works Warning", "pictureBoxRsuRww", "BMP\\RSU_RWW_PassRight.png"); break;
    case  3: setPictureBoxImage("SimRSU Road Works Warning", "pictureBoxRsuRww", "BMP\\RSU_RWW_PassLeft.png"); break;
  }
}

void drawCloseLanes(long packet)
 {
  struct DENM myDENM;
  long numberOfLanes;
  char lanes[50];
  int i;
  API_GetDENMParams(packet, myDENM);
  
  sysSetVariableString(sysvar::RWW_Display::closedLanes, lanes);
  if (myDENM.denm.alacarte.roadWorks.closedLanes.isValidFlag == 1)
  {
    numberOfLanes = myDENM.denm.alacarte.roadWorks.closedLanes.drivingLaneStatus.stringLength;
    for (i=0; i<numberOfLanes; i++)
    {
      if (myDENM.denm.alacarte.roadWorks.closedLanes.drivingLaneStatus.string[i] == 0)
      {
        strncat(lanes, "|   ", 50);
      }
      else
      {
        strncat(lanes, "| X  ", 50);
      }
    }
    
    if (myDENM.denm.alacarte.roadWorks.closedLanes.outerhardShoulderStatus.isValidFlag == 0)
    {
      strncat(lanes, "|", 50);
    }
    else
    {
      // Enumeration values for outerhardShoulderStatus: 
      // -------------------------------------------------------------
      // 0 : availableForStopping
      // 1 : closed
      // 2 : availableForDriving
      // -------------------------------------------------------------
      if (myDENM.denm.alacarte.roadWorks.closedLanes.outerhardShoulderStatus.value == 0)
      {
        strncat(lanes, "|| / |", 50);
      }
      else if (myDENM.denm.alacarte.roadWorks.closedLanes.outerhardShoulderStatus.value == 1)
      {
        strncat(lanes, "|| X |", 50);
      }
      else if (myDENM.denm.alacarte.roadWorks.closedLanes.outerhardShoulderStatus.value == 2)
      {
        strncat(lanes, "||   |", 50);
      }
    }
    sysSetVariableString(sysvar::RWW_Display::closedLanes, lanes);
  }
}

void CheckValidPathHistory()
{
  char  buffer[100];
  char  pathDeltaLat[1000];
  char  pathDeltaLon[1000];
  int64   positionExist;
  double prevLat, prevLon;
  double nextLat, nextLon;
  double distToNext;
  int pathPointsDistanceInvalid;
  double pathHistoryLength;
  int numberPathPoints;

  if (C2xIsTokenAvailable(gPacket,"DENM", "denm.location.traces.[0].[0]") == 1)
  {
    pathLat.clear();
    pathLon.clear();
    numberPathPoints = 0;
    pathHistoryLength = 0;
    pathPointsDistanceInvalid = 0;
    prevLat = C2xGetTokenInt64(gPacket, "DENM", "denm.management.eventPosition.latitude") * 0.0000001;
    prevLon = C2xGetTokenInt64(gPacket, "DENM", "denm.management.eventPosition.longitude") * 0.0000001;
    snprintf(pathDeltaLat, elcount(pathDeltaLat), "denm.location.traces.[0].[%d].pathPosition.deltaLatitude", numberPathPoints);
    snprintf(pathDeltaLon, elcount(pathDeltaLon), "denm.location.traces.[0].[%d].pathPosition.deltaLongitude", numberPathPoints);
    
    positionExist = C2xIsTokenAvailable(gPacket, "DENM", pathDeltaLat) * C2xIsTokenAvailable(gPacket, "DENM", pathDeltaLon);
    pathLat[numberPathPoints] = prevLat;
    pathLon[numberPathPoints] = prevLon;
    
    while (positionExist == 1)
    {
      nextLat = prevLat + C2xGetTokenInt64(gPacket, "DENM", pathDeltaLat) * 0.0000001;
      nextLon = prevLon + C2xGetTokenInt64(gPacket, "DENM", pathDeltaLon) * 0.0000001; 
      
      distToNext = API_PosCalcDistance(prevLat, prevLon, nextLat, nextLon);
      
      if (distToNext < 10)
      {
        pathPointsDistanceInvalid = 1;
      }
     
      pathHistoryLength += distToNext;
      
      prevLat = nextLat;
      prevLon = nextLon;
      
      pathLat[numberPathPoints+1] = prevLat;
      pathLon[numberPathPoints+1] = prevLon;
      
      numberPathPoints++;
      
      snprintf(pathDeltaLat, elcount(pathDeltaLat), "denm.location.traces.[0].[%d].pathPosition.deltaLatitude", numberPathPoints);
      snprintf(pathDeltaLon, elcount(pathDeltaLon), "denm.location.traces.[0].[%d].pathPosition.deltaLongitude", numberPathPoints);

      positionExist = C2xIsTokenAvailable(gPacket, "DENM", pathDeltaLat) * C2xIsTokenAvailable(gPacket, "DENM", pathDeltaLon);
    }
    
    if (pathPointsDistanceInvalid == 1)
    {
      C2xReportProtocolViolation(gStationHandle, 1, "RWW|DENM|CustomRules", 60002, "PathHistory Points should not be on top of each other", "Some PathHistory Points are less than 10m apart.", "PathHistory Points should be at least 10m apart.");
    }
    // check if there are enough points in PathHistory
    if (numberPathPoints < 5)
    {
      C2xReportProtocolViolation(gStationHandle, 1, "RWW|DENM|CustomRules", 60003, "PathHistory should contain some points", "PathHistory cointans not enough PathPoints", "PathHistory Points should contain at least 5 PathPoints.");
    }
    // check if PathHistory is long enough
    if (pathHistoryLength < 570)
    {
      snprintf(buffer,elcount(buffer), "PathHistory is too short, should be over 600m but is only %fm", pathHistoryLength);
      C2xReportProtocolViolation(gStationHandle, 0, "RWW|DENM|CustomRules", 60004, "PathHistory must be over 600m", buffer, "PathHistory must be at least 600m long.");
    }
  }
  else
  {
    C2xReportProtocolViolation(gStationHandle, 0, "RWW|DENM|CustomRules", 60005, "PathHistory must exist", "PathHistory is missing.", "DENM must contain a PathHistory.");
  }
}

on sysvar EventInformation::ConnectPathHistory
{
  int i;
  long handle;
  
  if (@this == 1)
  {
    for (i = 1; i < pathLon.size(); i++)
    {
      gHandles[i-1] = CreateMapObject( Line );
      SetMapObjectPosition(gHandles[i-1], pathLat[i-1], pathLon[i-1], pathLat[i], pathLon[i]);

      // optional settings
      SetMapObjectLineColor(gHandles[i-1], makeRGB(255, 0, 0));
      SetMapObjectPenWidth(gHandles[i-1], 2);
      // draw object
      DrawMapObject(gHandles[i-1]);
    }
  }
  if (@this == 0)
  {
    for (i = 0; i< elCount(gHandles) ; i++)
    {
       DeleteMapObject(gHandles[i]);   
    }
  }
}