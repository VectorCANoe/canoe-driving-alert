/*@!Encoding:1252*/
/*
//  (c) Vector Informatik GmbH. All rights reserved.
//
//  This file contains definitions of structs and methods that may be used
//  to set and get the values of an ASN.1 defined packet's payload.
//
//  //This example demonstrates how to set a packet's payload:
//  LONG packetHandle;
//  struct DENM payload;
//  //you need to set the values of the variable "payload" yourself
//  packetHandle = API_InitDENMPacket();
//  if (packetHandle!=0) {
//    if (API_SetDENMParams(packetHandle, payload)==0) {
//      if (C2xCompletePacket(packetHandle)==0) {
//        C2xOutputPacket(packetHandle);
//      }
//    }
//  }
//                                                                             */
includes
{

}
variables
{
    struct DENMItsPduHeader {
        INT isValidFlag;   // necessary if this struct is used as an optional field of a SEQUENCE
        BYTE protocolVersion;  // INTEGER, 0..255;
        BYTE messageID;  // INTEGER, 0..255, denm(1), cam(2), poi(3), spatem(4), mapem(5), ivim(6), ev_rsr(7), tistpgtransaction(8), srem(9), ssem(10), evcsn(11), saem(12), rtcmem(13);
        DWORD stationID;  // INTEGER, 0..4294967295;
    };
    
    struct DENMActionID {
        INT isValidFlag;   // necessary if this struct is used as an optional field of a SEQUENCE
        DWORD originatingStationID;  // INTEGER, 0..4294967295;
        WORD sequenceNumber;  // INTEGER, 0..65535;
    };
    
    struct DENMPosConfidenceEllipse {
        INT isValidFlag;   // necessary if this struct is used as an optional field of a SEQUENCE
        WORD semiMajorConfidence;  // INTEGER, 0..4095, outOfRange(4094), unavailable(4095);
        WORD semiMinorConfidence;  // INTEGER, 0..4095, outOfRange(4094), unavailable(4095);
        WORD semiMajorOrientation;  // INTEGER, 0..3601, unavailable(3601);
    };
    
    struct DENMAltitude {
        INT isValidFlag;   // necessary if this struct is used as an optional field of a SEQUENCE
        LONG altitudeValue;  // INTEGER, -100000..800001, unavailable(800001);
        INT altitudeConfidence;  // ENUMERATED, alt_000_01(0), alt_000_02(1), alt_000_05(2), alt_000_10(3), alt_000_20(4), alt_000_50(5), alt_001_00(6), alt_002_00(7), alt_005_00(8), alt_010_00(9), alt_020_00(10), alt_050_00(11), alt_100_00(12), alt_200_00(13), outOfRange(14), unavailable(15);
    };
    
    struct DENMReferencePosition {
        INT isValidFlag;   // necessary if this struct is used as an optional field of a SEQUENCE
        LONG latitude;  // INTEGER, -900000000..900000001, unavailable(900000001);
        LONG longitude;  // INTEGER, -1800000000..1800000001, unavailable(1800000001);
        struct DENMPosConfidenceEllipse positionConfidenceEllipse;  // SEQUENCE;
        struct DENMAltitude altitude;  // SEQUENCE;
    };
    
    struct DENMManagementContainer {
        INT isValidFlag;   // necessary if this struct is used as an optional field of a SEQUENCE
        struct DENMActionID actionID;  // SEQUENCE;
        QWORD detectionTime;  // INTEGER, 0..4398046511103;
        QWORD referenceTime;  // INTEGER, 0..4398046511103;
        struct OPT_ENUM_ASN termination;  // ENUMERATED, OPTIONAL, isCancellation(0), isNegation(1);
        struct DENMReferencePosition eventPosition;  // SEQUENCE;
        struct OPT_ENUM_ASN relevanceDistance;  // ENUMERATED, OPTIONAL, lessThan50m(0), lessThan100m(1), lessThan200m(2), lessThan500m(3), lessThan1000m(4), lessThan5km(5), lessThan10km(6), over10km(7);
        struct OPT_ENUM_ASN relevanceTrafficDirection;  // ENUMERATED, OPTIONAL, allTrafficDirections(0), upstreamTraffic(1), downstreamTraffic(2), oppositeTraffic(3);
        struct OPT_DWORD_ASN validityDuration;  // INTEGER, OPTIONAL, 0..86400, timeOfDetection(0), oneSecondAfterDetection(1);
        struct OPT_WORD_ASN transmissionInterval;  // INTEGER, OPTIONAL, 1..10000, oneMilliSecond(1), tenSeconds(10000);
        BYTE stationType;  // INTEGER, 0..255, unknown(0), pedestrian(1), cyclist(2), moped(3), motorcycle(4), passengerCar(5), bus(6), lightTruck(7), heavyTruck(8), trailer(9), specialVehicles(10), tram(11), roadSideUnit(15);
    };
    
    struct DENMCauseCode {
        INT isValidFlag;   // necessary if this struct is used as an optional field of a SEQUENCE
        BYTE causeCode;  // INTEGER, 0..255, reserved(0), trafficCondition(1), accident(2), roadworks(3), impassability(5), adverseWeatherCondition_Adhesion(6), aquaplannning(7), hazardousLocation_SurfaceCondition(9), hazardousLocation_ObstacleOnTheRoad(10), hazardousLocation_AnimalOnTheRoad(11), humanPresenceOnTheRoad(12), wrongWayDriving(14), rescueAndRecoveryWorkInProgress(15), adverseWeatherCondition_ExtremeWeatherCondition(17), adverseWeatherCondition_Visibility(18), adverseWeatherCondition_Precipitation(19), stoneThrowingPerson(20), slowVehicle(26), dangerousEndOfQueue(27), vehicleBreakdown(91), postCrash(92), humanProblem(93), stationaryVehicle(94), emergencyVehicleApproaching(95), hazardousLocation_DangerousCurve(96), collisionRisk(97), signalViolation(98), dangerousSituation(99), railwayCrossing(100);
        BYTE subCauseCode;  // INTEGER, 0..255;
    };
    
    struct DENMDeltaReferencePosition {
        INT isValidFlag;   // necessary if this struct is used as an optional field of a SEQUENCE
        LONG deltaLatitude;  // INTEGER, -131071..131072, unavailable(131072);
        LONG deltaLongitude;  // INTEGER, -131071..131072, unavailable(131072);
        INT deltaAltitude;  // INTEGER, -12700..12800, unavailable(12800);
    };
    
    struct DENMEventPoint {
        INT isValidFlag;   // necessary if this struct is used as an optional field of a SEQUENCE
        struct DENMDeltaReferencePosition eventPosition;  // SEQUENCE;
        struct OPT_WORD_ASN eventDeltaTime;  // INTEGER, OPTIONAL, 1..65535;
        BYTE informationQuality;  // INTEGER, 0..7, unavailable(0), lowest(1), highest(7);
    };
    
    struct DENMEventHistory {
        INT isValidFlag;   // necessary if this struct is used as an optional field of a SEQUENCE
        INT length;
        struct DENMEventPoint arrayValue[23];  // SEQUENCE;
    };
    
    struct DENMSituationContainer {
        INT isValidFlag;   // necessary if this struct is used as an optional field of a SEQUENCE
        BYTE informationQuality;  // INTEGER, 0..7, unavailable(0), lowest(1), highest(7);
        struct DENMCauseCode eventType;  // SEQUENCE;
        struct DENMCauseCode linkedCause;  // SEQUENCE, OPTIONAL;
        struct DENMEventHistory eventHistory;  // SEQUENCEOF, OPTIONAL;
    };
    
    struct DENMSpeed {
        INT isValidFlag;   // necessary if this struct is used as an optional field of a SEQUENCE
        WORD speedValue;  // INTEGER, 0..16383, unavailable(16383);
        BYTE speedConfidence;  // INTEGER, 1..127, outOfRange(126), unavailable(127);
    };
    
    struct DENMHeading {
        INT isValidFlag;   // necessary if this struct is used as an optional field of a SEQUENCE
        WORD headingValue;  // INTEGER, 0..3601, unavailable(3601);
        BYTE headingConfidence;  // INTEGER, 1..127, outOfRange(126), unavailable(127);
    };
    
    struct DENMPathPoint {
        INT isValidFlag;   // necessary if this struct is used as an optional field of a SEQUENCE
        struct DENMDeltaReferencePosition pathPosition;  // SEQUENCE;
        struct OPT_WORD_ASN pathDeltaTime;  // INTEGER, OPTIONAL, 1..65535;
    };
    
    struct DENMPathHistory {
        INT isValidFlag;   // necessary if this struct is used as an optional field of a SEQUENCE
        INT length;
        struct DENMPathPoint arrayValue[40];  // SEQUENCE;
    };
    
    struct DENMTraces {
        INT isValidFlag;   // necessary if this struct is used as an optional field of a SEQUENCE
        INT length;
        struct DENMPathHistory arrayValue[7];  // SEQUENCEOF;
    };
    
    struct DENMLocationContainer {
        INT isValidFlag;   // necessary if this struct is used as an optional field of a SEQUENCE
        struct DENMSpeed eventSpeed;  // SEQUENCE, OPTIONAL;
        struct DENMHeading eventPositionHeading;  // SEQUENCE, OPTIONAL;
        struct DENMTraces traces;  // SEQUENCEOF;
        struct OPT_ENUM_ASN roadType;  // ENUMERATED, OPTIONAL, urban_NoStructuralSeparationToOppositeLanes(0), urban_WithStructuralSeparationToOppositeLanes(1), nonUrban_NoStructuralSeparationToOppositeLanes(2), nonUrban_WithStructuralSeparationToOppositeLanes(3);
    };
    
    struct DENMPositionOfPillars {
        INT isValidFlag;   // necessary if this struct is used as an optional field of a SEQUENCE
        INT length;
        BYTE arrayValue[3];  // INTEGER, 1..30, unavailable(30);
    };
    
    struct DENMPositionOfOccupants {
        INT isValidFlag;   // necessary if this struct is used as an optional field of a SEQUENCE
        CHAR string[21];
        INT  stringLength;
    };
    
    struct DENMImpactReductionContainer {
        INT isValidFlag;   // necessary if this struct is used as an optional field of a SEQUENCE
        BYTE heightLonCarrLeft;  // INTEGER, 1..100, unavailable(100);
        BYTE heightLonCarrRight;  // INTEGER, 1..100, unavailable(100);
        BYTE posLonCarrLeft;  // INTEGER, 1..127, unavailable(127);
        BYTE posLonCarrRight;  // INTEGER, 1..127, unavailable(127);
        struct DENMPositionOfPillars positionOfPillars;  // SEQUENCEOF;
        BYTE posCentMass;  // INTEGER, 1..63, unavailable(63);
        BYTE wheelBaseVehicle;  // INTEGER, 1..127, unavailable(127);
        BYTE turningRadius;  // INTEGER, 1..255, unavailable(255);
        BYTE posFrontAx;  // INTEGER, 1..20, unavailable(20);
        struct DENMPositionOfOccupants positionOfOccupants;  // BITSTRING;
        WORD vehicleMass;  // INTEGER, 1..1024, unavailable(1024);
        INT requestResponseIndication;  // ENUMERATED, request(0), response(1);
    };
    
    struct DENMLightBarSirenInUse {
        INT isValidFlag;   // necessary if this struct is used as an optional field of a SEQUENCE
        CHAR string[3];
        INT  stringLength;
    };
    
    struct DENMDrivingLaneStatus {
        INT isValidFlag;   // necessary if this struct is used as an optional field of a SEQUENCE
        CHAR string[14];
        INT  stringLength;
    };
    
    struct DENMClosedLanes {
        INT isValidFlag;   // necessary if this struct is used as an optional field of a SEQUENCE
        struct OPT_ENUM_ASN innerhardShoulderStatus;  // ENUMERATED, OPTIONAL, availableForStopping(0), closed(1), availableForDriving(2);
        struct OPT_ENUM_ASN outerhardShoulderStatus;  // ENUMERATED, OPTIONAL, availableForStopping(0), closed(1), availableForDriving(2);
        struct DENMDrivingLaneStatus drivingLaneStatus;  // BITSTRING, OPTIONAL;
    };
    
    struct DENMRestrictedTypes {
        INT isValidFlag;   // necessary if this struct is used as an optional field of a SEQUENCE
        INT length;
        BYTE arrayValue[3];  // INTEGER, 0..255, unknown(0), pedestrian(1), cyclist(2), moped(3), motorcycle(4), passengerCar(5), bus(6), lightTruck(7), heavyTruck(8), trailer(9), specialVehicles(10), tram(11), roadSideUnit(15);
    };
    
    struct DENMItineraryPath {
        INT isValidFlag;   // necessary if this struct is used as an optional field of a SEQUENCE
        INT length;
        struct DENMReferencePosition arrayValue[40];  // SEQUENCE;
    };
    
    struct DENMReferenceDenms {
        INT isValidFlag;   // necessary if this struct is used as an optional field of a SEQUENCE
        INT length;
        struct DENMActionID arrayValue[8];  // SEQUENCE;
    };
    
    struct DENMRoadWorksContainerExtended {
        INT isValidFlag;   // necessary if this struct is used as an optional field of a SEQUENCE
        struct DENMLightBarSirenInUse lightBarSirenInUse;  // BITSTRING, OPTIONAL;
        struct DENMClosedLanes closedLanes;  // SEQUENCE, OPTIONAL;
        struct DENMRestrictedTypes restriction;  // SEQUENCEOF, OPTIONAL;
        struct OPT_BYTE_ASN speedLimit;  // INTEGER, OPTIONAL, 1..255;
        struct DENMCauseCode incidentIndication;  // SEQUENCE, OPTIONAL;
        struct DENMItineraryPath recommendedPath;  // SEQUENCEOF, OPTIONAL;
        struct DENMDeltaReferencePosition startingPointSpeedLimit;  // SEQUENCE, OPTIONAL;
        struct OPT_ENUM_ASN trafficFlowRule;  // ENUMERATED, OPTIONAL, noPassing(0), noPassingForTrucks(1), passToRight(2), passToLeft(3);
        struct DENMReferenceDenms referenceDenms;  // SEQUENCEOF, OPTIONAL;
    };
    
    struct DENMDangerousGoodsExtended_emergencyActionCode {
        INT isValidFlag;   // necessary if this struct is used as an optional field of a SEQUENCE
        CHAR string[25];
        INT  stringLength;
    };
    
    struct DENMPhoneNumber {
        INT isValidFlag;   // necessary if this struct is used as an optional field of a SEQUENCE
        CHAR string[17];
        INT  stringLength;
    };
    
    struct DENMDangerousGoodsExtended_companyName {
        INT isValidFlag;   // necessary if this struct is used as an optional field of a SEQUENCE
        CHAR string[25];
        INT  stringLength;
    };
    
    struct DENMDangerousGoodsExtended {
        INT isValidFlag;   // necessary if this struct is used as an optional field of a SEQUENCE
        INT dangerousGoodsType;  // ENUMERATED, explosives1(0), explosives2(1), explosives3(2), explosives4(3), explosives5(4), explosives6(5), flammableGases(6), nonFlammableGases(7), toxicGases(8), flammableLiquids(9), flammableSolids(10), substancesLiableToSpontaneousCombustion(11), substancesEmittingFlammableGasesUponContactWithWater(12), oxidizingSubstances(13), organicPeroxides(14), toxicSubstances(15), infectiousSubstances(16), radioactiveMaterial(17), corrosiveSubstances(18), miscellaneousDangerousSubstances(19);
        WORD unNumber;  // INTEGER, 0..9999;
        INT elevatedTemperature;  // BOOLEAN;
        INT tunnelsRestricted;  // BOOLEAN;
        INT limitedQuantity;  // BOOLEAN;
        struct DENMDangerousGoodsExtended_emergencyActionCode emergencyActionCode;  // IA5STRING, OPTIONAL;
        struct DENMPhoneNumber phoneNumber;  // NUMERICSTRING, OPTIONAL;
        struct DENMDangerousGoodsExtended_companyName companyName;  // UTF8STRING, OPTIONAL;
    };
    
    struct DENMWMInumber {
        INT isValidFlag;   // necessary if this struct is used as an optional field of a SEQUENCE
        CHAR string[4];
        INT  stringLength;
    };
    
    struct DENMVDS {
        INT isValidFlag;   // necessary if this struct is used as an optional field of a SEQUENCE
        CHAR string[7];
        INT  stringLength;
    };
    
    struct DENMVehicleIdentification {
        INT isValidFlag;   // necessary if this struct is used as an optional field of a SEQUENCE
        struct DENMWMInumber wMInumber;  // IA5STRING, OPTIONAL;
        struct DENMVDS vDS;  // IA5STRING, OPTIONAL;
    };
    
    struct DENMEnergyStorageType {
        INT isValidFlag;   // necessary if this struct is used as an optional field of a SEQUENCE
        CHAR string[8];
        INT  stringLength;
    };
    
    struct DENMStationaryVehicleContainer {
        INT isValidFlag;   // necessary if this struct is used as an optional field of a SEQUENCE
        struct OPT_ENUM_ASN stationarySince;  // ENUMERATED, OPTIONAL, lessThan1Minute(0), lessThan2Minutes(1), lessThan15Minutes(2), equalOrGreater15Minutes(3);
        struct DENMCauseCode stationaryCause;  // SEQUENCE, OPTIONAL;
        struct DENMDangerousGoodsExtended carryingDangerousGoods;  // SEQUENCE, OPTIONAL;
        struct OPT_BYTE_ASN numberOfOccupants;  // INTEGER, OPTIONAL, 0..127, oneOccupant(1), unavailable(127);
        struct DENMVehicleIdentification vehicleIdentification;  // SEQUENCE, OPTIONAL;
        struct DENMEnergyStorageType energyStorageType;  // BITSTRING, OPTIONAL;
    };
    
    struct DENMSensorIdList {
        INT isValidFlag;   // necessary if this struct is used as an optional field of a SEQUENCE
        INT length;
        BYTE arrayValue[128];  // INTEGER, 0..255;
    };
    
    struct DENMObjectDistanceWithConfidence {
        INT isValidFlag;   // necessary if this struct is used as an optional field of a SEQUENCE
        LONG value;  // INTEGER, -132768..132767, zeroPointZeroOneMeter(1), oneMeter(100);
        BYTE confidence;  // INTEGER, 0..102, zeroPointZeroOneMeter(1), oneMeter(100), outOfRange(101), unavailable(102);
    };
    
    struct DENMSpeedExtended {
        INT isValidFlag;   // necessary if this struct is used as an optional field of a SEQUENCE
        INT value;  // INTEGER, -16383..16383, standstill(0), oneCentimeterPerSec(1), unavailable(16383);
        BYTE confidence;  // INTEGER, 1..127, outOfRange(126), unavailable(127);
    };
    
    struct DENMLongitudinalAcceleration {
        INT isValidFlag;   // necessary if this struct is used as an optional field of a SEQUENCE
        INT longitudinalAccelerationValue;  // INTEGER, -160..161, unavailable(161);
        BYTE longitudinalAccelerationConfidence;  // INTEGER, 0..102, outOfRange(101), unavailable(102);
    };
    
    struct DENMLateralAcceleration {
        INT isValidFlag;   // necessary if this struct is used as an optional field of a SEQUENCE
        INT lateralAccelerationValue;  // INTEGER, -160..161, unavailable(161);
        BYTE lateralAccelerationConfidence;  // INTEGER, 0..102, outOfRange(101), unavailable(102);
    };
    
    struct DENMVerticalAcceleration {
        INT isValidFlag;   // necessary if this struct is used as an optional field of a SEQUENCE
        INT verticalAccelerationValue;  // INTEGER, -160..161, unavailable(161);
        BYTE verticalAccelerationConfidence;  // INTEGER, 0..102, outOfRange(101), unavailable(102);
    };
    
    struct DENMCartesianAngle {
        INT isValidFlag;   // necessary if this struct is used as an optional field of a SEQUENCE
        WORD value;  // INTEGER, 0..3601, zeroPointOneDegree(1), oneDegree(10), unavailable(3601);
        BYTE confidence;  // INTEGER, 1..127, zeroPointOneDegree(1), oneDegree(10), outOfRange(126), unavailable(127);
    };
    
    struct DENMObjectDimension {
        INT isValidFlag;   // necessary if this struct is used as an optional field of a SEQUENCE
        WORD value;  // INTEGER, 0..1023, zeroPointOneMeter(1), oneMeter(10);
        BYTE confidence;  // INTEGER, 0..102, zeroPointZeroOneMeter(1), oneMeter(100), outOfRange(101), unavailable(102);
    };
    
    struct DENMVehicleSubclass {
        INT isValidFlag;   // necessary if this struct is used as an optional field of a SEQUENCE
        struct OPT_BYTE_ASN type;  // INTEGER, OPTIONAL, 0..255, unknown(0), moped(1), motorcycle(2), passengerCar(3), bus(4), lightTruck(5), heavyTruck(6), trailer(7), specialVehicles(8), tram(9), emergencyVehicle(10), agricultural(11);
        struct OPT_BYTE_ASN confidence;  // INTEGER, OPTIONAL, 0..101, unknown(0), onePercent(1), oneHundredPercent(100), unavailable(101);
    };
    
    struct DENMPersonSubclass {
        INT isValidFlag;   // necessary if this struct is used as an optional field of a SEQUENCE
        struct OPT_BYTE_ASN type;  // INTEGER, OPTIONAL, 0..255, unknown(0), pedestrian(1), personInWheelchair(2), cyclist(3), personWithStroller(4), personOnSkates(5), personGroup(6);
        struct OPT_BYTE_ASN confidence;  // INTEGER, OPTIONAL, 0..101, unknown(0), onePercent(1), oneHundredPercent(100), unavailable(101);
    };
    
    struct DENMAnimalSubclass {
        INT isValidFlag;   // necessary if this struct is used as an optional field of a SEQUENCE
        struct OPT_BYTE_ASN type;  // INTEGER, OPTIONAL, 0..255, unknown(0);
        struct OPT_BYTE_ASN confidence;  // INTEGER, OPTIONAL, 0..101, unknown(0), onePercent(1), oneHundredPercent(100), unavailable(101);
    };
    
    struct DENMOtherSubclass {
        INT isValidFlag;   // necessary if this struct is used as an optional field of a SEQUENCE
        struct OPT_BYTE_ASN type;  // INTEGER, OPTIONAL, 0..255, unknown(0), roadSideUnit(1);
        struct OPT_BYTE_ASN confidence;  // INTEGER, OPTIONAL, 0..101, unknown(0), onePercent(1), oneHundredPercent(100), unavailable(101);
    };
    
    struct DENMObjectClass_class {
        INT isValidFlag;   // necessary if this struct is used as an optional field of a SEQUENCE
        INT choice;
        struct DENMVehicleSubclass vehicle;  // SEQUENCE;
        struct DENMPersonSubclass person;  // SEQUENCE;
        struct DENMAnimalSubclass animal;  // SEQUENCE;
        struct DENMOtherSubclass other;  // SEQUENCE;
    };
    
    struct DENMObjectClass {
        INT isValidFlag;   // necessary if this struct is used as an optional field of a SEQUENCE
        BYTE confidence;  // INTEGER, 0..101, unknown(0), onePercent(1), oneHundredPercent(100), unavailable(101);
        struct DENMObjectClass_class class;  // CHOICE;
    };
    
    struct DENMObjectClassDescription {
        INT isValidFlag;   // necessary if this struct is used as an optional field of a SEQUENCE
        INT length;
        struct DENMObjectClass arrayValue[8];  // SEQUENCE;
    };
    
    struct DENMLongitudinalLanePosition {
        INT isValidFlag;   // necessary if this struct is used as an optional field of a SEQUENCE
        WORD longitudinalLanePositionValue;  // INTEGER, 0..32767, zeroPointOneMeter(1);
        BYTE longitudinalLanePositionConfidence;  // INTEGER, 0..102, zeroPointZeroOneMeter(1), oneMeter(100), outOfRange(101), unavailable(102);
    };
    
    struct DENMMatchedPosition {
        INT isValidFlag;   // necessary if this struct is used as an optional field of a SEQUENCE
        struct OPT_BYTE_ASN laneID;  // INTEGER, OPTIONAL, 0..255;
        struct DENMLongitudinalLanePosition longitudinalLanePosition;  // SEQUENCE, OPTIONAL;
    };
    
    struct DENMPerceivedObject {
        INT isValidFlag;   // necessary if this struct is used as an optional field of a SEQUENCE
        BYTE objectID;  // INTEGER, 0..255;
        struct DENMSensorIdList sensorIDList;  // SEQUENCEOF, OPTIONAL;
        INT timeOfMeasurement;  // INTEGER, -1500..1500, oneMilliSecond(1);
        struct OPT_WORD_ASN objectAge;  // INTEGER, OPTIONAL, 0..1500, oneMiliSec(1);
        struct OPT_BYTE_ASN objectConfidence;  // INTEGER, OPTIONAL, 0..101, unknown(0), onePercent(1), oneHundredPercent(100), unavailable(101);
        struct DENMObjectDistanceWithConfidence xDistance;  // SEQUENCE;
        struct DENMObjectDistanceWithConfidence yDistance;  // SEQUENCE;
        struct DENMObjectDistanceWithConfidence zDistance;  // SEQUENCE, OPTIONAL;
        struct DENMSpeedExtended xSpeed;  // SEQUENCE;
        struct DENMSpeedExtended ySpeed;  // SEQUENCE;
        struct DENMSpeedExtended zSpeed;  // SEQUENCE, OPTIONAL;
        struct DENMLongitudinalAcceleration xAcceleration;  // SEQUENCE, OPTIONAL;
        struct DENMLateralAcceleration yAcceleration;  // SEQUENCE, OPTIONAL;
        struct DENMVerticalAcceleration zAcceleration;  // SEQUENCE, OPTIONAL;
        struct DENMCartesianAngle yawAngle;  // SEQUENCE, OPTIONAL;
        struct DENMObjectDimension planarObjectDimension1;  // SEQUENCE, OPTIONAL;
        struct DENMObjectDimension planarObjectDimension2;  // SEQUENCE, OPTIONAL;
        struct DENMObjectDimension verticalObjectDimension;  // SEQUENCE, OPTIONAL;
        struct OPT_BYTE_ASN objectRefPoint;  // INTEGER, OPTIONAL, 0..8, mid(0), bottomLeft(1), midLeft(2), topLeft(3), bottomMid(4), topMid(5), bottomRight(6), midRight(7), topRight(8);
        struct OPT_BYTE_ASN dynamicStatus;  // INTEGER, OPTIONAL, 0..2, dynamic(0), hasBeenDynamic(1), static(2);
        struct DENMObjectClassDescription classification;  // SEQUENCEOF, OPTIONAL;
        struct DENMMatchedPosition matchedPosition;  // SEQUENCE, OPTIONAL;
    };
    
    struct DENMWGS84Angle {
        INT isValidFlag;   // necessary if this struct is used as an optional field of a SEQUENCE
        WORD value;  // INTEGER, 0..3601, wgs84North(0), wgs84East(900), wgs84South(1800), wgs84West(2700), unavailable(3601);
        BYTE confidence;  // INTEGER, 1..127, zeroPointOneDegree(1), oneDegree(10), outOfRange(126), unavailable(127);
    };
    
    struct DENMPreCrashContainer {
        INT isValidFlag;   // necessary if this struct is used as an optional field of a SEQUENCE
        struct DENMPerceivedObject perceivedObject;  // SEQUENCE;
        struct OPT_DWORD_ASN objectStationId;  // INTEGER, OPTIONAL, 0..4294967295;
        struct OPT_WORD_ASN timeToCollision;  // INTEGER, OPTIONAL, 1..10000, oneMilliSecond(1), tenSeconds(10000);
        struct OPT_ENUM_ASN impactSection;  // ENUMERATED, OPTIONAL, unavailable(0), rear(1), front(2), sideLeftFront(3), sideLeftBack(4), sideRightFront(5), sideRightBack(6);
        struct DENMWGS84Angle hostVehicleOrientation;  // SEQUENCE;
    };
    
    struct DENMAlacarteContainer {
        INT isValidFlag;   // necessary if this struct is used as an optional field of a SEQUENCE
        struct OPT_INT_ASN lanePosition;  // INTEGER, OPTIONAL, -1..14, offTheRoad(-1), innerHardShoulder(0), innermostDrivingLane(1), secondLaneFromInside(2), outerHardShoulder(14);
        struct DENMImpactReductionContainer impactReduction;  // SEQUENCE, OPTIONAL;
        struct OPT_INT_ASN externalTemperature;  // INTEGER, OPTIONAL, -60..67, equalOrSmallerThanMinus60Deg(-60), oneDegreeCelsius(1), equalOrGreaterThan67Deg(67);
        struct DENMRoadWorksContainerExtended roadWorks;  // SEQUENCE, OPTIONAL;
        struct OPT_ENUM_ASN positioningSolution;  // ENUMERATED, OPTIONAL, noPositioningSolution(0), sGNSS(1), dGNSS(2), sGNSSplusDR(3), dGNSSplusDR(4), dR(5);
        struct DENMStationaryVehicleContainer stationaryVehicle;  // SEQUENCE, OPTIONAL;
        struct DENMPreCrashContainer preCrashContainer;  // SEQUENCE, OPTIONAL;
    };
    
    struct DENMDecentralizedEnvironmentalNotificationMessage {
        INT isValidFlag;   // necessary if this struct is used as an optional field of a SEQUENCE
        struct DENMManagementContainer management;  // SEQUENCE;
        struct DENMSituationContainer situation;  // SEQUENCE, OPTIONAL;
        struct DENMLocationContainer location;  // SEQUENCE, OPTIONAL;
        struct DENMAlacarteContainer alacarte;  // SEQUENCE, OPTIONAL;
    };
    
    struct DENM {
        INT isValidFlag;   // necessary if this struct is used as an optional field of a SEQUENCE
        struct DENMItsPduHeader header;  // SEQUENCE;
        struct DENMDecentralizedEnvironmentalNotificationMessage denm;  // SEQUENCE;
    };
    
}

/*
// init function to create a simple packet handle
*/ 
LONG API_InitDENMPacket()
{
  return C2xInitPacket("DENM"); 
}

/*
// init function to create a simple packet handle and
// initialize the struct with valid data
*/ 
LONG API_InitDENMPacket(struct DENM msgStruct)
{
  long pktHandle;

  pktHandle = API_InitDENMPacket();

  if (pktHandle != 0)
  {
    // create valid message and application data
    if (C2xCompletePacket(pktHandle) == 0) 
    {
      API_GetDENMParams(pktHandle, msgStruct);
    }
  }
  return pktHandle;
}

/*
// init function to create a packet with security layer and
// initialize the struct with valid data
*/ 
LONG API_InitDENMPacket(struct DENM msgStruct, char packetTypeDesignator[], char certificateName[])
{
  long pktHandle, certHdl;

  // initialize the packet
  pktHandle = C2xInitPacket("DENM", packetTypeDesignator);

  if (pktHandle != 0)
  {
    certHdl = C2xSecCertificateGetHandle(certificateName);  // get the certificate handle for the cert with name "certificateName"
    if (certHdl != 0) 
    {
      C2xSecPacketSetSignerHandle(pktHandle, certHdl); // set the certHdl to the packet
    }

    // create valid message and application data
    if (C2xCompletePacket(pktHandle) == 0) 
    {
      // copy application data to the application structure
      API_GetDENMParams(pktHandle, msgStruct);
    }
  }
  return pktHandle;
}
    

int GetDENMItsPduHeaderParams(LONG packetHandle, struct DENMItsPduHeader value, char oldPath[])
{
  char newPath[300];
  int result;

  result = 0;

  snprintf(newPath, elcount(newPath), "%s.%s", oldPath, "protocolVersion");
  value.protocolVersion = C2xGetTokenInt(packetHandle, "DENM", newPath);
  result = CheckLastError("DENM", gkFuncRefGet, result);

  snprintf(newPath, elcount(newPath), "%s.%s", oldPath, "messageID");
  value.messageID = C2xGetTokenInt(packetHandle, "DENM", newPath);
  result = CheckLastError("DENM", gkFuncRefGet, result);

  snprintf(newPath, elcount(newPath), "%s.%s", oldPath, "stationID");
  value.stationID = C2xGetTokenInt64(packetHandle, "DENM", newPath);
  result = CheckLastError("DENM", gkFuncRefGet, result);

  return result;
}

int SetDENMItsPduHeaderParams(LONG packetHandle, struct DENMItsPduHeader value, char oldPath[])
{
  char newPath[300];
  int result;

  result = 0;

  snprintf(newPath, elcount(newPath), "%s.%s", oldPath, "protocolVersion");
  C2xSetTokenInt(packetHandle, "DENM", newPath, value.protocolVersion);
  result = CheckLastError("DENM", gkFuncRefGet, result);

  snprintf(newPath, elcount(newPath), "%s.%s", oldPath, "messageID");
  C2xSetTokenInt(packetHandle, "DENM", newPath, value.messageID);
  result = CheckLastError("DENM", gkFuncRefGet, result);

  snprintf(newPath, elcount(newPath), "%s.%s", oldPath, "stationID");
  C2xSetTokenInt64(packetHandle, "DENM", newPath, value.stationID);
  result = CheckLastError("DENM", gkFuncRefGet, result);

  return result;
}

int GetDENMActionIDParams(LONG packetHandle, struct DENMActionID value, char oldPath[])
{
  char newPath[300];
  int result;

  result = 0;

  snprintf(newPath, elcount(newPath), "%s.%s", oldPath, "originatingStationID");
  value.originatingStationID = C2xGetTokenInt64(packetHandle, "DENM", newPath);
  result = CheckLastError("DENM", gkFuncRefGet, result);

  snprintf(newPath, elcount(newPath), "%s.%s", oldPath, "sequenceNumber");
  value.sequenceNumber = C2xGetTokenInt(packetHandle, "DENM", newPath);
  result = CheckLastError("DENM", gkFuncRefGet, result);

  return result;
}

int SetDENMActionIDParams(LONG packetHandle, struct DENMActionID value, char oldPath[])
{
  char newPath[300];
  int result;

  result = 0;

  snprintf(newPath, elcount(newPath), "%s.%s", oldPath, "originatingStationID");
  C2xSetTokenInt64(packetHandle, "DENM", newPath, value.originatingStationID);
  result = CheckLastError("DENM", gkFuncRefGet, result);

  snprintf(newPath, elcount(newPath), "%s.%s", oldPath, "sequenceNumber");
  C2xSetTokenInt(packetHandle, "DENM", newPath, value.sequenceNumber);
  result = CheckLastError("DENM", gkFuncRefGet, result);

  return result;
}

int GetDENMPosConfidenceEllipseParams(LONG packetHandle, struct DENMPosConfidenceEllipse value, char oldPath[])
{
  char newPath[300];
  int result;

  result = 0;

  snprintf(newPath, elcount(newPath), "%s.%s", oldPath, "semiMajorConfidence");
  value.semiMajorConfidence = C2xGetTokenInt(packetHandle, "DENM", newPath);
  result = CheckLastError("DENM", gkFuncRefGet, result);

  snprintf(newPath, elcount(newPath), "%s.%s", oldPath, "semiMinorConfidence");
  value.semiMinorConfidence = C2xGetTokenInt(packetHandle, "DENM", newPath);
  result = CheckLastError("DENM", gkFuncRefGet, result);

  snprintf(newPath, elcount(newPath), "%s.%s", oldPath, "semiMajorOrientation");
  value.semiMajorOrientation = C2xGetTokenInt(packetHandle, "DENM", newPath);
  result = CheckLastError("DENM", gkFuncRefGet, result);

  return result;
}

int SetDENMPosConfidenceEllipseParams(LONG packetHandle, struct DENMPosConfidenceEllipse value, char oldPath[])
{
  char newPath[300];
  int result;

  result = 0;

  snprintf(newPath, elcount(newPath), "%s.%s", oldPath, "semiMajorConfidence");
  C2xSetTokenInt(packetHandle, "DENM", newPath, value.semiMajorConfidence);
  result = CheckLastError("DENM", gkFuncRefGet, result);

  snprintf(newPath, elcount(newPath), "%s.%s", oldPath, "semiMinorConfidence");
  C2xSetTokenInt(packetHandle, "DENM", newPath, value.semiMinorConfidence);
  result = CheckLastError("DENM", gkFuncRefGet, result);

  snprintf(newPath, elcount(newPath), "%s.%s", oldPath, "semiMajorOrientation");
  C2xSetTokenInt(packetHandle, "DENM", newPath, value.semiMajorOrientation);
  result = CheckLastError("DENM", gkFuncRefGet, result);

  return result;
}

int GetDENMAltitudeParams(LONG packetHandle, struct DENMAltitude value, char oldPath[])
{
  char newPath[300];
  int result;

  result = 0;

  snprintf(newPath, elcount(newPath), "%s.%s", oldPath, "altitudeValue");
  value.altitudeValue = C2xGetTokenInt(packetHandle, "DENM", newPath);
  result = CheckLastError("DENM", gkFuncRefGet, result);

  snprintf(newPath, elcount(newPath), "%s.%s", oldPath, "altitudeConfidence");
  value.altitudeConfidence = C2xGetTokenInt(packetHandle, "DENM", newPath);
  result = CheckLastError("DENM", gkFuncRefGet, result);

  return result;
}

int SetDENMAltitudeParams(LONG packetHandle, struct DENMAltitude value, char oldPath[])
{
  char newPath[300];
  int result;

  result = 0;

  snprintf(newPath, elcount(newPath), "%s.%s", oldPath, "altitudeValue");
  C2xSetTokenInt(packetHandle, "DENM", newPath, value.altitudeValue);
  result = CheckLastError("DENM", gkFuncRefGet, result);

  snprintf(newPath, elcount(newPath), "%s.%s", oldPath, "altitudeConfidence");
  C2xSetTokenInt(packetHandle, "DENM", newPath, value.altitudeConfidence);
  result = CheckLastError("DENM", gkFuncRefGet, result);

  return result;
}

int GetDENMReferencePositionParams(LONG packetHandle, struct DENMReferencePosition value, char oldPath[])
{
  char newPath[300];
  int result;

  result = 0;

  snprintf(newPath, elcount(newPath), "%s.%s", oldPath, "latitude");
  value.latitude = C2xGetTokenInt(packetHandle, "DENM", newPath);
  result = CheckLastError("DENM", gkFuncRefGet, result);

  snprintf(newPath, elcount(newPath), "%s.%s", oldPath, "longitude");
  value.longitude = C2xGetTokenInt(packetHandle, "DENM", newPath);
  result = CheckLastError("DENM", gkFuncRefGet, result);

  snprintf(newPath, elcount(newPath), "%s.%s", oldPath, "positionConfidenceEllipse");
  GetDENMPosConfidenceEllipseParams(packetHandle, value.positionConfidenceEllipse, newPath);
  result = CheckLastError("DENM", gkFuncRefGet, result);

  snprintf(newPath, elcount(newPath), "%s.%s", oldPath, "altitude");
  GetDENMAltitudeParams(packetHandle, value.altitude, newPath);
  result = CheckLastError("DENM", gkFuncRefGet, result);

  return result;
}

int SetDENMReferencePositionParams(LONG packetHandle, struct DENMReferencePosition value, char oldPath[])
{
  char newPath[300];
  int result;

  result = 0;

  snprintf(newPath, elcount(newPath), "%s.%s", oldPath, "latitude");
  C2xSetTokenInt(packetHandle, "DENM", newPath, value.latitude);
  result = CheckLastError("DENM", gkFuncRefGet, result);

  snprintf(newPath, elcount(newPath), "%s.%s", oldPath, "longitude");
  C2xSetTokenInt(packetHandle, "DENM", newPath, value.longitude);
  result = CheckLastError("DENM", gkFuncRefGet, result);

  snprintf(newPath, elcount(newPath), "%s.%s", oldPath, "positionConfidenceEllipse");
  SetDENMPosConfidenceEllipseParams(packetHandle, value.positionConfidenceEllipse, newPath);
  result = CheckLastError("DENM", gkFuncRefGet, result);

  snprintf(newPath, elcount(newPath), "%s.%s", oldPath, "altitude");
  SetDENMAltitudeParams(packetHandle, value.altitude, newPath);
  result = CheckLastError("DENM", gkFuncRefGet, result);

  return result;
}

int GetDENMManagementContainerParams(LONG packetHandle, struct DENMManagementContainer value, char oldPath[])
{
  char newPath[300];
  int result;

  result = 0;

  snprintf(newPath, elcount(newPath), "%s.%s", oldPath, "actionID");
  GetDENMActionIDParams(packetHandle, value.actionID, newPath);
  result = CheckLastError("DENM", gkFuncRefGet, result);

  snprintf(newPath, elcount(newPath), "%s.%s", oldPath, "detectionTime");
  value.detectionTime = C2xGetTokenInt64(packetHandle, "DENM", newPath);
  result = CheckLastError("DENM", gkFuncRefGet, result);

  snprintf(newPath, elcount(newPath), "%s.%s", oldPath, "referenceTime");
  value.referenceTime = C2xGetTokenInt64(packetHandle, "DENM", newPath);
  result = CheckLastError("DENM", gkFuncRefGet, result);

  snprintf(newPath, elcount(newPath), "%s.%s", oldPath, "termination");
  value.termination.isValidFlag = C2xIsTokenAvailable(packetHandle, "DENM", newPath);
  if(value.termination.isValidFlag==1)
  {
    value.termination.value = C2xGetTokenInt(packetHandle, "DENM", newPath);
    result = CheckLastError("DENM", gkFuncRefGet, result);
  }
  snprintf(newPath, elcount(newPath), "%s.%s", oldPath, "eventPosition");
  GetDENMReferencePositionParams(packetHandle, value.eventPosition, newPath);
  result = CheckLastError("DENM", gkFuncRefGet, result);

  snprintf(newPath, elcount(newPath), "%s.%s", oldPath, "relevanceDistance");
  value.relevanceDistance.isValidFlag = C2xIsTokenAvailable(packetHandle, "DENM", newPath);
  if(value.relevanceDistance.isValidFlag==1)
  {
    value.relevanceDistance.value = C2xGetTokenInt(packetHandle, "DENM", newPath);
    result = CheckLastError("DENM", gkFuncRefGet, result);
  }
  snprintf(newPath, elcount(newPath), "%s.%s", oldPath, "relevanceTrafficDirection");
  value.relevanceTrafficDirection.isValidFlag = C2xIsTokenAvailable(packetHandle, "DENM", newPath);
  if(value.relevanceTrafficDirection.isValidFlag==1)
  {
    value.relevanceTrafficDirection.value = C2xGetTokenInt(packetHandle, "DENM", newPath);
    result = CheckLastError("DENM", gkFuncRefGet, result);
  }
  snprintf(newPath, elcount(newPath), "%s.%s", oldPath, "validityDuration");
  value.validityDuration.isValidFlag = C2xIsTokenAvailable(packetHandle, "DENM", newPath);
  if(value.validityDuration.isValidFlag==1)
  {
    value.validityDuration.value = C2xGetTokenInt(packetHandle, "DENM", newPath);
    result = CheckLastError("DENM", gkFuncRefGet, result);
  }
  snprintf(newPath, elcount(newPath), "%s.%s", oldPath, "transmissionInterval");
  value.transmissionInterval.isValidFlag = C2xIsTokenAvailable(packetHandle, "DENM", newPath);
  if(value.transmissionInterval.isValidFlag==1)
  {
    value.transmissionInterval.value = C2xGetTokenInt(packetHandle, "DENM", newPath);
    result = CheckLastError("DENM", gkFuncRefGet, result);
  }
  snprintf(newPath, elcount(newPath), "%s.%s", oldPath, "stationType");
  value.stationType = C2xGetTokenInt(packetHandle, "DENM", newPath);
  result = CheckLastError("DENM", gkFuncRefGet, result);

  return result;
}

int SetDENMManagementContainerParams(LONG packetHandle, struct DENMManagementContainer value, char oldPath[])
{
  char newPath[300];
  int result;

  result = 0;

  snprintf(newPath, elcount(newPath), "%s.%s", oldPath, "actionID");
  SetDENMActionIDParams(packetHandle, value.actionID, newPath);
  result = CheckLastError("DENM", gkFuncRefGet, result);

  snprintf(newPath, elcount(newPath), "%s.%s", oldPath, "detectionTime");
  C2xSetTokenInt64(packetHandle, "DENM", newPath, value.detectionTime);
  result = CheckLastError("DENM", gkFuncRefGet, result);

  snprintf(newPath, elcount(newPath), "%s.%s", oldPath, "referenceTime");
  C2xSetTokenInt64(packetHandle, "DENM", newPath, value.referenceTime);
  result = CheckLastError("DENM", gkFuncRefGet, result);

  snprintf(newPath, elcount(newPath), "%s.%s", oldPath, "termination");
  if(value.termination.isValidFlag==1)
  {
    C2xSetTokenInt(packetHandle, "DENM", newPath, value.termination.value);
    result = CheckLastError("DENM", gkFuncRefGet, result);
  }
  else
  {
    if( C2xIsTokenAvailable(packetHandle, "DENM", newPath) )
    {
      C2xRemoveToken(packetHandle, "DENM", newPath);
    }
  }

  snprintf(newPath, elcount(newPath), "%s.%s", oldPath, "eventPosition");
  SetDENMReferencePositionParams(packetHandle, value.eventPosition, newPath);
  result = CheckLastError("DENM", gkFuncRefGet, result);

  snprintf(newPath, elcount(newPath), "%s.%s", oldPath, "relevanceDistance");
  if(value.relevanceDistance.isValidFlag==1)
  {
    C2xSetTokenInt(packetHandle, "DENM", newPath, value.relevanceDistance.value);
    result = CheckLastError("DENM", gkFuncRefGet, result);
  }
  else
  {
    if( C2xIsTokenAvailable(packetHandle, "DENM", newPath) )
    {
      C2xRemoveToken(packetHandle, "DENM", newPath);
    }
  }

  snprintf(newPath, elcount(newPath), "%s.%s", oldPath, "relevanceTrafficDirection");
  if(value.relevanceTrafficDirection.isValidFlag==1)
  {
    C2xSetTokenInt(packetHandle, "DENM", newPath, value.relevanceTrafficDirection.value);
    result = CheckLastError("DENM", gkFuncRefGet, result);
  }
  else
  {
    if( C2xIsTokenAvailable(packetHandle, "DENM", newPath) )
    {
      C2xRemoveToken(packetHandle, "DENM", newPath);
    }
  }

  snprintf(newPath, elcount(newPath), "%s.%s", oldPath, "validityDuration");
  if(value.validityDuration.isValidFlag==1)
  {
    C2xSetTokenInt(packetHandle, "DENM", newPath, value.validityDuration.value);
    result = CheckLastError("DENM", gkFuncRefGet, result);
  }
  else
  {
    if( C2xIsTokenAvailable(packetHandle, "DENM", newPath) )
    {
      C2xRemoveToken(packetHandle, "DENM", newPath);
    }
  }

  snprintf(newPath, elcount(newPath), "%s.%s", oldPath, "transmissionInterval");
  if(value.transmissionInterval.isValidFlag==1)
  {
    if (value.transmissionInterval.value < 1)
    {
        C2xSetTokenInt(packetHandle, "DENM", newPath, 1);
    }
    else if (value.transmissionInterval.value > 10000)
    {
        C2xSetTokenInt(packetHandle, "DENM", newPath, 10000);
    }
    else
    {
        C2xSetTokenInt(packetHandle, "DENM", newPath, value.transmissionInterval.value);
    }
    result = CheckLastError("DENM", gkFuncRefGet, result);
  }
  else
  {
    if( C2xIsTokenAvailable(packetHandle, "DENM", newPath) )
    {
      C2xRemoveToken(packetHandle, "DENM", newPath);
    }
  }

  snprintf(newPath, elcount(newPath), "%s.%s", oldPath, "stationType");
  C2xSetTokenInt(packetHandle, "DENM", newPath, value.stationType);
  result = CheckLastError("DENM", gkFuncRefGet, result);

  return result;
}

int GetDENMCauseCodeParams(LONG packetHandle, struct DENMCauseCode value, char oldPath[])
{
  char newPath[300];
  int result;

  result = 0;

  snprintf(newPath, elcount(newPath), "%s.%s", oldPath, "causeCode");
  value.causeCode = C2xGetTokenInt(packetHandle, "DENM", newPath);
  result = CheckLastError("DENM", gkFuncRefGet, result);

  snprintf(newPath, elcount(newPath), "%s.%s", oldPath, "subCauseCode");
  value.subCauseCode = C2xGetTokenInt(packetHandle, "DENM", newPath);
  result = CheckLastError("DENM", gkFuncRefGet, result);

  return result;
}

int SetDENMCauseCodeParams(LONG packetHandle, struct DENMCauseCode value, char oldPath[])
{
  char newPath[300];
  int result;

  result = 0;

  snprintf(newPath, elcount(newPath), "%s.%s", oldPath, "causeCode");
  C2xSetTokenInt(packetHandle, "DENM", newPath, value.causeCode);
  result = CheckLastError("DENM", gkFuncRefGet, result);

  snprintf(newPath, elcount(newPath), "%s.%s", oldPath, "subCauseCode");
  C2xSetTokenInt(packetHandle, "DENM", newPath, value.subCauseCode);
  result = CheckLastError("DENM", gkFuncRefGet, result);

  return result;
}

int GetDENMDeltaReferencePositionParams(LONG packetHandle, struct DENMDeltaReferencePosition value, char oldPath[])
{
  char newPath[300];
  int result;

  result = 0;

  snprintf(newPath, elcount(newPath), "%s.%s", oldPath, "deltaLatitude");
  value.deltaLatitude = C2xGetTokenInt(packetHandle, "DENM", newPath);
  result = CheckLastError("DENM", gkFuncRefGet, result);

  snprintf(newPath, elcount(newPath), "%s.%s", oldPath, "deltaLongitude");
  value.deltaLongitude = C2xGetTokenInt(packetHandle, "DENM", newPath);
  result = CheckLastError("DENM", gkFuncRefGet, result);

  snprintf(newPath, elcount(newPath), "%s.%s", oldPath, "deltaAltitude");
  value.deltaAltitude = C2xGetTokenInt(packetHandle, "DENM", newPath);
  result = CheckLastError("DENM", gkFuncRefGet, result);

  return result;
}

int SetDENMDeltaReferencePositionParams(LONG packetHandle, struct DENMDeltaReferencePosition value, char oldPath[])
{
  char newPath[300];
  int result;

  result = 0;

  snprintf(newPath, elcount(newPath), "%s.%s", oldPath, "deltaLatitude");
  C2xSetTokenInt(packetHandle, "DENM", newPath, value.deltaLatitude);
  result = CheckLastError("DENM", gkFuncRefGet, result);

  snprintf(newPath, elcount(newPath), "%s.%s", oldPath, "deltaLongitude");
  C2xSetTokenInt(packetHandle, "DENM", newPath, value.deltaLongitude);
  result = CheckLastError("DENM", gkFuncRefGet, result);

  snprintf(newPath, elcount(newPath), "%s.%s", oldPath, "deltaAltitude");
  C2xSetTokenInt(packetHandle, "DENM", newPath, value.deltaAltitude);
  result = CheckLastError("DENM", gkFuncRefGet, result);

  return result;
}

int GetDENMEventPointParams(LONG packetHandle, struct DENMEventPoint value, char oldPath[])
{
  char newPath[300];
  int result;

  result = 0;

  snprintf(newPath, elcount(newPath), "%s.%s", oldPath, "eventPosition");
  GetDENMDeltaReferencePositionParams(packetHandle, value.eventPosition, newPath);
  result = CheckLastError("DENM", gkFuncRefGet, result);

  snprintf(newPath, elcount(newPath), "%s.%s", oldPath, "eventDeltaTime");
  value.eventDeltaTime.isValidFlag = C2xIsTokenAvailable(packetHandle, "DENM", newPath);
  if(value.eventDeltaTime.isValidFlag==1)
  {
    value.eventDeltaTime.value = C2xGetTokenInt(packetHandle, "DENM", newPath);
    result = CheckLastError("DENM", gkFuncRefGet, result);
  }
  snprintf(newPath, elcount(newPath), "%s.%s", oldPath, "informationQuality");
  value.informationQuality = C2xGetTokenInt(packetHandle, "DENM", newPath);
  result = CheckLastError("DENM", gkFuncRefGet, result);

  return result;
}

int SetDENMEventPointParams(LONG packetHandle, struct DENMEventPoint value, char oldPath[])
{
  char newPath[300];
  int result;

  result = 0;

  snprintf(newPath, elcount(newPath), "%s.%s", oldPath, "eventPosition");
  SetDENMDeltaReferencePositionParams(packetHandle, value.eventPosition, newPath);
  result = CheckLastError("DENM", gkFuncRefGet, result);

  snprintf(newPath, elcount(newPath), "%s.%s", oldPath, "eventDeltaTime");
  if(value.eventDeltaTime.isValidFlag==1)
  {
    if (value.eventDeltaTime.value < 1)
    {
        C2xSetTokenInt(packetHandle, "DENM", newPath, 1);
    }
    else if (value.eventDeltaTime.value > 65535)
    {
        C2xSetTokenInt(packetHandle, "DENM", newPath, 65535);
    }
    else
    {
        C2xSetTokenInt(packetHandle, "DENM", newPath, value.eventDeltaTime.value);
    }
    result = CheckLastError("DENM", gkFuncRefGet, result);
  }
  else
  {
    if( C2xIsTokenAvailable(packetHandle, "DENM", newPath) )
    {
      C2xRemoveToken(packetHandle, "DENM", newPath);
    }
  }

  snprintf(newPath, elcount(newPath), "%s.%s", oldPath, "informationQuality");
  C2xSetTokenInt(packetHandle, "DENM", newPath, value.informationQuality);
  result = CheckLastError("DENM", gkFuncRefGet, result);

  return result;
}

int GetDENMEventHistoryParams(LONG packetHandle, struct DENMEventHistory value, char oldPath[])
{
  char newPath[300]; 
  int i;
  int result;

  result = 0;

  value.length = C2xGetTokenInt(packetHandle, "DENM", oldPath);
  if((result = CheckLastError("DENM", gkFuncRefGet, result))==0)
  {
    for(i=0; i<value.length; i++)
    {
      snprintf(newPath, elcount(newPath), "%s[%d]", oldPath, i);
      GetDENMEventPointParams(packetHandle, value.arrayValue[i], newPath);
      result = CheckLastError("DENM", gkFuncRefGet, result);
    }
  }
  return result;
}

int SetDENMEventHistoryParams(LONG packetHandle, struct DENMEventHistory value, char oldPath[])
{
  char newPath[300]; 
  int i;
  int result;

  result = 0;

  C2xRemoveToken(packetHandle, "DENM", oldPath);
  for(i=0; i<value.length; i++)
  {
    snprintf(newPath, elcount(newPath), "%s[%d]", oldPath, i);
    SetDENMEventPointParams(packetHandle, value.arrayValue[i], newPath);
    result = CheckLastError("DENM", gkFuncRefGet, result);
  }
  return result;
}

int GetDENMSituationContainerParams(LONG packetHandle, struct DENMSituationContainer value, char oldPath[])
{
  char newPath[300];
  int result;

  result = 0;

  snprintf(newPath, elcount(newPath), "%s.%s", oldPath, "informationQuality");
  value.informationQuality = C2xGetTokenInt(packetHandle, "DENM", newPath);
  result = CheckLastError("DENM", gkFuncRefGet, result);

  snprintf(newPath, elcount(newPath), "%s.%s", oldPath, "eventType");
  GetDENMCauseCodeParams(packetHandle, value.eventType, newPath);
  result = CheckLastError("DENM", gkFuncRefGet, result);

  snprintf(newPath, elcount(newPath), "%s.%s", oldPath, "linkedCause");
  value.linkedCause.isValidFlag = C2xIsTokenAvailable(packetHandle, "DENM", newPath);
  if(value.linkedCause.isValidFlag==1)
  {
    GetDENMCauseCodeParams(packetHandle, value.linkedCause, newPath);
    result = CheckLastError("DENM", gkFuncRefGet, result);
  }
  snprintf(newPath, elcount(newPath), "%s.%s", oldPath, "eventHistory");
  value.eventHistory.isValidFlag = C2xIsTokenAvailable(packetHandle, "DENM", newPath);
  if(value.eventHistory.isValidFlag==1)
  {
    GetDENMEventHistoryParams(packetHandle, value.eventHistory, newPath);
    result = CheckLastError("DENM", gkFuncRefGet, result);
  }
  return result;
}

int SetDENMSituationContainerParams(LONG packetHandle, struct DENMSituationContainer value, char oldPath[])
{
  char newPath[300];
  int result;

  result = 0;

  snprintf(newPath, elcount(newPath), "%s.%s", oldPath, "informationQuality");
  C2xSetTokenInt(packetHandle, "DENM", newPath, value.informationQuality);
  result = CheckLastError("DENM", gkFuncRefGet, result);

  snprintf(newPath, elcount(newPath), "%s.%s", oldPath, "eventType");
  SetDENMCauseCodeParams(packetHandle, value.eventType, newPath);
  result = CheckLastError("DENM", gkFuncRefGet, result);

  snprintf(newPath, elcount(newPath), "%s.%s", oldPath, "linkedCause");
  if(value.linkedCause.isValidFlag==1)
  {
    SetDENMCauseCodeParams(packetHandle, value.linkedCause, newPath);
    result = CheckLastError("DENM", gkFuncRefGet, result);
  }
  else
  {
    if( C2xIsTokenAvailable(packetHandle, "DENM", newPath) )
    {
      C2xRemoveToken(packetHandle, "DENM", newPath);
    }
  }

  snprintf(newPath, elcount(newPath), "%s.%s", oldPath, "eventHistory");
  if(value.eventHistory.isValidFlag==1)
  {
    SetDENMEventHistoryParams(packetHandle, value.eventHistory, newPath);
    result = CheckLastError("DENM", gkFuncRefGet, result);
  }
  else
  {
    if( C2xIsTokenAvailable(packetHandle, "DENM", newPath) )
    {
      C2xRemoveToken(packetHandle, "DENM", newPath);
    }
  }

  return result;
}

int GetDENMSpeedParams(LONG packetHandle, struct DENMSpeed value, char oldPath[])
{
  char newPath[300];
  int result;

  result = 0;

  snprintf(newPath, elcount(newPath), "%s.%s", oldPath, "speedValue");
  value.speedValue = C2xGetTokenInt(packetHandle, "DENM", newPath);
  result = CheckLastError("DENM", gkFuncRefGet, result);

  snprintf(newPath, elcount(newPath), "%s.%s", oldPath, "speedConfidence");
  value.speedConfidence = C2xGetTokenInt(packetHandle, "DENM", newPath);
  result = CheckLastError("DENM", gkFuncRefGet, result);

  return result;
}

int SetDENMSpeedParams(LONG packetHandle, struct DENMSpeed value, char oldPath[])
{
  char newPath[300];
  int result;

  result = 0;

  snprintf(newPath, elcount(newPath), "%s.%s", oldPath, "speedValue");
  C2xSetTokenInt(packetHandle, "DENM", newPath, value.speedValue);
  result = CheckLastError("DENM", gkFuncRefGet, result);

  snprintf(newPath, elcount(newPath), "%s.%s", oldPath, "speedConfidence");
  if (value.speedConfidence < 1)
  {
    C2xSetTokenInt(packetHandle, "DENM", newPath, 1);
  }
  else if (value.speedConfidence > 127)
  {
    C2xSetTokenInt(packetHandle, "DENM", newPath, 127);
  }
  else
  {
    C2xSetTokenInt(packetHandle, "DENM", newPath, value.speedConfidence);
  }
  result = CheckLastError("DENM", gkFuncRefGet, result);

  return result;
}

int GetDENMHeadingParams(LONG packetHandle, struct DENMHeading value, char oldPath[])
{
  char newPath[300];
  int result;

  result = 0;

  snprintf(newPath, elcount(newPath), "%s.%s", oldPath, "headingValue");
  value.headingValue = C2xGetTokenInt(packetHandle, "DENM", newPath);
  result = CheckLastError("DENM", gkFuncRefGet, result);

  snprintf(newPath, elcount(newPath), "%s.%s", oldPath, "headingConfidence");
  value.headingConfidence = C2xGetTokenInt(packetHandle, "DENM", newPath);
  result = CheckLastError("DENM", gkFuncRefGet, result);

  return result;
}

int SetDENMHeadingParams(LONG packetHandle, struct DENMHeading value, char oldPath[])
{
  char newPath[300];
  int result;

  result = 0;

  snprintf(newPath, elcount(newPath), "%s.%s", oldPath, "headingValue");
  C2xSetTokenInt(packetHandle, "DENM", newPath, value.headingValue);
  result = CheckLastError("DENM", gkFuncRefGet, result);

  snprintf(newPath, elcount(newPath), "%s.%s", oldPath, "headingConfidence");
  if (value.headingConfidence < 1)
  {
    C2xSetTokenInt(packetHandle, "DENM", newPath, 1);
  }
  else if (value.headingConfidence > 127)
  {
    C2xSetTokenInt(packetHandle, "DENM", newPath, 127);
  }
  else
  {
    C2xSetTokenInt(packetHandle, "DENM", newPath, value.headingConfidence);
  }
  result = CheckLastError("DENM", gkFuncRefGet, result);

  return result;
}

int GetDENMPathPointParams(LONG packetHandle, struct DENMPathPoint value, char oldPath[])
{
  char newPath[300];
  int result;

  result = 0;

  snprintf(newPath, elcount(newPath), "%s.%s", oldPath, "pathPosition");
  GetDENMDeltaReferencePositionParams(packetHandle, value.pathPosition, newPath);
  result = CheckLastError("DENM", gkFuncRefGet, result);

  snprintf(newPath, elcount(newPath), "%s.%s", oldPath, "pathDeltaTime");
  value.pathDeltaTime.isValidFlag = C2xIsTokenAvailable(packetHandle, "DENM", newPath);
  if(value.pathDeltaTime.isValidFlag==1)
  {
    value.pathDeltaTime.value = C2xGetTokenInt(packetHandle, "DENM", newPath);
    result = CheckLastError("DENM", gkFuncRefGet, result);
  }
  return result;
}

int SetDENMPathPointParams(LONG packetHandle, struct DENMPathPoint value, char oldPath[])
{
  char newPath[300];
  int result;

  result = 0;

  snprintf(newPath, elcount(newPath), "%s.%s", oldPath, "pathPosition");
  SetDENMDeltaReferencePositionParams(packetHandle, value.pathPosition, newPath);
  result = CheckLastError("DENM", gkFuncRefGet, result);

  snprintf(newPath, elcount(newPath), "%s.%s", oldPath, "pathDeltaTime");
  if(value.pathDeltaTime.isValidFlag==1)
  {
    if (value.pathDeltaTime.value < 1)
    {
        C2xSetTokenInt(packetHandle, "DENM", newPath, 1);
    }
    else if (value.pathDeltaTime.value > 65535)
    {
        C2xSetTokenInt(packetHandle, "DENM", newPath, 65535);
    }
    else
    {
        C2xSetTokenInt(packetHandle, "DENM", newPath, value.pathDeltaTime.value);
    }
    result = CheckLastError("DENM", gkFuncRefGet, result);
  }
  else
  {
    if( C2xIsTokenAvailable(packetHandle, "DENM", newPath) )
    {
      C2xRemoveToken(packetHandle, "DENM", newPath);
    }
  }

  return result;
}

int GetDENMPathHistoryParams(LONG packetHandle, struct DENMPathHistory value, char oldPath[])
{
  char newPath[300]; 
  int i;
  int result;

  result = 0;

  value.length = C2xGetTokenInt(packetHandle, "DENM", oldPath);
  if((result = CheckLastError("DENM", gkFuncRefGet, result))==0)
  {
    for(i=0; i<value.length; i++)
    {
      snprintf(newPath, elcount(newPath), "%s[%d]", oldPath, i);
      GetDENMPathPointParams(packetHandle, value.arrayValue[i], newPath);
      result = CheckLastError("DENM", gkFuncRefGet, result);
    }
  }
  return result;
}

int SetDENMPathHistoryParams(LONG packetHandle, struct DENMPathHistory value, char oldPath[])
{
  char newPath[300]; 
  int i;
  int result;

  result = 0;

  C2xRemoveToken(packetHandle, "DENM", oldPath);
  for(i=0; i<value.length; i++)
  {
    snprintf(newPath, elcount(newPath), "%s[%d]", oldPath, i);
    SetDENMPathPointParams(packetHandle, value.arrayValue[i], newPath);
    result = CheckLastError("DENM", gkFuncRefGet, result);
  }
  return result;
}

int GetDENMTracesParams(LONG packetHandle, struct DENMTraces value, char oldPath[])
{
  char newPath[300]; 
  int i;
  int result;

  result = 0;

  value.length = C2xGetTokenInt(packetHandle, "DENM", oldPath);
  if((result = CheckLastError("DENM", gkFuncRefGet, result))==0)
  {
    for(i=0; i<value.length; i++)
    {
      snprintf(newPath, elcount(newPath), "%s[%d]", oldPath, i);
      GetDENMPathHistoryParams(packetHandle, value.arrayValue[i], newPath);
      result = CheckLastError("DENM", gkFuncRefGet, result);
    }
  }
  return result;
}

int SetDENMTracesParams(LONG packetHandle, struct DENMTraces value, char oldPath[])
{
  char newPath[300]; 
  int i;
  int result;

  result = 0;

  C2xRemoveToken(packetHandle, "DENM", oldPath);
  for(i=0; i<value.length; i++)
  {
    snprintf(newPath, elcount(newPath), "%s[%d]", oldPath, i);
    SetDENMPathHistoryParams(packetHandle, value.arrayValue[i], newPath);
    result = CheckLastError("DENM", gkFuncRefGet, result);
  }
  return result;
}

int GetDENMLocationContainerParams(LONG packetHandle, struct DENMLocationContainer value, char oldPath[])
{
  char newPath[300];
  int result;

  result = 0;

  snprintf(newPath, elcount(newPath), "%s.%s", oldPath, "eventSpeed");
  value.eventSpeed.isValidFlag = C2xIsTokenAvailable(packetHandle, "DENM", newPath);
  if(value.eventSpeed.isValidFlag==1)
  {
    GetDENMSpeedParams(packetHandle, value.eventSpeed, newPath);
    result = CheckLastError("DENM", gkFuncRefGet, result);
  }
  snprintf(newPath, elcount(newPath), "%s.%s", oldPath, "eventPositionHeading");
  value.eventPositionHeading.isValidFlag = C2xIsTokenAvailable(packetHandle, "DENM", newPath);
  if(value.eventPositionHeading.isValidFlag==1)
  {
    GetDENMHeadingParams(packetHandle, value.eventPositionHeading, newPath);
    result = CheckLastError("DENM", gkFuncRefGet, result);
  }
  snprintf(newPath, elcount(newPath), "%s.%s", oldPath, "traces");
  GetDENMTracesParams(packetHandle, value.traces, newPath);
  result = CheckLastError("DENM", gkFuncRefGet, result);

  snprintf(newPath, elcount(newPath), "%s.%s", oldPath, "roadType");
  value.roadType.isValidFlag = C2xIsTokenAvailable(packetHandle, "DENM", newPath);
  if(value.roadType.isValidFlag==1)
  {
    value.roadType.value = C2xGetTokenInt(packetHandle, "DENM", newPath);
    result = CheckLastError("DENM", gkFuncRefGet, result);
  }
  return result;
}

int SetDENMLocationContainerParams(LONG packetHandle, struct DENMLocationContainer value, char oldPath[])
{
  char newPath[300];
  int result;

  result = 0;

  snprintf(newPath, elcount(newPath), "%s.%s", oldPath, "eventSpeed");
  if(value.eventSpeed.isValidFlag==1)
  {
    SetDENMSpeedParams(packetHandle, value.eventSpeed, newPath);
    result = CheckLastError("DENM", gkFuncRefGet, result);
  }
  else
  {
    if( C2xIsTokenAvailable(packetHandle, "DENM", newPath) )
    {
      C2xRemoveToken(packetHandle, "DENM", newPath);
    }
  }

  snprintf(newPath, elcount(newPath), "%s.%s", oldPath, "eventPositionHeading");
  if(value.eventPositionHeading.isValidFlag==1)
  {
    SetDENMHeadingParams(packetHandle, value.eventPositionHeading, newPath);
    result = CheckLastError("DENM", gkFuncRefGet, result);
  }
  else
  {
    if( C2xIsTokenAvailable(packetHandle, "DENM", newPath) )
    {
      C2xRemoveToken(packetHandle, "DENM", newPath);
    }
  }

  snprintf(newPath, elcount(newPath), "%s.%s", oldPath, "traces");
  SetDENMTracesParams(packetHandle, value.traces, newPath);
  result = CheckLastError("DENM", gkFuncRefGet, result);

  snprintf(newPath, elcount(newPath), "%s.%s", oldPath, "roadType");
  if(value.roadType.isValidFlag==1)
  {
    C2xSetTokenInt(packetHandle, "DENM", newPath, value.roadType.value);
    result = CheckLastError("DENM", gkFuncRefGet, result);
  }
  else
  {
    if( C2xIsTokenAvailable(packetHandle, "DENM", newPath) )
    {
      C2xRemoveToken(packetHandle, "DENM", newPath);
    }
  }

  return result;
}

int GetDENMPositionOfPillarsParams(LONG packetHandle, struct DENMPositionOfPillars value, char oldPath[])
{
  char newPath[300]; 
  int i;
  int result;

  result = 0;

  value.length = C2xGetTokenInt(packetHandle, "DENM", oldPath);
  if((result = CheckLastError("DENM", gkFuncRefGet, result))==0)
  {
    for(i=0; i<value.length; i++)
    {
      snprintf(newPath, elcount(newPath), "%s[%d]", oldPath, i);
      value.arrayValue[i] = C2xGetTokenInt64(packetHandle, "DENM", newPath);
      result = CheckLastError("DENM", gkFuncRefGet, result);
    }
  }
  return result;
}

int SetDENMPositionOfPillarsParams(LONG packetHandle, struct DENMPositionOfPillars value, char oldPath[])
{
  char newPath[300]; 
  int i;
  int result;

  result = 0;

  C2xRemoveToken(packetHandle, "DENM", oldPath);
  for(i=0; i<value.length; i++)
  {
    snprintf(newPath, elcount(newPath), "%s[%d]", oldPath, i);
    C2xSetTokenInt64(packetHandle, "DENM", newPath, value.arrayValue[i]);
    result = CheckLastError("DENM", gkFuncRefGet, result);
  }
  return result;
}

int GetDENMImpactReductionContainerParams(LONG packetHandle, struct DENMImpactReductionContainer value, char oldPath[])
{
  char newPath[300]; 
  int j; 
  int k;
  int result;

  result = 0;

  snprintf(newPath, elcount(newPath), "%s.%s", oldPath, "heightLonCarrLeft");
  value.heightLonCarrLeft = C2xGetTokenInt(packetHandle, "DENM", newPath);
  result = CheckLastError("DENM", gkFuncRefGet, result);

  snprintf(newPath, elcount(newPath), "%s.%s", oldPath, "heightLonCarrRight");
  value.heightLonCarrRight = C2xGetTokenInt(packetHandle, "DENM", newPath);
  result = CheckLastError("DENM", gkFuncRefGet, result);

  snprintf(newPath, elcount(newPath), "%s.%s", oldPath, "posLonCarrLeft");
  value.posLonCarrLeft = C2xGetTokenInt(packetHandle, "DENM", newPath);
  result = CheckLastError("DENM", gkFuncRefGet, result);

  snprintf(newPath, elcount(newPath), "%s.%s", oldPath, "posLonCarrRight");
  value.posLonCarrRight = C2xGetTokenInt(packetHandle, "DENM", newPath);
  result = CheckLastError("DENM", gkFuncRefGet, result);

  snprintf(newPath, elcount(newPath), "%s.%s", oldPath, "positionOfPillars");
  GetDENMPositionOfPillarsParams(packetHandle, value.positionOfPillars, newPath);
  result = CheckLastError("DENM", gkFuncRefGet, result);

  snprintf(newPath, elcount(newPath), "%s.%s", oldPath, "posCentMass");
  value.posCentMass = C2xGetTokenInt(packetHandle, "DENM", newPath);
  result = CheckLastError("DENM", gkFuncRefGet, result);

  snprintf(newPath, elcount(newPath), "%s.%s", oldPath, "wheelBaseVehicle");
  value.wheelBaseVehicle = C2xGetTokenInt(packetHandle, "DENM", newPath);
  result = CheckLastError("DENM", gkFuncRefGet, result);

  snprintf(newPath, elcount(newPath), "%s.%s", oldPath, "turningRadius");
  value.turningRadius = C2xGetTokenInt(packetHandle, "DENM", newPath);
  result = CheckLastError("DENM", gkFuncRefGet, result);

  snprintf(newPath, elcount(newPath), "%s.%s", oldPath, "posFrontAx");
  value.posFrontAx = C2xGetTokenInt(packetHandle, "DENM", newPath);
  result = CheckLastError("DENM", gkFuncRefGet, result);

  snprintf(newPath, elcount(newPath), "%s.%s", oldPath, "positionOfOccupants");
  value.positionOfOccupants.isValidFlag = 1;
  value.positionOfOccupants.stringLength = C2xGetTokenLengthBit(packetHandle, "DENM", newPath);
  if ((result = CheckLastError("DENM", gkFuncRefGet, result))==0)
  {
    if(value.positionOfOccupants.stringLength > 0)
    {
      for(j=0; j<value.positionOfOccupants.stringLength; j++)
      {
        if(C2xGetTokenBitOfBitString(packetHandle, "DENM", newPath, j) == 0)
        {
          value.positionOfOccupants.string[j] = '0';
        }
        else if(C2xGetTokenBitOfBitString(packetHandle, "DENM", newPath, j) == 1)
        {
          value.positionOfOccupants.string[j] = '1';
        }

        if(value.positionOfOccupants.stringLength == 1)
        {
          value.positionOfOccupants.string[1] = '0';
        }
        result = CheckLastError("DENM", gkFuncRefGet, result);
      }
    }
    else
    {
      for(k = value.positionOfOccupants.stringLength+1; k > -1; k--)
      {
        if(value.positionOfOccupants.string[k] == '1')
        {
          value.positionOfOccupants.string[k] = '0';
        }
      }
    }
  }

  snprintf(newPath, elcount(newPath), "%s.%s", oldPath, "vehicleMass");
  value.vehicleMass = C2xGetTokenInt(packetHandle, "DENM", newPath);
  result = CheckLastError("DENM", gkFuncRefGet, result);

  snprintf(newPath, elcount(newPath), "%s.%s", oldPath, "requestResponseIndication");
  value.requestResponseIndication = C2xGetTokenInt(packetHandle, "DENM", newPath);
  result = CheckLastError("DENM", gkFuncRefGet, result);

  return result;
}

int SetDENMImpactReductionContainerParams(LONG packetHandle, struct DENMImpactReductionContainer value, char oldPath[])
{
  char newPath[300]; 
  int j;
  int result;

  result = 0;

  snprintf(newPath, elcount(newPath), "%s.%s", oldPath, "heightLonCarrLeft");
  if (value.heightLonCarrLeft < 1)
  {
    C2xSetTokenInt(packetHandle, "DENM", newPath, 1);
  }
  else if (value.heightLonCarrLeft > 100)
  {
    C2xSetTokenInt(packetHandle, "DENM", newPath, 100);
  }
  else
  {
    C2xSetTokenInt(packetHandle, "DENM", newPath, value.heightLonCarrLeft);
  }
  result = CheckLastError("DENM", gkFuncRefGet, result);

  snprintf(newPath, elcount(newPath), "%s.%s", oldPath, "heightLonCarrRight");
  if (value.heightLonCarrRight < 1)
  {
    C2xSetTokenInt(packetHandle, "DENM", newPath, 1);
  }
  else if (value.heightLonCarrRight > 100)
  {
    C2xSetTokenInt(packetHandle, "DENM", newPath, 100);
  }
  else
  {
    C2xSetTokenInt(packetHandle, "DENM", newPath, value.heightLonCarrRight);
  }
  result = CheckLastError("DENM", gkFuncRefGet, result);

  snprintf(newPath, elcount(newPath), "%s.%s", oldPath, "posLonCarrLeft");
  if (value.posLonCarrLeft < 1)
  {
    C2xSetTokenInt(packetHandle, "DENM", newPath, 1);
  }
  else if (value.posLonCarrLeft > 127)
  {
    C2xSetTokenInt(packetHandle, "DENM", newPath, 127);
  }
  else
  {
    C2xSetTokenInt(packetHandle, "DENM", newPath, value.posLonCarrLeft);
  }
  result = CheckLastError("DENM", gkFuncRefGet, result);

  snprintf(newPath, elcount(newPath), "%s.%s", oldPath, "posLonCarrRight");
  if (value.posLonCarrRight < 1)
  {
    C2xSetTokenInt(packetHandle, "DENM", newPath, 1);
  }
  else if (value.posLonCarrRight > 127)
  {
    C2xSetTokenInt(packetHandle, "DENM", newPath, 127);
  }
  else
  {
    C2xSetTokenInt(packetHandle, "DENM", newPath, value.posLonCarrRight);
  }
  result = CheckLastError("DENM", gkFuncRefGet, result);

  snprintf(newPath, elcount(newPath), "%s.%s", oldPath, "positionOfPillars");
  SetDENMPositionOfPillarsParams(packetHandle, value.positionOfPillars, newPath);
  result = CheckLastError("DENM", gkFuncRefGet, result);

  snprintf(newPath, elcount(newPath), "%s.%s", oldPath, "posCentMass");
  if (value.posCentMass < 1)
  {
    C2xSetTokenInt(packetHandle, "DENM", newPath, 1);
  }
  else if (value.posCentMass > 63)
  {
    C2xSetTokenInt(packetHandle, "DENM", newPath, 63);
  }
  else
  {
    C2xSetTokenInt(packetHandle, "DENM", newPath, value.posCentMass);
  }
  result = CheckLastError("DENM", gkFuncRefGet, result);

  snprintf(newPath, elcount(newPath), "%s.%s", oldPath, "wheelBaseVehicle");
  if (value.wheelBaseVehicle < 1)
  {
    C2xSetTokenInt(packetHandle, "DENM", newPath, 1);
  }
  else if (value.wheelBaseVehicle > 127)
  {
    C2xSetTokenInt(packetHandle, "DENM", newPath, 127);
  }
  else
  {
    C2xSetTokenInt(packetHandle, "DENM", newPath, value.wheelBaseVehicle);
  }
  result = CheckLastError("DENM", gkFuncRefGet, result);

  snprintf(newPath, elcount(newPath), "%s.%s", oldPath, "turningRadius");
  if (value.turningRadius < 1)
  {
    C2xSetTokenInt(packetHandle, "DENM", newPath, 1);
  }
  else if (value.turningRadius > 255)
  {
    C2xSetTokenInt(packetHandle, "DENM", newPath, 255);
  }
  else
  {
    C2xSetTokenInt(packetHandle, "DENM", newPath, value.turningRadius);
  }
  result = CheckLastError("DENM", gkFuncRefGet, result);

  snprintf(newPath, elcount(newPath), "%s.%s", oldPath, "posFrontAx");
  if (value.posFrontAx < 1)
  {
    C2xSetTokenInt(packetHandle, "DENM", newPath, 1);
  }
  else if (value.posFrontAx > 20)
  {
    C2xSetTokenInt(packetHandle, "DENM", newPath, 20);
  }
  else
  {
    C2xSetTokenInt(packetHandle, "DENM", newPath, value.posFrontAx);
  }
  result = CheckLastError("DENM", gkFuncRefGet, result);

  snprintf(newPath, elcount(newPath), "%s.%s", oldPath, "positionOfOccupants");
    for(j=0; j<value.positionOfOccupants.stringLength; j++)
    {
      if(value.positionOfOccupants.string[j] == '0')
      {
        C2xSetTokenBitOfBitString(packetHandle, "DENM", newPath, j, 0);
      }
      else
      {
        C2xSetTokenBitOfBitString(packetHandle, "DENM", newPath, j, 1);
      }
      result = CheckLastError("DENM", gkFuncRefGet, result);
    }

  snprintf(newPath, elcount(newPath), "%s.%s", oldPath, "vehicleMass");
  if (value.vehicleMass < 1)
  {
    C2xSetTokenInt(packetHandle, "DENM", newPath, 1);
  }
  else if (value.vehicleMass > 1024)
  {
    C2xSetTokenInt(packetHandle, "DENM", newPath, 1024);
  }
  else
  {
    C2xSetTokenInt(packetHandle, "DENM", newPath, value.vehicleMass);
  }
  result = CheckLastError("DENM", gkFuncRefGet, result);

  snprintf(newPath, elcount(newPath), "%s.%s", oldPath, "requestResponseIndication");
  C2xSetTokenInt(packetHandle, "DENM", newPath, value.requestResponseIndication);
  result = CheckLastError("DENM", gkFuncRefGet, result);

  return result;
}

int GetDENMClosedLanesParams(LONG packetHandle, struct DENMClosedLanes value, char oldPath[])
{
  char newPath[300]; 
  int j; 
  int k;
  int result;

  result = 0;

  snprintf(newPath, elcount(newPath), "%s.%s", oldPath, "innerhardShoulderStatus");
  value.innerhardShoulderStatus.isValidFlag = C2xIsTokenAvailable(packetHandle, "DENM", newPath);
  if(value.innerhardShoulderStatus.isValidFlag==1)
  {
    value.innerhardShoulderStatus.value = C2xGetTokenInt(packetHandle, "DENM", newPath);
    result = CheckLastError("DENM", gkFuncRefGet, result);
  }
  snprintf(newPath, elcount(newPath), "%s.%s", oldPath, "outerhardShoulderStatus");
  value.outerhardShoulderStatus.isValidFlag = C2xIsTokenAvailable(packetHandle, "DENM", newPath);
  if(value.outerhardShoulderStatus.isValidFlag==1)
  {
    value.outerhardShoulderStatus.value = C2xGetTokenInt(packetHandle, "DENM", newPath);
    result = CheckLastError("DENM", gkFuncRefGet, result);
  }
  snprintf(newPath, elcount(newPath), "%s.%s", oldPath, "drivingLaneStatus");
  value.drivingLaneStatus.isValidFlag = C2xIsTokenAvailable(packetHandle, "DENM", newPath);
  if(value.drivingLaneStatus.isValidFlag==1)
  {
    value.drivingLaneStatus.isValidFlag = 1;
    value.drivingLaneStatus.stringLength = C2xGetTokenLengthBit(packetHandle, "DENM", newPath);
    if ((result = CheckLastError("DENM", gkFuncRefGet, result))==0)
    {
      if(value.drivingLaneStatus.stringLength > 0)
      {
        for(j=0; j<value.drivingLaneStatus.stringLength; j++)
        {
          if(C2xGetTokenBitOfBitString(packetHandle, "DENM", newPath, j) == 0)
          {
            value.drivingLaneStatus.string[j] = '0';
          }
          else if(C2xGetTokenBitOfBitString(packetHandle, "DENM", newPath, j) == 1)
          {
            value.drivingLaneStatus.string[j] = '1';
          }

          if(value.drivingLaneStatus.stringLength == 1)
          {
            value.drivingLaneStatus.string[1] = '0';
          }
          result = CheckLastError("DENM", gkFuncRefGet, result);
        }
      }
      else
      {
        for(k = value.drivingLaneStatus.stringLength+1; k > -1; k--)
        {
          if(value.drivingLaneStatus.string[k] == '1')
          {
            value.drivingLaneStatus.string[k] = '0';
          }
        }
      }
    }

  }
  return result;
}

int SetDENMClosedLanesParams(LONG packetHandle, struct DENMClosedLanes value, char oldPath[])
{
  char newPath[300]; 
  int j;
  int result;

  result = 0;

  snprintf(newPath, elcount(newPath), "%s.%s", oldPath, "innerhardShoulderStatus");
  if(value.innerhardShoulderStatus.isValidFlag==1)
  {
    C2xSetTokenInt(packetHandle, "DENM", newPath, value.innerhardShoulderStatus.value);
    result = CheckLastError("DENM", gkFuncRefGet, result);
  }
  else
  {
    if( C2xIsTokenAvailable(packetHandle, "DENM", newPath) )
    {
      C2xRemoveToken(packetHandle, "DENM", newPath);
    }
  }

  snprintf(newPath, elcount(newPath), "%s.%s", oldPath, "outerhardShoulderStatus");
  if(value.outerhardShoulderStatus.isValidFlag==1)
  {
    C2xSetTokenInt(packetHandle, "DENM", newPath, value.outerhardShoulderStatus.value);
    result = CheckLastError("DENM", gkFuncRefGet, result);
  }
  else
  {
    if( C2xIsTokenAvailable(packetHandle, "DENM", newPath) )
    {
      C2xRemoveToken(packetHandle, "DENM", newPath);
    }
  }

  snprintf(newPath, elcount(newPath), "%s.%s", oldPath, "drivingLaneStatus");
  if(value.drivingLaneStatus.isValidFlag==1)
  {
      for(j=0; j<value.drivingLaneStatus.stringLength; j++)
      {
        if(value.drivingLaneStatus.string[j] == '0')
        {
          C2xSetTokenBitOfBitString(packetHandle, "DENM", newPath, j, 0);
        }
        else
        {
          C2xSetTokenBitOfBitString(packetHandle, "DENM", newPath, j, 1);
        }
        result = CheckLastError("DENM", gkFuncRefGet, result);
      }
  }
  else
  {
    if( C2xIsTokenAvailable(packetHandle, "DENM", newPath) )
    {
      C2xRemoveToken(packetHandle, "DENM", newPath);
    }
  }

  return result;
}

int GetDENMRestrictedTypesParams(LONG packetHandle, struct DENMRestrictedTypes value, char oldPath[])
{
  char newPath[300]; 
  int i;
  int result;

  result = 0;

  value.length = C2xGetTokenInt(packetHandle, "DENM", oldPath);
  if((result = CheckLastError("DENM", gkFuncRefGet, result))==0)
  {
    for(i=0; i<value.length; i++)
    {
      snprintf(newPath, elcount(newPath), "%s[%d]", oldPath, i);
      value.arrayValue[i] = C2xGetTokenInt64(packetHandle, "DENM", newPath);
      result = CheckLastError("DENM", gkFuncRefGet, result);
    }
  }
  return result;
}

int SetDENMRestrictedTypesParams(LONG packetHandle, struct DENMRestrictedTypes value, char oldPath[])
{
  char newPath[300]; 
  int i;
  int result;

  result = 0;

  C2xRemoveToken(packetHandle, "DENM", oldPath);
  for(i=0; i<value.length; i++)
  {
    snprintf(newPath, elcount(newPath), "%s[%d]", oldPath, i);
    C2xSetTokenInt64(packetHandle, "DENM", newPath, value.arrayValue[i]);
    result = CheckLastError("DENM", gkFuncRefGet, result);
  }
  return result;
}

int GetDENMItineraryPathParams(LONG packetHandle, struct DENMItineraryPath value, char oldPath[])
{
  char newPath[300]; 
  int i;
  int result;

  result = 0;

  value.length = C2xGetTokenInt(packetHandle, "DENM", oldPath);
  if((result = CheckLastError("DENM", gkFuncRefGet, result))==0)
  {
    for(i=0; i<value.length; i++)
    {
      snprintf(newPath, elcount(newPath), "%s[%d]", oldPath, i);
      GetDENMReferencePositionParams(packetHandle, value.arrayValue[i], newPath);
      result = CheckLastError("DENM", gkFuncRefGet, result);
    }
  }
  return result;
}

int SetDENMItineraryPathParams(LONG packetHandle, struct DENMItineraryPath value, char oldPath[])
{
  char newPath[300]; 
  int i;
  int result;

  result = 0;

  C2xRemoveToken(packetHandle, "DENM", oldPath);
  for(i=0; i<value.length; i++)
  {
    snprintf(newPath, elcount(newPath), "%s[%d]", oldPath, i);
    SetDENMReferencePositionParams(packetHandle, value.arrayValue[i], newPath);
    result = CheckLastError("DENM", gkFuncRefGet, result);
  }
  return result;
}

int GetDENMReferenceDenmsParams(LONG packetHandle, struct DENMReferenceDenms value, char oldPath[])
{
  char newPath[300]; 
  int i;
  int result;

  result = 0;

  value.length = C2xGetTokenInt(packetHandle, "DENM", oldPath);
  if((result = CheckLastError("DENM", gkFuncRefGet, result))==0)
  {
    for(i=0; i<value.length; i++)
    {
      snprintf(newPath, elcount(newPath), "%s[%d]", oldPath, i);
      GetDENMActionIDParams(packetHandle, value.arrayValue[i], newPath);
      result = CheckLastError("DENM", gkFuncRefGet, result);
    }
  }
  return result;
}

int SetDENMReferenceDenmsParams(LONG packetHandle, struct DENMReferenceDenms value, char oldPath[])
{
  char newPath[300]; 
  int i;
  int result;

  result = 0;

  C2xRemoveToken(packetHandle, "DENM", oldPath);
  for(i=0; i<value.length; i++)
  {
    snprintf(newPath, elcount(newPath), "%s[%d]", oldPath, i);
    SetDENMActionIDParams(packetHandle, value.arrayValue[i], newPath);
    result = CheckLastError("DENM", gkFuncRefGet, result);
  }
  return result;
}

int GetDENMRoadWorksContainerExtendedParams(LONG packetHandle, struct DENMRoadWorksContainerExtended value, char oldPath[])
{
  char newPath[300]; 
  int j; 
  int k;
  int result;

  result = 0;

  snprintf(newPath, elcount(newPath), "%s.%s", oldPath, "lightBarSirenInUse");
  value.lightBarSirenInUse.isValidFlag = C2xIsTokenAvailable(packetHandle, "DENM", newPath);
  if(value.lightBarSirenInUse.isValidFlag==1)
  {
    value.lightBarSirenInUse.isValidFlag = 1;
    value.lightBarSirenInUse.stringLength = C2xGetTokenLengthBit(packetHandle, "DENM", newPath);
    if ((result = CheckLastError("DENM", gkFuncRefGet, result))==0)
    {
      if(value.lightBarSirenInUse.stringLength > 0)
      {
        for(j=0; j<value.lightBarSirenInUse.stringLength; j++)
        {
          if(C2xGetTokenBitOfBitString(packetHandle, "DENM", newPath, j) == 0)
          {
            value.lightBarSirenInUse.string[j] = '0';
          }
          else if(C2xGetTokenBitOfBitString(packetHandle, "DENM", newPath, j) == 1)
          {
            value.lightBarSirenInUse.string[j] = '1';
          }

          if(value.lightBarSirenInUse.stringLength == 1)
          {
            value.lightBarSirenInUse.string[1] = '0';
          }
          result = CheckLastError("DENM", gkFuncRefGet, result);
        }
      }
      else
      {
        for(k = value.lightBarSirenInUse.stringLength+1; k > -1; k--)
        {
          if(value.lightBarSirenInUse.string[k] == '1')
          {
            value.lightBarSirenInUse.string[k] = '0';
          }
        }
      }
    }

  }
  snprintf(newPath, elcount(newPath), "%s.%s", oldPath, "closedLanes");
  value.closedLanes.isValidFlag = C2xIsTokenAvailable(packetHandle, "DENM", newPath);
  if(value.closedLanes.isValidFlag==1)
  {
    GetDENMClosedLanesParams(packetHandle, value.closedLanes, newPath);
    result = CheckLastError("DENM", gkFuncRefGet, result);
  }
  snprintf(newPath, elcount(newPath), "%s.%s", oldPath, "restriction");
  value.restriction.isValidFlag = C2xIsTokenAvailable(packetHandle, "DENM", newPath);
  if(value.restriction.isValidFlag==1)
  {
    GetDENMRestrictedTypesParams(packetHandle, value.restriction, newPath);
    result = CheckLastError("DENM", gkFuncRefGet, result);
  }
  snprintf(newPath, elcount(newPath), "%s.%s", oldPath, "speedLimit");
  value.speedLimit.isValidFlag = C2xIsTokenAvailable(packetHandle, "DENM", newPath);
  if(value.speedLimit.isValidFlag==1)
  {
    value.speedLimit.value = C2xGetTokenInt(packetHandle, "DENM", newPath);
    result = CheckLastError("DENM", gkFuncRefGet, result);
  }
  snprintf(newPath, elcount(newPath), "%s.%s", oldPath, "incidentIndication");
  value.incidentIndication.isValidFlag = C2xIsTokenAvailable(packetHandle, "DENM", newPath);
  if(value.incidentIndication.isValidFlag==1)
  {
    GetDENMCauseCodeParams(packetHandle, value.incidentIndication, newPath);
    result = CheckLastError("DENM", gkFuncRefGet, result);
  }
  snprintf(newPath, elcount(newPath), "%s.%s", oldPath, "recommendedPath");
  value.recommendedPath.isValidFlag = C2xIsTokenAvailable(packetHandle, "DENM", newPath);
  if(value.recommendedPath.isValidFlag==1)
  {
    GetDENMItineraryPathParams(packetHandle, value.recommendedPath, newPath);
    result = CheckLastError("DENM", gkFuncRefGet, result);
  }
  snprintf(newPath, elcount(newPath), "%s.%s", oldPath, "startingPointSpeedLimit");
  value.startingPointSpeedLimit.isValidFlag = C2xIsTokenAvailable(packetHandle, "DENM", newPath);
  if(value.startingPointSpeedLimit.isValidFlag==1)
  {
    GetDENMDeltaReferencePositionParams(packetHandle, value.startingPointSpeedLimit, newPath);
    result = CheckLastError("DENM", gkFuncRefGet, result);
  }
  snprintf(newPath, elcount(newPath), "%s.%s", oldPath, "trafficFlowRule");
  value.trafficFlowRule.isValidFlag = C2xIsTokenAvailable(packetHandle, "DENM", newPath);
  if(value.trafficFlowRule.isValidFlag==1)
  {
    value.trafficFlowRule.value = C2xGetTokenInt(packetHandle, "DENM", newPath);
    result = CheckLastError("DENM", gkFuncRefGet, result);
  }
  snprintf(newPath, elcount(newPath), "%s.%s", oldPath, "referenceDenms");
  value.referenceDenms.isValidFlag = C2xIsTokenAvailable(packetHandle, "DENM", newPath);
  if(value.referenceDenms.isValidFlag==1)
  {
    GetDENMReferenceDenmsParams(packetHandle, value.referenceDenms, newPath);
    result = CheckLastError("DENM", gkFuncRefGet, result);
  }
  return result;
}

int SetDENMRoadWorksContainerExtendedParams(LONG packetHandle, struct DENMRoadWorksContainerExtended value, char oldPath[])
{
  char newPath[300]; 
  int j;
  int result;

  result = 0;

  snprintf(newPath, elcount(newPath), "%s.%s", oldPath, "lightBarSirenInUse");
  if(value.lightBarSirenInUse.isValidFlag==1)
  {
      for(j=0; j<value.lightBarSirenInUse.stringLength; j++)
      {
        if(value.lightBarSirenInUse.string[j] == '0')
        {
          C2xSetTokenBitOfBitString(packetHandle, "DENM", newPath, j, 0);
        }
        else
        {
          C2xSetTokenBitOfBitString(packetHandle, "DENM", newPath, j, 1);
        }
        result = CheckLastError("DENM", gkFuncRefGet, result);
      }
  }
  else
  {
    if( C2xIsTokenAvailable(packetHandle, "DENM", newPath) )
    {
      C2xRemoveToken(packetHandle, "DENM", newPath);
    }
  }

  snprintf(newPath, elcount(newPath), "%s.%s", oldPath, "closedLanes");
  if(value.closedLanes.isValidFlag==1)
  {
    SetDENMClosedLanesParams(packetHandle, value.closedLanes, newPath);
    result = CheckLastError("DENM", gkFuncRefGet, result);
  }
  else
  {
    if( C2xIsTokenAvailable(packetHandle, "DENM", newPath) )
    {
      C2xRemoveToken(packetHandle, "DENM", newPath);
    }
  }

  snprintf(newPath, elcount(newPath), "%s.%s", oldPath, "restriction");
  if(value.restriction.isValidFlag==1)
  {
    SetDENMRestrictedTypesParams(packetHandle, value.restriction, newPath);
    result = CheckLastError("DENM", gkFuncRefGet, result);
  }
  else
  {
    if( C2xIsTokenAvailable(packetHandle, "DENM", newPath) )
    {
      C2xRemoveToken(packetHandle, "DENM", newPath);
    }
  }

  snprintf(newPath, elcount(newPath), "%s.%s", oldPath, "speedLimit");
  if(value.speedLimit.isValidFlag==1)
  {
    if (value.speedLimit.value < 1)
    {
        C2xSetTokenInt(packetHandle, "DENM", newPath, 1);
    }
    else if (value.speedLimit.value > 255)
    {
        C2xSetTokenInt(packetHandle, "DENM", newPath, 255);
    }
    else
    {
        C2xSetTokenInt(packetHandle, "DENM", newPath, value.speedLimit.value);
    }
    result = CheckLastError("DENM", gkFuncRefGet, result);
  }
  else
  {
    if( C2xIsTokenAvailable(packetHandle, "DENM", newPath) )
    {
      C2xRemoveToken(packetHandle, "DENM", newPath);
    }
  }

  snprintf(newPath, elcount(newPath), "%s.%s", oldPath, "incidentIndication");
  if(value.incidentIndication.isValidFlag==1)
  {
    SetDENMCauseCodeParams(packetHandle, value.incidentIndication, newPath);
    result = CheckLastError("DENM", gkFuncRefGet, result);
  }
  else
  {
    if( C2xIsTokenAvailable(packetHandle, "DENM", newPath) )
    {
      C2xRemoveToken(packetHandle, "DENM", newPath);
    }
  }

  snprintf(newPath, elcount(newPath), "%s.%s", oldPath, "recommendedPath");
  if(value.recommendedPath.isValidFlag==1)
  {
    SetDENMItineraryPathParams(packetHandle, value.recommendedPath, newPath);
    result = CheckLastError("DENM", gkFuncRefGet, result);
  }
  else
  {
    if( C2xIsTokenAvailable(packetHandle, "DENM", newPath) )
    {
      C2xRemoveToken(packetHandle, "DENM", newPath);
    }
  }

  snprintf(newPath, elcount(newPath), "%s.%s", oldPath, "startingPointSpeedLimit");
  if(value.startingPointSpeedLimit.isValidFlag==1)
  {
    SetDENMDeltaReferencePositionParams(packetHandle, value.startingPointSpeedLimit, newPath);
    result = CheckLastError("DENM", gkFuncRefGet, result);
  }
  else
  {
    if( C2xIsTokenAvailable(packetHandle, "DENM", newPath) )
    {
      C2xRemoveToken(packetHandle, "DENM", newPath);
    }
  }

  snprintf(newPath, elcount(newPath), "%s.%s", oldPath, "trafficFlowRule");
  if(value.trafficFlowRule.isValidFlag==1)
  {
    C2xSetTokenInt(packetHandle, "DENM", newPath, value.trafficFlowRule.value);
    result = CheckLastError("DENM", gkFuncRefGet, result);
  }
  else
  {
    if( C2xIsTokenAvailable(packetHandle, "DENM", newPath) )
    {
      C2xRemoveToken(packetHandle, "DENM", newPath);
    }
  }

  snprintf(newPath, elcount(newPath), "%s.%s", oldPath, "referenceDenms");
  if(value.referenceDenms.isValidFlag==1)
  {
    SetDENMReferenceDenmsParams(packetHandle, value.referenceDenms, newPath);
    result = CheckLastError("DENM", gkFuncRefGet, result);
  }
  else
  {
    if( C2xIsTokenAvailable(packetHandle, "DENM", newPath) )
    {
      C2xRemoveToken(packetHandle, "DENM", newPath);
    }
  }

  return result;
}

int GetDENMDangerousGoodsExtendedParams(LONG packetHandle, struct DENMDangerousGoodsExtended value, char oldPath[])
{
  char newPath[300];
  int result;

  result = 0;

  snprintf(newPath, elcount(newPath), "%s.%s", oldPath, "dangerousGoodsType");
  value.dangerousGoodsType = C2xGetTokenInt(packetHandle, "DENM", newPath);
  result = CheckLastError("DENM", gkFuncRefGet, result);

  snprintf(newPath, elcount(newPath), "%s.%s", oldPath, "unNumber");
  value.unNumber = C2xGetTokenInt(packetHandle, "DENM", newPath);
  result = CheckLastError("DENM", gkFuncRefGet, result);

  snprintf(newPath, elcount(newPath), "%s.%s", oldPath, "elevatedTemperature");
  value.elevatedTemperature = C2xGetTokenInt64(packetHandle, "DENM", newPath);
  result = CheckLastError("DENM", gkFuncRefGet, result);

  snprintf(newPath, elcount(newPath), "%s.%s", oldPath, "tunnelsRestricted");
  value.tunnelsRestricted = C2xGetTokenInt64(packetHandle, "DENM", newPath);
  result = CheckLastError("DENM", gkFuncRefGet, result);

  snprintf(newPath, elcount(newPath), "%s.%s", oldPath, "limitedQuantity");
  value.limitedQuantity = C2xGetTokenInt64(packetHandle, "DENM", newPath);
  result = CheckLastError("DENM", gkFuncRefGet, result);

  snprintf(newPath, elcount(newPath), "%s.%s", oldPath, "emergencyActionCode");
  value.emergencyActionCode.isValidFlag = C2xIsTokenAvailable(packetHandle, "DENM", newPath);
  if(value.emergencyActionCode.isValidFlag==1)
  {
    value.emergencyActionCode.stringLength = C2xGetTokenData(packetHandle, "DENM", newPath, elcount(value.emergencyActionCode.string), value.emergencyActionCode.string);
    result = CheckLastError("DENM", gkFuncRefGet, result);
  }
  snprintf(newPath, elcount(newPath), "%s.%s", oldPath, "phoneNumber");
  value.phoneNumber.isValidFlag = C2xIsTokenAvailable(packetHandle, "DENM", newPath);
  if(value.phoneNumber.isValidFlag==1)
  {
    value.phoneNumber.stringLength = C2xGetTokenData(packetHandle, "DENM", newPath, elcount(value.phoneNumber.string), value.phoneNumber.string);
    result = CheckLastError("DENM", gkFuncRefGet, result);
  }
  snprintf(newPath, elcount(newPath), "%s.%s", oldPath, "companyName");
  value.companyName.isValidFlag = C2xIsTokenAvailable(packetHandle, "DENM", newPath);
  if(value.companyName.isValidFlag==1)
  {
    value.companyName.stringLength = C2xGetTokenData(packetHandle, "DENM", newPath, elcount(value.companyName.string), value.companyName.string);
    result = CheckLastError("DENM", gkFuncRefGet, result);
  }
  return result;
}

int SetDENMDangerousGoodsExtendedParams(LONG packetHandle, struct DENMDangerousGoodsExtended value, char oldPath[])
{
  char newPath[300];
  int result;

  result = 0;

  snprintf(newPath, elcount(newPath), "%s.%s", oldPath, "dangerousGoodsType");
  C2xSetTokenInt(packetHandle, "DENM", newPath, value.dangerousGoodsType);
  result = CheckLastError("DENM", gkFuncRefGet, result);

  snprintf(newPath, elcount(newPath), "%s.%s", oldPath, "unNumber");
  C2xSetTokenInt(packetHandle, "DENM", newPath, value.unNumber);
  result = CheckLastError("DENM", gkFuncRefGet, result);

  snprintf(newPath, elcount(newPath), "%s.%s", oldPath, "elevatedTemperature");
  C2xSetTokenInt64(packetHandle, "DENM", newPath, value.elevatedTemperature);
  result = CheckLastError("DENM", gkFuncRefGet, result);

  snprintf(newPath, elcount(newPath), "%s.%s", oldPath, "tunnelsRestricted");
  C2xSetTokenInt64(packetHandle, "DENM", newPath, value.tunnelsRestricted);
  result = CheckLastError("DENM", gkFuncRefGet, result);

  snprintf(newPath, elcount(newPath), "%s.%s", oldPath, "limitedQuantity");
  C2xSetTokenInt64(packetHandle, "DENM", newPath, value.limitedQuantity);
  result = CheckLastError("DENM", gkFuncRefGet, result);

  snprintf(newPath, elcount(newPath), "%s.%s", oldPath, "emergencyActionCode");
  if(value.emergencyActionCode.isValidFlag==1)
  {
    C2xSetTokenData(packetHandle, "DENM", newPath, value.emergencyActionCode.stringLength, value.emergencyActionCode.string);
    result = CheckLastError("DENM", gkFuncRefGet, result);
  }
  else
  {
    if( C2xIsTokenAvailable(packetHandle, "DENM", newPath) )
    {
      C2xRemoveToken(packetHandle, "DENM", newPath);
    }
  }

  snprintf(newPath, elcount(newPath), "%s.%s", oldPath, "phoneNumber");
  if(value.phoneNumber.isValidFlag==1)
  {
    C2xSetTokenData(packetHandle, "DENM", newPath, value.phoneNumber.stringLength, value.phoneNumber.string);
    result = CheckLastError("DENM", gkFuncRefGet, result);
  }
  else
  {
    if( C2xIsTokenAvailable(packetHandle, "DENM", newPath) )
    {
      C2xRemoveToken(packetHandle, "DENM", newPath);
    }
  }

  snprintf(newPath, elcount(newPath), "%s.%s", oldPath, "companyName");
  if(value.companyName.isValidFlag==1)
  {
    C2xSetTokenData(packetHandle, "DENM", newPath, value.companyName.stringLength, value.companyName.string);
    result = CheckLastError("DENM", gkFuncRefGet, result);
  }
  else
  {
    if( C2xIsTokenAvailable(packetHandle, "DENM", newPath) )
    {
      C2xRemoveToken(packetHandle, "DENM", newPath);
    }
  }

  return result;
}

int GetDENMVehicleIdentificationParams(LONG packetHandle, struct DENMVehicleIdentification value, char oldPath[])
{
  char newPath[300];
  int result;

  result = 0;

  snprintf(newPath, elcount(newPath), "%s.%s", oldPath, "wMInumber");
  value.wMInumber.isValidFlag = C2xIsTokenAvailable(packetHandle, "DENM", newPath);
  if(value.wMInumber.isValidFlag==1)
  {
    value.wMInumber.stringLength = C2xGetTokenData(packetHandle, "DENM", newPath, elcount(value.wMInumber.string), value.wMInumber.string);
    result = CheckLastError("DENM", gkFuncRefGet, result);
  }
  snprintf(newPath, elcount(newPath), "%s.%s", oldPath, "vDS");
  value.vDS.isValidFlag = C2xIsTokenAvailable(packetHandle, "DENM", newPath);
  if(value.vDS.isValidFlag==1)
  {
    value.vDS.stringLength = C2xGetTokenData(packetHandle, "DENM", newPath, elcount(value.vDS.string), value.vDS.string);
    result = CheckLastError("DENM", gkFuncRefGet, result);
  }
  return result;
}

int SetDENMVehicleIdentificationParams(LONG packetHandle, struct DENMVehicleIdentification value, char oldPath[])
{
  char newPath[300];
  int result;

  result = 0;

  snprintf(newPath, elcount(newPath), "%s.%s", oldPath, "wMInumber");
  if(value.wMInumber.isValidFlag==1)
  {
    C2xSetTokenData(packetHandle, "DENM", newPath, value.wMInumber.stringLength, value.wMInumber.string);
    result = CheckLastError("DENM", gkFuncRefGet, result);
  }
  else
  {
    if( C2xIsTokenAvailable(packetHandle, "DENM", newPath) )
    {
      C2xRemoveToken(packetHandle, "DENM", newPath);
    }
  }

  snprintf(newPath, elcount(newPath), "%s.%s", oldPath, "vDS");
  if(value.vDS.isValidFlag==1)
  {
    C2xSetTokenData(packetHandle, "DENM", newPath, value.vDS.stringLength, value.vDS.string);
    result = CheckLastError("DENM", gkFuncRefGet, result);
  }
  else
  {
    if( C2xIsTokenAvailable(packetHandle, "DENM", newPath) )
    {
      C2xRemoveToken(packetHandle, "DENM", newPath);
    }
  }

  return result;
}

int GetDENMStationaryVehicleContainerParams(LONG packetHandle, struct DENMStationaryVehicleContainer value, char oldPath[])
{
  char newPath[300]; 
  int j; 
  int k;
  int result;

  result = 0;

  snprintf(newPath, elcount(newPath), "%s.%s", oldPath, "stationarySince");
  value.stationarySince.isValidFlag = C2xIsTokenAvailable(packetHandle, "DENM", newPath);
  if(value.stationarySince.isValidFlag==1)
  {
    value.stationarySince.value = C2xGetTokenInt(packetHandle, "DENM", newPath);
    result = CheckLastError("DENM", gkFuncRefGet, result);
  }
  snprintf(newPath, elcount(newPath), "%s.%s", oldPath, "stationaryCause");
  value.stationaryCause.isValidFlag = C2xIsTokenAvailable(packetHandle, "DENM", newPath);
  if(value.stationaryCause.isValidFlag==1)
  {
    GetDENMCauseCodeParams(packetHandle, value.stationaryCause, newPath);
    result = CheckLastError("DENM", gkFuncRefGet, result);
  }
  snprintf(newPath, elcount(newPath), "%s.%s", oldPath, "carryingDangerousGoods");
  value.carryingDangerousGoods.isValidFlag = C2xIsTokenAvailable(packetHandle, "DENM", newPath);
  if(value.carryingDangerousGoods.isValidFlag==1)
  {
    GetDENMDangerousGoodsExtendedParams(packetHandle, value.carryingDangerousGoods, newPath);
    result = CheckLastError("DENM", gkFuncRefGet, result);
  }
  snprintf(newPath, elcount(newPath), "%s.%s", oldPath, "numberOfOccupants");
  value.numberOfOccupants.isValidFlag = C2xIsTokenAvailable(packetHandle, "DENM", newPath);
  if(value.numberOfOccupants.isValidFlag==1)
  {
    value.numberOfOccupants.value = C2xGetTokenInt(packetHandle, "DENM", newPath);
    result = CheckLastError("DENM", gkFuncRefGet, result);
  }
  snprintf(newPath, elcount(newPath), "%s.%s", oldPath, "vehicleIdentification");
  value.vehicleIdentification.isValidFlag = C2xIsTokenAvailable(packetHandle, "DENM", newPath);
  if(value.vehicleIdentification.isValidFlag==1)
  {
    GetDENMVehicleIdentificationParams(packetHandle, value.vehicleIdentification, newPath);
    result = CheckLastError("DENM", gkFuncRefGet, result);
  }
  snprintf(newPath, elcount(newPath), "%s.%s", oldPath, "energyStorageType");
  value.energyStorageType.isValidFlag = C2xIsTokenAvailable(packetHandle, "DENM", newPath);
  if(value.energyStorageType.isValidFlag==1)
  {
    value.energyStorageType.isValidFlag = 1;
    value.energyStorageType.stringLength = C2xGetTokenLengthBit(packetHandle, "DENM", newPath);
    if ((result = CheckLastError("DENM", gkFuncRefGet, result))==0)
    {
      if(value.energyStorageType.stringLength > 0)
      {
        for(j=0; j<value.energyStorageType.stringLength; j++)
        {
          if(C2xGetTokenBitOfBitString(packetHandle, "DENM", newPath, j) == 0)
          {
            value.energyStorageType.string[j] = '0';
          }
          else if(C2xGetTokenBitOfBitString(packetHandle, "DENM", newPath, j) == 1)
          {
            value.energyStorageType.string[j] = '1';
          }

          if(value.energyStorageType.stringLength == 1)
          {
            value.energyStorageType.string[1] = '0';
          }
          result = CheckLastError("DENM", gkFuncRefGet, result);
        }
      }
      else
      {
        for(k = value.energyStorageType.stringLength+1; k > -1; k--)
        {
          if(value.energyStorageType.string[k] == '1')
          {
            value.energyStorageType.string[k] = '0';
          }
        }
      }
    }

  }
  return result;
}

int SetDENMStationaryVehicleContainerParams(LONG packetHandle, struct DENMStationaryVehicleContainer value, char oldPath[])
{
  char newPath[300]; 
  int j;
  int result;

  result = 0;

  snprintf(newPath, elcount(newPath), "%s.%s", oldPath, "stationarySince");
  if(value.stationarySince.isValidFlag==1)
  {
    C2xSetTokenInt(packetHandle, "DENM", newPath, value.stationarySince.value);
    result = CheckLastError("DENM", gkFuncRefGet, result);
  }
  else
  {
    if( C2xIsTokenAvailable(packetHandle, "DENM", newPath) )
    {
      C2xRemoveToken(packetHandle, "DENM", newPath);
    }
  }

  snprintf(newPath, elcount(newPath), "%s.%s", oldPath, "stationaryCause");
  if(value.stationaryCause.isValidFlag==1)
  {
    SetDENMCauseCodeParams(packetHandle, value.stationaryCause, newPath);
    result = CheckLastError("DENM", gkFuncRefGet, result);
  }
  else
  {
    if( C2xIsTokenAvailable(packetHandle, "DENM", newPath) )
    {
      C2xRemoveToken(packetHandle, "DENM", newPath);
    }
  }

  snprintf(newPath, elcount(newPath), "%s.%s", oldPath, "carryingDangerousGoods");
  if(value.carryingDangerousGoods.isValidFlag==1)
  {
    SetDENMDangerousGoodsExtendedParams(packetHandle, value.carryingDangerousGoods, newPath);
    result = CheckLastError("DENM", gkFuncRefGet, result);
  }
  else
  {
    if( C2xIsTokenAvailable(packetHandle, "DENM", newPath) )
    {
      C2xRemoveToken(packetHandle, "DENM", newPath);
    }
  }

  snprintf(newPath, elcount(newPath), "%s.%s", oldPath, "numberOfOccupants");
  if(value.numberOfOccupants.isValidFlag==1)
  {
    C2xSetTokenInt(packetHandle, "DENM", newPath, value.numberOfOccupants.value);
    result = CheckLastError("DENM", gkFuncRefGet, result);
  }
  else
  {
    if( C2xIsTokenAvailable(packetHandle, "DENM", newPath) )
    {
      C2xRemoveToken(packetHandle, "DENM", newPath);
    }
  }

  snprintf(newPath, elcount(newPath), "%s.%s", oldPath, "vehicleIdentification");
  if(value.vehicleIdentification.isValidFlag==1)
  {
    SetDENMVehicleIdentificationParams(packetHandle, value.vehicleIdentification, newPath);
    result = CheckLastError("DENM", gkFuncRefGet, result);
  }
  else
  {
    if( C2xIsTokenAvailable(packetHandle, "DENM", newPath) )
    {
      C2xRemoveToken(packetHandle, "DENM", newPath);
    }
  }

  snprintf(newPath, elcount(newPath), "%s.%s", oldPath, "energyStorageType");
  if(value.energyStorageType.isValidFlag==1)
  {
      for(j=0; j<value.energyStorageType.stringLength; j++)
      {
        if(value.energyStorageType.string[j] == '0')
        {
          C2xSetTokenBitOfBitString(packetHandle, "DENM", newPath, j, 0);
        }
        else
        {
          C2xSetTokenBitOfBitString(packetHandle, "DENM", newPath, j, 1);
        }
        result = CheckLastError("DENM", gkFuncRefGet, result);
      }
  }
  else
  {
    if( C2xIsTokenAvailable(packetHandle, "DENM", newPath) )
    {
      C2xRemoveToken(packetHandle, "DENM", newPath);
    }
  }

  return result;
}

int GetDENMSensorIdListParams(LONG packetHandle, struct DENMSensorIdList value, char oldPath[])
{
  char newPath[300]; 
  int i;
  int result;

  result = 0;

  value.length = C2xGetTokenInt(packetHandle, "DENM", oldPath);
  if((result = CheckLastError("DENM", gkFuncRefGet, result))==0)
  {
    for(i=0; i<value.length; i++)
    {
      snprintf(newPath, elcount(newPath), "%s[%d]", oldPath, i);
      value.arrayValue[i] = C2xGetTokenInt64(packetHandle, "DENM", newPath);
      result = CheckLastError("DENM", gkFuncRefGet, result);
    }
  }
  return result;
}

int SetDENMSensorIdListParams(LONG packetHandle, struct DENMSensorIdList value, char oldPath[])
{
  char newPath[300]; 
  int i;
  int result;

  result = 0;

  C2xRemoveToken(packetHandle, "DENM", oldPath);
  for(i=0; i<value.length; i++)
  {
    snprintf(newPath, elcount(newPath), "%s[%d]", oldPath, i);
    C2xSetTokenInt64(packetHandle, "DENM", newPath, value.arrayValue[i]);
    result = CheckLastError("DENM", gkFuncRefGet, result);
  }
  return result;
}

int GetDENMObjectDistanceWithConfidenceParams(LONG packetHandle, struct DENMObjectDistanceWithConfidence value, char oldPath[])
{
  char newPath[300];
  int result;

  result = 0;

  snprintf(newPath, elcount(newPath), "%s.%s", oldPath, "value");
  value.value = C2xGetTokenInt(packetHandle, "DENM", newPath);
  result = CheckLastError("DENM", gkFuncRefGet, result);

  snprintf(newPath, elcount(newPath), "%s.%s", oldPath, "confidence");
  value.confidence = C2xGetTokenInt(packetHandle, "DENM", newPath);
  result = CheckLastError("DENM", gkFuncRefGet, result);

  return result;
}

int SetDENMObjectDistanceWithConfidenceParams(LONG packetHandle, struct DENMObjectDistanceWithConfidence value, char oldPath[])
{
  char newPath[300];
  int result;

  result = 0;

  snprintf(newPath, elcount(newPath), "%s.%s", oldPath, "value");
  C2xSetTokenInt(packetHandle, "DENM", newPath, value.value);
  result = CheckLastError("DENM", gkFuncRefGet, result);

  snprintf(newPath, elcount(newPath), "%s.%s", oldPath, "confidence");
  C2xSetTokenInt(packetHandle, "DENM", newPath, value.confidence);
  result = CheckLastError("DENM", gkFuncRefGet, result);

  return result;
}

int GetDENMSpeedExtendedParams(LONG packetHandle, struct DENMSpeedExtended value, char oldPath[])
{
  char newPath[300];
  int result;

  result = 0;

  snprintf(newPath, elcount(newPath), "%s.%s", oldPath, "value");
  value.value = C2xGetTokenInt(packetHandle, "DENM", newPath);
  result = CheckLastError("DENM", gkFuncRefGet, result);

  snprintf(newPath, elcount(newPath), "%s.%s", oldPath, "confidence");
  value.confidence = C2xGetTokenInt(packetHandle, "DENM", newPath);
  result = CheckLastError("DENM", gkFuncRefGet, result);

  return result;
}

int SetDENMSpeedExtendedParams(LONG packetHandle, struct DENMSpeedExtended value, char oldPath[])
{
  char newPath[300];
  int result;

  result = 0;

  snprintf(newPath, elcount(newPath), "%s.%s", oldPath, "value");
  C2xSetTokenInt(packetHandle, "DENM", newPath, value.value);
  result = CheckLastError("DENM", gkFuncRefGet, result);

  snprintf(newPath, elcount(newPath), "%s.%s", oldPath, "confidence");
  if (value.confidence < 1)
  {
    C2xSetTokenInt(packetHandle, "DENM", newPath, 1);
  }
  else if (value.confidence > 127)
  {
    C2xSetTokenInt(packetHandle, "DENM", newPath, 127);
  }
  else
  {
    C2xSetTokenInt(packetHandle, "DENM", newPath, value.confidence);
  }
  result = CheckLastError("DENM", gkFuncRefGet, result);

  return result;
}

int GetDENMLongitudinalAccelerationParams(LONG packetHandle, struct DENMLongitudinalAcceleration value, char oldPath[])
{
  char newPath[300];
  int result;

  result = 0;

  snprintf(newPath, elcount(newPath), "%s.%s", oldPath, "longitudinalAccelerationValue");
  value.longitudinalAccelerationValue = C2xGetTokenInt(packetHandle, "DENM", newPath);
  result = CheckLastError("DENM", gkFuncRefGet, result);

  snprintf(newPath, elcount(newPath), "%s.%s", oldPath, "longitudinalAccelerationConfidence");
  value.longitudinalAccelerationConfidence = C2xGetTokenInt(packetHandle, "DENM", newPath);
  result = CheckLastError("DENM", gkFuncRefGet, result);

  return result;
}

int SetDENMLongitudinalAccelerationParams(LONG packetHandle, struct DENMLongitudinalAcceleration value, char oldPath[])
{
  char newPath[300];
  int result;

  result = 0;

  snprintf(newPath, elcount(newPath), "%s.%s", oldPath, "longitudinalAccelerationValue");
  C2xSetTokenInt(packetHandle, "DENM", newPath, value.longitudinalAccelerationValue);
  result = CheckLastError("DENM", gkFuncRefGet, result);

  snprintf(newPath, elcount(newPath), "%s.%s", oldPath, "longitudinalAccelerationConfidence");
  C2xSetTokenInt(packetHandle, "DENM", newPath, value.longitudinalAccelerationConfidence);
  result = CheckLastError("DENM", gkFuncRefGet, result);

  return result;
}

int GetDENMLateralAccelerationParams(LONG packetHandle, struct DENMLateralAcceleration value, char oldPath[])
{
  char newPath[300];
  int result;

  result = 0;

  snprintf(newPath, elcount(newPath), "%s.%s", oldPath, "lateralAccelerationValue");
  value.lateralAccelerationValue = C2xGetTokenInt(packetHandle, "DENM", newPath);
  result = CheckLastError("DENM", gkFuncRefGet, result);

  snprintf(newPath, elcount(newPath), "%s.%s", oldPath, "lateralAccelerationConfidence");
  value.lateralAccelerationConfidence = C2xGetTokenInt(packetHandle, "DENM", newPath);
  result = CheckLastError("DENM", gkFuncRefGet, result);

  return result;
}

int SetDENMLateralAccelerationParams(LONG packetHandle, struct DENMLateralAcceleration value, char oldPath[])
{
  char newPath[300];
  int result;

  result = 0;

  snprintf(newPath, elcount(newPath), "%s.%s", oldPath, "lateralAccelerationValue");
  C2xSetTokenInt(packetHandle, "DENM", newPath, value.lateralAccelerationValue);
  result = CheckLastError("DENM", gkFuncRefGet, result);

  snprintf(newPath, elcount(newPath), "%s.%s", oldPath, "lateralAccelerationConfidence");
  C2xSetTokenInt(packetHandle, "DENM", newPath, value.lateralAccelerationConfidence);
  result = CheckLastError("DENM", gkFuncRefGet, result);

  return result;
}

int GetDENMVerticalAccelerationParams(LONG packetHandle, struct DENMVerticalAcceleration value, char oldPath[])
{
  char newPath[300];
  int result;

  result = 0;

  snprintf(newPath, elcount(newPath), "%s.%s", oldPath, "verticalAccelerationValue");
  value.verticalAccelerationValue = C2xGetTokenInt(packetHandle, "DENM", newPath);
  result = CheckLastError("DENM", gkFuncRefGet, result);

  snprintf(newPath, elcount(newPath), "%s.%s", oldPath, "verticalAccelerationConfidence");
  value.verticalAccelerationConfidence = C2xGetTokenInt(packetHandle, "DENM", newPath);
  result = CheckLastError("DENM", gkFuncRefGet, result);

  return result;
}

int SetDENMVerticalAccelerationParams(LONG packetHandle, struct DENMVerticalAcceleration value, char oldPath[])
{
  char newPath[300];
  int result;

  result = 0;

  snprintf(newPath, elcount(newPath), "%s.%s", oldPath, "verticalAccelerationValue");
  C2xSetTokenInt(packetHandle, "DENM", newPath, value.verticalAccelerationValue);
  result = CheckLastError("DENM", gkFuncRefGet, result);

  snprintf(newPath, elcount(newPath), "%s.%s", oldPath, "verticalAccelerationConfidence");
  C2xSetTokenInt(packetHandle, "DENM", newPath, value.verticalAccelerationConfidence);
  result = CheckLastError("DENM", gkFuncRefGet, result);

  return result;
}

int GetDENMCartesianAngleParams(LONG packetHandle, struct DENMCartesianAngle value, char oldPath[])
{
  char newPath[300];
  int result;

  result = 0;

  snprintf(newPath, elcount(newPath), "%s.%s", oldPath, "value");
  value.value = C2xGetTokenInt(packetHandle, "DENM", newPath);
  result = CheckLastError("DENM", gkFuncRefGet, result);

  snprintf(newPath, elcount(newPath), "%s.%s", oldPath, "confidence");
  value.confidence = C2xGetTokenInt(packetHandle, "DENM", newPath);
  result = CheckLastError("DENM", gkFuncRefGet, result);

  return result;
}

int SetDENMCartesianAngleParams(LONG packetHandle, struct DENMCartesianAngle value, char oldPath[])
{
  char newPath[300];
  int result;

  result = 0;

  snprintf(newPath, elcount(newPath), "%s.%s", oldPath, "value");
  C2xSetTokenInt(packetHandle, "DENM", newPath, value.value);
  result = CheckLastError("DENM", gkFuncRefGet, result);

  snprintf(newPath, elcount(newPath), "%s.%s", oldPath, "confidence");
  if (value.confidence < 1)
  {
    C2xSetTokenInt(packetHandle, "DENM", newPath, 1);
  }
  else if (value.confidence > 127)
  {
    C2xSetTokenInt(packetHandle, "DENM", newPath, 127);
  }
  else
  {
    C2xSetTokenInt(packetHandle, "DENM", newPath, value.confidence);
  }
  result = CheckLastError("DENM", gkFuncRefGet, result);

  return result;
}

int GetDENMObjectDimensionParams(LONG packetHandle, struct DENMObjectDimension value, char oldPath[])
{
  char newPath[300];
  int result;

  result = 0;

  snprintf(newPath, elcount(newPath), "%s.%s", oldPath, "value");
  value.value = C2xGetTokenInt(packetHandle, "DENM", newPath);
  result = CheckLastError("DENM", gkFuncRefGet, result);

  snprintf(newPath, elcount(newPath), "%s.%s", oldPath, "confidence");
  value.confidence = C2xGetTokenInt(packetHandle, "DENM", newPath);
  result = CheckLastError("DENM", gkFuncRefGet, result);

  return result;
}

int SetDENMObjectDimensionParams(LONG packetHandle, struct DENMObjectDimension value, char oldPath[])
{
  char newPath[300];
  int result;

  result = 0;

  snprintf(newPath, elcount(newPath), "%s.%s", oldPath, "value");
  C2xSetTokenInt(packetHandle, "DENM", newPath, value.value);
  result = CheckLastError("DENM", gkFuncRefGet, result);

  snprintf(newPath, elcount(newPath), "%s.%s", oldPath, "confidence");
  C2xSetTokenInt(packetHandle, "DENM", newPath, value.confidence);
  result = CheckLastError("DENM", gkFuncRefGet, result);

  return result;
}

int GetDENMVehicleSubclassParams(LONG packetHandle, struct DENMVehicleSubclass value, char oldPath[])
{
  char newPath[300];
  int result;

  result = 0;

  snprintf(newPath, elcount(newPath), "%s.%s", oldPath, "type");
  value.type.isValidFlag = C2xIsTokenAvailable(packetHandle, "DENM", newPath);
  if(value.type.isValidFlag==1)
  {
    value.type.value = C2xGetTokenInt(packetHandle, "DENM", newPath);
    result = CheckLastError("DENM", gkFuncRefGet, result);
  }
  snprintf(newPath, elcount(newPath), "%s.%s", oldPath, "confidence");
  value.confidence.isValidFlag = C2xIsTokenAvailable(packetHandle, "DENM", newPath);
  if(value.confidence.isValidFlag==1)
  {
    value.confidence.value = C2xGetTokenInt(packetHandle, "DENM", newPath);
    result = CheckLastError("DENM", gkFuncRefGet, result);
  }
  return result;
}

int SetDENMVehicleSubclassParams(LONG packetHandle, struct DENMVehicleSubclass value, char oldPath[])
{
  char newPath[300];
  int result;

  result = 0;

  snprintf(newPath, elcount(newPath), "%s.%s", oldPath, "type");
  if(value.type.isValidFlag==1)
  {
    C2xSetTokenInt(packetHandle, "DENM", newPath, value.type.value);
    result = CheckLastError("DENM", gkFuncRefGet, result);
  }
  else
  {
    if( C2xIsTokenAvailable(packetHandle, "DENM", newPath) )
    {
      C2xRemoveToken(packetHandle, "DENM", newPath);
    }
  }

  snprintf(newPath, elcount(newPath), "%s.%s", oldPath, "confidence");
  if(value.confidence.isValidFlag==1)
  {
    C2xSetTokenInt(packetHandle, "DENM", newPath, value.confidence.value);
    result = CheckLastError("DENM", gkFuncRefGet, result);
  }
  else
  {
    if( C2xIsTokenAvailable(packetHandle, "DENM", newPath) )
    {
      C2xRemoveToken(packetHandle, "DENM", newPath);
    }
  }

  return result;
}

int GetDENMPersonSubclassParams(LONG packetHandle, struct DENMPersonSubclass value, char oldPath[])
{
  char newPath[300];
  int result;

  result = 0;

  snprintf(newPath, elcount(newPath), "%s.%s", oldPath, "type");
  value.type.isValidFlag = C2xIsTokenAvailable(packetHandle, "DENM", newPath);
  if(value.type.isValidFlag==1)
  {
    value.type.value = C2xGetTokenInt(packetHandle, "DENM", newPath);
    result = CheckLastError("DENM", gkFuncRefGet, result);
  }
  snprintf(newPath, elcount(newPath), "%s.%s", oldPath, "confidence");
  value.confidence.isValidFlag = C2xIsTokenAvailable(packetHandle, "DENM", newPath);
  if(value.confidence.isValidFlag==1)
  {
    value.confidence.value = C2xGetTokenInt(packetHandle, "DENM", newPath);
    result = CheckLastError("DENM", gkFuncRefGet, result);
  }
  return result;
}

int SetDENMPersonSubclassParams(LONG packetHandle, struct DENMPersonSubclass value, char oldPath[])
{
  char newPath[300];
  int result;

  result = 0;

  snprintf(newPath, elcount(newPath), "%s.%s", oldPath, "type");
  if(value.type.isValidFlag==1)
  {
    C2xSetTokenInt(packetHandle, "DENM", newPath, value.type.value);
    result = CheckLastError("DENM", gkFuncRefGet, result);
  }
  else
  {
    if( C2xIsTokenAvailable(packetHandle, "DENM", newPath) )
    {
      C2xRemoveToken(packetHandle, "DENM", newPath);
    }
  }

  snprintf(newPath, elcount(newPath), "%s.%s", oldPath, "confidence");
  if(value.confidence.isValidFlag==1)
  {
    C2xSetTokenInt(packetHandle, "DENM", newPath, value.confidence.value);
    result = CheckLastError("DENM", gkFuncRefGet, result);
  }
  else
  {
    if( C2xIsTokenAvailable(packetHandle, "DENM", newPath) )
    {
      C2xRemoveToken(packetHandle, "DENM", newPath);
    }
  }

  return result;
}

int GetDENMAnimalSubclassParams(LONG packetHandle, struct DENMAnimalSubclass value, char oldPath[])
{
  char newPath[300];
  int result;

  result = 0;

  snprintf(newPath, elcount(newPath), "%s.%s", oldPath, "type");
  value.type.isValidFlag = C2xIsTokenAvailable(packetHandle, "DENM", newPath);
  if(value.type.isValidFlag==1)
  {
    value.type.value = C2xGetTokenInt(packetHandle, "DENM", newPath);
    result = CheckLastError("DENM", gkFuncRefGet, result);
  }
  snprintf(newPath, elcount(newPath), "%s.%s", oldPath, "confidence");
  value.confidence.isValidFlag = C2xIsTokenAvailable(packetHandle, "DENM", newPath);
  if(value.confidence.isValidFlag==1)
  {
    value.confidence.value = C2xGetTokenInt(packetHandle, "DENM", newPath);
    result = CheckLastError("DENM", gkFuncRefGet, result);
  }
  return result;
}

int SetDENMAnimalSubclassParams(LONG packetHandle, struct DENMAnimalSubclass value, char oldPath[])
{
  char newPath[300];
  int result;

  result = 0;

  snprintf(newPath, elcount(newPath), "%s.%s", oldPath, "type");
  if(value.type.isValidFlag==1)
  {
    C2xSetTokenInt(packetHandle, "DENM", newPath, value.type.value);
    result = CheckLastError("DENM", gkFuncRefGet, result);
  }
  else
  {
    if( C2xIsTokenAvailable(packetHandle, "DENM", newPath) )
    {
      C2xRemoveToken(packetHandle, "DENM", newPath);
    }
  }

  snprintf(newPath, elcount(newPath), "%s.%s", oldPath, "confidence");
  if(value.confidence.isValidFlag==1)
  {
    C2xSetTokenInt(packetHandle, "DENM", newPath, value.confidence.value);
    result = CheckLastError("DENM", gkFuncRefGet, result);
  }
  else
  {
    if( C2xIsTokenAvailable(packetHandle, "DENM", newPath) )
    {
      C2xRemoveToken(packetHandle, "DENM", newPath);
    }
  }

  return result;
}

int GetDENMOtherSubclassParams(LONG packetHandle, struct DENMOtherSubclass value, char oldPath[])
{
  char newPath[300];
  int result;

  result = 0;

  snprintf(newPath, elcount(newPath), "%s.%s", oldPath, "type");
  value.type.isValidFlag = C2xIsTokenAvailable(packetHandle, "DENM", newPath);
  if(value.type.isValidFlag==1)
  {
    value.type.value = C2xGetTokenInt(packetHandle, "DENM", newPath);
    result = CheckLastError("DENM", gkFuncRefGet, result);
  }
  snprintf(newPath, elcount(newPath), "%s.%s", oldPath, "confidence");
  value.confidence.isValidFlag = C2xIsTokenAvailable(packetHandle, "DENM", newPath);
  if(value.confidence.isValidFlag==1)
  {
    value.confidence.value = C2xGetTokenInt(packetHandle, "DENM", newPath);
    result = CheckLastError("DENM", gkFuncRefGet, result);
  }
  return result;
}

int SetDENMOtherSubclassParams(LONG packetHandle, struct DENMOtherSubclass value, char oldPath[])
{
  char newPath[300];
  int result;

  result = 0;

  snprintf(newPath, elcount(newPath), "%s.%s", oldPath, "type");
  if(value.type.isValidFlag==1)
  {
    C2xSetTokenInt(packetHandle, "DENM", newPath, value.type.value);
    result = CheckLastError("DENM", gkFuncRefGet, result);
  }
  else
  {
    if( C2xIsTokenAvailable(packetHandle, "DENM", newPath) )
    {
      C2xRemoveToken(packetHandle, "DENM", newPath);
    }
  }

  snprintf(newPath, elcount(newPath), "%s.%s", oldPath, "confidence");
  if(value.confidence.isValidFlag==1)
  {
    C2xSetTokenInt(packetHandle, "DENM", newPath, value.confidence.value);
    result = CheckLastError("DENM", gkFuncRefGet, result);
  }
  else
  {
    if( C2xIsTokenAvailable(packetHandle, "DENM", newPath) )
    {
      C2xRemoveToken(packetHandle, "DENM", newPath);
    }
  }

  return result;
}

int GetDENMObjectClass_classParams(LONG packetHandle, struct DENMObjectClass_class value, char oldPath[])
{
  char newPath[300];
  int result;

  result = 0;

  value.choice = C2xGetTokenInt(packetHandle, "DENM", oldPath);

  switch(value.choice)
  {
    case 0:
    {
      snprintf(newPath, elcount(newPath), "%s.%s", oldPath, "vehicle");
      GetDENMVehicleSubclassParams(packetHandle, value.vehicle, newPath);
      result = CheckLastError("DENM", gkFuncRefGet, result);
    }
    break;
    case 1:
    {
      snprintf(newPath, elcount(newPath), "%s.%s", oldPath, "person");
      GetDENMPersonSubclassParams(packetHandle, value.person, newPath);
      result = CheckLastError("DENM", gkFuncRefGet, result);
    }
    break;
    case 2:
    {
      snprintf(newPath, elcount(newPath), "%s.%s", oldPath, "animal");
      GetDENMAnimalSubclassParams(packetHandle, value.animal, newPath);
      result = CheckLastError("DENM", gkFuncRefGet, result);
    }
    break;
    case 3:
    {
      snprintf(newPath, elcount(newPath), "%s.%s", oldPath, "other");
      GetDENMOtherSubclassParams(packetHandle, value.other, newPath);
      result = CheckLastError("DENM", gkFuncRefGet, result);
    }
    break;
  }
  return result;
}

int SetDENMObjectClass_classParams(LONG packetHandle, struct DENMObjectClass_class value, char oldPath[])
{
  char newPath[300];
  int result;

  result = 0;

  switch(value.choice)
  {
    case 0:
    {
      snprintf(newPath, elcount(newPath), "%s.%s", oldPath, "vehicle");
      SetDENMVehicleSubclassParams(packetHandle, value.vehicle, newPath);
      result = CheckLastError("DENM", gkFuncRefGet, result);
    }
    break;
    case 1:
    {
      snprintf(newPath, elcount(newPath), "%s.%s", oldPath, "person");
      SetDENMPersonSubclassParams(packetHandle, value.person, newPath);
      result = CheckLastError("DENM", gkFuncRefGet, result);
    }
    break;
    case 2:
    {
      snprintf(newPath, elcount(newPath), "%s.%s", oldPath, "animal");
      SetDENMAnimalSubclassParams(packetHandle, value.animal, newPath);
      result = CheckLastError("DENM", gkFuncRefGet, result);
    }
    break;
    case 3:
    {
      snprintf(newPath, elcount(newPath), "%s.%s", oldPath, "other");
      SetDENMOtherSubclassParams(packetHandle, value.other, newPath);
      result = CheckLastError("DENM", gkFuncRefGet, result);
    }
    break;
  }
  return result;
}

int GetDENMObjectClassParams(LONG packetHandle, struct DENMObjectClass value, char oldPath[])
{
  char newPath[300];
  int result;

  result = 0;

  snprintf(newPath, elcount(newPath), "%s.%s", oldPath, "confidence");
  value.confidence = C2xGetTokenInt(packetHandle, "DENM", newPath);
  result = CheckLastError("DENM", gkFuncRefGet, result);

  snprintf(newPath, elcount(newPath), "%s.%s", oldPath, "class");
  GetDENMObjectClass_classParams(packetHandle, value.class, newPath);
  result = CheckLastError("DENM", gkFuncRefGet, result);

  return result;
}

int SetDENMObjectClassParams(LONG packetHandle, struct DENMObjectClass value, char oldPath[])
{
  char newPath[300];
  int result;

  result = 0;

  snprintf(newPath, elcount(newPath), "%s.%s", oldPath, "confidence");
  C2xSetTokenInt(packetHandle, "DENM", newPath, value.confidence);
  result = CheckLastError("DENM", gkFuncRefGet, result);

  snprintf(newPath, elcount(newPath), "%s.%s", oldPath, "class");
  SetDENMObjectClass_classParams(packetHandle, value.class, newPath);
  result = CheckLastError("DENM", gkFuncRefGet, result);

  return result;
}

int GetDENMObjectClassDescriptionParams(LONG packetHandle, struct DENMObjectClassDescription value, char oldPath[])
{
  char newPath[300]; 
  int i;
  int result;

  result = 0;

  value.length = C2xGetTokenInt(packetHandle, "DENM", oldPath);
  if((result = CheckLastError("DENM", gkFuncRefGet, result))==0)
  {
    for(i=0; i<value.length; i++)
    {
      snprintf(newPath, elcount(newPath), "%s[%d]", oldPath, i);
      GetDENMObjectClassParams(packetHandle, value.arrayValue[i], newPath);
      result = CheckLastError("DENM", gkFuncRefGet, result);
    }
  }
  return result;
}

int SetDENMObjectClassDescriptionParams(LONG packetHandle, struct DENMObjectClassDescription value, char oldPath[])
{
  char newPath[300]; 
  int i;
  int result;

  result = 0;

  C2xRemoveToken(packetHandle, "DENM", oldPath);
  for(i=0; i<value.length; i++)
  {
    snprintf(newPath, elcount(newPath), "%s[%d]", oldPath, i);
    SetDENMObjectClassParams(packetHandle, value.arrayValue[i], newPath);
    result = CheckLastError("DENM", gkFuncRefGet, result);
  }
  return result;
}

int GetDENMLongitudinalLanePositionParams(LONG packetHandle, struct DENMLongitudinalLanePosition value, char oldPath[])
{
  char newPath[300];
  int result;

  result = 0;

  snprintf(newPath, elcount(newPath), "%s.%s", oldPath, "longitudinalLanePositionValue");
  value.longitudinalLanePositionValue = C2xGetTokenInt(packetHandle, "DENM", newPath);
  result = CheckLastError("DENM", gkFuncRefGet, result);

  snprintf(newPath, elcount(newPath), "%s.%s", oldPath, "longitudinalLanePositionConfidence");
  value.longitudinalLanePositionConfidence = C2xGetTokenInt(packetHandle, "DENM", newPath);
  result = CheckLastError("DENM", gkFuncRefGet, result);

  return result;
}

int SetDENMLongitudinalLanePositionParams(LONG packetHandle, struct DENMLongitudinalLanePosition value, char oldPath[])
{
  char newPath[300];
  int result;

  result = 0;

  snprintf(newPath, elcount(newPath), "%s.%s", oldPath, "longitudinalLanePositionValue");
  C2xSetTokenInt(packetHandle, "DENM", newPath, value.longitudinalLanePositionValue);
  result = CheckLastError("DENM", gkFuncRefGet, result);

  snprintf(newPath, elcount(newPath), "%s.%s", oldPath, "longitudinalLanePositionConfidence");
  C2xSetTokenInt(packetHandle, "DENM", newPath, value.longitudinalLanePositionConfidence);
  result = CheckLastError("DENM", gkFuncRefGet, result);

  return result;
}

int GetDENMMatchedPositionParams(LONG packetHandle, struct DENMMatchedPosition value, char oldPath[])
{
  char newPath[300];
  int result;

  result = 0;

  snprintf(newPath, elcount(newPath), "%s.%s", oldPath, "laneID");
  value.laneID.isValidFlag = C2xIsTokenAvailable(packetHandle, "DENM", newPath);
  if(value.laneID.isValidFlag==1)
  {
    value.laneID.value = C2xGetTokenInt(packetHandle, "DENM", newPath);
    result = CheckLastError("DENM", gkFuncRefGet, result);
  }
  snprintf(newPath, elcount(newPath), "%s.%s", oldPath, "longitudinalLanePosition");
  value.longitudinalLanePosition.isValidFlag = C2xIsTokenAvailable(packetHandle, "DENM", newPath);
  if(value.longitudinalLanePosition.isValidFlag==1)
  {
    GetDENMLongitudinalLanePositionParams(packetHandle, value.longitudinalLanePosition, newPath);
    result = CheckLastError("DENM", gkFuncRefGet, result);
  }
  return result;
}

int SetDENMMatchedPositionParams(LONG packetHandle, struct DENMMatchedPosition value, char oldPath[])
{
  char newPath[300];
  int result;

  result = 0;

  snprintf(newPath, elcount(newPath), "%s.%s", oldPath, "laneID");
  if(value.laneID.isValidFlag==1)
  {
    C2xSetTokenInt(packetHandle, "DENM", newPath, value.laneID.value);
    result = CheckLastError("DENM", gkFuncRefGet, result);
  }
  else
  {
    if( C2xIsTokenAvailable(packetHandle, "DENM", newPath) )
    {
      C2xRemoveToken(packetHandle, "DENM", newPath);
    }
  }

  snprintf(newPath, elcount(newPath), "%s.%s", oldPath, "longitudinalLanePosition");
  if(value.longitudinalLanePosition.isValidFlag==1)
  {
    SetDENMLongitudinalLanePositionParams(packetHandle, value.longitudinalLanePosition, newPath);
    result = CheckLastError("DENM", gkFuncRefGet, result);
  }
  else
  {
    if( C2xIsTokenAvailable(packetHandle, "DENM", newPath) )
    {
      C2xRemoveToken(packetHandle, "DENM", newPath);
    }
  }

  return result;
}

int GetDENMPerceivedObjectParams(LONG packetHandle, struct DENMPerceivedObject value, char oldPath[])
{
  char newPath[300];
  int result;

  result = 0;

  snprintf(newPath, elcount(newPath), "%s.%s", oldPath, "objectID");
  value.objectID = C2xGetTokenInt(packetHandle, "DENM", newPath);
  result = CheckLastError("DENM", gkFuncRefGet, result);

  snprintf(newPath, elcount(newPath), "%s.%s", oldPath, "sensorIDList");
  value.sensorIDList.isValidFlag = C2xIsTokenAvailable(packetHandle, "DENM", newPath);
  if(value.sensorIDList.isValidFlag==1)
  {
    GetDENMSensorIdListParams(packetHandle, value.sensorIDList, newPath);
    result = CheckLastError("DENM", gkFuncRefGet, result);
  }
  snprintf(newPath, elcount(newPath), "%s.%s", oldPath, "timeOfMeasurement");
  value.timeOfMeasurement = C2xGetTokenInt(packetHandle, "DENM", newPath);
  result = CheckLastError("DENM", gkFuncRefGet, result);

  snprintf(newPath, elcount(newPath), "%s.%s", oldPath, "objectAge");
  value.objectAge.isValidFlag = C2xIsTokenAvailable(packetHandle, "DENM", newPath);
  if(value.objectAge.isValidFlag==1)
  {
    value.objectAge.value = C2xGetTokenInt(packetHandle, "DENM", newPath);
    result = CheckLastError("DENM", gkFuncRefGet, result);
  }
  snprintf(newPath, elcount(newPath), "%s.%s", oldPath, "objectConfidence");
  value.objectConfidence.isValidFlag = C2xIsTokenAvailable(packetHandle, "DENM", newPath);
  if(value.objectConfidence.isValidFlag==1)
  {
    value.objectConfidence.value = C2xGetTokenInt(packetHandle, "DENM", newPath);
    result = CheckLastError("DENM", gkFuncRefGet, result);
  }
  snprintf(newPath, elcount(newPath), "%s.%s", oldPath, "xDistance");
  GetDENMObjectDistanceWithConfidenceParams(packetHandle, value.xDistance, newPath);
  result = CheckLastError("DENM", gkFuncRefGet, result);

  snprintf(newPath, elcount(newPath), "%s.%s", oldPath, "yDistance");
  GetDENMObjectDistanceWithConfidenceParams(packetHandle, value.yDistance, newPath);
  result = CheckLastError("DENM", gkFuncRefGet, result);

  snprintf(newPath, elcount(newPath), "%s.%s", oldPath, "zDistance");
  value.zDistance.isValidFlag = C2xIsTokenAvailable(packetHandle, "DENM", newPath);
  if(value.zDistance.isValidFlag==1)
  {
    GetDENMObjectDistanceWithConfidenceParams(packetHandle, value.zDistance, newPath);
    result = CheckLastError("DENM", gkFuncRefGet, result);
  }
  snprintf(newPath, elcount(newPath), "%s.%s", oldPath, "xSpeed");
  GetDENMSpeedExtendedParams(packetHandle, value.xSpeed, newPath);
  result = CheckLastError("DENM", gkFuncRefGet, result);

  snprintf(newPath, elcount(newPath), "%s.%s", oldPath, "ySpeed");
  GetDENMSpeedExtendedParams(packetHandle, value.ySpeed, newPath);
  result = CheckLastError("DENM", gkFuncRefGet, result);

  snprintf(newPath, elcount(newPath), "%s.%s", oldPath, "zSpeed");
  value.zSpeed.isValidFlag = C2xIsTokenAvailable(packetHandle, "DENM", newPath);
  if(value.zSpeed.isValidFlag==1)
  {
    GetDENMSpeedExtendedParams(packetHandle, value.zSpeed, newPath);
    result = CheckLastError("DENM", gkFuncRefGet, result);
  }
  snprintf(newPath, elcount(newPath), "%s.%s", oldPath, "xAcceleration");
  value.xAcceleration.isValidFlag = C2xIsTokenAvailable(packetHandle, "DENM", newPath);
  if(value.xAcceleration.isValidFlag==1)
  {
    GetDENMLongitudinalAccelerationParams(packetHandle, value.xAcceleration, newPath);
    result = CheckLastError("DENM", gkFuncRefGet, result);
  }
  snprintf(newPath, elcount(newPath), "%s.%s", oldPath, "yAcceleration");
  value.yAcceleration.isValidFlag = C2xIsTokenAvailable(packetHandle, "DENM", newPath);
  if(value.yAcceleration.isValidFlag==1)
  {
    GetDENMLateralAccelerationParams(packetHandle, value.yAcceleration, newPath);
    result = CheckLastError("DENM", gkFuncRefGet, result);
  }
  snprintf(newPath, elcount(newPath), "%s.%s", oldPath, "zAcceleration");
  value.zAcceleration.isValidFlag = C2xIsTokenAvailable(packetHandle, "DENM", newPath);
  if(value.zAcceleration.isValidFlag==1)
  {
    GetDENMVerticalAccelerationParams(packetHandle, value.zAcceleration, newPath);
    result = CheckLastError("DENM", gkFuncRefGet, result);
  }
  snprintf(newPath, elcount(newPath), "%s.%s", oldPath, "yawAngle");
  value.yawAngle.isValidFlag = C2xIsTokenAvailable(packetHandle, "DENM", newPath);
  if(value.yawAngle.isValidFlag==1)
  {
    GetDENMCartesianAngleParams(packetHandle, value.yawAngle, newPath);
    result = CheckLastError("DENM", gkFuncRefGet, result);
  }
  snprintf(newPath, elcount(newPath), "%s.%s", oldPath, "planarObjectDimension1");
  value.planarObjectDimension1.isValidFlag = C2xIsTokenAvailable(packetHandle, "DENM", newPath);
  if(value.planarObjectDimension1.isValidFlag==1)
  {
    GetDENMObjectDimensionParams(packetHandle, value.planarObjectDimension1, newPath);
    result = CheckLastError("DENM", gkFuncRefGet, result);
  }
  snprintf(newPath, elcount(newPath), "%s.%s", oldPath, "planarObjectDimension2");
  value.planarObjectDimension2.isValidFlag = C2xIsTokenAvailable(packetHandle, "DENM", newPath);
  if(value.planarObjectDimension2.isValidFlag==1)
  {
    GetDENMObjectDimensionParams(packetHandle, value.planarObjectDimension2, newPath);
    result = CheckLastError("DENM", gkFuncRefGet, result);
  }
  snprintf(newPath, elcount(newPath), "%s.%s", oldPath, "verticalObjectDimension");
  value.verticalObjectDimension.isValidFlag = C2xIsTokenAvailable(packetHandle, "DENM", newPath);
  if(value.verticalObjectDimension.isValidFlag==1)
  {
    GetDENMObjectDimensionParams(packetHandle, value.verticalObjectDimension, newPath);
    result = CheckLastError("DENM", gkFuncRefGet, result);
  }
  snprintf(newPath, elcount(newPath), "%s.%s", oldPath, "objectRefPoint");
  value.objectRefPoint.isValidFlag = C2xIsTokenAvailable(packetHandle, "DENM", newPath);
  if(value.objectRefPoint.isValidFlag==1)
  {
    value.objectRefPoint.value = C2xGetTokenInt(packetHandle, "DENM", newPath);
    result = CheckLastError("DENM", gkFuncRefGet, result);
  }
  snprintf(newPath, elcount(newPath), "%s.%s", oldPath, "dynamicStatus");
  value.dynamicStatus.isValidFlag = C2xIsTokenAvailable(packetHandle, "DENM", newPath);
  if(value.dynamicStatus.isValidFlag==1)
  {
    value.dynamicStatus.value = C2xGetTokenInt(packetHandle, "DENM", newPath);
    result = CheckLastError("DENM", gkFuncRefGet, result);
  }
  snprintf(newPath, elcount(newPath), "%s.%s", oldPath, "classification");
  value.classification.isValidFlag = C2xIsTokenAvailable(packetHandle, "DENM", newPath);
  if(value.classification.isValidFlag==1)
  {
    GetDENMObjectClassDescriptionParams(packetHandle, value.classification, newPath);
    result = CheckLastError("DENM", gkFuncRefGet, result);
  }
  snprintf(newPath, elcount(newPath), "%s.%s", oldPath, "matchedPosition");
  value.matchedPosition.isValidFlag = C2xIsTokenAvailable(packetHandle, "DENM", newPath);
  if(value.matchedPosition.isValidFlag==1)
  {
    GetDENMMatchedPositionParams(packetHandle, value.matchedPosition, newPath);
    result = CheckLastError("DENM", gkFuncRefGet, result);
  }
  return result;
}

int SetDENMPerceivedObjectParams(LONG packetHandle, struct DENMPerceivedObject value, char oldPath[])
{
  char newPath[300];
  int result;

  result = 0;

  snprintf(newPath, elcount(newPath), "%s.%s", oldPath, "objectID");
  C2xSetTokenInt(packetHandle, "DENM", newPath, value.objectID);
  result = CheckLastError("DENM", gkFuncRefGet, result);

  snprintf(newPath, elcount(newPath), "%s.%s", oldPath, "sensorIDList");
  if(value.sensorIDList.isValidFlag==1)
  {
    SetDENMSensorIdListParams(packetHandle, value.sensorIDList, newPath);
    result = CheckLastError("DENM", gkFuncRefGet, result);
  }
  else
  {
    if( C2xIsTokenAvailable(packetHandle, "DENM", newPath) )
    {
      C2xRemoveToken(packetHandle, "DENM", newPath);
    }
  }

  snprintf(newPath, elcount(newPath), "%s.%s", oldPath, "timeOfMeasurement");
  C2xSetTokenInt(packetHandle, "DENM", newPath, value.timeOfMeasurement);
  result = CheckLastError("DENM", gkFuncRefGet, result);

  snprintf(newPath, elcount(newPath), "%s.%s", oldPath, "objectAge");
  if(value.objectAge.isValidFlag==1)
  {
    C2xSetTokenInt(packetHandle, "DENM", newPath, value.objectAge.value);
    result = CheckLastError("DENM", gkFuncRefGet, result);
  }
  else
  {
    if( C2xIsTokenAvailable(packetHandle, "DENM", newPath) )
    {
      C2xRemoveToken(packetHandle, "DENM", newPath);
    }
  }

  snprintf(newPath, elcount(newPath), "%s.%s", oldPath, "objectConfidence");
  if(value.objectConfidence.isValidFlag==1)
  {
    C2xSetTokenInt(packetHandle, "DENM", newPath, value.objectConfidence.value);
    result = CheckLastError("DENM", gkFuncRefGet, result);
  }
  else
  {
    if( C2xIsTokenAvailable(packetHandle, "DENM", newPath) )
    {
      C2xRemoveToken(packetHandle, "DENM", newPath);
    }
  }

  snprintf(newPath, elcount(newPath), "%s.%s", oldPath, "xDistance");
  SetDENMObjectDistanceWithConfidenceParams(packetHandle, value.xDistance, newPath);
  result = CheckLastError("DENM", gkFuncRefGet, result);

  snprintf(newPath, elcount(newPath), "%s.%s", oldPath, "yDistance");
  SetDENMObjectDistanceWithConfidenceParams(packetHandle, value.yDistance, newPath);
  result = CheckLastError("DENM", gkFuncRefGet, result);

  snprintf(newPath, elcount(newPath), "%s.%s", oldPath, "zDistance");
  if(value.zDistance.isValidFlag==1)
  {
    SetDENMObjectDistanceWithConfidenceParams(packetHandle, value.zDistance, newPath);
    result = CheckLastError("DENM", gkFuncRefGet, result);
  }
  else
  {
    if( C2xIsTokenAvailable(packetHandle, "DENM", newPath) )
    {
      C2xRemoveToken(packetHandle, "DENM", newPath);
    }
  }

  snprintf(newPath, elcount(newPath), "%s.%s", oldPath, "xSpeed");
  SetDENMSpeedExtendedParams(packetHandle, value.xSpeed, newPath);
  result = CheckLastError("DENM", gkFuncRefGet, result);

  snprintf(newPath, elcount(newPath), "%s.%s", oldPath, "ySpeed");
  SetDENMSpeedExtendedParams(packetHandle, value.ySpeed, newPath);
  result = CheckLastError("DENM", gkFuncRefGet, result);

  snprintf(newPath, elcount(newPath), "%s.%s", oldPath, "zSpeed");
  if(value.zSpeed.isValidFlag==1)
  {
    SetDENMSpeedExtendedParams(packetHandle, value.zSpeed, newPath);
    result = CheckLastError("DENM", gkFuncRefGet, result);
  }
  else
  {
    if( C2xIsTokenAvailable(packetHandle, "DENM", newPath) )
    {
      C2xRemoveToken(packetHandle, "DENM", newPath);
    }
  }

  snprintf(newPath, elcount(newPath), "%s.%s", oldPath, "xAcceleration");
  if(value.xAcceleration.isValidFlag==1)
  {
    SetDENMLongitudinalAccelerationParams(packetHandle, value.xAcceleration, newPath);
    result = CheckLastError("DENM", gkFuncRefGet, result);
  }
  else
  {
    if( C2xIsTokenAvailable(packetHandle, "DENM", newPath) )
    {
      C2xRemoveToken(packetHandle, "DENM", newPath);
    }
  }

  snprintf(newPath, elcount(newPath), "%s.%s", oldPath, "yAcceleration");
  if(value.yAcceleration.isValidFlag==1)
  {
    SetDENMLateralAccelerationParams(packetHandle, value.yAcceleration, newPath);
    result = CheckLastError("DENM", gkFuncRefGet, result);
  }
  else
  {
    if( C2xIsTokenAvailable(packetHandle, "DENM", newPath) )
    {
      C2xRemoveToken(packetHandle, "DENM", newPath);
    }
  }

  snprintf(newPath, elcount(newPath), "%s.%s", oldPath, "zAcceleration");
  if(value.zAcceleration.isValidFlag==1)
  {
    SetDENMVerticalAccelerationParams(packetHandle, value.zAcceleration, newPath);
    result = CheckLastError("DENM", gkFuncRefGet, result);
  }
  else
  {
    if( C2xIsTokenAvailable(packetHandle, "DENM", newPath) )
    {
      C2xRemoveToken(packetHandle, "DENM", newPath);
    }
  }

  snprintf(newPath, elcount(newPath), "%s.%s", oldPath, "yawAngle");
  if(value.yawAngle.isValidFlag==1)
  {
    SetDENMCartesianAngleParams(packetHandle, value.yawAngle, newPath);
    result = CheckLastError("DENM", gkFuncRefGet, result);
  }
  else
  {
    if( C2xIsTokenAvailable(packetHandle, "DENM", newPath) )
    {
      C2xRemoveToken(packetHandle, "DENM", newPath);
    }
  }

  snprintf(newPath, elcount(newPath), "%s.%s", oldPath, "planarObjectDimension1");
  if(value.planarObjectDimension1.isValidFlag==1)
  {
    SetDENMObjectDimensionParams(packetHandle, value.planarObjectDimension1, newPath);
    result = CheckLastError("DENM", gkFuncRefGet, result);
  }
  else
  {
    if( C2xIsTokenAvailable(packetHandle, "DENM", newPath) )
    {
      C2xRemoveToken(packetHandle, "DENM", newPath);
    }
  }

  snprintf(newPath, elcount(newPath), "%s.%s", oldPath, "planarObjectDimension2");
  if(value.planarObjectDimension2.isValidFlag==1)
  {
    SetDENMObjectDimensionParams(packetHandle, value.planarObjectDimension2, newPath);
    result = CheckLastError("DENM", gkFuncRefGet, result);
  }
  else
  {
    if( C2xIsTokenAvailable(packetHandle, "DENM", newPath) )
    {
      C2xRemoveToken(packetHandle, "DENM", newPath);
    }
  }

  snprintf(newPath, elcount(newPath), "%s.%s", oldPath, "verticalObjectDimension");
  if(value.verticalObjectDimension.isValidFlag==1)
  {
    SetDENMObjectDimensionParams(packetHandle, value.verticalObjectDimension, newPath);
    result = CheckLastError("DENM", gkFuncRefGet, result);
  }
  else
  {
    if( C2xIsTokenAvailable(packetHandle, "DENM", newPath) )
    {
      C2xRemoveToken(packetHandle, "DENM", newPath);
    }
  }

  snprintf(newPath, elcount(newPath), "%s.%s", oldPath, "objectRefPoint");
  if(value.objectRefPoint.isValidFlag==1)
  {
    C2xSetTokenInt(packetHandle, "DENM", newPath, value.objectRefPoint.value);
    result = CheckLastError("DENM", gkFuncRefGet, result);
  }
  else
  {
    if( C2xIsTokenAvailable(packetHandle, "DENM", newPath) )
    {
      C2xRemoveToken(packetHandle, "DENM", newPath);
    }
  }

  snprintf(newPath, elcount(newPath), "%s.%s", oldPath, "dynamicStatus");
  if(value.dynamicStatus.isValidFlag==1)
  {
    C2xSetTokenInt(packetHandle, "DENM", newPath, value.dynamicStatus.value);
    result = CheckLastError("DENM", gkFuncRefGet, result);
  }
  else
  {
    if( C2xIsTokenAvailable(packetHandle, "DENM", newPath) )
    {
      C2xRemoveToken(packetHandle, "DENM", newPath);
    }
  }

  snprintf(newPath, elcount(newPath), "%s.%s", oldPath, "classification");
  if(value.classification.isValidFlag==1)
  {
    SetDENMObjectClassDescriptionParams(packetHandle, value.classification, newPath);
    result = CheckLastError("DENM", gkFuncRefGet, result);
  }
  else
  {
    if( C2xIsTokenAvailable(packetHandle, "DENM", newPath) )
    {
      C2xRemoveToken(packetHandle, "DENM", newPath);
    }
  }

  snprintf(newPath, elcount(newPath), "%s.%s", oldPath, "matchedPosition");
  if(value.matchedPosition.isValidFlag==1)
  {
    SetDENMMatchedPositionParams(packetHandle, value.matchedPosition, newPath);
    result = CheckLastError("DENM", gkFuncRefGet, result);
  }
  else
  {
    if( C2xIsTokenAvailable(packetHandle, "DENM", newPath) )
    {
      C2xRemoveToken(packetHandle, "DENM", newPath);
    }
  }

  return result;
}

int GetDENMWGS84AngleParams(LONG packetHandle, struct DENMWGS84Angle value, char oldPath[])
{
  char newPath[300];
  int result;

  result = 0;

  snprintf(newPath, elcount(newPath), "%s.%s", oldPath, "value");
  value.value = C2xGetTokenInt(packetHandle, "DENM", newPath);
  result = CheckLastError("DENM", gkFuncRefGet, result);

  snprintf(newPath, elcount(newPath), "%s.%s", oldPath, "confidence");
  value.confidence = C2xGetTokenInt(packetHandle, "DENM", newPath);
  result = CheckLastError("DENM", gkFuncRefGet, result);

  return result;
}

int SetDENMWGS84AngleParams(LONG packetHandle, struct DENMWGS84Angle value, char oldPath[])
{
  char newPath[300];
  int result;

  result = 0;

  snprintf(newPath, elcount(newPath), "%s.%s", oldPath, "value");
  C2xSetTokenInt(packetHandle, "DENM", newPath, value.value);
  result = CheckLastError("DENM", gkFuncRefGet, result);

  snprintf(newPath, elcount(newPath), "%s.%s", oldPath, "confidence");
  if (value.confidence < 1)
  {
    C2xSetTokenInt(packetHandle, "DENM", newPath, 1);
  }
  else if (value.confidence > 127)
  {
    C2xSetTokenInt(packetHandle, "DENM", newPath, 127);
  }
  else
  {
    C2xSetTokenInt(packetHandle, "DENM", newPath, value.confidence);
  }
  result = CheckLastError("DENM", gkFuncRefGet, result);

  return result;
}

int GetDENMPreCrashContainerParams(LONG packetHandle, struct DENMPreCrashContainer value, char oldPath[])
{
  char newPath[300];
  int result;

  result = 0;

  snprintf(newPath, elcount(newPath), "%s.%s", oldPath, "perceivedObject");
  GetDENMPerceivedObjectParams(packetHandle, value.perceivedObject, newPath);
  result = CheckLastError("DENM", gkFuncRefGet, result);

  snprintf(newPath, elcount(newPath), "%s.%s", oldPath, "objectStationId");
  value.objectStationId.isValidFlag = C2xIsTokenAvailable(packetHandle, "DENM", newPath);
  if(value.objectStationId.isValidFlag==1)
  {
    value.objectStationId.value = C2xGetTokenInt64(packetHandle, "DENM", newPath);
    result = CheckLastError("DENM", gkFuncRefGet, result);
  }
  snprintf(newPath, elcount(newPath), "%s.%s", oldPath, "timeToCollision");
  value.timeToCollision.isValidFlag = C2xIsTokenAvailable(packetHandle, "DENM", newPath);
  if(value.timeToCollision.isValidFlag==1)
  {
    value.timeToCollision.value = C2xGetTokenInt(packetHandle, "DENM", newPath);
    result = CheckLastError("DENM", gkFuncRefGet, result);
  }
  snprintf(newPath, elcount(newPath), "%s.%s", oldPath, "impactSection");
  value.impactSection.isValidFlag = C2xIsTokenAvailable(packetHandle, "DENM", newPath);
  if(value.impactSection.isValidFlag==1)
  {
    value.impactSection.value = C2xGetTokenInt(packetHandle, "DENM", newPath);
    result = CheckLastError("DENM", gkFuncRefGet, result);
  }
  snprintf(newPath, elcount(newPath), "%s.%s", oldPath, "hostVehicleOrientation");
  GetDENMWGS84AngleParams(packetHandle, value.hostVehicleOrientation, newPath);
  result = CheckLastError("DENM", gkFuncRefGet, result);

  return result;
}

int SetDENMPreCrashContainerParams(LONG packetHandle, struct DENMPreCrashContainer value, char oldPath[])
{
  char newPath[300];
  int result;

  result = 0;

  snprintf(newPath, elcount(newPath), "%s.%s", oldPath, "perceivedObject");
  SetDENMPerceivedObjectParams(packetHandle, value.perceivedObject, newPath);
  result = CheckLastError("DENM", gkFuncRefGet, result);

  snprintf(newPath, elcount(newPath), "%s.%s", oldPath, "objectStationId");
  if(value.objectStationId.isValidFlag==1)
  {
    C2xSetTokenInt64(packetHandle, "DENM", newPath, value.objectStationId.value);
    result = CheckLastError("DENM", gkFuncRefGet, result);
  }
  else
  {
    if( C2xIsTokenAvailable(packetHandle, "DENM", newPath) )
    {
      C2xRemoveToken(packetHandle, "DENM", newPath);
    }
  }

  snprintf(newPath, elcount(newPath), "%s.%s", oldPath, "timeToCollision");
  if(value.timeToCollision.isValidFlag==1)
  {
    if (value.timeToCollision.value < 1)
    {
        C2xSetTokenInt(packetHandle, "DENM", newPath, 1);
    }
    else if (value.timeToCollision.value > 10000)
    {
        C2xSetTokenInt(packetHandle, "DENM", newPath, 10000);
    }
    else
    {
        C2xSetTokenInt(packetHandle, "DENM", newPath, value.timeToCollision.value);
    }
    result = CheckLastError("DENM", gkFuncRefGet, result);
  }
  else
  {
    if( C2xIsTokenAvailable(packetHandle, "DENM", newPath) )
    {
      C2xRemoveToken(packetHandle, "DENM", newPath);
    }
  }

  snprintf(newPath, elcount(newPath), "%s.%s", oldPath, "impactSection");
  if(value.impactSection.isValidFlag==1)
  {
    C2xSetTokenInt(packetHandle, "DENM", newPath, value.impactSection.value);
    result = CheckLastError("DENM", gkFuncRefGet, result);
  }
  else
  {
    if( C2xIsTokenAvailable(packetHandle, "DENM", newPath) )
    {
      C2xRemoveToken(packetHandle, "DENM", newPath);
    }
  }

  snprintf(newPath, elcount(newPath), "%s.%s", oldPath, "hostVehicleOrientation");
  SetDENMWGS84AngleParams(packetHandle, value.hostVehicleOrientation, newPath);
  result = CheckLastError("DENM", gkFuncRefGet, result);

  return result;
}

int GetDENMAlacarteContainerParams(LONG packetHandle, struct DENMAlacarteContainer value, char oldPath[])
{
  char newPath[300];
  int result;

  result = 0;

  snprintf(newPath, elcount(newPath), "%s.%s", oldPath, "lanePosition");
  value.lanePosition.isValidFlag = C2xIsTokenAvailable(packetHandle, "DENM", newPath);
  if(value.lanePosition.isValidFlag==1)
  {
    value.lanePosition.value = C2xGetTokenInt(packetHandle, "DENM", newPath);
    result = CheckLastError("DENM", gkFuncRefGet, result);
  }
  snprintf(newPath, elcount(newPath), "%s.%s", oldPath, "impactReduction");
  value.impactReduction.isValidFlag = C2xIsTokenAvailable(packetHandle, "DENM", newPath);
  if(value.impactReduction.isValidFlag==1)
  {
    GetDENMImpactReductionContainerParams(packetHandle, value.impactReduction, newPath);
    result = CheckLastError("DENM", gkFuncRefGet, result);
  }
  snprintf(newPath, elcount(newPath), "%s.%s", oldPath, "externalTemperature");
  value.externalTemperature.isValidFlag = C2xIsTokenAvailable(packetHandle, "DENM", newPath);
  if(value.externalTemperature.isValidFlag==1)
  {
    value.externalTemperature.value = C2xGetTokenInt(packetHandle, "DENM", newPath);
    result = CheckLastError("DENM", gkFuncRefGet, result);
  }
  snprintf(newPath, elcount(newPath), "%s.%s", oldPath, "roadWorks");
  value.roadWorks.isValidFlag = C2xIsTokenAvailable(packetHandle, "DENM", newPath);
  if(value.roadWorks.isValidFlag==1)
  {
    GetDENMRoadWorksContainerExtendedParams(packetHandle, value.roadWorks, newPath);
    result = CheckLastError("DENM", gkFuncRefGet, result);
  }
  snprintf(newPath, elcount(newPath), "%s.%s", oldPath, "positioningSolution");
  value.positioningSolution.isValidFlag = C2xIsTokenAvailable(packetHandle, "DENM", newPath);
  if(value.positioningSolution.isValidFlag==1)
  {
    value.positioningSolution.value = C2xGetTokenInt(packetHandle, "DENM", newPath);
    result = CheckLastError("DENM", gkFuncRefGet, result);
  }
  snprintf(newPath, elcount(newPath), "%s.%s", oldPath, "stationaryVehicle");
  value.stationaryVehicle.isValidFlag = C2xIsTokenAvailable(packetHandle, "DENM", newPath);
  if(value.stationaryVehicle.isValidFlag==1)
  {
    GetDENMStationaryVehicleContainerParams(packetHandle, value.stationaryVehicle, newPath);
    result = CheckLastError("DENM", gkFuncRefGet, result);
  }
  snprintf(newPath, elcount(newPath), "%s.%s", oldPath, "preCrashContainer");
  value.preCrashContainer.isValidFlag = C2xIsTokenAvailable(packetHandle, "DENM", newPath);
  if(value.preCrashContainer.isValidFlag==1)
  {
    GetDENMPreCrashContainerParams(packetHandle, value.preCrashContainer, newPath);
    result = CheckLastError("DENM", gkFuncRefGet, result);
  }
  return result;
}

int SetDENMAlacarteContainerParams(LONG packetHandle, struct DENMAlacarteContainer value, char oldPath[])
{
  char newPath[300];
  int result;

  result = 0;

  snprintf(newPath, elcount(newPath), "%s.%s", oldPath, "lanePosition");
  if(value.lanePosition.isValidFlag==1)
  {
    C2xSetTokenInt(packetHandle, "DENM", newPath, value.lanePosition.value);
    result = CheckLastError("DENM", gkFuncRefGet, result);
  }
  else
  {
    if( C2xIsTokenAvailable(packetHandle, "DENM", newPath) )
    {
      C2xRemoveToken(packetHandle, "DENM", newPath);
    }
  }

  snprintf(newPath, elcount(newPath), "%s.%s", oldPath, "impactReduction");
  if(value.impactReduction.isValidFlag==1)
  {
    SetDENMImpactReductionContainerParams(packetHandle, value.impactReduction, newPath);
    result = CheckLastError("DENM", gkFuncRefGet, result);
  }
  else
  {
    if( C2xIsTokenAvailable(packetHandle, "DENM", newPath) )
    {
      C2xRemoveToken(packetHandle, "DENM", newPath);
    }
  }

  snprintf(newPath, elcount(newPath), "%s.%s", oldPath, "externalTemperature");
  if(value.externalTemperature.isValidFlag==1)
  {
    C2xSetTokenInt(packetHandle, "DENM", newPath, value.externalTemperature.value);
    result = CheckLastError("DENM", gkFuncRefGet, result);
  }
  else
  {
    if( C2xIsTokenAvailable(packetHandle, "DENM", newPath) )
    {
      C2xRemoveToken(packetHandle, "DENM", newPath);
    }
  }

  snprintf(newPath, elcount(newPath), "%s.%s", oldPath, "roadWorks");
  if(value.roadWorks.isValidFlag==1)
  {
    SetDENMRoadWorksContainerExtendedParams(packetHandle, value.roadWorks, newPath);
    result = CheckLastError("DENM", gkFuncRefGet, result);
  }
  else
  {
    if( C2xIsTokenAvailable(packetHandle, "DENM", newPath) )
    {
      C2xRemoveToken(packetHandle, "DENM", newPath);
    }
  }

  snprintf(newPath, elcount(newPath), "%s.%s", oldPath, "positioningSolution");
  if(value.positioningSolution.isValidFlag==1)
  {
    C2xSetTokenInt(packetHandle, "DENM", newPath, value.positioningSolution.value);
    result = CheckLastError("DENM", gkFuncRefGet, result);
  }
  else
  {
    if( C2xIsTokenAvailable(packetHandle, "DENM", newPath) )
    {
      C2xRemoveToken(packetHandle, "DENM", newPath);
    }
  }

  snprintf(newPath, elcount(newPath), "%s.%s", oldPath, "stationaryVehicle");
  if(value.stationaryVehicle.isValidFlag==1)
  {
    SetDENMStationaryVehicleContainerParams(packetHandle, value.stationaryVehicle, newPath);
    result = CheckLastError("DENM", gkFuncRefGet, result);
  }
  else
  {
    if( C2xIsTokenAvailable(packetHandle, "DENM", newPath) )
    {
      C2xRemoveToken(packetHandle, "DENM", newPath);
    }
  }

  snprintf(newPath, elcount(newPath), "%s.%s", oldPath, "preCrashContainer");
  if(value.preCrashContainer.isValidFlag==1)
  {
    SetDENMPreCrashContainerParams(packetHandle, value.preCrashContainer, newPath);
    result = CheckLastError("DENM", gkFuncRefGet, result);
  }
  else
  {
    if( C2xIsTokenAvailable(packetHandle, "DENM", newPath) )
    {
      C2xRemoveToken(packetHandle, "DENM", newPath);
    }
  }

  return result;
}

int GetDENMDecentralizedEnvironmentalNotificationMessageParams(LONG packetHandle, struct DENMDecentralizedEnvironmentalNotificationMessage value, char oldPath[])
{
  char newPath[300];
  int result;

  result = 0;

  snprintf(newPath, elcount(newPath), "%s.%s", oldPath, "management");
  GetDENMManagementContainerParams(packetHandle, value.management, newPath);
  result = CheckLastError("DENM", gkFuncRefGet, result);

  snprintf(newPath, elcount(newPath), "%s.%s", oldPath, "situation");
  value.situation.isValidFlag = C2xIsTokenAvailable(packetHandle, "DENM", newPath);
  if(value.situation.isValidFlag==1)
  {
    GetDENMSituationContainerParams(packetHandle, value.situation, newPath);
    result = CheckLastError("DENM", gkFuncRefGet, result);
  }
  snprintf(newPath, elcount(newPath), "%s.%s", oldPath, "location");
  value.location.isValidFlag = C2xIsTokenAvailable(packetHandle, "DENM", newPath);
  if(value.location.isValidFlag==1)
  {
    GetDENMLocationContainerParams(packetHandle, value.location, newPath);
    result = CheckLastError("DENM", gkFuncRefGet, result);
  }
  snprintf(newPath, elcount(newPath), "%s.%s", oldPath, "alacarte");
  value.alacarte.isValidFlag = C2xIsTokenAvailable(packetHandle, "DENM", newPath);
  if(value.alacarte.isValidFlag==1)
  {
    GetDENMAlacarteContainerParams(packetHandle, value.alacarte, newPath);
    result = CheckLastError("DENM", gkFuncRefGet, result);
  }
  return result;
}

int SetDENMDecentralizedEnvironmentalNotificationMessageParams(LONG packetHandle, struct DENMDecentralizedEnvironmentalNotificationMessage value, char oldPath[])
{
  char newPath[300];
  int result;

  result = 0;

  snprintf(newPath, elcount(newPath), "%s.%s", oldPath, "management");
  SetDENMManagementContainerParams(packetHandle, value.management, newPath);
  result = CheckLastError("DENM", gkFuncRefGet, result);

  snprintf(newPath, elcount(newPath), "%s.%s", oldPath, "situation");
  if(value.situation.isValidFlag==1)
  {
    SetDENMSituationContainerParams(packetHandle, value.situation, newPath);
    result = CheckLastError("DENM", gkFuncRefGet, result);
  }
  else
  {
    if( C2xIsTokenAvailable(packetHandle, "DENM", newPath) )
    {
      C2xRemoveToken(packetHandle, "DENM", newPath);
    }
  }

  snprintf(newPath, elcount(newPath), "%s.%s", oldPath, "location");
  if(value.location.isValidFlag==1)
  {
    SetDENMLocationContainerParams(packetHandle, value.location, newPath);
    result = CheckLastError("DENM", gkFuncRefGet, result);
  }
  else
  {
    if( C2xIsTokenAvailable(packetHandle, "DENM", newPath) )
    {
      C2xRemoveToken(packetHandle, "DENM", newPath);
    }
  }

  snprintf(newPath, elcount(newPath), "%s.%s", oldPath, "alacarte");
  if(value.alacarte.isValidFlag==1)
  {
    SetDENMAlacarteContainerParams(packetHandle, value.alacarte, newPath);
    result = CheckLastError("DENM", gkFuncRefGet, result);
  }
  else
  {
    if( C2xIsTokenAvailable(packetHandle, "DENM", newPath) )
    {
      C2xRemoveToken(packetHandle, "DENM", newPath);
    }
  }

  return result;
}

int API_GetDENMParams(LONG packetHandle, struct DENM value)
{
  int result;
  result = 0;

  value.header.isValidFlag = 1;
  GetDENMItsPduHeaderParams(packetHandle, value.header, "header");
  result = CheckLastError("DENM", gkFuncRefGet, result);

  value.denm.isValidFlag = 1;
  GetDENMDecentralizedEnvironmentalNotificationMessageParams(packetHandle, value.denm, "denm");
  result = CheckLastError("DENM", gkFuncRefGet, result);

  return result;
}

int API_SetDENMParams(LONG packetHandle, struct DENM value)
{
  int result;
  result = 0;

  SetDENMItsPduHeaderParams(packetHandle, value.header, "header");
  result = CheckLastError("DENM", gkFuncRefGet, result);

  SetDENMDecentralizedEnvironmentalNotificationMessageParams(packetHandle, value.denm, "denm");
  result = CheckLastError("DENM", gkFuncRefGet, result);

  return result;
}

