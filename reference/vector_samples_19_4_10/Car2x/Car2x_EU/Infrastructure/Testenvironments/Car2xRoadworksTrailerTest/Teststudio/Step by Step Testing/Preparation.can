/*@!Encoding:1252*/
includes
{
}

variables
{
  char testerName[11] = "DuT";
}

export ConfigurePathHistory()
{
  if (@EventInformation::ConnectPathHistory == 0)
  {
    @EventInformation::ConnectPathHistory = 1;
  }
  else
  {
    @EventInformation::ConnectPathHistory = 0;
  }
}



export TC_TestWaitForMessage()
{
  long result;
  result = C2xTestWaitForMessage("DENM", testerName, 10000);
  if(result == 1)
  {
    testStepPass("DENM expected, and DENM received");
  }
  else
  {
    TestWaitForMessageBox("No DENM is sent by node DuT. Test is stopped. Please retry.", 10000);
    testStepFail("DENM expected, but no DENM received");
  }
}

export TC_RequestCertificate()
{
  @CertificateRequest::requestCertificate = 1;
  
  if (TestWaitForSignalMatch(sysvar::CertificateRequest::receivedCertificate, 1, 5000) == 1)
  {
    if (TestWaitForSignalMatch(sysvar::CertificateRequest::receivedCertificate, 2, 10000) == 1)
    {
      testStepPass("Certificate requested and certificate received.");
    }
    else
    {
      testStepFail("Certificate requested, but no certificate received.");
    }
  }
  else
  {
    testStepFail("Certificate couldn't be requested, something went wrong.");
  }
}

export ConfigureMapPosition()
{
  SetMapPosition(@EventInformation::EventLatitude, @EventInformation::EventLongitude);
}
