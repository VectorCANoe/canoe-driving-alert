/*@!Encoding:1252*/
includes
{
  #include "..\DataSources_Templates\ASNV_Template_BaseDatatypes.cin"
  #include "..\DataSources_Templates\ASNV_Template_MAP.cin"
  #include "..\DataSources_Templates\ASNV_Template_SPAT.cin"

  #include "Car2xAPI.cin"
  #include "TL.cin"
}

variables
{
  byte gFirstMap = 1;
  byte gFirstSpat = 1;
  msTimer holdTimer;
}

on start
{
  C2xRegisterCallback(kPreTxIndication, "OnTxMAP" , "MAP" ) ;
  C2xRegisterCallback(kPreTxIndication, "OnTxSPAT", "SPAT") ;
}

on sysvar_update SSEM_Simulation::Status
{
  // Extend Green Phase for Public Transport if Status is granted
  if(@SSEM_Simulation::Status == 4) 
  {
    @RSU_TrafficLight::HoldGreenForPublicTransport = 1;
    setTimer(holdTimer, 10000);
  }
}

// Stop extended Green Phase
on timer holdTimer
{
  @RSU_TrafficLight::HoldGreenForPublicTransport = 0;
}

//ReInit MAP / SPAT on Scenario Restart
void OnScenarioStateChanged(long newState)
{
  if(newState == 3) // Completed
  {
    gFirstMap = 1;
    gFirstSpat = 1;
  }
}

// Callback function before sending MAP messages
void OnTxMAP(long packet)
{
  struct MAP mapPdu ;

  if (gFirstMap)
  {
    gFirstMap = 0 ;
    MapInit(packet, mapPdu) ;
    API_SetMAPParams(packet, mapPdu) ;
  }
  else
  {
    // nothing
  }

  C2xSetTokenInt64(packet, "geo_bh", "version", 1);
  C2xSetTokenInt64(packet, "geo_eh", "lpvTimeStamp", C2xConvertTimeToMSSinceUTC(C2xGetITSTimestamp(), 0));
}

// Callback function before sending SPAT messages
void OnTxSPAT(long packet)
{
  struct SPAT spatPdu ;

  if (gFirstSpat)
  {
    gFirstSpat = 0 ;
    SpatInit(packet, spatPdu) ;
  }
  else
  {
    API_GetSPATParams(packet, spatPdu) ;
  }
  
  //Don't update SPAT if extended Green Phase for Public Transport is active
  if(!(spatPdu.spat.intersections.arrayValue[0].states.arrayValue[4].state_time_speed.arrayValue[0].eventState == 5 && 
      @RSU_TrafficLight::HoldGreenForPublicTransport == 1))
  {
    UpdateSpat(spatPdu, 5, 0, signalGroup_1);
  }
  
  API_SetSPATParams(packet, spatPdu) ;

  C2xSetTokenInt64(packet, "geo_bh", "version", 1);
}
