/*@!Encoding:1252*/
/*
//  (c) Vector Informatik GmbH. All rights reserved.
//
//  This file contains definitions of structs and methods that may be used
//  to set and get the values of an ASN.1 defined packet's payload.
//
//  //This example demonstrates how to set a packet's payload:
//  LONG packetHandle;
//  struct CPM payload;
//  //you need to set the values of the variable "payload" yourself
//  packetHandle = API_InitCPMPacket();
//  if (packetHandle!=0) {
//    if (API_SetCPMParams(packetHandle, payload)==0) {
//      if (C2xCompletePacket(packetHandle)==0) {
//        C2xOutputPacket(packetHandle);
//      }
//    }
//  }
//                                                                             */
includes
{

}
variables
{
    struct CPMItsPduHeader {
        INT isValidFlag;   // necessary if this struct is used as an optional field of a SEQUENCE
        BYTE protocolVersion;  // INTEGER, 0..255;
        BYTE messageID;  // INTEGER, 0..255, denm(1), cam(2), poi(3), spatem(4), mapem(5), ivim(6), ev_rsr(7), tistpgtransaction(8), srem(9), ssem(10), evcsn(11), saem(12), rtcmem(13), cpm(14), imzm(15), vam(16), dsm(17), pcim(18), pcvm(19), mcm(20), pam(21);
        DWORD stationID;  // INTEGER, 0..4294967295;
    };
    
    struct CPMPosConfidenceEllipse {
        INT isValidFlag;   // necessary if this struct is used as an optional field of a SEQUENCE
        WORD semiMajorConfidence;  // INTEGER, 0..4095, doNotUse(0), outOfRange(4094), unavailable(4095);
        WORD semiMinorConfidence;  // INTEGER, 0..4095, doNotUse(0), outOfRange(4094), unavailable(4095);
        WORD semiMajorOrientation;  // INTEGER, 0..3601, wgs84North(0), wgs84East(900), wgs84South(1800), wgs84West(2700), doNotUse(3600), unavailable(3601);
    };
    
    struct CPMAltitude {
        INT isValidFlag;   // necessary if this struct is used as an optional field of a SEQUENCE
        LONG altitudeValue;  // INTEGER, -100000..800001, negativeOutOfRange(-100000), postiveOutOfRange(800000), unavailable(800001);
        INT altitudeConfidence;  // ENUMERATED, alt_000_01(0), alt_000_02(1), alt_000_05(2), alt_000_10(3), alt_000_20(4), alt_000_50(5), alt_001_00(6), alt_002_00(7), alt_005_00(8), alt_010_00(9), alt_020_00(10), alt_050_00(11), alt_100_00(12), alt_200_00(13), outOfRange(14), unavailable(15);
    };
    
    struct CPMReferencePosition {
        INT isValidFlag;   // necessary if this struct is used as an optional field of a SEQUENCE
        LONG latitude;  // INTEGER, -900000000..900000001, unavailable(900000001);
        LONG longitude;  // INTEGER, -1800000000..1800000001, valueNotUsed(-1800000000), unavailable(1800000001);
        struct CPMPosConfidenceEllipse positionConfidenceEllipse;  // SEQUENCE;
        struct CPMAltitude altitude;  // SEQUENCE;
    };
    
    struct CPMMessageSegmentationInfo {
        INT isValidFlag;   // necessary if this struct is used as an optional field of a SEQUENCE
        BYTE totalMsgNo;  // INTEGER, 1..8;
        BYTE thisMsgNo;  // INTEGER, 1..8;
    };
    
    struct CPMMessageRateHz {
        INT isValidFlag;   // necessary if this struct is used as an optional field of a SEQUENCE
        BYTE mantissa;  // INTEGER, 1..100;
        INT exponent;  // INTEGER, -5..2;
    };
    
    struct CPMMessageRateRange {
        INT isValidFlag;   // necessary if this struct is used as an optional field of a SEQUENCE
        struct CPMMessageRateHz messageRateMin;  // SEQUENCE;
        struct CPMMessageRateHz messageRateMax;  // SEQUENCE;
    };
    
    struct CPMManagementContainer {
        INT isValidFlag;   // necessary if this struct is used as an optional field of a SEQUENCE
        QWORD referenceTime;  // INTEGER, 0..4398046511103;
        struct CPMReferencePosition referencePosition;  // SEQUENCE;
        struct CPMMessageSegmentationInfo segmentationInfo;  // SEQUENCE, OPTIONAL;
        struct CPMMessageRateRange messageRateRange;  // SEQUENCE, OPTIONAL;
    };
    
    struct CPMWgs84Angle {
        INT isValidFlag;   // necessary if this struct is used as an optional field of a SEQUENCE
        WORD value;  // INTEGER, 0..3601, wgs84North(0), wgs84East(900), wgs84South(1800), wgs84West(2700), doNotUse(3600), unavailable(3601);
        BYTE confidence;  // INTEGER, 1..127, outOfRange(126), unavailable(127);
    };
    
    struct CPMCartesianAngle {
        INT isValidFlag;   // necessary if this struct is used as an optional field of a SEQUENCE
        WORD value;  // INTEGER, 0..3601, valueNotUsed(3600), unavailable(3601);
        BYTE confidence;  // INTEGER, 1..127, outOfRange(126), unavailable(127);
    };
    
    struct CPMTrailerData {
        INT isValidFlag;   // necessary if this struct is used as an optional field of a SEQUENCE
        BYTE refPointId;  // INTEGER, 0..255;
        BYTE hitchPointOffset;  // INTEGER, 0..255;
        struct CPMCartesianAngle hitchAngle;  // SEQUENCE;
    };
    
    struct CPMTrailerDataSet {
        INT isValidFlag;   // necessary if this struct is used as an optional field of a SEQUENCE
        INT length;
        struct CPMTrailerData arrayValue[8];  // SEQUENCE;
    };
    
    struct CPMOriginatingVehicleContainer {
        INT isValidFlag;   // necessary if this struct is used as an optional field of a SEQUENCE
        struct CPMWgs84Angle orientationAngle;  // SEQUENCE;
        struct CPMCartesianAngle pitchAngle;  // SEQUENCE, OPTIONAL;
        struct CPMCartesianAngle rollAngle;  // SEQUENCE, OPTIONAL;
        struct CPMTrailerDataSet trailerDataSet;  // SEQUENCEOF, OPTIONAL;
    };
    
    struct CPMRoadSegmentReferenceId {
        INT isValidFlag;   // necessary if this struct is used as an optional field of a SEQUENCE
        struct OPT_WORD_ASN region;  // INTEGER, OPTIONAL, 0..65535;
        WORD id;  // INTEGER, 0..65535;
    };
    
    struct CPMIntersectionReferenceId {
        INT isValidFlag;   // necessary if this struct is used as an optional field of a SEQUENCE
        struct OPT_WORD_ASN region;  // INTEGER, OPTIONAL, 0..65535;
        WORD id;  // INTEGER, 0..65535;
    };
    
    struct CPMMapReference {
        INT isValidFlag;   // necessary if this struct is used as an optional field of a SEQUENCE
        INT choice;
        struct CPMRoadSegmentReferenceId roadsegment;  // SEQUENCE;
        struct CPMIntersectionReferenceId intersection;  // SEQUENCE;
    };
    
    struct CPMOriginatingRsuContainer {
        INT isValidFlag;   // necessary if this struct is used as an optional field of a SEQUENCE
        struct CPMMapReference mapReference;  // CHOICE, OPTIONAL;
    };
    
    struct CPMCartesianPosition3d {
        INT isValidFlag;   // necessary if this struct is used as an optional field of a SEQUENCE
        INT xCoordinate;  // INTEGER, -32768..32767, negativeOutOfRange(-32768), positiveOutOfRange(32767);
        INT yCoordinate;  // INTEGER, -32768..32767, negativeOutOfRange(-32768), positiveOutOfRange(32767);
        struct OPT_INT_ASN zCoordinate;  // INTEGER, OPTIONAL, -32768..32767, negativeOutOfRange(-32768), positiveOutOfRange(32767);
    };
    
    struct CPMRectangularShape {
        INT isValidFlag;   // necessary if this struct is used as an optional field of a SEQUENCE
        struct CPMCartesianPosition3d centerPoint;  // SEQUENCE, OPTIONAL;
        WORD semiLength;  // INTEGER, 0..4095;
        WORD semiBreadth;  // INTEGER, 0..4095;
        struct OPT_WORD_ASN orientation;  // INTEGER, OPTIONAL, 0..3601, wgs84North(0), wgs84East(900), wgs84South(1800), wgs84West(2700), doNotUse(3600), unavailable(3601);
        struct OPT_WORD_ASN height;  // INTEGER, OPTIONAL, 0..4095;
    };
    
    struct CPMCircularShape {
        INT isValidFlag;   // necessary if this struct is used as an optional field of a SEQUENCE
        struct CPMCartesianPosition3d shapeReferencePoint;  // SEQUENCE, OPTIONAL;
        WORD radius;  // INTEGER, 0..4095;
        struct OPT_WORD_ASN height;  // INTEGER, OPTIONAL, 0..4095;
    };
    
    struct CPMSequenceOfCartesianPosition3d_3_16_ext {
        INT isValidFlag;   // necessary if this struct is used as an optional field of a SEQUENCE
        INT length;
        struct CPMCartesianPosition3d arrayValue[16];  // SEQUENCE;
    };
    
    struct CPMPolygonalShape {
        INT isValidFlag;   // necessary if this struct is used as an optional field of a SEQUENCE
        struct CPMCartesianPosition3d shapeReferencePoint;  // SEQUENCE, OPTIONAL;
        struct CPMSequenceOfCartesianPosition3d_3_16_ext polygon;  // SEQUENCEOF;
        struct OPT_WORD_ASN height;  // INTEGER, OPTIONAL, 0..4095;
    };
    
    struct CPMEllipticalShape {
        INT isValidFlag;   // necessary if this struct is used as an optional field of a SEQUENCE
        struct CPMCartesianPosition3d shapeReferencePoint;  // SEQUENCE, OPTIONAL;
        WORD semiMajorAxisLength;  // INTEGER, 0..4095;
        WORD semiMinorAxisLength;  // INTEGER, 0..4095;
        struct OPT_WORD_ASN orientation;  // INTEGER, OPTIONAL, 0..3601, wgs84North(0), wgs84East(900), wgs84South(1800), wgs84West(2700), doNotUse(3600), unavailable(3601);
        struct OPT_WORD_ASN height;  // INTEGER, OPTIONAL, 0..4095;
    };
    
    struct CPMRadialShape {
        INT isValidFlag;   // necessary if this struct is used as an optional field of a SEQUENCE
        struct CPMCartesianPosition3d shapeReferencePoint;  // SEQUENCE, OPTIONAL;
        WORD range;  // INTEGER, 0..4095;
        WORD stationaryHorizontalOpeningAngleStart;  // INTEGER, 0..3601, wgs84North(0), wgs84East(900), wgs84South(1800), wgs84West(2700), doNotUse(3600), unavailable(3601);
        WORD stationaryHorizontalOpeningAngleEnd;  // INTEGER, 0..3601, wgs84North(0), wgs84East(900), wgs84South(1800), wgs84West(2700), doNotUse(3600), unavailable(3601);
        struct OPT_WORD_ASN verticalOpeningAngleStart;  // INTEGER, OPTIONAL, 0..3601, valueNotUsed(3600), unavailable(3601);
        struct OPT_WORD_ASN verticalOpeningAngleEnd;  // INTEGER, OPTIONAL, 0..3601, valueNotUsed(3600), unavailable(3601);
    };
    
    struct CPMRadialShapeDetails {
        INT isValidFlag;   // necessary if this struct is used as an optional field of a SEQUENCE
        WORD range;  // INTEGER, 0..4095;
        WORD horizontalOpeningAngleStart;  // INTEGER, 0..3601, valueNotUsed(3600), unavailable(3601);
        WORD horizontalOpeningAngleEnd;  // INTEGER, 0..3601, valueNotUsed(3600), unavailable(3601);
        struct OPT_WORD_ASN verticalOpeningAngleStart;  // INTEGER, OPTIONAL, 0..3601, valueNotUsed(3600), unavailable(3601);
        struct OPT_WORD_ASN verticalOpeningAngleEnd;  // INTEGER, OPTIONAL, 0..3601, valueNotUsed(3600), unavailable(3601);
    };
    
    struct CPMRadialShapesList {
        INT isValidFlag;   // necessary if this struct is used as an optional field of a SEQUENCE
        INT length;
        struct CPMRadialShapeDetails arrayValue[16];  // SEQUENCE;
    };
    
    struct CPMRadialShapes {
        INT isValidFlag;   // necessary if this struct is used as an optional field of a SEQUENCE
        BYTE refPointId;  // INTEGER, 0..255;
        INT xCoordinate;  // INTEGER, -3094..1001, negativeOutOfRange(-3094), positiveOutOfRange(1001);
        INT yCoordinate;  // INTEGER, -3094..1001, negativeOutOfRange(-3094), positiveOutOfRange(1001);
        struct OPT_INT_ASN zCoordinate;  // INTEGER, OPTIONAL, -3094..1001, negativeOutOfRange(-3094), positiveOutOfRange(1001);
        struct CPMRadialShapesList radialShapesList;  // SEQUENCEOF;
    };
    
    struct CPMShape {
        INT isValidFlag;   // necessary if this struct is used as an optional field of a SEQUENCE
        INT choice;
        struct CPMRectangularShape rectangular;  // SEQUENCE;
        struct CPMCircularShape circular;  // SEQUENCE;
        struct CPMPolygonalShape polygonal;  // SEQUENCE;
        struct CPMEllipticalShape elliptical;  // SEQUENCE;
        struct CPMRadialShape radial;  // SEQUENCE;
        struct CPMRadialShapes radialShapes;  // SEQUENCE;
    };
    
    struct CPMSensorInformation {
        INT isValidFlag;   // necessary if this struct is used as an optional field of a SEQUENCE
        BYTE sensorId;  // INTEGER, 0..255;
        BYTE sensorType;  // INTEGER, 0..31, undefined(0), radar(1), lidar(2), monovideo(3), stereovision(4), nightvision(5), ultrasonic(6), pmd(7), inductionLoop(8), sphericalCamera(9), uwb(10), acoustic(11), localAggregation(12), itsAggregation(13);
        struct CPMShape perceptionRegionShape;  // CHOICE, OPTIONAL;
        struct OPT_BYTE_ASN perceptionRegionConfidence;  // INTEGER, OPTIONAL, 1..101, unavailable(101);
        INT shadowingApplies;  // BOOLEAN;
    };
    
    struct CPMSensorInformationContainer {
        INT isValidFlag;   // necessary if this struct is used as an optional field of a SEQUENCE
        INT length;
        struct CPMSensorInformation arrayValue[128];  // SEQUENCE;
    };
    
    struct CPMSequenceOfIdentifier1B {
        INT isValidFlag;   // necessary if this struct is used as an optional field of a SEQUENCE
        INT length;
        BYTE arrayValue[128];  // INTEGER, 0..255;
    };
    
    struct CPMPerceivedObjectIds {
        INT isValidFlag;   // necessary if this struct is used as an optional field of a SEQUENCE
        INT length;
        WORD arrayValue[255];  // INTEGER, 0..65535;
    };
    
    struct CPMPerceptionRegion {
        INT isValidFlag;   // necessary if this struct is used as an optional field of a SEQUENCE
        INT measurementDeltaTime;  // INTEGER, -2048..2047;
        BYTE perceptionRegionConfidence;  // INTEGER, 1..101, unavailable(101);
        struct CPMShape perceptionRegionShape;  // CHOICE;
        INT shadowingApplies;  // BOOLEAN;
        struct CPMSequenceOfIdentifier1B sensorIdList;  // SEQUENCEOF, OPTIONAL;
        struct OPT_BYTE_ASN numberOfPerceivedObjects;  // INTEGER, OPTIONAL, 0..255;
        struct CPMPerceivedObjectIds perceivedObjectIds;  // SEQUENCEOF, OPTIONAL;
    };
    
    struct CPMPerceptionRegionContainer {
        INT isValidFlag;   // necessary if this struct is used as an optional field of a SEQUENCE
        INT length;
        struct CPMPerceptionRegion arrayValue[256];  // SEQUENCE;
    };
    
    struct CPMCartesianCoordinateWithConfidence {
        INT isValidFlag;   // necessary if this struct is used as an optional field of a SEQUENCE
        LONG value;  // INTEGER, -131072..131071, negativeOutOfRange(-131072), positiveOutOfRange(131071);
        WORD confidence;  // INTEGER, 1..4096, outOfRange(4095), unavailable(4096);
    };
    
    struct CPMCartesianPosition3dWithConfidence {
        INT isValidFlag;   // necessary if this struct is used as an optional field of a SEQUENCE
        struct CPMCartesianCoordinateWithConfidence xCoordinate;  // SEQUENCE;
        struct CPMCartesianCoordinateWithConfidence yCoordinate;  // SEQUENCE;
        struct CPMCartesianCoordinateWithConfidence zCoordinate;  // SEQUENCE, OPTIONAL;
    };
    
    struct CPMSpeed {
        INT isValidFlag;   // necessary if this struct is used as an optional field of a SEQUENCE
        WORD speedValue;  // INTEGER, 0..16383, standstill(0), outOfRange(16382), unavailable(16383);
        BYTE speedConfidence;  // INTEGER, 1..127, outOfRange(126), unavailable(127);
    };
    
    struct CPMVelocityComponent {
        INT isValidFlag;   // necessary if this struct is used as an optional field of a SEQUENCE
        INT value;  // INTEGER, -16383..16383, negativeOutOfRange(-16383), positiveOutOfRange(16382), unavailable(16383);
        BYTE confidence;  // INTEGER, 1..127, outOfRange(126), unavailable(127);
    };
    
    struct CPMVelocityPolarWithZ {
        INT isValidFlag;   // necessary if this struct is used as an optional field of a SEQUENCE
        struct CPMSpeed velocityMagnitude;  // SEQUENCE;
        struct CPMCartesianAngle velocityDirection;  // SEQUENCE;
        struct CPMVelocityComponent zVelocity;  // SEQUENCE, OPTIONAL;
    };
    
    struct CPMVelocityCartesian {
        INT isValidFlag;   // necessary if this struct is used as an optional field of a SEQUENCE
        struct CPMVelocityComponent xVelocity;  // SEQUENCE;
        struct CPMVelocityComponent yVelocity;  // SEQUENCE;
        struct CPMVelocityComponent zVelocity;  // SEQUENCE, OPTIONAL;
    };
    
    struct CPMVelocity3dWithConfidence {
        INT isValidFlag;   // necessary if this struct is used as an optional field of a SEQUENCE
        INT choice;
        struct CPMVelocityPolarWithZ polarVelocity;  // SEQUENCE;
        struct CPMVelocityCartesian cartesianVelocity;  // SEQUENCE;
    };
    
    struct CPMAccelerationMagnitude {
        INT isValidFlag;   // necessary if this struct is used as an optional field of a SEQUENCE
        BYTE accelerationMagnitudeValue;  // INTEGER, 0..161, positiveOutOfRange(160), unavailable(161);
        BYTE accelerationConfidence;  // INTEGER, 0..102, outOfRange(101), unavailable(102);
    };
    
    struct CPMAccelerationComponent {
        INT isValidFlag;   // necessary if this struct is used as an optional field of a SEQUENCE
        INT value;  // INTEGER, -160..161, negativeOutOfRange(-160), positiveOutOfRange(160), unavailable(161);
        BYTE confidence;  // INTEGER, 0..102, outOfRange(101), unavailable(102);
    };
    
    struct CPMAccelerationPolarWithZ {
        INT isValidFlag;   // necessary if this struct is used as an optional field of a SEQUENCE
        struct CPMAccelerationMagnitude accelerationMagnitude;  // SEQUENCE;
        struct CPMCartesianAngle accelerationDirection;  // SEQUENCE;
        struct CPMAccelerationComponent zAcceleration;  // SEQUENCE, OPTIONAL;
    };
    
    struct CPMAccelerationCartesian {
        INT isValidFlag;   // necessary if this struct is used as an optional field of a SEQUENCE
        struct CPMAccelerationComponent xAcceleration;  // SEQUENCE;
        struct CPMAccelerationComponent yAcceleration;  // SEQUENCE;
        struct CPMAccelerationComponent zAcceleration;  // SEQUENCE, OPTIONAL;
    };
    
    struct CPMAcceleration3dWithConfidence {
        INT isValidFlag;   // necessary if this struct is used as an optional field of a SEQUENCE
        INT choice;
        struct CPMAccelerationPolarWithZ polarAcceleration;  // SEQUENCE;
        struct CPMAccelerationCartesian cartesianAcceleration;  // SEQUENCE;
    };
    
    struct CPMEulerAnglesWithConfidence {
        INT isValidFlag;   // necessary if this struct is used as an optional field of a SEQUENCE
        struct CPMCartesianAngle zAngle;  // SEQUENCE;
        struct CPMCartesianAngle yAngle;  // SEQUENCE, OPTIONAL;
        struct CPMCartesianAngle xAngle;  // SEQUENCE, OPTIONAL;
    };
    
    struct CPMCartesianAngularVelocityComponent {
        INT isValidFlag;   // necessary if this struct is used as an optional field of a SEQUENCE
        INT value;  // INTEGER, -255..256, negativeOutofRange(-255), positiveOutOfRange(255), unavailable(256);
        INT confidence;  // ENUMERATED, degSec_01(0), degSec_02(1), degSec_05(2), degSec_10(3), degSec_20(4), degSec_50(5), outOfRange(6), unavailable(7);
    };
    
    struct CPMMatrixIncludedComponents {
        INT isValidFlag;   // necessary if this struct is used as an optional field of a SEQUENCE
        CHAR string[14];
        INT  stringLength;
    };
    
    struct CPMCorrelationColumn {
        INT isValidFlag;   // necessary if this struct is used as an optional field of a SEQUENCE
        INT length;
        INT arrayValue[13];  // INTEGER, -100..101, full_negative_correlation(-100), no_correlation(0), full_positive_correlation(100), unavailable(101);
    };
    
    struct CPMLowerTriangularPositiveSemidefiniteMatrixColumns {
        INT isValidFlag;   // necessary if this struct is used as an optional field of a SEQUENCE
        INT length;
        struct CPMCorrelationColumn arrayValue[13];  // SEQUENCEOF;
    };
    
    struct CPMLowerTriangularPositiveSemidefiniteMatrix {
        INT isValidFlag;   // necessary if this struct is used as an optional field of a SEQUENCE
        struct CPMMatrixIncludedComponents componentsIncludedIntheMatrix;  // BITSTRING;
        struct CPMLowerTriangularPositiveSemidefiniteMatrixColumns matrix;  // SEQUENCEOF;
    };
    
    struct CPMLowerTriangularPositiveSemidefiniteMatrices {
        INT isValidFlag;   // necessary if this struct is used as an optional field of a SEQUENCE
        INT length;
        struct CPMLowerTriangularPositiveSemidefiniteMatrix arrayValue[4];  // SEQUENCE;
    };
    
    struct CPMObjectDimension {
        INT isValidFlag;   // necessary if this struct is used as an optional field of a SEQUENCE
        WORD value;  // INTEGER, 1..256, outOfRange(255), unavailable(256);
        BYTE confidence;  // INTEGER, 1..32, outOfRange(31), unavailable(32);
    };
    
    struct CPMVruProfileAndSubprofile {
        INT isValidFlag;   // necessary if this struct is used as an optional field of a SEQUENCE
        INT choice;
        INT pedestrian;  // ENUMERATED, unavailable(0), ordinary_pedestrian(1), road_worker(2), first_responder(3), max(15);
        INT bicyclistAndLightVruVehicle;  // ENUMERATED, unavailable(0), bicyclist(1), wheelchair_user(2), horse_and_rider(3), rollerskater(4), e_scooter(5), personal_transporter(6), pedelec(7), speed_pedelec(8), max(15);
        INT motorcyclist;  // ENUMERATED, unavailable(0), moped(1), motorcycle(2), motorcycle_and_sidecar_right(3), motorcycle_and_sidecar_left(4), max(15);
        INT animal;  // ENUMERATED, unavailable(0), wild_animal(1), farm_animal(2), service_animal(3), max(15);
    };
    
    struct CPMVruClusterProfiles {
        INT isValidFlag;   // necessary if this struct is used as an optional field of a SEQUENCE
        CHAR string[5];
        INT  stringLength;
    };
    
    struct CPMVruClusterInformation {
        INT isValidFlag;   // necessary if this struct is used as an optional field of a SEQUENCE
        struct OPT_BYTE_ASN clusterId;  // INTEGER, OPTIONAL, 0..255;
        struct CPMShape clusterBoundingBoxShape;  // CHOICE, OPTIONAL;
        BYTE clusterCardinalitySize;  // INTEGER, 0..255;
        struct CPMVruClusterProfiles clusterProfiles;  // BITSTRING, OPTIONAL;
    };
    
    struct CPMObjectClass {
        INT isValidFlag;   // necessary if this struct is used as an optional field of a SEQUENCE
        INT choice;
        BYTE vehicleSubClass;  // INTEGER, 0..14, unknown(0), passengerCar(5), bus(6), lightTruck(7), heavyTruck(8), trailer(9), specialVehicle(10), tram(11), agricultural(14);
        struct CPMVruProfileAndSubprofile vruSubClass;  // CHOICE;
        struct CPMVruClusterInformation groupSubClass;  // SEQUENCE;
        BYTE otherSubClass;  // INTEGER, 0..255, unknown(0), singleObject(1), multipleObjects(2), bulkMaterial(3);
    };
    
    struct CPMObjectClassWithConfidence {
        INT isValidFlag;   // necessary if this struct is used as an optional field of a SEQUENCE
        struct CPMObjectClass objectClass;  // CHOICE;
        BYTE confidence;  // INTEGER, 1..101, unavailable(101);
    };
    
    struct CPMObjectClassDescription {
        INT isValidFlag;   // necessary if this struct is used as an optional field of a SEQUENCE
        INT length;
        struct CPMObjectClassWithConfidence arrayValue[8];  // SEQUENCE;
    };
    
    struct CPMLongitudinalLanePosition {
        INT isValidFlag;   // necessary if this struct is used as an optional field of a SEQUENCE
        WORD longitudinalLanePositionValue;  // INTEGER, 0..32767, outOfRange(32766), unavailable(32767);
        WORD longitudinalLanePositionConfidence;  // INTEGER, 0..1023, outOfRange(1022), unavailable(1023);
    };
    
    struct CPMMapPosition {
        INT isValidFlag;   // necessary if this struct is used as an optional field of a SEQUENCE
        struct CPMMapReference mapReference;  // CHOICE, OPTIONAL;
        struct OPT_BYTE_ASN laneId;  // INTEGER, OPTIONAL, 0..255;
        struct OPT_BYTE_ASN connectionId;  // INTEGER, OPTIONAL, 0..255;
        struct CPMLongitudinalLanePosition longitudinalLanePosition;  // SEQUENCE, OPTIONAL;
    };
    
    struct CPMPerceivedObject {
        INT isValidFlag;   // necessary if this struct is used as an optional field of a SEQUENCE
        WORD objectId;  // INTEGER, 0..65535;
        INT measurementDeltaTime;  // INTEGER, -2048..2047;
        struct CPMCartesianPosition3dWithConfidence position;  // SEQUENCE;
        struct CPMVelocity3dWithConfidence velocity;  // CHOICE, OPTIONAL;
        struct CPMAcceleration3dWithConfidence acceleration;  // CHOICE, OPTIONAL;
        struct CPMEulerAnglesWithConfidence angles;  // SEQUENCE, OPTIONAL;
        struct CPMCartesianAngularVelocityComponent zAngularVelocity;  // SEQUENCE, OPTIONAL;
        struct CPMLowerTriangularPositiveSemidefiniteMatrices lowerTriangularCorrelationMatrices;  // SEQUENCEOF, OPTIONAL;
        struct CPMObjectDimension objectDimensionZ;  // SEQUENCE, OPTIONAL;
        struct CPMObjectDimension objectDimensionY;  // SEQUENCE, OPTIONAL;
        struct CPMObjectDimension objectDimensionX;  // SEQUENCE, OPTIONAL;
        struct OPT_WORD_ASN objectAge;  // INTEGER, OPTIONAL, 0..2047;
        struct OPT_BYTE_ASN objectPerceptionQuality;  // INTEGER, OPTIONAL, 0..15, noConfidence(0), fullConfidence(15);
        struct CPMSequenceOfIdentifier1B sensorIdList;  // SEQUENCEOF, OPTIONAL;
        struct CPMObjectClassDescription classification;  // SEQUENCEOF, OPTIONAL;
        struct CPMMapPosition mapPosition;  // SEQUENCE, OPTIONAL;
    };
    
    struct CPMPerceivedObjects {
        INT isValidFlag;   // necessary if this struct is used as an optional field of a SEQUENCE
        INT length;
        struct CPMPerceivedObject arrayValue[255];  // SEQUENCE;
    };
    
    struct CPMPerceivedObjectContainer {
        INT isValidFlag;   // necessary if this struct is used as an optional field of a SEQUENCE
        BYTE numberOfPerceivedObjects;  // INTEGER, 0..255;
        struct CPMPerceivedObjects perceivedObjects;  // SEQUENCEOF;
    };
    
    struct CPMCpmContainers {
        struct CPMOriginatingVehicleContainer originatingVehicleContainer;  // SEQUENCE;
        struct CPMOriginatingRsuContainer originatingRsuContainer;  // SEQUENCE;
        struct CPMSensorInformationContainer sensorInformationContainer;  // SEQUENCEOF;
        struct CPMPerceptionRegionContainer perceptionRegionContainer;  // SEQUENCEOF;
        struct CPMPerceivedObjectContainer perceivedObjectContainer;  // SEQUENCE;
    };
    
    struct CPMWrappedCpmContainer {
        INT isValidFlag;   // necessary if this struct is used as an optional field of a SEQUENCE
        BYTE containerId;  // INTEGER, 1..16, originatingVehicleContainer(1), originatingRsuContainer(2), sensorInformationContainer(3), perceptionRegionContainer(4), perceivedObjectContainer(5);
        struct CPMCpmContainers containerData;  // TABLE;
    };
    
    struct CPMWrappedCpmContainers {
        INT isValidFlag;   // necessary if this struct is used as an optional field of a SEQUENCE
        INT length;
        struct CPMWrappedCpmContainer arrayValue[8];  // SEQUENCE;
    };
    
    struct CPMCollectivePerceptionMessage {
        INT isValidFlag;   // necessary if this struct is used as an optional field of a SEQUENCE
        struct CPMManagementContainer managementContainer;  // SEQUENCE;
        struct CPMWrappedCpmContainers cpmContainers;  // SEQUENCEOF;
    };
    
    struct CPM {
        INT isValidFlag;   // necessary if this struct is used as an optional field of a SEQUENCE
        struct CPMItsPduHeader header;  // SEQUENCE;
        struct CPMCollectivePerceptionMessage cpm;  // SEQUENCE;
    };
    
}

/*
// init function to create a simple packet handle
*/ 
LONG API_InitCPMPacket()
{
  return C2xInitPacket("CPM"); 
}

/*
// init function to create a simple packet handle and
// initialize the struct with valid data
*/ 
LONG API_InitCPMPacket(struct CPM msgStruct)
{
  long pktHandle;

  pktHandle = API_InitCPMPacket();

  if (pktHandle != 0)
  {
    // create valid message and application data
    if (C2xCompletePacket(pktHandle) == 0) 
    {
      API_GetCPMParams(pktHandle, msgStruct);
    }
  }
  return pktHandle;
}

/*
// init function to create a packet with security layer and
// initialize the struct with valid data
*/ 
LONG API_InitCPMPacket(struct CPM msgStruct, char packetTypeDesignator[], char certificateName[])
{
  long pktHandle, certHdl;

  // initialize the packet
  pktHandle = C2xInitPacket("CPM", packetTypeDesignator);

  if (pktHandle != 0)
  {
    certHdl = C2xSecCertificateGetHandle(certificateName);  // get the certificate handle for the cert with name "certificateName"
    if (certHdl != 0) 
    {
      C2xSecPacketSetSignerHandle(pktHandle, certHdl); // set the certHdl to the packet
    }

    // create valid message and application data
    if (C2xCompletePacket(pktHandle) == 0) 
    {
      // copy application data to the application structure
      API_GetCPMParams(pktHandle, msgStruct);
    }
  }
  return pktHandle;
}
    

int GetCPMItsPduHeaderParams(LONG packetHandle, struct CPMItsPduHeader value, char oldPath[])
{
  char newPath[300];
  int result;

  result = 0;

  snprintf(newPath, elcount(newPath), "%s.%s", oldPath, "protocolVersion");
  value.protocolVersion = C2xGetTokenInt(packetHandle, "CPM", newPath);
  result = CheckLastError("CPM", gkFuncRefGet, result);

  snprintf(newPath, elcount(newPath), "%s.%s", oldPath, "messageID");
  value.messageID = C2xGetTokenInt(packetHandle, "CPM", newPath);
  result = CheckLastError("CPM", gkFuncRefGet, result);

  snprintf(newPath, elcount(newPath), "%s.%s", oldPath, "stationID");
  value.stationID = C2xGetTokenInt64(packetHandle, "CPM", newPath);
  result = CheckLastError("CPM", gkFuncRefGet, result);

  return result;
}

int SetCPMItsPduHeaderParams(LONG packetHandle, struct CPMItsPduHeader value, char oldPath[])
{
  char newPath[300];
  int result;

  result = 0;

  snprintf(newPath, elcount(newPath), "%s.%s", oldPath, "protocolVersion");
  C2xSetTokenInt(packetHandle, "CPM", newPath, value.protocolVersion);
  result = CheckLastError("CPM", gkFuncRefGet, result);

  snprintf(newPath, elcount(newPath), "%s.%s", oldPath, "messageID");
  C2xSetTokenInt(packetHandle, "CPM", newPath, value.messageID);
  result = CheckLastError("CPM", gkFuncRefGet, result);

  snprintf(newPath, elcount(newPath), "%s.%s", oldPath, "stationID");
  C2xSetTokenInt64(packetHandle, "CPM", newPath, value.stationID);
  result = CheckLastError("CPM", gkFuncRefGet, result);

  return result;
}

int GetCPMPosConfidenceEllipseParams(LONG packetHandle, struct CPMPosConfidenceEllipse value, char oldPath[])
{
  char newPath[300];
  int result;

  result = 0;

  snprintf(newPath, elcount(newPath), "%s.%s", oldPath, "semiMajorConfidence");
  value.semiMajorConfidence = C2xGetTokenInt(packetHandle, "CPM", newPath);
  result = CheckLastError("CPM", gkFuncRefGet, result);

  snprintf(newPath, elcount(newPath), "%s.%s", oldPath, "semiMinorConfidence");
  value.semiMinorConfidence = C2xGetTokenInt(packetHandle, "CPM", newPath);
  result = CheckLastError("CPM", gkFuncRefGet, result);

  snprintf(newPath, elcount(newPath), "%s.%s", oldPath, "semiMajorOrientation");
  value.semiMajorOrientation = C2xGetTokenInt(packetHandle, "CPM", newPath);
  result = CheckLastError("CPM", gkFuncRefGet, result);

  return result;
}

int SetCPMPosConfidenceEllipseParams(LONG packetHandle, struct CPMPosConfidenceEllipse value, char oldPath[])
{
  char newPath[300];
  int result;

  result = 0;

  snprintf(newPath, elcount(newPath), "%s.%s", oldPath, "semiMajorConfidence");
  C2xSetTokenInt(packetHandle, "CPM", newPath, value.semiMajorConfidence);
  result = CheckLastError("CPM", gkFuncRefGet, result);

  snprintf(newPath, elcount(newPath), "%s.%s", oldPath, "semiMinorConfidence");
  C2xSetTokenInt(packetHandle, "CPM", newPath, value.semiMinorConfidence);
  result = CheckLastError("CPM", gkFuncRefGet, result);

  snprintf(newPath, elcount(newPath), "%s.%s", oldPath, "semiMajorOrientation");
  C2xSetTokenInt(packetHandle, "CPM", newPath, value.semiMajorOrientation);
  result = CheckLastError("CPM", gkFuncRefGet, result);

  return result;
}

int GetCPMAltitudeParams(LONG packetHandle, struct CPMAltitude value, char oldPath[])
{
  char newPath[300];
  int result;

  result = 0;

  snprintf(newPath, elcount(newPath), "%s.%s", oldPath, "altitudeValue");
  value.altitudeValue = C2xGetTokenInt(packetHandle, "CPM", newPath);
  result = CheckLastError("CPM", gkFuncRefGet, result);

  snprintf(newPath, elcount(newPath), "%s.%s", oldPath, "altitudeConfidence");
  value.altitudeConfidence = C2xGetTokenInt(packetHandle, "CPM", newPath);
  result = CheckLastError("CPM", gkFuncRefGet, result);

  return result;
}

int SetCPMAltitudeParams(LONG packetHandle, struct CPMAltitude value, char oldPath[])
{
  char newPath[300];
  int result;

  result = 0;

  snprintf(newPath, elcount(newPath), "%s.%s", oldPath, "altitudeValue");
  C2xSetTokenInt(packetHandle, "CPM", newPath, value.altitudeValue);
  result = CheckLastError("CPM", gkFuncRefGet, result);

  snprintf(newPath, elcount(newPath), "%s.%s", oldPath, "altitudeConfidence");
  C2xSetTokenInt(packetHandle, "CPM", newPath, value.altitudeConfidence);
  result = CheckLastError("CPM", gkFuncRefGet, result);

  return result;
}

int GetCPMReferencePositionParams(LONG packetHandle, struct CPMReferencePosition value, char oldPath[])
{
  char newPath[300];
  int result;

  result = 0;

  snprintf(newPath, elcount(newPath), "%s.%s", oldPath, "latitude");
  value.latitude = C2xGetTokenInt(packetHandle, "CPM", newPath);
  result = CheckLastError("CPM", gkFuncRefGet, result);

  snprintf(newPath, elcount(newPath), "%s.%s", oldPath, "longitude");
  value.longitude = C2xGetTokenInt(packetHandle, "CPM", newPath);
  result = CheckLastError("CPM", gkFuncRefGet, result);

  snprintf(newPath, elcount(newPath), "%s.%s", oldPath, "positionConfidenceEllipse");
  GetCPMPosConfidenceEllipseParams(packetHandle, value.positionConfidenceEllipse, newPath);
  result = CheckLastError("CPM", gkFuncRefGet, result);

  snprintf(newPath, elcount(newPath), "%s.%s", oldPath, "altitude");
  GetCPMAltitudeParams(packetHandle, value.altitude, newPath);
  result = CheckLastError("CPM", gkFuncRefGet, result);

  return result;
}

int SetCPMReferencePositionParams(LONG packetHandle, struct CPMReferencePosition value, char oldPath[])
{
  char newPath[300];
  int result;

  result = 0;

  snprintf(newPath, elcount(newPath), "%s.%s", oldPath, "latitude");
  C2xSetTokenInt(packetHandle, "CPM", newPath, value.latitude);
  result = CheckLastError("CPM", gkFuncRefGet, result);

  snprintf(newPath, elcount(newPath), "%s.%s", oldPath, "longitude");
  C2xSetTokenInt(packetHandle, "CPM", newPath, value.longitude);
  result = CheckLastError("CPM", gkFuncRefGet, result);

  snprintf(newPath, elcount(newPath), "%s.%s", oldPath, "positionConfidenceEllipse");
  SetCPMPosConfidenceEllipseParams(packetHandle, value.positionConfidenceEllipse, newPath);
  result = CheckLastError("CPM", gkFuncRefGet, result);

  snprintf(newPath, elcount(newPath), "%s.%s", oldPath, "altitude");
  SetCPMAltitudeParams(packetHandle, value.altitude, newPath);
  result = CheckLastError("CPM", gkFuncRefGet, result);

  return result;
}

int GetCPMMessageSegmentationInfoParams(LONG packetHandle, struct CPMMessageSegmentationInfo value, char oldPath[])
{
  char newPath[300];
  int result;

  result = 0;

  snprintf(newPath, elcount(newPath), "%s.%s", oldPath, "totalMsgNo");
  value.totalMsgNo = C2xGetTokenInt(packetHandle, "CPM", newPath);
  result = CheckLastError("CPM", gkFuncRefGet, result);

  snprintf(newPath, elcount(newPath), "%s.%s", oldPath, "thisMsgNo");
  value.thisMsgNo = C2xGetTokenInt(packetHandle, "CPM", newPath);
  result = CheckLastError("CPM", gkFuncRefGet, result);

  return result;
}

int SetCPMMessageSegmentationInfoParams(LONG packetHandle, struct CPMMessageSegmentationInfo value, char oldPath[])
{
  char newPath[300];
  int result;

  result = 0;

  snprintf(newPath, elcount(newPath), "%s.%s", oldPath, "totalMsgNo");
  if (value.totalMsgNo < 1)
  {
    C2xSetTokenInt(packetHandle, "CPM", newPath, 1);
  }
  else if (value.totalMsgNo > 8)
  {
    C2xSetTokenInt(packetHandle, "CPM", newPath, 8);
  }
  else
  {
    C2xSetTokenInt(packetHandle, "CPM", newPath, value.totalMsgNo);
  }
  result = CheckLastError("CPM", gkFuncRefGet, result);

  snprintf(newPath, elcount(newPath), "%s.%s", oldPath, "thisMsgNo");
  if (value.thisMsgNo < 1)
  {
    C2xSetTokenInt(packetHandle, "CPM", newPath, 1);
  }
  else if (value.thisMsgNo > 8)
  {
    C2xSetTokenInt(packetHandle, "CPM", newPath, 8);
  }
  else
  {
    C2xSetTokenInt(packetHandle, "CPM", newPath, value.thisMsgNo);
  }
  result = CheckLastError("CPM", gkFuncRefGet, result);

  return result;
}

int GetCPMMessageRateHzParams(LONG packetHandle, struct CPMMessageRateHz value, char oldPath[])
{
  char newPath[300];
  int result;

  result = 0;

  snprintf(newPath, elcount(newPath), "%s.%s", oldPath, "mantissa");
  value.mantissa = C2xGetTokenInt(packetHandle, "CPM", newPath);
  result = CheckLastError("CPM", gkFuncRefGet, result);

  snprintf(newPath, elcount(newPath), "%s.%s", oldPath, "exponent");
  value.exponent = C2xGetTokenInt(packetHandle, "CPM", newPath);
  result = CheckLastError("CPM", gkFuncRefGet, result);

  return result;
}

int SetCPMMessageRateHzParams(LONG packetHandle, struct CPMMessageRateHz value, char oldPath[])
{
  char newPath[300];
  int result;

  result = 0;

  snprintf(newPath, elcount(newPath), "%s.%s", oldPath, "mantissa");
  if (value.mantissa < 1)
  {
    C2xSetTokenInt(packetHandle, "CPM", newPath, 1);
  }
  else if (value.mantissa > 100)
  {
    C2xSetTokenInt(packetHandle, "CPM", newPath, 100);
  }
  else
  {
    C2xSetTokenInt(packetHandle, "CPM", newPath, value.mantissa);
  }
  result = CheckLastError("CPM", gkFuncRefGet, result);

  snprintf(newPath, elcount(newPath), "%s.%s", oldPath, "exponent");
  C2xSetTokenInt(packetHandle, "CPM", newPath, value.exponent);
  result = CheckLastError("CPM", gkFuncRefGet, result);

  return result;
}

int GetCPMMessageRateRangeParams(LONG packetHandle, struct CPMMessageRateRange value, char oldPath[])
{
  char newPath[300];
  int result;

  result = 0;

  snprintf(newPath, elcount(newPath), "%s.%s", oldPath, "messageRateMin");
  GetCPMMessageRateHzParams(packetHandle, value.messageRateMin, newPath);
  result = CheckLastError("CPM", gkFuncRefGet, result);

  snprintf(newPath, elcount(newPath), "%s.%s", oldPath, "messageRateMax");
  GetCPMMessageRateHzParams(packetHandle, value.messageRateMax, newPath);
  result = CheckLastError("CPM", gkFuncRefGet, result);

  return result;
}

int SetCPMMessageRateRangeParams(LONG packetHandle, struct CPMMessageRateRange value, char oldPath[])
{
  char newPath[300];
  int result;

  result = 0;

  snprintf(newPath, elcount(newPath), "%s.%s", oldPath, "messageRateMin");
  SetCPMMessageRateHzParams(packetHandle, value.messageRateMin, newPath);
  result = CheckLastError("CPM", gkFuncRefGet, result);

  snprintf(newPath, elcount(newPath), "%s.%s", oldPath, "messageRateMax");
  SetCPMMessageRateHzParams(packetHandle, value.messageRateMax, newPath);
  result = CheckLastError("CPM", gkFuncRefGet, result);

  return result;
}

int GetCPMManagementContainerParams(LONG packetHandle, struct CPMManagementContainer value, char oldPath[])
{
  char newPath[300];
  int result;

  result = 0;

  snprintf(newPath, elcount(newPath), "%s.%s", oldPath, "referenceTime");
  value.referenceTime = C2xGetTokenInt64(packetHandle, "CPM", newPath);
  result = CheckLastError("CPM", gkFuncRefGet, result);

  snprintf(newPath, elcount(newPath), "%s.%s", oldPath, "referencePosition");
  GetCPMReferencePositionParams(packetHandle, value.referencePosition, newPath);
  result = CheckLastError("CPM", gkFuncRefGet, result);

  snprintf(newPath, elcount(newPath), "%s.%s", oldPath, "segmentationInfo");
  value.segmentationInfo.isValidFlag = C2xIsTokenAvailable(packetHandle, "CPM", newPath);
  if(value.segmentationInfo.isValidFlag==1)
  {
    GetCPMMessageSegmentationInfoParams(packetHandle, value.segmentationInfo, newPath);
    result = CheckLastError("CPM", gkFuncRefGet, result);
  }
  snprintf(newPath, elcount(newPath), "%s.%s", oldPath, "messageRateRange");
  value.messageRateRange.isValidFlag = C2xIsTokenAvailable(packetHandle, "CPM", newPath);
  if(value.messageRateRange.isValidFlag==1)
  {
    GetCPMMessageRateRangeParams(packetHandle, value.messageRateRange, newPath);
    result = CheckLastError("CPM", gkFuncRefGet, result);
  }
  return result;
}

int SetCPMManagementContainerParams(LONG packetHandle, struct CPMManagementContainer value, char oldPath[])
{
  char newPath[300];
  int result;

  result = 0;

  snprintf(newPath, elcount(newPath), "%s.%s", oldPath, "referenceTime");
  C2xSetTokenInt64(packetHandle, "CPM", newPath, value.referenceTime);
  result = CheckLastError("CPM", gkFuncRefGet, result);

  snprintf(newPath, elcount(newPath), "%s.%s", oldPath, "referencePosition");
  SetCPMReferencePositionParams(packetHandle, value.referencePosition, newPath);
  result = CheckLastError("CPM", gkFuncRefGet, result);

  snprintf(newPath, elcount(newPath), "%s.%s", oldPath, "segmentationInfo");
  if(value.segmentationInfo.isValidFlag==1)
  {
    SetCPMMessageSegmentationInfoParams(packetHandle, value.segmentationInfo, newPath);
    result = CheckLastError("CPM", gkFuncRefGet, result);
  }
  else
  {
    if( C2xIsTokenAvailable(packetHandle, "CPM", newPath) )
    {
      C2xRemoveToken(packetHandle, "CPM", newPath);
    }
  }

  snprintf(newPath, elcount(newPath), "%s.%s", oldPath, "messageRateRange");
  if(value.messageRateRange.isValidFlag==1)
  {
    SetCPMMessageRateRangeParams(packetHandle, value.messageRateRange, newPath);
    result = CheckLastError("CPM", gkFuncRefGet, result);
  }
  else
  {
    if( C2xIsTokenAvailable(packetHandle, "CPM", newPath) )
    {
      C2xRemoveToken(packetHandle, "CPM", newPath);
    }
  }

  return result;
}

int GetCPMWgs84AngleParams(LONG packetHandle, struct CPMWgs84Angle value, char oldPath[])
{
  char newPath[300];
  int result;

  result = 0;

  snprintf(newPath, elcount(newPath), "%s.%s", oldPath, "value");
  value.value = C2xGetTokenInt(packetHandle, "CPM", newPath);
  result = CheckLastError("CPM", gkFuncRefGet, result);

  snprintf(newPath, elcount(newPath), "%s.%s", oldPath, "confidence");
  value.confidence = C2xGetTokenInt(packetHandle, "CPM", newPath);
  result = CheckLastError("CPM", gkFuncRefGet, result);

  return result;
}

int SetCPMWgs84AngleParams(LONG packetHandle, struct CPMWgs84Angle value, char oldPath[])
{
  char newPath[300];
  int result;

  result = 0;

  snprintf(newPath, elcount(newPath), "%s.%s", oldPath, "value");
  C2xSetTokenInt(packetHandle, "CPM", newPath, value.value);
  result = CheckLastError("CPM", gkFuncRefGet, result);

  snprintf(newPath, elcount(newPath), "%s.%s", oldPath, "confidence");
  if (value.confidence < 1)
  {
    C2xSetTokenInt(packetHandle, "CPM", newPath, 1);
  }
  else if (value.confidence > 127)
  {
    C2xSetTokenInt(packetHandle, "CPM", newPath, 127);
  }
  else
  {
    C2xSetTokenInt(packetHandle, "CPM", newPath, value.confidence);
  }
  result = CheckLastError("CPM", gkFuncRefGet, result);

  return result;
}

int GetCPMCartesianAngleParams(LONG packetHandle, struct CPMCartesianAngle value, char oldPath[])
{
  char newPath[300];
  int result;

  result = 0;

  snprintf(newPath, elcount(newPath), "%s.%s", oldPath, "value");
  value.value = C2xGetTokenInt(packetHandle, "CPM", newPath);
  result = CheckLastError("CPM", gkFuncRefGet, result);

  snprintf(newPath, elcount(newPath), "%s.%s", oldPath, "confidence");
  value.confidence = C2xGetTokenInt(packetHandle, "CPM", newPath);
  result = CheckLastError("CPM", gkFuncRefGet, result);

  return result;
}

int SetCPMCartesianAngleParams(LONG packetHandle, struct CPMCartesianAngle value, char oldPath[])
{
  char newPath[300];
  int result;

  result = 0;

  snprintf(newPath, elcount(newPath), "%s.%s", oldPath, "value");
  C2xSetTokenInt(packetHandle, "CPM", newPath, value.value);
  result = CheckLastError("CPM", gkFuncRefGet, result);

  snprintf(newPath, elcount(newPath), "%s.%s", oldPath, "confidence");
  if (value.confidence < 1)
  {
    C2xSetTokenInt(packetHandle, "CPM", newPath, 1);
  }
  else if (value.confidence > 127)
  {
    C2xSetTokenInt(packetHandle, "CPM", newPath, 127);
  }
  else
  {
    C2xSetTokenInt(packetHandle, "CPM", newPath, value.confidence);
  }
  result = CheckLastError("CPM", gkFuncRefGet, result);

  return result;
}

int GetCPMTrailerDataParams(LONG packetHandle, struct CPMTrailerData value, char oldPath[])
{
  char newPath[300];
  int result;

  result = 0;

  snprintf(newPath, elcount(newPath), "%s.%s", oldPath, "refPointId");
  value.refPointId = C2xGetTokenInt(packetHandle, "CPM", newPath);
  result = CheckLastError("CPM", gkFuncRefGet, result);

  snprintf(newPath, elcount(newPath), "%s.%s", oldPath, "hitchPointOffset");
  value.hitchPointOffset = C2xGetTokenInt(packetHandle, "CPM", newPath);
  result = CheckLastError("CPM", gkFuncRefGet, result);

  snprintf(newPath, elcount(newPath), "%s.%s", oldPath, "hitchAngle");
  GetCPMCartesianAngleParams(packetHandle, value.hitchAngle, newPath);
  result = CheckLastError("CPM", gkFuncRefGet, result);

  return result;
}

int SetCPMTrailerDataParams(LONG packetHandle, struct CPMTrailerData value, char oldPath[])
{
  char newPath[300];
  int result;

  result = 0;

  snprintf(newPath, elcount(newPath), "%s.%s", oldPath, "refPointId");
  C2xSetTokenInt(packetHandle, "CPM", newPath, value.refPointId);
  result = CheckLastError("CPM", gkFuncRefGet, result);

  snprintf(newPath, elcount(newPath), "%s.%s", oldPath, "hitchPointOffset");
  C2xSetTokenInt(packetHandle, "CPM", newPath, value.hitchPointOffset);
  result = CheckLastError("CPM", gkFuncRefGet, result);

  snprintf(newPath, elcount(newPath), "%s.%s", oldPath, "hitchAngle");
  SetCPMCartesianAngleParams(packetHandle, value.hitchAngle, newPath);
  result = CheckLastError("CPM", gkFuncRefGet, result);

  return result;
}

int GetCPMTrailerDataSetParams(LONG packetHandle, struct CPMTrailerDataSet value, char oldPath[])
{
  char newPath[300]; 
  int i;
  int result;

  result = 0;

  value.length = C2xGetTokenInt(packetHandle, "CPM", oldPath);
  if((result = CheckLastError("CPM", gkFuncRefGet, result))==0)
  {
    for(i=0; i<value.length; i++)
    {
      snprintf(newPath, elcount(newPath), "%s[%d]", oldPath, i);
      GetCPMTrailerDataParams(packetHandle, value.arrayValue[i], newPath);
      result = CheckLastError("CPM", gkFuncRefGet, result);
    }
  }
  return result;
}

int SetCPMTrailerDataSetParams(LONG packetHandle, struct CPMTrailerDataSet value, char oldPath[])
{
  char newPath[300]; 
  int i;
  int result;

  result = 0;

  C2xRemoveToken(packetHandle, "CPM", oldPath);
  for(i=0; i<value.length; i++)
  {
    snprintf(newPath, elcount(newPath), "%s[%d]", oldPath, i);
    SetCPMTrailerDataParams(packetHandle, value.arrayValue[i], newPath);
    result = CheckLastError("CPM", gkFuncRefGet, result);
  }
  return result;
}

int GetCPMOriginatingVehicleContainerParams(LONG packetHandle, struct CPMOriginatingVehicleContainer value, char oldPath[])
{
  char newPath[300];
  int result;

  result = 0;

  snprintf(newPath, elcount(newPath), "%s.%s", oldPath, "orientationAngle");
  GetCPMWgs84AngleParams(packetHandle, value.orientationAngle, newPath);
  result = CheckLastError("CPM", gkFuncRefGet, result);

  snprintf(newPath, elcount(newPath), "%s.%s", oldPath, "pitchAngle");
  value.pitchAngle.isValidFlag = C2xIsTokenAvailable(packetHandle, "CPM", newPath);
  if(value.pitchAngle.isValidFlag==1)
  {
    GetCPMCartesianAngleParams(packetHandle, value.pitchAngle, newPath);
    result = CheckLastError("CPM", gkFuncRefGet, result);
  }
  snprintf(newPath, elcount(newPath), "%s.%s", oldPath, "rollAngle");
  value.rollAngle.isValidFlag = C2xIsTokenAvailable(packetHandle, "CPM", newPath);
  if(value.rollAngle.isValidFlag==1)
  {
    GetCPMCartesianAngleParams(packetHandle, value.rollAngle, newPath);
    result = CheckLastError("CPM", gkFuncRefGet, result);
  }
  snprintf(newPath, elcount(newPath), "%s.%s", oldPath, "trailerDataSet");
  value.trailerDataSet.isValidFlag = C2xIsTokenAvailable(packetHandle, "CPM", newPath);
  if(value.trailerDataSet.isValidFlag==1)
  {
    GetCPMTrailerDataSetParams(packetHandle, value.trailerDataSet, newPath);
    result = CheckLastError("CPM", gkFuncRefGet, result);
  }
  return result;
}

int SetCPMOriginatingVehicleContainerParams(LONG packetHandle, struct CPMOriginatingVehicleContainer value, char oldPath[])
{
  char newPath[300];
  int result;

  result = 0;

  snprintf(newPath, elcount(newPath), "%s.%s", oldPath, "orientationAngle");
  SetCPMWgs84AngleParams(packetHandle, value.orientationAngle, newPath);
  result = CheckLastError("CPM", gkFuncRefGet, result);

  snprintf(newPath, elcount(newPath), "%s.%s", oldPath, "pitchAngle");
  if(value.pitchAngle.isValidFlag==1)
  {
    SetCPMCartesianAngleParams(packetHandle, value.pitchAngle, newPath);
    result = CheckLastError("CPM", gkFuncRefGet, result);
  }
  else
  {
    if( C2xIsTokenAvailable(packetHandle, "CPM", newPath) )
    {
      C2xRemoveToken(packetHandle, "CPM", newPath);
    }
  }

  snprintf(newPath, elcount(newPath), "%s.%s", oldPath, "rollAngle");
  if(value.rollAngle.isValidFlag==1)
  {
    SetCPMCartesianAngleParams(packetHandle, value.rollAngle, newPath);
    result = CheckLastError("CPM", gkFuncRefGet, result);
  }
  else
  {
    if( C2xIsTokenAvailable(packetHandle, "CPM", newPath) )
    {
      C2xRemoveToken(packetHandle, "CPM", newPath);
    }
  }

  snprintf(newPath, elcount(newPath), "%s.%s", oldPath, "trailerDataSet");
  if(value.trailerDataSet.isValidFlag==1)
  {
    SetCPMTrailerDataSetParams(packetHandle, value.trailerDataSet, newPath);
    result = CheckLastError("CPM", gkFuncRefGet, result);
  }
  else
  {
    if( C2xIsTokenAvailable(packetHandle, "CPM", newPath) )
    {
      C2xRemoveToken(packetHandle, "CPM", newPath);
    }
  }

  return result;
}

int GetCPMRoadSegmentReferenceIdParams(LONG packetHandle, struct CPMRoadSegmentReferenceId value, char oldPath[])
{
  char newPath[300];
  int result;

  result = 0;

  snprintf(newPath, elcount(newPath), "%s.%s", oldPath, "region");
  value.region.isValidFlag = C2xIsTokenAvailable(packetHandle, "CPM", newPath);
  if(value.region.isValidFlag==1)
  {
    value.region.value = C2xGetTokenInt(packetHandle, "CPM", newPath);
    result = CheckLastError("CPM", gkFuncRefGet, result);
  }
  snprintf(newPath, elcount(newPath), "%s.%s", oldPath, "id");
  value.id = C2xGetTokenInt(packetHandle, "CPM", newPath);
  result = CheckLastError("CPM", gkFuncRefGet, result);

  return result;
}

int SetCPMRoadSegmentReferenceIdParams(LONG packetHandle, struct CPMRoadSegmentReferenceId value, char oldPath[])
{
  char newPath[300];
  int result;

  result = 0;

  snprintf(newPath, elcount(newPath), "%s.%s", oldPath, "region");
  if(value.region.isValidFlag==1)
  {
    C2xSetTokenInt(packetHandle, "CPM", newPath, value.region.value);
    result = CheckLastError("CPM", gkFuncRefGet, result);
  }
  else
  {
    if( C2xIsTokenAvailable(packetHandle, "CPM", newPath) )
    {
      C2xRemoveToken(packetHandle, "CPM", newPath);
    }
  }

  snprintf(newPath, elcount(newPath), "%s.%s", oldPath, "id");
  C2xSetTokenInt(packetHandle, "CPM", newPath, value.id);
  result = CheckLastError("CPM", gkFuncRefGet, result);

  return result;
}

int GetCPMIntersectionReferenceIdParams(LONG packetHandle, struct CPMIntersectionReferenceId value, char oldPath[])
{
  char newPath[300];
  int result;

  result = 0;

  snprintf(newPath, elcount(newPath), "%s.%s", oldPath, "region");
  value.region.isValidFlag = C2xIsTokenAvailable(packetHandle, "CPM", newPath);
  if(value.region.isValidFlag==1)
  {
    value.region.value = C2xGetTokenInt(packetHandle, "CPM", newPath);
    result = CheckLastError("CPM", gkFuncRefGet, result);
  }
  snprintf(newPath, elcount(newPath), "%s.%s", oldPath, "id");
  value.id = C2xGetTokenInt(packetHandle, "CPM", newPath);
  result = CheckLastError("CPM", gkFuncRefGet, result);

  return result;
}

int SetCPMIntersectionReferenceIdParams(LONG packetHandle, struct CPMIntersectionReferenceId value, char oldPath[])
{
  char newPath[300];
  int result;

  result = 0;

  snprintf(newPath, elcount(newPath), "%s.%s", oldPath, "region");
  if(value.region.isValidFlag==1)
  {
    C2xSetTokenInt(packetHandle, "CPM", newPath, value.region.value);
    result = CheckLastError("CPM", gkFuncRefGet, result);
  }
  else
  {
    if( C2xIsTokenAvailable(packetHandle, "CPM", newPath) )
    {
      C2xRemoveToken(packetHandle, "CPM", newPath);
    }
  }

  snprintf(newPath, elcount(newPath), "%s.%s", oldPath, "id");
  C2xSetTokenInt(packetHandle, "CPM", newPath, value.id);
  result = CheckLastError("CPM", gkFuncRefGet, result);

  return result;
}

int GetCPMMapReferenceParams(LONG packetHandle, struct CPMMapReference value, char oldPath[])
{
  char newPath[300];
  int result;

  result = 0;

  value.choice = C2xGetTokenInt(packetHandle, "CPM", oldPath);

  switch(value.choice)
  {
    case 0:
    {
      snprintf(newPath, elcount(newPath), "%s.%s", oldPath, "roadsegment");
      GetCPMRoadSegmentReferenceIdParams(packetHandle, value.roadsegment, newPath);
      result = CheckLastError("CPM", gkFuncRefGet, result);
    }
    break;
    case 1:
    {
      snprintf(newPath, elcount(newPath), "%s.%s", oldPath, "intersection");
      GetCPMIntersectionReferenceIdParams(packetHandle, value.intersection, newPath);
      result = CheckLastError("CPM", gkFuncRefGet, result);
    }
    break;
  }
  return result;
}

int SetCPMMapReferenceParams(LONG packetHandle, struct CPMMapReference value, char oldPath[])
{
  char newPath[300];
  int result;

  result = 0;

  switch(value.choice)
  {
    case 0:
    {
      snprintf(newPath, elcount(newPath), "%s.%s", oldPath, "roadsegment");
      SetCPMRoadSegmentReferenceIdParams(packetHandle, value.roadsegment, newPath);
      result = CheckLastError("CPM", gkFuncRefGet, result);
    }
    break;
    case 1:
    {
      snprintf(newPath, elcount(newPath), "%s.%s", oldPath, "intersection");
      SetCPMIntersectionReferenceIdParams(packetHandle, value.intersection, newPath);
      result = CheckLastError("CPM", gkFuncRefGet, result);
    }
    break;
  }
  return result;
}

int GetCPMOriginatingRsuContainerParams(LONG packetHandle, struct CPMOriginatingRsuContainer value, char oldPath[])
{
  char newPath[300];
  int result;

  result = 0;

  snprintf(newPath, elcount(newPath), "%s.%s", oldPath, "mapReference");
  value.mapReference.isValidFlag = C2xIsTokenAvailable(packetHandle, "CPM", newPath);
  if(value.mapReference.isValidFlag==1)
  {
    GetCPMMapReferenceParams(packetHandle, value.mapReference, newPath);
    result = CheckLastError("CPM", gkFuncRefGet, result);
  }
  return result;
}

int SetCPMOriginatingRsuContainerParams(LONG packetHandle, struct CPMOriginatingRsuContainer value, char oldPath[])
{
  char newPath[300];
  int result;

  result = 0;

  snprintf(newPath, elcount(newPath), "%s.%s", oldPath, "mapReference");
  if(value.mapReference.isValidFlag==1)
  {
    SetCPMMapReferenceParams(packetHandle, value.mapReference, newPath);
    result = CheckLastError("CPM", gkFuncRefGet, result);
  }
  else
  {
    if( C2xIsTokenAvailable(packetHandle, "CPM", newPath) )
    {
      C2xRemoveToken(packetHandle, "CPM", newPath);
    }
  }

  return result;
}

int GetCPMCartesianPosition3dParams(LONG packetHandle, struct CPMCartesianPosition3d value, char oldPath[])
{
  char newPath[300];
  int result;

  result = 0;

  snprintf(newPath, elcount(newPath), "%s.%s", oldPath, "xCoordinate");
  value.xCoordinate = C2xGetTokenInt(packetHandle, "CPM", newPath);
  result = CheckLastError("CPM", gkFuncRefGet, result);

  snprintf(newPath, elcount(newPath), "%s.%s", oldPath, "yCoordinate");
  value.yCoordinate = C2xGetTokenInt(packetHandle, "CPM", newPath);
  result = CheckLastError("CPM", gkFuncRefGet, result);

  snprintf(newPath, elcount(newPath), "%s.%s", oldPath, "zCoordinate");
  value.zCoordinate.isValidFlag = C2xIsTokenAvailable(packetHandle, "CPM", newPath);
  if(value.zCoordinate.isValidFlag==1)
  {
    value.zCoordinate.value = C2xGetTokenInt(packetHandle, "CPM", newPath);
    result = CheckLastError("CPM", gkFuncRefGet, result);
  }
  return result;
}

int SetCPMCartesianPosition3dParams(LONG packetHandle, struct CPMCartesianPosition3d value, char oldPath[])
{
  char newPath[300];
  int result;

  result = 0;

  snprintf(newPath, elcount(newPath), "%s.%s", oldPath, "xCoordinate");
  C2xSetTokenInt(packetHandle, "CPM", newPath, value.xCoordinate);
  result = CheckLastError("CPM", gkFuncRefGet, result);

  snprintf(newPath, elcount(newPath), "%s.%s", oldPath, "yCoordinate");
  C2xSetTokenInt(packetHandle, "CPM", newPath, value.yCoordinate);
  result = CheckLastError("CPM", gkFuncRefGet, result);

  snprintf(newPath, elcount(newPath), "%s.%s", oldPath, "zCoordinate");
  if(value.zCoordinate.isValidFlag==1)
  {
    C2xSetTokenInt(packetHandle, "CPM", newPath, value.zCoordinate.value);
    result = CheckLastError("CPM", gkFuncRefGet, result);
  }
  else
  {
    if( C2xIsTokenAvailable(packetHandle, "CPM", newPath) )
    {
      C2xRemoveToken(packetHandle, "CPM", newPath);
    }
  }

  return result;
}

int GetCPMRectangularShapeParams(LONG packetHandle, struct CPMRectangularShape value, char oldPath[])
{
  char newPath[300];
  int result;

  result = 0;

  snprintf(newPath, elcount(newPath), "%s.%s", oldPath, "centerPoint");
  value.centerPoint.isValidFlag = C2xIsTokenAvailable(packetHandle, "CPM", newPath);
  if(value.centerPoint.isValidFlag==1)
  {
    GetCPMCartesianPosition3dParams(packetHandle, value.centerPoint, newPath);
    result = CheckLastError("CPM", gkFuncRefGet, result);
  }
  snprintf(newPath, elcount(newPath), "%s.%s", oldPath, "semiLength");
  value.semiLength = C2xGetTokenInt(packetHandle, "CPM", newPath);
  result = CheckLastError("CPM", gkFuncRefGet, result);

  snprintf(newPath, elcount(newPath), "%s.%s", oldPath, "semiBreadth");
  value.semiBreadth = C2xGetTokenInt(packetHandle, "CPM", newPath);
  result = CheckLastError("CPM", gkFuncRefGet, result);

  snprintf(newPath, elcount(newPath), "%s.%s", oldPath, "orientation");
  value.orientation.isValidFlag = C2xIsTokenAvailable(packetHandle, "CPM", newPath);
  if(value.orientation.isValidFlag==1)
  {
    value.orientation.value = C2xGetTokenInt(packetHandle, "CPM", newPath);
    result = CheckLastError("CPM", gkFuncRefGet, result);
  }
  snprintf(newPath, elcount(newPath), "%s.%s", oldPath, "height");
  value.height.isValidFlag = C2xIsTokenAvailable(packetHandle, "CPM", newPath);
  if(value.height.isValidFlag==1)
  {
    value.height.value = C2xGetTokenInt(packetHandle, "CPM", newPath);
    result = CheckLastError("CPM", gkFuncRefGet, result);
  }
  return result;
}

int SetCPMRectangularShapeParams(LONG packetHandle, struct CPMRectangularShape value, char oldPath[])
{
  char newPath[300];
  int result;

  result = 0;

  snprintf(newPath, elcount(newPath), "%s.%s", oldPath, "centerPoint");
  if(value.centerPoint.isValidFlag==1)
  {
    SetCPMCartesianPosition3dParams(packetHandle, value.centerPoint, newPath);
    result = CheckLastError("CPM", gkFuncRefGet, result);
  }
  else
  {
    if( C2xIsTokenAvailable(packetHandle, "CPM", newPath) )
    {
      C2xRemoveToken(packetHandle, "CPM", newPath);
    }
  }

  snprintf(newPath, elcount(newPath), "%s.%s", oldPath, "semiLength");
  C2xSetTokenInt(packetHandle, "CPM", newPath, value.semiLength);
  result = CheckLastError("CPM", gkFuncRefGet, result);

  snprintf(newPath, elcount(newPath), "%s.%s", oldPath, "semiBreadth");
  C2xSetTokenInt(packetHandle, "CPM", newPath, value.semiBreadth);
  result = CheckLastError("CPM", gkFuncRefGet, result);

  snprintf(newPath, elcount(newPath), "%s.%s", oldPath, "orientation");
  if(value.orientation.isValidFlag==1)
  {
    C2xSetTokenInt(packetHandle, "CPM", newPath, value.orientation.value);
    result = CheckLastError("CPM", gkFuncRefGet, result);
  }
  else
  {
    if( C2xIsTokenAvailable(packetHandle, "CPM", newPath) )
    {
      C2xRemoveToken(packetHandle, "CPM", newPath);
    }
  }

  snprintf(newPath, elcount(newPath), "%s.%s", oldPath, "height");
  if(value.height.isValidFlag==1)
  {
    C2xSetTokenInt(packetHandle, "CPM", newPath, value.height.value);
    result = CheckLastError("CPM", gkFuncRefGet, result);
  }
  else
  {
    if( C2xIsTokenAvailable(packetHandle, "CPM", newPath) )
    {
      C2xRemoveToken(packetHandle, "CPM", newPath);
    }
  }

  return result;
}

int GetCPMCircularShapeParams(LONG packetHandle, struct CPMCircularShape value, char oldPath[])
{
  char newPath[300];
  int result;

  result = 0;

  snprintf(newPath, elcount(newPath), "%s.%s", oldPath, "shapeReferencePoint");
  value.shapeReferencePoint.isValidFlag = C2xIsTokenAvailable(packetHandle, "CPM", newPath);
  if(value.shapeReferencePoint.isValidFlag==1)
  {
    GetCPMCartesianPosition3dParams(packetHandle, value.shapeReferencePoint, newPath);
    result = CheckLastError("CPM", gkFuncRefGet, result);
  }
  snprintf(newPath, elcount(newPath), "%s.%s", oldPath, "radius");
  value.radius = C2xGetTokenInt(packetHandle, "CPM", newPath);
  result = CheckLastError("CPM", gkFuncRefGet, result);

  snprintf(newPath, elcount(newPath), "%s.%s", oldPath, "height");
  value.height.isValidFlag = C2xIsTokenAvailable(packetHandle, "CPM", newPath);
  if(value.height.isValidFlag==1)
  {
    value.height.value = C2xGetTokenInt(packetHandle, "CPM", newPath);
    result = CheckLastError("CPM", gkFuncRefGet, result);
  }
  return result;
}

int SetCPMCircularShapeParams(LONG packetHandle, struct CPMCircularShape value, char oldPath[])
{
  char newPath[300];
  int result;

  result = 0;

  snprintf(newPath, elcount(newPath), "%s.%s", oldPath, "shapeReferencePoint");
  if(value.shapeReferencePoint.isValidFlag==1)
  {
    SetCPMCartesianPosition3dParams(packetHandle, value.shapeReferencePoint, newPath);
    result = CheckLastError("CPM", gkFuncRefGet, result);
  }
  else
  {
    if( C2xIsTokenAvailable(packetHandle, "CPM", newPath) )
    {
      C2xRemoveToken(packetHandle, "CPM", newPath);
    }
  }

  snprintf(newPath, elcount(newPath), "%s.%s", oldPath, "radius");
  C2xSetTokenInt(packetHandle, "CPM", newPath, value.radius);
  result = CheckLastError("CPM", gkFuncRefGet, result);

  snprintf(newPath, elcount(newPath), "%s.%s", oldPath, "height");
  if(value.height.isValidFlag==1)
  {
    C2xSetTokenInt(packetHandle, "CPM", newPath, value.height.value);
    result = CheckLastError("CPM", gkFuncRefGet, result);
  }
  else
  {
    if( C2xIsTokenAvailable(packetHandle, "CPM", newPath) )
    {
      C2xRemoveToken(packetHandle, "CPM", newPath);
    }
  }

  return result;
}

int GetCPMSequenceOfCartesianPosition3d_3_16_extParams(LONG packetHandle, struct CPMSequenceOfCartesianPosition3d_3_16_ext value, char oldPath[])
{
  char newPath[300]; 
  int i;
  int result;

  result = 0;

  value.length = C2xGetTokenInt(packetHandle, "CPM", oldPath);
  if((result = CheckLastError("CPM", gkFuncRefGet, result))==0)
  {
    for(i=0; i<value.length; i++)
    {
      snprintf(newPath, elcount(newPath), "%s[%d]", oldPath, i);
      GetCPMCartesianPosition3dParams(packetHandle, value.arrayValue[i], newPath);
      result = CheckLastError("CPM", gkFuncRefGet, result);
    }
  }
  return result;
}

int SetCPMSequenceOfCartesianPosition3d_3_16_extParams(LONG packetHandle, struct CPMSequenceOfCartesianPosition3d_3_16_ext value, char oldPath[])
{
  char newPath[300]; 
  int i;
  int result;

  result = 0;

  C2xRemoveToken(packetHandle, "CPM", oldPath);
  for(i=0; i<value.length; i++)
  {
    snprintf(newPath, elcount(newPath), "%s[%d]", oldPath, i);
    SetCPMCartesianPosition3dParams(packetHandle, value.arrayValue[i], newPath);
    result = CheckLastError("CPM", gkFuncRefGet, result);
  }
  return result;
}

int GetCPMPolygonalShapeParams(LONG packetHandle, struct CPMPolygonalShape value, char oldPath[])
{
  char newPath[300];
  int result;

  result = 0;

  snprintf(newPath, elcount(newPath), "%s.%s", oldPath, "shapeReferencePoint");
  value.shapeReferencePoint.isValidFlag = C2xIsTokenAvailable(packetHandle, "CPM", newPath);
  if(value.shapeReferencePoint.isValidFlag==1)
  {
    GetCPMCartesianPosition3dParams(packetHandle, value.shapeReferencePoint, newPath);
    result = CheckLastError("CPM", gkFuncRefGet, result);
  }
  snprintf(newPath, elcount(newPath), "%s.%s", oldPath, "polygon");
  GetCPMSequenceOfCartesianPosition3d_3_16_extParams(packetHandle, value.polygon, newPath);
  result = CheckLastError("CPM", gkFuncRefGet, result);

  snprintf(newPath, elcount(newPath), "%s.%s", oldPath, "height");
  value.height.isValidFlag = C2xIsTokenAvailable(packetHandle, "CPM", newPath);
  if(value.height.isValidFlag==1)
  {
    value.height.value = C2xGetTokenInt(packetHandle, "CPM", newPath);
    result = CheckLastError("CPM", gkFuncRefGet, result);
  }
  return result;
}

int SetCPMPolygonalShapeParams(LONG packetHandle, struct CPMPolygonalShape value, char oldPath[])
{
  char newPath[300];
  int result;

  result = 0;

  snprintf(newPath, elcount(newPath), "%s.%s", oldPath, "shapeReferencePoint");
  if(value.shapeReferencePoint.isValidFlag==1)
  {
    SetCPMCartesianPosition3dParams(packetHandle, value.shapeReferencePoint, newPath);
    result = CheckLastError("CPM", gkFuncRefGet, result);
  }
  else
  {
    if( C2xIsTokenAvailable(packetHandle, "CPM", newPath) )
    {
      C2xRemoveToken(packetHandle, "CPM", newPath);
    }
  }

  snprintf(newPath, elcount(newPath), "%s.%s", oldPath, "polygon");
  SetCPMSequenceOfCartesianPosition3d_3_16_extParams(packetHandle, value.polygon, newPath);
  result = CheckLastError("CPM", gkFuncRefGet, result);

  snprintf(newPath, elcount(newPath), "%s.%s", oldPath, "height");
  if(value.height.isValidFlag==1)
  {
    C2xSetTokenInt(packetHandle, "CPM", newPath, value.height.value);
    result = CheckLastError("CPM", gkFuncRefGet, result);
  }
  else
  {
    if( C2xIsTokenAvailable(packetHandle, "CPM", newPath) )
    {
      C2xRemoveToken(packetHandle, "CPM", newPath);
    }
  }

  return result;
}

int GetCPMEllipticalShapeParams(LONG packetHandle, struct CPMEllipticalShape value, char oldPath[])
{
  char newPath[300];
  int result;

  result = 0;

  snprintf(newPath, elcount(newPath), "%s.%s", oldPath, "shapeReferencePoint");
  value.shapeReferencePoint.isValidFlag = C2xIsTokenAvailable(packetHandle, "CPM", newPath);
  if(value.shapeReferencePoint.isValidFlag==1)
  {
    GetCPMCartesianPosition3dParams(packetHandle, value.shapeReferencePoint, newPath);
    result = CheckLastError("CPM", gkFuncRefGet, result);
  }
  snprintf(newPath, elcount(newPath), "%s.%s", oldPath, "semiMajorAxisLength");
  value.semiMajorAxisLength = C2xGetTokenInt(packetHandle, "CPM", newPath);
  result = CheckLastError("CPM", gkFuncRefGet, result);

  snprintf(newPath, elcount(newPath), "%s.%s", oldPath, "semiMinorAxisLength");
  value.semiMinorAxisLength = C2xGetTokenInt(packetHandle, "CPM", newPath);
  result = CheckLastError("CPM", gkFuncRefGet, result);

  snprintf(newPath, elcount(newPath), "%s.%s", oldPath, "orientation");
  value.orientation.isValidFlag = C2xIsTokenAvailable(packetHandle, "CPM", newPath);
  if(value.orientation.isValidFlag==1)
  {
    value.orientation.value = C2xGetTokenInt(packetHandle, "CPM", newPath);
    result = CheckLastError("CPM", gkFuncRefGet, result);
  }
  snprintf(newPath, elcount(newPath), "%s.%s", oldPath, "height");
  value.height.isValidFlag = C2xIsTokenAvailable(packetHandle, "CPM", newPath);
  if(value.height.isValidFlag==1)
  {
    value.height.value = C2xGetTokenInt(packetHandle, "CPM", newPath);
    result = CheckLastError("CPM", gkFuncRefGet, result);
  }
  return result;
}

int SetCPMEllipticalShapeParams(LONG packetHandle, struct CPMEllipticalShape value, char oldPath[])
{
  char newPath[300];
  int result;

  result = 0;

  snprintf(newPath, elcount(newPath), "%s.%s", oldPath, "shapeReferencePoint");
  if(value.shapeReferencePoint.isValidFlag==1)
  {
    SetCPMCartesianPosition3dParams(packetHandle, value.shapeReferencePoint, newPath);
    result = CheckLastError("CPM", gkFuncRefGet, result);
  }
  else
  {
    if( C2xIsTokenAvailable(packetHandle, "CPM", newPath) )
    {
      C2xRemoveToken(packetHandle, "CPM", newPath);
    }
  }

  snprintf(newPath, elcount(newPath), "%s.%s", oldPath, "semiMajorAxisLength");
  C2xSetTokenInt(packetHandle, "CPM", newPath, value.semiMajorAxisLength);
  result = CheckLastError("CPM", gkFuncRefGet, result);

  snprintf(newPath, elcount(newPath), "%s.%s", oldPath, "semiMinorAxisLength");
  C2xSetTokenInt(packetHandle, "CPM", newPath, value.semiMinorAxisLength);
  result = CheckLastError("CPM", gkFuncRefGet, result);

  snprintf(newPath, elcount(newPath), "%s.%s", oldPath, "orientation");
  if(value.orientation.isValidFlag==1)
  {
    C2xSetTokenInt(packetHandle, "CPM", newPath, value.orientation.value);
    result = CheckLastError("CPM", gkFuncRefGet, result);
  }
  else
  {
    if( C2xIsTokenAvailable(packetHandle, "CPM", newPath) )
    {
      C2xRemoveToken(packetHandle, "CPM", newPath);
    }
  }

  snprintf(newPath, elcount(newPath), "%s.%s", oldPath, "height");
  if(value.height.isValidFlag==1)
  {
    C2xSetTokenInt(packetHandle, "CPM", newPath, value.height.value);
    result = CheckLastError("CPM", gkFuncRefGet, result);
  }
  else
  {
    if( C2xIsTokenAvailable(packetHandle, "CPM", newPath) )
    {
      C2xRemoveToken(packetHandle, "CPM", newPath);
    }
  }

  return result;
}

int GetCPMRadialShapeParams(LONG packetHandle, struct CPMRadialShape value, char oldPath[])
{
  char newPath[300];
  int result;

  result = 0;

  snprintf(newPath, elcount(newPath), "%s.%s", oldPath, "shapeReferencePoint");
  value.shapeReferencePoint.isValidFlag = C2xIsTokenAvailable(packetHandle, "CPM", newPath);
  if(value.shapeReferencePoint.isValidFlag==1)
  {
    GetCPMCartesianPosition3dParams(packetHandle, value.shapeReferencePoint, newPath);
    result = CheckLastError("CPM", gkFuncRefGet, result);
  }
  snprintf(newPath, elcount(newPath), "%s.%s", oldPath, "range");
  value.range = C2xGetTokenInt(packetHandle, "CPM", newPath);
  result = CheckLastError("CPM", gkFuncRefGet, result);

  snprintf(newPath, elcount(newPath), "%s.%s", oldPath, "stationaryHorizontalOpeningAngleStart");
  value.stationaryHorizontalOpeningAngleStart = C2xGetTokenInt(packetHandle, "CPM", newPath);
  result = CheckLastError("CPM", gkFuncRefGet, result);

  snprintf(newPath, elcount(newPath), "%s.%s", oldPath, "stationaryHorizontalOpeningAngleEnd");
  value.stationaryHorizontalOpeningAngleEnd = C2xGetTokenInt(packetHandle, "CPM", newPath);
  result = CheckLastError("CPM", gkFuncRefGet, result);

  snprintf(newPath, elcount(newPath), "%s.%s", oldPath, "verticalOpeningAngleStart");
  value.verticalOpeningAngleStart.isValidFlag = C2xIsTokenAvailable(packetHandle, "CPM", newPath);
  if(value.verticalOpeningAngleStart.isValidFlag==1)
  {
    value.verticalOpeningAngleStart.value = C2xGetTokenInt(packetHandle, "CPM", newPath);
    result = CheckLastError("CPM", gkFuncRefGet, result);
  }
  snprintf(newPath, elcount(newPath), "%s.%s", oldPath, "verticalOpeningAngleEnd");
  value.verticalOpeningAngleEnd.isValidFlag = C2xIsTokenAvailable(packetHandle, "CPM", newPath);
  if(value.verticalOpeningAngleEnd.isValidFlag==1)
  {
    value.verticalOpeningAngleEnd.value = C2xGetTokenInt(packetHandle, "CPM", newPath);
    result = CheckLastError("CPM", gkFuncRefGet, result);
  }
  return result;
}

int SetCPMRadialShapeParams(LONG packetHandle, struct CPMRadialShape value, char oldPath[])
{
  char newPath[300];
  int result;

  result = 0;

  snprintf(newPath, elcount(newPath), "%s.%s", oldPath, "shapeReferencePoint");
  if(value.shapeReferencePoint.isValidFlag==1)
  {
    SetCPMCartesianPosition3dParams(packetHandle, value.shapeReferencePoint, newPath);
    result = CheckLastError("CPM", gkFuncRefGet, result);
  }
  else
  {
    if( C2xIsTokenAvailable(packetHandle, "CPM", newPath) )
    {
      C2xRemoveToken(packetHandle, "CPM", newPath);
    }
  }

  snprintf(newPath, elcount(newPath), "%s.%s", oldPath, "range");
  C2xSetTokenInt(packetHandle, "CPM", newPath, value.range);
  result = CheckLastError("CPM", gkFuncRefGet, result);

  snprintf(newPath, elcount(newPath), "%s.%s", oldPath, "stationaryHorizontalOpeningAngleStart");
  C2xSetTokenInt(packetHandle, "CPM", newPath, value.stationaryHorizontalOpeningAngleStart);
  result = CheckLastError("CPM", gkFuncRefGet, result);

  snprintf(newPath, elcount(newPath), "%s.%s", oldPath, "stationaryHorizontalOpeningAngleEnd");
  C2xSetTokenInt(packetHandle, "CPM", newPath, value.stationaryHorizontalOpeningAngleEnd);
  result = CheckLastError("CPM", gkFuncRefGet, result);

  snprintf(newPath, elcount(newPath), "%s.%s", oldPath, "verticalOpeningAngleStart");
  if(value.verticalOpeningAngleStart.isValidFlag==1)
  {
    C2xSetTokenInt(packetHandle, "CPM", newPath, value.verticalOpeningAngleStart.value);
    result = CheckLastError("CPM", gkFuncRefGet, result);
  }
  else
  {
    if( C2xIsTokenAvailable(packetHandle, "CPM", newPath) )
    {
      C2xRemoveToken(packetHandle, "CPM", newPath);
    }
  }

  snprintf(newPath, elcount(newPath), "%s.%s", oldPath, "verticalOpeningAngleEnd");
  if(value.verticalOpeningAngleEnd.isValidFlag==1)
  {
    C2xSetTokenInt(packetHandle, "CPM", newPath, value.verticalOpeningAngleEnd.value);
    result = CheckLastError("CPM", gkFuncRefGet, result);
  }
  else
  {
    if( C2xIsTokenAvailable(packetHandle, "CPM", newPath) )
    {
      C2xRemoveToken(packetHandle, "CPM", newPath);
    }
  }

  return result;
}

int GetCPMRadialShapeDetailsParams(LONG packetHandle, struct CPMRadialShapeDetails value, char oldPath[])
{
  char newPath[300];
  int result;

  result = 0;

  snprintf(newPath, elcount(newPath), "%s.%s", oldPath, "range");
  value.range = C2xGetTokenInt(packetHandle, "CPM", newPath);
  result = CheckLastError("CPM", gkFuncRefGet, result);

  snprintf(newPath, elcount(newPath), "%s.%s", oldPath, "horizontalOpeningAngleStart");
  value.horizontalOpeningAngleStart = C2xGetTokenInt(packetHandle, "CPM", newPath);
  result = CheckLastError("CPM", gkFuncRefGet, result);

  snprintf(newPath, elcount(newPath), "%s.%s", oldPath, "horizontalOpeningAngleEnd");
  value.horizontalOpeningAngleEnd = C2xGetTokenInt(packetHandle, "CPM", newPath);
  result = CheckLastError("CPM", gkFuncRefGet, result);

  snprintf(newPath, elcount(newPath), "%s.%s", oldPath, "verticalOpeningAngleStart");
  value.verticalOpeningAngleStart.isValidFlag = C2xIsTokenAvailable(packetHandle, "CPM", newPath);
  if(value.verticalOpeningAngleStart.isValidFlag==1)
  {
    value.verticalOpeningAngleStart.value = C2xGetTokenInt(packetHandle, "CPM", newPath);
    result = CheckLastError("CPM", gkFuncRefGet, result);
  }
  snprintf(newPath, elcount(newPath), "%s.%s", oldPath, "verticalOpeningAngleEnd");
  value.verticalOpeningAngleEnd.isValidFlag = C2xIsTokenAvailable(packetHandle, "CPM", newPath);
  if(value.verticalOpeningAngleEnd.isValidFlag==1)
  {
    value.verticalOpeningAngleEnd.value = C2xGetTokenInt(packetHandle, "CPM", newPath);
    result = CheckLastError("CPM", gkFuncRefGet, result);
  }
  return result;
}

int SetCPMRadialShapeDetailsParams(LONG packetHandle, struct CPMRadialShapeDetails value, char oldPath[])
{
  char newPath[300];
  int result;

  result = 0;

  snprintf(newPath, elcount(newPath), "%s.%s", oldPath, "range");
  C2xSetTokenInt(packetHandle, "CPM", newPath, value.range);
  result = CheckLastError("CPM", gkFuncRefGet, result);

  snprintf(newPath, elcount(newPath), "%s.%s", oldPath, "horizontalOpeningAngleStart");
  C2xSetTokenInt(packetHandle, "CPM", newPath, value.horizontalOpeningAngleStart);
  result = CheckLastError("CPM", gkFuncRefGet, result);

  snprintf(newPath, elcount(newPath), "%s.%s", oldPath, "horizontalOpeningAngleEnd");
  C2xSetTokenInt(packetHandle, "CPM", newPath, value.horizontalOpeningAngleEnd);
  result = CheckLastError("CPM", gkFuncRefGet, result);

  snprintf(newPath, elcount(newPath), "%s.%s", oldPath, "verticalOpeningAngleStart");
  if(value.verticalOpeningAngleStart.isValidFlag==1)
  {
    C2xSetTokenInt(packetHandle, "CPM", newPath, value.verticalOpeningAngleStart.value);
    result = CheckLastError("CPM", gkFuncRefGet, result);
  }
  else
  {
    if( C2xIsTokenAvailable(packetHandle, "CPM", newPath) )
    {
      C2xRemoveToken(packetHandle, "CPM", newPath);
    }
  }

  snprintf(newPath, elcount(newPath), "%s.%s", oldPath, "verticalOpeningAngleEnd");
  if(value.verticalOpeningAngleEnd.isValidFlag==1)
  {
    C2xSetTokenInt(packetHandle, "CPM", newPath, value.verticalOpeningAngleEnd.value);
    result = CheckLastError("CPM", gkFuncRefGet, result);
  }
  else
  {
    if( C2xIsTokenAvailable(packetHandle, "CPM", newPath) )
    {
      C2xRemoveToken(packetHandle, "CPM", newPath);
    }
  }

  return result;
}

int GetCPMRadialShapesListParams(LONG packetHandle, struct CPMRadialShapesList value, char oldPath[])
{
  char newPath[300]; 
  int i;
  int result;

  result = 0;

  value.length = C2xGetTokenInt(packetHandle, "CPM", oldPath);
  if((result = CheckLastError("CPM", gkFuncRefGet, result))==0)
  {
    for(i=0; i<value.length; i++)
    {
      snprintf(newPath, elcount(newPath), "%s[%d]", oldPath, i);
      GetCPMRadialShapeDetailsParams(packetHandle, value.arrayValue[i], newPath);
      result = CheckLastError("CPM", gkFuncRefGet, result);
    }
  }
  return result;
}

int SetCPMRadialShapesListParams(LONG packetHandle, struct CPMRadialShapesList value, char oldPath[])
{
  char newPath[300]; 
  int i;
  int result;

  result = 0;

  C2xRemoveToken(packetHandle, "CPM", oldPath);
  for(i=0; i<value.length; i++)
  {
    snprintf(newPath, elcount(newPath), "%s[%d]", oldPath, i);
    SetCPMRadialShapeDetailsParams(packetHandle, value.arrayValue[i], newPath);
    result = CheckLastError("CPM", gkFuncRefGet, result);
  }
  return result;
}

int GetCPMRadialShapesParams(LONG packetHandle, struct CPMRadialShapes value, char oldPath[])
{
  char newPath[300];
  int result;

  result = 0;

  snprintf(newPath, elcount(newPath), "%s.%s", oldPath, "refPointId");
  value.refPointId = C2xGetTokenInt(packetHandle, "CPM", newPath);
  result = CheckLastError("CPM", gkFuncRefGet, result);

  snprintf(newPath, elcount(newPath), "%s.%s", oldPath, "xCoordinate");
  value.xCoordinate = C2xGetTokenInt(packetHandle, "CPM", newPath);
  result = CheckLastError("CPM", gkFuncRefGet, result);

  snprintf(newPath, elcount(newPath), "%s.%s", oldPath, "yCoordinate");
  value.yCoordinate = C2xGetTokenInt(packetHandle, "CPM", newPath);
  result = CheckLastError("CPM", gkFuncRefGet, result);

  snprintf(newPath, elcount(newPath), "%s.%s", oldPath, "zCoordinate");
  value.zCoordinate.isValidFlag = C2xIsTokenAvailable(packetHandle, "CPM", newPath);
  if(value.zCoordinate.isValidFlag==1)
  {
    value.zCoordinate.value = C2xGetTokenInt(packetHandle, "CPM", newPath);
    result = CheckLastError("CPM", gkFuncRefGet, result);
  }
  snprintf(newPath, elcount(newPath), "%s.%s", oldPath, "radialShapesList");
  GetCPMRadialShapesListParams(packetHandle, value.radialShapesList, newPath);
  result = CheckLastError("CPM", gkFuncRefGet, result);

  return result;
}

int SetCPMRadialShapesParams(LONG packetHandle, struct CPMRadialShapes value, char oldPath[])
{
  char newPath[300];
  int result;

  result = 0;

  snprintf(newPath, elcount(newPath), "%s.%s", oldPath, "refPointId");
  C2xSetTokenInt(packetHandle, "CPM", newPath, value.refPointId);
  result = CheckLastError("CPM", gkFuncRefGet, result);

  snprintf(newPath, elcount(newPath), "%s.%s", oldPath, "xCoordinate");
  C2xSetTokenInt(packetHandle, "CPM", newPath, value.xCoordinate);
  result = CheckLastError("CPM", gkFuncRefGet, result);

  snprintf(newPath, elcount(newPath), "%s.%s", oldPath, "yCoordinate");
  C2xSetTokenInt(packetHandle, "CPM", newPath, value.yCoordinate);
  result = CheckLastError("CPM", gkFuncRefGet, result);

  snprintf(newPath, elcount(newPath), "%s.%s", oldPath, "zCoordinate");
  if(value.zCoordinate.isValidFlag==1)
  {
    C2xSetTokenInt(packetHandle, "CPM", newPath, value.zCoordinate.value);
    result = CheckLastError("CPM", gkFuncRefGet, result);
  }
  else
  {
    if( C2xIsTokenAvailable(packetHandle, "CPM", newPath) )
    {
      C2xRemoveToken(packetHandle, "CPM", newPath);
    }
  }

  snprintf(newPath, elcount(newPath), "%s.%s", oldPath, "radialShapesList");
  SetCPMRadialShapesListParams(packetHandle, value.radialShapesList, newPath);
  result = CheckLastError("CPM", gkFuncRefGet, result);

  return result;
}

int GetCPMShapeParams(LONG packetHandle, struct CPMShape value, char oldPath[])
{
  char newPath[300];
  int result;

  result = 0;

  value.choice = C2xGetTokenInt(packetHandle, "CPM", oldPath);

  switch(value.choice)
  {
    case 0:
    {
      snprintf(newPath, elcount(newPath), "%s.%s", oldPath, "rectangular");
      GetCPMRectangularShapeParams(packetHandle, value.rectangular, newPath);
      result = CheckLastError("CPM", gkFuncRefGet, result);
    }
    break;
    case 1:
    {
      snprintf(newPath, elcount(newPath), "%s.%s", oldPath, "circular");
      GetCPMCircularShapeParams(packetHandle, value.circular, newPath);
      result = CheckLastError("CPM", gkFuncRefGet, result);
    }
    break;
    case 2:
    {
      snprintf(newPath, elcount(newPath), "%s.%s", oldPath, "polygonal");
      GetCPMPolygonalShapeParams(packetHandle, value.polygonal, newPath);
      result = CheckLastError("CPM", gkFuncRefGet, result);
    }
    break;
    case 3:
    {
      snprintf(newPath, elcount(newPath), "%s.%s", oldPath, "elliptical");
      GetCPMEllipticalShapeParams(packetHandle, value.elliptical, newPath);
      result = CheckLastError("CPM", gkFuncRefGet, result);
    }
    break;
    case 4:
    {
      snprintf(newPath, elcount(newPath), "%s.%s", oldPath, "radial");
      GetCPMRadialShapeParams(packetHandle, value.radial, newPath);
      result = CheckLastError("CPM", gkFuncRefGet, result);
    }
    break;
    case 5:
    {
      snprintf(newPath, elcount(newPath), "%s.%s", oldPath, "radialShapes");
      GetCPMRadialShapesParams(packetHandle, value.radialShapes, newPath);
      result = CheckLastError("CPM", gkFuncRefGet, result);
    }
    break;
  }
  return result;
}

int SetCPMShapeParams(LONG packetHandle, struct CPMShape value, char oldPath[])
{
  char newPath[300];
  int result;

  result = 0;

  switch(value.choice)
  {
    case 0:
    {
      snprintf(newPath, elcount(newPath), "%s.%s", oldPath, "rectangular");
      SetCPMRectangularShapeParams(packetHandle, value.rectangular, newPath);
      result = CheckLastError("CPM", gkFuncRefGet, result);
    }
    break;
    case 1:
    {
      snprintf(newPath, elcount(newPath), "%s.%s", oldPath, "circular");
      SetCPMCircularShapeParams(packetHandle, value.circular, newPath);
      result = CheckLastError("CPM", gkFuncRefGet, result);
    }
    break;
    case 2:
    {
      snprintf(newPath, elcount(newPath), "%s.%s", oldPath, "polygonal");
      SetCPMPolygonalShapeParams(packetHandle, value.polygonal, newPath);
      result = CheckLastError("CPM", gkFuncRefGet, result);
    }
    break;
    case 3:
    {
      snprintf(newPath, elcount(newPath), "%s.%s", oldPath, "elliptical");
      SetCPMEllipticalShapeParams(packetHandle, value.elliptical, newPath);
      result = CheckLastError("CPM", gkFuncRefGet, result);
    }
    break;
    case 4:
    {
      snprintf(newPath, elcount(newPath), "%s.%s", oldPath, "radial");
      SetCPMRadialShapeParams(packetHandle, value.radial, newPath);
      result = CheckLastError("CPM", gkFuncRefGet, result);
    }
    break;
    case 5:
    {
      snprintf(newPath, elcount(newPath), "%s.%s", oldPath, "radialShapes");
      SetCPMRadialShapesParams(packetHandle, value.radialShapes, newPath);
      result = CheckLastError("CPM", gkFuncRefGet, result);
    }
    break;
  }
  return result;
}

int GetCPMSensorInformationParams(LONG packetHandle, struct CPMSensorInformation value, char oldPath[])
{
  char newPath[300];
  int result;

  result = 0;

  snprintf(newPath, elcount(newPath), "%s.%s", oldPath, "sensorId");
  value.sensorId = C2xGetTokenInt(packetHandle, "CPM", newPath);
  result = CheckLastError("CPM", gkFuncRefGet, result);

  snprintf(newPath, elcount(newPath), "%s.%s", oldPath, "sensorType");
  value.sensorType = C2xGetTokenInt(packetHandle, "CPM", newPath);
  result = CheckLastError("CPM", gkFuncRefGet, result);

  snprintf(newPath, elcount(newPath), "%s.%s", oldPath, "perceptionRegionShape");
  value.perceptionRegionShape.isValidFlag = C2xIsTokenAvailable(packetHandle, "CPM", newPath);
  if(value.perceptionRegionShape.isValidFlag==1)
  {
    GetCPMShapeParams(packetHandle, value.perceptionRegionShape, newPath);
    result = CheckLastError("CPM", gkFuncRefGet, result);
  }
  snprintf(newPath, elcount(newPath), "%s.%s", oldPath, "perceptionRegionConfidence");
  value.perceptionRegionConfidence.isValidFlag = C2xIsTokenAvailable(packetHandle, "CPM", newPath);
  if(value.perceptionRegionConfidence.isValidFlag==1)
  {
    value.perceptionRegionConfidence.value = C2xGetTokenInt(packetHandle, "CPM", newPath);
    result = CheckLastError("CPM", gkFuncRefGet, result);
  }
  snprintf(newPath, elcount(newPath), "%s.%s", oldPath, "shadowingApplies");
  value.shadowingApplies = C2xGetTokenInt64(packetHandle, "CPM", newPath);
  result = CheckLastError("CPM", gkFuncRefGet, result);

  return result;
}

int SetCPMSensorInformationParams(LONG packetHandle, struct CPMSensorInformation value, char oldPath[])
{
  char newPath[300];
  int result;

  result = 0;

  snprintf(newPath, elcount(newPath), "%s.%s", oldPath, "sensorId");
  C2xSetTokenInt(packetHandle, "CPM", newPath, value.sensorId);
  result = CheckLastError("CPM", gkFuncRefGet, result);

  snprintf(newPath, elcount(newPath), "%s.%s", oldPath, "sensorType");
  C2xSetTokenInt(packetHandle, "CPM", newPath, value.sensorType);
  result = CheckLastError("CPM", gkFuncRefGet, result);

  snprintf(newPath, elcount(newPath), "%s.%s", oldPath, "perceptionRegionShape");
  if(value.perceptionRegionShape.isValidFlag==1)
  {
    SetCPMShapeParams(packetHandle, value.perceptionRegionShape, newPath);
    result = CheckLastError("CPM", gkFuncRefGet, result);
  }
  else
  {
    if( C2xIsTokenAvailable(packetHandle, "CPM", newPath) )
    {
      C2xRemoveToken(packetHandle, "CPM", newPath);
    }
  }

  snprintf(newPath, elcount(newPath), "%s.%s", oldPath, "perceptionRegionConfidence");
  if(value.perceptionRegionConfidence.isValidFlag==1)
  {
    if (value.perceptionRegionConfidence.value < 1)
    {
        C2xSetTokenInt(packetHandle, "CPM", newPath, 1);
    }
    else if (value.perceptionRegionConfidence.value > 101)
    {
        C2xSetTokenInt(packetHandle, "CPM", newPath, 101);
    }
    else
    {
        C2xSetTokenInt(packetHandle, "CPM", newPath, value.perceptionRegionConfidence.value);
    }
    result = CheckLastError("CPM", gkFuncRefGet, result);
  }
  else
  {
    if( C2xIsTokenAvailable(packetHandle, "CPM", newPath) )
    {
      C2xRemoveToken(packetHandle, "CPM", newPath);
    }
  }

  snprintf(newPath, elcount(newPath), "%s.%s", oldPath, "shadowingApplies");
  C2xSetTokenInt64(packetHandle, "CPM", newPath, value.shadowingApplies);
  result = CheckLastError("CPM", gkFuncRefGet, result);

  return result;
}

int GetCPMSensorInformationContainerParams(LONG packetHandle, struct CPMSensorInformationContainer value, char oldPath[])
{
  char newPath[300]; 
  int i;
  int result;

  result = 0;

  value.length = C2xGetTokenInt(packetHandle, "CPM", oldPath);
  if((result = CheckLastError("CPM", gkFuncRefGet, result))==0)
  {
    for(i=0; i<value.length; i++)
    {
      snprintf(newPath, elcount(newPath), "%s[%d]", oldPath, i);
      GetCPMSensorInformationParams(packetHandle, value.arrayValue[i], newPath);
      result = CheckLastError("CPM", gkFuncRefGet, result);
    }
  }
  return result;
}

int SetCPMSensorInformationContainerParams(LONG packetHandle, struct CPMSensorInformationContainer value, char oldPath[])
{
  char newPath[300]; 
  int i;
  int result;

  result = 0;

  C2xRemoveToken(packetHandle, "CPM", oldPath);
  for(i=0; i<value.length; i++)
  {
    snprintf(newPath, elcount(newPath), "%s[%d]", oldPath, i);
    SetCPMSensorInformationParams(packetHandle, value.arrayValue[i], newPath);
    result = CheckLastError("CPM", gkFuncRefGet, result);
  }
  return result;
}

int GetCPMSequenceOfIdentifier1BParams(LONG packetHandle, struct CPMSequenceOfIdentifier1B value, char oldPath[])
{
  char newPath[300]; 
  int i;
  int result;

  result = 0;

  value.length = C2xGetTokenInt(packetHandle, "CPM", oldPath);
  if((result = CheckLastError("CPM", gkFuncRefGet, result))==0)
  {
    for(i=0; i<value.length; i++)
    {
      snprintf(newPath, elcount(newPath), "%s[%d]", oldPath, i);
      value.arrayValue[i] = C2xGetTokenInt64(packetHandle, "CPM", newPath);
      result = CheckLastError("CPM", gkFuncRefGet, result);
    }
  }
  return result;
}

int SetCPMSequenceOfIdentifier1BParams(LONG packetHandle, struct CPMSequenceOfIdentifier1B value, char oldPath[])
{
  char newPath[300]; 
  int i;
  int result;

  result = 0;

  C2xRemoveToken(packetHandle, "CPM", oldPath);
  for(i=0; i<value.length; i++)
  {
    snprintf(newPath, elcount(newPath), "%s[%d]", oldPath, i);
    C2xSetTokenInt64(packetHandle, "CPM", newPath, value.arrayValue[i]);
    result = CheckLastError("CPM", gkFuncRefGet, result);
  }
  return result;
}

int GetCPMPerceivedObjectIdsParams(LONG packetHandle, struct CPMPerceivedObjectIds value, char oldPath[])
{
  char newPath[300]; 
  int i;
  int result;

  result = 0;

  value.length = C2xGetTokenInt(packetHandle, "CPM", oldPath);
  if((result = CheckLastError("CPM", gkFuncRefGet, result))==0)
  {
    for(i=0; i<value.length; i++)
    {
      snprintf(newPath, elcount(newPath), "%s[%d]", oldPath, i);
      value.arrayValue[i] = C2xGetTokenInt64(packetHandle, "CPM", newPath);
      result = CheckLastError("CPM", gkFuncRefGet, result);
    }
  }
  return result;
}

int SetCPMPerceivedObjectIdsParams(LONG packetHandle, struct CPMPerceivedObjectIds value, char oldPath[])
{
  char newPath[300]; 
  int i;
  int result;

  result = 0;

  C2xRemoveToken(packetHandle, "CPM", oldPath);
  for(i=0; i<value.length; i++)
  {
    snprintf(newPath, elcount(newPath), "%s[%d]", oldPath, i);
    C2xSetTokenInt64(packetHandle, "CPM", newPath, value.arrayValue[i]);
    result = CheckLastError("CPM", gkFuncRefGet, result);
  }
  return result;
}

int GetCPMPerceptionRegionParams(LONG packetHandle, struct CPMPerceptionRegion value, char oldPath[])
{
  char newPath[300];
  int result;

  result = 0;

  snprintf(newPath, elcount(newPath), "%s.%s", oldPath, "measurementDeltaTime");
  value.measurementDeltaTime = C2xGetTokenInt(packetHandle, "CPM", newPath);
  result = CheckLastError("CPM", gkFuncRefGet, result);

  snprintf(newPath, elcount(newPath), "%s.%s", oldPath, "perceptionRegionConfidence");
  value.perceptionRegionConfidence = C2xGetTokenInt(packetHandle, "CPM", newPath);
  result = CheckLastError("CPM", gkFuncRefGet, result);

  snprintf(newPath, elcount(newPath), "%s.%s", oldPath, "perceptionRegionShape");
  GetCPMShapeParams(packetHandle, value.perceptionRegionShape, newPath);
  result = CheckLastError("CPM", gkFuncRefGet, result);

  snprintf(newPath, elcount(newPath), "%s.%s", oldPath, "shadowingApplies");
  value.shadowingApplies = C2xGetTokenInt64(packetHandle, "CPM", newPath);
  result = CheckLastError("CPM", gkFuncRefGet, result);

  snprintf(newPath, elcount(newPath), "%s.%s", oldPath, "sensorIdList");
  value.sensorIdList.isValidFlag = C2xIsTokenAvailable(packetHandle, "CPM", newPath);
  if(value.sensorIdList.isValidFlag==1)
  {
    GetCPMSequenceOfIdentifier1BParams(packetHandle, value.sensorIdList, newPath);
    result = CheckLastError("CPM", gkFuncRefGet, result);
  }
  snprintf(newPath, elcount(newPath), "%s.%s", oldPath, "numberOfPerceivedObjects");
  value.numberOfPerceivedObjects.isValidFlag = C2xIsTokenAvailable(packetHandle, "CPM", newPath);
  if(value.numberOfPerceivedObjects.isValidFlag==1)
  {
    value.numberOfPerceivedObjects.value = C2xGetTokenInt(packetHandle, "CPM", newPath);
    result = CheckLastError("CPM", gkFuncRefGet, result);
  }
  snprintf(newPath, elcount(newPath), "%s.%s", oldPath, "perceivedObjectIds");
  value.perceivedObjectIds.isValidFlag = C2xIsTokenAvailable(packetHandle, "CPM", newPath);
  if(value.perceivedObjectIds.isValidFlag==1)
  {
    GetCPMPerceivedObjectIdsParams(packetHandle, value.perceivedObjectIds, newPath);
    result = CheckLastError("CPM", gkFuncRefGet, result);
  }
  return result;
}

int SetCPMPerceptionRegionParams(LONG packetHandle, struct CPMPerceptionRegion value, char oldPath[])
{
  char newPath[300];
  int result;

  result = 0;

  snprintf(newPath, elcount(newPath), "%s.%s", oldPath, "measurementDeltaTime");
  C2xSetTokenInt(packetHandle, "CPM", newPath, value.measurementDeltaTime);
  result = CheckLastError("CPM", gkFuncRefGet, result);

  snprintf(newPath, elcount(newPath), "%s.%s", oldPath, "perceptionRegionConfidence");
  if (value.perceptionRegionConfidence < 1)
  {
    C2xSetTokenInt(packetHandle, "CPM", newPath, 1);
  }
  else if (value.perceptionRegionConfidence > 101)
  {
    C2xSetTokenInt(packetHandle, "CPM", newPath, 101);
  }
  else
  {
    C2xSetTokenInt(packetHandle, "CPM", newPath, value.perceptionRegionConfidence);
  }
  result = CheckLastError("CPM", gkFuncRefGet, result);

  snprintf(newPath, elcount(newPath), "%s.%s", oldPath, "perceptionRegionShape");
  SetCPMShapeParams(packetHandle, value.perceptionRegionShape, newPath);
  result = CheckLastError("CPM", gkFuncRefGet, result);

  snprintf(newPath, elcount(newPath), "%s.%s", oldPath, "shadowingApplies");
  C2xSetTokenInt64(packetHandle, "CPM", newPath, value.shadowingApplies);
  result = CheckLastError("CPM", gkFuncRefGet, result);

  snprintf(newPath, elcount(newPath), "%s.%s", oldPath, "sensorIdList");
  if(value.sensorIdList.isValidFlag==1)
  {
    SetCPMSequenceOfIdentifier1BParams(packetHandle, value.sensorIdList, newPath);
    result = CheckLastError("CPM", gkFuncRefGet, result);
  }
  else
  {
    if( C2xIsTokenAvailable(packetHandle, "CPM", newPath) )
    {
      C2xRemoveToken(packetHandle, "CPM", newPath);
    }
  }

  snprintf(newPath, elcount(newPath), "%s.%s", oldPath, "numberOfPerceivedObjects");
  if(value.numberOfPerceivedObjects.isValidFlag==1)
  {
    C2xSetTokenInt(packetHandle, "CPM", newPath, value.numberOfPerceivedObjects.value);
    result = CheckLastError("CPM", gkFuncRefGet, result);
  }
  else
  {
    if( C2xIsTokenAvailable(packetHandle, "CPM", newPath) )
    {
      C2xRemoveToken(packetHandle, "CPM", newPath);
    }
  }

  snprintf(newPath, elcount(newPath), "%s.%s", oldPath, "perceivedObjectIds");
  if(value.perceivedObjectIds.isValidFlag==1)
  {
    SetCPMPerceivedObjectIdsParams(packetHandle, value.perceivedObjectIds, newPath);
    result = CheckLastError("CPM", gkFuncRefGet, result);
  }
  else
  {
    if( C2xIsTokenAvailable(packetHandle, "CPM", newPath) )
    {
      C2xRemoveToken(packetHandle, "CPM", newPath);
    }
  }

  return result;
}

int GetCPMPerceptionRegionContainerParams(LONG packetHandle, struct CPMPerceptionRegionContainer value, char oldPath[])
{
  char newPath[300]; 
  int i;
  int result;

  result = 0;

  value.length = C2xGetTokenInt(packetHandle, "CPM", oldPath);
  if((result = CheckLastError("CPM", gkFuncRefGet, result))==0)
  {
    for(i=0; i<value.length; i++)
    {
      snprintf(newPath, elcount(newPath), "%s[%d]", oldPath, i);
      GetCPMPerceptionRegionParams(packetHandle, value.arrayValue[i], newPath);
      result = CheckLastError("CPM", gkFuncRefGet, result);
    }
  }
  return result;
}

int SetCPMPerceptionRegionContainerParams(LONG packetHandle, struct CPMPerceptionRegionContainer value, char oldPath[])
{
  char newPath[300]; 
  int i;
  int result;

  result = 0;

  C2xRemoveToken(packetHandle, "CPM", oldPath);
  for(i=0; i<value.length; i++)
  {
    snprintf(newPath, elcount(newPath), "%s[%d]", oldPath, i);
    SetCPMPerceptionRegionParams(packetHandle, value.arrayValue[i], newPath);
    result = CheckLastError("CPM", gkFuncRefGet, result);
  }
  return result;
}

int GetCPMCartesianCoordinateWithConfidenceParams(LONG packetHandle, struct CPMCartesianCoordinateWithConfidence value, char oldPath[])
{
  char newPath[300];
  int result;

  result = 0;

  snprintf(newPath, elcount(newPath), "%s.%s", oldPath, "value");
  value.value = C2xGetTokenInt(packetHandle, "CPM", newPath);
  result = CheckLastError("CPM", gkFuncRefGet, result);

  snprintf(newPath, elcount(newPath), "%s.%s", oldPath, "confidence");
  value.confidence = C2xGetTokenInt(packetHandle, "CPM", newPath);
  result = CheckLastError("CPM", gkFuncRefGet, result);

  return result;
}

int SetCPMCartesianCoordinateWithConfidenceParams(LONG packetHandle, struct CPMCartesianCoordinateWithConfidence value, char oldPath[])
{
  char newPath[300];
  int result;

  result = 0;

  snprintf(newPath, elcount(newPath), "%s.%s", oldPath, "value");
  C2xSetTokenInt(packetHandle, "CPM", newPath, value.value);
  result = CheckLastError("CPM", gkFuncRefGet, result);

  snprintf(newPath, elcount(newPath), "%s.%s", oldPath, "confidence");
  if (value.confidence < 1)
  {
    C2xSetTokenInt(packetHandle, "CPM", newPath, 1);
  }
  else if (value.confidence > 4096)
  {
    C2xSetTokenInt(packetHandle, "CPM", newPath, 4096);
  }
  else
  {
    C2xSetTokenInt(packetHandle, "CPM", newPath, value.confidence);
  }
  result = CheckLastError("CPM", gkFuncRefGet, result);

  return result;
}

int GetCPMCartesianPosition3dWithConfidenceParams(LONG packetHandle, struct CPMCartesianPosition3dWithConfidence value, char oldPath[])
{
  char newPath[300];
  int result;

  result = 0;

  snprintf(newPath, elcount(newPath), "%s.%s", oldPath, "xCoordinate");
  GetCPMCartesianCoordinateWithConfidenceParams(packetHandle, value.xCoordinate, newPath);
  result = CheckLastError("CPM", gkFuncRefGet, result);

  snprintf(newPath, elcount(newPath), "%s.%s", oldPath, "yCoordinate");
  GetCPMCartesianCoordinateWithConfidenceParams(packetHandle, value.yCoordinate, newPath);
  result = CheckLastError("CPM", gkFuncRefGet, result);

  snprintf(newPath, elcount(newPath), "%s.%s", oldPath, "zCoordinate");
  value.zCoordinate.isValidFlag = C2xIsTokenAvailable(packetHandle, "CPM", newPath);
  if(value.zCoordinate.isValidFlag==1)
  {
    GetCPMCartesianCoordinateWithConfidenceParams(packetHandle, value.zCoordinate, newPath);
    result = CheckLastError("CPM", gkFuncRefGet, result);
  }
  return result;
}

int SetCPMCartesianPosition3dWithConfidenceParams(LONG packetHandle, struct CPMCartesianPosition3dWithConfidence value, char oldPath[])
{
  char newPath[300];
  int result;

  result = 0;

  snprintf(newPath, elcount(newPath), "%s.%s", oldPath, "xCoordinate");
  SetCPMCartesianCoordinateWithConfidenceParams(packetHandle, value.xCoordinate, newPath);
  result = CheckLastError("CPM", gkFuncRefGet, result);

  snprintf(newPath, elcount(newPath), "%s.%s", oldPath, "yCoordinate");
  SetCPMCartesianCoordinateWithConfidenceParams(packetHandle, value.yCoordinate, newPath);
  result = CheckLastError("CPM", gkFuncRefGet, result);

  snprintf(newPath, elcount(newPath), "%s.%s", oldPath, "zCoordinate");
  if(value.zCoordinate.isValidFlag==1)
  {
    SetCPMCartesianCoordinateWithConfidenceParams(packetHandle, value.zCoordinate, newPath);
    result = CheckLastError("CPM", gkFuncRefGet, result);
  }
  else
  {
    if( C2xIsTokenAvailable(packetHandle, "CPM", newPath) )
    {
      C2xRemoveToken(packetHandle, "CPM", newPath);
    }
  }

  return result;
}

int GetCPMSpeedParams(LONG packetHandle, struct CPMSpeed value, char oldPath[])
{
  char newPath[300];
  int result;

  result = 0;

  snprintf(newPath, elcount(newPath), "%s.%s", oldPath, "speedValue");
  value.speedValue = C2xGetTokenInt(packetHandle, "CPM", newPath);
  result = CheckLastError("CPM", gkFuncRefGet, result);

  snprintf(newPath, elcount(newPath), "%s.%s", oldPath, "speedConfidence");
  value.speedConfidence = C2xGetTokenInt(packetHandle, "CPM", newPath);
  result = CheckLastError("CPM", gkFuncRefGet, result);

  return result;
}

int SetCPMSpeedParams(LONG packetHandle, struct CPMSpeed value, char oldPath[])
{
  char newPath[300];
  int result;

  result = 0;

  snprintf(newPath, elcount(newPath), "%s.%s", oldPath, "speedValue");
  C2xSetTokenInt(packetHandle, "CPM", newPath, value.speedValue);
  result = CheckLastError("CPM", gkFuncRefGet, result);

  snprintf(newPath, elcount(newPath), "%s.%s", oldPath, "speedConfidence");
  if (value.speedConfidence < 1)
  {
    C2xSetTokenInt(packetHandle, "CPM", newPath, 1);
  }
  else if (value.speedConfidence > 127)
  {
    C2xSetTokenInt(packetHandle, "CPM", newPath, 127);
  }
  else
  {
    C2xSetTokenInt(packetHandle, "CPM", newPath, value.speedConfidence);
  }
  result = CheckLastError("CPM", gkFuncRefGet, result);

  return result;
}

int GetCPMVelocityComponentParams(LONG packetHandle, struct CPMVelocityComponent value, char oldPath[])
{
  char newPath[300];
  int result;

  result = 0;

  snprintf(newPath, elcount(newPath), "%s.%s", oldPath, "value");
  value.value = C2xGetTokenInt(packetHandle, "CPM", newPath);
  result = CheckLastError("CPM", gkFuncRefGet, result);

  snprintf(newPath, elcount(newPath), "%s.%s", oldPath, "confidence");
  value.confidence = C2xGetTokenInt(packetHandle, "CPM", newPath);
  result = CheckLastError("CPM", gkFuncRefGet, result);

  return result;
}

int SetCPMVelocityComponentParams(LONG packetHandle, struct CPMVelocityComponent value, char oldPath[])
{
  char newPath[300];
  int result;

  result = 0;

  snprintf(newPath, elcount(newPath), "%s.%s", oldPath, "value");
  C2xSetTokenInt(packetHandle, "CPM", newPath, value.value);
  result = CheckLastError("CPM", gkFuncRefGet, result);

  snprintf(newPath, elcount(newPath), "%s.%s", oldPath, "confidence");
  if (value.confidence < 1)
  {
    C2xSetTokenInt(packetHandle, "CPM", newPath, 1);
  }
  else if (value.confidence > 127)
  {
    C2xSetTokenInt(packetHandle, "CPM", newPath, 127);
  }
  else
  {
    C2xSetTokenInt(packetHandle, "CPM", newPath, value.confidence);
  }
  result = CheckLastError("CPM", gkFuncRefGet, result);

  return result;
}

int GetCPMVelocityPolarWithZParams(LONG packetHandle, struct CPMVelocityPolarWithZ value, char oldPath[])
{
  char newPath[300];
  int result;

  result = 0;

  snprintf(newPath, elcount(newPath), "%s.%s", oldPath, "velocityMagnitude");
  GetCPMSpeedParams(packetHandle, value.velocityMagnitude, newPath);
  result = CheckLastError("CPM", gkFuncRefGet, result);

  snprintf(newPath, elcount(newPath), "%s.%s", oldPath, "velocityDirection");
  GetCPMCartesianAngleParams(packetHandle, value.velocityDirection, newPath);
  result = CheckLastError("CPM", gkFuncRefGet, result);

  snprintf(newPath, elcount(newPath), "%s.%s", oldPath, "zVelocity");
  value.zVelocity.isValidFlag = C2xIsTokenAvailable(packetHandle, "CPM", newPath);
  if(value.zVelocity.isValidFlag==1)
  {
    GetCPMVelocityComponentParams(packetHandle, value.zVelocity, newPath);
    result = CheckLastError("CPM", gkFuncRefGet, result);
  }
  return result;
}

int SetCPMVelocityPolarWithZParams(LONG packetHandle, struct CPMVelocityPolarWithZ value, char oldPath[])
{
  char newPath[300];
  int result;

  result = 0;

  snprintf(newPath, elcount(newPath), "%s.%s", oldPath, "velocityMagnitude");
  SetCPMSpeedParams(packetHandle, value.velocityMagnitude, newPath);
  result = CheckLastError("CPM", gkFuncRefGet, result);

  snprintf(newPath, elcount(newPath), "%s.%s", oldPath, "velocityDirection");
  SetCPMCartesianAngleParams(packetHandle, value.velocityDirection, newPath);
  result = CheckLastError("CPM", gkFuncRefGet, result);

  snprintf(newPath, elcount(newPath), "%s.%s", oldPath, "zVelocity");
  if(value.zVelocity.isValidFlag==1)
  {
    SetCPMVelocityComponentParams(packetHandle, value.zVelocity, newPath);
    result = CheckLastError("CPM", gkFuncRefGet, result);
  }
  else
  {
    if( C2xIsTokenAvailable(packetHandle, "CPM", newPath) )
    {
      C2xRemoveToken(packetHandle, "CPM", newPath);
    }
  }

  return result;
}

int GetCPMVelocityCartesianParams(LONG packetHandle, struct CPMVelocityCartesian value, char oldPath[])
{
  char newPath[300];
  int result;

  result = 0;

  snprintf(newPath, elcount(newPath), "%s.%s", oldPath, "xVelocity");
  GetCPMVelocityComponentParams(packetHandle, value.xVelocity, newPath);
  result = CheckLastError("CPM", gkFuncRefGet, result);

  snprintf(newPath, elcount(newPath), "%s.%s", oldPath, "yVelocity");
  GetCPMVelocityComponentParams(packetHandle, value.yVelocity, newPath);
  result = CheckLastError("CPM", gkFuncRefGet, result);

  snprintf(newPath, elcount(newPath), "%s.%s", oldPath, "zVelocity");
  value.zVelocity.isValidFlag = C2xIsTokenAvailable(packetHandle, "CPM", newPath);
  if(value.zVelocity.isValidFlag==1)
  {
    GetCPMVelocityComponentParams(packetHandle, value.zVelocity, newPath);
    result = CheckLastError("CPM", gkFuncRefGet, result);
  }
  return result;
}

int SetCPMVelocityCartesianParams(LONG packetHandle, struct CPMVelocityCartesian value, char oldPath[])
{
  char newPath[300];
  int result;

  result = 0;

  snprintf(newPath, elcount(newPath), "%s.%s", oldPath, "xVelocity");
  SetCPMVelocityComponentParams(packetHandle, value.xVelocity, newPath);
  result = CheckLastError("CPM", gkFuncRefGet, result);

  snprintf(newPath, elcount(newPath), "%s.%s", oldPath, "yVelocity");
  SetCPMVelocityComponentParams(packetHandle, value.yVelocity, newPath);
  result = CheckLastError("CPM", gkFuncRefGet, result);

  snprintf(newPath, elcount(newPath), "%s.%s", oldPath, "zVelocity");
  if(value.zVelocity.isValidFlag==1)
  {
    SetCPMVelocityComponentParams(packetHandle, value.zVelocity, newPath);
    result = CheckLastError("CPM", gkFuncRefGet, result);
  }
  else
  {
    if( C2xIsTokenAvailable(packetHandle, "CPM", newPath) )
    {
      C2xRemoveToken(packetHandle, "CPM", newPath);
    }
  }

  return result;
}

int GetCPMVelocity3dWithConfidenceParams(LONG packetHandle, struct CPMVelocity3dWithConfidence value, char oldPath[])
{
  char newPath[300];
  int result;

  result = 0;

  value.choice = C2xGetTokenInt(packetHandle, "CPM", oldPath);

  switch(value.choice)
  {
    case 0:
    {
      snprintf(newPath, elcount(newPath), "%s.%s", oldPath, "polarVelocity");
      GetCPMVelocityPolarWithZParams(packetHandle, value.polarVelocity, newPath);
      result = CheckLastError("CPM", gkFuncRefGet, result);
    }
    break;
    case 1:
    {
      snprintf(newPath, elcount(newPath), "%s.%s", oldPath, "cartesianVelocity");
      GetCPMVelocityCartesianParams(packetHandle, value.cartesianVelocity, newPath);
      result = CheckLastError("CPM", gkFuncRefGet, result);
    }
    break;
  }
  return result;
}

int SetCPMVelocity3dWithConfidenceParams(LONG packetHandle, struct CPMVelocity3dWithConfidence value, char oldPath[])
{
  char newPath[300];
  int result;

  result = 0;

  switch(value.choice)
  {
    case 0:
    {
      snprintf(newPath, elcount(newPath), "%s.%s", oldPath, "polarVelocity");
      SetCPMVelocityPolarWithZParams(packetHandle, value.polarVelocity, newPath);
      result = CheckLastError("CPM", gkFuncRefGet, result);
    }
    break;
    case 1:
    {
      snprintf(newPath, elcount(newPath), "%s.%s", oldPath, "cartesianVelocity");
      SetCPMVelocityCartesianParams(packetHandle, value.cartesianVelocity, newPath);
      result = CheckLastError("CPM", gkFuncRefGet, result);
    }
    break;
  }
  return result;
}

int GetCPMAccelerationMagnitudeParams(LONG packetHandle, struct CPMAccelerationMagnitude value, char oldPath[])
{
  char newPath[300];
  int result;

  result = 0;

  snprintf(newPath, elcount(newPath), "%s.%s", oldPath, "accelerationMagnitudeValue");
  value.accelerationMagnitudeValue = C2xGetTokenInt(packetHandle, "CPM", newPath);
  result = CheckLastError("CPM", gkFuncRefGet, result);

  snprintf(newPath, elcount(newPath), "%s.%s", oldPath, "accelerationConfidence");
  value.accelerationConfidence = C2xGetTokenInt(packetHandle, "CPM", newPath);
  result = CheckLastError("CPM", gkFuncRefGet, result);

  return result;
}

int SetCPMAccelerationMagnitudeParams(LONG packetHandle, struct CPMAccelerationMagnitude value, char oldPath[])
{
  char newPath[300];
  int result;

  result = 0;

  snprintf(newPath, elcount(newPath), "%s.%s", oldPath, "accelerationMagnitudeValue");
  C2xSetTokenInt(packetHandle, "CPM", newPath, value.accelerationMagnitudeValue);
  result = CheckLastError("CPM", gkFuncRefGet, result);

  snprintf(newPath, elcount(newPath), "%s.%s", oldPath, "accelerationConfidence");
  C2xSetTokenInt(packetHandle, "CPM", newPath, value.accelerationConfidence);
  result = CheckLastError("CPM", gkFuncRefGet, result);

  return result;
}

int GetCPMAccelerationComponentParams(LONG packetHandle, struct CPMAccelerationComponent value, char oldPath[])
{
  char newPath[300];
  int result;

  result = 0;

  snprintf(newPath, elcount(newPath), "%s.%s", oldPath, "value");
  value.value = C2xGetTokenInt(packetHandle, "CPM", newPath);
  result = CheckLastError("CPM", gkFuncRefGet, result);

  snprintf(newPath, elcount(newPath), "%s.%s", oldPath, "confidence");
  value.confidence = C2xGetTokenInt(packetHandle, "CPM", newPath);
  result = CheckLastError("CPM", gkFuncRefGet, result);

  return result;
}

int SetCPMAccelerationComponentParams(LONG packetHandle, struct CPMAccelerationComponent value, char oldPath[])
{
  char newPath[300];
  int result;

  result = 0;

  snprintf(newPath, elcount(newPath), "%s.%s", oldPath, "value");
  C2xSetTokenInt(packetHandle, "CPM", newPath, value.value);
  result = CheckLastError("CPM", gkFuncRefGet, result);

  snprintf(newPath, elcount(newPath), "%s.%s", oldPath, "confidence");
  C2xSetTokenInt(packetHandle, "CPM", newPath, value.confidence);
  result = CheckLastError("CPM", gkFuncRefGet, result);

  return result;
}

int GetCPMAccelerationPolarWithZParams(LONG packetHandle, struct CPMAccelerationPolarWithZ value, char oldPath[])
{
  char newPath[300];
  int result;

  result = 0;

  snprintf(newPath, elcount(newPath), "%s.%s", oldPath, "accelerationMagnitude");
  GetCPMAccelerationMagnitudeParams(packetHandle, value.accelerationMagnitude, newPath);
  result = CheckLastError("CPM", gkFuncRefGet, result);

  snprintf(newPath, elcount(newPath), "%s.%s", oldPath, "accelerationDirection");
  GetCPMCartesianAngleParams(packetHandle, value.accelerationDirection, newPath);
  result = CheckLastError("CPM", gkFuncRefGet, result);

  snprintf(newPath, elcount(newPath), "%s.%s", oldPath, "zAcceleration");
  value.zAcceleration.isValidFlag = C2xIsTokenAvailable(packetHandle, "CPM", newPath);
  if(value.zAcceleration.isValidFlag==1)
  {
    GetCPMAccelerationComponentParams(packetHandle, value.zAcceleration, newPath);
    result = CheckLastError("CPM", gkFuncRefGet, result);
  }
  return result;
}

int SetCPMAccelerationPolarWithZParams(LONG packetHandle, struct CPMAccelerationPolarWithZ value, char oldPath[])
{
  char newPath[300];
  int result;

  result = 0;

  snprintf(newPath, elcount(newPath), "%s.%s", oldPath, "accelerationMagnitude");
  SetCPMAccelerationMagnitudeParams(packetHandle, value.accelerationMagnitude, newPath);
  result = CheckLastError("CPM", gkFuncRefGet, result);

  snprintf(newPath, elcount(newPath), "%s.%s", oldPath, "accelerationDirection");
  SetCPMCartesianAngleParams(packetHandle, value.accelerationDirection, newPath);
  result = CheckLastError("CPM", gkFuncRefGet, result);

  snprintf(newPath, elcount(newPath), "%s.%s", oldPath, "zAcceleration");
  if(value.zAcceleration.isValidFlag==1)
  {
    SetCPMAccelerationComponentParams(packetHandle, value.zAcceleration, newPath);
    result = CheckLastError("CPM", gkFuncRefGet, result);
  }
  else
  {
    if( C2xIsTokenAvailable(packetHandle, "CPM", newPath) )
    {
      C2xRemoveToken(packetHandle, "CPM", newPath);
    }
  }

  return result;
}

int GetCPMAccelerationCartesianParams(LONG packetHandle, struct CPMAccelerationCartesian value, char oldPath[])
{
  char newPath[300];
  int result;

  result = 0;

  snprintf(newPath, elcount(newPath), "%s.%s", oldPath, "xAcceleration");
  GetCPMAccelerationComponentParams(packetHandle, value.xAcceleration, newPath);
  result = CheckLastError("CPM", gkFuncRefGet, result);

  snprintf(newPath, elcount(newPath), "%s.%s", oldPath, "yAcceleration");
  GetCPMAccelerationComponentParams(packetHandle, value.yAcceleration, newPath);
  result = CheckLastError("CPM", gkFuncRefGet, result);

  snprintf(newPath, elcount(newPath), "%s.%s", oldPath, "zAcceleration");
  value.zAcceleration.isValidFlag = C2xIsTokenAvailable(packetHandle, "CPM", newPath);
  if(value.zAcceleration.isValidFlag==1)
  {
    GetCPMAccelerationComponentParams(packetHandle, value.zAcceleration, newPath);
    result = CheckLastError("CPM", gkFuncRefGet, result);
  }
  return result;
}

int SetCPMAccelerationCartesianParams(LONG packetHandle, struct CPMAccelerationCartesian value, char oldPath[])
{
  char newPath[300];
  int result;

  result = 0;

  snprintf(newPath, elcount(newPath), "%s.%s", oldPath, "xAcceleration");
  SetCPMAccelerationComponentParams(packetHandle, value.xAcceleration, newPath);
  result = CheckLastError("CPM", gkFuncRefGet, result);

  snprintf(newPath, elcount(newPath), "%s.%s", oldPath, "yAcceleration");
  SetCPMAccelerationComponentParams(packetHandle, value.yAcceleration, newPath);
  result = CheckLastError("CPM", gkFuncRefGet, result);

  snprintf(newPath, elcount(newPath), "%s.%s", oldPath, "zAcceleration");
  if(value.zAcceleration.isValidFlag==1)
  {
    SetCPMAccelerationComponentParams(packetHandle, value.zAcceleration, newPath);
    result = CheckLastError("CPM", gkFuncRefGet, result);
  }
  else
  {
    if( C2xIsTokenAvailable(packetHandle, "CPM", newPath) )
    {
      C2xRemoveToken(packetHandle, "CPM", newPath);
    }
  }

  return result;
}

int GetCPMAcceleration3dWithConfidenceParams(LONG packetHandle, struct CPMAcceleration3dWithConfidence value, char oldPath[])
{
  char newPath[300];
  int result;

  result = 0;

  value.choice = C2xGetTokenInt(packetHandle, "CPM", oldPath);

  switch(value.choice)
  {
    case 0:
    {
      snprintf(newPath, elcount(newPath), "%s.%s", oldPath, "polarAcceleration");
      GetCPMAccelerationPolarWithZParams(packetHandle, value.polarAcceleration, newPath);
      result = CheckLastError("CPM", gkFuncRefGet, result);
    }
    break;
    case 1:
    {
      snprintf(newPath, elcount(newPath), "%s.%s", oldPath, "cartesianAcceleration");
      GetCPMAccelerationCartesianParams(packetHandle, value.cartesianAcceleration, newPath);
      result = CheckLastError("CPM", gkFuncRefGet, result);
    }
    break;
  }
  return result;
}

int SetCPMAcceleration3dWithConfidenceParams(LONG packetHandle, struct CPMAcceleration3dWithConfidence value, char oldPath[])
{
  char newPath[300];
  int result;

  result = 0;

  switch(value.choice)
  {
    case 0:
    {
      snprintf(newPath, elcount(newPath), "%s.%s", oldPath, "polarAcceleration");
      SetCPMAccelerationPolarWithZParams(packetHandle, value.polarAcceleration, newPath);
      result = CheckLastError("CPM", gkFuncRefGet, result);
    }
    break;
    case 1:
    {
      snprintf(newPath, elcount(newPath), "%s.%s", oldPath, "cartesianAcceleration");
      SetCPMAccelerationCartesianParams(packetHandle, value.cartesianAcceleration, newPath);
      result = CheckLastError("CPM", gkFuncRefGet, result);
    }
    break;
  }
  return result;
}

int GetCPMEulerAnglesWithConfidenceParams(LONG packetHandle, struct CPMEulerAnglesWithConfidence value, char oldPath[])
{
  char newPath[300];
  int result;

  result = 0;

  snprintf(newPath, elcount(newPath), "%s.%s", oldPath, "zAngle");
  GetCPMCartesianAngleParams(packetHandle, value.zAngle, newPath);
  result = CheckLastError("CPM", gkFuncRefGet, result);

  snprintf(newPath, elcount(newPath), "%s.%s", oldPath, "yAngle");
  value.yAngle.isValidFlag = C2xIsTokenAvailable(packetHandle, "CPM", newPath);
  if(value.yAngle.isValidFlag==1)
  {
    GetCPMCartesianAngleParams(packetHandle, value.yAngle, newPath);
    result = CheckLastError("CPM", gkFuncRefGet, result);
  }
  snprintf(newPath, elcount(newPath), "%s.%s", oldPath, "xAngle");
  value.xAngle.isValidFlag = C2xIsTokenAvailable(packetHandle, "CPM", newPath);
  if(value.xAngle.isValidFlag==1)
  {
    GetCPMCartesianAngleParams(packetHandle, value.xAngle, newPath);
    result = CheckLastError("CPM", gkFuncRefGet, result);
  }
  return result;
}

int SetCPMEulerAnglesWithConfidenceParams(LONG packetHandle, struct CPMEulerAnglesWithConfidence value, char oldPath[])
{
  char newPath[300];
  int result;

  result = 0;

  snprintf(newPath, elcount(newPath), "%s.%s", oldPath, "zAngle");
  SetCPMCartesianAngleParams(packetHandle, value.zAngle, newPath);
  result = CheckLastError("CPM", gkFuncRefGet, result);

  snprintf(newPath, elcount(newPath), "%s.%s", oldPath, "yAngle");
  if(value.yAngle.isValidFlag==1)
  {
    SetCPMCartesianAngleParams(packetHandle, value.yAngle, newPath);
    result = CheckLastError("CPM", gkFuncRefGet, result);
  }
  else
  {
    if( C2xIsTokenAvailable(packetHandle, "CPM", newPath) )
    {
      C2xRemoveToken(packetHandle, "CPM", newPath);
    }
  }

  snprintf(newPath, elcount(newPath), "%s.%s", oldPath, "xAngle");
  if(value.xAngle.isValidFlag==1)
  {
    SetCPMCartesianAngleParams(packetHandle, value.xAngle, newPath);
    result = CheckLastError("CPM", gkFuncRefGet, result);
  }
  else
  {
    if( C2xIsTokenAvailable(packetHandle, "CPM", newPath) )
    {
      C2xRemoveToken(packetHandle, "CPM", newPath);
    }
  }

  return result;
}

int GetCPMCartesianAngularVelocityComponentParams(LONG packetHandle, struct CPMCartesianAngularVelocityComponent value, char oldPath[])
{
  char newPath[300];
  int result;

  result = 0;

  snprintf(newPath, elcount(newPath), "%s.%s", oldPath, "value");
  value.value = C2xGetTokenInt(packetHandle, "CPM", newPath);
  result = CheckLastError("CPM", gkFuncRefGet, result);

  snprintf(newPath, elcount(newPath), "%s.%s", oldPath, "confidence");
  value.confidence = C2xGetTokenInt(packetHandle, "CPM", newPath);
  result = CheckLastError("CPM", gkFuncRefGet, result);

  return result;
}

int SetCPMCartesianAngularVelocityComponentParams(LONG packetHandle, struct CPMCartesianAngularVelocityComponent value, char oldPath[])
{
  char newPath[300];
  int result;

  result = 0;

  snprintf(newPath, elcount(newPath), "%s.%s", oldPath, "value");
  C2xSetTokenInt(packetHandle, "CPM", newPath, value.value);
  result = CheckLastError("CPM", gkFuncRefGet, result);

  snprintf(newPath, elcount(newPath), "%s.%s", oldPath, "confidence");
  C2xSetTokenInt(packetHandle, "CPM", newPath, value.confidence);
  result = CheckLastError("CPM", gkFuncRefGet, result);

  return result;
}

int GetCPMCorrelationColumnParams(LONG packetHandle, struct CPMCorrelationColumn value, char oldPath[])
{
  char newPath[300]; 
  int i;
  int result;

  result = 0;

  value.length = C2xGetTokenInt(packetHandle, "CPM", oldPath);
  if((result = CheckLastError("CPM", gkFuncRefGet, result))==0)
  {
    for(i=0; i<value.length; i++)
    {
      snprintf(newPath, elcount(newPath), "%s[%d]", oldPath, i);
      value.arrayValue[i] = C2xGetTokenInt64(packetHandle, "CPM", newPath);
      result = CheckLastError("CPM", gkFuncRefGet, result);
    }
  }
  return result;
}

int SetCPMCorrelationColumnParams(LONG packetHandle, struct CPMCorrelationColumn value, char oldPath[])
{
  char newPath[300]; 
  int i;
  int result;

  result = 0;

  C2xRemoveToken(packetHandle, "CPM", oldPath);
  for(i=0; i<value.length; i++)
  {
    snprintf(newPath, elcount(newPath), "%s[%d]", oldPath, i);
    C2xSetTokenInt64(packetHandle, "CPM", newPath, value.arrayValue[i]);
    result = CheckLastError("CPM", gkFuncRefGet, result);
  }
  return result;
}

int GetCPMLowerTriangularPositiveSemidefiniteMatrixColumnsParams(LONG packetHandle, struct CPMLowerTriangularPositiveSemidefiniteMatrixColumns value, char oldPath[])
{
  char newPath[300]; 
  int i;
  int result;

  result = 0;

  value.length = C2xGetTokenInt(packetHandle, "CPM", oldPath);
  if((result = CheckLastError("CPM", gkFuncRefGet, result))==0)
  {
    for(i=0; i<value.length; i++)
    {
      snprintf(newPath, elcount(newPath), "%s[%d]", oldPath, i);
      GetCPMCorrelationColumnParams(packetHandle, value.arrayValue[i], newPath);
      result = CheckLastError("CPM", gkFuncRefGet, result);
    }
  }
  return result;
}

int SetCPMLowerTriangularPositiveSemidefiniteMatrixColumnsParams(LONG packetHandle, struct CPMLowerTriangularPositiveSemidefiniteMatrixColumns value, char oldPath[])
{
  char newPath[300]; 
  int i;
  int result;

  result = 0;

  C2xRemoveToken(packetHandle, "CPM", oldPath);
  for(i=0; i<value.length; i++)
  {
    snprintf(newPath, elcount(newPath), "%s[%d]", oldPath, i);
    SetCPMCorrelationColumnParams(packetHandle, value.arrayValue[i], newPath);
    result = CheckLastError("CPM", gkFuncRefGet, result);
  }
  return result;
}

int GetCPMLowerTriangularPositiveSemidefiniteMatrixParams(LONG packetHandle, struct CPMLowerTriangularPositiveSemidefiniteMatrix value, char oldPath[])
{
  char newPath[300]; 
  int j; 
  int k;
  int result;

  result = 0;

  snprintf(newPath, elcount(newPath), "%s.%s", oldPath, "componentsIncludedIntheMatrix");
  value.componentsIncludedIntheMatrix.isValidFlag = 1;
  value.componentsIncludedIntheMatrix.stringLength = C2xGetTokenLengthBit(packetHandle, "CPM", newPath);
  if ((result = CheckLastError("CPM", gkFuncRefGet, result))==0)
  {
    if(value.componentsIncludedIntheMatrix.stringLength > 0)
    {
      for(j=0; j<value.componentsIncludedIntheMatrix.stringLength; j++)
      {
        if(C2xGetTokenBitOfBitString(packetHandle, "CPM", newPath, j) == 0)
        {
          value.componentsIncludedIntheMatrix.string[j] = '0';
        }
        else if(C2xGetTokenBitOfBitString(packetHandle, "CPM", newPath, j) == 1)
        {
          value.componentsIncludedIntheMatrix.string[j] = '1';
        }

        if(value.componentsIncludedIntheMatrix.stringLength == 1)
        {
          value.componentsIncludedIntheMatrix.string[1] = '0';
        }
        result = CheckLastError("CPM", gkFuncRefGet, result);
      }
    }
    else
    {
      for(k = value.componentsIncludedIntheMatrix.stringLength+1; k > -1; k--)
      {
        if(value.componentsIncludedIntheMatrix.string[k] == '1')
        {
          value.componentsIncludedIntheMatrix.string[k] = '0';
        }
      }
    }
  }

  snprintf(newPath, elcount(newPath), "%s.%s", oldPath, "matrix");
  GetCPMLowerTriangularPositiveSemidefiniteMatrixColumnsParams(packetHandle, value.matrix, newPath);
  result = CheckLastError("CPM", gkFuncRefGet, result);

  return result;
}

int SetCPMLowerTriangularPositiveSemidefiniteMatrixParams(LONG packetHandle, struct CPMLowerTriangularPositiveSemidefiniteMatrix value, char oldPath[])
{
  char newPath[300]; 
  int j;
  int result;

  result = 0;

  snprintf(newPath, elcount(newPath), "%s.%s", oldPath, "componentsIncludedIntheMatrix");
    for(j=0; j<value.componentsIncludedIntheMatrix.stringLength; j++)
    {
      if(value.componentsIncludedIntheMatrix.string[j] == '0')
      {
        C2xSetTokenBitOfBitString(packetHandle, "CPM", newPath, j, 0);
      }
      else
      {
        C2xSetTokenBitOfBitString(packetHandle, "CPM", newPath, j, 1);
      }
      result = CheckLastError("CPM", gkFuncRefGet, result);
    }

  snprintf(newPath, elcount(newPath), "%s.%s", oldPath, "matrix");
  SetCPMLowerTriangularPositiveSemidefiniteMatrixColumnsParams(packetHandle, value.matrix, newPath);
  result = CheckLastError("CPM", gkFuncRefGet, result);

  return result;
}

int GetCPMLowerTriangularPositiveSemidefiniteMatricesParams(LONG packetHandle, struct CPMLowerTriangularPositiveSemidefiniteMatrices value, char oldPath[])
{
  char newPath[300]; 
  int i;
  int result;

  result = 0;

  value.length = C2xGetTokenInt(packetHandle, "CPM", oldPath);
  if((result = CheckLastError("CPM", gkFuncRefGet, result))==0)
  {
    for(i=0; i<value.length; i++)
    {
      snprintf(newPath, elcount(newPath), "%s[%d]", oldPath, i);
      GetCPMLowerTriangularPositiveSemidefiniteMatrixParams(packetHandle, value.arrayValue[i], newPath);
      result = CheckLastError("CPM", gkFuncRefGet, result);
    }
  }
  return result;
}

int SetCPMLowerTriangularPositiveSemidefiniteMatricesParams(LONG packetHandle, struct CPMLowerTriangularPositiveSemidefiniteMatrices value, char oldPath[])
{
  char newPath[300]; 
  int i;
  int result;

  result = 0;

  C2xRemoveToken(packetHandle, "CPM", oldPath);
  for(i=0; i<value.length; i++)
  {
    snprintf(newPath, elcount(newPath), "%s[%d]", oldPath, i);
    SetCPMLowerTriangularPositiveSemidefiniteMatrixParams(packetHandle, value.arrayValue[i], newPath);
    result = CheckLastError("CPM", gkFuncRefGet, result);
  }
  return result;
}

int GetCPMObjectDimensionParams(LONG packetHandle, struct CPMObjectDimension value, char oldPath[])
{
  char newPath[300];
  int result;

  result = 0;

  snprintf(newPath, elcount(newPath), "%s.%s", oldPath, "value");
  value.value = C2xGetTokenInt(packetHandle, "CPM", newPath);
  result = CheckLastError("CPM", gkFuncRefGet, result);

  snprintf(newPath, elcount(newPath), "%s.%s", oldPath, "confidence");
  value.confidence = C2xGetTokenInt(packetHandle, "CPM", newPath);
  result = CheckLastError("CPM", gkFuncRefGet, result);

  return result;
}

int SetCPMObjectDimensionParams(LONG packetHandle, struct CPMObjectDimension value, char oldPath[])
{
  char newPath[300];
  int result;

  result = 0;

  snprintf(newPath, elcount(newPath), "%s.%s", oldPath, "value");
  if (value.value < 1)
  {
    C2xSetTokenInt(packetHandle, "CPM", newPath, 1);
  }
  else if (value.value > 256)
  {
    C2xSetTokenInt(packetHandle, "CPM", newPath, 256);
  }
  else
  {
    C2xSetTokenInt(packetHandle, "CPM", newPath, value.value);
  }
  result = CheckLastError("CPM", gkFuncRefGet, result);

  snprintf(newPath, elcount(newPath), "%s.%s", oldPath, "confidence");
  if (value.confidence < 1)
  {
    C2xSetTokenInt(packetHandle, "CPM", newPath, 1);
  }
  else if (value.confidence > 32)
  {
    C2xSetTokenInt(packetHandle, "CPM", newPath, 32);
  }
  else
  {
    C2xSetTokenInt(packetHandle, "CPM", newPath, value.confidence);
  }
  result = CheckLastError("CPM", gkFuncRefGet, result);

  return result;
}

int GetCPMVruProfileAndSubprofileParams(LONG packetHandle, struct CPMVruProfileAndSubprofile value, char oldPath[])
{
  char newPath[300];
  int result;

  result = 0;

  value.choice = C2xGetTokenInt(packetHandle, "CPM", oldPath);

  switch(value.choice)
  {
    case 0:
    {
      snprintf(newPath, elcount(newPath), "%s.%s", oldPath, "pedestrian");
      value.pedestrian = C2xGetTokenInt(packetHandle, "CPM", newPath);
      result = CheckLastError("CPM", gkFuncRefGet, result);
    }
    break;
    case 1:
    {
      snprintf(newPath, elcount(newPath), "%s.%s", oldPath, "bicyclistAndLightVruVehicle");
      value.bicyclistAndLightVruVehicle = C2xGetTokenInt(packetHandle, "CPM", newPath);
      result = CheckLastError("CPM", gkFuncRefGet, result);
    }
    break;
    case 2:
    {
      snprintf(newPath, elcount(newPath), "%s.%s", oldPath, "motorcyclist");
      value.motorcyclist = C2xGetTokenInt(packetHandle, "CPM", newPath);
      result = CheckLastError("CPM", gkFuncRefGet, result);
    }
    break;
    case 3:
    {
      snprintf(newPath, elcount(newPath), "%s.%s", oldPath, "animal");
      value.animal = C2xGetTokenInt(packetHandle, "CPM", newPath);
      result = CheckLastError("CPM", gkFuncRefGet, result);
    }
    break;
  }
  return result;
}

int SetCPMVruProfileAndSubprofileParams(LONG packetHandle, struct CPMVruProfileAndSubprofile value, char oldPath[])
{
  char newPath[300];
  int result;

  result = 0;

  switch(value.choice)
  {
    case 0:
    {
      snprintf(newPath, elcount(newPath), "%s.%s", oldPath, "pedestrian");
      C2xSetTokenInt(packetHandle, "CPM", newPath, value.pedestrian);
      result = CheckLastError("CPM", gkFuncRefGet, result);
    }
    break;
    case 1:
    {
      snprintf(newPath, elcount(newPath), "%s.%s", oldPath, "bicyclistAndLightVruVehicle");
      C2xSetTokenInt(packetHandle, "CPM", newPath, value.bicyclistAndLightVruVehicle);
      result = CheckLastError("CPM", gkFuncRefGet, result);
    }
    break;
    case 2:
    {
      snprintf(newPath, elcount(newPath), "%s.%s", oldPath, "motorcyclist");
      C2xSetTokenInt(packetHandle, "CPM", newPath, value.motorcyclist);
      result = CheckLastError("CPM", gkFuncRefGet, result);
    }
    break;
    case 3:
    {
      snprintf(newPath, elcount(newPath), "%s.%s", oldPath, "animal");
      C2xSetTokenInt(packetHandle, "CPM", newPath, value.animal);
      result = CheckLastError("CPM", gkFuncRefGet, result);
    }
    break;
  }
  return result;
}

int GetCPMVruClusterInformationParams(LONG packetHandle, struct CPMVruClusterInformation value, char oldPath[])
{
  char newPath[300]; 
  int j; 
  int k;
  int result;

  result = 0;

  snprintf(newPath, elcount(newPath), "%s.%s", oldPath, "clusterId");
  value.clusterId.isValidFlag = C2xIsTokenAvailable(packetHandle, "CPM", newPath);
  if(value.clusterId.isValidFlag==1)
  {
    value.clusterId.value = C2xGetTokenInt(packetHandle, "CPM", newPath);
    result = CheckLastError("CPM", gkFuncRefGet, result);
  }
  snprintf(newPath, elcount(newPath), "%s.%s", oldPath, "clusterBoundingBoxShape");
  value.clusterBoundingBoxShape.isValidFlag = C2xIsTokenAvailable(packetHandle, "CPM", newPath);
  if(value.clusterBoundingBoxShape.isValidFlag==1)
  {
    GetCPMShapeParams(packetHandle, value.clusterBoundingBoxShape, newPath);
    result = CheckLastError("CPM", gkFuncRefGet, result);
  }
  snprintf(newPath, elcount(newPath), "%s.%s", oldPath, "clusterCardinalitySize");
  value.clusterCardinalitySize = C2xGetTokenInt(packetHandle, "CPM", newPath);
  result = CheckLastError("CPM", gkFuncRefGet, result);

  snprintf(newPath, elcount(newPath), "%s.%s", oldPath, "clusterProfiles");
  value.clusterProfiles.isValidFlag = C2xIsTokenAvailable(packetHandle, "CPM", newPath);
  if(value.clusterProfiles.isValidFlag==1)
  {
    value.clusterProfiles.isValidFlag = 1;
    value.clusterProfiles.stringLength = C2xGetTokenLengthBit(packetHandle, "CPM", newPath);
    if ((result = CheckLastError("CPM", gkFuncRefGet, result))==0)
    {
      if(value.clusterProfiles.stringLength > 0)
      {
        for(j=0; j<value.clusterProfiles.stringLength; j++)
        {
          if(C2xGetTokenBitOfBitString(packetHandle, "CPM", newPath, j) == 0)
          {
            value.clusterProfiles.string[j] = '0';
          }
          else if(C2xGetTokenBitOfBitString(packetHandle, "CPM", newPath, j) == 1)
          {
            value.clusterProfiles.string[j] = '1';
          }

          if(value.clusterProfiles.stringLength == 1)
          {
            value.clusterProfiles.string[1] = '0';
          }
          result = CheckLastError("CPM", gkFuncRefGet, result);
        }
      }
      else
      {
        for(k = value.clusterProfiles.stringLength+1; k > -1; k--)
        {
          if(value.clusterProfiles.string[k] == '1')
          {
            value.clusterProfiles.string[k] = '0';
          }
        }
      }
    }

  }
  return result;
}

int SetCPMVruClusterInformationParams(LONG packetHandle, struct CPMVruClusterInformation value, char oldPath[])
{
  char newPath[300]; 
  int j;
  int result;

  result = 0;

  snprintf(newPath, elcount(newPath), "%s.%s", oldPath, "clusterId");
  if(value.clusterId.isValidFlag==1)
  {
    C2xSetTokenInt(packetHandle, "CPM", newPath, value.clusterId.value);
    result = CheckLastError("CPM", gkFuncRefGet, result);
  }
  else
  {
    if( C2xIsTokenAvailable(packetHandle, "CPM", newPath) )
    {
      C2xRemoveToken(packetHandle, "CPM", newPath);
    }
  }

  snprintf(newPath, elcount(newPath), "%s.%s", oldPath, "clusterBoundingBoxShape");
  if(value.clusterBoundingBoxShape.isValidFlag==1)
  {
    SetCPMShapeParams(packetHandle, value.clusterBoundingBoxShape, newPath);
    result = CheckLastError("CPM", gkFuncRefGet, result);
  }
  else
  {
    if( C2xIsTokenAvailable(packetHandle, "CPM", newPath) )
    {
      C2xRemoveToken(packetHandle, "CPM", newPath);
    }
  }

  snprintf(newPath, elcount(newPath), "%s.%s", oldPath, "clusterCardinalitySize");
  C2xSetTokenInt(packetHandle, "CPM", newPath, value.clusterCardinalitySize);
  result = CheckLastError("CPM", gkFuncRefGet, result);

  snprintf(newPath, elcount(newPath), "%s.%s", oldPath, "clusterProfiles");
  if(value.clusterProfiles.isValidFlag==1)
  {
      for(j=0; j<value.clusterProfiles.stringLength; j++)
      {
        if(value.clusterProfiles.string[j] == '0')
        {
          C2xSetTokenBitOfBitString(packetHandle, "CPM", newPath, j, 0);
        }
        else
        {
          C2xSetTokenBitOfBitString(packetHandle, "CPM", newPath, j, 1);
        }
        result = CheckLastError("CPM", gkFuncRefGet, result);
      }
  }
  else
  {
    if( C2xIsTokenAvailable(packetHandle, "CPM", newPath) )
    {
      C2xRemoveToken(packetHandle, "CPM", newPath);
    }
  }

  return result;
}

int GetCPMObjectClassParams(LONG packetHandle, struct CPMObjectClass value, char oldPath[])
{
  char newPath[300];
  int result;

  result = 0;

  value.choice = C2xGetTokenInt(packetHandle, "CPM", oldPath);

  switch(value.choice)
  {
    case 0:
    {
      snprintf(newPath, elcount(newPath), "%s.%s", oldPath, "vehicleSubClass");
      value.vehicleSubClass = C2xGetTokenInt(packetHandle, "CPM", newPath);
      result = CheckLastError("CPM", gkFuncRefGet, result);
    }
    break;
    case 1:
    {
      snprintf(newPath, elcount(newPath), "%s.%s", oldPath, "vruSubClass");
      GetCPMVruProfileAndSubprofileParams(packetHandle, value.vruSubClass, newPath);
      result = CheckLastError("CPM", gkFuncRefGet, result);
    }
    break;
    case 2:
    {
      snprintf(newPath, elcount(newPath), "%s.%s", oldPath, "groupSubClass");
      GetCPMVruClusterInformationParams(packetHandle, value.groupSubClass, newPath);
      result = CheckLastError("CPM", gkFuncRefGet, result);
    }
    break;
    case 3:
    {
      snprintf(newPath, elcount(newPath), "%s.%s", oldPath, "otherSubClass");
      value.otherSubClass = C2xGetTokenInt(packetHandle, "CPM", newPath);
      result = CheckLastError("CPM", gkFuncRefGet, result);
    }
    break;
  }
  return result;
}

int SetCPMObjectClassParams(LONG packetHandle, struct CPMObjectClass value, char oldPath[])
{
  char newPath[300];
  int result;

  result = 0;

  switch(value.choice)
  {
    case 0:
    {
      snprintf(newPath, elcount(newPath), "%s.%s", oldPath, "vehicleSubClass");
      C2xSetTokenInt(packetHandle, "CPM", newPath, value.vehicleSubClass);
      result = CheckLastError("CPM", gkFuncRefGet, result);
    }
    break;
    case 1:
    {
      snprintf(newPath, elcount(newPath), "%s.%s", oldPath, "vruSubClass");
      SetCPMVruProfileAndSubprofileParams(packetHandle, value.vruSubClass, newPath);
      result = CheckLastError("CPM", gkFuncRefGet, result);
    }
    break;
    case 2:
    {
      snprintf(newPath, elcount(newPath), "%s.%s", oldPath, "groupSubClass");
      SetCPMVruClusterInformationParams(packetHandle, value.groupSubClass, newPath);
      result = CheckLastError("CPM", gkFuncRefGet, result);
    }
    break;
    case 3:
    {
      snprintf(newPath, elcount(newPath), "%s.%s", oldPath, "otherSubClass");
      C2xSetTokenInt(packetHandle, "CPM", newPath, value.otherSubClass);
      result = CheckLastError("CPM", gkFuncRefGet, result);
    }
    break;
  }
  return result;
}

int GetCPMObjectClassWithConfidenceParams(LONG packetHandle, struct CPMObjectClassWithConfidence value, char oldPath[])
{
  char newPath[300];
  int result;

  result = 0;

  snprintf(newPath, elcount(newPath), "%s.%s", oldPath, "objectClass");
  GetCPMObjectClassParams(packetHandle, value.objectClass, newPath);
  result = CheckLastError("CPM", gkFuncRefGet, result);

  snprintf(newPath, elcount(newPath), "%s.%s", oldPath, "confidence");
  value.confidence = C2xGetTokenInt(packetHandle, "CPM", newPath);
  result = CheckLastError("CPM", gkFuncRefGet, result);

  return result;
}

int SetCPMObjectClassWithConfidenceParams(LONG packetHandle, struct CPMObjectClassWithConfidence value, char oldPath[])
{
  char newPath[300];
  int result;

  result = 0;

  snprintf(newPath, elcount(newPath), "%s.%s", oldPath, "objectClass");
  SetCPMObjectClassParams(packetHandle, value.objectClass, newPath);
  result = CheckLastError("CPM", gkFuncRefGet, result);

  snprintf(newPath, elcount(newPath), "%s.%s", oldPath, "confidence");
  if (value.confidence < 1)
  {
    C2xSetTokenInt(packetHandle, "CPM", newPath, 1);
  }
  else if (value.confidence > 101)
  {
    C2xSetTokenInt(packetHandle, "CPM", newPath, 101);
  }
  else
  {
    C2xSetTokenInt(packetHandle, "CPM", newPath, value.confidence);
  }
  result = CheckLastError("CPM", gkFuncRefGet, result);

  return result;
}

int GetCPMObjectClassDescriptionParams(LONG packetHandle, struct CPMObjectClassDescription value, char oldPath[])
{
  char newPath[300]; 
  int i;
  int result;

  result = 0;

  value.length = C2xGetTokenInt(packetHandle, "CPM", oldPath);
  if((result = CheckLastError("CPM", gkFuncRefGet, result))==0)
  {
    for(i=0; i<value.length; i++)
    {
      snprintf(newPath, elcount(newPath), "%s[%d]", oldPath, i);
      GetCPMObjectClassWithConfidenceParams(packetHandle, value.arrayValue[i], newPath);
      result = CheckLastError("CPM", gkFuncRefGet, result);
    }
  }
  return result;
}

int SetCPMObjectClassDescriptionParams(LONG packetHandle, struct CPMObjectClassDescription value, char oldPath[])
{
  char newPath[300]; 
  int i;
  int result;

  result = 0;

  C2xRemoveToken(packetHandle, "CPM", oldPath);
  for(i=0; i<value.length; i++)
  {
    snprintf(newPath, elcount(newPath), "%s[%d]", oldPath, i);
    SetCPMObjectClassWithConfidenceParams(packetHandle, value.arrayValue[i], newPath);
    result = CheckLastError("CPM", gkFuncRefGet, result);
  }
  return result;
}

int GetCPMLongitudinalLanePositionParams(LONG packetHandle, struct CPMLongitudinalLanePosition value, char oldPath[])
{
  char newPath[300];
  int result;

  result = 0;

  snprintf(newPath, elcount(newPath), "%s.%s", oldPath, "longitudinalLanePositionValue");
  value.longitudinalLanePositionValue = C2xGetTokenInt(packetHandle, "CPM", newPath);
  result = CheckLastError("CPM", gkFuncRefGet, result);

  snprintf(newPath, elcount(newPath), "%s.%s", oldPath, "longitudinalLanePositionConfidence");
  value.longitudinalLanePositionConfidence = C2xGetTokenInt(packetHandle, "CPM", newPath);
  result = CheckLastError("CPM", gkFuncRefGet, result);

  return result;
}

int SetCPMLongitudinalLanePositionParams(LONG packetHandle, struct CPMLongitudinalLanePosition value, char oldPath[])
{
  char newPath[300];
  int result;

  result = 0;

  snprintf(newPath, elcount(newPath), "%s.%s", oldPath, "longitudinalLanePositionValue");
  C2xSetTokenInt(packetHandle, "CPM", newPath, value.longitudinalLanePositionValue);
  result = CheckLastError("CPM", gkFuncRefGet, result);

  snprintf(newPath, elcount(newPath), "%s.%s", oldPath, "longitudinalLanePositionConfidence");
  C2xSetTokenInt(packetHandle, "CPM", newPath, value.longitudinalLanePositionConfidence);
  result = CheckLastError("CPM", gkFuncRefGet, result);

  return result;
}

int GetCPMMapPositionParams(LONG packetHandle, struct CPMMapPosition value, char oldPath[])
{
  char newPath[300];
  int result;

  result = 0;

  snprintf(newPath, elcount(newPath), "%s.%s", oldPath, "mapReference");
  value.mapReference.isValidFlag = C2xIsTokenAvailable(packetHandle, "CPM", newPath);
  if(value.mapReference.isValidFlag==1)
  {
    GetCPMMapReferenceParams(packetHandle, value.mapReference, newPath);
    result = CheckLastError("CPM", gkFuncRefGet, result);
  }
  snprintf(newPath, elcount(newPath), "%s.%s", oldPath, "laneId");
  value.laneId.isValidFlag = C2xIsTokenAvailable(packetHandle, "CPM", newPath);
  if(value.laneId.isValidFlag==1)
  {
    value.laneId.value = C2xGetTokenInt(packetHandle, "CPM", newPath);
    result = CheckLastError("CPM", gkFuncRefGet, result);
  }
  snprintf(newPath, elcount(newPath), "%s.%s", oldPath, "connectionId");
  value.connectionId.isValidFlag = C2xIsTokenAvailable(packetHandle, "CPM", newPath);
  if(value.connectionId.isValidFlag==1)
  {
    value.connectionId.value = C2xGetTokenInt(packetHandle, "CPM", newPath);
    result = CheckLastError("CPM", gkFuncRefGet, result);
  }
  snprintf(newPath, elcount(newPath), "%s.%s", oldPath, "longitudinalLanePosition");
  value.longitudinalLanePosition.isValidFlag = C2xIsTokenAvailable(packetHandle, "CPM", newPath);
  if(value.longitudinalLanePosition.isValidFlag==1)
  {
    GetCPMLongitudinalLanePositionParams(packetHandle, value.longitudinalLanePosition, newPath);
    result = CheckLastError("CPM", gkFuncRefGet, result);
  }
  return result;
}

int SetCPMMapPositionParams(LONG packetHandle, struct CPMMapPosition value, char oldPath[])
{
  char newPath[300];
  int result;

  result = 0;

  snprintf(newPath, elcount(newPath), "%s.%s", oldPath, "mapReference");
  if(value.mapReference.isValidFlag==1)
  {
    SetCPMMapReferenceParams(packetHandle, value.mapReference, newPath);
    result = CheckLastError("CPM", gkFuncRefGet, result);
  }
  else
  {
    if( C2xIsTokenAvailable(packetHandle, "CPM", newPath) )
    {
      C2xRemoveToken(packetHandle, "CPM", newPath);
    }
  }

  snprintf(newPath, elcount(newPath), "%s.%s", oldPath, "laneId");
  if(value.laneId.isValidFlag==1)
  {
    C2xSetTokenInt(packetHandle, "CPM", newPath, value.laneId.value);
    result = CheckLastError("CPM", gkFuncRefGet, result);
  }
  else
  {
    if( C2xIsTokenAvailable(packetHandle, "CPM", newPath) )
    {
      C2xRemoveToken(packetHandle, "CPM", newPath);
    }
  }

  snprintf(newPath, elcount(newPath), "%s.%s", oldPath, "connectionId");
  if(value.connectionId.isValidFlag==1)
  {
    C2xSetTokenInt(packetHandle, "CPM", newPath, value.connectionId.value);
    result = CheckLastError("CPM", gkFuncRefGet, result);
  }
  else
  {
    if( C2xIsTokenAvailable(packetHandle, "CPM", newPath) )
    {
      C2xRemoveToken(packetHandle, "CPM", newPath);
    }
  }

  snprintf(newPath, elcount(newPath), "%s.%s", oldPath, "longitudinalLanePosition");
  if(value.longitudinalLanePosition.isValidFlag==1)
  {
    SetCPMLongitudinalLanePositionParams(packetHandle, value.longitudinalLanePosition, newPath);
    result = CheckLastError("CPM", gkFuncRefGet, result);
  }
  else
  {
    if( C2xIsTokenAvailable(packetHandle, "CPM", newPath) )
    {
      C2xRemoveToken(packetHandle, "CPM", newPath);
    }
  }

  return result;
}

int GetCPMPerceivedObjectParams(LONG packetHandle, struct CPMPerceivedObject value, char oldPath[])
{
  char newPath[300];
  int result;

  result = 0;

  snprintf(newPath, elcount(newPath), "%s.%s", oldPath, "objectId");
  value.objectId = C2xGetTokenInt(packetHandle, "CPM", newPath);
  result = CheckLastError("CPM", gkFuncRefGet, result);

  snprintf(newPath, elcount(newPath), "%s.%s", oldPath, "measurementDeltaTime");
  value.measurementDeltaTime = C2xGetTokenInt(packetHandle, "CPM", newPath);
  result = CheckLastError("CPM", gkFuncRefGet, result);

  snprintf(newPath, elcount(newPath), "%s.%s", oldPath, "position");
  GetCPMCartesianPosition3dWithConfidenceParams(packetHandle, value.position, newPath);
  result = CheckLastError("CPM", gkFuncRefGet, result);

  snprintf(newPath, elcount(newPath), "%s.%s", oldPath, "velocity");
  value.velocity.isValidFlag = C2xIsTokenAvailable(packetHandle, "CPM", newPath);
  if(value.velocity.isValidFlag==1)
  {
    GetCPMVelocity3dWithConfidenceParams(packetHandle, value.velocity, newPath);
    result = CheckLastError("CPM", gkFuncRefGet, result);
  }
  snprintf(newPath, elcount(newPath), "%s.%s", oldPath, "acceleration");
  value.acceleration.isValidFlag = C2xIsTokenAvailable(packetHandle, "CPM", newPath);
  if(value.acceleration.isValidFlag==1)
  {
    GetCPMAcceleration3dWithConfidenceParams(packetHandle, value.acceleration, newPath);
    result = CheckLastError("CPM", gkFuncRefGet, result);
  }
  snprintf(newPath, elcount(newPath), "%s.%s", oldPath, "angles");
  value.angles.isValidFlag = C2xIsTokenAvailable(packetHandle, "CPM", newPath);
  if(value.angles.isValidFlag==1)
  {
    GetCPMEulerAnglesWithConfidenceParams(packetHandle, value.angles, newPath);
    result = CheckLastError("CPM", gkFuncRefGet, result);
  }
  snprintf(newPath, elcount(newPath), "%s.%s", oldPath, "zAngularVelocity");
  value.zAngularVelocity.isValidFlag = C2xIsTokenAvailable(packetHandle, "CPM", newPath);
  if(value.zAngularVelocity.isValidFlag==1)
  {
    GetCPMCartesianAngularVelocityComponentParams(packetHandle, value.zAngularVelocity, newPath);
    result = CheckLastError("CPM", gkFuncRefGet, result);
  }
  snprintf(newPath, elcount(newPath), "%s.%s", oldPath, "lowerTriangularCorrelationMatrices");
  value.lowerTriangularCorrelationMatrices.isValidFlag = C2xIsTokenAvailable(packetHandle, "CPM", newPath);
  if(value.lowerTriangularCorrelationMatrices.isValidFlag==1)
  {
    GetCPMLowerTriangularPositiveSemidefiniteMatricesParams(packetHandle, value.lowerTriangularCorrelationMatrices, newPath);
    result = CheckLastError("CPM", gkFuncRefGet, result);
  }
  snprintf(newPath, elcount(newPath), "%s.%s", oldPath, "objectDimensionZ");
  value.objectDimensionZ.isValidFlag = C2xIsTokenAvailable(packetHandle, "CPM", newPath);
  if(value.objectDimensionZ.isValidFlag==1)
  {
    GetCPMObjectDimensionParams(packetHandle, value.objectDimensionZ, newPath);
    result = CheckLastError("CPM", gkFuncRefGet, result);
  }
  snprintf(newPath, elcount(newPath), "%s.%s", oldPath, "objectDimensionY");
  value.objectDimensionY.isValidFlag = C2xIsTokenAvailable(packetHandle, "CPM", newPath);
  if(value.objectDimensionY.isValidFlag==1)
  {
    GetCPMObjectDimensionParams(packetHandle, value.objectDimensionY, newPath);
    result = CheckLastError("CPM", gkFuncRefGet, result);
  }
  snprintf(newPath, elcount(newPath), "%s.%s", oldPath, "objectDimensionX");
  value.objectDimensionX.isValidFlag = C2xIsTokenAvailable(packetHandle, "CPM", newPath);
  if(value.objectDimensionX.isValidFlag==1)
  {
    GetCPMObjectDimensionParams(packetHandle, value.objectDimensionX, newPath);
    result = CheckLastError("CPM", gkFuncRefGet, result);
  }
  snprintf(newPath, elcount(newPath), "%s.%s", oldPath, "objectAge");
  value.objectAge.isValidFlag = C2xIsTokenAvailable(packetHandle, "CPM", newPath);
  if(value.objectAge.isValidFlag==1)
  {
    value.objectAge.value = C2xGetTokenInt(packetHandle, "CPM", newPath);
    result = CheckLastError("CPM", gkFuncRefGet, result);
  }
  snprintf(newPath, elcount(newPath), "%s.%s", oldPath, "objectPerceptionQuality");
  value.objectPerceptionQuality.isValidFlag = C2xIsTokenAvailable(packetHandle, "CPM", newPath);
  if(value.objectPerceptionQuality.isValidFlag==1)
  {
    value.objectPerceptionQuality.value = C2xGetTokenInt(packetHandle, "CPM", newPath);
    result = CheckLastError("CPM", gkFuncRefGet, result);
  }
  snprintf(newPath, elcount(newPath), "%s.%s", oldPath, "sensorIdList");
  value.sensorIdList.isValidFlag = C2xIsTokenAvailable(packetHandle, "CPM", newPath);
  if(value.sensorIdList.isValidFlag==1)
  {
    GetCPMSequenceOfIdentifier1BParams(packetHandle, value.sensorIdList, newPath);
    result = CheckLastError("CPM", gkFuncRefGet, result);
  }
  snprintf(newPath, elcount(newPath), "%s.%s", oldPath, "classification");
  value.classification.isValidFlag = C2xIsTokenAvailable(packetHandle, "CPM", newPath);
  if(value.classification.isValidFlag==1)
  {
    GetCPMObjectClassDescriptionParams(packetHandle, value.classification, newPath);
    result = CheckLastError("CPM", gkFuncRefGet, result);
  }
  snprintf(newPath, elcount(newPath), "%s.%s", oldPath, "mapPosition");
  value.mapPosition.isValidFlag = C2xIsTokenAvailable(packetHandle, "CPM", newPath);
  if(value.mapPosition.isValidFlag==1)
  {
    GetCPMMapPositionParams(packetHandle, value.mapPosition, newPath);
    result = CheckLastError("CPM", gkFuncRefGet, result);
  }
  return result;
}

int SetCPMPerceivedObjectParams(LONG packetHandle, struct CPMPerceivedObject value, char oldPath[])
{
  char newPath[300];
  int result;

  result = 0;

  snprintf(newPath, elcount(newPath), "%s.%s", oldPath, "objectId");
  C2xSetTokenInt(packetHandle, "CPM", newPath, value.objectId);
  result = CheckLastError("CPM", gkFuncRefGet, result);

  snprintf(newPath, elcount(newPath), "%s.%s", oldPath, "measurementDeltaTime");
  C2xSetTokenInt(packetHandle, "CPM", newPath, value.measurementDeltaTime);
  result = CheckLastError("CPM", gkFuncRefGet, result);

  snprintf(newPath, elcount(newPath), "%s.%s", oldPath, "position");
  SetCPMCartesianPosition3dWithConfidenceParams(packetHandle, value.position, newPath);
  result = CheckLastError("CPM", gkFuncRefGet, result);

  snprintf(newPath, elcount(newPath), "%s.%s", oldPath, "velocity");
  if(value.velocity.isValidFlag==1)
  {
    SetCPMVelocity3dWithConfidenceParams(packetHandle, value.velocity, newPath);
    result = CheckLastError("CPM", gkFuncRefGet, result);
  }
  else
  {
    if( C2xIsTokenAvailable(packetHandle, "CPM", newPath) )
    {
      C2xRemoveToken(packetHandle, "CPM", newPath);
    }
  }

  snprintf(newPath, elcount(newPath), "%s.%s", oldPath, "acceleration");
  if(value.acceleration.isValidFlag==1)
  {
    SetCPMAcceleration3dWithConfidenceParams(packetHandle, value.acceleration, newPath);
    result = CheckLastError("CPM", gkFuncRefGet, result);
  }
  else
  {
    if( C2xIsTokenAvailable(packetHandle, "CPM", newPath) )
    {
      C2xRemoveToken(packetHandle, "CPM", newPath);
    }
  }

  snprintf(newPath, elcount(newPath), "%s.%s", oldPath, "angles");
  if(value.angles.isValidFlag==1)
  {
    SetCPMEulerAnglesWithConfidenceParams(packetHandle, value.angles, newPath);
    result = CheckLastError("CPM", gkFuncRefGet, result);
  }
  else
  {
    if( C2xIsTokenAvailable(packetHandle, "CPM", newPath) )
    {
      C2xRemoveToken(packetHandle, "CPM", newPath);
    }
  }

  snprintf(newPath, elcount(newPath), "%s.%s", oldPath, "zAngularVelocity");
  if(value.zAngularVelocity.isValidFlag==1)
  {
    SetCPMCartesianAngularVelocityComponentParams(packetHandle, value.zAngularVelocity, newPath);
    result = CheckLastError("CPM", gkFuncRefGet, result);
  }
  else
  {
    if( C2xIsTokenAvailable(packetHandle, "CPM", newPath) )
    {
      C2xRemoveToken(packetHandle, "CPM", newPath);
    }
  }

  snprintf(newPath, elcount(newPath), "%s.%s", oldPath, "lowerTriangularCorrelationMatrices");
  if(value.lowerTriangularCorrelationMatrices.isValidFlag==1)
  {
    SetCPMLowerTriangularPositiveSemidefiniteMatricesParams(packetHandle, value.lowerTriangularCorrelationMatrices, newPath);
    result = CheckLastError("CPM", gkFuncRefGet, result);
  }
  else
  {
    if( C2xIsTokenAvailable(packetHandle, "CPM", newPath) )
    {
      C2xRemoveToken(packetHandle, "CPM", newPath);
    }
  }

  snprintf(newPath, elcount(newPath), "%s.%s", oldPath, "objectDimensionZ");
  if(value.objectDimensionZ.isValidFlag==1)
  {
    SetCPMObjectDimensionParams(packetHandle, value.objectDimensionZ, newPath);
    result = CheckLastError("CPM", gkFuncRefGet, result);
  }
  else
  {
    if( C2xIsTokenAvailable(packetHandle, "CPM", newPath) )
    {
      C2xRemoveToken(packetHandle, "CPM", newPath);
    }
  }

  snprintf(newPath, elcount(newPath), "%s.%s", oldPath, "objectDimensionY");
  if(value.objectDimensionY.isValidFlag==1)
  {
    SetCPMObjectDimensionParams(packetHandle, value.objectDimensionY, newPath);
    result = CheckLastError("CPM", gkFuncRefGet, result);
  }
  else
  {
    if( C2xIsTokenAvailable(packetHandle, "CPM", newPath) )
    {
      C2xRemoveToken(packetHandle, "CPM", newPath);
    }
  }

  snprintf(newPath, elcount(newPath), "%s.%s", oldPath, "objectDimensionX");
  if(value.objectDimensionX.isValidFlag==1)
  {
    SetCPMObjectDimensionParams(packetHandle, value.objectDimensionX, newPath);
    result = CheckLastError("CPM", gkFuncRefGet, result);
  }
  else
  {
    if( C2xIsTokenAvailable(packetHandle, "CPM", newPath) )
    {
      C2xRemoveToken(packetHandle, "CPM", newPath);
    }
  }

  snprintf(newPath, elcount(newPath), "%s.%s", oldPath, "objectAge");
  if(value.objectAge.isValidFlag==1)
  {
    C2xSetTokenInt(packetHandle, "CPM", newPath, value.objectAge.value);
    result = CheckLastError("CPM", gkFuncRefGet, result);
  }
  else
  {
    if( C2xIsTokenAvailable(packetHandle, "CPM", newPath) )
    {
      C2xRemoveToken(packetHandle, "CPM", newPath);
    }
  }

  snprintf(newPath, elcount(newPath), "%s.%s", oldPath, "objectPerceptionQuality");
  if(value.objectPerceptionQuality.isValidFlag==1)
  {
    C2xSetTokenInt(packetHandle, "CPM", newPath, value.objectPerceptionQuality.value);
    result = CheckLastError("CPM", gkFuncRefGet, result);
  }
  else
  {
    if( C2xIsTokenAvailable(packetHandle, "CPM", newPath) )
    {
      C2xRemoveToken(packetHandle, "CPM", newPath);
    }
  }

  snprintf(newPath, elcount(newPath), "%s.%s", oldPath, "sensorIdList");
  if(value.sensorIdList.isValidFlag==1)
  {
    SetCPMSequenceOfIdentifier1BParams(packetHandle, value.sensorIdList, newPath);
    result = CheckLastError("CPM", gkFuncRefGet, result);
  }
  else
  {
    if( C2xIsTokenAvailable(packetHandle, "CPM", newPath) )
    {
      C2xRemoveToken(packetHandle, "CPM", newPath);
    }
  }

  snprintf(newPath, elcount(newPath), "%s.%s", oldPath, "classification");
  if(value.classification.isValidFlag==1)
  {
    SetCPMObjectClassDescriptionParams(packetHandle, value.classification, newPath);
    result = CheckLastError("CPM", gkFuncRefGet, result);
  }
  else
  {
    if( C2xIsTokenAvailable(packetHandle, "CPM", newPath) )
    {
      C2xRemoveToken(packetHandle, "CPM", newPath);
    }
  }

  snprintf(newPath, elcount(newPath), "%s.%s", oldPath, "mapPosition");
  if(value.mapPosition.isValidFlag==1)
  {
    SetCPMMapPositionParams(packetHandle, value.mapPosition, newPath);
    result = CheckLastError("CPM", gkFuncRefGet, result);
  }
  else
  {
    if( C2xIsTokenAvailable(packetHandle, "CPM", newPath) )
    {
      C2xRemoveToken(packetHandle, "CPM", newPath);
    }
  }

  return result;
}

int GetCPMPerceivedObjectsParams(LONG packetHandle, struct CPMPerceivedObjects value, char oldPath[])
{
  char newPath[300]; 
  int i;
  int result;

  result = 0;

  value.length = C2xGetTokenInt(packetHandle, "CPM", oldPath);
  if((result = CheckLastError("CPM", gkFuncRefGet, result))==0)
  {
    for(i=0; i<value.length; i++)
    {
      snprintf(newPath, elcount(newPath), "%s[%d]", oldPath, i);
      GetCPMPerceivedObjectParams(packetHandle, value.arrayValue[i], newPath);
      result = CheckLastError("CPM", gkFuncRefGet, result);
    }
  }
  return result;
}

int SetCPMPerceivedObjectsParams(LONG packetHandle, struct CPMPerceivedObjects value, char oldPath[])
{
  char newPath[300]; 
  int i;
  int result;

  result = 0;

  C2xRemoveToken(packetHandle, "CPM", oldPath);
  for(i=0; i<value.length; i++)
  {
    snprintf(newPath, elcount(newPath), "%s[%d]", oldPath, i);
    SetCPMPerceivedObjectParams(packetHandle, value.arrayValue[i], newPath);
    result = CheckLastError("CPM", gkFuncRefGet, result);
  }
  return result;
}

int GetCPMPerceivedObjectContainerParams(LONG packetHandle, struct CPMPerceivedObjectContainer value, char oldPath[])
{
  char newPath[300];
  int result;

  result = 0;

  snprintf(newPath, elcount(newPath), "%s.%s", oldPath, "numberOfPerceivedObjects");
  value.numberOfPerceivedObjects = C2xGetTokenInt(packetHandle, "CPM", newPath);
  result = CheckLastError("CPM", gkFuncRefGet, result);

  snprintf(newPath, elcount(newPath), "%s.%s", oldPath, "perceivedObjects");
  GetCPMPerceivedObjectsParams(packetHandle, value.perceivedObjects, newPath);
  result = CheckLastError("CPM", gkFuncRefGet, result);

  return result;
}

int SetCPMPerceivedObjectContainerParams(LONG packetHandle, struct CPMPerceivedObjectContainer value, char oldPath[])
{
  char newPath[300];
  int result;

  result = 0;

  snprintf(newPath, elcount(newPath), "%s.%s", oldPath, "numberOfPerceivedObjects");
  C2xSetTokenInt(packetHandle, "CPM", newPath, value.numberOfPerceivedObjects);
  result = CheckLastError("CPM", gkFuncRefGet, result);

  snprintf(newPath, elcount(newPath), "%s.%s", oldPath, "perceivedObjects");
  SetCPMPerceivedObjectsParams(packetHandle, value.perceivedObjects, newPath);
  result = CheckLastError("CPM", gkFuncRefGet, result);

  return result;
}

int GetCPMCpmContainersParams(LONG packetHandle, WORD tableKey, struct CPMCpmContainers value, char oldPath[])
{
  char newPath[300];
  int result;

  result = 0;

  switch(tableKey)
  {
    case 1:
    {
      snprintf(newPath, elcount(newPath), "%s.%s", oldPath, "originatingVehicleContainer");
      GetCPMOriginatingVehicleContainerParams(packetHandle, value.originatingVehicleContainer, newPath);
      result = CheckLastError("CPM", gkFuncRefGet, result);
    }
    break;
    case 2:
    {
      snprintf(newPath, elcount(newPath), "%s.%s", oldPath, "originatingRsuContainer");
      GetCPMOriginatingRsuContainerParams(packetHandle, value.originatingRsuContainer, newPath);
      result = CheckLastError("CPM", gkFuncRefGet, result);
    }
    break;
    case 3:
    {
      snprintf(newPath, elcount(newPath), "%s.%s", oldPath, "sensorInformationContainer");
      GetCPMSensorInformationContainerParams(packetHandle, value.sensorInformationContainer, newPath);
      result = CheckLastError("CPM", gkFuncRefGet, result);
    }
    break;
    case 4:
    {
      snprintf(newPath, elcount(newPath), "%s.%s", oldPath, "perceptionRegionContainer");
      GetCPMPerceptionRegionContainerParams(packetHandle, value.perceptionRegionContainer, newPath);
      result = CheckLastError("CPM", gkFuncRefGet, result);
    }
    break;
    case 5:
    {
      snprintf(newPath, elcount(newPath), "%s.%s", oldPath, "perceivedObjectContainer");
      GetCPMPerceivedObjectContainerParams(packetHandle, value.perceivedObjectContainer, newPath);
      result = CheckLastError("CPM", gkFuncRefGet, result);
    }
    break;
  }
  return result;
}

int SetCPMCpmContainersParams(LONG packetHandle, WORD tableKey, struct CPMCpmContainers value, char oldPath[])
{
  char newPath[300];
  int result;

  result = 0;

  switch(tableKey)
  {
    case 1:
    {
      snprintf(newPath, elcount(newPath), "%s.%s", oldPath, "originatingVehicleContainer");
      SetCPMOriginatingVehicleContainerParams(packetHandle, value.originatingVehicleContainer, newPath);
      result = CheckLastError("CPM", gkFuncRefGet, result);
    }
    break;
    case 2:
    {
      snprintf(newPath, elcount(newPath), "%s.%s", oldPath, "originatingRsuContainer");
      SetCPMOriginatingRsuContainerParams(packetHandle, value.originatingRsuContainer, newPath);
      result = CheckLastError("CPM", gkFuncRefGet, result);
    }
    break;
    case 3:
    {
      snprintf(newPath, elcount(newPath), "%s.%s", oldPath, "sensorInformationContainer");
      SetCPMSensorInformationContainerParams(packetHandle, value.sensorInformationContainer, newPath);
      result = CheckLastError("CPM", gkFuncRefGet, result);
    }
    break;
    case 4:
    {
      snprintf(newPath, elcount(newPath), "%s.%s", oldPath, "perceptionRegionContainer");
      SetCPMPerceptionRegionContainerParams(packetHandle, value.perceptionRegionContainer, newPath);
      result = CheckLastError("CPM", gkFuncRefGet, result);
    }
    break;
    case 5:
    {
      snprintf(newPath, elcount(newPath), "%s.%s", oldPath, "perceivedObjectContainer");
      SetCPMPerceivedObjectContainerParams(packetHandle, value.perceivedObjectContainer, newPath);
      result = CheckLastError("CPM", gkFuncRefGet, result);
    }
    break;
  }
  return result;
}

int GetCPMWrappedCpmContainerParams(LONG packetHandle, struct CPMWrappedCpmContainer value, char oldPath[])
{
  char newPath[300];
  int result;

  result = 0;

  snprintf(newPath, elcount(newPath), "%s.%s", oldPath, "containerId");
  value.containerId = C2xGetTokenInt(packetHandle, "CPM", newPath);
  result = CheckLastError("CPM", gkFuncRefGet, result);

  snprintf(newPath, elcount(newPath), "%s.%s", oldPath, "containerData");
  GetCPMCpmContainersParams(packetHandle, value.containerId, value.containerData, newPath);
  result = CheckLastError("CPM", gkFuncRefGet, result);

  return result;
}

int SetCPMWrappedCpmContainerParams(LONG packetHandle, struct CPMWrappedCpmContainer value, char oldPath[])
{
  char newPath[300];
  int result;

  result = 0;


  snprintf(newPath, elcount(newPath), "%s.%s", oldPath, "containerData");
  SetCPMCpmContainersParams(packetHandle, value.containerId, value.containerData, newPath);
  result = CheckLastError("CPM", gkFuncRefGet, result);

  return result;
}

int GetCPMWrappedCpmContainersParams(LONG packetHandle, struct CPMWrappedCpmContainers value, char oldPath[])
{
  char newPath[300]; 
  int i;
  int result;

  result = 0;

  value.length = C2xGetTokenInt(packetHandle, "CPM", oldPath);
  if((result = CheckLastError("CPM", gkFuncRefGet, result))==0)
  {
    for(i=0; i<value.length; i++)
    {
      snprintf(newPath, elcount(newPath), "%s[%d]", oldPath, i);
      GetCPMWrappedCpmContainerParams(packetHandle, value.arrayValue[i], newPath);
      result = CheckLastError("CPM", gkFuncRefGet, result);
    }
  }
  return result;
}

int SetCPMWrappedCpmContainersParams(LONG packetHandle, struct CPMWrappedCpmContainers value, char oldPath[])
{
  char newPath[300]; 
  int i;
  int result;

  result = 0;

  C2xRemoveToken(packetHandle, "CPM", oldPath);
  for(i=0; i<value.length; i++)
  {
    snprintf(newPath, elcount(newPath), "%s[%d]", oldPath, i);
    SetCPMWrappedCpmContainerParams(packetHandle, value.arrayValue[i], newPath);
    result = CheckLastError("CPM", gkFuncRefGet, result);
  }
  return result;
}

int GetCPMCollectivePerceptionMessageParams(LONG packetHandle, struct CPMCollectivePerceptionMessage value, char oldPath[])
{
  char newPath[300];
  int result;

  result = 0;

  snprintf(newPath, elcount(newPath), "%s.%s", oldPath, "managementContainer");
  GetCPMManagementContainerParams(packetHandle, value.managementContainer, newPath);
  result = CheckLastError("CPM", gkFuncRefGet, result);

  snprintf(newPath, elcount(newPath), "%s.%s", oldPath, "cpmContainers");
  GetCPMWrappedCpmContainersParams(packetHandle, value.cpmContainers, newPath);
  result = CheckLastError("CPM", gkFuncRefGet, result);

  return result;
}

int SetCPMCollectivePerceptionMessageParams(LONG packetHandle, struct CPMCollectivePerceptionMessage value, char oldPath[])
{
  char newPath[300];
  int result;

  result = 0;

  snprintf(newPath, elcount(newPath), "%s.%s", oldPath, "managementContainer");
  SetCPMManagementContainerParams(packetHandle, value.managementContainer, newPath);
  result = CheckLastError("CPM", gkFuncRefGet, result);

  snprintf(newPath, elcount(newPath), "%s.%s", oldPath, "cpmContainers");
  SetCPMWrappedCpmContainersParams(packetHandle, value.cpmContainers, newPath);
  result = CheckLastError("CPM", gkFuncRefGet, result);

  return result;
}

int API_GetCPMParams(LONG packetHandle, struct CPM value)
{
  int result;
  result = 0;

  value.header.isValidFlag = 1;
  GetCPMItsPduHeaderParams(packetHandle, value.header, "header");
  result = CheckLastError("CPM", gkFuncRefGet, result);

  value.cpm.isValidFlag = 1;
  GetCPMCollectivePerceptionMessageParams(packetHandle, value.cpm, "cpm");
  result = CheckLastError("CPM", gkFuncRefGet, result);

  return result;
}

int API_SetCPMParams(LONG packetHandle, struct CPM value)
{
  int result;
  result = 0;

  SetCPMItsPduHeaderParams(packetHandle, value.header, "header");
  result = CheckLastError("CPM", gkFuncRefGet, result);

  SetCPMCollectivePerceptionMessageParams(packetHandle, value.cpm, "cpm");
  result = CheckLastError("CPM", gkFuncRefGet, result);

  return result;
}

