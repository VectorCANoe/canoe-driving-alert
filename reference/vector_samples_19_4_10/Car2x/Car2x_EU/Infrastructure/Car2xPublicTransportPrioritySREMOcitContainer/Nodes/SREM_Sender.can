/*@!Encoding:1252*/
includes
{
  #include "..\DataSources_Templates\ASNV_Template_BaseDatatypes.cin"
  #include "..\DataSources_Templates\ASNV_Template_CAM.cin"
  #include "..\DataSources_Templates\ASNV_Template_SREM.cin"
}

variables
{
  struct SREM  pktSREM;
}

on start
{
  enum CallbackType { OnRx, PreTx };
  
  C2xRegisterCallback(PreTx, "OnPreTxSREM", "SREM");
  
  if(@HoldRequest::UseScenario == 1)
  {
    @sysvar::Ocit::TransitDirection = C2xGetStationAttributeInt64("HoldRequest");
    SetControlVisibility("Manual Request (HA)", "HoldRequestButton_NO", 0);
    SetControlVisibility("Manual Request (HA)", "HoldRequestButton_RIGHT", 0);
    SetControlVisibility("Manual Request (HA)", "HoldRequestButton_STRAIGHT", 0);
    SetControlVisibility("Manual Request (HA)", "HoldRequestButton_LEFT", 0);
    SetControlVisibility("Manual Request (HA)", "GroupBox", 0);
  }
  else
  {
    SetControlVisibility("Manual Request (HA)", "HoldRequestButton_NO", 1);
    SetControlVisibility("Manual Request (HA)", "HoldRequestButton_RIGHT", 1);
    SetControlVisibility("Manual Request (HA)", "HoldRequestButton_STRAIGHT", 1);
    SetControlVisibility("Manual Request (HA)", "HoldRequestButton_LEFT", 1);
    SetControlVisibility("Manual Request (HA)", "GroupBox", 1);
  }
}

//Set SysVars on Attribute Update
void OnStationAttributeTrigger(char attributeName[])
{
  if(strncmp(attributeName,"SREM", strlen(attributeName)) == 0)
  {
    @SREM::Active = C2xGetStationAttributeInt64("SREM");
  }
  
  if(strncmp(attributeName,"SREM::RequesterStationId", strlen(attributeName)) == 0)
  {
    @SREM::StationId = C2xGetStationAttributeInt64("RequesterStationId");
  }
  
  if(strncmp(attributeName,"SREM::TransitSchedule", strlen(attributeName)) == 0)
  {
    @SREM::transitSchedule = C2xGetStationAttributeInt64("TransitSchedule");
  }
  
  if(strncmp(attributeName,"SREM::ReportingPointNo", strlen(attributeName)) == 0)
  {
    @Ocit::ReportingPoint = C2xGetStationAttributeInt64("ReportingPointNo");
  }
  
  if(strncmp(attributeName,"SREM::Priority", strlen(attributeName)) == 0)
  {
    @Ocit::PriorityLevel= C2xGetStationAttributeInt64("Priority");
  }
  
  if(strncmp(attributeName,"SREM::LineNo", strlen(attributeName)) == 0)
  {
    @Ocit::Line= C2xGetStationAttributeInt64("LineNo");
  }

  if(strncmp(attributeName,"SREM::RouteNo", strlen(attributeName)) == 0)
  {
    @Ocit::Route= C2xGetStationAttributeInt64("RouteNo");
  }
  
  if(strncmp(attributeName,"SREM::DestinationNo", strlen(attributeName)) == 0)
  {
    @Ocit::Tour= C2xGetStationAttributeInt64("DestinationNo");
  }
  
  if(strncmp(attributeName,"SREM::PlatoonLength", strlen(attributeName)) == 0)
  {
    @Ocit::Length= C2xGetStationAttributeInt64("PlatoonLength");
  }
  
  if(strncmp(attributeName,"SREM::PlatoonLength", strlen(attributeName)) == 0)
  {
    @Ocit::Length= C2xGetStationAttributeInt64("PlatoonLength");
  }
  
  if(strncmp(attributeName,"SREM::Version", strlen(attributeName)) == 0)
  {
    @Ocit::Version= C2xGetStationAttributeInt64("Version");
  }
  
  
  if (strncmp(attributeName,"SREM::TransitDirection",strlen(attributeName)) == 0)
  {
  
    if(@HoldRequest::UseScenario == 1)
    {
      @Ocit::TransitDirection = C2xGetStationAttributeInt64("TransitDirection");
    }
  }
}

on sysvar_update SREM::Active
{
  if(@SREM::Active == 1) 
  {
    C2xEnableMsg("SREM");
  }
  else
  {
    C2xDisableMsg("SREM");
  }
}

// Callback function before sending SREM messages
void OnPreTxSREM(LONG packet)
{
  C2xSetTokenInt64(packet, "geo_eh", "areaPosLatitude", C2xGetStationAttributeDouble("Latitude") * 1e7);
  C2xSetTokenInt64(packet, "geo_eh", "areaPosLongitude", C2xGetStationAttributeDouble("Longitude") * 1e7);
  C2xSetTokenInt64(packet, "geo_eh", "distanceA", 400);
  
  API_GetSREMParams(packet, pktSREM);
  
  //Set Transit Schedule
  pktSREM.srm.requestor.isValidFlag= 1;
  pktSREM.srm.requestor.transitSchedule.value = @SREM::transitSchedule;

  //Set Requester Role
  pktSREM.srm.requestor.type.isValidFlag = 1;
  pktSREM.srm.requestor.type.role = 1;//public Transport
  
  //Set transit Status
  pktSREM.srm.requestor.transitStatus.isValidFlag = 1;
  pktSREM.srm.requestor.transitStatus.stringLength = 8;
  memcpy(pktSREM.srm.requestor.transitStatus.string, "00000000", pktSREM.srm.requestor.transitStatus.stringLength);
  
  //Set Ocit Container
  pktSREM.srm.requestor.ocit.line.isValidFlag= 1;
  pktSREM.srm.requestor.ocit.line.value =  @Ocit::Line;
  pktSREM.srm.requestor.ocit.route.isValidFlag = 1;
  pktSREM.srm.requestor.ocit.route.value =  @Ocit::Route;
  pktSREM.srm.requestor.ocit.reportingPoint.isValidFlag = 1;
  pktSREM.srm.requestor.ocit.reportingPoint.value = @Ocit::ReportingPoint;
  pktSREM.srm.requestor.ocit.tour.value = @Ocit::Tour;
  pktSREM.srm.requestor.ocit.priorityLevel.isValidFlag = 1;
  pktSREM.srm.requestor.ocit.priorityLevel.value = @Ocit::PriorityLevel;
  pktSREM.srm.requestor.ocit.length.isValidFlag =1;
  pktSREM.srm.requestor.ocit.length.value = @Ocit::Length;
  pktSREM.srm.requestor.ocit.direction.isValidFlag =1;
  pktSREM.srm.requestor.ocit.direction.value = @Ocit::TransitDirection;
  pktSREM.srm.requestor.ocit.Version.isValidFlag =1;
  pktSREM.srm.requestor.ocit.Version.value = @Ocit::Version;
  API_SetSREMParams(packet,pktSREM);
}

//Restart scenario
void OnScenarioStateChanged(long newState)
{
  switch(newState)
  {
    case 0: // Loaded
    {    
      break;
    }
    case 1: // Started
    {
      break;
    }
    case 2: // Stopped
    {
      C2xStartScenario();
      break;
    }
    case 3: // Completed
    {
      C2xStopScenario();
      break;
    }
  }
}

//Handling of Manual Request Panel
on sysvar Ocit::TransitDirection 
{
  switch(@Ocit::TransitDirection )
  {
    case 0:
      SetControlBackColor("Manual Request (HA)", "HoldRequestButton_NO", MakeRGB(255,255,0));
      SetControlBackColor("Manual Request (HA)", "HoldRequestButton_RIGHT", MakeRGB(255,255,255));
      SetControlBackColor("Manual Request (HA)", "HoldRequestButton_STRAIGHT", MakeRGB(255,255,255));
      SetControlBackColor("Manual Request (HA)", "HoldRequestButton_LEFT", MakeRGB(255,255,255));
      break;
    case 1:
      SetControlBackColor("Manual Request (HA)", "HoldRequestButton_NO", MakeRGB(255,255,255));
      SetControlBackColor("Manual Request (HA)", "HoldRequestButton_RIGHT", MakeRGB(255,255,255));
      SetControlBackColor("Manual Request (HA)", "HoldRequestButton_STRAIGHT", MakeRGB(255,255,0));
      SetControlBackColor("Manual Request (HA)", "HoldRequestButton_LEFT", MakeRGB(255,255,255));
      break;
    case 2:
      SetControlBackColor("Manual Request (HA)", "HoldRequestButton_NO", MakeRGB(255,255,255));
      SetControlBackColor("Manual Request (HA)", "HoldRequestButton_RIGHT", MakeRGB(255,255,255));
      SetControlBackColor("Manual Request (HA)", "HoldRequestButton_STRAIGHT", MakeRGB(255,255,255));
      SetControlBackColor("Manual Request (HA)", "HoldRequestButton_LEFT", MakeRGB(255,255,0));
      break;
    case 3:
      SetControlBackColor("Manual Request (HA)", "HoldRequestButton_NO", MakeRGB(255,255,255));
      SetControlBackColor("Manual Request (HA)", "HoldRequestButton_RIGHT", MakeRGB(255,255,0));
      SetControlBackColor("Manual Request (HA)", "HoldRequestButton_STRAIGHT", MakeRGB(255,255,255));
      SetControlBackColor("Manual Request (HA)", "HoldRequestButton_LEFT", MakeRGB(255,255,255));
      break;
  }
}

on sysvar HoldRequest::UseScenario
{
  if(@HoldRequest::UseScenario == 1)
  {
    @sysvar::Ocit::TransitDirection = C2xGetStationAttributeInt64("TransitDirection");
    SetControlVisibility("Manual Request (HA)", "HoldRequestButton_NO", 0);
    SetControlVisibility("Manual Request (HA)", "HoldRequestButton_RIGHT", 0);
    SetControlVisibility("Manual Request (HA)", "HoldRequestButton_STRAIGHT", 0);
    SetControlVisibility("Manual Request (HA)", "HoldRequestButton_LEFT", 0);
    SetControlVisibility("Manual Request (HA)", "GroupBox", 0);
  }
  else
  {
    SetControlVisibility("Manual Request (HA)", "HoldRequestButton_NO", 1);
    SetControlVisibility("Manual Request (HA)", "HoldRequestButton_RIGHT", 1);
    SetControlVisibility("Manual Request (HA)", "HoldRequestButton_STRAIGHT", 1);
    SetControlVisibility("Manual Request (HA)", "HoldRequestButton_LEFT", 1);
    SetControlVisibility("Manual Request (HA)", "GroupBox", 1);
  }
}