/*@!Encoding:65001*/
includes
{
  #include "..\DataSources_Templates\ASNV_Template_BaseDatatypes.cin"
  #include "..\DataSources_Templates\ASNV_Template_CAM.cin"
  #include "..\DataSources_Templates\ASNV_Template_SREM.cin"
}

variables
{
  // Figures of the CAPL-Map Drawining-API
  enum VEnumFigures { kSquare = 1, kRectangle = 2, kEllipse = 3, kCross = 4, kTriangle = 5, kLine = 6, kBitmap = 7, kText = 8, kVehicle = 9 };

}

on start
{ 
  enum CallbackType { OnRx, PreTx };

  C2xRegisterCallback(OnRx, "OnRxSREM", "SREM") ;  
}

void OnRxSREM(long channel, long dir, long radioChannel, long signalStrength, long signalQuality, long packet)
{
  struct SREM sremMessage;
  
  API_GetSREMParams(packet, sremMessage);
  

  DrawOcit(sremMessage);
  
  @Priority::RequesterStationId = sremMessage.srm.requestor.id.stationID;
}


void DrawOcit(struct SREM sremMessage)
{
  long objectHandleText;
  long colorCode;
  long opacity;
  word colorValue;
  char text[10];
  
  
  if(objectHandleText == 0)
  {
    objectHandleText = CreateMapObject(kText);
  }

  SetMapObjectPosition(objectHandleText   , sremMessage.srm.requestor.position.position.lat * 1e-7 - 0.0001, sremMessage.srm.requestor.position.position.lon * 1e-7 - 0.0001);
   
  snprintf(text, elcount(text), "%ld", @Ocit::ReportingPoint);
  SetMapObjectText(objectHandleText, text );
  SetMapObjectSize(objectHandleText, 30);
  
  colorValue =  @Ocit::ReportingPoint;
  colorCode = makeRGB( 255, 20, 150);
  
  SetMapObjectFillColor( objectHandleText, colorCode );
  SetMapObjectVisible( objectHandleText, 1/*visible*/);
  DrawMapObject(objectHandleText);  
}