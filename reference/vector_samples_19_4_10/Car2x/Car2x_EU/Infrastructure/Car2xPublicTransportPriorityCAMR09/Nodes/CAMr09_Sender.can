/*@!Encoding:1252*/
includes
{
  #include "..\DataSources_Templates\ASNV_Template_BaseDatatypes.cin"
  #include "..\DataSources_Templates\ASNV_Template_CAM.cin"
}

variables
{
  struct CAM pktCAM;
}

on start
{
  enum CallbackType { OnRx, PreTx };
  
  C2xRegisterCallback(PreTx, "OnPreTxCAM", "CAM");
  
  if(@HoldRequest::UseScenario == 1)
  {
    @sysvar::HoldRequest::State = C2xGetStationAttributeInt64("HoldRequest");
    SetControlVisibility("Manual Request (HA)", "HoldRequestButton_NO", 0);
    SetControlVisibility("Manual Request (HA)", "HoldRequestButton_RIGHT", 0);
    SetControlVisibility("Manual Request (HA)", "HoldRequestButton_STRAIGHT", 0);
    SetControlVisibility("Manual Request (HA)", "HoldRequestButton_LEFT", 0);
    SetControlVisibility("Manual Request (HA)", "GroupBox", 0);
  }
  else
  {
    SetControlVisibility("Manual Request (HA)", "HoldRequestButton_NO", 1);
    SetControlVisibility("Manual Request (HA)", "HoldRequestButton_RIGHT", 1);
    SetControlVisibility("Manual Request (HA)", "HoldRequestButton_STRAIGHT", 1);
    SetControlVisibility("Manual Request (HA)", "HoldRequestButton_LEFT", 1);
    SetControlVisibility("Manual Request (HA)", "GroupBox", 1);
  }

}

// Callback function before sending CAM messages 
void OnPreTxCAM(LONG packet)
{
  byte activationData[9] = { 0x00, 0x00, 0x00, 0x00, 0x00, 0x00, 0x00, 0x00, 0x00 };
  long lineNo, lineNo100, lineNo10, lineNo1;
  long destinationNo, destinationNo100, destinationNo10, destinationNo1;
  long routeNo, routeNo10, routeNo1;
  
  API_GetCAMParams(packet, pktCAM);
  
  //Check if LowFrequencyContainer is present
  if(pktCAM.cam.camParameters.lowFrequencyContainer.isValidFlag)
  {
    // Set Role
    pktCAM.cam.camParameters.lowFrequencyContainer.basicVehicleContainerLowFrequency.vehicleRole = 1;  //  publicTransport
  
    // Set Public Transport Conatiner
    pktCAM.cam.camParameters.specialVehicleContainer.isValidFlag = 1;
    pktCAM.cam.camParameters.specialVehicleContainer.choice = 0;   //  publicTransportContainer
    pktCAM.cam.camParameters.specialVehicleContainer.publicTransportContainer.embarkationStatus = 0;
    
    //Check if CAM R09 is active
    if(C2xGetStationAttributeInt64("CAMR09"))
    {
      //Calculate digits for line no
      lineNo = C2xGetStationAttributeInt64("LineNo");
      lineNo100 = lineNo / 100;
      lineNo10  = (lineNo - (100 *lineNo100)) / 10 ;
      lineNo1   = lineNo - (100 *lineNo100) - (10 * lineNo10);
      
      //Calculate digits for destination no
      destinationNo = C2xGetStationAttributeInt64("DestinationNo");
      destinationNo100 = destinationNo / 100;
      destinationNo10  = (destinationNo - (100 *destinationNo100)) / 10 ;
      destinationNo1   = destinationNo - (100 *destinationNo100) - (10 * destinationNo10);
      
      //Calculate digits for route no
      routeNo = C2xGetStationAttributeInt64("RouteNo");
      routeNo10  = routeNo / 10;
      routeNo1   = routeNo - (10 *routeNo10);
      
      //Set  r09_16CodingType
      pktCAM.cam.camParameters.specialVehicleContainer.publicTransportContainer.ptActivation.isValidFlag = 1;
      pktCAM.cam.camParameters.specialVehicleContainer.publicTransportContainer.ptActivation.ptActivationType = 1;
      
      //Set ptActivationData
      pktCAM.cam.camParameters.specialVehicleContainer.publicTransportContainer.ptActivation.ptActivationData.isValidFlag = 1;
      pktCAM.cam.camParameters.specialVehicleContainer.publicTransportContainer.ptActivation.ptActivationData.stringLength = 9;
      
      //Set OctetString
      activationData[0] = 0x91;   // R09.1x
      if(C2xGetStationAttributeInt64("TimetableDeviation") > 0)
      {
        activationData[1] = 0x86 | (C2xGetStationAttributeInt64("TimetableDeviation") << 4) & 0x70;    // Length 6 -> R09.16
      }
      else
      {
        activationData[1] =  (C2xGetStationAttributeInt64("TimetableDeviation") << 4) & 0x70;
      }
      activationData[2] = (C2xGetStationAttributeInt64("ReportingPointNo") >> 8)& 0xFF;
      
      activationData[3] = C2xGetStationAttributeInt64("ReportingPointNo") & 0xFF;
      
      activationData[4] = (C2xGetStationAttributeInt64("Priority") << 6) & 0xC0 |
                          //(C2xGetStationAttributeInt64("HoldRequest") << 4) & 0x30 | 
                          (@sysvar::HoldRequest::State << 4) & 0x30 | 
                          lineNo100 & 0x0F;
      
      activationData[5] = (lineNo10 << 4) & 0xF0 | 
                          (lineNo1) & 0x0F;           // lineNo is BCD coded (0-999)
      
      activationData[6] = (routeNo10 << 4) & 0xF0 | 
                          routeNo1& 0x0F;             // routeNo is BCD coded (0-99)
      
      activationData[7] = (destinationNo100 << 4) & 0xF0 | 
                          destinationNo10 & 0x0F;     // destinationNo is BCD coded (0-999)
      
      activationData[8] = (destinationNo1 << 4) & 0xF0 | 
                          C2xGetStationAttributeInt64("PlatoonLength") & 0x07;
      
      memcpy(pktCAM.cam.camParameters.specialVehicleContainer.publicTransportContainer.ptActivation.ptActivationData.string, 
             activationData, 
             pktCAM.cam.camParameters.specialVehicleContainer.publicTransportContainer.ptActivation.ptActivationData.stringLength);
    }
    else
    {
      pktCAM.cam.camParameters.specialVehicleContainer.publicTransportContainer.ptActivation.isValidFlag = 0;
    }
  }
  else
  {
    // send SpecialVehicleContainer only together with LowFrequencyContainer
    pktCAM.cam.camParameters.specialVehicleContainer.isValidFlag = 0;
  }

  API_SetCAMParams(packet,pktCAM);
  
  switch(@SecuritySettings::Type)
  {
    case 0: // Security Header with signed data (default)
    {    
      break;
    }
    case 1: // Scecurity Header with unsecured data
    {
      C2xSetTokenInt(packet, "wssv3", "signerType", 0);
      C2xCompletePacket(packet);
      break;
    }
    case 2: // No Security Header
    {

      break;
    }
  }
}

//Restart scenario
void OnScenarioStateChanged(long newState)
{
  switch(newState)
  {
    case 0: // Loaded
    {    
      break;
    }
    case 1: // Started
    {
      break;
    }
    case 2: // Stopped
    {
      C2xStartScenario();
      break;
    }
    case 3: // Completed
    {
      C2xStopScenario();
      break;
    }
  }
}
//Handling of Manual Request Panel
on sysvar HoldRequest::State
{
  switch(@HoldRequest::State)
  {
    case 0:
      SetControlBackColor("Manual Request (HA)", "HoldRequestButton_NO", MakeRGB(255,255,0));
      SetControlBackColor("Manual Request (HA)", "HoldRequestButton_RIGHT", MakeRGB(255,255,255));
      SetControlBackColor("Manual Request (HA)", "HoldRequestButton_STRAIGHT", MakeRGB(255,255,255));
      SetControlBackColor("Manual Request (HA)", "HoldRequestButton_LEFT", MakeRGB(255,255,255));
      break;
    case 1:
      SetControlBackColor("Manual Request (HA)", "HoldRequestButton_NO", MakeRGB(255,255,255));
      SetControlBackColor("Manual Request (HA)", "HoldRequestButton_RIGHT", MakeRGB(255,255,255));
      SetControlBackColor("Manual Request (HA)", "HoldRequestButton_STRAIGHT", MakeRGB(255,255,0));
      SetControlBackColor("Manual Request (HA)", "HoldRequestButton_LEFT", MakeRGB(255,255,255));
      break;
    case 2:
      SetControlBackColor("Manual Request (HA)", "HoldRequestButton_NO", MakeRGB(255,255,255));
      SetControlBackColor("Manual Request (HA)", "HoldRequestButton_RIGHT", MakeRGB(255,255,255));
      SetControlBackColor("Manual Request (HA)", "HoldRequestButton_STRAIGHT", MakeRGB(255,255,255));
      SetControlBackColor("Manual Request (HA)", "HoldRequestButton_LEFT", MakeRGB(255,255,0));
      break;
    case 3:
      SetControlBackColor("Manual Request (HA)", "HoldRequestButton_NO", MakeRGB(255,255,255));
      SetControlBackColor("Manual Request (HA)", "HoldRequestButton_RIGHT", MakeRGB(255,255,0));
      SetControlBackColor("Manual Request (HA)", "HoldRequestButton_STRAIGHT", MakeRGB(255,255,255));
      SetControlBackColor("Manual Request (HA)", "HoldRequestButton_LEFT", MakeRGB(255,255,255));
      break;
  }
}

on sysvar HoldRequest::UseScenario
{
  if(@HoldRequest::UseScenario == 1)
  {
    @sysvar::HoldRequest::State = C2xGetStationAttributeInt64("HoldRequest");
    SetControlVisibility("Manual Request (HA)", "HoldRequestButton_NO", 0);
    SetControlVisibility("Manual Request (HA)", "HoldRequestButton_RIGHT", 0);
    SetControlVisibility("Manual Request (HA)", "HoldRequestButton_STRAIGHT", 0);
    SetControlVisibility("Manual Request (HA)", "HoldRequestButton_LEFT", 0);
    SetControlVisibility("Manual Request (HA)", "GroupBox", 0);
  }
  else
  {
    SetControlVisibility("Manual Request (HA)", "HoldRequestButton_NO", 1);
    SetControlVisibility("Manual Request (HA)", "HoldRequestButton_RIGHT", 1);
    SetControlVisibility("Manual Request (HA)", "HoldRequestButton_STRAIGHT", 1);
    SetControlVisibility("Manual Request (HA)", "HoldRequestButton_LEFT", 1);
    SetControlVisibility("Manual Request (HA)", "GroupBox", 1);
  }
}

void OnStationAttributeTrigger(char attrName[])
{
  long stationHandle;
  char stationName[200];

  // For concrete attribute of this station
  if (strncmp(attrName,"CAMR09::HoldRequest",strlen(attrName)) == 0)
  {
    if(@HoldRequest::UseScenario == 1)
    {
      @sysvar::HoldRequest::State = C2xGetStationAttributeInt64("HoldRequest");
    }
  }
}