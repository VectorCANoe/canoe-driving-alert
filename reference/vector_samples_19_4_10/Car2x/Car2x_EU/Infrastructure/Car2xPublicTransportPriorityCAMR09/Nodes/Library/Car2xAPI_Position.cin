/*@!Encoding:1252*/
variables
{
  
  
  struct Pos3D
  {
    double latitude;
    double longitude;
    double elevation;
  };
  
  struct Pos2D
  {
    double latitude;
    double longitude;
  };
}


double API_ConvertToDeg(dword val10microDeg)
{
  return (double)val10microDeg * 1.E-7;
}

API_GetPosition(dword packet, struct Pos2D pos2d)
{
  pos2d.latitude  = API_ConvertToDeg( C2xGetTokenInt(packet, "geo_eh", "lpvLatitude" ) );
  pos2d.longitude = API_ConvertToDeg( C2xGetTokenInt(packet, "geo_eh", "lpvLongitude") );
}

API_GetGnssPosition(long channelNumber, struct Pos2D gnssPosition)
{
  struct Pos3D temp;
  
  API_GetGnssPosition(channelNumber, temp);
  gnssPosition.latitude  = temp.latitude;
  gnssPosition.longitude = temp.longitude;
}

API_GetGnssPosition(long channelNumber, struct Pos3D gnssPosition)
{
  char gnssStructName[1+5];
  char gnssMemberName[1+63];
  
  if(channelNumber < 1) return;
  
  snprintf(gnssStructName, elcount(gnssStructName), "Ath%ld", channelNumber);
  
  snprintf(gnssMemberName, elcount(gnssMemberName), "%s.Latitude", gnssStructName);
  sysGetVariableFloat("GNSS", gnssMemberName, gnssPosition.latitude);
  
  snprintf(gnssMemberName, elcount(gnssMemberName), "%s.Longitude", gnssStructName);
  sysGetVariableFloat("GNSS", gnssMemberName, gnssPosition.longitude);
  
  snprintf(gnssMemberName, elcount(gnssMemberName), "%s.Altitude", gnssStructName);
  sysGetVariableFloat("GNSS", gnssMemberName, gnssPosition.elevation);
}

long API_IsGnssPositionAvailable(struct Pos2D gnssPosition)
{
  return (gnssPosition.latitude != 0) && (gnssPosition.longitude != 0);
}

long API_IsGnssPositionAvailable(word channelNumber)
{
  struct Pos2D gnssPosition;
  
  API_GetGnssPosition(channelNumber, gnssPosition);
  
  return API_IsGnssPositionAvailable(gnssPosition);
}

////////////////////////////////////////////////////////////////////////////////
// Calc Distance
////////////////////////////////////////////////////////////////////////////////

double API_PosCalcDistance (double latPos1, double lonPos1, double latPos2, double lonPos2)
{
  const double cSphereCorrectionLongitude = 1000.0 * 71.5;
  const double cSphereCorrectionLatitude  = 1000.0 * 111.3;
    
  double  diffLon;
  double  diffLat;
    
  diffLon = (lonPos1-lonPos2) * cSphereCorrectionLongitude;
  diffLat = (latPos1-latPos2) * cSphereCorrectionLatitude;

  return sqrt( (diffLon*diffLon) + (diffLat*diffLat) );
}

double API_PosCalcDistance(struct Pos2D posA, struct Pos2D posB)
{
  return API_PosCalcDistance(posA.latitude, posA.longitude, posB.latitude, posB.longitude);
}

double API_PosCalcDistance(dword packet, struct Pos2D pos2d)
{
  struct Pos2D packet2d;

  API_GetPosition(packet, packet2d); if (C2xGetLastError()) return ~0;

  return API_PosCalcDistance(packet2d.latitude, packet2d.longitude, pos2d.latitude, pos2d.longitude);
}

double API_PosCalcDistance(dword packet, struct Pos3D pos3d)
{
  struct Pos2D packet2d;

  API_GetPosition(packet, packet2d); if (C2xGetLastError()) return ~0;

  return API_PosCalcDistance(packet2d.latitude, packet2d.longitude, pos3d.latitude, pos3d.longitude);
}

////////////////////////////////////////////////////////////////////////////////
// EOF
////////////////////////////////////////////////////////////////////////////////
