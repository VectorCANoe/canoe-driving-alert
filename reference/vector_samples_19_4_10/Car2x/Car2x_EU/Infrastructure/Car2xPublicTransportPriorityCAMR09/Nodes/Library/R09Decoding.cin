/*@!Encoding:1252*/
includes
{
  
}

variables
{
  enum ePtActivationType
  {
      undefinedCodingType = 0
    , r09_16CodingType    = 1
    , vdv_50149CodingType = 2
  };
  
  const long cR09_16Length = 9;
  
  enum etR09_HoldRequest
  {
      NO_REQUEST     = 0
    , BUTTON_STRAIGHT = 1
    , BUTTON_LEFT  = 2
    , BUTTON_RIGHT= 3
  };
  
  struct stR09_16
  {
    byte RawData[cR09_16Length];
    int   TimetableDeviation;
    word  ReportingPointNo;
    byte  Priority;
    enum etR09_HoldRequest HoldRequest;
    word LineNo;
    byte RouteNo;
    word DestNo;
    byte PlatoonLength;
  };
  
  enum etCAMStationType
  {
      UNKNOWN         =  0 // 0 : unknown
    , PEDESTRIAN      =  1 // 1 : pedestrian
    , CYCLIST         =  2 // 2 : cyclist
    , MOPED           =  3 // 3 : moped
    , MOTORCYCLE      =  4 // 4 : motorcycle
    , PASSENGERCAR    =  5 // 5 : passengerCar
    , BUS             =  6 // 6 : bus
    , LIGHTTRUCK      =  7 // 7 : lightTruck
    , HEAVYTRUCK      =  8 // 8 : heavyTruck
    , TRAILER         =  9 // 9 : trailer
    , SPECIALVEHICLES = 10 // 10 : specialVehicles
    , TRAM            = 11 // 11 : tram
    , UNDEFINED12     = 12
    , UNDEFINED13     = 13
    , UNDEFINED14     = 14
    , ROADSIDEUNIT    = 15 // 15 : roadSideUnit
  };
  
  long gMapObjectHandles[250];
  long gMapObjectCount = 0;
}

void API_R09_SetSysVars(struct CAM camMessage, struct stR09_16 r09_16)
{
  sysBeginVariableStructUpdate(sysvar::R09Decoding::R09_16);
  
  sysSetVariableData  (sysvarMember::R09Decoding::R09_16.R09_16_RawData    , r09_16.RawData, cR09_16Length);
  sysSetVariableInt   (sysvarMember::R09Decoding::R09_16.SignalStrength    , 0);
  sysSetVariableInt   (sysvarMember::R09Decoding::R09_16.StationID         , camMessage.header.stationID);
  sysSetVariableString(sysvarMember::R09Decoding::R09_16.StationType       , ((enum etCAMStationType)camMessage.cam.camParameters.basicContainer.stationType).name());
  sysSetVariableFloat (sysvarMember::R09Decoding::R09_16.Latitude          , camMessage.cam.camParameters.basicContainer.referencePosition.latitude * 1.E-7);
  sysSetVariableFloat (sysvarMember::R09Decoding::R09_16.Longitude         , camMessage.cam.camParameters.basicContainer.referencePosition.longitude * 1.E-7);
  sysSetVariableInt   (sysvarMember::R09Decoding::R09_16.EmbarkationStatus , camMessage.cam.camParameters.specialVehicleContainer.publicTransportContainer.embarkationStatus);
  
  sysSetVariableInt   (sysvarMember::R09Decoding::R09_16.R09_16_Data.TimetableDeviation, r09_16.TimetableDeviation);
  sysSetVariableInt   (sysvarMember::R09Decoding::R09_16.R09_16_Data.ReportingPointNo  , r09_16.ReportingPointNo  );
  sysSetVariableInt   (sysvarMember::R09Decoding::R09_16.R09_16_Data.LineNo            , r09_16.LineNo            );
  sysSetVariableInt   (sysvarMember::R09Decoding::R09_16.R09_16_Data.RouteNo           , r09_16.RouteNo           );
  sysSetVariableInt   (sysvarMember::R09Decoding::R09_16.R09_16_Data.DestinationNo     , r09_16.DestNo            );
  sysSetVariableInt   (sysvarMember::R09Decoding::R09_16.R09_16_Data.PlatoonLength     , r09_16.PlatoonLength     );
  sysSetVariableInt   (sysvarMember::R09Decoding::R09_16.R09_16_Data.Priority          , r09_16.Priority          );
  sysSetVariableString(sysvarMember::R09Decoding::R09_16.R09_16_Data.HoldRequest       , r09_16.HoldRequest.Name());
  
  sysEndVariableStructUpdate(sysvar::R09Decoding::R09_16);
}

void API_R09_DrawObjects(struct CAM camMessage, struct stR09_16 r09_16)
{
  long objectHandleText;
  long colorCode;
  long opacity;
  word colorValue;
  char text[1+5];
  
  if(!@ R09Decoding::DrawMeldepunkte) return;
  
  if(objectHandleText == 0)
  {
    objectHandleText = CreateMapObject(kText);
  }
  
  SetMapObjectPosition(objectHandleText   , @sysvarMember::R09Decoding::R09_16.Latitude - 0.0001, @sysvarMember::R09Decoding::R09_16.Longitude - 0.0001);
   
  snprintf(text, elcount(text), "%ld", @sysvarMember::R09Decoding::R09_16.R09_16_Data.ReportingPointNo);
  SetMapObjectText(objectHandleText, text );
  SetMapObjectSize(objectHandleText, 30);
  
  colorValue = @sysvarMember::R09Decoding::R09_16.R09_16_Data.ReportingPointNo;
  colorCode = makeRGB( 255, 20, 150);
  
  SetMapObjectFillColor( objectHandleText, colorCode );
  SetMapObjectVisible( objectHandleText, 1/*visible*/);
  DrawMapObject(objectHandleText);  
}

long API_R09_GetFromCAM(struct CAMCamParameters camContent, struct stR09_16 r09_16)
{
  struct CAMPtActivation sPtActivation; 
  
  if(!camContent.specialVehicleContainer.isValidFlag) return 0;
  
  memcpy(sPtActivation, camContent.specialVehicleContainer.publicTransportContainer.ptActivation);
  
  if(!sPtActivation.isValidFlag) return 0;
  if( sPtActivation.ptActivationType != r09_16CodingType ) return 0;
  
  if( sPtActivation.ptActivationData.stringLength != cR09_16Length )
  {
    writeLineEx(1,3,"Unexpected length of Public Transport Activation Data for R09.16: %ld, expected: %ld"
                   , sPtActivation.ptActivationData.stringLength 
                   , cR09_16Length
               );
    return 0;
  }
  
  memcpy(r09_16.RawData, sPtActivation.ptActivationData.string, cR09_16Length);
  
  r09_16.TimetableDeviation = ((r09_16.RawData[1] & 0x80)? (+1) : (-1)) * ((r09_16.RawData[1] & 0x70) >> 4);
  r09_16.ReportingPointNo = (((word)r09_16.RawData[2]) << 8) 
                          + ((word)r09_16.RawData[3]);
  
  r09_16.Priority       = (r09_16.RawData[4] & 0xC0) >> 6;
  r09_16.HoldRequest    = (enum etR09_HoldRequest) (( r09_16.RawData[4] & 0x30) >> 4);
  
  r09_16.LineNo       = ((r09_16.RawData[4] & 0x0F ) >> 0) * 100 
                      + ((r09_16.RawData[5] & 0xF0 ) >> 4) * 10 
                      + ((r09_16.RawData[5] & 0x0F ) >> 0) * 1;
  
  r09_16.RouteNo    = ((r09_16.RawData[6] & 0xF0) >> 4) * 10 
                    + ((r09_16.RawData[6] & 0x0F) >> 0) * 1;
  
  r09_16.DestNo     = ((r09_16.RawData[7] & 0xF0) >> 4) * 100 
                    + ((r09_16.RawData[7] & 0x0F) >> 0) * 10 
                    + ((r09_16.RawData[8] & 0xF0) >> 4) * 1;
  
  r09_16.PlatoonLength = r09_16.RawData[8] & 0x07;
    
  return 1;
}
