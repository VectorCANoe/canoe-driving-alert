/*@!Encoding:65001*/
includes
{
  
}

variables
{
  
}

on sysvar SecuritySettings::Type
{
  
}