/*@!Encoding:1252*/
includes
{
  #include "..\DataSources_Templates\ASNV_Template_BaseDatatypes.cin" 
  #include "..\DataSources_Templates\ASNV_Template_CAM.cin"
}

variables
{
  long gHeading = 1800;  // 360°, divide through 0.0125 to get the heading val
  long gLatitude = 488251930;
  long gLongitude = 90941940;

  int gLatCounter = 0;

  msTimer transmitCAM;
  long    gPacketHandle = 0;
  
  struct CAM gCAM;
}

/****************************************************************/
// Called on simulation start
/****************************************************************/
on start
{
  // register the pre transmit callback
  C2xRegisterCallback(1, "OnTxCAM", "CAM") ;
  setTimerCyclic(transmitCAM, 100, 100);
}

/****************************************************************/
// Timer to calculate CAM position
/****************************************************************/
on timer transmitCAM
{

  gLatitude -= 100;
  gLatCounter++;
  
  if(gLatCounter % 10 == 0)
  {
    gLongitude += 80;
    gHeading -= 3;
  }
  
  // Set values back, so that vehicles drive in a loop
  if(gLatitude <= 488234070)
  {
    gHeading = 1800;
    gLatitude = 488251930;
    gLongitude = 90941940;
    gLatCounter = 0;
  }
}

/****************************************************************/
// Callback before sending CAM
/****************************************************************/
void OnTxCAM(LONG packet)
{
  gPacketHandle = packet;
  
  C2xSetTokenInt(gPacketHandle, "geo_bh", "multiplier", 1);
  C2xSetTokenInt(gPacketHandle, "geo_bh", "base", 1);
  C2xSetTokenInt(gPacketHandle, "geo_ch", "flags", 128);
  C2xSetTokenInt(gPacketHandle, "geo_eh", "lpvPositionAccuracyIndicator", 1);
  C2xSetTokenInt(gPacketHandle, "geo_eh", "lpvHeading", gHeading);
  C2xSetTokenInt(gPacketHandle, "geo_eh", "lpvLatitude", gLatitude);
  C2xSetTokenInt(gPacketHandle, "geo_eh", "lpvLongitude", gLongitude);
  C2xSetTokenInt(gPacketHandle, "geo_eh", "areaPosLatitude", gLatitude);
  C2xSetTokenInt(gPacketHandle, "geo_eh", "areaPosLongitude", gLongitude);
    
  C2xSetTokenInt64(gPacketHandle, "CAM", "header.stationID", 2);
  C2xSetTokenInt64(gPacketHandle, "CAM", "cam.camParameters.basicContainer.stationType", 5); //Station Type is passenger car
  C2xSetTokenInt64(gPacketHandle, "CAM", "cam.camParameters.basicContainer.referencePosition.latitude", gLatitude);
  C2xSetTokenInt64(gPacketHandle, "CAM", "cam.camParameters.basicContainer.referencePosition.longitude", gLongitude);
  C2xSetTokenInt64(gPacketHandle, "CAM", "cam.camParameters.highFrequencyContainer.basicVehicleContainerHighFrequency.vehicleLength.vehicleLengthValue", 40); //length 4 m
  C2xSetTokenInt64(gPacketHandle, "CAM", "cam.camParameters.highFrequencyContainer.basicVehicleContainerHighFrequency.vehicleWidth", 20); //width 2 m
  C2xSetTokenInt64(gPacketHandle, "CAM", "cam.camParameters.highFrequencyContainer.basicVehicleContainerHighFrequency.heading.headingConfidence", 1);
  C2xSetTokenInt64(gPacketHandle, "CAM", "cam.camParameters.highFrequencyContainer.basicVehicleContainerHighFrequency.heading.headingValue", gHeading);
  C2xSetTokenInt64(gPacketHandle, "CAM", "cam.camParameters.highFrequencyContainer.basicVehicleContainerHighFrequency.speed.speedConfidence", 1);
}
