/*@!Encoding:1252*/
includes
{
  #include "..\DataSources_Templates\ASNV_Template_BaseDatatypes.cin" 
  #include "..\DataSources_Templates\ASNV_Template_CAM.cin"
}

variables
{
  long gHeading = 3600;  // 360°, divide through 0.0125 to get the heading val
  long gLatitude = 488234070;
  long gLongitude = 90943150;

  int gLatCounter = 0;
}

/****************************************************************/
// Called on simulation start
/****************************************************************/
on start
{
  // register the pre transmit callbacks
  C2xRegisterCallback(1, "OnTxCAM", "CAM") ;
  C2xRegisterCallback(1, "OnTxDENM", "DENM") ;

}

/****************************************************************/
// Callback before sending CAM
/****************************************************************/
void OnTxCAM(LONG packet)
{

  C2xSetTokenInt(packet, "geo_eh", "lpvHeading", gHeading);
  C2xSetTokenInt(packet, "geo_eh", "lpvLatitude", gLatitude);
  C2xSetTokenInt(packet, "geo_eh", "lpvLongitude", gLongitude);
  C2xSetTokenInt(packet, "geo_eh", "areaPosLatitude", gLatitude);
  C2xSetTokenInt(packet, "geo_eh", "areaPosLongitude", gLongitude);
  
  C2xSetTokenInt64(packet, "CAM", "header.protocolVersion", 2);
  C2xSetTokenInt64(packet, "CAM", "header.stationID", 1);
  
  C2xSetTokenInt64(packet, "CAM", "cam.camParameters.highFrequencyContainer.basicVehicleContainerHighFrequency.heading.headingConfidence", 1);
  C2xSetTokenInt64(packet, "CAM", "cam.camParameters.highFrequencyContainer.basicVehicleContainerHighFrequency.heading.headingValue", gHeading);
  C2xSetTokenInt64(packet, "CAM", "cam.camParameters.highFrequencyContainer.basicVehicleContainerHighFrequency.speed.speedConfidence", 1);

  C2xSetTokenInt64(packet, "CAM", "cam.camParameters.basicContainer.referencePosition.latitude", gLatitude);
  C2xSetTokenInt64(packet, "CAM", "cam.camParameters.basicContainer.referencePosition.longitude", gLongitude);
  
  gLatitude += 100;
  gLatCounter++;
  
  if(gLatCounter % 10 == 0)
  {
    gLongitude -= 80;
    gHeading -= 3;
  }
  
  // Set values back, so that vehicles drive in a loop
  if(gLatitude >= 488251930)
  {
    gHeading = 3600;
    gLatitude = 488234070;
    gLongitude = 90943150;
    gLatCounter = 0;
  }
}

/****************************************************************/
// Callback before sending DENM
/****************************************************************/
void OnTxDENM(LONG packet)
{
  int64 itsTimestamp = 0; // original time stamp
  int64 itsTS2004 = 0; // converted to 2004 format
  enum enumRefTime{en2004 = 0, en2010 = 1};
  
  C2xSetTokenInt(packet, "geo_eh", "lpvHeading", gHeading);
  C2xSetTokenInt(packet, "geo_eh", "lpvLatitude", gLatitude);
  C2xSetTokenInt(packet, "geo_eh", "lpvLongitude", gLongitude);
  C2xSetTokenInt(packet, "geo_eh", "areaPosLatitude", gLatitude);
  C2xSetTokenInt(packet, "geo_eh", "areaPosLongitude", gLongitude);
  
  C2xSetTokenInt64(packet, "DENM", "header.protocolVersion", 2);
  C2xSetTokenInt64(packet, "DENM", "header.stationID", 1);
  C2xSetTokenInt64(packet, "DENM","denm.management.actionID.originatingStationID",1);
  
  C2xSetTokenInt64(packet, "DENM", "denm.management.eventPosition.latitude", gLatitude);
  C2xSetTokenInt64(packet, "DENM", "denm.management.eventPosition.longitude", gLongitude);
  C2xSetTokenInt64(packet, "DENM", "denm.situation.eventType.causeCode", 14);

  // Get timestamp for detection and reference time 
  itsTimestamp = C2xGetITSTimestamp();
  itsTS2004 = C2xConvertTimeToMSSinceUTC(itsTimestamp, en2004);
  C2xSetTokenInt64(packet, "DENM", "denm.management.detectionTime", itsTS2004);
  C2xSetTokenInt64(packet, "DENM", "denm.management.referenceTime", itsTS2004);
}
