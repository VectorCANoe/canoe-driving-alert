/*@!Encoding:1252*/
includes
{
  #include "DrawRouteUtils.cin"
}

variables
{
  /*
    Default names of objects in scenario files (should be the same in all files).
  */
  char egoVehicle[50] = "DuT";
  char scenarioRoute[50] = "ScenarioDefinitionRoute";
  
  // Name of route and reference point for EVA scenarios
  char collisionRoute[50] = "Route_EVA";
  char collisionPoint[50] = "CollisionPoint1"; 
  
  // Name of route and reference point for AVWC scenario
  char refRoute[50] = "Route_RSU";
  char refPoint[50] = "RefPoint1";
  
  /*
    Default name of the route file and name. Values are given in the system variables.
  */
  char routeFile[255] = "";
  char loadedRoute[50] = "";
}


on start
{  
  // if route path is given relative, get it as absolute for Panel
  char absPath[256], relPath[256];
  sysGetVariableString(sysvar::RouteCtrl::FileName, relPath, elCount(relPath));
  getAbsFilePath(relPath, absPath, 256);
  sysSetVariableString(sysvar::RouteCtrl::FileName, absPath);
  
  loadScenario();
}

/********************************************************************************************************************************
****************************************************Starting Scenario************************************************************
*********************************************************************************************************************************/
void startScenarioOnRoute()
{
  int status;
  long routeHandle;
  
  // If the Scenario is running, it's stopped.
  if (C2xIsScenarioStarted())
  {
    C2xStopScenario();
  }
  // Try to start the scenario.
  else
  { 
    CleanTemporaryRoutes();
    // Check if scenario should be started relative
    if (@sysvar::ScenarioCtrl::StartScenarioRelative == 1)
    {
      write("Starting scenario relative using GNSS position.");  
      C2xResetScenario();
      status = C2xStartScenario(egoVehicle, @GNSS::Ath1.Latitude, @GNSS::Ath1.Longitude, @GNSS::Ath1.Direction);
      if (status == 1)
      {
        write("Scenario started.");
      }
      if (status == -1)
      {
        write("Error, scenario start was not successful.");
      }
      if (status == -2)
      {
        write("Error, invalid or out of range parameter specified.");
      }
      return;
    }

    write("Starting scenario on given route using GNSS position.");  
    // get the given file and route name
    sysGetVariableString(sysvar::RouteCtrl::FileName, routeFile, elCount(routeFile));
    sysGetVariableString(sysvar::RouteCtrl::RouteName, loadedRoute, elCount(loadedRoute));
    
    // try to load route from file
    if (strlen(routeFile) == 0 || strlen(loadedRoute) == 0)
    {
      write("No route given, cannot start scenario on loaded route.");
      return;
    }
    
    /****************************************************************
     *********************Step 1: Load Route*************************
     ****************************************************************/
    status = C2xLoadRoute(routeFile, loadedRoute, @sysvar::RouteCtrl::LoopFlag, routeHandle);
    if (status == -1)
    {
      write("Route File Path '%s' doesn't exist or file doesn't contain route by name '%s'", routeFile, loadedRoute);
      return;
    }
    if (status == -2)
    {
      write("Route with name '%s' was already loaded, using existing route.", loadedRoute);
    }
    else
    {    
      write("Route '%s' loaded from file '%s'.", loadedRoute, routeFile);
    }
    
      /****************************************************************
     *********************Step 2: Start Scenario on Route***********
     ****************************************************************/
    write("Starting scenario on route '%s' from current GNSS position.", loadedRoute);
  	C2xStartScenario(routeHandle, egoVehicle, @GNSS::Ath1.Latitude, @GNSS::Ath1.Longitude, @GNSS::Ath1.Direction);
  }
} 


void moveRouteRelative(char refRouteName[] , char refPointName[], int drawInMapWindow)
{
  double refPointLat, refPointLng;
  long status;
  if (C2xGetReferencePoint(refPointName, refPointLat,refPointLng) == 0)
  {
    write("Moving route '%s' relative to '%s' using reference point '%s'.", refRouteName, loadedRoute, refPointName);
    status = C2xMoveRouteRelativeToRefPoint(refRouteName, loadedRoute, refPointName);
    if (status == -1)
    {
      write("Error, route '%s' does not exist in the loaded scenario.", refRouteName);
      return;
    }
    else if (status == -2)
    {
      write("Error, scenario is still running.");
      return;
    }
    else if (status == -3)
    {
     	write("Error, offset of the refPoint is larger than remaining route length.");
      return;
    }
	  C2xGetReferencePoint(refPointName, refPointLat,refPointLng);
    write("'%s' is now at %f, %f", refPointName, refPointLat, refPointLng);
    
    if (drawInMapWindow == 1)
    {
      DrawTemporaryRouteInMapWindow(refRouteName);
      DrawReferencePointInMapWindow(refPointName);
    }
  }
  else
  {
    if (C2xGetNumberOfRoutePoints(refRouteName) > 0)
    {
      write("Route '%s' exists in the scenario, but no reference point '%s'. Please check the naming in the scenario.", refRouteName, refPointName);      
    }
  }
}
/********************************************************************************************************************************
****************************************************Control Buttons and Sysvar***************************************************
*********************************************************************************************************************************/
// Called when pressing/releasing the "Start Scenario" button
// in the "Scenario Control" panel
on sysvar ScenarioCtrl::StartBtnState
{
  if (@this == 1 /*button pressed*/)
  {
    startScenarioOnRoute();
  }
}
// Called when pressing/releasing the "Stop Scenario" button
// in the "Scenario Control" panel
on sysvar ScenarioCtrl::StopBtnState
{
  if (@this == 1 /*button pressed*/)
  {
    C2xStopScenario();
  }
}

// Called when pressing/releasing the "Draw Route" button
// in the "Scenario Control" panel
on sysvar RouteCtrl::DrawRouteBtnState
{
  if (@this == 1 /*button pressed*/)
  {
    // get the given file and route name
    sysGetVariableString(sysvar::RouteCtrl::FileName, routeFile, elCount(routeFile));
    sysGetVariableString(sysvar::RouteCtrl::RouteName, loadedRoute, elCount(loadedRoute));
    if (C2xLoadRoute(routeFile, loadedRoute, @RouteCtrl::LoopFlag) == -1)
    {
      write("Route File Path '%s' doesn't exist or file doesn't contain route by name '%s'", routeFile, loadedRoute);
      return;
    }
    DrawRouteInMapWindow(loadedRoute);
  }
}

on key 's'
{
  startScenarioOnRoute();
}

/****************************************************************
 ********************Load Scenarios******************************
 ****************************************************************/
void OnScenarioStateChanged(long newState)
{
  if (newState == 2)
  {
    write("Scenario stopped.");
  }
}

on sysvar ScenarioCtrl::ScenarioNumber
{
  loadScenario();
}

//Load Scenario file
void loadScenario()
{
  char folderName[500];
  char fileName[500];
  char scenarioFile[500];
  char scenarioName[1000];
  char slash = '/';
  
  // stop scenario if running
  if (C2xIsScenarioStarted() == 1)
  {
    C2xStopScenario();
  }
  
  // empty scenarioFile string
  snprintf(scenarioFile, elcount(scenarioFile), "");
    
  // get general foldername
  sysGetVariableString(sysvar::ScenarioCtrl::ScenarioFolderName, folderName, elcount(folderName));
  // get scenario file for current scenario number
  sysGetVariableDescriptionForValue(sysvar::ScenarioCtrl::ScenarioFileName, @ScenarioCtrl::ScenarioNumber, fileName, elcount(fileName));
  sysGetVariableDescriptionForValue(sysvar::ScenarioCtrl::ScenarioNumber, @ScenarioCtrl::ScenarioNumber, scenarioName, elcount(scenarioName));

  // concatenate string: <folderName>/<fileName>
  strncat(folderName, "/", elcount(folderName));
  strncat(scenarioFile, folderName, elcount(scenarioFile));
  strncat(scenarioFile, fileName, elcount(scenarioFile));
  // add .scn if not given
  if (mbstrstr(scenarioFile, ".scn") == -1)
  {
    strncat(scenarioFile, ".scn", elcount(scenarioFile)); 
  }
  
  // try to load scenario file for chosen scenario
  if(C2xLoadScenario(scenarioFile) == 1)
  {
    Write("Scenario %s loaded from file '%s'", scenarioName, scenarioFile);
  }
  else
  {
    Write("Loading scenario %s from file '%s' failed", scenarioName, scenarioFile);
  }
}