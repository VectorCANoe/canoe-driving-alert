/*@!Encoding:1252*/
/*
//  (c) Vector Informatik GmbH. All rights reserved.
//
//  This file contains definitions of structs and methods that may be used
//  to set and get the values of an ASN.1 defined packet's payload.
//
//  //This example demonstrates how to set a packet's payload:
//  LONG packetHandle;
//  struct CAM payload;
//  //you need to set the values of the variable "payload" yourself
//  packetHandle = API_InitCAMPacket();
//  if (packetHandle!=0) {
//    if (API_SetCAMParams(packetHandle, payload)==0) {
//      if (C2xCompletePacket(packetHandle)==0) {
//        C2xOutputPacket(packetHandle);
//      }
//    }
//  }
//                                                                             */
includes
{

}
variables
{
    struct CAMItsPduHeader {
        INT isValidFlag;   // necessary if this struct is used as an optional field of a SEQUENCE
        BYTE protocolVersion;  // INTEGER, 0..255;
        BYTE messageID;  // INTEGER, 0..255, denm(1), cam(2), poim(3), spatem(4), mapem(5), ivim(6), rfu1(7), rfu2(8), srem(9), ssem(10), evcsn(11), saem(12), rtcmem(13), cpm(14), imzm(15), vam(16), dsm(17), mim(18), mvm(19), mcm(20);
        DWORD stationID;  // INTEGER, 0..4294967295;
    };
    
    struct CAMPositionConfidenceEllipse {
        INT isValidFlag;   // necessary if this struct is used as an optional field of a SEQUENCE
        WORD semiMajorAxisLength;  // INTEGER, 0..4095, doNotUse(0), outOfRange(4094), unavailable(4095);
        WORD semiMinorAxisLength;  // INTEGER, 0..4095, doNotUse(0), outOfRange(4094), unavailable(4095);
        WORD semiMajorAxisOrientation;  // INTEGER, 0..3601, wgs84North(0), wgs84East(900), wgs84South(1800), wgs84West(2700), doNotUse(3600), unavailable(3601);
    };
    
    struct CAMAltitude {
        INT isValidFlag;   // necessary if this struct is used as an optional field of a SEQUENCE
        LONG altitudeValue;  // INTEGER, -100000..800001, negativeOutOfRange(-100000), postiveOutOfRange(800000), unavailable(800001);
        INT altitudeConfidence;  // ENUMERATED, alt_000_01(0), alt_000_02(1), alt_000_05(2), alt_000_10(3), alt_000_20(4), alt_000_50(5), alt_001_00(6), alt_002_00(7), alt_005_00(8), alt_010_00(9), alt_020_00(10), alt_050_00(11), alt_100_00(12), alt_200_00(13), outOfRange(14), unavailable(15);
    };
    
    struct CAMReferencePositionWithConfidence {
        INT isValidFlag;   // necessary if this struct is used as an optional field of a SEQUENCE
        LONG latitude;  // INTEGER, -900000000..900000001, unavailable(900000001);
        LONG longitude;  // INTEGER, -1800000000..1800000001, valueNotUsed(-1800000000), unavailable(1800000001);
        struct CAMPositionConfidenceEllipse positionConfidenceEllipse;  // SEQUENCE;
        struct CAMAltitude altitude;  // SEQUENCE;
    };
    
    struct CAMBasicContainer {
        INT isValidFlag;   // necessary if this struct is used as an optional field of a SEQUENCE
        BYTE stationType;  // INTEGER, 0..255, unknown(0), pedestrian(1), cyclist(2), moped(3), motorcycle(4), passengerCar(5), bus(6), lightTruck(7), heavyTruck(8), trailer(9), specialVehicle(10), tram(11), lightVruVehicle(12), animal(13), agricultural(14), roadSideUnit(15);
        struct CAMReferencePositionWithConfidence referencePosition;  // SEQUENCE;
    };
    
    struct CAMHeading {
        INT isValidFlag;   // necessary if this struct is used as an optional field of a SEQUENCE
        WORD headingValue;  // INTEGER, 0..3601, wgs84North(0), wgs84East(900), wgs84South(1800), wgs84West(2700), doNotUse(3600), unavailable(3601);
        BYTE headingConfidence;  // INTEGER, 1..127, outOfRange(126), unavailable(127);
    };
    
    struct CAMSpeed {
        INT isValidFlag;   // necessary if this struct is used as an optional field of a SEQUENCE
        WORD speedValue;  // INTEGER, 0..16383, standstill(0), outOfRange(16382), unavailable(16383);
        BYTE speedConfidence;  // INTEGER, 1..127, outOfRange(126), unavailable(127);
    };
    
    struct CAMVehicleLength {
        INT isValidFlag;   // necessary if this struct is used as an optional field of a SEQUENCE
        WORD vehicleLengthValue;  // INTEGER, 1..1023, outOfRange(1022), unavailable(1023);
        INT vehicleLengthConfidenceIndication;  // ENUMERATED, noTrailerPresent(0), trailerPresentWithKnownLength(1), trailerPresentWithUnknownLength(2), trailerPresenceIsUnknown(3), unavailable(4);
    };
    
    struct CAMAccelerationComponent {
        INT isValidFlag;   // necessary if this struct is used as an optional field of a SEQUENCE
        INT value;  // INTEGER, -160..161, negativeOutOfRange(-160), positiveOutOfRange(160), unavailable(161);
        BYTE confidence;  // INTEGER, 0..102, outOfRange(101), unavailable(102);
    };
    
    struct CAMCurvature {
        INT isValidFlag;   // necessary if this struct is used as an optional field of a SEQUENCE
        INT curvatureValue;  // INTEGER, -1023..1023, outOfRangeNegative(-1023), straight(0), outOfRangePositive(1022), unavailable(1023);
        INT curvatureConfidence;  // ENUMERATED, onePerMeter_0_00002(0), onePerMeter_0_0001(1), onePerMeter_0_0005(2), onePerMeter_0_002(3), onePerMeter_0_01(4), onePerMeter_0_1(5), outOfRange(6), unavailable(7);
    };
    
    struct CAMYawRate {
        INT isValidFlag;   // necessary if this struct is used as an optional field of a SEQUENCE
        INT yawRateValue;  // INTEGER, -32766..32767, negativeOutOfRange(-32766), positiveOutOfRange(32766), unavailable(32767);
        INT yawRateConfidence;  // ENUMERATED, degSec_000_01(0), degSec_000_05(1), degSec_000_10(2), degSec_001_00(3), degSec_005_00(4), degSec_010_00(5), degSec_100_00(6), outOfRange(7), unavailable(8);
    };
    
    struct CAMAccelerationControl {
        INT isValidFlag;   // necessary if this struct is used as an optional field of a SEQUENCE
        CHAR string[8];
        INT  stringLength;
    };
    
    struct CAMSteeringWheelAngle {
        INT isValidFlag;   // necessary if this struct is used as an optional field of a SEQUENCE
        INT steeringWheelAngleValue;  // INTEGER, -511..512, negativeOutOfRange(-511), positiveOutOfRange(511), unavailable(512);
        BYTE steeringWheelAngleConfidence;  // INTEGER, 1..127, outOfRange(126), unavailable(127);
    };
    
    struct CAMCenDsrcTollingZone {
        INT isValidFlag;   // necessary if this struct is used as an optional field of a SEQUENCE
        LONG protectedZoneLatitude;  // INTEGER, -900000000..900000001, unavailable(900000001);
        LONG protectedZoneLongitude;  // INTEGER, -1800000000..1800000001, valueNotUsed(-1800000000), unavailable(1800000001);
        struct OPT_DWORD_ASN cenDsrcTollingZoneId;  // INTEGER, OPTIONAL, 0..134217727;
    };
    
    struct CAMBasicVehicleContainerHighFrequency {
        INT isValidFlag;   // necessary if this struct is used as an optional field of a SEQUENCE
        struct CAMHeading heading;  // SEQUENCE;
        struct CAMSpeed speed;  // SEQUENCE;
        INT driveDirection;  // ENUMERATED, forward(0), backward(1), unavailable(2);
        struct CAMVehicleLength vehicleLength;  // SEQUENCE;
        BYTE vehicleWidth;  // INTEGER, 1..62, outOfRange(61), unavailable(62);
        struct CAMAccelerationComponent longitudinalAcceleration;  // SEQUENCE;
        struct CAMCurvature curvature;  // SEQUENCE;
        INT curvatureCalculationMode;  // ENUMERATED, yawRateUsed(0), yawRateNotUsed(1), unavailable(2);
        struct CAMYawRate yawRate;  // SEQUENCE;
        struct CAMAccelerationControl accelerationControl;  // BITSTRING, OPTIONAL;
        struct OPT_INT_ASN lanePosition;  // INTEGER, OPTIONAL, -1..14, offTheRoad(-1), innerHardShoulder(0), outerHardShoulder(14);
        struct CAMSteeringWheelAngle steeringWheelAngle;  // SEQUENCE, OPTIONAL;
        struct CAMAccelerationComponent lateralAcceleration;  // SEQUENCE, OPTIONAL;
        struct CAMAccelerationComponent verticalAcceleration;  // SEQUENCE, OPTIONAL;
        struct OPT_BYTE_ASN performanceClass;  // INTEGER, OPTIONAL, 0..7, unavailable(0), performanceClassA(1), performanceClassB(2);
        struct CAMCenDsrcTollingZone cenDsrcTollingZone;  // SEQUENCE, OPTIONAL;
    };
    
    struct CAMProtectedCommunicationZone {
        INT isValidFlag;   // necessary if this struct is used as an optional field of a SEQUENCE
        INT protectedZoneType;  // ENUMERATED, permanentCenDsrcTolling(0), temporaryCenDsrcTolling(1);
        struct OPT_QWORD_ASN expiryTime;  // INTEGER, OPTIONAL, 0..4398046511103;
        LONG protectedZoneLatitude;  // INTEGER, -900000000..900000001, unavailable(900000001);
        LONG protectedZoneLongitude;  // INTEGER, -1800000000..1800000001, valueNotUsed(-1800000000), unavailable(1800000001);
        struct OPT_BYTE_ASN protectedZoneRadius;  // INTEGER, OPTIONAL, 1..255;
        struct OPT_DWORD_ASN protectedZoneId;  // INTEGER, OPTIONAL, 0..134217727;
    };
    
    struct CAMProtectedCommunicationZonesRSU {
        INT isValidFlag;   // necessary if this struct is used as an optional field of a SEQUENCE
        INT length;
        struct CAMProtectedCommunicationZone arrayValue[16];  // SEQUENCE;
    };
    
    struct CAMRSUContainerHighFrequency {
        INT isValidFlag;   // necessary if this struct is used as an optional field of a SEQUENCE
        struct CAMProtectedCommunicationZonesRSU protectedCommunicationZonesRSU;  // SEQUENCEOF, OPTIONAL;
    };
    
    struct CAMHighFrequencyContainer {
        INT isValidFlag;   // necessary if this struct is used as an optional field of a SEQUENCE
        INT choice;
        struct CAMBasicVehicleContainerHighFrequency basicVehicleContainerHighFrequency;  // SEQUENCE;
        struct CAMRSUContainerHighFrequency rsuContainerHighFrequency;  // SEQUENCE;
    };
    
    struct CAMExteriorLights {
        INT isValidFlag;   // necessary if this struct is used as an optional field of a SEQUENCE
        CHAR string[9];
        INT  stringLength;
    };
    
    struct CAMDeltaReferencePosition {
        INT isValidFlag;   // necessary if this struct is used as an optional field of a SEQUENCE
        LONG deltaLatitude;  // INTEGER, -131071..131072, unavailable(131072);
        LONG deltaLongitude;  // INTEGER, -131071..131072, unavailable(131072);
        INT deltaAltitude;  // INTEGER, -12700..12800, negativeOutOfRange(-12700), positiveOutOfRange(12799), unavailable(12800);
    };
    
    struct CAMPathPoint {
        INT isValidFlag;   // necessary if this struct is used as an optional field of a SEQUENCE
        struct CAMDeltaReferencePosition pathPosition;  // SEQUENCE;
        struct OPT_WORD_ASN pathDeltaTime;  // INTEGER, OPTIONAL, 1..65535;
    };
    
    struct CAMPath {
        INT isValidFlag;   // necessary if this struct is used as an optional field of a SEQUENCE
        INT length;
        struct CAMPathPoint arrayValue[40];  // SEQUENCE;
    };
    
    struct CAMBasicVehicleContainerLowFrequency {
        INT isValidFlag;   // necessary if this struct is used as an optional field of a SEQUENCE
        INT vehicleRole;  // ENUMERATED, default(0), publicTransport(1), specialTransport(2), dangerousGoods(3), roadWork(4), rescue(5), emergency(6), safetyCar(7), agriculture(8), commercial(9), military(10), roadOperator(11), taxi(12), uvar(13), rfu1(14), rfu2(15);
        struct CAMExteriorLights exteriorLights;  // BITSTRING;
        struct CAMPath pathHistory;  // SEQUENCEOF;
    };
    
    struct CAMLowFrequencyContainer {
        INT isValidFlag;   // necessary if this struct is used as an optional field of a SEQUENCE
        INT choice;
        struct CAMBasicVehicleContainerLowFrequency basicVehicleContainerLowFrequency;  // SEQUENCE;
    };
    
    struct CAMPtActivationData {
        INT isValidFlag;   // necessary if this struct is used as an optional field of a SEQUENCE
        CHAR string[21];
        INT  stringLength;
    };
    
    struct CAMPtActivation {
        INT isValidFlag;   // necessary if this struct is used as an optional field of a SEQUENCE
        BYTE ptActivationType;  // INTEGER, 0..255, undefinedCodingType(0), r09_16CodingType(1), vdv_50149CodingType(2);
        struct CAMPtActivationData ptActivationData;  // OCTETSTRING;
    };
    
    struct CAMPublicTransportContainer {
        INT isValidFlag;   // necessary if this struct is used as an optional field of a SEQUENCE
        INT embarkationStatus;  // BOOLEAN;
        struct CAMPtActivation ptActivation;  // SEQUENCE, OPTIONAL;
    };
    
    struct CAMSpecialTransportType {
        INT isValidFlag;   // necessary if this struct is used as an optional field of a SEQUENCE
        CHAR string[5];
        INT  stringLength;
    };
    
    struct CAMLightBarSirenInUse {
        INT isValidFlag;   // necessary if this struct is used as an optional field of a SEQUENCE
        CHAR string[3];
        INT  stringLength;
    };
    
    struct CAMSpecialTransportContainer {
        INT isValidFlag;   // necessary if this struct is used as an optional field of a SEQUENCE
        struct CAMSpecialTransportType specialTransportType;  // BITSTRING;
        struct CAMLightBarSirenInUse lightBarSirenInUse;  // BITSTRING;
    };
    
    struct CAMDangerousGoodsContainer {
        INT isValidFlag;   // necessary if this struct is used as an optional field of a SEQUENCE
        INT dangerousGoodsBasic;  // ENUMERATED, explosives1(0), explosives2(1), explosives3(2), explosives4(3), explosives5(4), explosives6(5), flammableGases(6), nonFlammableGases(7), toxicGases(8), flammableLiquids(9), flammableSolids(10), substancesLiableToSpontaneousCombustion(11), substancesEmittingFlammableGasesUponContactWithWater(12), oxidizingSubstances(13), organicPeroxides(14), toxicSubstances(15), infectiousSubstances(16), radioactiveMaterial(17), corrosiveSubstances(18), miscellaneousDangerousSubstances(19);
    };
    
    struct CAMDrivingLaneStatus {
        INT isValidFlag;   // necessary if this struct is used as an optional field of a SEQUENCE
        CHAR string[14];
        INT  stringLength;
    };
    
    struct CAMClosedLanes {
        INT isValidFlag;   // necessary if this struct is used as an optional field of a SEQUENCE
        struct OPT_ENUM_ASN innerhardShoulderStatus;  // ENUMERATED, OPTIONAL, availableForStopping(0), closed(1), availableForDriving(2);
        struct OPT_ENUM_ASN outerhardShoulderStatus;  // ENUMERATED, OPTIONAL, availableForStopping(0), closed(1), availableForDriving(2);
        struct CAMDrivingLaneStatus drivingLaneStatus;  // BITSTRING, OPTIONAL;
    };
    
    struct CAMRoadWorksContainerBasic {
        INT isValidFlag;   // necessary if this struct is used as an optional field of a SEQUENCE
        struct OPT_BYTE_ASN roadworksSubCauseCode;  // INTEGER, OPTIONAL, 0..255, unavailable(0), majorRoadworks(1), roadMarkingWork(2), slowMovingRoadMaintenance(3), shortTermStationaryRoadworks(4), streetCleaning(5), winterService(6), setupPhase(7), remodellingPhase(8), dismantlingPhase(9);
        struct CAMLightBarSirenInUse lightBarSirenInUse;  // BITSTRING;
        struct CAMClosedLanes closedLanes;  // SEQUENCE, OPTIONAL;
    };
    
    struct CAMRescueContainer {
        INT isValidFlag;   // necessary if this struct is used as an optional field of a SEQUENCE
        struct CAMLightBarSirenInUse lightBarSirenInUse;  // BITSTRING;
    };
    
    struct CAMCauseCode {
        INT isValidFlag;   // necessary if this struct is used as an optional field of a SEQUENCE
        BYTE causeCode;  // INTEGER, 0..255, reserved(0), trafficCondition(1), accident(2), roadworks(3), impassability(5), adverseWeatherCondition_Adhesion(6), aquaplannning(7), hazardousLocation_SurfaceCondition(9), hazardousLocation_ObstacleOnTheRoad(10), hazardousLocation_AnimalOnTheRoad(11), humanPresenceOnTheRoad(12), wrongWayDriving(14), rescueAndRecoveryWorkInProgress(15), adverseWeatherCondition_ExtremeWeatherCondition(17), adverseWeatherCondition_Visibility(18), adverseWeatherCondition_Precipitation(19), violence(20), slowVehicle(26), dangerousEndOfQueue(27), publicTransportVehicleApproaching(28), dontPanic(42), vehicleBreakdown(91), postCrash(92), humanProblem(93), stationaryVehicle(94), emergencyVehicleApproaching(95), hazardousLocation_DangerousCurve(96), collisionRisk(97), signalViolation(98), dangerousSituation(99), railwayCrossing (100);
        BYTE subCauseCode;  // INTEGER, 0..255;
    };
    
    struct CAMEmergencyPriority {
        INT isValidFlag;   // necessary if this struct is used as an optional field of a SEQUENCE
        CHAR string[3];
        INT  stringLength;
    };
    
    struct CAMEmergencyContainer {
        INT isValidFlag;   // necessary if this struct is used as an optional field of a SEQUENCE
        struct CAMLightBarSirenInUse lightBarSirenInUse;  // BITSTRING;
        struct CAMCauseCode incidentIndication;  // SEQUENCE, OPTIONAL;
        struct CAMEmergencyPriority emergencyPriority;  // BITSTRING, OPTIONAL;
    };
    
    struct CAMSafetyCarContainer {
        INT isValidFlag;   // necessary if this struct is used as an optional field of a SEQUENCE
        struct CAMLightBarSirenInUse lightBarSirenInUse;  // BITSTRING;
        struct CAMCauseCode incidentIndication;  // SEQUENCE, OPTIONAL;
        struct OPT_ENUM_ASN trafficRule;  // ENUMERATED, OPTIONAL, noPassing(0), noPassingForTrucks(1), passToRight(2), passToLeft(3), passToLeftOrRight(4);
        struct OPT_BYTE_ASN speedLimit;  // INTEGER, OPTIONAL, 1..255;
    };
    
    struct CAMSpecialVehicleContainer {
        INT isValidFlag;   // necessary if this struct is used as an optional field of a SEQUENCE
        INT choice;
        struct CAMPublicTransportContainer publicTransportContainer;  // SEQUENCE;
        struct CAMSpecialTransportContainer specialTransportContainer;  // SEQUENCE;
        struct CAMDangerousGoodsContainer dangerousGoodsContainer;  // SEQUENCE;
        struct CAMRoadWorksContainerBasic roadWorksContainerBasic;  // SEQUENCE;
        struct CAMRescueContainer rescueContainer;  // SEQUENCE;
        struct CAMEmergencyContainer emergencyContainer;  // SEQUENCE;
        struct CAMSafetyCarContainer safetyCarContainer;  // SEQUENCE;
    };
    
    struct CAMCyclistTypeSpecificInformation {
        INT isValidFlag;   // necessary if this struct is used as an optional field of a SEQUENCE
        struct OPT_BYTE_ASN vruSubProfileBicyclist;  // INTEGER, OPTIONAL, 0..15, unavailable(0), bicyclist(1), wheelchair_user(2), horse_and_rider(3), rollerskater(4), e_scooter(5), personal_transporter(6), pedelec(7), speed_pedelec(8), roadbike(9), childrensbike(10);
        struct OPT_BYTE_ASN vruMovementControl;  // INTEGER, OPTIONAL, 0..15, unavailable(0), braking(1), hardBraking(2), stopPedaling(3), brakingAndStopPedaling(4), hardBrakingAndStopPedaling(5), noReaction(6);
    };
    
    struct CAMTwoWheelerTypeSpecificInformation {
        INT isValidFlag;   // necessary if this struct is used as an optional field of a SEQUENCE
        INT choice;
        struct CAMCyclistTypeSpecificInformation cyclist;  // SEQUENCE;
    };
    
    struct CAMCartesianAngle {
        INT isValidFlag;   // necessary if this struct is used as an optional field of a SEQUENCE
        WORD value;  // INTEGER, 0..3601, valueNotUsed(3600), unavailable(3601);
        BYTE confidence;  // INTEGER, 1..127, outOfRange(126), unavailable(127);
    };
    
    struct CAMWgs84Angle {
        INT isValidFlag;   // necessary if this struct is used as an optional field of a SEQUENCE
        WORD value;  // INTEGER, 0..3601, wgs84North(0), wgs84East(900), wgs84South(1800), wgs84West(2700), doNotUse(3600), unavailable(3601);
        BYTE confidence;  // INTEGER, 1..127, outOfRange(126), unavailable(127);
    };
    
    struct CAMStabilityChangeIndication {
        INT isValidFlag;   // necessary if this struct is used as an optional field of a SEQUENCE
        BYTE lossProbability;  // INTEGER, 0..63, stable(0), totalLossOfStability(50), unavailable(63);
        BYTE actionDeltaTime;  // INTEGER, 0..127, unavailable(127);
    };
    
    struct CAMTwoWheelerContainer {
        INT isValidFlag;   // necessary if this struct is used as an optional field of a SEQUENCE
        struct CAMTwoWheelerTypeSpecificInformation typeSpecificInformation;  // CHOICE, OPTIONAL;
        struct CAMCartesianAngle rollAngle;  // SEQUENCE, OPTIONAL;
        struct CAMWgs84Angle orientation;  // SEQUENCE, OPTIONAL;
        struct CAMStabilityChangeIndication stabilityChangeIndication;  // SEQUENCE, OPTIONAL;
    };
    
    struct CAMDeltaPosition {
        INT isValidFlag;   // necessary if this struct is used as an optional field of a SEQUENCE
        LONG deltaLatitude;  // INTEGER, -131071..131072, unavailable(131072);
        LONG deltaLongitude;  // INTEGER, -131071..131072, unavailable(131072);
    };
    
    struct CAMDeltaPositions {
        INT isValidFlag;   // necessary if this struct is used as an optional field of a SEQUENCE
        INT length;
        struct CAMDeltaPosition arrayValue[32];  // SEQUENCE;
    };
    
    struct CAMDeltaReferencePositions {
        INT isValidFlag;   // necessary if this struct is used as an optional field of a SEQUENCE
        INT length;
        struct CAMDeltaReferencePosition arrayValue[32];  // SEQUENCE;
    };
    
    struct CAMGeoPositionWoAltitude {
        INT isValidFlag;   // necessary if this struct is used as an optional field of a SEQUENCE
        LONG latitude;  // INTEGER, -900000000..900000001, unavailable(900000001);
        LONG longitude;  // INTEGER, -1800000000..1800000001, valueNotUsed(-1800000000), unavailable(1800000001);
    };
    
    struct CAMGeoPositionsWoAltitude {
        INT isValidFlag;   // necessary if this struct is used as an optional field of a SEQUENCE
        INT length;
        struct CAMGeoPositionWoAltitude arrayValue[8];  // SEQUENCE;
    };
    
    struct CAMGeoPositionWAltitude {
        INT isValidFlag;   // necessary if this struct is used as an optional field of a SEQUENCE
        LONG latitude;  // INTEGER, -900000000..900000001, unavailable(900000001);
        LONG longitude;  // INTEGER, -1800000000..1800000001, valueNotUsed(-1800000000), unavailable(1800000001);
        struct CAMAltitude altitude;  // SEQUENCE;
    };
    
    struct CAMGeoPositionsWAltitude {
        INT isValidFlag;   // necessary if this struct is used as an optional field of a SEQUENCE
        INT length;
        struct CAMGeoPositionWAltitude arrayValue[8];  // SEQUENCE;
    };
    
    struct CAMPolygonalLine {
        INT isValidFlag;   // necessary if this struct is used as an optional field of a SEQUENCE
        INT choice;
        struct CAMDeltaPositions deltaPositions;  // SEQUENCEOF;
        struct CAMDeltaReferencePositions deltaPositionsWithAltitude;  // SEQUENCEOF;
        struct CAMGeoPositionsWoAltitude absolutePositions;  // SEQUENCEOF;
        struct CAMGeoPositionsWAltitude absolutePositionsWithAltitude;  // SEQUENCEOF;
    };
    
    struct CAMConfidenceLevels {
        INT isValidFlag;   // necessary if this struct is used as an optional field of a SEQUENCE
        INT length;
        BYTE arrayValue[32];  // INTEGER, 1..101, unavailable(101);
    };
    
    struct CAMBasicLaneInformation {
        INT isValidFlag;   // necessary if this struct is used as an optional field of a SEQUENCE
        INT laneNumber;  // INTEGER, -1..14, offTheRoad(-1), innerHardShoulder(0), outerHardShoulder(14);
        BYTE direction;  // INTEGER, 0..3, sameDirection(0), oppositeDirection(1), bothDirections(2), unavailable(3);
        struct OPT_WORD_ASN laneWidth;  // INTEGER, OPTIONAL, 0..1023;
        struct OPT_INT_ASN connectingLane;  // INTEGER, OPTIONAL, -1..14, offTheRoad(-1), innerHardShoulder(0), outerHardShoulder(14);
        struct OPT_BYTE_ASN connectingRoadSection;  // INTEGER, OPTIONAL, 0..8;
    };
    
    struct CAMBasicLaneConfiguration {
        INT isValidFlag;   // necessary if this struct is used as an optional field of a SEQUENCE
        INT length;
        struct CAMBasicLaneInformation arrayValue[16];  // SEQUENCE;
    };
    
    struct CAMSensorTypes {
        INT isValidFlag;   // necessary if this struct is used as an optional field of a SEQUENCE
        CHAR string[17];
        INT  stringLength;
    };
    
    struct CAMStoredInformationType {
        INT isValidFlag;   // necessary if this struct is used as an optional field of a SEQUENCE
        CHAR string[9];
        INT  stringLength;
    };
    
    struct CAMMetaInformation {
        INT isValidFlag;   // necessary if this struct is used as an optional field of a SEQUENCE
        struct CAMSensorTypes usedDetectionInformation;  // BITSTRING;
        struct CAMStoredInformationType usedStoredInformation;  // BITSTRING;
        struct OPT_BYTE_ASN confidenceValue;  // INTEGER, OPTIONAL, 1..101, unavailable(101);
    };
    
    struct CAMEHorizonLocationSharingContainer {
        INT isValidFlag;   // necessary if this struct is used as an optional field of a SEQUENCE
        struct CAMPolygonalLine segmentAhead;  // CHOICE;
        struct CAMConfidenceLevels nodeProbabilities;  // SEQUENCEOF, OPTIONAL;
        struct CAMPolygonalLine segmentBehind;  // CHOICE;
        struct CAMBasicLaneConfiguration laneLevelDetails;  // SEQUENCEOF, OPTIONAL;
        struct CAMMetaInformation segmentSource;  // SEQUENCE, OPTIONAL;
    };
    
    struct CAMBrakeControl {
        INT isValidFlag;   // necessary if this struct is used as an optional field of a SEQUENCE
        CHAR string[4];
        INT  stringLength;
    };
    
    struct CAMVeryLowFrequencyContainer {
        INT isValidFlag;   // necessary if this struct is used as an optional field of a SEQUENCE
        struct OPT_BYTE_ASN vehicleHeight;  // INTEGER, OPTIONAL, 1..62, outOfRange(61), unavailable(62);
        struct OPT_BYTE_ASN wiperStatus;  // INTEGER, OPTIONAL, 0..7, unavailable(0), off(1), intermittent(2), low(3), high(4);
        struct CAMBrakeControl brakeControl;  // BITSTRING, OPTIONAL;
    };
    
    struct CAMPosConfidenceEllipse {
        INT isValidFlag;   // necessary if this struct is used as an optional field of a SEQUENCE
        WORD semiMajorConfidence;  // INTEGER, 0..4095, doNotUse(0), outOfRange(4094), unavailable(4095);
        WORD semiMinorConfidence;  // INTEGER, 0..4095, doNotUse(0), outOfRange(4094), unavailable(4095);
        WORD semiMajorOrientation;  // INTEGER, 0..3601, wgs84North(0), wgs84East(900), wgs84South(1800), wgs84West(2700), doNotUse(3600), unavailable(3601);
    };
    
    struct CAMPathDeltaTimeChoice {
        INT isValidFlag;   // necessary if this struct is used as an optional field of a SEQUENCE
        INT choice;
        BYTE deltaTimeHighPrecision;  // INTEGER, 0..127, unavailable(127);
        BYTE deltaTimeBigRange;  // INTEGER, 0..127;
        DWORD deltaTimeMidRange;  // INTEGER, 0..86400;
    };
    
    struct CAMPathPointPredicted {
        INT isValidFlag;   // necessary if this struct is used as an optional field of a SEQUENCE
        LONG deltaLatitude;  // INTEGER, -131071..131072, unavailable(131072);
        LONG deltaLongitude;  // INTEGER, -131071..131072, unavailable(131072);
        struct CAMPosConfidenceEllipse horizontalPositionConfidence;  // SEQUENCE, OPTIONAL;
        struct OPT_INT_ASN deltaAltitude;  // INTEGER, OPTIONAL, -12700..12800, negativeOutOfRange(-12700), positiveOutOfRange(12799), unavailable(12800);
        struct OPT_ENUM_ASN altitudeConfidence;  // ENUMERATED, OPTIONAL, alt_000_01(0), alt_000_02(1), alt_000_05(2), alt_000_10(3), alt_000_20(4), alt_000_50(5), alt_001_00(6), alt_002_00(7), alt_005_00(8), alt_010_00(9), alt_020_00(10), alt_050_00(11), alt_100_00(12), alt_200_00(13), outOfRange(14), unavailable(15);
        struct CAMPathDeltaTimeChoice pathDeltaTime;  // CHOICE, OPTIONAL;
        struct OPT_WORD_ASN symmetricAreaOffset;  // INTEGER, OPTIONAL, 0..511;
        struct OPT_WORD_ASN asymmetricAreaOffset;  // INTEGER, OPTIONAL, 0..511;
    };
    
    struct CAMPathPredicted {
        INT isValidFlag;   // necessary if this struct is used as an optional field of a SEQUENCE
        INT length;
        struct CAMPathPointPredicted arrayValue[16];  // SEQUENCE;
    };
    
    struct CAMPathPredicted2 {
        INT isValidFlag;   // necessary if this struct is used as an optional field of a SEQUENCE
        struct CAMPathPredicted pathPredicted;  // SEQUENCEOF;
        INT usageIndication;  // ENUMERATED, noIndication(0), specialUse(1), rescueOperation(2), railroad(3), fixedRoute(4), restrictedRoute(5), adasAd(6), navigation(7);
        BYTE confidenceLevel;  // INTEGER, 1..101, unavailable(101);
    };
    
    struct CAMPathPredictedList {
        INT isValidFlag;   // necessary if this struct is used as an optional field of a SEQUENCE
        INT length;
        struct CAMPathPredicted2 arrayValue[16];  // SEQUENCE;
    };
    
    struct CAMPathPredictionContainer {
        INT isValidFlag;   // necessary if this struct is used as an optional field of a SEQUENCE
        struct CAMPathPredictedList pathPredictedList;  // SEQUENCEOF;
    };
    
    struct CAMLanePositionAndType {
        INT isValidFlag;   // necessary if this struct is used as an optional field of a SEQUENCE
        INT transversalPosition;  // INTEGER, -1..14, offTheRoad(-1), innerHardShoulder(0), outerHardShoulder(14);
        struct OPT_BYTE_ASN laneType;  // INTEGER, OPTIONAL, 0..31, traffic(0), through(1), reversible(2), acceleration(3), deceleration(4), leftHandTurning(5), rightHandTurning(6), dedicatedVehicle(7), bus(8), taxi(9), hov(10), hot(11), pedestrian(12), cycleLane(13), median(14), striping(15), trackedVehicle(16), parking(17), emergency(18), verge(19), minimumRiskManoeuvre(20), exclusiveCycleLane(21), unknown(31);
        struct OPT_BYTE_ASN direction;  // INTEGER, OPTIONAL, 0..3, sameDirection(0), oppositeDirection(1), bothDirections(2), unavailable(3);
    };
    
    struct CAMLanePositionWithLateralDetails {
        INT isValidFlag;   // necessary if this struct is used as an optional field of a SEQUENCE
        INT transversalPosition;  // INTEGER, -1..14, offTheRoad(-1), innerHardShoulder(0), outerHardShoulder(14);
        struct OPT_BYTE_ASN laneType;  // INTEGER, OPTIONAL, 0..31, traffic(0), through(1), reversible(2), acceleration(3), deceleration(4), leftHandTurning(5), rightHandTurning(6), dedicatedVehicle(7), bus(8), taxi(9), hov(10), hot(11), pedestrian(12), cycleLane(13), median(14), striping(15), trackedVehicle(16), parking(17), emergency(18), verge(19), minimumRiskManoeuvre(20), exclusiveCycleLane(21), unknown(31);
        struct OPT_BYTE_ASN direction;  // INTEGER, OPTIONAL, 0..3, sameDirection(0), oppositeDirection(1), bothDirections(2), unavailable(3);
        WORD distanceToLeftBorder;  // INTEGER, 0..511;
        WORD distanceToRightBorder;  // INTEGER, 0..511;
    };
    
    struct CAMTrafficIslandPosition {
        INT isValidFlag;   // necessary if this struct is used as an optional field of a SEQUENCE
        struct CAMLanePositionAndType oneSide;  // SEQUENCE;
        struct CAMLanePositionAndType otherSide;  // SEQUENCE;
    };
    
    struct CAMLanePositionOptions {
        INT isValidFlag;   // necessary if this struct is used as an optional field of a SEQUENCE
        INT choice;
        INT simplelanePosition;  // INTEGER, -1..14, offTheRoad(-1), innerHardShoulder(0), outerHardShoulder(14);
        BYTE simpleLaneType;  // INTEGER, 0..31, traffic(0), through(1), reversible(2), acceleration(3), deceleration(4), leftHandTurning(5), rightHandTurning(6), dedicatedVehicle(7), bus(8), taxi(9), hov(10), hot(11), pedestrian(12), cycleLane(13), median(14), striping(15), trackedVehicle(16), parking(17), emergency(18), verge(19), minimumRiskManoeuvre(20), exclusiveCycleLane(21), unknown(31);
        struct CAMLanePositionAndType detailedlanePosition;  // SEQUENCE;
        struct CAMLanePositionWithLateralDetails lanePositionWithLateralDetails;  // SEQUENCE;
        struct CAMTrafficIslandPosition trafficIslandPosition;  // SEQUENCE;
    };
    
    struct CAMRoadSegmentReferenceId {
        INT isValidFlag;   // necessary if this struct is used as an optional field of a SEQUENCE
        struct OPT_WORD_ASN region;  // INTEGER, OPTIONAL, 0..65535;
        WORD id;  // INTEGER, 0..65535;
    };
    
    struct CAMIntersectionReferenceId {
        INT isValidFlag;   // necessary if this struct is used as an optional field of a SEQUENCE
        struct OPT_WORD_ASN region;  // INTEGER, OPTIONAL, 0..65535;
        WORD id;  // INTEGER, 0..65535;
    };
    
    struct CAMMapReference {
        INT isValidFlag;   // necessary if this struct is used as an optional field of a SEQUENCE
        INT choice;
        struct CAMRoadSegmentReferenceId roadsegment;  // SEQUENCE;
        struct CAMIntersectionReferenceId intersection;  // SEQUENCE;
    };
    
    struct CAMLongitudinalLanePosition {
        INT isValidFlag;   // necessary if this struct is used as an optional field of a SEQUENCE
        WORD longitudinalLanePositionValue;  // INTEGER, 0..32767, outOfRange(32766), unavailable(32767);
        WORD longitudinalLanePositionConfidence;  // INTEGER, 0..1023, outOfRange(1022), unavailable(1023);
    };
    
    struct CAMMapPosition {
        INT isValidFlag;   // necessary if this struct is used as an optional field of a SEQUENCE
        struct CAMMapReference mapReference;  // CHOICE, OPTIONAL;
        struct OPT_BYTE_ASN laneId;  // INTEGER, OPTIONAL, 0..255;
        struct OPT_BYTE_ASN connectionId;  // INTEGER, OPTIONAL, 0..255;
        struct CAMLongitudinalLanePosition longitudinalLanePosition;  // SEQUENCE, OPTIONAL;
    };
    
    struct CAMGeneralizedLanePosition {
        INT isValidFlag;   // necessary if this struct is used as an optional field of a SEQUENCE
        struct CAMLanePositionOptions lanePositionBased;  // CHOICE;
        struct CAMMapPosition mapBased;  // SEQUENCE, OPTIONAL;
        struct CAMMetaInformation confidence;  // SEQUENCE;
    };
    
    struct CAMGeneralizedLanePositions {
        INT isValidFlag;   // necessary if this struct is used as an optional field of a SEQUENCE
        INT length;
        struct CAMGeneralizedLanePosition arrayValue[4];  // SEQUENCE;
    };
    
    struct CAMGeneralizedLanePositionsContainer {
        INT isValidFlag;   // necessary if this struct is used as an optional field of a SEQUENCE
        struct CAMGeneralizedLanePositions generalizedLanePositions;  // SEQUENCEOF;
    };
    
    struct CAMPedalStatus {
        INT isValidFlag;   // necessary if this struct is used as an optional field of a SEQUENCE
        BYTE pedalPositionValue;  // INTEGER, 0..11, notPressed(0), fullyPressed(10), unavailable(11);
    };
    
    struct CAMAutomationControl {
        INT isValidFlag;   // necessary if this struct is used as an optional field of a SEQUENCE
        CHAR string[7];
        INT  stringLength;
    };
    
    struct CAMAccelerationControlExtension {
        INT isValidFlag;   // necessary if this struct is used as an optional field of a SEQUENCE
        CHAR string[4];
        INT  stringLength;
    };
    
    struct CAMVehicleMovementControl {
        INT isValidFlag;   // necessary if this struct is used as an optional field of a SEQUENCE
        struct CAMPedalStatus accelerationPedalStatus;  // SEQUENCE;
        struct CAMPedalStatus brakePedalStatus;  // SEQUENCE;
        struct OPT_BYTE_ASN saeAutomationLevel;  // INTEGER, OPTIONAL, 0..5;
        struct CAMAutomationControl automationControl;  // BITSTRING, OPTIONAL;
        struct CAMAccelerationControl accelerationControl;  // BITSTRING, OPTIONAL;
        struct CAMAccelerationControlExtension accelerationControlExtension;  // BITSTRING, OPTIONAL;
    };
    
    struct CAMVehicleMovementControlContainer {
        INT isValidFlag;   // necessary if this struct is used as an optional field of a SEQUENCE
        struct CAMVehicleMovementControl vehicleMovementControl;  // SEQUENCE;
    };
    
    struct CAMExtensionContainers {
        struct CAMTwoWheelerContainer twoWheelerContainer;  // SEQUENCE;
        struct CAMEHorizonLocationSharingContainer eHorizonLocationSharingContainer;  // SEQUENCE;
        struct CAMVeryLowFrequencyContainer veryLowFrequencyContainer;  // SEQUENCE;
        struct CAMPathPredictionContainer pathPredictionContainer;  // SEQUENCE;
        struct CAMGeneralizedLanePositionsContainer generalizedLanePositionsContainer;  // SEQUENCE;
        struct CAMVehicleMovementControlContainer vehicleMovementControlContainer;  // SEQUENCE;
    };
    
    struct CAMWrappedExtensionContainer {
        INT isValidFlag;   // necessary if this struct is used as an optional field of a SEQUENCE
        BYTE containerId;  // INTEGER, 1..16, twoWheelerContainer(1), eHorizonLocationSharingContainer(2), veryLowFrequencyContainer(3), pathPredictionContainer(4), generalizedLanePositionsContainer(5), vehicleMovementControlContainer(6);
        struct CAMExtensionContainers containerData;  // TABLE;
    };
    
    struct CAMWrappedExtensionContainers {
        INT isValidFlag;   // necessary if this struct is used as an optional field of a SEQUENCE
        INT length;
        struct CAMWrappedExtensionContainer arrayValue[8];  // SEQUENCE;
    };
    
    struct CAMCamParameters {
        INT isValidFlag;   // necessary if this struct is used as an optional field of a SEQUENCE
        struct CAMBasicContainer basicContainer;  // SEQUENCE;
        struct CAMHighFrequencyContainer highFrequencyContainer;  // CHOICE;
        struct CAMLowFrequencyContainer lowFrequencyContainer;  // CHOICE, OPTIONAL;
        struct CAMSpecialVehicleContainer specialVehicleContainer;  // CHOICE, OPTIONAL;
        struct CAMWrappedExtensionContainers extensionContainers;  // SEQUENCEOF, OPTIONAL;
    };
    
    struct CAMCamPayload {
        INT isValidFlag;   // necessary if this struct is used as an optional field of a SEQUENCE
        WORD generationDeltaTime;  // INTEGER, 0..65535, oneMilliSec(1);
        struct CAMCamParameters camParameters;  // SEQUENCE;
    };
    
    struct CAM {
        INT isValidFlag;   // necessary if this struct is used as an optional field of a SEQUENCE
        struct CAMItsPduHeader header;  // SEQUENCE;
        struct CAMCamPayload cam;  // SEQUENCE;
    };
    
}

/*
// init function to create a simple packet handle
*/ 
LONG API_InitCAMPacket()
{
  return C2xInitPacket("CAM"); 
}

/*
// init function to create a simple packet handle and
// initialize the struct with valid data
*/ 
LONG API_InitCAMPacket(struct CAM msgStruct)
{
  long pktHandle;

  pktHandle = API_InitCAMPacket();

  if (pktHandle != 0)
  {
    // create valid message and application data
    if (C2xCompletePacket(pktHandle) == 0) 
    {
      API_GetCAMParams(pktHandle, msgStruct);
    }
  }
  return pktHandle;
}

/*
// init function to create a packet with security layer and
// initialize the struct with valid data
*/ 
LONG API_InitCAMPacket(struct CAM msgStruct, char packetTypeDesignator[], char certificateName[])
{
  long pktHandle, certHdl;

  // initialize the packet
  pktHandle = C2xInitPacket("CAM", packetTypeDesignator);

  if (pktHandle != 0)
  {
    certHdl = C2xSecCertificateGetHandle(certificateName);  // get the certificate handle for the cert with name "certificateName"
    if (certHdl != 0) 
    {
      C2xSecPacketSetSignerHandle(pktHandle, certHdl); // set the certHdl to the packet
    }

    // create valid message and application data
    if (C2xCompletePacket(pktHandle) == 0) 
    {
      // copy application data to the application structure
      API_GetCAMParams(pktHandle, msgStruct);
    }
  }
  return pktHandle;
}
    

int GetCAMItsPduHeaderParams(LONG packetHandle, struct CAMItsPduHeader value, char oldPath[])
{
  char newPath[300];
  int result;

  result = 0;

  snprintf(newPath, elcount(newPath), "%s.%s", oldPath, "protocolVersion");
  value.protocolVersion = C2xGetTokenInt(packetHandle, "CAM", newPath);
  result = CheckLastError("CAM", gkFuncRefGet, result);

  snprintf(newPath, elcount(newPath), "%s.%s", oldPath, "messageID");
  value.messageID = C2xGetTokenInt(packetHandle, "CAM", newPath);
  result = CheckLastError("CAM", gkFuncRefGet, result);

  snprintf(newPath, elcount(newPath), "%s.%s", oldPath, "stationID");
  value.stationID = C2xGetTokenInt64(packetHandle, "CAM", newPath);
  result = CheckLastError("CAM", gkFuncRefGet, result);

  return result;
}

int SetCAMItsPduHeaderParams(LONG packetHandle, struct CAMItsPduHeader value, char oldPath[])
{
  char newPath[300];
  int result;

  result = 0;

  snprintf(newPath, elcount(newPath), "%s.%s", oldPath, "protocolVersion");
  C2xSetTokenInt(packetHandle, "CAM", newPath, value.protocolVersion);
  result = CheckLastError("CAM", gkFuncRefGet, result);

  snprintf(newPath, elcount(newPath), "%s.%s", oldPath, "messageID");
  C2xSetTokenInt(packetHandle, "CAM", newPath, value.messageID);
  result = CheckLastError("CAM", gkFuncRefGet, result);

  snprintf(newPath, elcount(newPath), "%s.%s", oldPath, "stationID");
  C2xSetTokenInt64(packetHandle, "CAM", newPath, value.stationID);
  result = CheckLastError("CAM", gkFuncRefGet, result);

  return result;
}

int GetCAMPositionConfidenceEllipseParams(LONG packetHandle, struct CAMPositionConfidenceEllipse value, char oldPath[])
{
  char newPath[300];
  int result;

  result = 0;

  snprintf(newPath, elcount(newPath), "%s.%s", oldPath, "semiMajorAxisLength");
  value.semiMajorAxisLength = C2xGetTokenInt(packetHandle, "CAM", newPath);
  result = CheckLastError("CAM", gkFuncRefGet, result);

  snprintf(newPath, elcount(newPath), "%s.%s", oldPath, "semiMinorAxisLength");
  value.semiMinorAxisLength = C2xGetTokenInt(packetHandle, "CAM", newPath);
  result = CheckLastError("CAM", gkFuncRefGet, result);

  snprintf(newPath, elcount(newPath), "%s.%s", oldPath, "semiMajorAxisOrientation");
  value.semiMajorAxisOrientation = C2xGetTokenInt(packetHandle, "CAM", newPath);
  result = CheckLastError("CAM", gkFuncRefGet, result);

  return result;
}

int SetCAMPositionConfidenceEllipseParams(LONG packetHandle, struct CAMPositionConfidenceEllipse value, char oldPath[])
{
  char newPath[300];
  int result;

  result = 0;

  snprintf(newPath, elcount(newPath), "%s.%s", oldPath, "semiMajorAxisLength");
  C2xSetTokenInt(packetHandle, "CAM", newPath, value.semiMajorAxisLength);
  result = CheckLastError("CAM", gkFuncRefGet, result);

  snprintf(newPath, elcount(newPath), "%s.%s", oldPath, "semiMinorAxisLength");
  C2xSetTokenInt(packetHandle, "CAM", newPath, value.semiMinorAxisLength);
  result = CheckLastError("CAM", gkFuncRefGet, result);

  snprintf(newPath, elcount(newPath), "%s.%s", oldPath, "semiMajorAxisOrientation");
  C2xSetTokenInt(packetHandle, "CAM", newPath, value.semiMajorAxisOrientation);
  result = CheckLastError("CAM", gkFuncRefGet, result);

  return result;
}

int GetCAMAltitudeParams(LONG packetHandle, struct CAMAltitude value, char oldPath[])
{
  char newPath[300];
  int result;

  result = 0;

  snprintf(newPath, elcount(newPath), "%s.%s", oldPath, "altitudeValue");
  value.altitudeValue = C2xGetTokenInt(packetHandle, "CAM", newPath);
  result = CheckLastError("CAM", gkFuncRefGet, result);

  snprintf(newPath, elcount(newPath), "%s.%s", oldPath, "altitudeConfidence");
  value.altitudeConfidence = C2xGetTokenInt(packetHandle, "CAM", newPath);
  result = CheckLastError("CAM", gkFuncRefGet, result);

  return result;
}

int SetCAMAltitudeParams(LONG packetHandle, struct CAMAltitude value, char oldPath[])
{
  char newPath[300];
  int result;

  result = 0;

  snprintf(newPath, elcount(newPath), "%s.%s", oldPath, "altitudeValue");
  C2xSetTokenInt(packetHandle, "CAM", newPath, value.altitudeValue);
  result = CheckLastError("CAM", gkFuncRefGet, result);

  snprintf(newPath, elcount(newPath), "%s.%s", oldPath, "altitudeConfidence");
  C2xSetTokenInt(packetHandle, "CAM", newPath, value.altitudeConfidence);
  result = CheckLastError("CAM", gkFuncRefGet, result);

  return result;
}

int GetCAMReferencePositionWithConfidenceParams(LONG packetHandle, struct CAMReferencePositionWithConfidence value, char oldPath[])
{
  char newPath[300];
  int result;

  result = 0;

  snprintf(newPath, elcount(newPath), "%s.%s", oldPath, "latitude");
  value.latitude = C2xGetTokenInt(packetHandle, "CAM", newPath);
  result = CheckLastError("CAM", gkFuncRefGet, result);

  snprintf(newPath, elcount(newPath), "%s.%s", oldPath, "longitude");
  value.longitude = C2xGetTokenInt(packetHandle, "CAM", newPath);
  result = CheckLastError("CAM", gkFuncRefGet, result);

  snprintf(newPath, elcount(newPath), "%s.%s", oldPath, "positionConfidenceEllipse");
  GetCAMPositionConfidenceEllipseParams(packetHandle, value.positionConfidenceEllipse, newPath);
  result = CheckLastError("CAM", gkFuncRefGet, result);

  snprintf(newPath, elcount(newPath), "%s.%s", oldPath, "altitude");
  GetCAMAltitudeParams(packetHandle, value.altitude, newPath);
  result = CheckLastError("CAM", gkFuncRefGet, result);

  return result;
}

int SetCAMReferencePositionWithConfidenceParams(LONG packetHandle, struct CAMReferencePositionWithConfidence value, char oldPath[])
{
  char newPath[300];
  int result;

  result = 0;

  snprintf(newPath, elcount(newPath), "%s.%s", oldPath, "latitude");
  C2xSetTokenInt(packetHandle, "CAM", newPath, value.latitude);
  result = CheckLastError("CAM", gkFuncRefGet, result);

  snprintf(newPath, elcount(newPath), "%s.%s", oldPath, "longitude");
  C2xSetTokenInt(packetHandle, "CAM", newPath, value.longitude);
  result = CheckLastError("CAM", gkFuncRefGet, result);

  snprintf(newPath, elcount(newPath), "%s.%s", oldPath, "positionConfidenceEllipse");
  SetCAMPositionConfidenceEllipseParams(packetHandle, value.positionConfidenceEllipse, newPath);
  result = CheckLastError("CAM", gkFuncRefGet, result);

  snprintf(newPath, elcount(newPath), "%s.%s", oldPath, "altitude");
  SetCAMAltitudeParams(packetHandle, value.altitude, newPath);
  result = CheckLastError("CAM", gkFuncRefGet, result);

  return result;
}

int GetCAMBasicContainerParams(LONG packetHandle, struct CAMBasicContainer value, char oldPath[])
{
  char newPath[300];
  int result;

  result = 0;

  snprintf(newPath, elcount(newPath), "%s.%s", oldPath, "stationType");
  value.stationType = C2xGetTokenInt(packetHandle, "CAM", newPath);
  result = CheckLastError("CAM", gkFuncRefGet, result);

  snprintf(newPath, elcount(newPath), "%s.%s", oldPath, "referencePosition");
  GetCAMReferencePositionWithConfidenceParams(packetHandle, value.referencePosition, newPath);
  result = CheckLastError("CAM", gkFuncRefGet, result);

  return result;
}

int SetCAMBasicContainerParams(LONG packetHandle, struct CAMBasicContainer value, char oldPath[])
{
  char newPath[300];
  int result;

  result = 0;

  snprintf(newPath, elcount(newPath), "%s.%s", oldPath, "stationType");
  C2xSetTokenInt(packetHandle, "CAM", newPath, value.stationType);
  result = CheckLastError("CAM", gkFuncRefGet, result);

  snprintf(newPath, elcount(newPath), "%s.%s", oldPath, "referencePosition");
  SetCAMReferencePositionWithConfidenceParams(packetHandle, value.referencePosition, newPath);
  result = CheckLastError("CAM", gkFuncRefGet, result);

  return result;
}

int GetCAMHeadingParams(LONG packetHandle, struct CAMHeading value, char oldPath[])
{
  char newPath[300];
  int result;

  result = 0;

  snprintf(newPath, elcount(newPath), "%s.%s", oldPath, "headingValue");
  value.headingValue = C2xGetTokenInt(packetHandle, "CAM", newPath);
  result = CheckLastError("CAM", gkFuncRefGet, result);

  snprintf(newPath, elcount(newPath), "%s.%s", oldPath, "headingConfidence");
  value.headingConfidence = C2xGetTokenInt(packetHandle, "CAM", newPath);
  result = CheckLastError("CAM", gkFuncRefGet, result);

  return result;
}

int SetCAMHeadingParams(LONG packetHandle, struct CAMHeading value, char oldPath[])
{
  char newPath[300];
  int result;

  result = 0;

  snprintf(newPath, elcount(newPath), "%s.%s", oldPath, "headingValue");
  C2xSetTokenInt(packetHandle, "CAM", newPath, value.headingValue);
  result = CheckLastError("CAM", gkFuncRefGet, result);

  snprintf(newPath, elcount(newPath), "%s.%s", oldPath, "headingConfidence");
  if (value.headingConfidence < 1)
  {
    C2xSetTokenInt(packetHandle, "CAM", newPath, 1);
  }
  else if (value.headingConfidence > 127)
  {
    C2xSetTokenInt(packetHandle, "CAM", newPath, 127);
  }
  else
  {
    C2xSetTokenInt(packetHandle, "CAM", newPath, value.headingConfidence);
  }
  result = CheckLastError("CAM", gkFuncRefGet, result);

  return result;
}

int GetCAMSpeedParams(LONG packetHandle, struct CAMSpeed value, char oldPath[])
{
  char newPath[300];
  int result;

  result = 0;

  snprintf(newPath, elcount(newPath), "%s.%s", oldPath, "speedValue");
  value.speedValue = C2xGetTokenInt(packetHandle, "CAM", newPath);
  result = CheckLastError("CAM", gkFuncRefGet, result);

  snprintf(newPath, elcount(newPath), "%s.%s", oldPath, "speedConfidence");
  value.speedConfidence = C2xGetTokenInt(packetHandle, "CAM", newPath);
  result = CheckLastError("CAM", gkFuncRefGet, result);

  return result;
}

int SetCAMSpeedParams(LONG packetHandle, struct CAMSpeed value, char oldPath[])
{
  char newPath[300];
  int result;

  result = 0;

  snprintf(newPath, elcount(newPath), "%s.%s", oldPath, "speedValue");
  C2xSetTokenInt(packetHandle, "CAM", newPath, value.speedValue);
  result = CheckLastError("CAM", gkFuncRefGet, result);

  snprintf(newPath, elcount(newPath), "%s.%s", oldPath, "speedConfidence");
  if (value.speedConfidence < 1)
  {
    C2xSetTokenInt(packetHandle, "CAM", newPath, 1);
  }
  else if (value.speedConfidence > 127)
  {
    C2xSetTokenInt(packetHandle, "CAM", newPath, 127);
  }
  else
  {
    C2xSetTokenInt(packetHandle, "CAM", newPath, value.speedConfidence);
  }
  result = CheckLastError("CAM", gkFuncRefGet, result);

  return result;
}

int GetCAMVehicleLengthParams(LONG packetHandle, struct CAMVehicleLength value, char oldPath[])
{
  char newPath[300];
  int result;

  result = 0;

  snprintf(newPath, elcount(newPath), "%s.%s", oldPath, "vehicleLengthValue");
  value.vehicleLengthValue = C2xGetTokenInt(packetHandle, "CAM", newPath);
  result = CheckLastError("CAM", gkFuncRefGet, result);

  snprintf(newPath, elcount(newPath), "%s.%s", oldPath, "vehicleLengthConfidenceIndication");
  value.vehicleLengthConfidenceIndication = C2xGetTokenInt(packetHandle, "CAM", newPath);
  result = CheckLastError("CAM", gkFuncRefGet, result);

  return result;
}

int SetCAMVehicleLengthParams(LONG packetHandle, struct CAMVehicleLength value, char oldPath[])
{
  char newPath[300];
  int result;

  result = 0;

  snprintf(newPath, elcount(newPath), "%s.%s", oldPath, "vehicleLengthValue");
  if (value.vehicleLengthValue < 1)
  {
    C2xSetTokenInt(packetHandle, "CAM", newPath, 1);
  }
  else if (value.vehicleLengthValue > 1023)
  {
    C2xSetTokenInt(packetHandle, "CAM", newPath, 1023);
  }
  else
  {
    C2xSetTokenInt(packetHandle, "CAM", newPath, value.vehicleLengthValue);
  }
  result = CheckLastError("CAM", gkFuncRefGet, result);

  snprintf(newPath, elcount(newPath), "%s.%s", oldPath, "vehicleLengthConfidenceIndication");
  C2xSetTokenInt(packetHandle, "CAM", newPath, value.vehicleLengthConfidenceIndication);
  result = CheckLastError("CAM", gkFuncRefGet, result);

  return result;
}

int GetCAMAccelerationComponentParams(LONG packetHandle, struct CAMAccelerationComponent value, char oldPath[])
{
  char newPath[300];
  int result;

  result = 0;

  snprintf(newPath, elcount(newPath), "%s.%s", oldPath, "value");
  value.value = C2xGetTokenInt(packetHandle, "CAM", newPath);
  result = CheckLastError("CAM", gkFuncRefGet, result);

  snprintf(newPath, elcount(newPath), "%s.%s", oldPath, "confidence");
  value.confidence = C2xGetTokenInt(packetHandle, "CAM", newPath);
  result = CheckLastError("CAM", gkFuncRefGet, result);

  return result;
}

int SetCAMAccelerationComponentParams(LONG packetHandle, struct CAMAccelerationComponent value, char oldPath[])
{
  char newPath[300];
  int result;

  result = 0;

  snprintf(newPath, elcount(newPath), "%s.%s", oldPath, "value");
  C2xSetTokenInt(packetHandle, "CAM", newPath, value.value);
  result = CheckLastError("CAM", gkFuncRefGet, result);

  snprintf(newPath, elcount(newPath), "%s.%s", oldPath, "confidence");
  C2xSetTokenInt(packetHandle, "CAM", newPath, value.confidence);
  result = CheckLastError("CAM", gkFuncRefGet, result);

  return result;
}

int GetCAMCurvatureParams(LONG packetHandle, struct CAMCurvature value, char oldPath[])
{
  char newPath[300];
  int result;

  result = 0;

  snprintf(newPath, elcount(newPath), "%s.%s", oldPath, "curvatureValue");
  value.curvatureValue = C2xGetTokenInt(packetHandle, "CAM", newPath);
  result = CheckLastError("CAM", gkFuncRefGet, result);

  snprintf(newPath, elcount(newPath), "%s.%s", oldPath, "curvatureConfidence");
  value.curvatureConfidence = C2xGetTokenInt(packetHandle, "CAM", newPath);
  result = CheckLastError("CAM", gkFuncRefGet, result);

  return result;
}

int SetCAMCurvatureParams(LONG packetHandle, struct CAMCurvature value, char oldPath[])
{
  char newPath[300];
  int result;

  result = 0;

  snprintf(newPath, elcount(newPath), "%s.%s", oldPath, "curvatureValue");
  C2xSetTokenInt(packetHandle, "CAM", newPath, value.curvatureValue);
  result = CheckLastError("CAM", gkFuncRefGet, result);

  snprintf(newPath, elcount(newPath), "%s.%s", oldPath, "curvatureConfidence");
  C2xSetTokenInt(packetHandle, "CAM", newPath, value.curvatureConfidence);
  result = CheckLastError("CAM", gkFuncRefGet, result);

  return result;
}

int GetCAMYawRateParams(LONG packetHandle, struct CAMYawRate value, char oldPath[])
{
  char newPath[300];
  int result;

  result = 0;

  snprintf(newPath, elcount(newPath), "%s.%s", oldPath, "yawRateValue");
  value.yawRateValue = C2xGetTokenInt(packetHandle, "CAM", newPath);
  result = CheckLastError("CAM", gkFuncRefGet, result);

  snprintf(newPath, elcount(newPath), "%s.%s", oldPath, "yawRateConfidence");
  value.yawRateConfidence = C2xGetTokenInt(packetHandle, "CAM", newPath);
  result = CheckLastError("CAM", gkFuncRefGet, result);

  return result;
}

int SetCAMYawRateParams(LONG packetHandle, struct CAMYawRate value, char oldPath[])
{
  char newPath[300];
  int result;

  result = 0;

  snprintf(newPath, elcount(newPath), "%s.%s", oldPath, "yawRateValue");
  C2xSetTokenInt(packetHandle, "CAM", newPath, value.yawRateValue);
  result = CheckLastError("CAM", gkFuncRefGet, result);

  snprintf(newPath, elcount(newPath), "%s.%s", oldPath, "yawRateConfidence");
  C2xSetTokenInt(packetHandle, "CAM", newPath, value.yawRateConfidence);
  result = CheckLastError("CAM", gkFuncRefGet, result);

  return result;
}

int GetCAMSteeringWheelAngleParams(LONG packetHandle, struct CAMSteeringWheelAngle value, char oldPath[])
{
  char newPath[300];
  int result;

  result = 0;

  snprintf(newPath, elcount(newPath), "%s.%s", oldPath, "steeringWheelAngleValue");
  value.steeringWheelAngleValue = C2xGetTokenInt(packetHandle, "CAM", newPath);
  result = CheckLastError("CAM", gkFuncRefGet, result);

  snprintf(newPath, elcount(newPath), "%s.%s", oldPath, "steeringWheelAngleConfidence");
  value.steeringWheelAngleConfidence = C2xGetTokenInt(packetHandle, "CAM", newPath);
  result = CheckLastError("CAM", gkFuncRefGet, result);

  return result;
}

int SetCAMSteeringWheelAngleParams(LONG packetHandle, struct CAMSteeringWheelAngle value, char oldPath[])
{
  char newPath[300];
  int result;

  result = 0;

  snprintf(newPath, elcount(newPath), "%s.%s", oldPath, "steeringWheelAngleValue");
  C2xSetTokenInt(packetHandle, "CAM", newPath, value.steeringWheelAngleValue);
  result = CheckLastError("CAM", gkFuncRefGet, result);

  snprintf(newPath, elcount(newPath), "%s.%s", oldPath, "steeringWheelAngleConfidence");
  if (value.steeringWheelAngleConfidence < 1)
  {
    C2xSetTokenInt(packetHandle, "CAM", newPath, 1);
  }
  else if (value.steeringWheelAngleConfidence > 127)
  {
    C2xSetTokenInt(packetHandle, "CAM", newPath, 127);
  }
  else
  {
    C2xSetTokenInt(packetHandle, "CAM", newPath, value.steeringWheelAngleConfidence);
  }
  result = CheckLastError("CAM", gkFuncRefGet, result);

  return result;
}

int GetCAMCenDsrcTollingZoneParams(LONG packetHandle, struct CAMCenDsrcTollingZone value, char oldPath[])
{
  char newPath[300];
  int result;

  result = 0;

  snprintf(newPath, elcount(newPath), "%s.%s", oldPath, "protectedZoneLatitude");
  value.protectedZoneLatitude = C2xGetTokenInt(packetHandle, "CAM", newPath);
  result = CheckLastError("CAM", gkFuncRefGet, result);

  snprintf(newPath, elcount(newPath), "%s.%s", oldPath, "protectedZoneLongitude");
  value.protectedZoneLongitude = C2xGetTokenInt(packetHandle, "CAM", newPath);
  result = CheckLastError("CAM", gkFuncRefGet, result);

  snprintf(newPath, elcount(newPath), "%s.%s", oldPath, "cenDsrcTollingZoneId");
  value.cenDsrcTollingZoneId.isValidFlag = C2xIsTokenAvailable(packetHandle, "CAM", newPath);
  if(value.cenDsrcTollingZoneId.isValidFlag==1)
  {
    value.cenDsrcTollingZoneId.value = C2xGetTokenInt(packetHandle, "CAM", newPath);
    result = CheckLastError("CAM", gkFuncRefGet, result);
  }
  return result;
}

int SetCAMCenDsrcTollingZoneParams(LONG packetHandle, struct CAMCenDsrcTollingZone value, char oldPath[])
{
  char newPath[300];
  int result;

  result = 0;

  snprintf(newPath, elcount(newPath), "%s.%s", oldPath, "protectedZoneLatitude");
  C2xSetTokenInt(packetHandle, "CAM", newPath, value.protectedZoneLatitude);
  result = CheckLastError("CAM", gkFuncRefGet, result);

  snprintf(newPath, elcount(newPath), "%s.%s", oldPath, "protectedZoneLongitude");
  C2xSetTokenInt(packetHandle, "CAM", newPath, value.protectedZoneLongitude);
  result = CheckLastError("CAM", gkFuncRefGet, result);

  snprintf(newPath, elcount(newPath), "%s.%s", oldPath, "cenDsrcTollingZoneId");
  if(value.cenDsrcTollingZoneId.isValidFlag==1)
  {
    C2xSetTokenInt(packetHandle, "CAM", newPath, value.cenDsrcTollingZoneId.value);
    result = CheckLastError("CAM", gkFuncRefGet, result);
  }
  else
  {
    if( C2xIsTokenAvailable(packetHandle, "CAM", newPath) )
    {
      C2xRemoveToken(packetHandle, "CAM", newPath);
    }
  }

  return result;
}

int GetCAMBasicVehicleContainerHighFrequencyParams(LONG packetHandle, struct CAMBasicVehicleContainerHighFrequency value, char oldPath[])
{
  char newPath[300]; 
  int j; 
  int k;
  int result;

  result = 0;

  snprintf(newPath, elcount(newPath), "%s.%s", oldPath, "heading");
  GetCAMHeadingParams(packetHandle, value.heading, newPath);
  result = CheckLastError("CAM", gkFuncRefGet, result);

  snprintf(newPath, elcount(newPath), "%s.%s", oldPath, "speed");
  GetCAMSpeedParams(packetHandle, value.speed, newPath);
  result = CheckLastError("CAM", gkFuncRefGet, result);

  snprintf(newPath, elcount(newPath), "%s.%s", oldPath, "driveDirection");
  value.driveDirection = C2xGetTokenInt(packetHandle, "CAM", newPath);
  result = CheckLastError("CAM", gkFuncRefGet, result);

  snprintf(newPath, elcount(newPath), "%s.%s", oldPath, "vehicleLength");
  GetCAMVehicleLengthParams(packetHandle, value.vehicleLength, newPath);
  result = CheckLastError("CAM", gkFuncRefGet, result);

  snprintf(newPath, elcount(newPath), "%s.%s", oldPath, "vehicleWidth");
  value.vehicleWidth = C2xGetTokenInt(packetHandle, "CAM", newPath);
  result = CheckLastError("CAM", gkFuncRefGet, result);

  snprintf(newPath, elcount(newPath), "%s.%s", oldPath, "longitudinalAcceleration");
  GetCAMAccelerationComponentParams(packetHandle, value.longitudinalAcceleration, newPath);
  result = CheckLastError("CAM", gkFuncRefGet, result);

  snprintf(newPath, elcount(newPath), "%s.%s", oldPath, "curvature");
  GetCAMCurvatureParams(packetHandle, value.curvature, newPath);
  result = CheckLastError("CAM", gkFuncRefGet, result);

  snprintf(newPath, elcount(newPath), "%s.%s", oldPath, "curvatureCalculationMode");
  value.curvatureCalculationMode = C2xGetTokenInt(packetHandle, "CAM", newPath);
  result = CheckLastError("CAM", gkFuncRefGet, result);

  snprintf(newPath, elcount(newPath), "%s.%s", oldPath, "yawRate");
  GetCAMYawRateParams(packetHandle, value.yawRate, newPath);
  result = CheckLastError("CAM", gkFuncRefGet, result);

  snprintf(newPath, elcount(newPath), "%s.%s", oldPath, "accelerationControl");
  value.accelerationControl.isValidFlag = C2xIsTokenAvailable(packetHandle, "CAM", newPath);
  if(value.accelerationControl.isValidFlag==1)
  {
    value.accelerationControl.isValidFlag = 1;
    value.accelerationControl.stringLength = C2xGetTokenLengthBit(packetHandle, "CAM", newPath);
    if ((result = CheckLastError("CAM", gkFuncRefGet, result))==0)
    {
      if(value.accelerationControl.stringLength > 0)
      {
        for(j=0; j<value.accelerationControl.stringLength; j++)
        {
          if(C2xGetTokenBitOfBitString(packetHandle, "CAM", newPath, j) == 0)
          {
            value.accelerationControl.string[j] = '0';
          }
          else if(C2xGetTokenBitOfBitString(packetHandle, "CAM", newPath, j) == 1)
          {
            value.accelerationControl.string[j] = '1';
          }

          if(value.accelerationControl.stringLength == 1)
          {
            value.accelerationControl.string[1] = '0';
          }
          result = CheckLastError("CAM", gkFuncRefGet, result);
        }
      }
      else
      {
        for(k = value.accelerationControl.stringLength+1; k > -1; k--)
        {
          if(value.accelerationControl.string[k] == '1')
          {
            value.accelerationControl.string[k] = '0';
          }
        }
      }
    }

  }
  snprintf(newPath, elcount(newPath), "%s.%s", oldPath, "lanePosition");
  value.lanePosition.isValidFlag = C2xIsTokenAvailable(packetHandle, "CAM", newPath);
  if(value.lanePosition.isValidFlag==1)
  {
    value.lanePosition.value = C2xGetTokenInt(packetHandle, "CAM", newPath);
    result = CheckLastError("CAM", gkFuncRefGet, result);
  }
  snprintf(newPath, elcount(newPath), "%s.%s", oldPath, "steeringWheelAngle");
  value.steeringWheelAngle.isValidFlag = C2xIsTokenAvailable(packetHandle, "CAM", newPath);
  if(value.steeringWheelAngle.isValidFlag==1)
  {
    GetCAMSteeringWheelAngleParams(packetHandle, value.steeringWheelAngle, newPath);
    result = CheckLastError("CAM", gkFuncRefGet, result);
  }
  snprintf(newPath, elcount(newPath), "%s.%s", oldPath, "lateralAcceleration");
  value.lateralAcceleration.isValidFlag = C2xIsTokenAvailable(packetHandle, "CAM", newPath);
  if(value.lateralAcceleration.isValidFlag==1)
  {
    GetCAMAccelerationComponentParams(packetHandle, value.lateralAcceleration, newPath);
    result = CheckLastError("CAM", gkFuncRefGet, result);
  }
  snprintf(newPath, elcount(newPath), "%s.%s", oldPath, "verticalAcceleration");
  value.verticalAcceleration.isValidFlag = C2xIsTokenAvailable(packetHandle, "CAM", newPath);
  if(value.verticalAcceleration.isValidFlag==1)
  {
    GetCAMAccelerationComponentParams(packetHandle, value.verticalAcceleration, newPath);
    result = CheckLastError("CAM", gkFuncRefGet, result);
  }
  snprintf(newPath, elcount(newPath), "%s.%s", oldPath, "performanceClass");
  value.performanceClass.isValidFlag = C2xIsTokenAvailable(packetHandle, "CAM", newPath);
  if(value.performanceClass.isValidFlag==1)
  {
    value.performanceClass.value = C2xGetTokenInt(packetHandle, "CAM", newPath);
    result = CheckLastError("CAM", gkFuncRefGet, result);
  }
  snprintf(newPath, elcount(newPath), "%s.%s", oldPath, "cenDsrcTollingZone");
  value.cenDsrcTollingZone.isValidFlag = C2xIsTokenAvailable(packetHandle, "CAM", newPath);
  if(value.cenDsrcTollingZone.isValidFlag==1)
  {
    GetCAMCenDsrcTollingZoneParams(packetHandle, value.cenDsrcTollingZone, newPath);
    result = CheckLastError("CAM", gkFuncRefGet, result);
  }
  return result;
}

int SetCAMBasicVehicleContainerHighFrequencyParams(LONG packetHandle, struct CAMBasicVehicleContainerHighFrequency value, char oldPath[])
{
  char newPath[300]; 
  int j;
  int result;

  result = 0;

  snprintf(newPath, elcount(newPath), "%s.%s", oldPath, "heading");
  SetCAMHeadingParams(packetHandle, value.heading, newPath);
  result = CheckLastError("CAM", gkFuncRefGet, result);

  snprintf(newPath, elcount(newPath), "%s.%s", oldPath, "speed");
  SetCAMSpeedParams(packetHandle, value.speed, newPath);
  result = CheckLastError("CAM", gkFuncRefGet, result);

  snprintf(newPath, elcount(newPath), "%s.%s", oldPath, "driveDirection");
  C2xSetTokenInt(packetHandle, "CAM", newPath, value.driveDirection);
  result = CheckLastError("CAM", gkFuncRefGet, result);

  snprintf(newPath, elcount(newPath), "%s.%s", oldPath, "vehicleLength");
  SetCAMVehicleLengthParams(packetHandle, value.vehicleLength, newPath);
  result = CheckLastError("CAM", gkFuncRefGet, result);

  snprintf(newPath, elcount(newPath), "%s.%s", oldPath, "vehicleWidth");
  if (value.vehicleWidth < 1)
  {
    C2xSetTokenInt(packetHandle, "CAM", newPath, 1);
  }
  else if (value.vehicleWidth > 62)
  {
    C2xSetTokenInt(packetHandle, "CAM", newPath, 62);
  }
  else
  {
    C2xSetTokenInt(packetHandle, "CAM", newPath, value.vehicleWidth);
  }
  result = CheckLastError("CAM", gkFuncRefGet, result);

  snprintf(newPath, elcount(newPath), "%s.%s", oldPath, "longitudinalAcceleration");
  SetCAMAccelerationComponentParams(packetHandle, value.longitudinalAcceleration, newPath);
  result = CheckLastError("CAM", gkFuncRefGet, result);

  snprintf(newPath, elcount(newPath), "%s.%s", oldPath, "curvature");
  SetCAMCurvatureParams(packetHandle, value.curvature, newPath);
  result = CheckLastError("CAM", gkFuncRefGet, result);

  snprintf(newPath, elcount(newPath), "%s.%s", oldPath, "curvatureCalculationMode");
  C2xSetTokenInt(packetHandle, "CAM", newPath, value.curvatureCalculationMode);
  result = CheckLastError("CAM", gkFuncRefGet, result);

  snprintf(newPath, elcount(newPath), "%s.%s", oldPath, "yawRate");
  SetCAMYawRateParams(packetHandle, value.yawRate, newPath);
  result = CheckLastError("CAM", gkFuncRefGet, result);

  snprintf(newPath, elcount(newPath), "%s.%s", oldPath, "accelerationControl");
  if(value.accelerationControl.isValidFlag==1)
  {
      for(j=0; j<value.accelerationControl.stringLength; j++)
      {
        if(value.accelerationControl.string[j] == '0')
        {
          C2xSetTokenBitOfBitString(packetHandle, "CAM", newPath, j, 0);
        }
        else
        {
          C2xSetTokenBitOfBitString(packetHandle, "CAM", newPath, j, 1);
        }
        result = CheckLastError("CAM", gkFuncRefGet, result);
      }
  }
  else
  {
    if( C2xIsTokenAvailable(packetHandle, "CAM", newPath) )
    {
      C2xRemoveToken(packetHandle, "CAM", newPath);
    }
  }

  snprintf(newPath, elcount(newPath), "%s.%s", oldPath, "lanePosition");
  if(value.lanePosition.isValidFlag==1)
  {
    C2xSetTokenInt(packetHandle, "CAM", newPath, value.lanePosition.value);
    result = CheckLastError("CAM", gkFuncRefGet, result);
  }
  else
  {
    if( C2xIsTokenAvailable(packetHandle, "CAM", newPath) )
    {
      C2xRemoveToken(packetHandle, "CAM", newPath);
    }
  }

  snprintf(newPath, elcount(newPath), "%s.%s", oldPath, "steeringWheelAngle");
  if(value.steeringWheelAngle.isValidFlag==1)
  {
    SetCAMSteeringWheelAngleParams(packetHandle, value.steeringWheelAngle, newPath);
    result = CheckLastError("CAM", gkFuncRefGet, result);
  }
  else
  {
    if( C2xIsTokenAvailable(packetHandle, "CAM", newPath) )
    {
      C2xRemoveToken(packetHandle, "CAM", newPath);
    }
  }

  snprintf(newPath, elcount(newPath), "%s.%s", oldPath, "lateralAcceleration");
  if(value.lateralAcceleration.isValidFlag==1)
  {
    SetCAMAccelerationComponentParams(packetHandle, value.lateralAcceleration, newPath);
    result = CheckLastError("CAM", gkFuncRefGet, result);
  }
  else
  {
    if( C2xIsTokenAvailable(packetHandle, "CAM", newPath) )
    {
      C2xRemoveToken(packetHandle, "CAM", newPath);
    }
  }

  snprintf(newPath, elcount(newPath), "%s.%s", oldPath, "verticalAcceleration");
  if(value.verticalAcceleration.isValidFlag==1)
  {
    SetCAMAccelerationComponentParams(packetHandle, value.verticalAcceleration, newPath);
    result = CheckLastError("CAM", gkFuncRefGet, result);
  }
  else
  {
    if( C2xIsTokenAvailable(packetHandle, "CAM", newPath) )
    {
      C2xRemoveToken(packetHandle, "CAM", newPath);
    }
  }

  snprintf(newPath, elcount(newPath), "%s.%s", oldPath, "performanceClass");
  if(value.performanceClass.isValidFlag==1)
  {
    C2xSetTokenInt(packetHandle, "CAM", newPath, value.performanceClass.value);
    result = CheckLastError("CAM", gkFuncRefGet, result);
  }
  else
  {
    if( C2xIsTokenAvailable(packetHandle, "CAM", newPath) )
    {
      C2xRemoveToken(packetHandle, "CAM", newPath);
    }
  }

  snprintf(newPath, elcount(newPath), "%s.%s", oldPath, "cenDsrcTollingZone");
  if(value.cenDsrcTollingZone.isValidFlag==1)
  {
    SetCAMCenDsrcTollingZoneParams(packetHandle, value.cenDsrcTollingZone, newPath);
    result = CheckLastError("CAM", gkFuncRefGet, result);
  }
  else
  {
    if( C2xIsTokenAvailable(packetHandle, "CAM", newPath) )
    {
      C2xRemoveToken(packetHandle, "CAM", newPath);
    }
  }

  return result;
}

int GetCAMProtectedCommunicationZoneParams(LONG packetHandle, struct CAMProtectedCommunicationZone value, char oldPath[])
{
  char newPath[300];
  int result;

  result = 0;

  snprintf(newPath, elcount(newPath), "%s.%s", oldPath, "protectedZoneType");
  value.protectedZoneType = C2xGetTokenInt(packetHandle, "CAM", newPath);
  result = CheckLastError("CAM", gkFuncRefGet, result);

  snprintf(newPath, elcount(newPath), "%s.%s", oldPath, "expiryTime");
  value.expiryTime.isValidFlag = C2xIsTokenAvailable(packetHandle, "CAM", newPath);
  if(value.expiryTime.isValidFlag==1)
  {
    value.expiryTime.value = C2xGetTokenInt64(packetHandle, "CAM", newPath);
    result = CheckLastError("CAM", gkFuncRefGet, result);
  }
  snprintf(newPath, elcount(newPath), "%s.%s", oldPath, "protectedZoneLatitude");
  value.protectedZoneLatitude = C2xGetTokenInt(packetHandle, "CAM", newPath);
  result = CheckLastError("CAM", gkFuncRefGet, result);

  snprintf(newPath, elcount(newPath), "%s.%s", oldPath, "protectedZoneLongitude");
  value.protectedZoneLongitude = C2xGetTokenInt(packetHandle, "CAM", newPath);
  result = CheckLastError("CAM", gkFuncRefGet, result);

  snprintf(newPath, elcount(newPath), "%s.%s", oldPath, "protectedZoneRadius");
  value.protectedZoneRadius.isValidFlag = C2xIsTokenAvailable(packetHandle, "CAM", newPath);
  if(value.protectedZoneRadius.isValidFlag==1)
  {
    value.protectedZoneRadius.value = C2xGetTokenInt(packetHandle, "CAM", newPath);
    result = CheckLastError("CAM", gkFuncRefGet, result);
  }
  snprintf(newPath, elcount(newPath), "%s.%s", oldPath, "protectedZoneId");
  value.protectedZoneId.isValidFlag = C2xIsTokenAvailable(packetHandle, "CAM", newPath);
  if(value.protectedZoneId.isValidFlag==1)
  {
    value.protectedZoneId.value = C2xGetTokenInt(packetHandle, "CAM", newPath);
    result = CheckLastError("CAM", gkFuncRefGet, result);
  }
  return result;
}

int SetCAMProtectedCommunicationZoneParams(LONG packetHandle, struct CAMProtectedCommunicationZone value, char oldPath[])
{
  char newPath[300];
  int result;

  result = 0;

  snprintf(newPath, elcount(newPath), "%s.%s", oldPath, "protectedZoneType");
  C2xSetTokenInt(packetHandle, "CAM", newPath, value.protectedZoneType);
  result = CheckLastError("CAM", gkFuncRefGet, result);

  snprintf(newPath, elcount(newPath), "%s.%s", oldPath, "expiryTime");
  if(value.expiryTime.isValidFlag==1)
  {
    C2xSetTokenInt64(packetHandle, "CAM", newPath, value.expiryTime.value);
    result = CheckLastError("CAM", gkFuncRefGet, result);
  }
  else
  {
    if( C2xIsTokenAvailable(packetHandle, "CAM", newPath) )
    {
      C2xRemoveToken(packetHandle, "CAM", newPath);
    }
  }

  snprintf(newPath, elcount(newPath), "%s.%s", oldPath, "protectedZoneLatitude");
  C2xSetTokenInt(packetHandle, "CAM", newPath, value.protectedZoneLatitude);
  result = CheckLastError("CAM", gkFuncRefGet, result);

  snprintf(newPath, elcount(newPath), "%s.%s", oldPath, "protectedZoneLongitude");
  C2xSetTokenInt(packetHandle, "CAM", newPath, value.protectedZoneLongitude);
  result = CheckLastError("CAM", gkFuncRefGet, result);

  snprintf(newPath, elcount(newPath), "%s.%s", oldPath, "protectedZoneRadius");
  if(value.protectedZoneRadius.isValidFlag==1)
  {
    if (value.protectedZoneRadius.value < 1)
    {
        C2xSetTokenInt(packetHandle, "CAM", newPath, 1);
    }
    else if (value.protectedZoneRadius.value > 255)
    {
        C2xSetTokenInt(packetHandle, "CAM", newPath, 255);
    }
    else
    {
        C2xSetTokenInt(packetHandle, "CAM", newPath, value.protectedZoneRadius.value);
    }
    result = CheckLastError("CAM", gkFuncRefGet, result);
  }
  else
  {
    if( C2xIsTokenAvailable(packetHandle, "CAM", newPath) )
    {
      C2xRemoveToken(packetHandle, "CAM", newPath);
    }
  }

  snprintf(newPath, elcount(newPath), "%s.%s", oldPath, "protectedZoneId");
  if(value.protectedZoneId.isValidFlag==1)
  {
    C2xSetTokenInt(packetHandle, "CAM", newPath, value.protectedZoneId.value);
    result = CheckLastError("CAM", gkFuncRefGet, result);
  }
  else
  {
    if( C2xIsTokenAvailable(packetHandle, "CAM", newPath) )
    {
      C2xRemoveToken(packetHandle, "CAM", newPath);
    }
  }

  return result;
}

int GetCAMProtectedCommunicationZonesRSUParams(LONG packetHandle, struct CAMProtectedCommunicationZonesRSU value, char oldPath[])
{
  char newPath[300]; 
  int i;
  int result;

  result = 0;

  value.length = C2xGetTokenInt(packetHandle, "CAM", oldPath);
  if((result = CheckLastError("CAM", gkFuncRefGet, result))==0)
  {
    for(i=0; i<value.length; i++)
    {
      snprintf(newPath, elcount(newPath), "%s[%d]", oldPath, i);
      GetCAMProtectedCommunicationZoneParams(packetHandle, value.arrayValue[i], newPath);
      result = CheckLastError("CAM", gkFuncRefGet, result);
    }
  }
  return result;
}

int SetCAMProtectedCommunicationZonesRSUParams(LONG packetHandle, struct CAMProtectedCommunicationZonesRSU value, char oldPath[])
{
  char newPath[300]; 
  int i;
  int result;

  result = 0;

  C2xRemoveToken(packetHandle, "CAM", oldPath);
  for(i=0; i<value.length; i++)
  {
    snprintf(newPath, elcount(newPath), "%s[%d]", oldPath, i);
    SetCAMProtectedCommunicationZoneParams(packetHandle, value.arrayValue[i], newPath);
    result = CheckLastError("CAM", gkFuncRefGet, result);
  }
  return result;
}

int GetCAMRSUContainerHighFrequencyParams(LONG packetHandle, struct CAMRSUContainerHighFrequency value, char oldPath[])
{
  char newPath[300];
  int result;

  result = 0;

  snprintf(newPath, elcount(newPath), "%s.%s", oldPath, "protectedCommunicationZonesRSU");
  value.protectedCommunicationZonesRSU.isValidFlag = C2xIsTokenAvailable(packetHandle, "CAM", newPath);
  if(value.protectedCommunicationZonesRSU.isValidFlag==1)
  {
    GetCAMProtectedCommunicationZonesRSUParams(packetHandle, value.protectedCommunicationZonesRSU, newPath);
    result = CheckLastError("CAM", gkFuncRefGet, result);
  }
  return result;
}

int SetCAMRSUContainerHighFrequencyParams(LONG packetHandle, struct CAMRSUContainerHighFrequency value, char oldPath[])
{
  char newPath[300];
  int result;

  result = 0;

  snprintf(newPath, elcount(newPath), "%s.%s", oldPath, "protectedCommunicationZonesRSU");
  if(value.protectedCommunicationZonesRSU.isValidFlag==1)
  {
    SetCAMProtectedCommunicationZonesRSUParams(packetHandle, value.protectedCommunicationZonesRSU, newPath);
    result = CheckLastError("CAM", gkFuncRefGet, result);
  }
  else
  {
    if( C2xIsTokenAvailable(packetHandle, "CAM", newPath) )
    {
      C2xRemoveToken(packetHandle, "CAM", newPath);
    }
  }

  return result;
}

int GetCAMHighFrequencyContainerParams(LONG packetHandle, struct CAMHighFrequencyContainer value, char oldPath[])
{
  char newPath[300];
  int result;

  result = 0;

  value.choice = C2xGetTokenInt(packetHandle, "CAM", oldPath);

  switch(value.choice)
  {
    case 0:
    {
      snprintf(newPath, elcount(newPath), "%s.%s", oldPath, "basicVehicleContainerHighFrequency");
      GetCAMBasicVehicleContainerHighFrequencyParams(packetHandle, value.basicVehicleContainerHighFrequency, newPath);
      result = CheckLastError("CAM", gkFuncRefGet, result);
    }
    break;
    case 1:
    {
      snprintf(newPath, elcount(newPath), "%s.%s", oldPath, "rsuContainerHighFrequency");
      GetCAMRSUContainerHighFrequencyParams(packetHandle, value.rsuContainerHighFrequency, newPath);
      result = CheckLastError("CAM", gkFuncRefGet, result);
    }
    break;
  }
  return result;
}

int SetCAMHighFrequencyContainerParams(LONG packetHandle, struct CAMHighFrequencyContainer value, char oldPath[])
{
  char newPath[300];
  int result;

  result = 0;

  switch(value.choice)
  {
    case 0:
    {
      snprintf(newPath, elcount(newPath), "%s.%s", oldPath, "basicVehicleContainerHighFrequency");
      SetCAMBasicVehicleContainerHighFrequencyParams(packetHandle, value.basicVehicleContainerHighFrequency, newPath);
      result = CheckLastError("CAM", gkFuncRefGet, result);
    }
    break;
    case 1:
    {
      snprintf(newPath, elcount(newPath), "%s.%s", oldPath, "rsuContainerHighFrequency");
      SetCAMRSUContainerHighFrequencyParams(packetHandle, value.rsuContainerHighFrequency, newPath);
      result = CheckLastError("CAM", gkFuncRefGet, result);
    }
    break;
  }
  return result;
}

int GetCAMDeltaReferencePositionParams(LONG packetHandle, struct CAMDeltaReferencePosition value, char oldPath[])
{
  char newPath[300];
  int result;

  result = 0;

  snprintf(newPath, elcount(newPath), "%s.%s", oldPath, "deltaLatitude");
  value.deltaLatitude = C2xGetTokenInt(packetHandle, "CAM", newPath);
  result = CheckLastError("CAM", gkFuncRefGet, result);

  snprintf(newPath, elcount(newPath), "%s.%s", oldPath, "deltaLongitude");
  value.deltaLongitude = C2xGetTokenInt(packetHandle, "CAM", newPath);
  result = CheckLastError("CAM", gkFuncRefGet, result);

  snprintf(newPath, elcount(newPath), "%s.%s", oldPath, "deltaAltitude");
  value.deltaAltitude = C2xGetTokenInt(packetHandle, "CAM", newPath);
  result = CheckLastError("CAM", gkFuncRefGet, result);

  return result;
}

int SetCAMDeltaReferencePositionParams(LONG packetHandle, struct CAMDeltaReferencePosition value, char oldPath[])
{
  char newPath[300];
  int result;

  result = 0;

  snprintf(newPath, elcount(newPath), "%s.%s", oldPath, "deltaLatitude");
  C2xSetTokenInt(packetHandle, "CAM", newPath, value.deltaLatitude);
  result = CheckLastError("CAM", gkFuncRefGet, result);

  snprintf(newPath, elcount(newPath), "%s.%s", oldPath, "deltaLongitude");
  C2xSetTokenInt(packetHandle, "CAM", newPath, value.deltaLongitude);
  result = CheckLastError("CAM", gkFuncRefGet, result);

  snprintf(newPath, elcount(newPath), "%s.%s", oldPath, "deltaAltitude");
  C2xSetTokenInt(packetHandle, "CAM", newPath, value.deltaAltitude);
  result = CheckLastError("CAM", gkFuncRefGet, result);

  return result;
}

int GetCAMPathPointParams(LONG packetHandle, struct CAMPathPoint value, char oldPath[])
{
  char newPath[300];
  int result;

  result = 0;

  snprintf(newPath, elcount(newPath), "%s.%s", oldPath, "pathPosition");
  GetCAMDeltaReferencePositionParams(packetHandle, value.pathPosition, newPath);
  result = CheckLastError("CAM", gkFuncRefGet, result);

  snprintf(newPath, elcount(newPath), "%s.%s", oldPath, "pathDeltaTime");
  value.pathDeltaTime.isValidFlag = C2xIsTokenAvailable(packetHandle, "CAM", newPath);
  if(value.pathDeltaTime.isValidFlag==1)
  {
    value.pathDeltaTime.value = C2xGetTokenInt(packetHandle, "CAM", newPath);
    result = CheckLastError("CAM", gkFuncRefGet, result);
  }
  return result;
}

int SetCAMPathPointParams(LONG packetHandle, struct CAMPathPoint value, char oldPath[])
{
  char newPath[300];
  int result;

  result = 0;

  snprintf(newPath, elcount(newPath), "%s.%s", oldPath, "pathPosition");
  SetCAMDeltaReferencePositionParams(packetHandle, value.pathPosition, newPath);
  result = CheckLastError("CAM", gkFuncRefGet, result);

  snprintf(newPath, elcount(newPath), "%s.%s", oldPath, "pathDeltaTime");
  if(value.pathDeltaTime.isValidFlag==1)
  {
    if (value.pathDeltaTime.value < 1)
    {
        C2xSetTokenInt(packetHandle, "CAM", newPath, 1);
    }
    else if (value.pathDeltaTime.value > 65535)
    {
        C2xSetTokenInt(packetHandle, "CAM", newPath, 65535);
    }
    else
    {
        C2xSetTokenInt(packetHandle, "CAM", newPath, value.pathDeltaTime.value);
    }
    result = CheckLastError("CAM", gkFuncRefGet, result);
  }
  else
  {
    if( C2xIsTokenAvailable(packetHandle, "CAM", newPath) )
    {
      C2xRemoveToken(packetHandle, "CAM", newPath);
    }
  }

  return result;
}

int GetCAMPathParams(LONG packetHandle, struct CAMPath value, char oldPath[])
{
  char newPath[300]; 
  int i;
  int result;

  result = 0;

  value.length = C2xGetTokenInt(packetHandle, "CAM", oldPath);
  if((result = CheckLastError("CAM", gkFuncRefGet, result))==0)
  {
    for(i=0; i<value.length; i++)
    {
      snprintf(newPath, elcount(newPath), "%s[%d]", oldPath, i);
      GetCAMPathPointParams(packetHandle, value.arrayValue[i], newPath);
      result = CheckLastError("CAM", gkFuncRefGet, result);
    }
  }
  return result;
}

int SetCAMPathParams(LONG packetHandle, struct CAMPath value, char oldPath[])
{
  char newPath[300]; 
  int i;
  int result;

  result = 0;

  C2xRemoveToken(packetHandle, "CAM", oldPath);
  for(i=0; i<value.length; i++)
  {
    snprintf(newPath, elcount(newPath), "%s[%d]", oldPath, i);
    SetCAMPathPointParams(packetHandle, value.arrayValue[i], newPath);
    result = CheckLastError("CAM", gkFuncRefGet, result);
  }
  return result;
}

int GetCAMBasicVehicleContainerLowFrequencyParams(LONG packetHandle, struct CAMBasicVehicleContainerLowFrequency value, char oldPath[])
{
  char newPath[300]; 
  int j; 
  int k;
  int result;

  result = 0;

  snprintf(newPath, elcount(newPath), "%s.%s", oldPath, "vehicleRole");
  value.vehicleRole = C2xGetTokenInt(packetHandle, "CAM", newPath);
  result = CheckLastError("CAM", gkFuncRefGet, result);

  snprintf(newPath, elcount(newPath), "%s.%s", oldPath, "exteriorLights");
  value.exteriorLights.isValidFlag = 1;
  value.exteriorLights.stringLength = C2xGetTokenLengthBit(packetHandle, "CAM", newPath);
  if ((result = CheckLastError("CAM", gkFuncRefGet, result))==0)
  {
    if(value.exteriorLights.stringLength > 0)
    {
      for(j=0; j<value.exteriorLights.stringLength; j++)
      {
        if(C2xGetTokenBitOfBitString(packetHandle, "CAM", newPath, j) == 0)
        {
          value.exteriorLights.string[j] = '0';
        }
        else if(C2xGetTokenBitOfBitString(packetHandle, "CAM", newPath, j) == 1)
        {
          value.exteriorLights.string[j] = '1';
        }

        if(value.exteriorLights.stringLength == 1)
        {
          value.exteriorLights.string[1] = '0';
        }
        result = CheckLastError("CAM", gkFuncRefGet, result);
      }
    }
    else
    {
      for(k = value.exteriorLights.stringLength+1; k > -1; k--)
      {
        if(value.exteriorLights.string[k] == '1')
        {
          value.exteriorLights.string[k] = '0';
        }
      }
    }
  }

  snprintf(newPath, elcount(newPath), "%s.%s", oldPath, "pathHistory");
  GetCAMPathParams(packetHandle, value.pathHistory, newPath);
  result = CheckLastError("CAM", gkFuncRefGet, result);

  return result;
}

int SetCAMBasicVehicleContainerLowFrequencyParams(LONG packetHandle, struct CAMBasicVehicleContainerLowFrequency value, char oldPath[])
{
  char newPath[300]; 
  int j;
  int result;

  result = 0;

  snprintf(newPath, elcount(newPath), "%s.%s", oldPath, "vehicleRole");
  C2xSetTokenInt(packetHandle, "CAM", newPath, value.vehicleRole);
  result = CheckLastError("CAM", gkFuncRefGet, result);

  snprintf(newPath, elcount(newPath), "%s.%s", oldPath, "exteriorLights");
    for(j=0; j<value.exteriorLights.stringLength; j++)
    {
      if(value.exteriorLights.string[j] == '0')
      {
        C2xSetTokenBitOfBitString(packetHandle, "CAM", newPath, j, 0);
      }
      else
      {
        C2xSetTokenBitOfBitString(packetHandle, "CAM", newPath, j, 1);
      }
      result = CheckLastError("CAM", gkFuncRefGet, result);
    }

  snprintf(newPath, elcount(newPath), "%s.%s", oldPath, "pathHistory");
  SetCAMPathParams(packetHandle, value.pathHistory, newPath);
  result = CheckLastError("CAM", gkFuncRefGet, result);

  return result;
}

int GetCAMLowFrequencyContainerParams(LONG packetHandle, struct CAMLowFrequencyContainer value, char oldPath[])
{
  char newPath[300];
  int result;

  result = 0;

  value.choice = C2xGetTokenInt(packetHandle, "CAM", oldPath);

  switch(value.choice)
  {
    case 0:
    {
      snprintf(newPath, elcount(newPath), "%s.%s", oldPath, "basicVehicleContainerLowFrequency");
      GetCAMBasicVehicleContainerLowFrequencyParams(packetHandle, value.basicVehicleContainerLowFrequency, newPath);
      result = CheckLastError("CAM", gkFuncRefGet, result);
    }
    break;
  }
  return result;
}

int SetCAMLowFrequencyContainerParams(LONG packetHandle, struct CAMLowFrequencyContainer value, char oldPath[])
{
  char newPath[300];
  int result;

  result = 0;

  switch(value.choice)
  {
    case 0:
    {
      snprintf(newPath, elcount(newPath), "%s.%s", oldPath, "basicVehicleContainerLowFrequency");
      SetCAMBasicVehicleContainerLowFrequencyParams(packetHandle, value.basicVehicleContainerLowFrequency, newPath);
      result = CheckLastError("CAM", gkFuncRefGet, result);
    }
    break;
  }
  return result;
}

int GetCAMPtActivationParams(LONG packetHandle, struct CAMPtActivation value, char oldPath[])
{
  char newPath[300];
  int result;

  result = 0;

  snprintf(newPath, elcount(newPath), "%s.%s", oldPath, "ptActivationType");
  value.ptActivationType = C2xGetTokenInt(packetHandle, "CAM", newPath);
  result = CheckLastError("CAM", gkFuncRefGet, result);

  snprintf(newPath, elcount(newPath), "%s.%s", oldPath, "ptActivationData");
  value.ptActivationData.stringLength = C2xGetTokenData(packetHandle, "CAM", newPath, elcount(value.ptActivationData.string), value.ptActivationData.string);
  return result;
}

int SetCAMPtActivationParams(LONG packetHandle, struct CAMPtActivation value, char oldPath[])
{
  char newPath[300];
  int result;

  result = 0;

  snprintf(newPath, elcount(newPath), "%s.%s", oldPath, "ptActivationType");
  C2xSetTokenInt(packetHandle, "CAM", newPath, value.ptActivationType);
  result = CheckLastError("CAM", gkFuncRefGet, result);

  snprintf(newPath, elcount(newPath), "%s.%s", oldPath, "ptActivationData");
  C2xSetTokenData(packetHandle, "CAM", newPath, value.ptActivationData.stringLength, value.ptActivationData.string);

  return result;
}

int GetCAMPublicTransportContainerParams(LONG packetHandle, struct CAMPublicTransportContainer value, char oldPath[])
{
  char newPath[300];
  int result;

  result = 0;

  snprintf(newPath, elcount(newPath), "%s.%s", oldPath, "embarkationStatus");
  value.embarkationStatus = C2xGetTokenInt64(packetHandle, "CAM", newPath);
  result = CheckLastError("CAM", gkFuncRefGet, result);

  snprintf(newPath, elcount(newPath), "%s.%s", oldPath, "ptActivation");
  value.ptActivation.isValidFlag = C2xIsTokenAvailable(packetHandle, "CAM", newPath);
  if(value.ptActivation.isValidFlag==1)
  {
    GetCAMPtActivationParams(packetHandle, value.ptActivation, newPath);
    result = CheckLastError("CAM", gkFuncRefGet, result);
  }
  return result;
}

int SetCAMPublicTransportContainerParams(LONG packetHandle, struct CAMPublicTransportContainer value, char oldPath[])
{
  char newPath[300];
  int result;

  result = 0;

  snprintf(newPath, elcount(newPath), "%s.%s", oldPath, "embarkationStatus");
  C2xSetTokenInt64(packetHandle, "CAM", newPath, value.embarkationStatus);
  result = CheckLastError("CAM", gkFuncRefGet, result);

  snprintf(newPath, elcount(newPath), "%s.%s", oldPath, "ptActivation");
  if(value.ptActivation.isValidFlag==1)
  {
    SetCAMPtActivationParams(packetHandle, value.ptActivation, newPath);
    result = CheckLastError("CAM", gkFuncRefGet, result);
  }
  else
  {
    if( C2xIsTokenAvailable(packetHandle, "CAM", newPath) )
    {
      C2xRemoveToken(packetHandle, "CAM", newPath);
    }
  }

  return result;
}

int GetCAMSpecialTransportContainerParams(LONG packetHandle, struct CAMSpecialTransportContainer value, char oldPath[])
{
  char newPath[300]; 
  int j; 
  int k;
  int result;

  result = 0;

  snprintf(newPath, elcount(newPath), "%s.%s", oldPath, "specialTransportType");
  value.specialTransportType.isValidFlag = 1;
  value.specialTransportType.stringLength = C2xGetTokenLengthBit(packetHandle, "CAM", newPath);
  if ((result = CheckLastError("CAM", gkFuncRefGet, result))==0)
  {
    if(value.specialTransportType.stringLength > 0)
    {
      for(j=0; j<value.specialTransportType.stringLength; j++)
      {
        if(C2xGetTokenBitOfBitString(packetHandle, "CAM", newPath, j) == 0)
        {
          value.specialTransportType.string[j] = '0';
        }
        else if(C2xGetTokenBitOfBitString(packetHandle, "CAM", newPath, j) == 1)
        {
          value.specialTransportType.string[j] = '1';
        }

        if(value.specialTransportType.stringLength == 1)
        {
          value.specialTransportType.string[1] = '0';
        }
        result = CheckLastError("CAM", gkFuncRefGet, result);
      }
    }
    else
    {
      for(k = value.specialTransportType.stringLength+1; k > -1; k--)
      {
        if(value.specialTransportType.string[k] == '1')
        {
          value.specialTransportType.string[k] = '0';
        }
      }
    }
  }

  snprintf(newPath, elcount(newPath), "%s.%s", oldPath, "lightBarSirenInUse");
  value.lightBarSirenInUse.isValidFlag = 1;
  value.lightBarSirenInUse.stringLength = C2xGetTokenLengthBit(packetHandle, "CAM", newPath);
  if ((result = CheckLastError("CAM", gkFuncRefGet, result))==0)
  {
    if(value.lightBarSirenInUse.stringLength > 0)
    {
      for(j=0; j<value.lightBarSirenInUse.stringLength; j++)
      {
        if(C2xGetTokenBitOfBitString(packetHandle, "CAM", newPath, j) == 0)
        {
          value.lightBarSirenInUse.string[j] = '0';
        }
        else if(C2xGetTokenBitOfBitString(packetHandle, "CAM", newPath, j) == 1)
        {
          value.lightBarSirenInUse.string[j] = '1';
        }

        if(value.lightBarSirenInUse.stringLength == 1)
        {
          value.lightBarSirenInUse.string[1] = '0';
        }
        result = CheckLastError("CAM", gkFuncRefGet, result);
      }
    }
    else
    {
      for(k = value.lightBarSirenInUse.stringLength+1; k > -1; k--)
      {
        if(value.lightBarSirenInUse.string[k] == '1')
        {
          value.lightBarSirenInUse.string[k] = '0';
        }
      }
    }
  }

  return result;
}

int SetCAMSpecialTransportContainerParams(LONG packetHandle, struct CAMSpecialTransportContainer value, char oldPath[])
{
  char newPath[300]; 
  int j;
  int result;

  result = 0;

  snprintf(newPath, elcount(newPath), "%s.%s", oldPath, "specialTransportType");
    for(j=0; j<value.specialTransportType.stringLength; j++)
    {
      if(value.specialTransportType.string[j] == '0')
      {
        C2xSetTokenBitOfBitString(packetHandle, "CAM", newPath, j, 0);
      }
      else
      {
        C2xSetTokenBitOfBitString(packetHandle, "CAM", newPath, j, 1);
      }
      result = CheckLastError("CAM", gkFuncRefGet, result);
    }

  snprintf(newPath, elcount(newPath), "%s.%s", oldPath, "lightBarSirenInUse");
    for(j=0; j<value.lightBarSirenInUse.stringLength; j++)
    {
      if(value.lightBarSirenInUse.string[j] == '0')
      {
        C2xSetTokenBitOfBitString(packetHandle, "CAM", newPath, j, 0);
      }
      else
      {
        C2xSetTokenBitOfBitString(packetHandle, "CAM", newPath, j, 1);
      }
      result = CheckLastError("CAM", gkFuncRefGet, result);
    }

  return result;
}

int GetCAMDangerousGoodsContainerParams(LONG packetHandle, struct CAMDangerousGoodsContainer value, char oldPath[])
{
  char newPath[300];
  int result;

  result = 0;

  snprintf(newPath, elcount(newPath), "%s.%s", oldPath, "dangerousGoodsBasic");
  value.dangerousGoodsBasic = C2xGetTokenInt(packetHandle, "CAM", newPath);
  result = CheckLastError("CAM", gkFuncRefGet, result);

  return result;
}

int SetCAMDangerousGoodsContainerParams(LONG packetHandle, struct CAMDangerousGoodsContainer value, char oldPath[])
{
  char newPath[300];
  int result;

  result = 0;

  snprintf(newPath, elcount(newPath), "%s.%s", oldPath, "dangerousGoodsBasic");
  C2xSetTokenInt(packetHandle, "CAM", newPath, value.dangerousGoodsBasic);
  result = CheckLastError("CAM", gkFuncRefGet, result);

  return result;
}

int GetCAMClosedLanesParams(LONG packetHandle, struct CAMClosedLanes value, char oldPath[])
{
  char newPath[300]; 
  int j; 
  int k;
  int result;

  result = 0;

  snprintf(newPath, elcount(newPath), "%s.%s", oldPath, "innerhardShoulderStatus");
  value.innerhardShoulderStatus.isValidFlag = C2xIsTokenAvailable(packetHandle, "CAM", newPath);
  if(value.innerhardShoulderStatus.isValidFlag==1)
  {
    value.innerhardShoulderStatus.value = C2xGetTokenInt(packetHandle, "CAM", newPath);
    result = CheckLastError("CAM", gkFuncRefGet, result);
  }
  snprintf(newPath, elcount(newPath), "%s.%s", oldPath, "outerhardShoulderStatus");
  value.outerhardShoulderStatus.isValidFlag = C2xIsTokenAvailable(packetHandle, "CAM", newPath);
  if(value.outerhardShoulderStatus.isValidFlag==1)
  {
    value.outerhardShoulderStatus.value = C2xGetTokenInt(packetHandle, "CAM", newPath);
    result = CheckLastError("CAM", gkFuncRefGet, result);
  }
  snprintf(newPath, elcount(newPath), "%s.%s", oldPath, "drivingLaneStatus");
  value.drivingLaneStatus.isValidFlag = C2xIsTokenAvailable(packetHandle, "CAM", newPath);
  if(value.drivingLaneStatus.isValidFlag==1)
  {
    value.drivingLaneStatus.isValidFlag = 1;
    value.drivingLaneStatus.stringLength = C2xGetTokenLengthBit(packetHandle, "CAM", newPath);
    if ((result = CheckLastError("CAM", gkFuncRefGet, result))==0)
    {
      if(value.drivingLaneStatus.stringLength > 0)
      {
        for(j=0; j<value.drivingLaneStatus.stringLength; j++)
        {
          if(C2xGetTokenBitOfBitString(packetHandle, "CAM", newPath, j) == 0)
          {
            value.drivingLaneStatus.string[j] = '0';
          }
          else if(C2xGetTokenBitOfBitString(packetHandle, "CAM", newPath, j) == 1)
          {
            value.drivingLaneStatus.string[j] = '1';
          }

          if(value.drivingLaneStatus.stringLength == 1)
          {
            value.drivingLaneStatus.string[1] = '0';
          }
          result = CheckLastError("CAM", gkFuncRefGet, result);
        }
      }
      else
      {
        for(k = value.drivingLaneStatus.stringLength+1; k > -1; k--)
        {
          if(value.drivingLaneStatus.string[k] == '1')
          {
            value.drivingLaneStatus.string[k] = '0';
          }
        }
      }
    }

  }
  return result;
}

int SetCAMClosedLanesParams(LONG packetHandle, struct CAMClosedLanes value, char oldPath[])
{
  char newPath[300]; 
  int j;
  int result;

  result = 0;

  snprintf(newPath, elcount(newPath), "%s.%s", oldPath, "innerhardShoulderStatus");
  if(value.innerhardShoulderStatus.isValidFlag==1)
  {
    C2xSetTokenInt(packetHandle, "CAM", newPath, value.innerhardShoulderStatus.value);
    result = CheckLastError("CAM", gkFuncRefGet, result);
  }
  else
  {
    if( C2xIsTokenAvailable(packetHandle, "CAM", newPath) )
    {
      C2xRemoveToken(packetHandle, "CAM", newPath);
    }
  }

  snprintf(newPath, elcount(newPath), "%s.%s", oldPath, "outerhardShoulderStatus");
  if(value.outerhardShoulderStatus.isValidFlag==1)
  {
    C2xSetTokenInt(packetHandle, "CAM", newPath, value.outerhardShoulderStatus.value);
    result = CheckLastError("CAM", gkFuncRefGet, result);
  }
  else
  {
    if( C2xIsTokenAvailable(packetHandle, "CAM", newPath) )
    {
      C2xRemoveToken(packetHandle, "CAM", newPath);
    }
  }

  snprintf(newPath, elcount(newPath), "%s.%s", oldPath, "drivingLaneStatus");
  if(value.drivingLaneStatus.isValidFlag==1)
  {
      for(j=0; j<value.drivingLaneStatus.stringLength; j++)
      {
        if(value.drivingLaneStatus.string[j] == '0')
        {
          C2xSetTokenBitOfBitString(packetHandle, "CAM", newPath, j, 0);
        }
        else
        {
          C2xSetTokenBitOfBitString(packetHandle, "CAM", newPath, j, 1);
        }
        result = CheckLastError("CAM", gkFuncRefGet, result);
      }
  }
  else
  {
    if( C2xIsTokenAvailable(packetHandle, "CAM", newPath) )
    {
      C2xRemoveToken(packetHandle, "CAM", newPath);
    }
  }

  return result;
}

int GetCAMRoadWorksContainerBasicParams(LONG packetHandle, struct CAMRoadWorksContainerBasic value, char oldPath[])
{
  char newPath[300]; 
  int j; 
  int k;
  int result;

  result = 0;

  snprintf(newPath, elcount(newPath), "%s.%s", oldPath, "roadworksSubCauseCode");
  value.roadworksSubCauseCode.isValidFlag = C2xIsTokenAvailable(packetHandle, "CAM", newPath);
  if(value.roadworksSubCauseCode.isValidFlag==1)
  {
    value.roadworksSubCauseCode.value = C2xGetTokenInt(packetHandle, "CAM", newPath);
    result = CheckLastError("CAM", gkFuncRefGet, result);
  }
  snprintf(newPath, elcount(newPath), "%s.%s", oldPath, "lightBarSirenInUse");
  value.lightBarSirenInUse.isValidFlag = 1;
  value.lightBarSirenInUse.stringLength = C2xGetTokenLengthBit(packetHandle, "CAM", newPath);
  if ((result = CheckLastError("CAM", gkFuncRefGet, result))==0)
  {
    if(value.lightBarSirenInUse.stringLength > 0)
    {
      for(j=0; j<value.lightBarSirenInUse.stringLength; j++)
      {
        if(C2xGetTokenBitOfBitString(packetHandle, "CAM", newPath, j) == 0)
        {
          value.lightBarSirenInUse.string[j] = '0';
        }
        else if(C2xGetTokenBitOfBitString(packetHandle, "CAM", newPath, j) == 1)
        {
          value.lightBarSirenInUse.string[j] = '1';
        }

        if(value.lightBarSirenInUse.stringLength == 1)
        {
          value.lightBarSirenInUse.string[1] = '0';
        }
        result = CheckLastError("CAM", gkFuncRefGet, result);
      }
    }
    else
    {
      for(k = value.lightBarSirenInUse.stringLength+1; k > -1; k--)
      {
        if(value.lightBarSirenInUse.string[k] == '1')
        {
          value.lightBarSirenInUse.string[k] = '0';
        }
      }
    }
  }

  snprintf(newPath, elcount(newPath), "%s.%s", oldPath, "closedLanes");
  value.closedLanes.isValidFlag = C2xIsTokenAvailable(packetHandle, "CAM", newPath);
  if(value.closedLanes.isValidFlag==1)
  {
    GetCAMClosedLanesParams(packetHandle, value.closedLanes, newPath);
    result = CheckLastError("CAM", gkFuncRefGet, result);
  }
  return result;
}

int SetCAMRoadWorksContainerBasicParams(LONG packetHandle, struct CAMRoadWorksContainerBasic value, char oldPath[])
{
  char newPath[300]; 
  int j;
  int result;

  result = 0;

  snprintf(newPath, elcount(newPath), "%s.%s", oldPath, "roadworksSubCauseCode");
  if(value.roadworksSubCauseCode.isValidFlag==1)
  {
    C2xSetTokenInt(packetHandle, "CAM", newPath, value.roadworksSubCauseCode.value);
    result = CheckLastError("CAM", gkFuncRefGet, result);
  }
  else
  {
    if( C2xIsTokenAvailable(packetHandle, "CAM", newPath) )
    {
      C2xRemoveToken(packetHandle, "CAM", newPath);
    }
  }

  snprintf(newPath, elcount(newPath), "%s.%s", oldPath, "lightBarSirenInUse");
    for(j=0; j<value.lightBarSirenInUse.stringLength; j++)
    {
      if(value.lightBarSirenInUse.string[j] == '0')
      {
        C2xSetTokenBitOfBitString(packetHandle, "CAM", newPath, j, 0);
      }
      else
      {
        C2xSetTokenBitOfBitString(packetHandle, "CAM", newPath, j, 1);
      }
      result = CheckLastError("CAM", gkFuncRefGet, result);
    }

  snprintf(newPath, elcount(newPath), "%s.%s", oldPath, "closedLanes");
  if(value.closedLanes.isValidFlag==1)
  {
    SetCAMClosedLanesParams(packetHandle, value.closedLanes, newPath);
    result = CheckLastError("CAM", gkFuncRefGet, result);
  }
  else
  {
    if( C2xIsTokenAvailable(packetHandle, "CAM", newPath) )
    {
      C2xRemoveToken(packetHandle, "CAM", newPath);
    }
  }

  return result;
}

int GetCAMRescueContainerParams(LONG packetHandle, struct CAMRescueContainer value, char oldPath[])
{
  char newPath[300]; 
  int j; 
  int k;
  int result;

  result = 0;

  snprintf(newPath, elcount(newPath), "%s.%s", oldPath, "lightBarSirenInUse");
  value.lightBarSirenInUse.isValidFlag = 1;
  value.lightBarSirenInUse.stringLength = C2xGetTokenLengthBit(packetHandle, "CAM", newPath);
  if ((result = CheckLastError("CAM", gkFuncRefGet, result))==0)
  {
    if(value.lightBarSirenInUse.stringLength > 0)
    {
      for(j=0; j<value.lightBarSirenInUse.stringLength; j++)
      {
        if(C2xGetTokenBitOfBitString(packetHandle, "CAM", newPath, j) == 0)
        {
          value.lightBarSirenInUse.string[j] = '0';
        }
        else if(C2xGetTokenBitOfBitString(packetHandle, "CAM", newPath, j) == 1)
        {
          value.lightBarSirenInUse.string[j] = '1';
        }

        if(value.lightBarSirenInUse.stringLength == 1)
        {
          value.lightBarSirenInUse.string[1] = '0';
        }
        result = CheckLastError("CAM", gkFuncRefGet, result);
      }
    }
    else
    {
      for(k = value.lightBarSirenInUse.stringLength+1; k > -1; k--)
      {
        if(value.lightBarSirenInUse.string[k] == '1')
        {
          value.lightBarSirenInUse.string[k] = '0';
        }
      }
    }
  }

  return result;
}

int SetCAMRescueContainerParams(LONG packetHandle, struct CAMRescueContainer value, char oldPath[])
{
  char newPath[300]; 
  int j;
  int result;

  result = 0;

  snprintf(newPath, elcount(newPath), "%s.%s", oldPath, "lightBarSirenInUse");
    for(j=0; j<value.lightBarSirenInUse.stringLength; j++)
    {
      if(value.lightBarSirenInUse.string[j] == '0')
      {
        C2xSetTokenBitOfBitString(packetHandle, "CAM", newPath, j, 0);
      }
      else
      {
        C2xSetTokenBitOfBitString(packetHandle, "CAM", newPath, j, 1);
      }
      result = CheckLastError("CAM", gkFuncRefGet, result);
    }

  return result;
}

int GetCAMCauseCodeParams(LONG packetHandle, struct CAMCauseCode value, char oldPath[])
{
  char newPath[300];
  int result;

  result = 0;

  snprintf(newPath, elcount(newPath), "%s.%s", oldPath, "causeCode");
  value.causeCode = C2xGetTokenInt(packetHandle, "CAM", newPath);
  result = CheckLastError("CAM", gkFuncRefGet, result);

  snprintf(newPath, elcount(newPath), "%s.%s", oldPath, "subCauseCode");
  value.subCauseCode = C2xGetTokenInt(packetHandle, "CAM", newPath);
  result = CheckLastError("CAM", gkFuncRefGet, result);

  return result;
}

int SetCAMCauseCodeParams(LONG packetHandle, struct CAMCauseCode value, char oldPath[])
{
  char newPath[300];
  int result;

  result = 0;

  snprintf(newPath, elcount(newPath), "%s.%s", oldPath, "causeCode");
  C2xSetTokenInt(packetHandle, "CAM", newPath, value.causeCode);
  result = CheckLastError("CAM", gkFuncRefGet, result);

  snprintf(newPath, elcount(newPath), "%s.%s", oldPath, "subCauseCode");
  C2xSetTokenInt(packetHandle, "CAM", newPath, value.subCauseCode);
  result = CheckLastError("CAM", gkFuncRefGet, result);

  return result;
}

int GetCAMEmergencyContainerParams(LONG packetHandle, struct CAMEmergencyContainer value, char oldPath[])
{
  char newPath[300]; 
  int j; 
  int k;
  int result;

  result = 0;

  snprintf(newPath, elcount(newPath), "%s.%s", oldPath, "lightBarSirenInUse");
  value.lightBarSirenInUse.isValidFlag = 1;
  value.lightBarSirenInUse.stringLength = C2xGetTokenLengthBit(packetHandle, "CAM", newPath);
  if ((result = CheckLastError("CAM", gkFuncRefGet, result))==0)
  {
    if(value.lightBarSirenInUse.stringLength > 0)
    {
      for(j=0; j<value.lightBarSirenInUse.stringLength; j++)
      {
        if(C2xGetTokenBitOfBitString(packetHandle, "CAM", newPath, j) == 0)
        {
          value.lightBarSirenInUse.string[j] = '0';
        }
        else if(C2xGetTokenBitOfBitString(packetHandle, "CAM", newPath, j) == 1)
        {
          value.lightBarSirenInUse.string[j] = '1';
        }

        if(value.lightBarSirenInUse.stringLength == 1)
        {
          value.lightBarSirenInUse.string[1] = '0';
        }
        result = CheckLastError("CAM", gkFuncRefGet, result);
      }
    }
    else
    {
      for(k = value.lightBarSirenInUse.stringLength+1; k > -1; k--)
      {
        if(value.lightBarSirenInUse.string[k] == '1')
        {
          value.lightBarSirenInUse.string[k] = '0';
        }
      }
    }
  }

  snprintf(newPath, elcount(newPath), "%s.%s", oldPath, "incidentIndication");
  value.incidentIndication.isValidFlag = C2xIsTokenAvailable(packetHandle, "CAM", newPath);
  if(value.incidentIndication.isValidFlag==1)
  {
    GetCAMCauseCodeParams(packetHandle, value.incidentIndication, newPath);
    result = CheckLastError("CAM", gkFuncRefGet, result);
  }
  snprintf(newPath, elcount(newPath), "%s.%s", oldPath, "emergencyPriority");
  value.emergencyPriority.isValidFlag = C2xIsTokenAvailable(packetHandle, "CAM", newPath);
  if(value.emergencyPriority.isValidFlag==1)
  {
    value.emergencyPriority.isValidFlag = 1;
    value.emergencyPriority.stringLength = C2xGetTokenLengthBit(packetHandle, "CAM", newPath);
    if ((result = CheckLastError("CAM", gkFuncRefGet, result))==0)
    {
      if(value.emergencyPriority.stringLength > 0)
      {
        for(j=0; j<value.emergencyPriority.stringLength; j++)
        {
          if(C2xGetTokenBitOfBitString(packetHandle, "CAM", newPath, j) == 0)
          {
            value.emergencyPriority.string[j] = '0';
          }
          else if(C2xGetTokenBitOfBitString(packetHandle, "CAM", newPath, j) == 1)
          {
            value.emergencyPriority.string[j] = '1';
          }

          if(value.emergencyPriority.stringLength == 1)
          {
            value.emergencyPriority.string[1] = '0';
          }
          result = CheckLastError("CAM", gkFuncRefGet, result);
        }
      }
      else
      {
        for(k = value.emergencyPriority.stringLength+1; k > -1; k--)
        {
          if(value.emergencyPriority.string[k] == '1')
          {
            value.emergencyPriority.string[k] = '0';
          }
        }
      }
    }

  }
  return result;
}

int SetCAMEmergencyContainerParams(LONG packetHandle, struct CAMEmergencyContainer value, char oldPath[])
{
  char newPath[300]; 
  int j;
  int result;

  result = 0;

  snprintf(newPath, elcount(newPath), "%s.%s", oldPath, "lightBarSirenInUse");
    for(j=0; j<value.lightBarSirenInUse.stringLength; j++)
    {
      if(value.lightBarSirenInUse.string[j] == '0')
      {
        C2xSetTokenBitOfBitString(packetHandle, "CAM", newPath, j, 0);
      }
      else
      {
        C2xSetTokenBitOfBitString(packetHandle, "CAM", newPath, j, 1);
      }
      result = CheckLastError("CAM", gkFuncRefGet, result);
    }

  snprintf(newPath, elcount(newPath), "%s.%s", oldPath, "incidentIndication");
  if(value.incidentIndication.isValidFlag==1)
  {
    SetCAMCauseCodeParams(packetHandle, value.incidentIndication, newPath);
    result = CheckLastError("CAM", gkFuncRefGet, result);
  }
  else
  {
    if( C2xIsTokenAvailable(packetHandle, "CAM", newPath) )
    {
      C2xRemoveToken(packetHandle, "CAM", newPath);
    }
  }

  snprintf(newPath, elcount(newPath), "%s.%s", oldPath, "emergencyPriority");
  if(value.emergencyPriority.isValidFlag==1)
  {
      for(j=0; j<value.emergencyPriority.stringLength; j++)
      {
        if(value.emergencyPriority.string[j] == '0')
        {
          C2xSetTokenBitOfBitString(packetHandle, "CAM", newPath, j, 0);
        }
        else
        {
          C2xSetTokenBitOfBitString(packetHandle, "CAM", newPath, j, 1);
        }
        result = CheckLastError("CAM", gkFuncRefGet, result);
      }
  }
  else
  {
    if( C2xIsTokenAvailable(packetHandle, "CAM", newPath) )
    {
      C2xRemoveToken(packetHandle, "CAM", newPath);
    }
  }

  return result;
}

int GetCAMSafetyCarContainerParams(LONG packetHandle, struct CAMSafetyCarContainer value, char oldPath[])
{
  char newPath[300]; 
  int j; 
  int k;
  int result;

  result = 0;

  snprintf(newPath, elcount(newPath), "%s.%s", oldPath, "lightBarSirenInUse");
  value.lightBarSirenInUse.isValidFlag = 1;
  value.lightBarSirenInUse.stringLength = C2xGetTokenLengthBit(packetHandle, "CAM", newPath);
  if ((result = CheckLastError("CAM", gkFuncRefGet, result))==0)
  {
    if(value.lightBarSirenInUse.stringLength > 0)
    {
      for(j=0; j<value.lightBarSirenInUse.stringLength; j++)
      {
        if(C2xGetTokenBitOfBitString(packetHandle, "CAM", newPath, j) == 0)
        {
          value.lightBarSirenInUse.string[j] = '0';
        }
        else if(C2xGetTokenBitOfBitString(packetHandle, "CAM", newPath, j) == 1)
        {
          value.lightBarSirenInUse.string[j] = '1';
        }

        if(value.lightBarSirenInUse.stringLength == 1)
        {
          value.lightBarSirenInUse.string[1] = '0';
        }
        result = CheckLastError("CAM", gkFuncRefGet, result);
      }
    }
    else
    {
      for(k = value.lightBarSirenInUse.stringLength+1; k > -1; k--)
      {
        if(value.lightBarSirenInUse.string[k] == '1')
        {
          value.lightBarSirenInUse.string[k] = '0';
        }
      }
    }
  }

  snprintf(newPath, elcount(newPath), "%s.%s", oldPath, "incidentIndication");
  value.incidentIndication.isValidFlag = C2xIsTokenAvailable(packetHandle, "CAM", newPath);
  if(value.incidentIndication.isValidFlag==1)
  {
    GetCAMCauseCodeParams(packetHandle, value.incidentIndication, newPath);
    result = CheckLastError("CAM", gkFuncRefGet, result);
  }
  snprintf(newPath, elcount(newPath), "%s.%s", oldPath, "trafficRule");
  value.trafficRule.isValidFlag = C2xIsTokenAvailable(packetHandle, "CAM", newPath);
  if(value.trafficRule.isValidFlag==1)
  {
    value.trafficRule.value = C2xGetTokenInt(packetHandle, "CAM", newPath);
    result = CheckLastError("CAM", gkFuncRefGet, result);
  }
  snprintf(newPath, elcount(newPath), "%s.%s", oldPath, "speedLimit");
  value.speedLimit.isValidFlag = C2xIsTokenAvailable(packetHandle, "CAM", newPath);
  if(value.speedLimit.isValidFlag==1)
  {
    value.speedLimit.value = C2xGetTokenInt(packetHandle, "CAM", newPath);
    result = CheckLastError("CAM", gkFuncRefGet, result);
  }
  return result;
}

int SetCAMSafetyCarContainerParams(LONG packetHandle, struct CAMSafetyCarContainer value, char oldPath[])
{
  char newPath[300]; 
  int j;
  int result;

  result = 0;

  snprintf(newPath, elcount(newPath), "%s.%s", oldPath, "lightBarSirenInUse");
    for(j=0; j<value.lightBarSirenInUse.stringLength; j++)
    {
      if(value.lightBarSirenInUse.string[j] == '0')
      {
        C2xSetTokenBitOfBitString(packetHandle, "CAM", newPath, j, 0);
      }
      else
      {
        C2xSetTokenBitOfBitString(packetHandle, "CAM", newPath, j, 1);
      }
      result = CheckLastError("CAM", gkFuncRefGet, result);
    }

  snprintf(newPath, elcount(newPath), "%s.%s", oldPath, "incidentIndication");
  if(value.incidentIndication.isValidFlag==1)
  {
    SetCAMCauseCodeParams(packetHandle, value.incidentIndication, newPath);
    result = CheckLastError("CAM", gkFuncRefGet, result);
  }
  else
  {
    if( C2xIsTokenAvailable(packetHandle, "CAM", newPath) )
    {
      C2xRemoveToken(packetHandle, "CAM", newPath);
    }
  }

  snprintf(newPath, elcount(newPath), "%s.%s", oldPath, "trafficRule");
  if(value.trafficRule.isValidFlag==1)
  {
    C2xSetTokenInt(packetHandle, "CAM", newPath, value.trafficRule.value);
    result = CheckLastError("CAM", gkFuncRefGet, result);
  }
  else
  {
    if( C2xIsTokenAvailable(packetHandle, "CAM", newPath) )
    {
      C2xRemoveToken(packetHandle, "CAM", newPath);
    }
  }

  snprintf(newPath, elcount(newPath), "%s.%s", oldPath, "speedLimit");
  if(value.speedLimit.isValidFlag==1)
  {
    if (value.speedLimit.value < 1)
    {
        C2xSetTokenInt(packetHandle, "CAM", newPath, 1);
    }
    else if (value.speedLimit.value > 255)
    {
        C2xSetTokenInt(packetHandle, "CAM", newPath, 255);
    }
    else
    {
        C2xSetTokenInt(packetHandle, "CAM", newPath, value.speedLimit.value);
    }
    result = CheckLastError("CAM", gkFuncRefGet, result);
  }
  else
  {
    if( C2xIsTokenAvailable(packetHandle, "CAM", newPath) )
    {
      C2xRemoveToken(packetHandle, "CAM", newPath);
    }
  }

  return result;
}

int GetCAMSpecialVehicleContainerParams(LONG packetHandle, struct CAMSpecialVehicleContainer value, char oldPath[])
{
  char newPath[300];
  int result;

  result = 0;

  value.choice = C2xGetTokenInt(packetHandle, "CAM", oldPath);

  switch(value.choice)
  {
    case 0:
    {
      snprintf(newPath, elcount(newPath), "%s.%s", oldPath, "publicTransportContainer");
      GetCAMPublicTransportContainerParams(packetHandle, value.publicTransportContainer, newPath);
      result = CheckLastError("CAM", gkFuncRefGet, result);
    }
    break;
    case 1:
    {
      snprintf(newPath, elcount(newPath), "%s.%s", oldPath, "specialTransportContainer");
      GetCAMSpecialTransportContainerParams(packetHandle, value.specialTransportContainer, newPath);
      result = CheckLastError("CAM", gkFuncRefGet, result);
    }
    break;
    case 2:
    {
      snprintf(newPath, elcount(newPath), "%s.%s", oldPath, "dangerousGoodsContainer");
      GetCAMDangerousGoodsContainerParams(packetHandle, value.dangerousGoodsContainer, newPath);
      result = CheckLastError("CAM", gkFuncRefGet, result);
    }
    break;
    case 3:
    {
      snprintf(newPath, elcount(newPath), "%s.%s", oldPath, "roadWorksContainerBasic");
      GetCAMRoadWorksContainerBasicParams(packetHandle, value.roadWorksContainerBasic, newPath);
      result = CheckLastError("CAM", gkFuncRefGet, result);
    }
    break;
    case 4:
    {
      snprintf(newPath, elcount(newPath), "%s.%s", oldPath, "rescueContainer");
      GetCAMRescueContainerParams(packetHandle, value.rescueContainer, newPath);
      result = CheckLastError("CAM", gkFuncRefGet, result);
    }
    break;
    case 5:
    {
      snprintf(newPath, elcount(newPath), "%s.%s", oldPath, "emergencyContainer");
      GetCAMEmergencyContainerParams(packetHandle, value.emergencyContainer, newPath);
      result = CheckLastError("CAM", gkFuncRefGet, result);
    }
    break;
    case 6:
    {
      snprintf(newPath, elcount(newPath), "%s.%s", oldPath, "safetyCarContainer");
      GetCAMSafetyCarContainerParams(packetHandle, value.safetyCarContainer, newPath);
      result = CheckLastError("CAM", gkFuncRefGet, result);
    }
    break;
  }
  return result;
}

int SetCAMSpecialVehicleContainerParams(LONG packetHandle, struct CAMSpecialVehicleContainer value, char oldPath[])
{
  char newPath[300];
  int result;

  result = 0;

  switch(value.choice)
  {
    case 0:
    {
      snprintf(newPath, elcount(newPath), "%s.%s", oldPath, "publicTransportContainer");
      SetCAMPublicTransportContainerParams(packetHandle, value.publicTransportContainer, newPath);
      result = CheckLastError("CAM", gkFuncRefGet, result);
    }
    break;
    case 1:
    {
      snprintf(newPath, elcount(newPath), "%s.%s", oldPath, "specialTransportContainer");
      SetCAMSpecialTransportContainerParams(packetHandle, value.specialTransportContainer, newPath);
      result = CheckLastError("CAM", gkFuncRefGet, result);
    }
    break;
    case 2:
    {
      snprintf(newPath, elcount(newPath), "%s.%s", oldPath, "dangerousGoodsContainer");
      SetCAMDangerousGoodsContainerParams(packetHandle, value.dangerousGoodsContainer, newPath);
      result = CheckLastError("CAM", gkFuncRefGet, result);
    }
    break;
    case 3:
    {
      snprintf(newPath, elcount(newPath), "%s.%s", oldPath, "roadWorksContainerBasic");
      SetCAMRoadWorksContainerBasicParams(packetHandle, value.roadWorksContainerBasic, newPath);
      result = CheckLastError("CAM", gkFuncRefGet, result);
    }
    break;
    case 4:
    {
      snprintf(newPath, elcount(newPath), "%s.%s", oldPath, "rescueContainer");
      SetCAMRescueContainerParams(packetHandle, value.rescueContainer, newPath);
      result = CheckLastError("CAM", gkFuncRefGet, result);
    }
    break;
    case 5:
    {
      snprintf(newPath, elcount(newPath), "%s.%s", oldPath, "emergencyContainer");
      SetCAMEmergencyContainerParams(packetHandle, value.emergencyContainer, newPath);
      result = CheckLastError("CAM", gkFuncRefGet, result);
    }
    break;
    case 6:
    {
      snprintf(newPath, elcount(newPath), "%s.%s", oldPath, "safetyCarContainer");
      SetCAMSafetyCarContainerParams(packetHandle, value.safetyCarContainer, newPath);
      result = CheckLastError("CAM", gkFuncRefGet, result);
    }
    break;
  }
  return result;
}

int GetCAMCyclistTypeSpecificInformationParams(LONG packetHandle, struct CAMCyclistTypeSpecificInformation value, char oldPath[])
{
  char newPath[300];
  int result;

  result = 0;

  snprintf(newPath, elcount(newPath), "%s.%s", oldPath, "vruSubProfileBicyclist");
  value.vruSubProfileBicyclist.isValidFlag = C2xIsTokenAvailable(packetHandle, "CAM", newPath);
  if(value.vruSubProfileBicyclist.isValidFlag==1)
  {
    value.vruSubProfileBicyclist.value = C2xGetTokenInt(packetHandle, "CAM", newPath);
    result = CheckLastError("CAM", gkFuncRefGet, result);
  }
  snprintf(newPath, elcount(newPath), "%s.%s", oldPath, "vruMovementControl");
  value.vruMovementControl.isValidFlag = C2xIsTokenAvailable(packetHandle, "CAM", newPath);
  if(value.vruMovementControl.isValidFlag==1)
  {
    value.vruMovementControl.value = C2xGetTokenInt(packetHandle, "CAM", newPath);
    result = CheckLastError("CAM", gkFuncRefGet, result);
  }
  return result;
}

int SetCAMCyclistTypeSpecificInformationParams(LONG packetHandle, struct CAMCyclistTypeSpecificInformation value, char oldPath[])
{
  char newPath[300];
  int result;

  result = 0;

  snprintf(newPath, elcount(newPath), "%s.%s", oldPath, "vruSubProfileBicyclist");
  if(value.vruSubProfileBicyclist.isValidFlag==1)
  {
    C2xSetTokenInt(packetHandle, "CAM", newPath, value.vruSubProfileBicyclist.value);
    result = CheckLastError("CAM", gkFuncRefGet, result);
  }
  else
  {
    if( C2xIsTokenAvailable(packetHandle, "CAM", newPath) )
    {
      C2xRemoveToken(packetHandle, "CAM", newPath);
    }
  }

  snprintf(newPath, elcount(newPath), "%s.%s", oldPath, "vruMovementControl");
  if(value.vruMovementControl.isValidFlag==1)
  {
    C2xSetTokenInt(packetHandle, "CAM", newPath, value.vruMovementControl.value);
    result = CheckLastError("CAM", gkFuncRefGet, result);
  }
  else
  {
    if( C2xIsTokenAvailable(packetHandle, "CAM", newPath) )
    {
      C2xRemoveToken(packetHandle, "CAM", newPath);
    }
  }

  return result;
}

int GetCAMTwoWheelerTypeSpecificInformationParams(LONG packetHandle, struct CAMTwoWheelerTypeSpecificInformation value, char oldPath[])
{
  char newPath[300];
  int result;

  result = 0;

  value.choice = C2xGetTokenInt(packetHandle, "CAM", oldPath);

  switch(value.choice)
  {
    case 0:
    {
      snprintf(newPath, elcount(newPath), "%s.%s", oldPath, "cyclist");
      GetCAMCyclistTypeSpecificInformationParams(packetHandle, value.cyclist, newPath);
      result = CheckLastError("CAM", gkFuncRefGet, result);
    }
    break;
  }
  return result;
}

int SetCAMTwoWheelerTypeSpecificInformationParams(LONG packetHandle, struct CAMTwoWheelerTypeSpecificInformation value, char oldPath[])
{
  char newPath[300];
  int result;

  result = 0;

  switch(value.choice)
  {
    case 0:
    {
      snprintf(newPath, elcount(newPath), "%s.%s", oldPath, "cyclist");
      SetCAMCyclistTypeSpecificInformationParams(packetHandle, value.cyclist, newPath);
      result = CheckLastError("CAM", gkFuncRefGet, result);
    }
    break;
  }
  return result;
}

int GetCAMCartesianAngleParams(LONG packetHandle, struct CAMCartesianAngle value, char oldPath[])
{
  char newPath[300];
  int result;

  result = 0;

  snprintf(newPath, elcount(newPath), "%s.%s", oldPath, "value");
  value.value = C2xGetTokenInt(packetHandle, "CAM", newPath);
  result = CheckLastError("CAM", gkFuncRefGet, result);

  snprintf(newPath, elcount(newPath), "%s.%s", oldPath, "confidence");
  value.confidence = C2xGetTokenInt(packetHandle, "CAM", newPath);
  result = CheckLastError("CAM", gkFuncRefGet, result);

  return result;
}

int SetCAMCartesianAngleParams(LONG packetHandle, struct CAMCartesianAngle value, char oldPath[])
{
  char newPath[300];
  int result;

  result = 0;

  snprintf(newPath, elcount(newPath), "%s.%s", oldPath, "value");
  C2xSetTokenInt(packetHandle, "CAM", newPath, value.value);
  result = CheckLastError("CAM", gkFuncRefGet, result);

  snprintf(newPath, elcount(newPath), "%s.%s", oldPath, "confidence");
  if (value.confidence < 1)
  {
    C2xSetTokenInt(packetHandle, "CAM", newPath, 1);
  }
  else if (value.confidence > 127)
  {
    C2xSetTokenInt(packetHandle, "CAM", newPath, 127);
  }
  else
  {
    C2xSetTokenInt(packetHandle, "CAM", newPath, value.confidence);
  }
  result = CheckLastError("CAM", gkFuncRefGet, result);

  return result;
}

int GetCAMWgs84AngleParams(LONG packetHandle, struct CAMWgs84Angle value, char oldPath[])
{
  char newPath[300];
  int result;

  result = 0;

  snprintf(newPath, elcount(newPath), "%s.%s", oldPath, "value");
  value.value = C2xGetTokenInt(packetHandle, "CAM", newPath);
  result = CheckLastError("CAM", gkFuncRefGet, result);

  snprintf(newPath, elcount(newPath), "%s.%s", oldPath, "confidence");
  value.confidence = C2xGetTokenInt(packetHandle, "CAM", newPath);
  result = CheckLastError("CAM", gkFuncRefGet, result);

  return result;
}

int SetCAMWgs84AngleParams(LONG packetHandle, struct CAMWgs84Angle value, char oldPath[])
{
  char newPath[300];
  int result;

  result = 0;

  snprintf(newPath, elcount(newPath), "%s.%s", oldPath, "value");
  C2xSetTokenInt(packetHandle, "CAM", newPath, value.value);
  result = CheckLastError("CAM", gkFuncRefGet, result);

  snprintf(newPath, elcount(newPath), "%s.%s", oldPath, "confidence");
  if (value.confidence < 1)
  {
    C2xSetTokenInt(packetHandle, "CAM", newPath, 1);
  }
  else if (value.confidence > 127)
  {
    C2xSetTokenInt(packetHandle, "CAM", newPath, 127);
  }
  else
  {
    C2xSetTokenInt(packetHandle, "CAM", newPath, value.confidence);
  }
  result = CheckLastError("CAM", gkFuncRefGet, result);

  return result;
}

int GetCAMStabilityChangeIndicationParams(LONG packetHandle, struct CAMStabilityChangeIndication value, char oldPath[])
{
  char newPath[300];
  int result;

  result = 0;

  snprintf(newPath, elcount(newPath), "%s.%s", oldPath, "lossProbability");
  value.lossProbability = C2xGetTokenInt(packetHandle, "CAM", newPath);
  result = CheckLastError("CAM", gkFuncRefGet, result);

  snprintf(newPath, elcount(newPath), "%s.%s", oldPath, "actionDeltaTime");
  value.actionDeltaTime = C2xGetTokenInt(packetHandle, "CAM", newPath);
  result = CheckLastError("CAM", gkFuncRefGet, result);

  return result;
}

int SetCAMStabilityChangeIndicationParams(LONG packetHandle, struct CAMStabilityChangeIndication value, char oldPath[])
{
  char newPath[300];
  int result;

  result = 0;

  snprintf(newPath, elcount(newPath), "%s.%s", oldPath, "lossProbability");
  C2xSetTokenInt(packetHandle, "CAM", newPath, value.lossProbability);
  result = CheckLastError("CAM", gkFuncRefGet, result);

  snprintf(newPath, elcount(newPath), "%s.%s", oldPath, "actionDeltaTime");
  C2xSetTokenInt(packetHandle, "CAM", newPath, value.actionDeltaTime);
  result = CheckLastError("CAM", gkFuncRefGet, result);

  return result;
}

int GetCAMTwoWheelerContainerParams(LONG packetHandle, struct CAMTwoWheelerContainer value, char oldPath[])
{
  char newPath[300];
  int result;

  result = 0;

  snprintf(newPath, elcount(newPath), "%s.%s", oldPath, "typeSpecificInformation");
  value.typeSpecificInformation.isValidFlag = C2xIsTokenAvailable(packetHandle, "CAM", newPath);
  if(value.typeSpecificInformation.isValidFlag==1)
  {
    GetCAMTwoWheelerTypeSpecificInformationParams(packetHandle, value.typeSpecificInformation, newPath);
    result = CheckLastError("CAM", gkFuncRefGet, result);
  }
  snprintf(newPath, elcount(newPath), "%s.%s", oldPath, "rollAngle");
  value.rollAngle.isValidFlag = C2xIsTokenAvailable(packetHandle, "CAM", newPath);
  if(value.rollAngle.isValidFlag==1)
  {
    GetCAMCartesianAngleParams(packetHandle, value.rollAngle, newPath);
    result = CheckLastError("CAM", gkFuncRefGet, result);
  }
  snprintf(newPath, elcount(newPath), "%s.%s", oldPath, "orientation");
  value.orientation.isValidFlag = C2xIsTokenAvailable(packetHandle, "CAM", newPath);
  if(value.orientation.isValidFlag==1)
  {
    GetCAMWgs84AngleParams(packetHandle, value.orientation, newPath);
    result = CheckLastError("CAM", gkFuncRefGet, result);
  }
  snprintf(newPath, elcount(newPath), "%s.%s", oldPath, "stabilityChangeIndication");
  value.stabilityChangeIndication.isValidFlag = C2xIsTokenAvailable(packetHandle, "CAM", newPath);
  if(value.stabilityChangeIndication.isValidFlag==1)
  {
    GetCAMStabilityChangeIndicationParams(packetHandle, value.stabilityChangeIndication, newPath);
    result = CheckLastError("CAM", gkFuncRefGet, result);
  }
  return result;
}

int SetCAMTwoWheelerContainerParams(LONG packetHandle, struct CAMTwoWheelerContainer value, char oldPath[])
{
  char newPath[300];
  int result;

  result = 0;

  snprintf(newPath, elcount(newPath), "%s.%s", oldPath, "typeSpecificInformation");
  if(value.typeSpecificInformation.isValidFlag==1)
  {
    SetCAMTwoWheelerTypeSpecificInformationParams(packetHandle, value.typeSpecificInformation, newPath);
    result = CheckLastError("CAM", gkFuncRefGet, result);
  }
  else
  {
    if( C2xIsTokenAvailable(packetHandle, "CAM", newPath) )
    {
      C2xRemoveToken(packetHandle, "CAM", newPath);
    }
  }

  snprintf(newPath, elcount(newPath), "%s.%s", oldPath, "rollAngle");
  if(value.rollAngle.isValidFlag==1)
  {
    SetCAMCartesianAngleParams(packetHandle, value.rollAngle, newPath);
    result = CheckLastError("CAM", gkFuncRefGet, result);
  }
  else
  {
    if( C2xIsTokenAvailable(packetHandle, "CAM", newPath) )
    {
      C2xRemoveToken(packetHandle, "CAM", newPath);
    }
  }

  snprintf(newPath, elcount(newPath), "%s.%s", oldPath, "orientation");
  if(value.orientation.isValidFlag==1)
  {
    SetCAMWgs84AngleParams(packetHandle, value.orientation, newPath);
    result = CheckLastError("CAM", gkFuncRefGet, result);
  }
  else
  {
    if( C2xIsTokenAvailable(packetHandle, "CAM", newPath) )
    {
      C2xRemoveToken(packetHandle, "CAM", newPath);
    }
  }

  snprintf(newPath, elcount(newPath), "%s.%s", oldPath, "stabilityChangeIndication");
  if(value.stabilityChangeIndication.isValidFlag==1)
  {
    SetCAMStabilityChangeIndicationParams(packetHandle, value.stabilityChangeIndication, newPath);
    result = CheckLastError("CAM", gkFuncRefGet, result);
  }
  else
  {
    if( C2xIsTokenAvailable(packetHandle, "CAM", newPath) )
    {
      C2xRemoveToken(packetHandle, "CAM", newPath);
    }
  }

  return result;
}

int GetCAMDeltaPositionParams(LONG packetHandle, struct CAMDeltaPosition value, char oldPath[])
{
  char newPath[300];
  int result;

  result = 0;

  snprintf(newPath, elcount(newPath), "%s.%s", oldPath, "deltaLatitude");
  value.deltaLatitude = C2xGetTokenInt(packetHandle, "CAM", newPath);
  result = CheckLastError("CAM", gkFuncRefGet, result);

  snprintf(newPath, elcount(newPath), "%s.%s", oldPath, "deltaLongitude");
  value.deltaLongitude = C2xGetTokenInt(packetHandle, "CAM", newPath);
  result = CheckLastError("CAM", gkFuncRefGet, result);

  return result;
}

int SetCAMDeltaPositionParams(LONG packetHandle, struct CAMDeltaPosition value, char oldPath[])
{
  char newPath[300];
  int result;

  result = 0;

  snprintf(newPath, elcount(newPath), "%s.%s", oldPath, "deltaLatitude");
  C2xSetTokenInt(packetHandle, "CAM", newPath, value.deltaLatitude);
  result = CheckLastError("CAM", gkFuncRefGet, result);

  snprintf(newPath, elcount(newPath), "%s.%s", oldPath, "deltaLongitude");
  C2xSetTokenInt(packetHandle, "CAM", newPath, value.deltaLongitude);
  result = CheckLastError("CAM", gkFuncRefGet, result);

  return result;
}

int GetCAMDeltaPositionsParams(LONG packetHandle, struct CAMDeltaPositions value, char oldPath[])
{
  char newPath[300]; 
  int i;
  int result;

  result = 0;

  value.length = C2xGetTokenInt(packetHandle, "CAM", oldPath);
  if((result = CheckLastError("CAM", gkFuncRefGet, result))==0)
  {
    for(i=0; i<value.length; i++)
    {
      snprintf(newPath, elcount(newPath), "%s[%d]", oldPath, i);
      GetCAMDeltaPositionParams(packetHandle, value.arrayValue[i], newPath);
      result = CheckLastError("CAM", gkFuncRefGet, result);
    }
  }
  return result;
}

int SetCAMDeltaPositionsParams(LONG packetHandle, struct CAMDeltaPositions value, char oldPath[])
{
  char newPath[300]; 
  int i;
  int result;

  result = 0;

  C2xRemoveToken(packetHandle, "CAM", oldPath);
  for(i=0; i<value.length; i++)
  {
    snprintf(newPath, elcount(newPath), "%s[%d]", oldPath, i);
    SetCAMDeltaPositionParams(packetHandle, value.arrayValue[i], newPath);
    result = CheckLastError("CAM", gkFuncRefGet, result);
  }
  return result;
}

int GetCAMDeltaReferencePositionsParams(LONG packetHandle, struct CAMDeltaReferencePositions value, char oldPath[])
{
  char newPath[300]; 
  int i;
  int result;

  result = 0;

  value.length = C2xGetTokenInt(packetHandle, "CAM", oldPath);
  if((result = CheckLastError("CAM", gkFuncRefGet, result))==0)
  {
    for(i=0; i<value.length; i++)
    {
      snprintf(newPath, elcount(newPath), "%s[%d]", oldPath, i);
      GetCAMDeltaReferencePositionParams(packetHandle, value.arrayValue[i], newPath);
      result = CheckLastError("CAM", gkFuncRefGet, result);
    }
  }
  return result;
}

int SetCAMDeltaReferencePositionsParams(LONG packetHandle, struct CAMDeltaReferencePositions value, char oldPath[])
{
  char newPath[300]; 
  int i;
  int result;

  result = 0;

  C2xRemoveToken(packetHandle, "CAM", oldPath);
  for(i=0; i<value.length; i++)
  {
    snprintf(newPath, elcount(newPath), "%s[%d]", oldPath, i);
    SetCAMDeltaReferencePositionParams(packetHandle, value.arrayValue[i], newPath);
    result = CheckLastError("CAM", gkFuncRefGet, result);
  }
  return result;
}

int GetCAMGeoPositionWoAltitudeParams(LONG packetHandle, struct CAMGeoPositionWoAltitude value, char oldPath[])
{
  char newPath[300];
  int result;

  result = 0;

  snprintf(newPath, elcount(newPath), "%s.%s", oldPath, "latitude");
  value.latitude = C2xGetTokenInt(packetHandle, "CAM", newPath);
  result = CheckLastError("CAM", gkFuncRefGet, result);

  snprintf(newPath, elcount(newPath), "%s.%s", oldPath, "longitude");
  value.longitude = C2xGetTokenInt(packetHandle, "CAM", newPath);
  result = CheckLastError("CAM", gkFuncRefGet, result);

  return result;
}

int SetCAMGeoPositionWoAltitudeParams(LONG packetHandle, struct CAMGeoPositionWoAltitude value, char oldPath[])
{
  char newPath[300];
  int result;

  result = 0;

  snprintf(newPath, elcount(newPath), "%s.%s", oldPath, "latitude");
  C2xSetTokenInt(packetHandle, "CAM", newPath, value.latitude);
  result = CheckLastError("CAM", gkFuncRefGet, result);

  snprintf(newPath, elcount(newPath), "%s.%s", oldPath, "longitude");
  C2xSetTokenInt(packetHandle, "CAM", newPath, value.longitude);
  result = CheckLastError("CAM", gkFuncRefGet, result);

  return result;
}

int GetCAMGeoPositionsWoAltitudeParams(LONG packetHandle, struct CAMGeoPositionsWoAltitude value, char oldPath[])
{
  char newPath[300]; 
  int i;
  int result;

  result = 0;

  value.length = C2xGetTokenInt(packetHandle, "CAM", oldPath);
  if((result = CheckLastError("CAM", gkFuncRefGet, result))==0)
  {
    for(i=0; i<value.length; i++)
    {
      snprintf(newPath, elcount(newPath), "%s[%d]", oldPath, i);
      GetCAMGeoPositionWoAltitudeParams(packetHandle, value.arrayValue[i], newPath);
      result = CheckLastError("CAM", gkFuncRefGet, result);
    }
  }
  return result;
}

int SetCAMGeoPositionsWoAltitudeParams(LONG packetHandle, struct CAMGeoPositionsWoAltitude value, char oldPath[])
{
  char newPath[300]; 
  int i;
  int result;

  result = 0;

  C2xRemoveToken(packetHandle, "CAM", oldPath);
  for(i=0; i<value.length; i++)
  {
    snprintf(newPath, elcount(newPath), "%s[%d]", oldPath, i);
    SetCAMGeoPositionWoAltitudeParams(packetHandle, value.arrayValue[i], newPath);
    result = CheckLastError("CAM", gkFuncRefGet, result);
  }
  return result;
}

int GetCAMGeoPositionWAltitudeParams(LONG packetHandle, struct CAMGeoPositionWAltitude value, char oldPath[])
{
  char newPath[300];
  int result;

  result = 0;

  snprintf(newPath, elcount(newPath), "%s.%s", oldPath, "latitude");
  value.latitude = C2xGetTokenInt(packetHandle, "CAM", newPath);
  result = CheckLastError("CAM", gkFuncRefGet, result);

  snprintf(newPath, elcount(newPath), "%s.%s", oldPath, "longitude");
  value.longitude = C2xGetTokenInt(packetHandle, "CAM", newPath);
  result = CheckLastError("CAM", gkFuncRefGet, result);

  snprintf(newPath, elcount(newPath), "%s.%s", oldPath, "altitude");
  GetCAMAltitudeParams(packetHandle, value.altitude, newPath);
  result = CheckLastError("CAM", gkFuncRefGet, result);

  return result;
}

int SetCAMGeoPositionWAltitudeParams(LONG packetHandle, struct CAMGeoPositionWAltitude value, char oldPath[])
{
  char newPath[300];
  int result;

  result = 0;

  snprintf(newPath, elcount(newPath), "%s.%s", oldPath, "latitude");
  C2xSetTokenInt(packetHandle, "CAM", newPath, value.latitude);
  result = CheckLastError("CAM", gkFuncRefGet, result);

  snprintf(newPath, elcount(newPath), "%s.%s", oldPath, "longitude");
  C2xSetTokenInt(packetHandle, "CAM", newPath, value.longitude);
  result = CheckLastError("CAM", gkFuncRefGet, result);

  snprintf(newPath, elcount(newPath), "%s.%s", oldPath, "altitude");
  SetCAMAltitudeParams(packetHandle, value.altitude, newPath);
  result = CheckLastError("CAM", gkFuncRefGet, result);

  return result;
}

int GetCAMGeoPositionsWAltitudeParams(LONG packetHandle, struct CAMGeoPositionsWAltitude value, char oldPath[])
{
  char newPath[300]; 
  int i;
  int result;

  result = 0;

  value.length = C2xGetTokenInt(packetHandle, "CAM", oldPath);
  if((result = CheckLastError("CAM", gkFuncRefGet, result))==0)
  {
    for(i=0; i<value.length; i++)
    {
      snprintf(newPath, elcount(newPath), "%s[%d]", oldPath, i);
      GetCAMGeoPositionWAltitudeParams(packetHandle, value.arrayValue[i], newPath);
      result = CheckLastError("CAM", gkFuncRefGet, result);
    }
  }
  return result;
}

int SetCAMGeoPositionsWAltitudeParams(LONG packetHandle, struct CAMGeoPositionsWAltitude value, char oldPath[])
{
  char newPath[300]; 
  int i;
  int result;

  result = 0;

  C2xRemoveToken(packetHandle, "CAM", oldPath);
  for(i=0; i<value.length; i++)
  {
    snprintf(newPath, elcount(newPath), "%s[%d]", oldPath, i);
    SetCAMGeoPositionWAltitudeParams(packetHandle, value.arrayValue[i], newPath);
    result = CheckLastError("CAM", gkFuncRefGet, result);
  }
  return result;
}

int GetCAMPolygonalLineParams(LONG packetHandle, struct CAMPolygonalLine value, char oldPath[])
{
  char newPath[300];
  int result;

  result = 0;

  value.choice = C2xGetTokenInt(packetHandle, "CAM", oldPath);

  switch(value.choice)
  {
    case 0:
    {
      snprintf(newPath, elcount(newPath), "%s.%s", oldPath, "deltaPositions");
      GetCAMDeltaPositionsParams(packetHandle, value.deltaPositions, newPath);
      result = CheckLastError("CAM", gkFuncRefGet, result);
    }
    break;
    case 1:
    {
      snprintf(newPath, elcount(newPath), "%s.%s", oldPath, "deltaPositionsWithAltitude");
      GetCAMDeltaReferencePositionsParams(packetHandle, value.deltaPositionsWithAltitude, newPath);
      result = CheckLastError("CAM", gkFuncRefGet, result);
    }
    break;
    case 2:
    {
      snprintf(newPath, elcount(newPath), "%s.%s", oldPath, "absolutePositions");
      GetCAMGeoPositionsWoAltitudeParams(packetHandle, value.absolutePositions, newPath);
      result = CheckLastError("CAM", gkFuncRefGet, result);
    }
    break;
    case 3:
    {
      snprintf(newPath, elcount(newPath), "%s.%s", oldPath, "absolutePositionsWithAltitude");
      GetCAMGeoPositionsWAltitudeParams(packetHandle, value.absolutePositionsWithAltitude, newPath);
      result = CheckLastError("CAM", gkFuncRefGet, result);
    }
    break;
  }
  return result;
}

int SetCAMPolygonalLineParams(LONG packetHandle, struct CAMPolygonalLine value, char oldPath[])
{
  char newPath[300];
  int result;

  result = 0;

  switch(value.choice)
  {
    case 0:
    {
      snprintf(newPath, elcount(newPath), "%s.%s", oldPath, "deltaPositions");
      SetCAMDeltaPositionsParams(packetHandle, value.deltaPositions, newPath);
      result = CheckLastError("CAM", gkFuncRefGet, result);
    }
    break;
    case 1:
    {
      snprintf(newPath, elcount(newPath), "%s.%s", oldPath, "deltaPositionsWithAltitude");
      SetCAMDeltaReferencePositionsParams(packetHandle, value.deltaPositionsWithAltitude, newPath);
      result = CheckLastError("CAM", gkFuncRefGet, result);
    }
    break;
    case 2:
    {
      snprintf(newPath, elcount(newPath), "%s.%s", oldPath, "absolutePositions");
      SetCAMGeoPositionsWoAltitudeParams(packetHandle, value.absolutePositions, newPath);
      result = CheckLastError("CAM", gkFuncRefGet, result);
    }
    break;
    case 3:
    {
      snprintf(newPath, elcount(newPath), "%s.%s", oldPath, "absolutePositionsWithAltitude");
      SetCAMGeoPositionsWAltitudeParams(packetHandle, value.absolutePositionsWithAltitude, newPath);
      result = CheckLastError("CAM", gkFuncRefGet, result);
    }
    break;
  }
  return result;
}

int GetCAMConfidenceLevelsParams(LONG packetHandle, struct CAMConfidenceLevels value, char oldPath[])
{
  char newPath[300]; 
  int i;
  int result;

  result = 0;

  value.length = C2xGetTokenInt(packetHandle, "CAM", oldPath);
  if((result = CheckLastError("CAM", gkFuncRefGet, result))==0)
  {
    for(i=0; i<value.length; i++)
    {
      snprintf(newPath, elcount(newPath), "%s[%d]", oldPath, i);
      value.arrayValue[i] = C2xGetTokenInt64(packetHandle, "CAM", newPath);
      result = CheckLastError("CAM", gkFuncRefGet, result);
    }
  }
  return result;
}

int SetCAMConfidenceLevelsParams(LONG packetHandle, struct CAMConfidenceLevels value, char oldPath[])
{
  char newPath[300]; 
  int i;
  int result;

  result = 0;

  C2xRemoveToken(packetHandle, "CAM", oldPath);
  for(i=0; i<value.length; i++)
  {
    snprintf(newPath, elcount(newPath), "%s[%d]", oldPath, i);
    C2xSetTokenInt64(packetHandle, "CAM", newPath, value.arrayValue[i]);
    result = CheckLastError("CAM", gkFuncRefGet, result);
  }
  return result;
}

int GetCAMBasicLaneInformationParams(LONG packetHandle, struct CAMBasicLaneInformation value, char oldPath[])
{
  char newPath[300];
  int result;

  result = 0;

  snprintf(newPath, elcount(newPath), "%s.%s", oldPath, "laneNumber");
  value.laneNumber = C2xGetTokenInt(packetHandle, "CAM", newPath);
  result = CheckLastError("CAM", gkFuncRefGet, result);

  snprintf(newPath, elcount(newPath), "%s.%s", oldPath, "direction");
  value.direction = C2xGetTokenInt(packetHandle, "CAM", newPath);
  result = CheckLastError("CAM", gkFuncRefGet, result);

  snprintf(newPath, elcount(newPath), "%s.%s", oldPath, "laneWidth");
  value.laneWidth.isValidFlag = C2xIsTokenAvailable(packetHandle, "CAM", newPath);
  if(value.laneWidth.isValidFlag==1)
  {
    value.laneWidth.value = C2xGetTokenInt(packetHandle, "CAM", newPath);
    result = CheckLastError("CAM", gkFuncRefGet, result);
  }
  snprintf(newPath, elcount(newPath), "%s.%s", oldPath, "connectingLane");
  value.connectingLane.isValidFlag = C2xIsTokenAvailable(packetHandle, "CAM", newPath);
  if(value.connectingLane.isValidFlag==1)
  {
    value.connectingLane.value = C2xGetTokenInt(packetHandle, "CAM", newPath);
    result = CheckLastError("CAM", gkFuncRefGet, result);
  }
  snprintf(newPath, elcount(newPath), "%s.%s", oldPath, "connectingRoadSection");
  value.connectingRoadSection.isValidFlag = C2xIsTokenAvailable(packetHandle, "CAM", newPath);
  if(value.connectingRoadSection.isValidFlag==1)
  {
    value.connectingRoadSection.value = C2xGetTokenInt(packetHandle, "CAM", newPath);
    result = CheckLastError("CAM", gkFuncRefGet, result);
  }
  return result;
}

int SetCAMBasicLaneInformationParams(LONG packetHandle, struct CAMBasicLaneInformation value, char oldPath[])
{
  char newPath[300];
  int result;

  result = 0;

  snprintf(newPath, elcount(newPath), "%s.%s", oldPath, "laneNumber");
  C2xSetTokenInt(packetHandle, "CAM", newPath, value.laneNumber);
  result = CheckLastError("CAM", gkFuncRefGet, result);

  snprintf(newPath, elcount(newPath), "%s.%s", oldPath, "direction");
  C2xSetTokenInt(packetHandle, "CAM", newPath, value.direction);
  result = CheckLastError("CAM", gkFuncRefGet, result);

  snprintf(newPath, elcount(newPath), "%s.%s", oldPath, "laneWidth");
  if(value.laneWidth.isValidFlag==1)
  {
    C2xSetTokenInt(packetHandle, "CAM", newPath, value.laneWidth.value);
    result = CheckLastError("CAM", gkFuncRefGet, result);
  }
  else
  {
    if( C2xIsTokenAvailable(packetHandle, "CAM", newPath) )
    {
      C2xRemoveToken(packetHandle, "CAM", newPath);
    }
  }

  snprintf(newPath, elcount(newPath), "%s.%s", oldPath, "connectingLane");
  if(value.connectingLane.isValidFlag==1)
  {
    C2xSetTokenInt(packetHandle, "CAM", newPath, value.connectingLane.value);
    result = CheckLastError("CAM", gkFuncRefGet, result);
  }
  else
  {
    if( C2xIsTokenAvailable(packetHandle, "CAM", newPath) )
    {
      C2xRemoveToken(packetHandle, "CAM", newPath);
    }
  }

  snprintf(newPath, elcount(newPath), "%s.%s", oldPath, "connectingRoadSection");
  if(value.connectingRoadSection.isValidFlag==1)
  {
    C2xSetTokenInt(packetHandle, "CAM", newPath, value.connectingRoadSection.value);
    result = CheckLastError("CAM", gkFuncRefGet, result);
  }
  else
  {
    if( C2xIsTokenAvailable(packetHandle, "CAM", newPath) )
    {
      C2xRemoveToken(packetHandle, "CAM", newPath);
    }
  }

  return result;
}

int GetCAMBasicLaneConfigurationParams(LONG packetHandle, struct CAMBasicLaneConfiguration value, char oldPath[])
{
  char newPath[300]; 
  int i;
  int result;

  result = 0;

  value.length = C2xGetTokenInt(packetHandle, "CAM", oldPath);
  if((result = CheckLastError("CAM", gkFuncRefGet, result))==0)
  {
    for(i=0; i<value.length; i++)
    {
      snprintf(newPath, elcount(newPath), "%s[%d]", oldPath, i);
      GetCAMBasicLaneInformationParams(packetHandle, value.arrayValue[i], newPath);
      result = CheckLastError("CAM", gkFuncRefGet, result);
    }
  }
  return result;
}

int SetCAMBasicLaneConfigurationParams(LONG packetHandle, struct CAMBasicLaneConfiguration value, char oldPath[])
{
  char newPath[300]; 
  int i;
  int result;

  result = 0;

  C2xRemoveToken(packetHandle, "CAM", oldPath);
  for(i=0; i<value.length; i++)
  {
    snprintf(newPath, elcount(newPath), "%s[%d]", oldPath, i);
    SetCAMBasicLaneInformationParams(packetHandle, value.arrayValue[i], newPath);
    result = CheckLastError("CAM", gkFuncRefGet, result);
  }
  return result;
}

int GetCAMMetaInformationParams(LONG packetHandle, struct CAMMetaInformation value, char oldPath[])
{
  char newPath[300]; 
  int j; 
  int k;
  int result;

  result = 0;

  snprintf(newPath, elcount(newPath), "%s.%s", oldPath, "usedDetectionInformation");
  value.usedDetectionInformation.isValidFlag = 1;
  value.usedDetectionInformation.stringLength = C2xGetTokenLengthBit(packetHandle, "CAM", newPath);
  if ((result = CheckLastError("CAM", gkFuncRefGet, result))==0)
  {
    if(value.usedDetectionInformation.stringLength > 0)
    {
      for(j=0; j<value.usedDetectionInformation.stringLength; j++)
      {
        if(C2xGetTokenBitOfBitString(packetHandle, "CAM", newPath, j) == 0)
        {
          value.usedDetectionInformation.string[j] = '0';
        }
        else if(C2xGetTokenBitOfBitString(packetHandle, "CAM", newPath, j) == 1)
        {
          value.usedDetectionInformation.string[j] = '1';
        }

        if(value.usedDetectionInformation.stringLength == 1)
        {
          value.usedDetectionInformation.string[1] = '0';
        }
        result = CheckLastError("CAM", gkFuncRefGet, result);
      }
    }
    else
    {
      for(k = value.usedDetectionInformation.stringLength+1; k > -1; k--)
      {
        if(value.usedDetectionInformation.string[k] == '1')
        {
          value.usedDetectionInformation.string[k] = '0';
        }
      }
    }
  }

  snprintf(newPath, elcount(newPath), "%s.%s", oldPath, "usedStoredInformation");
  value.usedStoredInformation.isValidFlag = 1;
  value.usedStoredInformation.stringLength = C2xGetTokenLengthBit(packetHandle, "CAM", newPath);
  if ((result = CheckLastError("CAM", gkFuncRefGet, result))==0)
  {
    if(value.usedStoredInformation.stringLength > 0)
    {
      for(j=0; j<value.usedStoredInformation.stringLength; j++)
      {
        if(C2xGetTokenBitOfBitString(packetHandle, "CAM", newPath, j) == 0)
        {
          value.usedStoredInformation.string[j] = '0';
        }
        else if(C2xGetTokenBitOfBitString(packetHandle, "CAM", newPath, j) == 1)
        {
          value.usedStoredInformation.string[j] = '1';
        }

        if(value.usedStoredInformation.stringLength == 1)
        {
          value.usedStoredInformation.string[1] = '0';
        }
        result = CheckLastError("CAM", gkFuncRefGet, result);
      }
    }
    else
    {
      for(k = value.usedStoredInformation.stringLength+1; k > -1; k--)
      {
        if(value.usedStoredInformation.string[k] == '1')
        {
          value.usedStoredInformation.string[k] = '0';
        }
      }
    }
  }

  snprintf(newPath, elcount(newPath), "%s.%s", oldPath, "confidenceValue");
  value.confidenceValue.isValidFlag = C2xIsTokenAvailable(packetHandle, "CAM", newPath);
  if(value.confidenceValue.isValidFlag==1)
  {
    value.confidenceValue.value = C2xGetTokenInt(packetHandle, "CAM", newPath);
    result = CheckLastError("CAM", gkFuncRefGet, result);
  }
  return result;
}

int SetCAMMetaInformationParams(LONG packetHandle, struct CAMMetaInformation value, char oldPath[])
{
  char newPath[300]; 
  int j;
  int result;

  result = 0;

  snprintf(newPath, elcount(newPath), "%s.%s", oldPath, "usedDetectionInformation");
    for(j=0; j<value.usedDetectionInformation.stringLength; j++)
    {
      if(value.usedDetectionInformation.string[j] == '0')
      {
        C2xSetTokenBitOfBitString(packetHandle, "CAM", newPath, j, 0);
      }
      else
      {
        C2xSetTokenBitOfBitString(packetHandle, "CAM", newPath, j, 1);
      }
      result = CheckLastError("CAM", gkFuncRefGet, result);
    }

  snprintf(newPath, elcount(newPath), "%s.%s", oldPath, "usedStoredInformation");
    for(j=0; j<value.usedStoredInformation.stringLength; j++)
    {
      if(value.usedStoredInformation.string[j] == '0')
      {
        C2xSetTokenBitOfBitString(packetHandle, "CAM", newPath, j, 0);
      }
      else
      {
        C2xSetTokenBitOfBitString(packetHandle, "CAM", newPath, j, 1);
      }
      result = CheckLastError("CAM", gkFuncRefGet, result);
    }

  snprintf(newPath, elcount(newPath), "%s.%s", oldPath, "confidenceValue");
  if(value.confidenceValue.isValidFlag==1)
  {
    if (value.confidenceValue.value < 1)
    {
        C2xSetTokenInt(packetHandle, "CAM", newPath, 1);
    }
    else if (value.confidenceValue.value > 101)
    {
        C2xSetTokenInt(packetHandle, "CAM", newPath, 101);
    }
    else
    {
        C2xSetTokenInt(packetHandle, "CAM", newPath, value.confidenceValue.value);
    }
    result = CheckLastError("CAM", gkFuncRefGet, result);
  }
  else
  {
    if( C2xIsTokenAvailable(packetHandle, "CAM", newPath) )
    {
      C2xRemoveToken(packetHandle, "CAM", newPath);
    }
  }

  return result;
}

int GetCAMEHorizonLocationSharingContainerParams(LONG packetHandle, struct CAMEHorizonLocationSharingContainer value, char oldPath[])
{
  char newPath[300];
  int result;

  result = 0;

  snprintf(newPath, elcount(newPath), "%s.%s", oldPath, "segmentAhead");
  GetCAMPolygonalLineParams(packetHandle, value.segmentAhead, newPath);
  result = CheckLastError("CAM", gkFuncRefGet, result);

  snprintf(newPath, elcount(newPath), "%s.%s", oldPath, "nodeProbabilities");
  value.nodeProbabilities.isValidFlag = C2xIsTokenAvailable(packetHandle, "CAM", newPath);
  if(value.nodeProbabilities.isValidFlag==1)
  {
    GetCAMConfidenceLevelsParams(packetHandle, value.nodeProbabilities, newPath);
    result = CheckLastError("CAM", gkFuncRefGet, result);
  }
  snprintf(newPath, elcount(newPath), "%s.%s", oldPath, "segmentBehind");
  GetCAMPolygonalLineParams(packetHandle, value.segmentBehind, newPath);
  result = CheckLastError("CAM", gkFuncRefGet, result);

  snprintf(newPath, elcount(newPath), "%s.%s", oldPath, "laneLevelDetails");
  value.laneLevelDetails.isValidFlag = C2xIsTokenAvailable(packetHandle, "CAM", newPath);
  if(value.laneLevelDetails.isValidFlag==1)
  {
    GetCAMBasicLaneConfigurationParams(packetHandle, value.laneLevelDetails, newPath);
    result = CheckLastError("CAM", gkFuncRefGet, result);
  }
  snprintf(newPath, elcount(newPath), "%s.%s", oldPath, "segmentSource");
  value.segmentSource.isValidFlag = C2xIsTokenAvailable(packetHandle, "CAM", newPath);
  if(value.segmentSource.isValidFlag==1)
  {
    GetCAMMetaInformationParams(packetHandle, value.segmentSource, newPath);
    result = CheckLastError("CAM", gkFuncRefGet, result);
  }
  return result;
}

int SetCAMEHorizonLocationSharingContainerParams(LONG packetHandle, struct CAMEHorizonLocationSharingContainer value, char oldPath[])
{
  char newPath[300];
  int result;

  result = 0;

  snprintf(newPath, elcount(newPath), "%s.%s", oldPath, "segmentAhead");
  SetCAMPolygonalLineParams(packetHandle, value.segmentAhead, newPath);
  result = CheckLastError("CAM", gkFuncRefGet, result);

  snprintf(newPath, elcount(newPath), "%s.%s", oldPath, "nodeProbabilities");
  if(value.nodeProbabilities.isValidFlag==1)
  {
    SetCAMConfidenceLevelsParams(packetHandle, value.nodeProbabilities, newPath);
    result = CheckLastError("CAM", gkFuncRefGet, result);
  }
  else
  {
    if( C2xIsTokenAvailable(packetHandle, "CAM", newPath) )
    {
      C2xRemoveToken(packetHandle, "CAM", newPath);
    }
  }

  snprintf(newPath, elcount(newPath), "%s.%s", oldPath, "segmentBehind");
  SetCAMPolygonalLineParams(packetHandle, value.segmentBehind, newPath);
  result = CheckLastError("CAM", gkFuncRefGet, result);

  snprintf(newPath, elcount(newPath), "%s.%s", oldPath, "laneLevelDetails");
  if(value.laneLevelDetails.isValidFlag==1)
  {
    SetCAMBasicLaneConfigurationParams(packetHandle, value.laneLevelDetails, newPath);
    result = CheckLastError("CAM", gkFuncRefGet, result);
  }
  else
  {
    if( C2xIsTokenAvailable(packetHandle, "CAM", newPath) )
    {
      C2xRemoveToken(packetHandle, "CAM", newPath);
    }
  }

  snprintf(newPath, elcount(newPath), "%s.%s", oldPath, "segmentSource");
  if(value.segmentSource.isValidFlag==1)
  {
    SetCAMMetaInformationParams(packetHandle, value.segmentSource, newPath);
    result = CheckLastError("CAM", gkFuncRefGet, result);
  }
  else
  {
    if( C2xIsTokenAvailable(packetHandle, "CAM", newPath) )
    {
      C2xRemoveToken(packetHandle, "CAM", newPath);
    }
  }

  return result;
}

int GetCAMVeryLowFrequencyContainerParams(LONG packetHandle, struct CAMVeryLowFrequencyContainer value, char oldPath[])
{
  char newPath[300]; 
  int j; 
  int k;
  int result;

  result = 0;

  snprintf(newPath, elcount(newPath), "%s.%s", oldPath, "vehicleHeight");
  value.vehicleHeight.isValidFlag = C2xIsTokenAvailable(packetHandle, "CAM", newPath);
  if(value.vehicleHeight.isValidFlag==1)
  {
    value.vehicleHeight.value = C2xGetTokenInt(packetHandle, "CAM", newPath);
    result = CheckLastError("CAM", gkFuncRefGet, result);
  }
  snprintf(newPath, elcount(newPath), "%s.%s", oldPath, "wiperStatus");
  value.wiperStatus.isValidFlag = C2xIsTokenAvailable(packetHandle, "CAM", newPath);
  if(value.wiperStatus.isValidFlag==1)
  {
    value.wiperStatus.value = C2xGetTokenInt(packetHandle, "CAM", newPath);
    result = CheckLastError("CAM", gkFuncRefGet, result);
  }
  snprintf(newPath, elcount(newPath), "%s.%s", oldPath, "brakeControl");
  value.brakeControl.isValidFlag = C2xIsTokenAvailable(packetHandle, "CAM", newPath);
  if(value.brakeControl.isValidFlag==1)
  {
    value.brakeControl.isValidFlag = 1;
    value.brakeControl.stringLength = C2xGetTokenLengthBit(packetHandle, "CAM", newPath);
    if ((result = CheckLastError("CAM", gkFuncRefGet, result))==0)
    {
      if(value.brakeControl.stringLength > 0)
      {
        for(j=0; j<value.brakeControl.stringLength; j++)
        {
          if(C2xGetTokenBitOfBitString(packetHandle, "CAM", newPath, j) == 0)
          {
            value.brakeControl.string[j] = '0';
          }
          else if(C2xGetTokenBitOfBitString(packetHandle, "CAM", newPath, j) == 1)
          {
            value.brakeControl.string[j] = '1';
          }

          if(value.brakeControl.stringLength == 1)
          {
            value.brakeControl.string[1] = '0';
          }
          result = CheckLastError("CAM", gkFuncRefGet, result);
        }
      }
      else
      {
        for(k = value.brakeControl.stringLength+1; k > -1; k--)
        {
          if(value.brakeControl.string[k] == '1')
          {
            value.brakeControl.string[k] = '0';
          }
        }
      }
    }

  }
  return result;
}

int SetCAMVeryLowFrequencyContainerParams(LONG packetHandle, struct CAMVeryLowFrequencyContainer value, char oldPath[])
{
  char newPath[300]; 
  int j;
  int result;

  result = 0;

  snprintf(newPath, elcount(newPath), "%s.%s", oldPath, "vehicleHeight");
  if(value.vehicleHeight.isValidFlag==1)
  {
    if (value.vehicleHeight.value < 1)
    {
        C2xSetTokenInt(packetHandle, "CAM", newPath, 1);
    }
    else if (value.vehicleHeight.value > 62)
    {
        C2xSetTokenInt(packetHandle, "CAM", newPath, 62);
    }
    else
    {
        C2xSetTokenInt(packetHandle, "CAM", newPath, value.vehicleHeight.value);
    }
    result = CheckLastError("CAM", gkFuncRefGet, result);
  }
  else
  {
    if( C2xIsTokenAvailable(packetHandle, "CAM", newPath) )
    {
      C2xRemoveToken(packetHandle, "CAM", newPath);
    }
  }

  snprintf(newPath, elcount(newPath), "%s.%s", oldPath, "wiperStatus");
  if(value.wiperStatus.isValidFlag==1)
  {
    C2xSetTokenInt(packetHandle, "CAM", newPath, value.wiperStatus.value);
    result = CheckLastError("CAM", gkFuncRefGet, result);
  }
  else
  {
    if( C2xIsTokenAvailable(packetHandle, "CAM", newPath) )
    {
      C2xRemoveToken(packetHandle, "CAM", newPath);
    }
  }

  snprintf(newPath, elcount(newPath), "%s.%s", oldPath, "brakeControl");
  if(value.brakeControl.isValidFlag==1)
  {
      for(j=0; j<value.brakeControl.stringLength; j++)
      {
        if(value.brakeControl.string[j] == '0')
        {
          C2xSetTokenBitOfBitString(packetHandle, "CAM", newPath, j, 0);
        }
        else
        {
          C2xSetTokenBitOfBitString(packetHandle, "CAM", newPath, j, 1);
        }
        result = CheckLastError("CAM", gkFuncRefGet, result);
      }
  }
  else
  {
    if( C2xIsTokenAvailable(packetHandle, "CAM", newPath) )
    {
      C2xRemoveToken(packetHandle, "CAM", newPath);
    }
  }

  return result;
}

int GetCAMPosConfidenceEllipseParams(LONG packetHandle, struct CAMPosConfidenceEllipse value, char oldPath[])
{
  char newPath[300];
  int result;

  result = 0;

  snprintf(newPath, elcount(newPath), "%s.%s", oldPath, "semiMajorConfidence");
  value.semiMajorConfidence = C2xGetTokenInt(packetHandle, "CAM", newPath);
  result = CheckLastError("CAM", gkFuncRefGet, result);

  snprintf(newPath, elcount(newPath), "%s.%s", oldPath, "semiMinorConfidence");
  value.semiMinorConfidence = C2xGetTokenInt(packetHandle, "CAM", newPath);
  result = CheckLastError("CAM", gkFuncRefGet, result);

  snprintf(newPath, elcount(newPath), "%s.%s", oldPath, "semiMajorOrientation");
  value.semiMajorOrientation = C2xGetTokenInt(packetHandle, "CAM", newPath);
  result = CheckLastError("CAM", gkFuncRefGet, result);

  return result;
}

int SetCAMPosConfidenceEllipseParams(LONG packetHandle, struct CAMPosConfidenceEllipse value, char oldPath[])
{
  char newPath[300];
  int result;

  result = 0;

  snprintf(newPath, elcount(newPath), "%s.%s", oldPath, "semiMajorConfidence");
  C2xSetTokenInt(packetHandle, "CAM", newPath, value.semiMajorConfidence);
  result = CheckLastError("CAM", gkFuncRefGet, result);

  snprintf(newPath, elcount(newPath), "%s.%s", oldPath, "semiMinorConfidence");
  C2xSetTokenInt(packetHandle, "CAM", newPath, value.semiMinorConfidence);
  result = CheckLastError("CAM", gkFuncRefGet, result);

  snprintf(newPath, elcount(newPath), "%s.%s", oldPath, "semiMajorOrientation");
  C2xSetTokenInt(packetHandle, "CAM", newPath, value.semiMajorOrientation);
  result = CheckLastError("CAM", gkFuncRefGet, result);

  return result;
}

int GetCAMPathDeltaTimeChoiceParams(LONG packetHandle, struct CAMPathDeltaTimeChoice value, char oldPath[])
{
  char newPath[300];
  int result;

  result = 0;

  value.choice = C2xGetTokenInt(packetHandle, "CAM", oldPath);

  switch(value.choice)
  {
    case 0:
    {
      snprintf(newPath, elcount(newPath), "%s.%s", oldPath, "deltaTimeHighPrecision");
      value.deltaTimeHighPrecision = C2xGetTokenInt(packetHandle, "CAM", newPath);
      result = CheckLastError("CAM", gkFuncRefGet, result);
    }
    break;
    case 1:
    {
      snprintf(newPath, elcount(newPath), "%s.%s", oldPath, "deltaTimeBigRange");
      value.deltaTimeBigRange = C2xGetTokenInt(packetHandle, "CAM", newPath);
      result = CheckLastError("CAM", gkFuncRefGet, result);
    }
    break;
    case 2:
    {
      snprintf(newPath, elcount(newPath), "%s.%s", oldPath, "deltaTimeMidRange");
      value.deltaTimeMidRange = C2xGetTokenInt(packetHandle, "CAM", newPath);
      result = CheckLastError("CAM", gkFuncRefGet, result);
    }
    break;
  }
  return result;
}

int SetCAMPathDeltaTimeChoiceParams(LONG packetHandle, struct CAMPathDeltaTimeChoice value, char oldPath[])
{
  char newPath[300];
  int result;

  result = 0;

  switch(value.choice)
  {
    case 0:
    {
      snprintf(newPath, elcount(newPath), "%s.%s", oldPath, "deltaTimeHighPrecision");
      C2xSetTokenInt(packetHandle, "CAM", newPath, value.deltaTimeHighPrecision);
      result = CheckLastError("CAM", gkFuncRefGet, result);
    }
    break;
    case 1:
    {
      snprintf(newPath, elcount(newPath), "%s.%s", oldPath, "deltaTimeBigRange");
      C2xSetTokenInt(packetHandle, "CAM", newPath, value.deltaTimeBigRange);
      result = CheckLastError("CAM", gkFuncRefGet, result);
    }
    break;
    case 2:
    {
      snprintf(newPath, elcount(newPath), "%s.%s", oldPath, "deltaTimeMidRange");
      C2xSetTokenInt(packetHandle, "CAM", newPath, value.deltaTimeMidRange);
      result = CheckLastError("CAM", gkFuncRefGet, result);
    }
    break;
  }
  return result;
}

int GetCAMPathPointPredictedParams(LONG packetHandle, struct CAMPathPointPredicted value, char oldPath[])
{
  char newPath[300];
  int result;

  result = 0;

  snprintf(newPath, elcount(newPath), "%s.%s", oldPath, "deltaLatitude");
  value.deltaLatitude = C2xGetTokenInt(packetHandle, "CAM", newPath);
  result = CheckLastError("CAM", gkFuncRefGet, result);

  snprintf(newPath, elcount(newPath), "%s.%s", oldPath, "deltaLongitude");
  value.deltaLongitude = C2xGetTokenInt(packetHandle, "CAM", newPath);
  result = CheckLastError("CAM", gkFuncRefGet, result);

  snprintf(newPath, elcount(newPath), "%s.%s", oldPath, "horizontalPositionConfidence");
  value.horizontalPositionConfidence.isValidFlag = C2xIsTokenAvailable(packetHandle, "CAM", newPath);
  if(value.horizontalPositionConfidence.isValidFlag==1)
  {
    GetCAMPosConfidenceEllipseParams(packetHandle, value.horizontalPositionConfidence, newPath);
    result = CheckLastError("CAM", gkFuncRefGet, result);
  }
  snprintf(newPath, elcount(newPath), "%s.%s", oldPath, "deltaAltitude");
  value.deltaAltitude.isValidFlag = C2xIsTokenAvailable(packetHandle, "CAM", newPath);
  if(value.deltaAltitude.isValidFlag==1)
  {
    value.deltaAltitude.value = C2xGetTokenInt(packetHandle, "CAM", newPath);
    result = CheckLastError("CAM", gkFuncRefGet, result);
  }
  snprintf(newPath, elcount(newPath), "%s.%s", oldPath, "altitudeConfidence");
  value.altitudeConfidence.isValidFlag = C2xIsTokenAvailable(packetHandle, "CAM", newPath);
  if(value.altitudeConfidence.isValidFlag==1)
  {
    value.altitudeConfidence.value = C2xGetTokenInt(packetHandle, "CAM", newPath);
    result = CheckLastError("CAM", gkFuncRefGet, result);
  }
  snprintf(newPath, elcount(newPath), "%s.%s", oldPath, "pathDeltaTime");
  value.pathDeltaTime.isValidFlag = C2xIsTokenAvailable(packetHandle, "CAM", newPath);
  if(value.pathDeltaTime.isValidFlag==1)
  {
    GetCAMPathDeltaTimeChoiceParams(packetHandle, value.pathDeltaTime, newPath);
    result = CheckLastError("CAM", gkFuncRefGet, result);
  }
  snprintf(newPath, elcount(newPath), "%s.%s", oldPath, "symmetricAreaOffset");
  value.symmetricAreaOffset.isValidFlag = C2xIsTokenAvailable(packetHandle, "CAM", newPath);
  if(value.symmetricAreaOffset.isValidFlag==1)
  {
    value.symmetricAreaOffset.value = C2xGetTokenInt(packetHandle, "CAM", newPath);
    result = CheckLastError("CAM", gkFuncRefGet, result);
  }
  snprintf(newPath, elcount(newPath), "%s.%s", oldPath, "asymmetricAreaOffset");
  value.asymmetricAreaOffset.isValidFlag = C2xIsTokenAvailable(packetHandle, "CAM", newPath);
  if(value.asymmetricAreaOffset.isValidFlag==1)
  {
    value.asymmetricAreaOffset.value = C2xGetTokenInt(packetHandle, "CAM", newPath);
    result = CheckLastError("CAM", gkFuncRefGet, result);
  }
  return result;
}

int SetCAMPathPointPredictedParams(LONG packetHandle, struct CAMPathPointPredicted value, char oldPath[])
{
  char newPath[300];
  int result;

  result = 0;

  snprintf(newPath, elcount(newPath), "%s.%s", oldPath, "deltaLatitude");
  C2xSetTokenInt(packetHandle, "CAM", newPath, value.deltaLatitude);
  result = CheckLastError("CAM", gkFuncRefGet, result);

  snprintf(newPath, elcount(newPath), "%s.%s", oldPath, "deltaLongitude");
  C2xSetTokenInt(packetHandle, "CAM", newPath, value.deltaLongitude);
  result = CheckLastError("CAM", gkFuncRefGet, result);

  snprintf(newPath, elcount(newPath), "%s.%s", oldPath, "horizontalPositionConfidence");
  if(value.horizontalPositionConfidence.isValidFlag==1)
  {
    SetCAMPosConfidenceEllipseParams(packetHandle, value.horizontalPositionConfidence, newPath);
    result = CheckLastError("CAM", gkFuncRefGet, result);
  }
  else
  {
    if( C2xIsTokenAvailable(packetHandle, "CAM", newPath) )
    {
      C2xRemoveToken(packetHandle, "CAM", newPath);
    }
  }

  snprintf(newPath, elcount(newPath), "%s.%s", oldPath, "deltaAltitude");
  if(value.deltaAltitude.isValidFlag==1)
  {
    C2xSetTokenInt(packetHandle, "CAM", newPath, value.deltaAltitude.value);
    result = CheckLastError("CAM", gkFuncRefGet, result);
  }
  else
  {
    if( C2xIsTokenAvailable(packetHandle, "CAM", newPath) )
    {
      C2xRemoveToken(packetHandle, "CAM", newPath);
    }
  }

  snprintf(newPath, elcount(newPath), "%s.%s", oldPath, "altitudeConfidence");
  if(value.altitudeConfidence.isValidFlag==1)
  {
    C2xSetTokenInt(packetHandle, "CAM", newPath, value.altitudeConfidence.value);
    result = CheckLastError("CAM", gkFuncRefGet, result);
  }
  else
  {
    if( C2xIsTokenAvailable(packetHandle, "CAM", newPath) )
    {
      C2xRemoveToken(packetHandle, "CAM", newPath);
    }
  }

  snprintf(newPath, elcount(newPath), "%s.%s", oldPath, "pathDeltaTime");
  if(value.pathDeltaTime.isValidFlag==1)
  {
    SetCAMPathDeltaTimeChoiceParams(packetHandle, value.pathDeltaTime, newPath);
    result = CheckLastError("CAM", gkFuncRefGet, result);
  }
  else
  {
    if( C2xIsTokenAvailable(packetHandle, "CAM", newPath) )
    {
      C2xRemoveToken(packetHandle, "CAM", newPath);
    }
  }

  snprintf(newPath, elcount(newPath), "%s.%s", oldPath, "symmetricAreaOffset");
  if(value.symmetricAreaOffset.isValidFlag==1)
  {
    C2xSetTokenInt(packetHandle, "CAM", newPath, value.symmetricAreaOffset.value);
    result = CheckLastError("CAM", gkFuncRefGet, result);
  }
  else
  {
    if( C2xIsTokenAvailable(packetHandle, "CAM", newPath) )
    {
      C2xRemoveToken(packetHandle, "CAM", newPath);
    }
  }

  snprintf(newPath, elcount(newPath), "%s.%s", oldPath, "asymmetricAreaOffset");
  if(value.asymmetricAreaOffset.isValidFlag==1)
  {
    C2xSetTokenInt(packetHandle, "CAM", newPath, value.asymmetricAreaOffset.value);
    result = CheckLastError("CAM", gkFuncRefGet, result);
  }
  else
  {
    if( C2xIsTokenAvailable(packetHandle, "CAM", newPath) )
    {
      C2xRemoveToken(packetHandle, "CAM", newPath);
    }
  }

  return result;
}

int GetCAMPathPredictedParams(LONG packetHandle, struct CAMPathPredicted value, char oldPath[])
{
  char newPath[300]; 
  int i;
  int result;

  result = 0;

  value.length = C2xGetTokenInt(packetHandle, "CAM", oldPath);
  if((result = CheckLastError("CAM", gkFuncRefGet, result))==0)
  {
    for(i=0; i<value.length; i++)
    {
      snprintf(newPath, elcount(newPath), "%s[%d]", oldPath, i);
      GetCAMPathPointPredictedParams(packetHandle, value.arrayValue[i], newPath);
      result = CheckLastError("CAM", gkFuncRefGet, result);
    }
  }
  return result;
}

int SetCAMPathPredictedParams(LONG packetHandle, struct CAMPathPredicted value, char oldPath[])
{
  char newPath[300]; 
  int i;
  int result;

  result = 0;

  C2xRemoveToken(packetHandle, "CAM", oldPath);
  for(i=0; i<value.length; i++)
  {
    snprintf(newPath, elcount(newPath), "%s[%d]", oldPath, i);
    SetCAMPathPointPredictedParams(packetHandle, value.arrayValue[i], newPath);
    result = CheckLastError("CAM", gkFuncRefGet, result);
  }
  return result;
}

int GetCAMPathPredicted2Params(LONG packetHandle, struct CAMPathPredicted2 value, char oldPath[])
{
  char newPath[300];
  int result;

  result = 0;

  snprintf(newPath, elcount(newPath), "%s.%s", oldPath, "pathPredicted");
  GetCAMPathPredictedParams(packetHandle, value.pathPredicted, newPath);
  result = CheckLastError("CAM", gkFuncRefGet, result);

  snprintf(newPath, elcount(newPath), "%s.%s", oldPath, "usageIndication");
  value.usageIndication = C2xGetTokenInt(packetHandle, "CAM", newPath);
  result = CheckLastError("CAM", gkFuncRefGet, result);

  snprintf(newPath, elcount(newPath), "%s.%s", oldPath, "confidenceLevel");
  value.confidenceLevel = C2xGetTokenInt(packetHandle, "CAM", newPath);
  result = CheckLastError("CAM", gkFuncRefGet, result);

  return result;
}

int SetCAMPathPredicted2Params(LONG packetHandle, struct CAMPathPredicted2 value, char oldPath[])
{
  char newPath[300];
  int result;

  result = 0;

  snprintf(newPath, elcount(newPath), "%s.%s", oldPath, "pathPredicted");
  SetCAMPathPredictedParams(packetHandle, value.pathPredicted, newPath);
  result = CheckLastError("CAM", gkFuncRefGet, result);

  snprintf(newPath, elcount(newPath), "%s.%s", oldPath, "usageIndication");
  C2xSetTokenInt(packetHandle, "CAM", newPath, value.usageIndication);
  result = CheckLastError("CAM", gkFuncRefGet, result);

  snprintf(newPath, elcount(newPath), "%s.%s", oldPath, "confidenceLevel");
  if (value.confidenceLevel < 1)
  {
    C2xSetTokenInt(packetHandle, "CAM", newPath, 1);
  }
  else if (value.confidenceLevel > 101)
  {
    C2xSetTokenInt(packetHandle, "CAM", newPath, 101);
  }
  else
  {
    C2xSetTokenInt(packetHandle, "CAM", newPath, value.confidenceLevel);
  }
  result = CheckLastError("CAM", gkFuncRefGet, result);

  return result;
}

int GetCAMPathPredictedListParams(LONG packetHandle, struct CAMPathPredictedList value, char oldPath[])
{
  char newPath[300]; 
  int i;
  int result;

  result = 0;

  value.length = C2xGetTokenInt(packetHandle, "CAM", oldPath);
  if((result = CheckLastError("CAM", gkFuncRefGet, result))==0)
  {
    for(i=0; i<value.length; i++)
    {
      snprintf(newPath, elcount(newPath), "%s[%d]", oldPath, i);
      GetCAMPathPredicted2Params(packetHandle, value.arrayValue[i], newPath);
      result = CheckLastError("CAM", gkFuncRefGet, result);
    }
  }
  return result;
}

int SetCAMPathPredictedListParams(LONG packetHandle, struct CAMPathPredictedList value, char oldPath[])
{
  char newPath[300]; 
  int i;
  int result;

  result = 0;

  C2xRemoveToken(packetHandle, "CAM", oldPath);
  for(i=0; i<value.length; i++)
  {
    snprintf(newPath, elcount(newPath), "%s[%d]", oldPath, i);
    SetCAMPathPredicted2Params(packetHandle, value.arrayValue[i], newPath);
    result = CheckLastError("CAM", gkFuncRefGet, result);
  }
  return result;
}

int GetCAMPathPredictionContainerParams(LONG packetHandle, struct CAMPathPredictionContainer value, char oldPath[])
{
  char newPath[300];
  int result;

  result = 0;

  snprintf(newPath, elcount(newPath), "%s.%s", oldPath, "pathPredictedList");
  GetCAMPathPredictedListParams(packetHandle, value.pathPredictedList, newPath);
  result = CheckLastError("CAM", gkFuncRefGet, result);

  return result;
}

int SetCAMPathPredictionContainerParams(LONG packetHandle, struct CAMPathPredictionContainer value, char oldPath[])
{
  char newPath[300];
  int result;

  result = 0;

  snprintf(newPath, elcount(newPath), "%s.%s", oldPath, "pathPredictedList");
  SetCAMPathPredictedListParams(packetHandle, value.pathPredictedList, newPath);
  result = CheckLastError("CAM", gkFuncRefGet, result);

  return result;
}

int GetCAMLanePositionAndTypeParams(LONG packetHandle, struct CAMLanePositionAndType value, char oldPath[])
{
  char newPath[300];
  int result;

  result = 0;

  snprintf(newPath, elcount(newPath), "%s.%s", oldPath, "transversalPosition");
  value.transversalPosition = C2xGetTokenInt(packetHandle, "CAM", newPath);
  result = CheckLastError("CAM", gkFuncRefGet, result);

  snprintf(newPath, elcount(newPath), "%s.%s", oldPath, "laneType");
  value.laneType.isValidFlag = C2xIsTokenAvailable(packetHandle, "CAM", newPath);
  if(value.laneType.isValidFlag==1)
  {
    value.laneType.value = C2xGetTokenInt(packetHandle, "CAM", newPath);
    result = CheckLastError("CAM", gkFuncRefGet, result);
  }
  snprintf(newPath, elcount(newPath), "%s.%s", oldPath, "direction");
  value.direction.isValidFlag = C2xIsTokenAvailable(packetHandle, "CAM", newPath);
  if(value.direction.isValidFlag==1)
  {
    value.direction.value = C2xGetTokenInt(packetHandle, "CAM", newPath);
    result = CheckLastError("CAM", gkFuncRefGet, result);
  }
  return result;
}

int SetCAMLanePositionAndTypeParams(LONG packetHandle, struct CAMLanePositionAndType value, char oldPath[])
{
  char newPath[300];
  int result;

  result = 0;

  snprintf(newPath, elcount(newPath), "%s.%s", oldPath, "transversalPosition");
  C2xSetTokenInt(packetHandle, "CAM", newPath, value.transversalPosition);
  result = CheckLastError("CAM", gkFuncRefGet, result);

  snprintf(newPath, elcount(newPath), "%s.%s", oldPath, "laneType");
  if(value.laneType.isValidFlag==1)
  {
    C2xSetTokenInt(packetHandle, "CAM", newPath, value.laneType.value);
    result = CheckLastError("CAM", gkFuncRefGet, result);
  }
  else
  {
    if( C2xIsTokenAvailable(packetHandle, "CAM", newPath) )
    {
      C2xRemoveToken(packetHandle, "CAM", newPath);
    }
  }

  snprintf(newPath, elcount(newPath), "%s.%s", oldPath, "direction");
  if(value.direction.isValidFlag==1)
  {
    C2xSetTokenInt(packetHandle, "CAM", newPath, value.direction.value);
    result = CheckLastError("CAM", gkFuncRefGet, result);
  }
  else
  {
    if( C2xIsTokenAvailable(packetHandle, "CAM", newPath) )
    {
      C2xRemoveToken(packetHandle, "CAM", newPath);
    }
  }

  return result;
}

int GetCAMLanePositionWithLateralDetailsParams(LONG packetHandle, struct CAMLanePositionWithLateralDetails value, char oldPath[])
{
  char newPath[300];
  int result;

  result = 0;

  snprintf(newPath, elcount(newPath), "%s.%s", oldPath, "transversalPosition");
  value.transversalPosition = C2xGetTokenInt(packetHandle, "CAM", newPath);
  result = CheckLastError("CAM", gkFuncRefGet, result);

  snprintf(newPath, elcount(newPath), "%s.%s", oldPath, "laneType");
  value.laneType.isValidFlag = C2xIsTokenAvailable(packetHandle, "CAM", newPath);
  if(value.laneType.isValidFlag==1)
  {
    value.laneType.value = C2xGetTokenInt(packetHandle, "CAM", newPath);
    result = CheckLastError("CAM", gkFuncRefGet, result);
  }
  snprintf(newPath, elcount(newPath), "%s.%s", oldPath, "direction");
  value.direction.isValidFlag = C2xIsTokenAvailable(packetHandle, "CAM", newPath);
  if(value.direction.isValidFlag==1)
  {
    value.direction.value = C2xGetTokenInt(packetHandle, "CAM", newPath);
    result = CheckLastError("CAM", gkFuncRefGet, result);
  }
  snprintf(newPath, elcount(newPath), "%s.%s", oldPath, "distanceToLeftBorder");
  value.distanceToLeftBorder = C2xGetTokenInt(packetHandle, "CAM", newPath);
  result = CheckLastError("CAM", gkFuncRefGet, result);

  snprintf(newPath, elcount(newPath), "%s.%s", oldPath, "distanceToRightBorder");
  value.distanceToRightBorder = C2xGetTokenInt(packetHandle, "CAM", newPath);
  result = CheckLastError("CAM", gkFuncRefGet, result);

  return result;
}

int SetCAMLanePositionWithLateralDetailsParams(LONG packetHandle, struct CAMLanePositionWithLateralDetails value, char oldPath[])
{
  char newPath[300];
  int result;

  result = 0;

  snprintf(newPath, elcount(newPath), "%s.%s", oldPath, "transversalPosition");
  C2xSetTokenInt(packetHandle, "CAM", newPath, value.transversalPosition);
  result = CheckLastError("CAM", gkFuncRefGet, result);

  snprintf(newPath, elcount(newPath), "%s.%s", oldPath, "laneType");
  if(value.laneType.isValidFlag==1)
  {
    C2xSetTokenInt(packetHandle, "CAM", newPath, value.laneType.value);
    result = CheckLastError("CAM", gkFuncRefGet, result);
  }
  else
  {
    if( C2xIsTokenAvailable(packetHandle, "CAM", newPath) )
    {
      C2xRemoveToken(packetHandle, "CAM", newPath);
    }
  }

  snprintf(newPath, elcount(newPath), "%s.%s", oldPath, "direction");
  if(value.direction.isValidFlag==1)
  {
    C2xSetTokenInt(packetHandle, "CAM", newPath, value.direction.value);
    result = CheckLastError("CAM", gkFuncRefGet, result);
  }
  else
  {
    if( C2xIsTokenAvailable(packetHandle, "CAM", newPath) )
    {
      C2xRemoveToken(packetHandle, "CAM", newPath);
    }
  }

  snprintf(newPath, elcount(newPath), "%s.%s", oldPath, "distanceToLeftBorder");
  C2xSetTokenInt(packetHandle, "CAM", newPath, value.distanceToLeftBorder);
  result = CheckLastError("CAM", gkFuncRefGet, result);

  snprintf(newPath, elcount(newPath), "%s.%s", oldPath, "distanceToRightBorder");
  C2xSetTokenInt(packetHandle, "CAM", newPath, value.distanceToRightBorder);
  result = CheckLastError("CAM", gkFuncRefGet, result);

  return result;
}

int GetCAMTrafficIslandPositionParams(LONG packetHandle, struct CAMTrafficIslandPosition value, char oldPath[])
{
  char newPath[300];
  int result;

  result = 0;

  snprintf(newPath, elcount(newPath), "%s.%s", oldPath, "oneSide");
  GetCAMLanePositionAndTypeParams(packetHandle, value.oneSide, newPath);
  result = CheckLastError("CAM", gkFuncRefGet, result);

  snprintf(newPath, elcount(newPath), "%s.%s", oldPath, "otherSide");
  GetCAMLanePositionAndTypeParams(packetHandle, value.otherSide, newPath);
  result = CheckLastError("CAM", gkFuncRefGet, result);

  return result;
}

int SetCAMTrafficIslandPositionParams(LONG packetHandle, struct CAMTrafficIslandPosition value, char oldPath[])
{
  char newPath[300];
  int result;

  result = 0;

  snprintf(newPath, elcount(newPath), "%s.%s", oldPath, "oneSide");
  SetCAMLanePositionAndTypeParams(packetHandle, value.oneSide, newPath);
  result = CheckLastError("CAM", gkFuncRefGet, result);

  snprintf(newPath, elcount(newPath), "%s.%s", oldPath, "otherSide");
  SetCAMLanePositionAndTypeParams(packetHandle, value.otherSide, newPath);
  result = CheckLastError("CAM", gkFuncRefGet, result);

  return result;
}

int GetCAMLanePositionOptionsParams(LONG packetHandle, struct CAMLanePositionOptions value, char oldPath[])
{
  char newPath[300];
  int result;

  result = 0;

  value.choice = C2xGetTokenInt(packetHandle, "CAM", oldPath);

  switch(value.choice)
  {
    case 0:
    {
      snprintf(newPath, elcount(newPath), "%s.%s", oldPath, "simplelanePosition");
      value.simplelanePosition = C2xGetTokenInt(packetHandle, "CAM", newPath);
      result = CheckLastError("CAM", gkFuncRefGet, result);
    }
    break;
    case 1:
    {
      snprintf(newPath, elcount(newPath), "%s.%s", oldPath, "simpleLaneType");
      value.simpleLaneType = C2xGetTokenInt(packetHandle, "CAM", newPath);
      result = CheckLastError("CAM", gkFuncRefGet, result);
    }
    break;
    case 2:
    {
      snprintf(newPath, elcount(newPath), "%s.%s", oldPath, "detailedlanePosition");
      GetCAMLanePositionAndTypeParams(packetHandle, value.detailedlanePosition, newPath);
      result = CheckLastError("CAM", gkFuncRefGet, result);
    }
    break;
    case 3:
    {
      snprintf(newPath, elcount(newPath), "%s.%s", oldPath, "lanePositionWithLateralDetails");
      GetCAMLanePositionWithLateralDetailsParams(packetHandle, value.lanePositionWithLateralDetails, newPath);
      result = CheckLastError("CAM", gkFuncRefGet, result);
    }
    break;
    case 4:
    {
      snprintf(newPath, elcount(newPath), "%s.%s", oldPath, "trafficIslandPosition");
      GetCAMTrafficIslandPositionParams(packetHandle, value.trafficIslandPosition, newPath);
      result = CheckLastError("CAM", gkFuncRefGet, result);
    }
    break;
  }
  return result;
}

int SetCAMLanePositionOptionsParams(LONG packetHandle, struct CAMLanePositionOptions value, char oldPath[])
{
  char newPath[300];
  int result;

  result = 0;

  switch(value.choice)
  {
    case 0:
    {
      snprintf(newPath, elcount(newPath), "%s.%s", oldPath, "simplelanePosition");
      C2xSetTokenInt(packetHandle, "CAM", newPath, value.simplelanePosition);
      result = CheckLastError("CAM", gkFuncRefGet, result);
    }
    break;
    case 1:
    {
      snprintf(newPath, elcount(newPath), "%s.%s", oldPath, "simpleLaneType");
      C2xSetTokenInt(packetHandle, "CAM", newPath, value.simpleLaneType);
      result = CheckLastError("CAM", gkFuncRefGet, result);
    }
    break;
    case 2:
    {
      snprintf(newPath, elcount(newPath), "%s.%s", oldPath, "detailedlanePosition");
      SetCAMLanePositionAndTypeParams(packetHandle, value.detailedlanePosition, newPath);
      result = CheckLastError("CAM", gkFuncRefGet, result);
    }
    break;
    case 3:
    {
      snprintf(newPath, elcount(newPath), "%s.%s", oldPath, "lanePositionWithLateralDetails");
      SetCAMLanePositionWithLateralDetailsParams(packetHandle, value.lanePositionWithLateralDetails, newPath);
      result = CheckLastError("CAM", gkFuncRefGet, result);
    }
    break;
    case 4:
    {
      snprintf(newPath, elcount(newPath), "%s.%s", oldPath, "trafficIslandPosition");
      SetCAMTrafficIslandPositionParams(packetHandle, value.trafficIslandPosition, newPath);
      result = CheckLastError("CAM", gkFuncRefGet, result);
    }
    break;
  }
  return result;
}

int GetCAMRoadSegmentReferenceIdParams(LONG packetHandle, struct CAMRoadSegmentReferenceId value, char oldPath[])
{
  char newPath[300];
  int result;

  result = 0;

  snprintf(newPath, elcount(newPath), "%s.%s", oldPath, "region");
  value.region.isValidFlag = C2xIsTokenAvailable(packetHandle, "CAM", newPath);
  if(value.region.isValidFlag==1)
  {
    value.region.value = C2xGetTokenInt(packetHandle, "CAM", newPath);
    result = CheckLastError("CAM", gkFuncRefGet, result);
  }
  snprintf(newPath, elcount(newPath), "%s.%s", oldPath, "id");
  value.id = C2xGetTokenInt(packetHandle, "CAM", newPath);
  result = CheckLastError("CAM", gkFuncRefGet, result);

  return result;
}

int SetCAMRoadSegmentReferenceIdParams(LONG packetHandle, struct CAMRoadSegmentReferenceId value, char oldPath[])
{
  char newPath[300];
  int result;

  result = 0;

  snprintf(newPath, elcount(newPath), "%s.%s", oldPath, "region");
  if(value.region.isValidFlag==1)
  {
    C2xSetTokenInt(packetHandle, "CAM", newPath, value.region.value);
    result = CheckLastError("CAM", gkFuncRefGet, result);
  }
  else
  {
    if( C2xIsTokenAvailable(packetHandle, "CAM", newPath) )
    {
      C2xRemoveToken(packetHandle, "CAM", newPath);
    }
  }

  snprintf(newPath, elcount(newPath), "%s.%s", oldPath, "id");
  C2xSetTokenInt(packetHandle, "CAM", newPath, value.id);
  result = CheckLastError("CAM", gkFuncRefGet, result);

  return result;
}

int GetCAMIntersectionReferenceIdParams(LONG packetHandle, struct CAMIntersectionReferenceId value, char oldPath[])
{
  char newPath[300];
  int result;

  result = 0;

  snprintf(newPath, elcount(newPath), "%s.%s", oldPath, "region");
  value.region.isValidFlag = C2xIsTokenAvailable(packetHandle, "CAM", newPath);
  if(value.region.isValidFlag==1)
  {
    value.region.value = C2xGetTokenInt(packetHandle, "CAM", newPath);
    result = CheckLastError("CAM", gkFuncRefGet, result);
  }
  snprintf(newPath, elcount(newPath), "%s.%s", oldPath, "id");
  value.id = C2xGetTokenInt(packetHandle, "CAM", newPath);
  result = CheckLastError("CAM", gkFuncRefGet, result);

  return result;
}

int SetCAMIntersectionReferenceIdParams(LONG packetHandle, struct CAMIntersectionReferenceId value, char oldPath[])
{
  char newPath[300];
  int result;

  result = 0;

  snprintf(newPath, elcount(newPath), "%s.%s", oldPath, "region");
  if(value.region.isValidFlag==1)
  {
    C2xSetTokenInt(packetHandle, "CAM", newPath, value.region.value);
    result = CheckLastError("CAM", gkFuncRefGet, result);
  }
  else
  {
    if( C2xIsTokenAvailable(packetHandle, "CAM", newPath) )
    {
      C2xRemoveToken(packetHandle, "CAM", newPath);
    }
  }

  snprintf(newPath, elcount(newPath), "%s.%s", oldPath, "id");
  C2xSetTokenInt(packetHandle, "CAM", newPath, value.id);
  result = CheckLastError("CAM", gkFuncRefGet, result);

  return result;
}

int GetCAMMapReferenceParams(LONG packetHandle, struct CAMMapReference value, char oldPath[])
{
  char newPath[300];
  int result;

  result = 0;

  value.choice = C2xGetTokenInt(packetHandle, "CAM", oldPath);

  switch(value.choice)
  {
    case 0:
    {
      snprintf(newPath, elcount(newPath), "%s.%s", oldPath, "roadsegment");
      GetCAMRoadSegmentReferenceIdParams(packetHandle, value.roadsegment, newPath);
      result = CheckLastError("CAM", gkFuncRefGet, result);
    }
    break;
    case 1:
    {
      snprintf(newPath, elcount(newPath), "%s.%s", oldPath, "intersection");
      GetCAMIntersectionReferenceIdParams(packetHandle, value.intersection, newPath);
      result = CheckLastError("CAM", gkFuncRefGet, result);
    }
    break;
  }
  return result;
}

int SetCAMMapReferenceParams(LONG packetHandle, struct CAMMapReference value, char oldPath[])
{
  char newPath[300];
  int result;

  result = 0;

  switch(value.choice)
  {
    case 0:
    {
      snprintf(newPath, elcount(newPath), "%s.%s", oldPath, "roadsegment");
      SetCAMRoadSegmentReferenceIdParams(packetHandle, value.roadsegment, newPath);
      result = CheckLastError("CAM", gkFuncRefGet, result);
    }
    break;
    case 1:
    {
      snprintf(newPath, elcount(newPath), "%s.%s", oldPath, "intersection");
      SetCAMIntersectionReferenceIdParams(packetHandle, value.intersection, newPath);
      result = CheckLastError("CAM", gkFuncRefGet, result);
    }
    break;
  }
  return result;
}

int GetCAMLongitudinalLanePositionParams(LONG packetHandle, struct CAMLongitudinalLanePosition value, char oldPath[])
{
  char newPath[300];
  int result;

  result = 0;

  snprintf(newPath, elcount(newPath), "%s.%s", oldPath, "longitudinalLanePositionValue");
  value.longitudinalLanePositionValue = C2xGetTokenInt(packetHandle, "CAM", newPath);
  result = CheckLastError("CAM", gkFuncRefGet, result);

  snprintf(newPath, elcount(newPath), "%s.%s", oldPath, "longitudinalLanePositionConfidence");
  value.longitudinalLanePositionConfidence = C2xGetTokenInt(packetHandle, "CAM", newPath);
  result = CheckLastError("CAM", gkFuncRefGet, result);

  return result;
}

int SetCAMLongitudinalLanePositionParams(LONG packetHandle, struct CAMLongitudinalLanePosition value, char oldPath[])
{
  char newPath[300];
  int result;

  result = 0;

  snprintf(newPath, elcount(newPath), "%s.%s", oldPath, "longitudinalLanePositionValue");
  C2xSetTokenInt(packetHandle, "CAM", newPath, value.longitudinalLanePositionValue);
  result = CheckLastError("CAM", gkFuncRefGet, result);

  snprintf(newPath, elcount(newPath), "%s.%s", oldPath, "longitudinalLanePositionConfidence");
  C2xSetTokenInt(packetHandle, "CAM", newPath, value.longitudinalLanePositionConfidence);
  result = CheckLastError("CAM", gkFuncRefGet, result);

  return result;
}

int GetCAMMapPositionParams(LONG packetHandle, struct CAMMapPosition value, char oldPath[])
{
  char newPath[300];
  int result;

  result = 0;

  snprintf(newPath, elcount(newPath), "%s.%s", oldPath, "mapReference");
  value.mapReference.isValidFlag = C2xIsTokenAvailable(packetHandle, "CAM", newPath);
  if(value.mapReference.isValidFlag==1)
  {
    GetCAMMapReferenceParams(packetHandle, value.mapReference, newPath);
    result = CheckLastError("CAM", gkFuncRefGet, result);
  }
  snprintf(newPath, elcount(newPath), "%s.%s", oldPath, "laneId");
  value.laneId.isValidFlag = C2xIsTokenAvailable(packetHandle, "CAM", newPath);
  if(value.laneId.isValidFlag==1)
  {
    value.laneId.value = C2xGetTokenInt(packetHandle, "CAM", newPath);
    result = CheckLastError("CAM", gkFuncRefGet, result);
  }
  snprintf(newPath, elcount(newPath), "%s.%s", oldPath, "connectionId");
  value.connectionId.isValidFlag = C2xIsTokenAvailable(packetHandle, "CAM", newPath);
  if(value.connectionId.isValidFlag==1)
  {
    value.connectionId.value = C2xGetTokenInt(packetHandle, "CAM", newPath);
    result = CheckLastError("CAM", gkFuncRefGet, result);
  }
  snprintf(newPath, elcount(newPath), "%s.%s", oldPath, "longitudinalLanePosition");
  value.longitudinalLanePosition.isValidFlag = C2xIsTokenAvailable(packetHandle, "CAM", newPath);
  if(value.longitudinalLanePosition.isValidFlag==1)
  {
    GetCAMLongitudinalLanePositionParams(packetHandle, value.longitudinalLanePosition, newPath);
    result = CheckLastError("CAM", gkFuncRefGet, result);
  }
  return result;
}

int SetCAMMapPositionParams(LONG packetHandle, struct CAMMapPosition value, char oldPath[])
{
  char newPath[300];
  int result;

  result = 0;

  snprintf(newPath, elcount(newPath), "%s.%s", oldPath, "mapReference");
  if(value.mapReference.isValidFlag==1)
  {
    SetCAMMapReferenceParams(packetHandle, value.mapReference, newPath);
    result = CheckLastError("CAM", gkFuncRefGet, result);
  }
  else
  {
    if( C2xIsTokenAvailable(packetHandle, "CAM", newPath) )
    {
      C2xRemoveToken(packetHandle, "CAM", newPath);
    }
  }

  snprintf(newPath, elcount(newPath), "%s.%s", oldPath, "laneId");
  if(value.laneId.isValidFlag==1)
  {
    C2xSetTokenInt(packetHandle, "CAM", newPath, value.laneId.value);
    result = CheckLastError("CAM", gkFuncRefGet, result);
  }
  else
  {
    if( C2xIsTokenAvailable(packetHandle, "CAM", newPath) )
    {
      C2xRemoveToken(packetHandle, "CAM", newPath);
    }
  }

  snprintf(newPath, elcount(newPath), "%s.%s", oldPath, "connectionId");
  if(value.connectionId.isValidFlag==1)
  {
    C2xSetTokenInt(packetHandle, "CAM", newPath, value.connectionId.value);
    result = CheckLastError("CAM", gkFuncRefGet, result);
  }
  else
  {
    if( C2xIsTokenAvailable(packetHandle, "CAM", newPath) )
    {
      C2xRemoveToken(packetHandle, "CAM", newPath);
    }
  }

  snprintf(newPath, elcount(newPath), "%s.%s", oldPath, "longitudinalLanePosition");
  if(value.longitudinalLanePosition.isValidFlag==1)
  {
    SetCAMLongitudinalLanePositionParams(packetHandle, value.longitudinalLanePosition, newPath);
    result = CheckLastError("CAM", gkFuncRefGet, result);
  }
  else
  {
    if( C2xIsTokenAvailable(packetHandle, "CAM", newPath) )
    {
      C2xRemoveToken(packetHandle, "CAM", newPath);
    }
  }

  return result;
}

int GetCAMGeneralizedLanePositionParams(LONG packetHandle, struct CAMGeneralizedLanePosition value, char oldPath[])
{
  char newPath[300];
  int result;

  result = 0;

  snprintf(newPath, elcount(newPath), "%s.%s", oldPath, "lanePositionBased");
  GetCAMLanePositionOptionsParams(packetHandle, value.lanePositionBased, newPath);
  result = CheckLastError("CAM", gkFuncRefGet, result);

  snprintf(newPath, elcount(newPath), "%s.%s", oldPath, "mapBased");
  value.mapBased.isValidFlag = C2xIsTokenAvailable(packetHandle, "CAM", newPath);
  if(value.mapBased.isValidFlag==1)
  {
    GetCAMMapPositionParams(packetHandle, value.mapBased, newPath);
    result = CheckLastError("CAM", gkFuncRefGet, result);
  }
  snprintf(newPath, elcount(newPath), "%s.%s", oldPath, "confidence");
  GetCAMMetaInformationParams(packetHandle, value.confidence, newPath);
  result = CheckLastError("CAM", gkFuncRefGet, result);

  return result;
}

int SetCAMGeneralizedLanePositionParams(LONG packetHandle, struct CAMGeneralizedLanePosition value, char oldPath[])
{
  char newPath[300];
  int result;

  result = 0;

  snprintf(newPath, elcount(newPath), "%s.%s", oldPath, "lanePositionBased");
  SetCAMLanePositionOptionsParams(packetHandle, value.lanePositionBased, newPath);
  result = CheckLastError("CAM", gkFuncRefGet, result);

  snprintf(newPath, elcount(newPath), "%s.%s", oldPath, "mapBased");
  if(value.mapBased.isValidFlag==1)
  {
    SetCAMMapPositionParams(packetHandle, value.mapBased, newPath);
    result = CheckLastError("CAM", gkFuncRefGet, result);
  }
  else
  {
    if( C2xIsTokenAvailable(packetHandle, "CAM", newPath) )
    {
      C2xRemoveToken(packetHandle, "CAM", newPath);
    }
  }

  snprintf(newPath, elcount(newPath), "%s.%s", oldPath, "confidence");
  SetCAMMetaInformationParams(packetHandle, value.confidence, newPath);
  result = CheckLastError("CAM", gkFuncRefGet, result);

  return result;
}

int GetCAMGeneralizedLanePositionsParams(LONG packetHandle, struct CAMGeneralizedLanePositions value, char oldPath[])
{
  char newPath[300]; 
  int i;
  int result;

  result = 0;

  value.length = C2xGetTokenInt(packetHandle, "CAM", oldPath);
  if((result = CheckLastError("CAM", gkFuncRefGet, result))==0)
  {
    for(i=0; i<value.length; i++)
    {
      snprintf(newPath, elcount(newPath), "%s[%d]", oldPath, i);
      GetCAMGeneralizedLanePositionParams(packetHandle, value.arrayValue[i], newPath);
      result = CheckLastError("CAM", gkFuncRefGet, result);
    }
  }
  return result;
}

int SetCAMGeneralizedLanePositionsParams(LONG packetHandle, struct CAMGeneralizedLanePositions value, char oldPath[])
{
  char newPath[300]; 
  int i;
  int result;

  result = 0;

  C2xRemoveToken(packetHandle, "CAM", oldPath);
  for(i=0; i<value.length; i++)
  {
    snprintf(newPath, elcount(newPath), "%s[%d]", oldPath, i);
    SetCAMGeneralizedLanePositionParams(packetHandle, value.arrayValue[i], newPath);
    result = CheckLastError("CAM", gkFuncRefGet, result);
  }
  return result;
}

int GetCAMGeneralizedLanePositionsContainerParams(LONG packetHandle, struct CAMGeneralizedLanePositionsContainer value, char oldPath[])
{
  char newPath[300];
  int result;

  result = 0;

  snprintf(newPath, elcount(newPath), "%s.%s", oldPath, "generalizedLanePositions");
  GetCAMGeneralizedLanePositionsParams(packetHandle, value.generalizedLanePositions, newPath);
  result = CheckLastError("CAM", gkFuncRefGet, result);

  return result;
}

int SetCAMGeneralizedLanePositionsContainerParams(LONG packetHandle, struct CAMGeneralizedLanePositionsContainer value, char oldPath[])
{
  char newPath[300];
  int result;

  result = 0;

  snprintf(newPath, elcount(newPath), "%s.%s", oldPath, "generalizedLanePositions");
  SetCAMGeneralizedLanePositionsParams(packetHandle, value.generalizedLanePositions, newPath);
  result = CheckLastError("CAM", gkFuncRefGet, result);

  return result;
}

int GetCAMPedalStatusParams(LONG packetHandle, struct CAMPedalStatus value, char oldPath[])
{
  char newPath[300];
  int result;

  result = 0;

  snprintf(newPath, elcount(newPath), "%s.%s", oldPath, "pedalPositionValue");
  value.pedalPositionValue = C2xGetTokenInt(packetHandle, "CAM", newPath);
  result = CheckLastError("CAM", gkFuncRefGet, result);

  return result;
}

int SetCAMPedalStatusParams(LONG packetHandle, struct CAMPedalStatus value, char oldPath[])
{
  char newPath[300];
  int result;

  result = 0;

  snprintf(newPath, elcount(newPath), "%s.%s", oldPath, "pedalPositionValue");
  C2xSetTokenInt(packetHandle, "CAM", newPath, value.pedalPositionValue);
  result = CheckLastError("CAM", gkFuncRefGet, result);

  return result;
}

int GetCAMVehicleMovementControlParams(LONG packetHandle, struct CAMVehicleMovementControl value, char oldPath[])
{
  char newPath[300]; 
  int j; 
  int k;
  int result;

  result = 0;

  snprintf(newPath, elcount(newPath), "%s.%s", oldPath, "accelerationPedalStatus");
  GetCAMPedalStatusParams(packetHandle, value.accelerationPedalStatus, newPath);
  result = CheckLastError("CAM", gkFuncRefGet, result);

  snprintf(newPath, elcount(newPath), "%s.%s", oldPath, "brakePedalStatus");
  GetCAMPedalStatusParams(packetHandle, value.brakePedalStatus, newPath);
  result = CheckLastError("CAM", gkFuncRefGet, result);

  snprintf(newPath, elcount(newPath), "%s.%s", oldPath, "saeAutomationLevel");
  value.saeAutomationLevel.isValidFlag = C2xIsTokenAvailable(packetHandle, "CAM", newPath);
  if(value.saeAutomationLevel.isValidFlag==1)
  {
    value.saeAutomationLevel.value = C2xGetTokenInt(packetHandle, "CAM", newPath);
    result = CheckLastError("CAM", gkFuncRefGet, result);
  }
  snprintf(newPath, elcount(newPath), "%s.%s", oldPath, "automationControl");
  value.automationControl.isValidFlag = C2xIsTokenAvailable(packetHandle, "CAM", newPath);
  if(value.automationControl.isValidFlag==1)
  {
    value.automationControl.isValidFlag = 1;
    value.automationControl.stringLength = C2xGetTokenLengthBit(packetHandle, "CAM", newPath);
    if ((result = CheckLastError("CAM", gkFuncRefGet, result))==0)
    {
      if(value.automationControl.stringLength > 0)
      {
        for(j=0; j<value.automationControl.stringLength; j++)
        {
          if(C2xGetTokenBitOfBitString(packetHandle, "CAM", newPath, j) == 0)
          {
            value.automationControl.string[j] = '0';
          }
          else if(C2xGetTokenBitOfBitString(packetHandle, "CAM", newPath, j) == 1)
          {
            value.automationControl.string[j] = '1';
          }

          if(value.automationControl.stringLength == 1)
          {
            value.automationControl.string[1] = '0';
          }
          result = CheckLastError("CAM", gkFuncRefGet, result);
        }
      }
      else
      {
        for(k = value.automationControl.stringLength+1; k > -1; k--)
        {
          if(value.automationControl.string[k] == '1')
          {
            value.automationControl.string[k] = '0';
          }
        }
      }
    }

  }
  snprintf(newPath, elcount(newPath), "%s.%s", oldPath, "accelerationControl");
  value.accelerationControl.isValidFlag = C2xIsTokenAvailable(packetHandle, "CAM", newPath);
  if(value.accelerationControl.isValidFlag==1)
  {
    value.accelerationControl.isValidFlag = 1;
    value.accelerationControl.stringLength = C2xGetTokenLengthBit(packetHandle, "CAM", newPath);
    if ((result = CheckLastError("CAM", gkFuncRefGet, result))==0)
    {
      if(value.accelerationControl.stringLength > 0)
      {
        for(j=0; j<value.accelerationControl.stringLength; j++)
        {
          if(C2xGetTokenBitOfBitString(packetHandle, "CAM", newPath, j) == 0)
          {
            value.accelerationControl.string[j] = '0';
          }
          else if(C2xGetTokenBitOfBitString(packetHandle, "CAM", newPath, j) == 1)
          {
            value.accelerationControl.string[j] = '1';
          }

          if(value.accelerationControl.stringLength == 1)
          {
            value.accelerationControl.string[1] = '0';
          }
          result = CheckLastError("CAM", gkFuncRefGet, result);
        }
      }
      else
      {
        for(k = value.accelerationControl.stringLength+1; k > -1; k--)
        {
          if(value.accelerationControl.string[k] == '1')
          {
            value.accelerationControl.string[k] = '0';
          }
        }
      }
    }

  }
  snprintf(newPath, elcount(newPath), "%s.%s", oldPath, "accelerationControlExtension");
  value.accelerationControlExtension.isValidFlag = C2xIsTokenAvailable(packetHandle, "CAM", newPath);
  if(value.accelerationControlExtension.isValidFlag==1)
  {
    value.accelerationControlExtension.isValidFlag = 1;
    value.accelerationControlExtension.stringLength = C2xGetTokenLengthBit(packetHandle, "CAM", newPath);
    if ((result = CheckLastError("CAM", gkFuncRefGet, result))==0)
    {
      if(value.accelerationControlExtension.stringLength > 0)
      {
        for(j=0; j<value.accelerationControlExtension.stringLength; j++)
        {
          if(C2xGetTokenBitOfBitString(packetHandle, "CAM", newPath, j) == 0)
          {
            value.accelerationControlExtension.string[j] = '0';
          }
          else if(C2xGetTokenBitOfBitString(packetHandle, "CAM", newPath, j) == 1)
          {
            value.accelerationControlExtension.string[j] = '1';
          }

          if(value.accelerationControlExtension.stringLength == 1)
          {
            value.accelerationControlExtension.string[1] = '0';
          }
          result = CheckLastError("CAM", gkFuncRefGet, result);
        }
      }
      else
      {
        for(k = value.accelerationControlExtension.stringLength+1; k > -1; k--)
        {
          if(value.accelerationControlExtension.string[k] == '1')
          {
            value.accelerationControlExtension.string[k] = '0';
          }
        }
      }
    }

  }
  return result;
}

int SetCAMVehicleMovementControlParams(LONG packetHandle, struct CAMVehicleMovementControl value, char oldPath[])
{
  char newPath[300]; 
  int j;
  int result;

  result = 0;

  snprintf(newPath, elcount(newPath), "%s.%s", oldPath, "accelerationPedalStatus");
  SetCAMPedalStatusParams(packetHandle, value.accelerationPedalStatus, newPath);
  result = CheckLastError("CAM", gkFuncRefGet, result);

  snprintf(newPath, elcount(newPath), "%s.%s", oldPath, "brakePedalStatus");
  SetCAMPedalStatusParams(packetHandle, value.brakePedalStatus, newPath);
  result = CheckLastError("CAM", gkFuncRefGet, result);

  snprintf(newPath, elcount(newPath), "%s.%s", oldPath, "saeAutomationLevel");
  if(value.saeAutomationLevel.isValidFlag==1)
  {
    C2xSetTokenInt(packetHandle, "CAM", newPath, value.saeAutomationLevel.value);
    result = CheckLastError("CAM", gkFuncRefGet, result);
  }
  else
  {
    if( C2xIsTokenAvailable(packetHandle, "CAM", newPath) )
    {
      C2xRemoveToken(packetHandle, "CAM", newPath);
    }
  }

  snprintf(newPath, elcount(newPath), "%s.%s", oldPath, "automationControl");
  if(value.automationControl.isValidFlag==1)
  {
      for(j=0; j<value.automationControl.stringLength; j++)
      {
        if(value.automationControl.string[j] == '0')
        {
          C2xSetTokenBitOfBitString(packetHandle, "CAM", newPath, j, 0);
        }
        else
        {
          C2xSetTokenBitOfBitString(packetHandle, "CAM", newPath, j, 1);
        }
        result = CheckLastError("CAM", gkFuncRefGet, result);
      }
  }
  else
  {
    if( C2xIsTokenAvailable(packetHandle, "CAM", newPath) )
    {
      C2xRemoveToken(packetHandle, "CAM", newPath);
    }
  }

  snprintf(newPath, elcount(newPath), "%s.%s", oldPath, "accelerationControl");
  if(value.accelerationControl.isValidFlag==1)
  {
      for(j=0; j<value.accelerationControl.stringLength; j++)
      {
        if(value.accelerationControl.string[j] == '0')
        {
          C2xSetTokenBitOfBitString(packetHandle, "CAM", newPath, j, 0);
        }
        else
        {
          C2xSetTokenBitOfBitString(packetHandle, "CAM", newPath, j, 1);
        }
        result = CheckLastError("CAM", gkFuncRefGet, result);
      }
  }
  else
  {
    if( C2xIsTokenAvailable(packetHandle, "CAM", newPath) )
    {
      C2xRemoveToken(packetHandle, "CAM", newPath);
    }
  }

  snprintf(newPath, elcount(newPath), "%s.%s", oldPath, "accelerationControlExtension");
  if(value.accelerationControlExtension.isValidFlag==1)
  {
      for(j=0; j<value.accelerationControlExtension.stringLength; j++)
      {
        if(value.accelerationControlExtension.string[j] == '0')
        {
          C2xSetTokenBitOfBitString(packetHandle, "CAM", newPath, j, 0);
        }
        else
        {
          C2xSetTokenBitOfBitString(packetHandle, "CAM", newPath, j, 1);
        }
        result = CheckLastError("CAM", gkFuncRefGet, result);
      }
  }
  else
  {
    if( C2xIsTokenAvailable(packetHandle, "CAM", newPath) )
    {
      C2xRemoveToken(packetHandle, "CAM", newPath);
    }
  }

  return result;
}

int GetCAMVehicleMovementControlContainerParams(LONG packetHandle, struct CAMVehicleMovementControlContainer value, char oldPath[])
{
  char newPath[300];
  int result;

  result = 0;

  snprintf(newPath, elcount(newPath), "%s.%s", oldPath, "vehicleMovementControl");
  GetCAMVehicleMovementControlParams(packetHandle, value.vehicleMovementControl, newPath);
  result = CheckLastError("CAM", gkFuncRefGet, result);

  return result;
}

int SetCAMVehicleMovementControlContainerParams(LONG packetHandle, struct CAMVehicleMovementControlContainer value, char oldPath[])
{
  char newPath[300];
  int result;

  result = 0;

  snprintf(newPath, elcount(newPath), "%s.%s", oldPath, "vehicleMovementControl");
  SetCAMVehicleMovementControlParams(packetHandle, value.vehicleMovementControl, newPath);
  result = CheckLastError("CAM", gkFuncRefGet, result);

  return result;
}

int GetCAMExtensionContainersParams(LONG packetHandle, WORD tableKey, struct CAMExtensionContainers value, char oldPath[])
{
  char newPath[300];
  int result;

  result = 0;

  switch(tableKey)
  {
    case 1:
    {
      snprintf(newPath, elcount(newPath), "%s.%s", oldPath, "twoWheelerContainer");
      GetCAMTwoWheelerContainerParams(packetHandle, value.twoWheelerContainer, newPath);
      result = CheckLastError("CAM", gkFuncRefGet, result);
    }
    break;
    case 2:
    {
      snprintf(newPath, elcount(newPath), "%s.%s", oldPath, "eHorizonLocationSharingContainer");
      GetCAMEHorizonLocationSharingContainerParams(packetHandle, value.eHorizonLocationSharingContainer, newPath);
      result = CheckLastError("CAM", gkFuncRefGet, result);
    }
    break;
    case 3:
    {
      snprintf(newPath, elcount(newPath), "%s.%s", oldPath, "veryLowFrequencyContainer");
      GetCAMVeryLowFrequencyContainerParams(packetHandle, value.veryLowFrequencyContainer, newPath);
      result = CheckLastError("CAM", gkFuncRefGet, result);
    }
    break;
    case 4:
    {
      snprintf(newPath, elcount(newPath), "%s.%s", oldPath, "pathPredictionContainer");
      GetCAMPathPredictionContainerParams(packetHandle, value.pathPredictionContainer, newPath);
      result = CheckLastError("CAM", gkFuncRefGet, result);
    }
    break;
    case 5:
    {
      snprintf(newPath, elcount(newPath), "%s.%s", oldPath, "generalizedLanePositionsContainer");
      GetCAMGeneralizedLanePositionsContainerParams(packetHandle, value.generalizedLanePositionsContainer, newPath);
      result = CheckLastError("CAM", gkFuncRefGet, result);
    }
    break;
    case 6:
    {
      snprintf(newPath, elcount(newPath), "%s.%s", oldPath, "vehicleMovementControlContainer");
      GetCAMVehicleMovementControlContainerParams(packetHandle, value.vehicleMovementControlContainer, newPath);
      result = CheckLastError("CAM", gkFuncRefGet, result);
    }
    break;
  }
  return result;
}

int SetCAMExtensionContainersParams(LONG packetHandle, WORD tableKey, struct CAMExtensionContainers value, char oldPath[])
{
  char newPath[300];
  int result;

  result = 0;

  switch(tableKey)
  {
    case 1:
    {
      snprintf(newPath, elcount(newPath), "%s.%s", oldPath, "twoWheelerContainer");
      SetCAMTwoWheelerContainerParams(packetHandle, value.twoWheelerContainer, newPath);
      result = CheckLastError("CAM", gkFuncRefGet, result);
    }
    break;
    case 2:
    {
      snprintf(newPath, elcount(newPath), "%s.%s", oldPath, "eHorizonLocationSharingContainer");
      SetCAMEHorizonLocationSharingContainerParams(packetHandle, value.eHorizonLocationSharingContainer, newPath);
      result = CheckLastError("CAM", gkFuncRefGet, result);
    }
    break;
    case 3:
    {
      snprintf(newPath, elcount(newPath), "%s.%s", oldPath, "veryLowFrequencyContainer");
      SetCAMVeryLowFrequencyContainerParams(packetHandle, value.veryLowFrequencyContainer, newPath);
      result = CheckLastError("CAM", gkFuncRefGet, result);
    }
    break;
    case 4:
    {
      snprintf(newPath, elcount(newPath), "%s.%s", oldPath, "pathPredictionContainer");
      SetCAMPathPredictionContainerParams(packetHandle, value.pathPredictionContainer, newPath);
      result = CheckLastError("CAM", gkFuncRefGet, result);
    }
    break;
    case 5:
    {
      snprintf(newPath, elcount(newPath), "%s.%s", oldPath, "generalizedLanePositionsContainer");
      SetCAMGeneralizedLanePositionsContainerParams(packetHandle, value.generalizedLanePositionsContainer, newPath);
      result = CheckLastError("CAM", gkFuncRefGet, result);
    }
    break;
    case 6:
    {
      snprintf(newPath, elcount(newPath), "%s.%s", oldPath, "vehicleMovementControlContainer");
      SetCAMVehicleMovementControlContainerParams(packetHandle, value.vehicleMovementControlContainer, newPath);
      result = CheckLastError("CAM", gkFuncRefGet, result);
    }
    break;
  }
  return result;
}

int GetCAMWrappedExtensionContainerParams(LONG packetHandle, struct CAMWrappedExtensionContainer value, char oldPath[])
{
  char newPath[300];
  int result;

  result = 0;

  snprintf(newPath, elcount(newPath), "%s.%s", oldPath, "containerId");
  value.containerId = C2xGetTokenInt(packetHandle, "CAM", newPath);
  result = CheckLastError("CAM", gkFuncRefGet, result);

  snprintf(newPath, elcount(newPath), "%s.%s", oldPath, "containerData");
  GetCAMExtensionContainersParams(packetHandle, value.containerId, value.containerData, newPath);
  result = CheckLastError("CAM", gkFuncRefGet, result);

  return result;
}

int SetCAMWrappedExtensionContainerParams(LONG packetHandle, struct CAMWrappedExtensionContainer value, char oldPath[])
{
  char newPath[300];
  int result;

  result = 0;


  snprintf(newPath, elcount(newPath), "%s.%s", oldPath, "containerData");
  SetCAMExtensionContainersParams(packetHandle, value.containerId, value.containerData, newPath);
  result = CheckLastError("CAM", gkFuncRefGet, result);

  return result;
}

int GetCAMWrappedExtensionContainersParams(LONG packetHandle, struct CAMWrappedExtensionContainers value, char oldPath[])
{
  char newPath[300]; 
  int i;
  int result;

  result = 0;

  value.length = C2xGetTokenInt(packetHandle, "CAM", oldPath);
  if((result = CheckLastError("CAM", gkFuncRefGet, result))==0)
  {
    for(i=0; i<value.length; i++)
    {
      snprintf(newPath, elcount(newPath), "%s[%d]", oldPath, i);
      GetCAMWrappedExtensionContainerParams(packetHandle, value.arrayValue[i], newPath);
      result = CheckLastError("CAM", gkFuncRefGet, result);
    }
  }
  return result;
}

int SetCAMWrappedExtensionContainersParams(LONG packetHandle, struct CAMWrappedExtensionContainers value, char oldPath[])
{
  char newPath[300]; 
  int i;
  int result;

  result = 0;

  C2xRemoveToken(packetHandle, "CAM", oldPath);
  for(i=0; i<value.length; i++)
  {
    snprintf(newPath, elcount(newPath), "%s[%d]", oldPath, i);
    SetCAMWrappedExtensionContainerParams(packetHandle, value.arrayValue[i], newPath);
    result = CheckLastError("CAM", gkFuncRefGet, result);
  }
  return result;
}

int GetCAMCamParametersParams(LONG packetHandle, struct CAMCamParameters value, char oldPath[])
{
  char newPath[300];
  int result;

  result = 0;

  snprintf(newPath, elcount(newPath), "%s.%s", oldPath, "basicContainer");
  GetCAMBasicContainerParams(packetHandle, value.basicContainer, newPath);
  result = CheckLastError("CAM", gkFuncRefGet, result);

  snprintf(newPath, elcount(newPath), "%s.%s", oldPath, "highFrequencyContainer");
  GetCAMHighFrequencyContainerParams(packetHandle, value.highFrequencyContainer, newPath);
  result = CheckLastError("CAM", gkFuncRefGet, result);

  snprintf(newPath, elcount(newPath), "%s.%s", oldPath, "lowFrequencyContainer");
  value.lowFrequencyContainer.isValidFlag = C2xIsTokenAvailable(packetHandle, "CAM", newPath);
  if(value.lowFrequencyContainer.isValidFlag==1)
  {
    GetCAMLowFrequencyContainerParams(packetHandle, value.lowFrequencyContainer, newPath);
    result = CheckLastError("CAM", gkFuncRefGet, result);
  }
  snprintf(newPath, elcount(newPath), "%s.%s", oldPath, "specialVehicleContainer");
  value.specialVehicleContainer.isValidFlag = C2xIsTokenAvailable(packetHandle, "CAM", newPath);
  if(value.specialVehicleContainer.isValidFlag==1)
  {
    GetCAMSpecialVehicleContainerParams(packetHandle, value.specialVehicleContainer, newPath);
    result = CheckLastError("CAM", gkFuncRefGet, result);
  }
  snprintf(newPath, elcount(newPath), "%s.%s", oldPath, "extensionContainers");
  value.extensionContainers.isValidFlag = C2xIsTokenAvailable(packetHandle, "CAM", newPath);
  if(value.extensionContainers.isValidFlag==1)
  {
    GetCAMWrappedExtensionContainersParams(packetHandle, value.extensionContainers, newPath);
    result = CheckLastError("CAM", gkFuncRefGet, result);
  }
  return result;
}

int SetCAMCamParametersParams(LONG packetHandle, struct CAMCamParameters value, char oldPath[])
{
  char newPath[300];
  int result;

  result = 0;

  snprintf(newPath, elcount(newPath), "%s.%s", oldPath, "basicContainer");
  SetCAMBasicContainerParams(packetHandle, value.basicContainer, newPath);
  result = CheckLastError("CAM", gkFuncRefGet, result);

  snprintf(newPath, elcount(newPath), "%s.%s", oldPath, "highFrequencyContainer");
  SetCAMHighFrequencyContainerParams(packetHandle, value.highFrequencyContainer, newPath);
  result = CheckLastError("CAM", gkFuncRefGet, result);

  snprintf(newPath, elcount(newPath), "%s.%s", oldPath, "lowFrequencyContainer");
  if(value.lowFrequencyContainer.isValidFlag==1)
  {
    SetCAMLowFrequencyContainerParams(packetHandle, value.lowFrequencyContainer, newPath);
    result = CheckLastError("CAM", gkFuncRefGet, result);
  }
  else
  {
    if( C2xIsTokenAvailable(packetHandle, "CAM", newPath) )
    {
      C2xRemoveToken(packetHandle, "CAM", newPath);
    }
  }

  snprintf(newPath, elcount(newPath), "%s.%s", oldPath, "specialVehicleContainer");
  if(value.specialVehicleContainer.isValidFlag==1)
  {
    SetCAMSpecialVehicleContainerParams(packetHandle, value.specialVehicleContainer, newPath);
    result = CheckLastError("CAM", gkFuncRefGet, result);
  }
  else
  {
    if( C2xIsTokenAvailable(packetHandle, "CAM", newPath) )
    {
      C2xRemoveToken(packetHandle, "CAM", newPath);
    }
  }

  snprintf(newPath, elcount(newPath), "%s.%s", oldPath, "extensionContainers");
  if(value.extensionContainers.isValidFlag==1)
  {
    SetCAMWrappedExtensionContainersParams(packetHandle, value.extensionContainers, newPath);
    result = CheckLastError("CAM", gkFuncRefGet, result);
  }
  else
  {
    if( C2xIsTokenAvailable(packetHandle, "CAM", newPath) )
    {
      C2xRemoveToken(packetHandle, "CAM", newPath);
    }
  }

  return result;
}

int GetCAMCamPayloadParams(LONG packetHandle, struct CAMCamPayload value, char oldPath[])
{
  char newPath[300];
  int result;

  result = 0;

  snprintf(newPath, elcount(newPath), "%s.%s", oldPath, "generationDeltaTime");
  value.generationDeltaTime = C2xGetTokenInt(packetHandle, "CAM", newPath);
  result = CheckLastError("CAM", gkFuncRefGet, result);

  snprintf(newPath, elcount(newPath), "%s.%s", oldPath, "camParameters");
  GetCAMCamParametersParams(packetHandle, value.camParameters, newPath);
  result = CheckLastError("CAM", gkFuncRefGet, result);

  return result;
}

int SetCAMCamPayloadParams(LONG packetHandle, struct CAMCamPayload value, char oldPath[])
{
  char newPath[300];
  int result;

  result = 0;

  snprintf(newPath, elcount(newPath), "%s.%s", oldPath, "generationDeltaTime");
  C2xSetTokenInt(packetHandle, "CAM", newPath, value.generationDeltaTime);
  result = CheckLastError("CAM", gkFuncRefGet, result);

  snprintf(newPath, elcount(newPath), "%s.%s", oldPath, "camParameters");
  SetCAMCamParametersParams(packetHandle, value.camParameters, newPath);
  result = CheckLastError("CAM", gkFuncRefGet, result);

  return result;
}

int API_GetCAMParams(LONG packetHandle, struct CAM value)
{
  int result;
  result = 0;

  value.header.isValidFlag = 1;
  GetCAMItsPduHeaderParams(packetHandle, value.header, "header");
  result = CheckLastError("CAM", gkFuncRefGet, result);

  value.cam.isValidFlag = 1;
  GetCAMCamPayloadParams(packetHandle, value.cam, "cam");
  result = CheckLastError("CAM", gkFuncRefGet, result);

  return result;
}

int API_SetCAMParams(LONG packetHandle, struct CAM value)
{
  int result;
  result = 0;

  SetCAMItsPduHeaderParams(packetHandle, value.header, "header");
  result = CheckLastError("CAM", gkFuncRefGet, result);

  SetCAMCamPayloadParams(packetHandle, value.cam, "cam");
  result = CheckLastError("CAM", gkFuncRefGet, result);

  return result;
}

