/*@!Encoding:1252*/
/*
//  (c) Vector Informatik GmbH. All rights reserved.
//
//  This file contains definitions of structs and methods that may be used
//  to set and get the values of an ASN.1 defined packet's payload.
//
//  //This example demonstrates how to set a packet's payload:
//  LONG packetHandle;
//  struct MVM payload;
//  //you need to set the values of the variable "payload" yourself
//  packetHandle = API_InitMVMPacket();
//  if (packetHandle!=0) {
//    if (API_SetMVMParams(packetHandle, payload)==0) {
//      if (C2xCompletePacket(packetHandle)==0) {
//        C2xOutputPacket(packetHandle);
//      }
//    }
//  }
//                                                                             */
includes
{
 
}
variables
{
    struct MVMItsPduHeader {
        INT isValidFlag;   // necessary if this struct is used as an optional field of a SEQUENCE
        BYTE protocolVersion;  // INTEGER, 0..255;
        BYTE messageID;  // INTEGER, 0..255, denm(1), cam(2), poim(3), spatem(4), mapem(5), ivim(6), rfu1(7), rfu2(8), srem(9), ssem(10), evcsn(11), saem(12), rtcmem(13), cpm(14), imzm(15), vam(16), dsm(17), mim(18), mvm(19), mcm(20);
        DWORD stationID;  // INTEGER, 0..4294967295;
    };
    
    struct MVMAvmE2EProtection {
        INT isValidFlag;   // necessary if this struct is used as an optional field of a SEQUENCE
        WORD length;  // INTEGER, 0..65535;
        WORD rollingCounter;  // INTEGER, 0..65535;
        DWORD dataID;  // INTEGER, 0..4294967295;
        DWORD crc32;  // INTEGER, 0..4294967295;
    };
    
    struct MVMMVMDataControlField_rollingCounterFromMim {
        INT isValidFlag;   // necessary if this struct is used as an optional field of a SEQUENCE
        INT length;
        WORD arrayValue[10];  // INTEGER, 0..65535;
    };
    
    struct MVMMVMDataControlField {
        INT isValidFlag;   // necessary if this struct is used as an optional field of a SEQUENCE
        struct OPT_QWORD_ASN mvmGenerationTime;  // INTEGER, OPTIONAL, 0..4398046511103;
        struct MVMMVMDataControlField_rollingCounterFromMim rollingCounterFromMim;  // SEQUENCEOF;
        struct OPT_WORD_ASN proprietaryExtensionField;  // INTEGER, OPTIONAL, 0..65535;
    };
    
    struct MVMSessionMissionID {
        INT isValidFlag;   // necessary if this struct is used as an optional field of a SEQUENCE
        CHAR string[33];
        INT  stringLength;
    };
    
    struct MVMVehicleID {
        INT isValidFlag;   // necessary if this struct is used as an optional field of a SEQUENCE
        CHAR string[18];
        INT  stringLength;
    };
    
    struct MVMFacilityID {
        INT isValidFlag;   // necessary if this struct is used as an optional field of a SEQUENCE
        CHAR string[33];
        INT  stringLength;
    };
    
    struct MVMSystemManagementData {
        INT isValidFlag;   // necessary if this struct is used as an optional field of a SEQUENCE
        struct MVMSessionMissionID sessionID;  // IA5STRING, OPTIONAL;
        struct MVMSessionMissionID missionID;  // IA5STRING, OPTIONAL;
        struct MVMVehicleID vehicleID;  // IA5STRING, OPTIONAL;
        struct MVMFacilityID facilityID;  // IA5STRING, OPTIONAL;
    };
    
    struct MVMPose {
        INT isValidFlag;   // necessary if this struct is used as an optional field of a SEQUENCE
        LONG x;  // INTEGER, -524288..524287, negativeOutOfRange(-524287), positiveOutOfRange(524287), unavailable(-524288);
        LONG y;  // INTEGER, -524288..524287, negativeOutOfRange(-524287), positiveOutOfRange(524287), unavailable(-524288);
        WORD psi;  // INTEGER, 0..62833, xDirection(0), outOfRange(62832), unavailable(62833);
    };
    
    struct MVMVehicleState {
        INT isValidFlag;   // necessary if this struct is used as an optional field of a SEQUENCE
        struct OPT_QWORD_ASN vehicleStateGenerationTime;  // INTEGER, OPTIONAL, 0..4398046511103;
        INT operationMode;  // ENUMERATED, unknown(0), initializing(1), prepared(2), driving(3), terminating(4), suspend(5), tempError(6), humanInControl(7), stationHold(8);
        INT gearState;  // ENUMERATED, park(0), backwards(1), neutral(2), forwards(3), unknown(4);
        INT directionIndicatorState;  // ENUMERATED, off(0), right(1), left(2), both(3), unknown(4);
        INT parkingBrakeState;  // ENUMERATED, unknown(0), engaging(1), engaged(2), disengaging(3), disengaged(4);
        INT motorSystemState;  // ENUMERATED, off(0), on(1), unknown(2);
        INT currentVelocity;  // INTEGER, -16383..16383, negativeOutOfRange(-16383), positiveOutOfRange(16382), unavailable(16383);
        INT currentCurvature;  // INTEGER, -32768..32767, outOfRangeNegative(-32767), straight(0), outOfRangePositive(32767), unavailable(-32768);
        INT secureStandstill;  // BOOLEAN;
        struct OPT_WORD_ASN idxLastWayPoint;  // INTEGER, OPTIONAL, 0..65535;
        struct MVMPose localizedPose;  // SEQUENCE, OPTIONAL;
    };
    
    struct MVMVidResponse {
        INT isValidFlag;   // necessary if this struct is used as an optional field of a SEQUENCE
        INT vidVehicleState;  // ENUMERATED, undefined(0), ready(1), lightFlashingInProgress(2), lightFlashingCompleted(3), lightFlashingFailed(4), authorized(5);
        QWORD vidVehiclePublicKey;  // INTEGER, 0..18446744073709551615;
    };
    
    struct MVMSafetyTimeSyncResponse {
        INT isValidFlag;   // necessary if this struct is used as an optional field of a SEQUENCE
        WORD challenge;  // INTEGER, 0..65535;
        QWORD vehicleSafetyClockReceiveTimestamp;  // INTEGER, 0..4398046511103;
        QWORD vehicleSafetyClockTransmitTimestamp;  // INTEGER, 0..4398046511103;
        DWORD checksum;  // INTEGER, 0..4294967295;
    };
    
    struct MVMSafeVehicleTypeConfirmation_vehicleType {
        INT isValidFlag;   // necessary if this struct is used as an optional field of a SEQUENCE
        CHAR string[33];
        INT  stringLength;
    };
    
    struct MVMSafeVehicleTypeConfirmation_safetyProfile {
        INT isValidFlag;   // necessary if this struct is used as an optional field of a SEQUENCE
        CHAR string[33];
        INT  stringLength;
    };
    
    struct MVMSafeVehicleTypeConfirmation {
        INT isValidFlag;   // necessary if this struct is used as an optional field of a SEQUENCE
        struct MVMSafeVehicleTypeConfirmation_vehicleType vehicleType;  // IA5STRING;
        struct MVMSafeVehicleTypeConfirmation_safetyProfile safetyProfile;  // IA5STRING;
        DWORD checksum;  // INTEGER, 0..4294967295;
    };
    
    struct MVMDescription {
        INT isValidFlag;   // necessary if this struct is used as an optional field of a SEQUENCE
        CHAR string[201];
        INT  stringLength;
    };
    
    struct MVMVehicleError {
        INT isValidFlag;   // necessary if this struct is used as an optional field of a SEQUENCE
        QWORD time;  // INTEGER, 0..4398046511103;
        INT vehCode;  // ENUMERATED, unspecified(0), pathNotDriveable(1), onboardVehicleFault(2), communicationFault(3), vehicleEgressFault(4);
        BYTE customCode;  // INTEGER, 0..255;
        struct MVMDescription description;  // IA5STRING, OPTIONAL;
    };
    
    struct MVMSafetyViolationsContainer {
        INT isValidFlag;   // necessary if this struct is used as an optional field of a SEQUENCE
        INT length;
        INT arrayValue[5];  // ENUMERATED, noViolation(0), noDrivingPermissionReceived(1), lastDrivingPermissionTooOld(2), crcViolationClockSyncRequest(3), crcViolationDrivingPermission(4), expirationTimeViolation(5), drivingDirectionMismatch(6), velocityViolation(7), curvatureMinViolation(8), curvatureMaxViolation(9), expirationTimeTooHigh(10), monitoring(11);
    };
    
    struct MVMVehicleSafetyFeedbackContainer {
        INT isValidFlag;   // necessary if this struct is used as an optional field of a SEQUENCE
        INT remainingTimeToStartBraking;  // INTEGER, -32768..32767;
        struct MVMSafetyViolationsContainer safetyViolations;  // SEQUENCEOF;
        QWORD currentVehicleSafetyClockTime;  // INTEGER, 0..4398046511103;
    };
    
    struct MVMVehicleSafetyFeedback {
        INT isValidFlag;   // necessary if this struct is used as an optional field of a SEQUENCE
        INT length;
        struct MVMVehicleSafetyFeedbackContainer arrayValue[20];  // SEQUENCE;
    };
    
    struct MVMVehicleProperties {
        INT isValidFlag;   // necessary if this struct is used as an optional field of a SEQUENCE
        INT basicVehicleClass;  // ENUMERATED, none(0), unknown(1), special(2), moto(3), car(4), carOther(5), bus(6), axleCnt2(7), axleCnt3(8), axleCnt4(9), axleCnt4Trailer(10), axleCnt5Trailer(11), axleCnt6Trailer(12), axleCnt5MultiTrailer(13), axleCnt6MultiTrailer(14), axleCnt7MultiTrailer(15);
        LONG vehicleLength;  // INTEGER, -524288..524287, negativeOutOfRange(-524287), positiveOutOfRange(524287), unavailable(-524288);
        LONG vehicleWheelbase;  // INTEGER, -524288..524287, negativeOutOfRange(-524287), positiveOutOfRange(524287), unavailable(-524288);
        LONG vehicleRearOverhang;  // INTEGER, -524288..524287, negativeOutOfRange(-524287), positiveOutOfRange(524287), unavailable(-524288);
        LONG vehicleWidth;  // INTEGER, -524288..524287, negativeOutOfRange(-524287), positiveOutOfRange(524287), unavailable(-524288);
        LONG vehicleTireWidth;  // INTEGER, -524288..524287, negativeOutOfRange(-524287), positiveOutOfRange(524287), unavailable(-524288);
        LONG vehicleTrackWidth;  // INTEGER, -524288..524287, negativeOutOfRange(-524287), positiveOutOfRange(524287), unavailable(-524288);
        WORD vehicleMass;  // INTEGER, 1..1024, outOfRange(1023), unavailable(1024);
        INT vehicleSpeedLimit;  // INTEGER, -16383..16383, negativeOutOfRange(-16383), positiveOutOfRange(16382), unavailable(16383);
        INT vehicleCuvatureLimit;  // INTEGER, -32768..32767, outOfRangeNegative(-32767), straight(0), outOfRangePositive(32767), unavailable(-32768);
        INT vehicleMaxAngularSteeringRate;  // INTEGER, -32767..32766, negativeOutOfRange(-32766), positiveOutOfRange(32766), unavailable(-32767);
    };
    
    struct MVMMvm {
        INT isValidFlag;   // necessary if this struct is used as an optional field of a SEQUENCE
        struct MVMMVMDataControlField mvmDataControlField;  // SEQUENCE, OPTIONAL;
        struct MVMSystemManagementData systemManagementData;  // SEQUENCE, OPTIONAL;
        struct MVMVehicleState vehicleState;  // SEQUENCE, OPTIONAL;
        struct MVMVidResponse vidResponse;  // SEQUENCE, OPTIONAL;
        struct MVMSafetyTimeSyncResponse safetyTimeSyncResponse;  // SEQUENCE, OPTIONAL;
        struct MVMSafeVehicleTypeConfirmation safeVehicleTypeConfirmation;  // SEQUENCE, OPTIONAL;
        struct MVMVehicleError vehicleError;  // SEQUENCE, OPTIONAL;
        struct MVMVehicleSafetyFeedback vehicleSafetyFeedback;  // SEQUENCEOF, OPTIONAL;
        struct MVMVehicleProperties vehicleProperties;  // SEQUENCE, OPTIONAL;
    };
    
    struct MVM {
        INT isValidFlag;   // necessary if this struct is used as an optional field of a SEQUENCE
        struct MVMItsPduHeader header;  // SEQUENCE;
        struct MVMAvmE2EProtection e2eProtection;  // SEQUENCE;
        struct MVMMvm mvm;  // SEQUENCE;
    };
    
}

/*
// init function to create a simple packet handle
*/ 
LONG API_InitMVMPacket()
{
  return C2xInitPacket("MVM"); 
}

/*
// init function to create a simple packet handle and
// initialize the struct with valid data
*/ 
LONG API_InitMVMPacket(struct MVM msgStruct)
{
  long pktHandle;

  pktHandle = API_InitMVMPacket();

  if (pktHandle != 0)
  {
    // create valid message and application data
    if (C2xCompletePacket(pktHandle) == 0) 
    {
      API_GetMVMParams(pktHandle, msgStruct);
    }
  }
  return pktHandle;
}

/*
// init function to create a packet with security layer and
// initialize the struct with valid data
*/ 
LONG API_InitMVMPacket(struct MVM msgStruct, char packetTypeDesignator[], char certificateName[])
{
  long pktHandle, certHdl;

  // initialize the packet
  pktHandle = C2xInitPacket("MVM", packetTypeDesignator);

  if (pktHandle != 0)
  {
    certHdl = C2xSecCertificateGetHandle(certificateName);  // get the certificate handle for the cert with name "certificateName"
    if (certHdl != 0) 
    {
      C2xSecPacketSetSignerHandle(pktHandle, certHdl); // set the certHdl to the packet
    }

    // create valid message and application data
    if (C2xCompletePacket(pktHandle) == 0) 
    {
      // copy application data to the application structure
      API_GetMVMParams(pktHandle, msgStruct);
    }
  }
  return pktHandle;
}
    

int GetMVMItsPduHeaderParams(LONG packetHandle, struct MVMItsPduHeader value, char oldPath[])
{
  char newPath[300];
  int result;

  result = 0;

  snprintf(newPath, elcount(newPath), "%s.%s", oldPath, "protocolVersion");
  value.protocolVersion = C2xGetTokenInt(packetHandle, "MVM", newPath);
  result = CheckLastError("MVM", gkFuncRefGet, result);

  snprintf(newPath, elcount(newPath), "%s.%s", oldPath, "messageID");
  value.messageID = C2xGetTokenInt(packetHandle, "MVM", newPath);
  result = CheckLastError("MVM", gkFuncRefGet, result);

  snprintf(newPath, elcount(newPath), "%s.%s", oldPath, "stationID");
  value.stationID = C2xGetTokenInt64(packetHandle, "MVM", newPath);
  result = CheckLastError("MVM", gkFuncRefGet, result);

  return result;
}

int SetMVMItsPduHeaderParams(LONG packetHandle, struct MVMItsPduHeader value, char oldPath[])
{
  char newPath[300];
  int result;

  result = 0;

  snprintf(newPath, elcount(newPath), "%s.%s", oldPath, "protocolVersion");
  C2xSetTokenInt(packetHandle, "MVM", newPath, value.protocolVersion);
  result = CheckLastError("MVM", gkFuncRefGet, result);

  snprintf(newPath, elcount(newPath), "%s.%s", oldPath, "messageID");
  C2xSetTokenInt(packetHandle, "MVM", newPath, value.messageID);
  result = CheckLastError("MVM", gkFuncRefGet, result);

  snprintf(newPath, elcount(newPath), "%s.%s", oldPath, "stationID");
  C2xSetTokenInt64(packetHandle, "MVM", newPath, value.stationID);
  result = CheckLastError("MVM", gkFuncRefGet, result);

  return result;
}

int GetMVMAvmE2EProtectionParams(LONG packetHandle, struct MVMAvmE2EProtection value, char oldPath[])
{
  char newPath[300];
  int result;

  result = 0;

  snprintf(newPath, elcount(newPath), "%s.%s", oldPath, "length");
  value.length = C2xGetTokenInt(packetHandle, "MVM", newPath);
  result = CheckLastError("MVM", gkFuncRefGet, result);

  snprintf(newPath, elcount(newPath), "%s.%s", oldPath, "rollingCounter");
  value.rollingCounter = C2xGetTokenInt(packetHandle, "MVM", newPath);
  result = CheckLastError("MVM", gkFuncRefGet, result);

  snprintf(newPath, elcount(newPath), "%s.%s", oldPath, "dataID");
  value.dataID = C2xGetTokenInt64(packetHandle, "MVM", newPath);
  result = CheckLastError("MVM", gkFuncRefGet, result);

  snprintf(newPath, elcount(newPath), "%s.%s", oldPath, "crc32");
  value.crc32 = C2xGetTokenInt64(packetHandle, "MVM", newPath);
  result = CheckLastError("MVM", gkFuncRefGet, result);

  return result;
}

int SetMVMAvmE2EProtectionParams(LONG packetHandle, struct MVMAvmE2EProtection value, char oldPath[])
{
  char newPath[300];
  int result;

  result = 0;

  snprintf(newPath, elcount(newPath), "%s.%s", oldPath, "length");
  C2xSetTokenInt(packetHandle, "MVM", newPath, value.length);
  result = CheckLastError("MVM", gkFuncRefGet, result);

  snprintf(newPath, elcount(newPath), "%s.%s", oldPath, "rollingCounter");
  C2xSetTokenInt(packetHandle, "MVM", newPath, value.rollingCounter);
  result = CheckLastError("MVM", gkFuncRefGet, result);

  snprintf(newPath, elcount(newPath), "%s.%s", oldPath, "dataID");
  C2xSetTokenInt64(packetHandle, "MVM", newPath, value.dataID);
  result = CheckLastError("MVM", gkFuncRefGet, result);

  snprintf(newPath, elcount(newPath), "%s.%s", oldPath, "crc32");
  C2xSetTokenInt64(packetHandle, "MVM", newPath, value.crc32);
  result = CheckLastError("MVM", gkFuncRefGet, result);

  return result;
}

int GetMVMMVMDataControlField_rollingCounterFromMimParams(LONG packetHandle, struct MVMMVMDataControlField_rollingCounterFromMim value, char oldPath[])
{
  char newPath[300]; 
  int i;
  int result;

  result = 0;

  value.length = C2xGetTokenInt(packetHandle, "MVM", oldPath);
  if((result = CheckLastError("MVM", gkFuncRefGet, result))==0)
  {
    for(i=0; i<value.length; i++)
    {
      snprintf(newPath, elcount(newPath), "%s[%d]", oldPath, i);
      value.arrayValue[i] = C2xGetTokenInt64(packetHandle, "MVM", newPath);
      result = CheckLastError("MVM", gkFuncRefGet, result);
    }
  }
  return result;
}

int SetMVMMVMDataControlField_rollingCounterFromMimParams(LONG packetHandle, struct MVMMVMDataControlField_rollingCounterFromMim value, char oldPath[])
{
  char newPath[300]; 
  int i;
  int result;

  result = 0;

  C2xRemoveToken(packetHandle, "MVM", oldPath);
  for(i=0; i<value.length; i++)
  {
    snprintf(newPath, elcount(newPath), "%s[%d]", oldPath, i);
    C2xSetTokenInt64(packetHandle, "MVM", newPath, value.arrayValue[i]);
    result = CheckLastError("MVM", gkFuncRefGet, result);
  }
  return result;
}

int GetMVMMVMDataControlFieldParams(LONG packetHandle, struct MVMMVMDataControlField value, char oldPath[])
{
  char newPath[300];
  int result;

  result = 0;

  snprintf(newPath, elcount(newPath), "%s.%s", oldPath, "mvmGenerationTime");
  value.mvmGenerationTime.isValidFlag = C2xIsTokenAvailable(packetHandle, "MVM", newPath);
  if(value.mvmGenerationTime.isValidFlag==1)
  {
    value.mvmGenerationTime.value = C2xGetTokenInt64(packetHandle, "MVM", newPath);
    result = CheckLastError("MVM", gkFuncRefGet, result);
  }
  snprintf(newPath, elcount(newPath), "%s.%s", oldPath, "rollingCounterFromMim");
  GetMVMMVMDataControlField_rollingCounterFromMimParams(packetHandle, value.rollingCounterFromMim, newPath);
  result = CheckLastError("MVM", gkFuncRefGet, result);

  snprintf(newPath, elcount(newPath), "%s.%s", oldPath, "proprietaryExtensionField");
  value.proprietaryExtensionField.isValidFlag = C2xIsTokenAvailable(packetHandle, "MVM", newPath);
  if(value.proprietaryExtensionField.isValidFlag==1)
  {
    value.proprietaryExtensionField.value = C2xGetTokenInt(packetHandle, "MVM", newPath);
    result = CheckLastError("MVM", gkFuncRefGet, result);
  }
  return result;
}

int SetMVMMVMDataControlFieldParams(LONG packetHandle, struct MVMMVMDataControlField value, char oldPath[])
{
  char newPath[300];
  int result;

  result = 0;

  snprintf(newPath, elcount(newPath), "%s.%s", oldPath, "mvmGenerationTime");
  if(value.mvmGenerationTime.isValidFlag==1)
  {
    C2xSetTokenInt64(packetHandle, "MVM", newPath, value.mvmGenerationTime.value);
    result = CheckLastError("MVM", gkFuncRefGet, result);
  }
  else
  {
    if( C2xIsTokenAvailable(packetHandle, "MVM", newPath) )
    {
      C2xRemoveToken(packetHandle, "MVM", newPath);
    }
  }

  snprintf(newPath, elcount(newPath), "%s.%s", oldPath, "rollingCounterFromMim");
  SetMVMMVMDataControlField_rollingCounterFromMimParams(packetHandle, value.rollingCounterFromMim, newPath);
  result = CheckLastError("MVM", gkFuncRefGet, result);

  snprintf(newPath, elcount(newPath), "%s.%s", oldPath, "proprietaryExtensionField");
  if(value.proprietaryExtensionField.isValidFlag==1)
  {
    C2xSetTokenInt(packetHandle, "MVM", newPath, value.proprietaryExtensionField.value);
    result = CheckLastError("MVM", gkFuncRefGet, result);
  }
  else
  {
    if( C2xIsTokenAvailable(packetHandle, "MVM", newPath) )
    {
      C2xRemoveToken(packetHandle, "MVM", newPath);
    }
  }

  return result;
}

int GetMVMSystemManagementDataParams(LONG packetHandle, struct MVMSystemManagementData value, char oldPath[])
{
  char newPath[300];
  int result;

  result = 0;

  snprintf(newPath, elcount(newPath), "%s.%s", oldPath, "sessionID");
  value.sessionID.isValidFlag = C2xIsTokenAvailable(packetHandle, "MVM", newPath);
  if(value.sessionID.isValidFlag==1)
  {
    value.sessionID.stringLength = C2xGetTokenData(packetHandle, "MVM", newPath, elcount(value.sessionID.string), value.sessionID.string);
    result = CheckLastError("MVM", gkFuncRefGet, result);
  }
  snprintf(newPath, elcount(newPath), "%s.%s", oldPath, "missionID");
  value.missionID.isValidFlag = C2xIsTokenAvailable(packetHandle, "MVM", newPath);
  if(value.missionID.isValidFlag==1)
  {
    value.missionID.stringLength = C2xGetTokenData(packetHandle, "MVM", newPath, elcount(value.missionID.string), value.missionID.string);
    result = CheckLastError("MVM", gkFuncRefGet, result);
  }
  snprintf(newPath, elcount(newPath), "%s.%s", oldPath, "vehicleID");
  value.vehicleID.isValidFlag = C2xIsTokenAvailable(packetHandle, "MVM", newPath);
  if(value.vehicleID.isValidFlag==1)
  {
    value.vehicleID.stringLength = C2xGetTokenData(packetHandle, "MVM", newPath, elcount(value.vehicleID.string), value.vehicleID.string);
    result = CheckLastError("MVM", gkFuncRefGet, result);
  }
  snprintf(newPath, elcount(newPath), "%s.%s", oldPath, "facilityID");
  value.facilityID.isValidFlag = C2xIsTokenAvailable(packetHandle, "MVM", newPath);
  if(value.facilityID.isValidFlag==1)
  {
    value.facilityID.stringLength = C2xGetTokenData(packetHandle, "MVM", newPath, elcount(value.facilityID.string), value.facilityID.string);
    result = CheckLastError("MVM", gkFuncRefGet, result);
  }
  return result;
}

int SetMVMSystemManagementDataParams(LONG packetHandle, struct MVMSystemManagementData value, char oldPath[])
{
  char newPath[300];
  int result;

  result = 0;

  snprintf(newPath, elcount(newPath), "%s.%s", oldPath, "sessionID");
  if(value.sessionID.isValidFlag==1)
  {
    C2xSetTokenData(packetHandle, "MVM", newPath, value.sessionID.stringLength, value.sessionID.string);
    result = CheckLastError("MVM", gkFuncRefGet, result);
  }
  else
  {
    if( C2xIsTokenAvailable(packetHandle, "MVM", newPath) )
    {
      C2xRemoveToken(packetHandle, "MVM", newPath);
    }
  }

  snprintf(newPath, elcount(newPath), "%s.%s", oldPath, "missionID");
  if(value.missionID.isValidFlag==1)
  {
    C2xSetTokenData(packetHandle, "MVM", newPath, value.missionID.stringLength, value.missionID.string);
    result = CheckLastError("MVM", gkFuncRefGet, result);
  }
  else
  {
    if( C2xIsTokenAvailable(packetHandle, "MVM", newPath) )
    {
      C2xRemoveToken(packetHandle, "MVM", newPath);
    }
  }

  snprintf(newPath, elcount(newPath), "%s.%s", oldPath, "vehicleID");
  if(value.vehicleID.isValidFlag==1)
  {
    C2xSetTokenData(packetHandle, "MVM", newPath, value.vehicleID.stringLength, value.vehicleID.string);
    result = CheckLastError("MVM", gkFuncRefGet, result);
  }
  else
  {
    if( C2xIsTokenAvailable(packetHandle, "MVM", newPath) )
    {
      C2xRemoveToken(packetHandle, "MVM", newPath);
    }
  }

  snprintf(newPath, elcount(newPath), "%s.%s", oldPath, "facilityID");
  if(value.facilityID.isValidFlag==1)
  {
    C2xSetTokenData(packetHandle, "MVM", newPath, value.facilityID.stringLength, value.facilityID.string);
    result = CheckLastError("MVM", gkFuncRefGet, result);
  }
  else
  {
    if( C2xIsTokenAvailable(packetHandle, "MVM", newPath) )
    {
      C2xRemoveToken(packetHandle, "MVM", newPath);
    }
  }

  return result;
}

int GetMVMPoseParams(LONG packetHandle, struct MVMPose value, char oldPath[])
{
  char newPath[300];
  int result;

  result = 0;

  snprintf(newPath, elcount(newPath), "%s.%s", oldPath, "x");
  value.x = C2xGetTokenInt(packetHandle, "MVM", newPath);
  result = CheckLastError("MVM", gkFuncRefGet, result);

  snprintf(newPath, elcount(newPath), "%s.%s", oldPath, "y");
  value.y = C2xGetTokenInt(packetHandle, "MVM", newPath);
  result = CheckLastError("MVM", gkFuncRefGet, result);

  snprintf(newPath, elcount(newPath), "%s.%s", oldPath, "psi");
  value.psi = C2xGetTokenInt(packetHandle, "MVM", newPath);
  result = CheckLastError("MVM", gkFuncRefGet, result);

  return result;
}

int SetMVMPoseParams(LONG packetHandle, struct MVMPose value, char oldPath[])
{
  char newPath[300];
  int result;

  result = 0;

  snprintf(newPath, elcount(newPath), "%s.%s", oldPath, "x");
  C2xSetTokenInt(packetHandle, "MVM", newPath, value.x);
  result = CheckLastError("MVM", gkFuncRefGet, result);

  snprintf(newPath, elcount(newPath), "%s.%s", oldPath, "y");
  C2xSetTokenInt(packetHandle, "MVM", newPath, value.y);
  result = CheckLastError("MVM", gkFuncRefGet, result);

  snprintf(newPath, elcount(newPath), "%s.%s", oldPath, "psi");
  C2xSetTokenInt(packetHandle, "MVM", newPath, value.psi);
  result = CheckLastError("MVM", gkFuncRefGet, result);

  return result;
}

int GetMVMVehicleStateParams(LONG packetHandle, struct MVMVehicleState value, char oldPath[])
{
  char newPath[300];
  int result;

  result = 0;

  snprintf(newPath, elcount(newPath), "%s.%s", oldPath, "vehicleStateGenerationTime");
  value.vehicleStateGenerationTime.isValidFlag = C2xIsTokenAvailable(packetHandle, "MVM", newPath);
  if(value.vehicleStateGenerationTime.isValidFlag==1)
  {
    value.vehicleStateGenerationTime.value = C2xGetTokenInt64(packetHandle, "MVM", newPath);
    result = CheckLastError("MVM", gkFuncRefGet, result);
  }
  snprintf(newPath, elcount(newPath), "%s.%s", oldPath, "operationMode");
  value.operationMode = C2xGetTokenInt(packetHandle, "MVM", newPath);
  result = CheckLastError("MVM", gkFuncRefGet, result);

  snprintf(newPath, elcount(newPath), "%s.%s", oldPath, "gearState");
  value.gearState = C2xGetTokenInt(packetHandle, "MVM", newPath);
  result = CheckLastError("MVM", gkFuncRefGet, result);

  snprintf(newPath, elcount(newPath), "%s.%s", oldPath, "directionIndicatorState");
  value.directionIndicatorState = C2xGetTokenInt(packetHandle, "MVM", newPath);
  result = CheckLastError("MVM", gkFuncRefGet, result);

  snprintf(newPath, elcount(newPath), "%s.%s", oldPath, "parkingBrakeState");
  value.parkingBrakeState = C2xGetTokenInt(packetHandle, "MVM", newPath);
  result = CheckLastError("MVM", gkFuncRefGet, result);

  snprintf(newPath, elcount(newPath), "%s.%s", oldPath, "motorSystemState");
  value.motorSystemState = C2xGetTokenInt(packetHandle, "MVM", newPath);
  result = CheckLastError("MVM", gkFuncRefGet, result);

  snprintf(newPath, elcount(newPath), "%s.%s", oldPath, "currentVelocity");
  value.currentVelocity = C2xGetTokenInt(packetHandle, "MVM", newPath);
  result = CheckLastError("MVM", gkFuncRefGet, result);

  snprintf(newPath, elcount(newPath), "%s.%s", oldPath, "currentCurvature");
  value.currentCurvature = C2xGetTokenInt(packetHandle, "MVM", newPath);
  result = CheckLastError("MVM", gkFuncRefGet, result);

  snprintf(newPath, elcount(newPath), "%s.%s", oldPath, "secureStandstill");
  value.secureStandstill = C2xGetTokenInt64(packetHandle, "MVM", newPath);
  result = CheckLastError("MVM", gkFuncRefGet, result);

  snprintf(newPath, elcount(newPath), "%s.%s", oldPath, "idxLastWayPoint");
  value.idxLastWayPoint.isValidFlag = C2xIsTokenAvailable(packetHandle, "MVM", newPath);
  if(value.idxLastWayPoint.isValidFlag==1)
  {
    value.idxLastWayPoint.value = C2xGetTokenInt(packetHandle, "MVM", newPath);
    result = CheckLastError("MVM", gkFuncRefGet, result);
  }
  snprintf(newPath, elcount(newPath), "%s.%s", oldPath, "localizedPose");
  value.localizedPose.isValidFlag = C2xIsTokenAvailable(packetHandle, "MVM", newPath);
  if(value.localizedPose.isValidFlag==1)
  {
    GetMVMPoseParams(packetHandle, value.localizedPose, newPath);
    result = CheckLastError("MVM", gkFuncRefGet, result);
  }
  return result;
}

int SetMVMVehicleStateParams(LONG packetHandle, struct MVMVehicleState value, char oldPath[])
{
  char newPath[300];
  int result;

  result = 0;

  snprintf(newPath, elcount(newPath), "%s.%s", oldPath, "vehicleStateGenerationTime");
  if(value.vehicleStateGenerationTime.isValidFlag==1)
  {
    C2xSetTokenInt64(packetHandle, "MVM", newPath, value.vehicleStateGenerationTime.value);
    result = CheckLastError("MVM", gkFuncRefGet, result);
  }
  else
  {
    if( C2xIsTokenAvailable(packetHandle, "MVM", newPath) )
    {
      C2xRemoveToken(packetHandle, "MVM", newPath);
    }
  }

  snprintf(newPath, elcount(newPath), "%s.%s", oldPath, "operationMode");
  C2xSetTokenInt(packetHandle, "MVM", newPath, value.operationMode);
  result = CheckLastError("MVM", gkFuncRefGet, result);

  snprintf(newPath, elcount(newPath), "%s.%s", oldPath, "gearState");
  C2xSetTokenInt(packetHandle, "MVM", newPath, value.gearState);
  result = CheckLastError("MVM", gkFuncRefGet, result);

  snprintf(newPath, elcount(newPath), "%s.%s", oldPath, "directionIndicatorState");
  C2xSetTokenInt(packetHandle, "MVM", newPath, value.directionIndicatorState);
  result = CheckLastError("MVM", gkFuncRefGet, result);

  snprintf(newPath, elcount(newPath), "%s.%s", oldPath, "parkingBrakeState");
  C2xSetTokenInt(packetHandle, "MVM", newPath, value.parkingBrakeState);
  result = CheckLastError("MVM", gkFuncRefGet, result);

  snprintf(newPath, elcount(newPath), "%s.%s", oldPath, "motorSystemState");
  C2xSetTokenInt(packetHandle, "MVM", newPath, value.motorSystemState);
  result = CheckLastError("MVM", gkFuncRefGet, result);

  snprintf(newPath, elcount(newPath), "%s.%s", oldPath, "currentVelocity");
  C2xSetTokenInt(packetHandle, "MVM", newPath, value.currentVelocity);
  result = CheckLastError("MVM", gkFuncRefGet, result);

  snprintf(newPath, elcount(newPath), "%s.%s", oldPath, "currentCurvature");
  C2xSetTokenInt(packetHandle, "MVM", newPath, value.currentCurvature);
  result = CheckLastError("MVM", gkFuncRefGet, result);

  snprintf(newPath, elcount(newPath), "%s.%s", oldPath, "secureStandstill");
  C2xSetTokenInt64(packetHandle, "MVM", newPath, value.secureStandstill);
  result = CheckLastError("MVM", gkFuncRefGet, result);

  snprintf(newPath, elcount(newPath), "%s.%s", oldPath, "idxLastWayPoint");
  if(value.idxLastWayPoint.isValidFlag==1)
  {
    C2xSetTokenInt(packetHandle, "MVM", newPath, value.idxLastWayPoint.value);
    result = CheckLastError("MVM", gkFuncRefGet, result);
  }
  else
  {
    if( C2xIsTokenAvailable(packetHandle, "MVM", newPath) )
    {
      C2xRemoveToken(packetHandle, "MVM", newPath);
    }
  }

  snprintf(newPath, elcount(newPath), "%s.%s", oldPath, "localizedPose");
  if(value.localizedPose.isValidFlag==1)
  {
    SetMVMPoseParams(packetHandle, value.localizedPose, newPath);
    result = CheckLastError("MVM", gkFuncRefGet, result);
  }
  else
  {
    if( C2xIsTokenAvailable(packetHandle, "MVM", newPath) )
    {
      C2xRemoveToken(packetHandle, "MVM", newPath);
    }
  }

  return result;
}

int GetMVMVidResponseParams(LONG packetHandle, struct MVMVidResponse value, char oldPath[])
{
  char newPath[300];
  int result;

  result = 0;

  snprintf(newPath, elcount(newPath), "%s.%s", oldPath, "vidVehicleState");
  value.vidVehicleState = C2xGetTokenInt(packetHandle, "MVM", newPath);
  result = CheckLastError("MVM", gkFuncRefGet, result);

  snprintf(newPath, elcount(newPath), "%s.%s", oldPath, "vidVehiclePublicKey");
  value.vidVehiclePublicKey = C2xGetTokenInt64(packetHandle, "MVM", newPath);
  result = CheckLastError("MVM", gkFuncRefGet, result);

  return result;
}

int SetMVMVidResponseParams(LONG packetHandle, struct MVMVidResponse value, char oldPath[])
{
  char newPath[300];
  int result;

  result = 0;

  snprintf(newPath, elcount(newPath), "%s.%s", oldPath, "vidVehicleState");
  C2xSetTokenInt(packetHandle, "MVM", newPath, value.vidVehicleState);
  result = CheckLastError("MVM", gkFuncRefGet, result);

  snprintf(newPath, elcount(newPath), "%s.%s", oldPath, "vidVehiclePublicKey");
  C2xSetTokenInt64(packetHandle, "MVM", newPath, value.vidVehiclePublicKey);
  result = CheckLastError("MVM", gkFuncRefGet, result);

  return result;
}

int GetMVMSafetyTimeSyncResponseParams(LONG packetHandle, struct MVMSafetyTimeSyncResponse value, char oldPath[])
{
  char newPath[300];
  int result;

  result = 0;

  snprintf(newPath, elcount(newPath), "%s.%s", oldPath, "challenge");
  value.challenge = C2xGetTokenInt(packetHandle, "MVM", newPath);
  result = CheckLastError("MVM", gkFuncRefGet, result);

  snprintf(newPath, elcount(newPath), "%s.%s", oldPath, "vehicleSafetyClockReceiveTimestamp");
  value.vehicleSafetyClockReceiveTimestamp = C2xGetTokenInt64(packetHandle, "MVM", newPath);
  result = CheckLastError("MVM", gkFuncRefGet, result);

  snprintf(newPath, elcount(newPath), "%s.%s", oldPath, "vehicleSafetyClockTransmitTimestamp");
  value.vehicleSafetyClockTransmitTimestamp = C2xGetTokenInt64(packetHandle, "MVM", newPath);
  result = CheckLastError("MVM", gkFuncRefGet, result);

  snprintf(newPath, elcount(newPath), "%s.%s", oldPath, "checksum");
  value.checksum = C2xGetTokenInt64(packetHandle, "MVM", newPath);
  result = CheckLastError("MVM", gkFuncRefGet, result);

  return result;
}

int SetMVMSafetyTimeSyncResponseParams(LONG packetHandle, struct MVMSafetyTimeSyncResponse value, char oldPath[])
{
  char newPath[300];
  int result;

  result = 0;

  snprintf(newPath, elcount(newPath), "%s.%s", oldPath, "challenge");
  C2xSetTokenInt(packetHandle, "MVM", newPath, value.challenge);
  result = CheckLastError("MVM", gkFuncRefGet, result);

  snprintf(newPath, elcount(newPath), "%s.%s", oldPath, "vehicleSafetyClockReceiveTimestamp");
  C2xSetTokenInt64(packetHandle, "MVM", newPath, value.vehicleSafetyClockReceiveTimestamp);
  result = CheckLastError("MVM", gkFuncRefGet, result);

  snprintf(newPath, elcount(newPath), "%s.%s", oldPath, "vehicleSafetyClockTransmitTimestamp");
  C2xSetTokenInt64(packetHandle, "MVM", newPath, value.vehicleSafetyClockTransmitTimestamp);
  result = CheckLastError("MVM", gkFuncRefGet, result);

  snprintf(newPath, elcount(newPath), "%s.%s", oldPath, "checksum");
  C2xSetTokenInt64(packetHandle, "MVM", newPath, value.checksum);
  result = CheckLastError("MVM", gkFuncRefGet, result);

  return result;
}

int GetMVMSafeVehicleTypeConfirmationParams(LONG packetHandle, struct MVMSafeVehicleTypeConfirmation value, char oldPath[])
{
  char newPath[300];
  int result;

  result = 0;

  snprintf(newPath, elcount(newPath), "%s.%s", oldPath, "vehicleType");
  value.vehicleType.stringLength = C2xGetTokenData(packetHandle, "MVM", newPath, elcount(value.vehicleType.string), value.vehicleType.string);
  result = CheckLastError("MVM", gkFuncRefGet, result);
  snprintf(newPath, elcount(newPath), "%s.%s", oldPath, "safetyProfile");
  value.safetyProfile.stringLength = C2xGetTokenData(packetHandle, "MVM", newPath, elcount(value.safetyProfile.string), value.safetyProfile.string);
  result = CheckLastError("MVM", gkFuncRefGet, result);
  snprintf(newPath, elcount(newPath), "%s.%s", oldPath, "checksum");
  value.checksum = C2xGetTokenInt64(packetHandle, "MVM", newPath);
  result = CheckLastError("MVM", gkFuncRefGet, result);

  return result;
}

int SetMVMSafeVehicleTypeConfirmationParams(LONG packetHandle, struct MVMSafeVehicleTypeConfirmation value, char oldPath[])
{
  char newPath[300];
  int result;

  result = 0;

  snprintf(newPath, elcount(newPath), "%s.%s", oldPath, "vehicleType");
  C2xSetTokenData(packetHandle, "MVM", newPath, value.vehicleType.stringLength, value.vehicleType.string);
  result = CheckLastError("MVM", gkFuncRefGet, result);

  snprintf(newPath, elcount(newPath), "%s.%s", oldPath, "safetyProfile");
  C2xSetTokenData(packetHandle, "MVM", newPath, value.safetyProfile.stringLength, value.safetyProfile.string);
  result = CheckLastError("MVM", gkFuncRefGet, result);

  snprintf(newPath, elcount(newPath), "%s.%s", oldPath, "checksum");
  C2xSetTokenInt64(packetHandle, "MVM", newPath, value.checksum);
  result = CheckLastError("MVM", gkFuncRefGet, result);

  return result;
}

int GetMVMVehicleErrorParams(LONG packetHandle, struct MVMVehicleError value, char oldPath[])
{
  char newPath[300];
  int result;

  result = 0;

  snprintf(newPath, elcount(newPath), "%s.%s", oldPath, "time");
  value.time = C2xGetTokenInt64(packetHandle, "MVM", newPath);
  result = CheckLastError("MVM", gkFuncRefGet, result);

  snprintf(newPath, elcount(newPath), "%s.%s", oldPath, "vehCode");
  value.vehCode = C2xGetTokenInt(packetHandle, "MVM", newPath);
  result = CheckLastError("MVM", gkFuncRefGet, result);

  snprintf(newPath, elcount(newPath), "%s.%s", oldPath, "customCode");
  value.customCode = C2xGetTokenInt(packetHandle, "MVM", newPath);
  result = CheckLastError("MVM", gkFuncRefGet, result);

  snprintf(newPath, elcount(newPath), "%s.%s", oldPath, "description");
  value.description.isValidFlag = C2xIsTokenAvailable(packetHandle, "MVM", newPath);
  if(value.description.isValidFlag==1)
  {
    value.description.stringLength = C2xGetTokenData(packetHandle, "MVM", newPath, elcount(value.description.string), value.description.string);
    result = CheckLastError("MVM", gkFuncRefGet, result);
  }
  return result;
}

int SetMVMVehicleErrorParams(LONG packetHandle, struct MVMVehicleError value, char oldPath[])
{
  char newPath[300];
  int result;

  result = 0;

  snprintf(newPath, elcount(newPath), "%s.%s", oldPath, "time");
  C2xSetTokenInt64(packetHandle, "MVM", newPath, value.time);
  result = CheckLastError("MVM", gkFuncRefGet, result);

  snprintf(newPath, elcount(newPath), "%s.%s", oldPath, "vehCode");
  C2xSetTokenInt(packetHandle, "MVM", newPath, value.vehCode);
  result = CheckLastError("MVM", gkFuncRefGet, result);

  snprintf(newPath, elcount(newPath), "%s.%s", oldPath, "customCode");
  C2xSetTokenInt(packetHandle, "MVM", newPath, value.customCode);
  result = CheckLastError("MVM", gkFuncRefGet, result);

  snprintf(newPath, elcount(newPath), "%s.%s", oldPath, "description");
  if(value.description.isValidFlag==1)
  {
    C2xSetTokenData(packetHandle, "MVM", newPath, value.description.stringLength, value.description.string);
    result = CheckLastError("MVM", gkFuncRefGet, result);
  }
  else
  {
    if( C2xIsTokenAvailable(packetHandle, "MVM", newPath) )
    {
      C2xRemoveToken(packetHandle, "MVM", newPath);
    }
  }

  return result;
}

int GetMVMSafetyViolationsContainerParams(LONG packetHandle, struct MVMSafetyViolationsContainer value, char oldPath[])
{
  char newPath[300]; 
  int i;
  int result;

  result = 0;

  value.length = C2xGetTokenInt(packetHandle, "MVM", oldPath);
  if((result = CheckLastError("MVM", gkFuncRefGet, result))==0)
  {
    for(i=0; i<value.length; i++)
    {
      snprintf(newPath, elcount(newPath), "%s[%d]", oldPath, i);
      value.arrayValue[i] = C2xGetTokenInt64(packetHandle, "MVM", newPath);
      result = CheckLastError("MVM", gkFuncRefGet, result);
    }
  }
  return result;
}

int SetMVMSafetyViolationsContainerParams(LONG packetHandle, struct MVMSafetyViolationsContainer value, char oldPath[])
{
  char newPath[300]; 
  int i;
  int result;

  result = 0;

  C2xRemoveToken(packetHandle, "MVM", oldPath);
  for(i=0; i<value.length; i++)
  {
    snprintf(newPath, elcount(newPath), "%s[%d]", oldPath, i);
    C2xSetTokenInt64(packetHandle, "MVM", newPath, value.arrayValue[i]);
    result = CheckLastError("MVM", gkFuncRefGet, result);
  }
  return result;
}

int GetMVMVehicleSafetyFeedbackContainerParams(LONG packetHandle, struct MVMVehicleSafetyFeedbackContainer value, char oldPath[])
{
  char newPath[300];
  int result;

  result = 0;

  snprintf(newPath, elcount(newPath), "%s.%s", oldPath, "remainingTimeToStartBraking");
  value.remainingTimeToStartBraking = C2xGetTokenInt(packetHandle, "MVM", newPath);
  result = CheckLastError("MVM", gkFuncRefGet, result);

  snprintf(newPath, elcount(newPath), "%s.%s", oldPath, "safetyViolations");
  GetMVMSafetyViolationsContainerParams(packetHandle, value.safetyViolations, newPath);
  result = CheckLastError("MVM", gkFuncRefGet, result);

  snprintf(newPath, elcount(newPath), "%s.%s", oldPath, "currentVehicleSafetyClockTime");
  value.currentVehicleSafetyClockTime = C2xGetTokenInt64(packetHandle, "MVM", newPath);
  result = CheckLastError("MVM", gkFuncRefGet, result);

  return result;
}

int SetMVMVehicleSafetyFeedbackContainerParams(LONG packetHandle, struct MVMVehicleSafetyFeedbackContainer value, char oldPath[])
{
  char newPath[300];
  int result;

  result = 0;

  snprintf(newPath, elcount(newPath), "%s.%s", oldPath, "remainingTimeToStartBraking");
  C2xSetTokenInt(packetHandle, "MVM", newPath, value.remainingTimeToStartBraking);
  result = CheckLastError("MVM", gkFuncRefGet, result);

  snprintf(newPath, elcount(newPath), "%s.%s", oldPath, "safetyViolations");
  SetMVMSafetyViolationsContainerParams(packetHandle, value.safetyViolations, newPath);
  result = CheckLastError("MVM", gkFuncRefGet, result);

  snprintf(newPath, elcount(newPath), "%s.%s", oldPath, "currentVehicleSafetyClockTime");
  C2xSetTokenInt64(packetHandle, "MVM", newPath, value.currentVehicleSafetyClockTime);
  result = CheckLastError("MVM", gkFuncRefGet, result);

  return result;
}

int GetMVMVehicleSafetyFeedbackParams(LONG packetHandle, struct MVMVehicleSafetyFeedback value, char oldPath[])
{
  char newPath[300]; 
  int i;
  int result;

  result = 0;

  value.length = C2xGetTokenInt(packetHandle, "MVM", oldPath);
  if((result = CheckLastError("MVM", gkFuncRefGet, result))==0)
  {
    for(i=0; i<value.length; i++)
    {
      snprintf(newPath, elcount(newPath), "%s[%d]", oldPath, i);
      GetMVMVehicleSafetyFeedbackContainerParams(packetHandle, value.arrayValue[i], newPath);
      result = CheckLastError("MVM", gkFuncRefGet, result);
    }
  }
  return result;
}

int SetMVMVehicleSafetyFeedbackParams(LONG packetHandle, struct MVMVehicleSafetyFeedback value, char oldPath[])
{
  char newPath[300]; 
  int i;
  int result;

  result = 0;

  C2xRemoveToken(packetHandle, "MVM", oldPath);
  for(i=0; i<value.length; i++)
  {
    snprintf(newPath, elcount(newPath), "%s[%d]", oldPath, i);
    SetMVMVehicleSafetyFeedbackContainerParams(packetHandle, value.arrayValue[i], newPath);
    result = CheckLastError("MVM", gkFuncRefGet, result);
  }
  return result;
}

int GetMVMVehiclePropertiesParams(LONG packetHandle, struct MVMVehicleProperties value, char oldPath[])
{
  char newPath[300];
  int result;

  result = 0;

  snprintf(newPath, elcount(newPath), "%s.%s", oldPath, "basicVehicleClass");
  value.basicVehicleClass = C2xGetTokenInt(packetHandle, "MVM", newPath);
  result = CheckLastError("MVM", gkFuncRefGet, result);

  snprintf(newPath, elcount(newPath), "%s.%s", oldPath, "vehicleLength");
  value.vehicleLength = C2xGetTokenInt(packetHandle, "MVM", newPath);
  result = CheckLastError("MVM", gkFuncRefGet, result);

  snprintf(newPath, elcount(newPath), "%s.%s", oldPath, "vehicleWheelbase");
  value.vehicleWheelbase = C2xGetTokenInt(packetHandle, "MVM", newPath);
  result = CheckLastError("MVM", gkFuncRefGet, result);

  snprintf(newPath, elcount(newPath), "%s.%s", oldPath, "vehicleRearOverhang");
  value.vehicleRearOverhang = C2xGetTokenInt(packetHandle, "MVM", newPath);
  result = CheckLastError("MVM", gkFuncRefGet, result);

  snprintf(newPath, elcount(newPath), "%s.%s", oldPath, "vehicleWidth");
  value.vehicleWidth = C2xGetTokenInt(packetHandle, "MVM", newPath);
  result = CheckLastError("MVM", gkFuncRefGet, result);

  snprintf(newPath, elcount(newPath), "%s.%s", oldPath, "vehicleTireWidth");
  value.vehicleTireWidth = C2xGetTokenInt(packetHandle, "MVM", newPath);
  result = CheckLastError("MVM", gkFuncRefGet, result);

  snprintf(newPath, elcount(newPath), "%s.%s", oldPath, "vehicleTrackWidth");
  value.vehicleTrackWidth = C2xGetTokenInt(packetHandle, "MVM", newPath);
  result = CheckLastError("MVM", gkFuncRefGet, result);

  snprintf(newPath, elcount(newPath), "%s.%s", oldPath, "vehicleMass");
  value.vehicleMass = C2xGetTokenInt(packetHandle, "MVM", newPath);
  result = CheckLastError("MVM", gkFuncRefGet, result);

  snprintf(newPath, elcount(newPath), "%s.%s", oldPath, "vehicleSpeedLimit");
  value.vehicleSpeedLimit = C2xGetTokenInt(packetHandle, "MVM", newPath);
  result = CheckLastError("MVM", gkFuncRefGet, result);

  snprintf(newPath, elcount(newPath), "%s.%s", oldPath, "vehicleCuvatureLimit");
  value.vehicleCuvatureLimit = C2xGetTokenInt(packetHandle, "MVM", newPath);
  result = CheckLastError("MVM", gkFuncRefGet, result);

  snprintf(newPath, elcount(newPath), "%s.%s", oldPath, "vehicleMaxAngularSteeringRate");
  value.vehicleMaxAngularSteeringRate = C2xGetTokenInt(packetHandle, "MVM", newPath);
  result = CheckLastError("MVM", gkFuncRefGet, result);

  return result;
}

int SetMVMVehiclePropertiesParams(LONG packetHandle, struct MVMVehicleProperties value, char oldPath[])
{
  char newPath[300];
  int result;

  result = 0;

  snprintf(newPath, elcount(newPath), "%s.%s", oldPath, "basicVehicleClass");
  C2xSetTokenInt(packetHandle, "MVM", newPath, value.basicVehicleClass);
  result = CheckLastError("MVM", gkFuncRefGet, result);

  snprintf(newPath, elcount(newPath), "%s.%s", oldPath, "vehicleLength");
  C2xSetTokenInt(packetHandle, "MVM", newPath, value.vehicleLength);
  result = CheckLastError("MVM", gkFuncRefGet, result);

  snprintf(newPath, elcount(newPath), "%s.%s", oldPath, "vehicleWheelbase");
  C2xSetTokenInt(packetHandle, "MVM", newPath, value.vehicleWheelbase);
  result = CheckLastError("MVM", gkFuncRefGet, result);

  snprintf(newPath, elcount(newPath), "%s.%s", oldPath, "vehicleRearOverhang");
  C2xSetTokenInt(packetHandle, "MVM", newPath, value.vehicleRearOverhang);
  result = CheckLastError("MVM", gkFuncRefGet, result);

  snprintf(newPath, elcount(newPath), "%s.%s", oldPath, "vehicleWidth");
  C2xSetTokenInt(packetHandle, "MVM", newPath, value.vehicleWidth);
  result = CheckLastError("MVM", gkFuncRefGet, result);

  snprintf(newPath, elcount(newPath), "%s.%s", oldPath, "vehicleTireWidth");
  C2xSetTokenInt(packetHandle, "MVM", newPath, value.vehicleTireWidth);
  result = CheckLastError("MVM", gkFuncRefGet, result);

  snprintf(newPath, elcount(newPath), "%s.%s", oldPath, "vehicleTrackWidth");
  C2xSetTokenInt(packetHandle, "MVM", newPath, value.vehicleTrackWidth);
  result = CheckLastError("MVM", gkFuncRefGet, result);

  snprintf(newPath, elcount(newPath), "%s.%s", oldPath, "vehicleMass");
  if (value.vehicleMass < 1)
  {
    C2xSetTokenInt(packetHandle, "MVM", newPath, 1);
  }
  else if (value.vehicleMass > 1024)
  {
    C2xSetTokenInt(packetHandle, "MVM", newPath, 1024);
  }
  else
  {
    C2xSetTokenInt(packetHandle, "MVM", newPath, value.vehicleMass);
  }
  result = CheckLastError("MVM", gkFuncRefGet, result);

  snprintf(newPath, elcount(newPath), "%s.%s", oldPath, "vehicleSpeedLimit");
  C2xSetTokenInt(packetHandle, "MVM", newPath, value.vehicleSpeedLimit);
  result = CheckLastError("MVM", gkFuncRefGet, result);

  snprintf(newPath, elcount(newPath), "%s.%s", oldPath, "vehicleCuvatureLimit");
  C2xSetTokenInt(packetHandle, "MVM", newPath, value.vehicleCuvatureLimit);
  result = CheckLastError("MVM", gkFuncRefGet, result);

  snprintf(newPath, elcount(newPath), "%s.%s", oldPath, "vehicleMaxAngularSteeringRate");
  C2xSetTokenInt(packetHandle, "MVM", newPath, value.vehicleMaxAngularSteeringRate);
  result = CheckLastError("MVM", gkFuncRefGet, result);

  return result;
}

int GetMVMMvmParams(LONG packetHandle, struct MVMMvm value, char oldPath[])
{
  char newPath[300];
  int result;

  result = 0;

  snprintf(newPath, elcount(newPath), "%s.%s", oldPath, "mvmDataControlField");
  value.mvmDataControlField.isValidFlag = C2xIsTokenAvailable(packetHandle, "MVM", newPath);
  if(value.mvmDataControlField.isValidFlag==1)
  {
    GetMVMMVMDataControlFieldParams(packetHandle, value.mvmDataControlField, newPath);
    result = CheckLastError("MVM", gkFuncRefGet, result);
  }
  snprintf(newPath, elcount(newPath), "%s.%s", oldPath, "systemManagementData");
  value.systemManagementData.isValidFlag = C2xIsTokenAvailable(packetHandle, "MVM", newPath);
  if(value.systemManagementData.isValidFlag==1)
  {
    GetMVMSystemManagementDataParams(packetHandle, value.systemManagementData, newPath);
    result = CheckLastError("MVM", gkFuncRefGet, result);
  }
  snprintf(newPath, elcount(newPath), "%s.%s", oldPath, "vehicleState");
  value.vehicleState.isValidFlag = C2xIsTokenAvailable(packetHandle, "MVM", newPath);
  if(value.vehicleState.isValidFlag==1)
  {
    GetMVMVehicleStateParams(packetHandle, value.vehicleState, newPath);
    result = CheckLastError("MVM", gkFuncRefGet, result);
  }
  snprintf(newPath, elcount(newPath), "%s.%s", oldPath, "vidResponse");
  value.vidResponse.isValidFlag = C2xIsTokenAvailable(packetHandle, "MVM", newPath);
  if(value.vidResponse.isValidFlag==1)
  {
    GetMVMVidResponseParams(packetHandle, value.vidResponse, newPath);
    result = CheckLastError("MVM", gkFuncRefGet, result);
  }
  snprintf(newPath, elcount(newPath), "%s.%s", oldPath, "safetyTimeSyncResponse");
  value.safetyTimeSyncResponse.isValidFlag = C2xIsTokenAvailable(packetHandle, "MVM", newPath);
  if(value.safetyTimeSyncResponse.isValidFlag==1)
  {
    GetMVMSafetyTimeSyncResponseParams(packetHandle, value.safetyTimeSyncResponse, newPath);
    result = CheckLastError("MVM", gkFuncRefGet, result);
  }
  snprintf(newPath, elcount(newPath), "%s.%s", oldPath, "safeVehicleTypeConfirmation");
  value.safeVehicleTypeConfirmation.isValidFlag = C2xIsTokenAvailable(packetHandle, "MVM", newPath);
  if(value.safeVehicleTypeConfirmation.isValidFlag==1)
  {
    GetMVMSafeVehicleTypeConfirmationParams(packetHandle, value.safeVehicleTypeConfirmation, newPath);
    result = CheckLastError("MVM", gkFuncRefGet, result);
  }
  snprintf(newPath, elcount(newPath), "%s.%s", oldPath, "vehicleError");
  value.vehicleError.isValidFlag = C2xIsTokenAvailable(packetHandle, "MVM", newPath);
  if(value.vehicleError.isValidFlag==1)
  {
    GetMVMVehicleErrorParams(packetHandle, value.vehicleError, newPath);
    result = CheckLastError("MVM", gkFuncRefGet, result);
  }
  snprintf(newPath, elcount(newPath), "%s.%s", oldPath, "vehicleSafetyFeedback");
  value.vehicleSafetyFeedback.isValidFlag = C2xIsTokenAvailable(packetHandle, "MVM", newPath);
  if(value.vehicleSafetyFeedback.isValidFlag==1)
  {
    GetMVMVehicleSafetyFeedbackParams(packetHandle, value.vehicleSafetyFeedback, newPath);
    result = CheckLastError("MVM", gkFuncRefGet, result);
  }
  snprintf(newPath, elcount(newPath), "%s.%s", oldPath, "vehicleProperties");
  value.vehicleProperties.isValidFlag = C2xIsTokenAvailable(packetHandle, "MVM", newPath);
  if(value.vehicleProperties.isValidFlag==1)
  {
    GetMVMVehiclePropertiesParams(packetHandle, value.vehicleProperties, newPath);
    result = CheckLastError("MVM", gkFuncRefGet, result);
  }
  return result;
}

int SetMVMMvmParams(LONG packetHandle, struct MVMMvm value, char oldPath[])
{
  char newPath[300];
  int result;

  result = 0;

  snprintf(newPath, elcount(newPath), "%s.%s", oldPath, "mvmDataControlField");
  if(value.mvmDataControlField.isValidFlag==1)
  {
    SetMVMMVMDataControlFieldParams(packetHandle, value.mvmDataControlField, newPath);
    result = CheckLastError("MVM", gkFuncRefGet, result);
  }
  else
  {
    if( C2xIsTokenAvailable(packetHandle, "MVM", newPath) )
    {
      C2xRemoveToken(packetHandle, "MVM", newPath);
    }
  }

  snprintf(newPath, elcount(newPath), "%s.%s", oldPath, "systemManagementData");
  if(value.systemManagementData.isValidFlag==1)
  {
    SetMVMSystemManagementDataParams(packetHandle, value.systemManagementData, newPath);
    result = CheckLastError("MVM", gkFuncRefGet, result);
  }
  else
  {
    if( C2xIsTokenAvailable(packetHandle, "MVM", newPath) )
    {
      C2xRemoveToken(packetHandle, "MVM", newPath);
    }
  }

  snprintf(newPath, elcount(newPath), "%s.%s", oldPath, "vehicleState");
  if(value.vehicleState.isValidFlag==1)
  {
    SetMVMVehicleStateParams(packetHandle, value.vehicleState, newPath);
    result = CheckLastError("MVM", gkFuncRefGet, result);
  }
  else
  {
    if( C2xIsTokenAvailable(packetHandle, "MVM", newPath) )
    {
      C2xRemoveToken(packetHandle, "MVM", newPath);
    }
  }

  snprintf(newPath, elcount(newPath), "%s.%s", oldPath, "vidResponse");
  if(value.vidResponse.isValidFlag==1)
  {
    SetMVMVidResponseParams(packetHandle, value.vidResponse, newPath);
    result = CheckLastError("MVM", gkFuncRefGet, result);
  }
  else
  {
    if( C2xIsTokenAvailable(packetHandle, "MVM", newPath) )
    {
      C2xRemoveToken(packetHandle, "MVM", newPath);
    }
  }

  snprintf(newPath, elcount(newPath), "%s.%s", oldPath, "safetyTimeSyncResponse");
  if(value.safetyTimeSyncResponse.isValidFlag==1)
  {
    SetMVMSafetyTimeSyncResponseParams(packetHandle, value.safetyTimeSyncResponse, newPath);
    result = CheckLastError("MVM", gkFuncRefGet, result);
  }
  else
  {
    if( C2xIsTokenAvailable(packetHandle, "MVM", newPath) )
    {
      C2xRemoveToken(packetHandle, "MVM", newPath);
    }
  }

  snprintf(newPath, elcount(newPath), "%s.%s", oldPath, "safeVehicleTypeConfirmation");
  if(value.safeVehicleTypeConfirmation.isValidFlag==1)
  {
    SetMVMSafeVehicleTypeConfirmationParams(packetHandle, value.safeVehicleTypeConfirmation, newPath);
    result = CheckLastError("MVM", gkFuncRefGet, result);
  }
  else
  {
    if( C2xIsTokenAvailable(packetHandle, "MVM", newPath) )
    {
      C2xRemoveToken(packetHandle, "MVM", newPath);
    }
  }

  snprintf(newPath, elcount(newPath), "%s.%s", oldPath, "vehicleError");
  if(value.vehicleError.isValidFlag==1)
  {
    SetMVMVehicleErrorParams(packetHandle, value.vehicleError, newPath);
    result = CheckLastError("MVM", gkFuncRefGet, result);
  }
  else
  {
    if( C2xIsTokenAvailable(packetHandle, "MVM", newPath) )
    {
      C2xRemoveToken(packetHandle, "MVM", newPath);
    }
  }

  snprintf(newPath, elcount(newPath), "%s.%s", oldPath, "vehicleSafetyFeedback");
  if(value.vehicleSafetyFeedback.isValidFlag==1)
  {
    SetMVMVehicleSafetyFeedbackParams(packetHandle, value.vehicleSafetyFeedback, newPath);
    result = CheckLastError("MVM", gkFuncRefGet, result);
  }
  else
  {
    if( C2xIsTokenAvailable(packetHandle, "MVM", newPath) )
    {
      C2xRemoveToken(packetHandle, "MVM", newPath);
    }
  }

  snprintf(newPath, elcount(newPath), "%s.%s", oldPath, "vehicleProperties");
  if(value.vehicleProperties.isValidFlag==1)
  {
    SetMVMVehiclePropertiesParams(packetHandle, value.vehicleProperties, newPath);
    result = CheckLastError("MVM", gkFuncRefGet, result);
  }
  else
  {
    if( C2xIsTokenAvailable(packetHandle, "MVM", newPath) )
    {
      C2xRemoveToken(packetHandle, "MVM", newPath);
    }
  }

  return result;
}

int API_GetMVMParams(LONG packetHandle, struct MVM value)
{
  int result;
  result = 0;

  value.header.isValidFlag = 1;
  GetMVMItsPduHeaderParams(packetHandle, value.header, "header");
  result = CheckLastError("MVM", gkFuncRefGet, result);

  value.e2eProtection.isValidFlag = 1;
  GetMVMAvmE2EProtectionParams(packetHandle, value.e2eProtection, "e2eProtection");
  result = CheckLastError("MVM", gkFuncRefGet, result);

  value.mvm.isValidFlag = 1;
  GetMVMMvmParams(packetHandle, value.mvm, "mvm");
  result = CheckLastError("MVM", gkFuncRefGet, result);

  return result;
}

int API_SetMVMParams(LONG packetHandle, struct MVM value)
{
  int result;
  result = 0;

  SetMVMItsPduHeaderParams(packetHandle, value.header, "header");
  result = CheckLastError("MVM", gkFuncRefGet, result);

  SetMVMAvmE2EProtectionParams(packetHandle, value.e2eProtection, "e2eProtection");
  result = CheckLastError("MVM", gkFuncRefGet, result);

  SetMVMMvmParams(packetHandle, value.mvm, "mvm");
  result = CheckLastError("MVM", gkFuncRefGet, result);

  return result;
}

