/*@!Encoding:1252*/
/*
//  (c) Vector Informatik GmbH. All rights reserved.
//
//  This file contains definitions of structs and methods that may be used
//  to set and get the values of an ASN.1 defined packet's payload.
//
//  //This example demonstrates how to set a packet's payload:
//  LONG packetHandle;
//  struct MIM payload;
//  //you need to set the values of the variable "payload" yourself
//  packetHandle = API_InitMIMPacket();
//  if (packetHandle!=0) {
//    if (API_SetMIMParams(packetHandle, payload)==0) {
//      if (C2xCompletePacket(packetHandle)==0) {
//        C2xOutputPacket(packetHandle);
//      }
//    }
//  }
//                                                                             */
includes
{
 
}
variables
{
    struct MIMItsPduHeader {
        INT isValidFlag;   // necessary if this struct is used as an optional field of a SEQUENCE
        BYTE protocolVersion;  // INTEGER, 0..255;
        BYTE messageID;  // INTEGER, 0..255, denm(1), cam(2), poim(3), spatem(4), mapem(5), ivim(6), rfu1(7), rfu2(8), srem(9), ssem(10), evcsn(11), saem(12), rtcmem(13), cpm(14), imzm(15), vam(16), dsm(17), mim(18), mvm(19), mcm(20);
        DWORD stationID;  // INTEGER, 0..4294967295;
    };
    
    struct MIMAvmE2EProtection {
        INT isValidFlag;   // necessary if this struct is used as an optional field of a SEQUENCE
        WORD length;  // INTEGER, 0..65535;
        WORD rollingCounter;  // INTEGER, 0..65535;
        DWORD dataID;  // INTEGER, 0..4294967295;
        DWORD crc32;  // INTEGER, 0..4294967295;
    };
    
    struct MIMMIMDataControlField_rollingCounterFromMvm {
        INT isValidFlag;   // necessary if this struct is used as an optional field of a SEQUENCE
        INT length;
        WORD arrayValue[10];  // INTEGER, 0..65535;
    };
    
    struct MIMMIMDataControlField {
        INT isValidFlag;   // necessary if this struct is used as an optional field of a SEQUENCE
        struct OPT_DWORD_ASN checksum;  // INTEGER, OPTIONAL, 0..4294967295;
        struct OPT_QWORD_ASN mimGenerationTime;  // INTEGER, OPTIONAL, 0..4398046511103;
        struct MIMMIMDataControlField_rollingCounterFromMvm rollingCounterFromMvm;  // SEQUENCEOF;
        struct OPT_WORD_ASN proprietaryExtensionField;  // INTEGER, OPTIONAL, 0..65535;
    };
    
    struct MIMSessionMissionID {
        INT isValidFlag;   // necessary if this struct is used as an optional field of a SEQUENCE
        CHAR string[33];
        INT  stringLength;
    };
    
    struct MIMVehicleID {
        INT isValidFlag;   // necessary if this struct is used as an optional field of a SEQUENCE
        CHAR string[18];
        INT  stringLength;
    };
    
    struct MIMFacilityID {
        INT isValidFlag;   // necessary if this struct is used as an optional field of a SEQUENCE
        CHAR string[33];
        INT  stringLength;
    };
    
    struct MIMSystemManagementData {
        INT isValidFlag;   // necessary if this struct is used as an optional field of a SEQUENCE
        struct MIMSessionMissionID sessionID;  // IA5STRING, OPTIONAL;
        struct MIMSessionMissionID missionID;  // IA5STRING, OPTIONAL;
        struct MIMVehicleID vehicleID;  // IA5STRING, OPTIONAL;
        struct MIMFacilityID facilityID;  // IA5STRING, OPTIONAL;
    };
    
    struct MIMBlinking {
        INT isValidFlag;   // necessary if this struct is used as an optional field of a SEQUENCE
        QWORD vidRoPublicKey;  // INTEGER, 0..18446744073709551615;
        BYTE codeLength;  // INTEGER, 0..255;
        INT blinkingCommand;  // ENUMERATED, generateNewCode(0), generateNewCodeAndPrepareForFlashing(1), flashing(2), successful(3);
    };
    
    struct MIMVidRequest {
        INT isValidFlag;   // necessary if this struct is used as an optional field of a SEQUENCE
        INT choice;
        struct MIMBlinking blinking;  // SEQUENCE;
    };
    
    struct MIMDrivingPermission {
        INT isValidFlag;   // necessary if this struct is used as an optional field of a SEQUENCE
        QWORD expirationTime;  // INTEGER, 0..4398046511103;
        INT velocityMax;  // INTEGER, -16383..16383, negativeOutOfRange(-16383), positiveOutOfRange(16382), unavailable(16383);
        INT curvatureMin;  // INTEGER, -32768..32767, outOfRangeNegative(-32767), straight(0), outOfRangePositive(32767), unavailable(-32768);
        INT curvatureMax;  // INTEGER, -32768..32767, outOfRangeNegative(-32767), straight(0), outOfRangePositive(32767), unavailable(-32768);
        DWORD checksum;  // INTEGER, 0..4294967295;
    };
    
    struct MIMSafetyTimeSyncRequest {
        INT isValidFlag;   // necessary if this struct is used as an optional field of a SEQUENCE
        WORD challenge;  // INTEGER, 0..65535;
        DWORD checksum;  // INTEGER, 0..4294967295;
    };
    
    struct MIMDriveCommand {
        INT isValidFlag;   // necessary if this struct is used as an optional field of a SEQUENCE
        INT driveCommandAction;  // ENUMERATED, sleep(0), initialize(1), wait(2), drive(3), terminate(4);
        INT terminateReason;  // ENUMERATED, proceed(0), destinationReached(1), infrastructureError(2), vehicleError(3), backend(4), vehicleIdentificationError(5);
        struct OPT_ENUM_ASN gearRequest;  // ENUMERATED, OPTIONAL, park(0), backwards(1), neutral(2), forwards(3), unknown(4);
        struct OPT_ENUM_ASN directionIndicatorRequest;  // ENUMERATED, OPTIONAL, off(0), right(1), left(2), both(3), unknown(4);
        struct OPT_ENUM_ASN parkingBrakeRequest;  // ENUMERATED, OPTIONAL, disengage(0), engage(1);
        struct OPT_ENUM_ASN motorSystemRequest;  // ENUMERATED, OPTIONAL, off(0), on(1), unknown(2);
        struct OPT_ENUM_ASN emergencyStopRequest;  // ENUMERATED, OPTIONAL, inactive(0), precharge(1), active(2), tempError(3), suspend(4);
        struct OPT_ENUM_ASN interlockRequest;  // ENUMERATED, OPTIONAL, none(0), zonalInterlock(1), globalStop(2);
        struct OPT_ENUM_ASN hornRequest;  // ENUMERATED, OPTIONAL, none(0), singleHorn(1), doubleHorn(2), holdHorn(3);
    };
    
    struct MIMPose {
        INT isValidFlag;   // necessary if this struct is used as an optional field of a SEQUENCE
        LONG x;  // INTEGER, -524288..524287, negativeOutOfRange(-524287), positiveOutOfRange(524287), unavailable(-524288);
        LONG y;  // INTEGER, -524288..524287, negativeOutOfRange(-524287), positiveOutOfRange(524287), unavailable(-524288);
        WORD psi;  // INTEGER, 0..62833, xDirection(0), outOfRange(62832), unavailable(62833);
    };
    
    struct MIMDetectedVehiclePose {
        INT isValidFlag;   // necessary if this struct is used as an optional field of a SEQUENCE
        struct MIMPose detectedPose;  // SEQUENCE;
        QWORD poseMeasurementTime;  // INTEGER, 0..4398046511103;
    };
    
    struct MIMWayPoint {
        INT isValidFlag;   // necessary if this struct is used as an optional field of a SEQUENCE
        struct OPT_WORD_ASN index;  // INTEGER, OPTIONAL, 0..65535;
        struct MIMPose wayPointPose;  // SEQUENCE;
        INT velocity;  // INTEGER, -16383..16383, negativeOutOfRange(-16383), positiveOutOfRange(16382), unavailable(16383);
        INT curvature;  // INTEGER, -32768..32767, outOfRangeNegative(-32767), straight(0), outOfRangePositive(32767), unavailable(-32768);
        struct OPT_WORD_ASN pitchAngle;  // INTEGER, OPTIONAL, 0..3601, valueNotUsed(3600), unavailable(3601);
    };
    
    struct MIMPathSnippet {
        INT isValidFlag;   // necessary if this struct is used as an optional field of a SEQUENCE
        INT length;
        struct MIMWayPoint arrayValue[200];  // SEQUENCE;
    };
    
    struct MIMPathControl {
        INT isValidFlag;   // necessary if this struct is used as an optional field of a SEQUENCE
        struct MIMPathSnippet pathSnippet;  // SEQUENCEOF, OPTIONAL;
        LONG clearedDistanceOnPath;  // INTEGER, -524288..524287, negativeOutOfRange(-524287), positiveOutOfRange(524287), unavailable(-524288);
        struct OPT_INT_ASN situationalVelocityLimit;  // INTEGER, OPTIONAL, -16383..16383, negativeOutOfRange(-16383), positiveOutOfRange(16382), unavailable(16383);
    };
    
    struct MIMControlVelocity {
        INT isValidFlag;   // necessary if this struct is used as an optional field of a SEQUENCE
        INT velocity;  // INTEGER, -16383..16383, negativeOutOfRange(-16383), positiveOutOfRange(16382), unavailable(16383);
        struct OPT_LONG_ASN distanceToStop;  // INTEGER, OPTIONAL, -524288..524287, negativeOutOfRange(-524287), positiveOutOfRange(524287), unavailable(-524288);
    };
    
    struct MIMControlParameter {
        INT isValidFlag;   // necessary if this struct is used as an optional field of a SEQUENCE
        INT choice;
        INT controlAcceleration;  // INTEGER, -160..161, negativeOutOfRange(-160), positiveOutOfRange(160), unavailable(161);
        struct MIMControlVelocity controlVelocity;  // SEQUENCE;
    };
    
    struct MIMControlPoint {
        INT isValidFlag;   // necessary if this struct is used as an optional field of a SEQUENCE
        INT curvature;  // INTEGER, -32768..32767, outOfRangeNegative(-32767), straight(0), outOfRangePositive(32767), unavailable(-32768);
        struct MIMControlParameter controlParameter;  // CHOICE;
    };
    
    struct MIMControlTrajectory {
        INT isValidFlag;   // necessary if this struct is used as an optional field of a SEQUENCE
        INT length;
        struct MIMControlPoint arrayValue[50];  // SEQUENCE;
    };
    
    struct MIMStatePoint {
        INT isValidFlag;   // necessary if this struct is used as an optional field of a SEQUENCE
        struct MIMPose statePose;  // SEQUENCE;
        INT velocity;  // INTEGER, -16383..16383, negativeOutOfRange(-16383), positiveOutOfRange(16382), unavailable(16383);
    };
    
    struct MIMStateTrajectory {
        INT isValidFlag;   // necessary if this struct is used as an optional field of a SEQUENCE
        INT length;
        struct MIMStatePoint arrayValue[50];  // SEQUENCE;
    };
    
    struct MIMTrajectoryControl {
        INT isValidFlag;   // necessary if this struct is used as an optional field of a SEQUENCE
        QWORD timeReference;  // INTEGER, 0..4398046511103;
        struct OPT_ENUM_ASN driveDirection;  // ENUMERATED, OPTIONAL, forwards(0), backwards(1);
        struct MIMControlTrajectory controlTrajectory;  // SEQUENCEOF;
        struct MIMStateTrajectory stateTrajectory;  // SEQUENCEOF, OPTIONAL;
    };
    
    struct MIMControlInterface {
        INT isValidFlag;   // necessary if this struct is used as an optional field of a SEQUENCE
        INT choice;
        struct MIMPathControl pathControl;  // SEQUENCE;
        struct MIMTrajectoryControl trajectoryControl;  // SEQUENCE;
    };
    
    struct MIMMim {
        INT isValidFlag;   // necessary if this struct is used as an optional field of a SEQUENCE
        struct MIMMIMDataControlField mimDataControlField;  // SEQUENCE, OPTIONAL;
        struct MIMSystemManagementData systemManagementData;  // SEQUENCE, OPTIONAL;
        struct MIMVidRequest vehicleIdentification;  // CHOICE, OPTIONAL;
        struct MIMDrivingPermission drivingPermission;  // SEQUENCE, OPTIONAL;
        struct MIMSafetyTimeSyncRequest safetyTimeSyncRequest;  // SEQUENCE, OPTIONAL;
        struct MIMDriveCommand driveCommand;  // SEQUENCE, OPTIONAL;
        struct MIMDetectedVehiclePose detectedVehiclePose;  // SEQUENCE, OPTIONAL;
        struct MIMControlInterface controlInterface;  // CHOICE, OPTIONAL;
    };
    
    struct MIMMIM_mims {
        INT isValidFlag;   // necessary if this struct is used as an optional field of a SEQUENCE
        INT length;
        struct MIMMim arrayValue[32];  // SEQUENCE;
    };
    
    struct MIM {
        INT isValidFlag;   // necessary if this struct is used as an optional field of a SEQUENCE
        struct MIMItsPduHeader header;  // SEQUENCE;
        struct MIMAvmE2EProtection e2eProtection;  // SEQUENCE;
        struct MIMMIM_mims mims;  // SEQUENCEOF;
    };
    
}

/*
// init function to create a simple packet handle
*/ 
LONG API_InitMIMPacket()
{
  return C2xInitPacket("MIM"); 
}

/*
// init function to create a simple packet handle and
// initialize the struct with valid data
*/ 
LONG API_InitMIMPacket(struct MIM msgStruct)
{
  long pktHandle;

  pktHandle = API_InitMIMPacket();

  if (pktHandle != 0)
  {
    // create valid message and application data
    if (C2xCompletePacket(pktHandle) == 0) 
    {
      API_GetMIMParams(pktHandle, msgStruct);
    }
  }
  return pktHandle;
}

/*
// init function to create a packet with security layer and
// initialize the struct with valid data
*/ 
LONG API_InitMIMPacket(struct MIM msgStruct, char packetTypeDesignator[], char certificateName[])
{
  long pktHandle, certHdl;

  // initialize the packet
  pktHandle = C2xInitPacket("MIM", packetTypeDesignator);

  if (pktHandle != 0)
  {
    certHdl = C2xSecCertificateGetHandle(certificateName);  // get the certificate handle for the cert with name "certificateName"
    if (certHdl != 0) 
    {
      C2xSecPacketSetSignerHandle(pktHandle, certHdl); // set the certHdl to the packet
    }

    // create valid message and application data
    if (C2xCompletePacket(pktHandle) == 0) 
    {
      // copy application data to the application structure
      API_GetMIMParams(pktHandle, msgStruct);
    }
  }
  return pktHandle;
}
    

int GetMIMItsPduHeaderParams(LONG packetHandle, struct MIMItsPduHeader value, char oldPath[])
{
  char newPath[300];
  int result;

  result = 0;

  snprintf(newPath, elcount(newPath), "%s.%s", oldPath, "protocolVersion");
  value.protocolVersion = C2xGetTokenInt(packetHandle, "MIM", newPath);
  result = CheckLastError("MIM", gkFuncRefGet, result);

  snprintf(newPath, elcount(newPath), "%s.%s", oldPath, "messageID");
  value.messageID = C2xGetTokenInt(packetHandle, "MIM", newPath);
  result = CheckLastError("MIM", gkFuncRefGet, result);

  snprintf(newPath, elcount(newPath), "%s.%s", oldPath, "stationID");
  value.stationID = C2xGetTokenInt64(packetHandle, "MIM", newPath);
  result = CheckLastError("MIM", gkFuncRefGet, result);

  return result;
}

int SetMIMItsPduHeaderParams(LONG packetHandle, struct MIMItsPduHeader value, char oldPath[])
{
  char newPath[300];
  int result;

  result = 0;

  snprintf(newPath, elcount(newPath), "%s.%s", oldPath, "protocolVersion");
  C2xSetTokenInt(packetHandle, "MIM", newPath, value.protocolVersion);
  result = CheckLastError("MIM", gkFuncRefGet, result);

  snprintf(newPath, elcount(newPath), "%s.%s", oldPath, "messageID");
  C2xSetTokenInt(packetHandle, "MIM", newPath, value.messageID);
  result = CheckLastError("MIM", gkFuncRefGet, result);

  snprintf(newPath, elcount(newPath), "%s.%s", oldPath, "stationID");
  C2xSetTokenInt64(packetHandle, "MIM", newPath, value.stationID);
  result = CheckLastError("MIM", gkFuncRefGet, result);

  return result;
}

int GetMIMAvmE2EProtectionParams(LONG packetHandle, struct MIMAvmE2EProtection value, char oldPath[])
{
  char newPath[300];
  int result;

  result = 0;

  snprintf(newPath, elcount(newPath), "%s.%s", oldPath, "length");
  value.length = C2xGetTokenInt(packetHandle, "MIM", newPath);
  result = CheckLastError("MIM", gkFuncRefGet, result);

  snprintf(newPath, elcount(newPath), "%s.%s", oldPath, "rollingCounter");
  value.rollingCounter = C2xGetTokenInt(packetHandle, "MIM", newPath);
  result = CheckLastError("MIM", gkFuncRefGet, result);

  snprintf(newPath, elcount(newPath), "%s.%s", oldPath, "dataID");
  value.dataID = C2xGetTokenInt64(packetHandle, "MIM", newPath);
  result = CheckLastError("MIM", gkFuncRefGet, result);

  snprintf(newPath, elcount(newPath), "%s.%s", oldPath, "crc32");
  value.crc32 = C2xGetTokenInt64(packetHandle, "MIM", newPath);
  result = CheckLastError("MIM", gkFuncRefGet, result);

  return result;
}

int SetMIMAvmE2EProtectionParams(LONG packetHandle, struct MIMAvmE2EProtection value, char oldPath[])
{
  char newPath[300];
  int result;

  result = 0;

  snprintf(newPath, elcount(newPath), "%s.%s", oldPath, "length");
  C2xSetTokenInt(packetHandle, "MIM", newPath, value.length);
  result = CheckLastError("MIM", gkFuncRefGet, result);

  snprintf(newPath, elcount(newPath), "%s.%s", oldPath, "rollingCounter");
  C2xSetTokenInt(packetHandle, "MIM", newPath, value.rollingCounter);
  result = CheckLastError("MIM", gkFuncRefGet, result);

  snprintf(newPath, elcount(newPath), "%s.%s", oldPath, "dataID");
  C2xSetTokenInt64(packetHandle, "MIM", newPath, value.dataID);
  result = CheckLastError("MIM", gkFuncRefGet, result);

  snprintf(newPath, elcount(newPath), "%s.%s", oldPath, "crc32");
  C2xSetTokenInt64(packetHandle, "MIM", newPath, value.crc32);
  result = CheckLastError("MIM", gkFuncRefGet, result);

  return result;
}

int GetMIMMIMDataControlField_rollingCounterFromMvmParams(LONG packetHandle, struct MIMMIMDataControlField_rollingCounterFromMvm value, char oldPath[])
{
  char newPath[300]; 
  int i;
  int result;

  result = 0;

  value.length = C2xGetTokenInt(packetHandle, "MIM", oldPath);
  if((result = CheckLastError("MIM", gkFuncRefGet, result))==0)
  {
    for(i=0; i<value.length; i++)
    {
      snprintf(newPath, elcount(newPath), "%s[%d]", oldPath, i);
      value.arrayValue[i] = C2xGetTokenInt64(packetHandle, "MIM", newPath);
      result = CheckLastError("MIM", gkFuncRefGet, result);
    }
  }
  return result;
}

int SetMIMMIMDataControlField_rollingCounterFromMvmParams(LONG packetHandle, struct MIMMIMDataControlField_rollingCounterFromMvm value, char oldPath[])
{
  char newPath[300]; 
  int i;
  int result;

  result = 0;

  C2xRemoveToken(packetHandle, "MIM", oldPath);
  for(i=0; i<value.length; i++)
  {
    snprintf(newPath, elcount(newPath), "%s[%d]", oldPath, i);
    C2xSetTokenInt64(packetHandle, "MIM", newPath, value.arrayValue[i]);
    result = CheckLastError("MIM", gkFuncRefGet, result);
  }
  return result;
}

int GetMIMMIMDataControlFieldParams(LONG packetHandle, struct MIMMIMDataControlField value, char oldPath[])
{
  char newPath[300];
  int result;

  result = 0;

  snprintf(newPath, elcount(newPath), "%s.%s", oldPath, "checksum");
  value.checksum.isValidFlag = C2xIsTokenAvailable(packetHandle, "MIM", newPath);
  if(value.checksum.isValidFlag==1)
  {
    value.checksum.value = C2xGetTokenInt64(packetHandle, "MIM", newPath);
    result = CheckLastError("MIM", gkFuncRefGet, result);
  }
  snprintf(newPath, elcount(newPath), "%s.%s", oldPath, "mimGenerationTime");
  value.mimGenerationTime.isValidFlag = C2xIsTokenAvailable(packetHandle, "MIM", newPath);
  if(value.mimGenerationTime.isValidFlag==1)
  {
    value.mimGenerationTime.value = C2xGetTokenInt64(packetHandle, "MIM", newPath);
    result = CheckLastError("MIM", gkFuncRefGet, result);
  }
  snprintf(newPath, elcount(newPath), "%s.%s", oldPath, "rollingCounterFromMvm");
  GetMIMMIMDataControlField_rollingCounterFromMvmParams(packetHandle, value.rollingCounterFromMvm, newPath);
  result = CheckLastError("MIM", gkFuncRefGet, result);

  snprintf(newPath, elcount(newPath), "%s.%s", oldPath, "proprietaryExtensionField");
  value.proprietaryExtensionField.isValidFlag = C2xIsTokenAvailable(packetHandle, "MIM", newPath);
  if(value.proprietaryExtensionField.isValidFlag==1)
  {
    value.proprietaryExtensionField.value = C2xGetTokenInt(packetHandle, "MIM", newPath);
    result = CheckLastError("MIM", gkFuncRefGet, result);
  }
  return result;
}

int SetMIMMIMDataControlFieldParams(LONG packetHandle, struct MIMMIMDataControlField value, char oldPath[])
{
  char newPath[300];
  int result;

  result = 0;

  snprintf(newPath, elcount(newPath), "%s.%s", oldPath, "checksum");
  if(value.checksum.isValidFlag==1)
  {
    C2xSetTokenInt64(packetHandle, "MIM", newPath, value.checksum.value);
    result = CheckLastError("MIM", gkFuncRefGet, result);
  }
  else
  {
    if( C2xIsTokenAvailable(packetHandle, "MIM", newPath) )
    {
      C2xRemoveToken(packetHandle, "MIM", newPath);
    }
  }

  snprintf(newPath, elcount(newPath), "%s.%s", oldPath, "mimGenerationTime");
  if(value.mimGenerationTime.isValidFlag==1)
  {
    C2xSetTokenInt64(packetHandle, "MIM", newPath, value.mimGenerationTime.value);
    result = CheckLastError("MIM", gkFuncRefGet, result);
  }
  else
  {
    if( C2xIsTokenAvailable(packetHandle, "MIM", newPath) )
    {
      C2xRemoveToken(packetHandle, "MIM", newPath);
    }
  }

  snprintf(newPath, elcount(newPath), "%s.%s", oldPath, "rollingCounterFromMvm");
  SetMIMMIMDataControlField_rollingCounterFromMvmParams(packetHandle, value.rollingCounterFromMvm, newPath);
  result = CheckLastError("MIM", gkFuncRefGet, result);

  snprintf(newPath, elcount(newPath), "%s.%s", oldPath, "proprietaryExtensionField");
  if(value.proprietaryExtensionField.isValidFlag==1)
  {
    C2xSetTokenInt(packetHandle, "MIM", newPath, value.proprietaryExtensionField.value);
    result = CheckLastError("MIM", gkFuncRefGet, result);
  }
  else
  {
    if( C2xIsTokenAvailable(packetHandle, "MIM", newPath) )
    {
      C2xRemoveToken(packetHandle, "MIM", newPath);
    }
  }

  return result;
}

int GetMIMSystemManagementDataParams(LONG packetHandle, struct MIMSystemManagementData value, char oldPath[])
{
  char newPath[300];
  int result;

  result = 0;

  snprintf(newPath, elcount(newPath), "%s.%s", oldPath, "sessionID");
  value.sessionID.isValidFlag = C2xIsTokenAvailable(packetHandle, "MIM", newPath);
  if(value.sessionID.isValidFlag==1)
  {
    value.sessionID.stringLength = C2xGetTokenData(packetHandle, "MIM", newPath, elcount(value.sessionID.string), value.sessionID.string);
    result = CheckLastError("MIM", gkFuncRefGet, result);
  }
  snprintf(newPath, elcount(newPath), "%s.%s", oldPath, "missionID");
  value.missionID.isValidFlag = C2xIsTokenAvailable(packetHandle, "MIM", newPath);
  if(value.missionID.isValidFlag==1)
  {
    value.missionID.stringLength = C2xGetTokenData(packetHandle, "MIM", newPath, elcount(value.missionID.string), value.missionID.string);
    result = CheckLastError("MIM", gkFuncRefGet, result);
  }
  snprintf(newPath, elcount(newPath), "%s.%s", oldPath, "vehicleID");
  value.vehicleID.isValidFlag = C2xIsTokenAvailable(packetHandle, "MIM", newPath);
  if(value.vehicleID.isValidFlag==1)
  {
    value.vehicleID.stringLength = C2xGetTokenData(packetHandle, "MIM", newPath, elcount(value.vehicleID.string), value.vehicleID.string);
    result = CheckLastError("MIM", gkFuncRefGet, result);
  }
  snprintf(newPath, elcount(newPath), "%s.%s", oldPath, "facilityID");
  value.facilityID.isValidFlag = C2xIsTokenAvailable(packetHandle, "MIM", newPath);
  if(value.facilityID.isValidFlag==1)
  {
    value.facilityID.stringLength = C2xGetTokenData(packetHandle, "MIM", newPath, elcount(value.facilityID.string), value.facilityID.string);
    result = CheckLastError("MIM", gkFuncRefGet, result);
  }
  return result;
}

int SetMIMSystemManagementDataParams(LONG packetHandle, struct MIMSystemManagementData value, char oldPath[])
{
  char newPath[300];
  int result;

  result = 0;

  snprintf(newPath, elcount(newPath), "%s.%s", oldPath, "sessionID");
  if(value.sessionID.isValidFlag==1)
  {
    C2xSetTokenData(packetHandle, "MIM", newPath, value.sessionID.stringLength, value.sessionID.string);
    result = CheckLastError("MIM", gkFuncRefGet, result);
  }
  else
  {
    if( C2xIsTokenAvailable(packetHandle, "MIM", newPath) )
    {
      C2xRemoveToken(packetHandle, "MIM", newPath);
    }
  }

  snprintf(newPath, elcount(newPath), "%s.%s", oldPath, "missionID");
  if(value.missionID.isValidFlag==1)
  {
    C2xSetTokenData(packetHandle, "MIM", newPath, value.missionID.stringLength, value.missionID.string);
    result = CheckLastError("MIM", gkFuncRefGet, result);
  }
  else
  {
    if( C2xIsTokenAvailable(packetHandle, "MIM", newPath) )
    {
      C2xRemoveToken(packetHandle, "MIM", newPath);
    }
  }

  snprintf(newPath, elcount(newPath), "%s.%s", oldPath, "vehicleID");
  if(value.vehicleID.isValidFlag==1)
  {
    C2xSetTokenData(packetHandle, "MIM", newPath, value.vehicleID.stringLength, value.vehicleID.string);
    result = CheckLastError("MIM", gkFuncRefGet, result);
  }
  else
  {
    if( C2xIsTokenAvailable(packetHandle, "MIM", newPath) )
    {
      C2xRemoveToken(packetHandle, "MIM", newPath);
    }
  }

  snprintf(newPath, elcount(newPath), "%s.%s", oldPath, "facilityID");
  if(value.facilityID.isValidFlag==1)
  {
    C2xSetTokenData(packetHandle, "MIM", newPath, value.facilityID.stringLength, value.facilityID.string);
    result = CheckLastError("MIM", gkFuncRefGet, result);
  }
  else
  {
    if( C2xIsTokenAvailable(packetHandle, "MIM", newPath) )
    {
      C2xRemoveToken(packetHandle, "MIM", newPath);
    }
  }

  return result;
}

int GetMIMBlinkingParams(LONG packetHandle, struct MIMBlinking value, char oldPath[])
{
  char newPath[300];
  int result;

  result = 0;

  snprintf(newPath, elcount(newPath), "%s.%s", oldPath, "vidRoPublicKey");
  value.vidRoPublicKey = C2xGetTokenInt64(packetHandle, "MIM", newPath);
  result = CheckLastError("MIM", gkFuncRefGet, result);

  snprintf(newPath, elcount(newPath), "%s.%s", oldPath, "codeLength");
  value.codeLength = C2xGetTokenInt(packetHandle, "MIM", newPath);
  result = CheckLastError("MIM", gkFuncRefGet, result);

  snprintf(newPath, elcount(newPath), "%s.%s", oldPath, "blinkingCommand");
  value.blinkingCommand = C2xGetTokenInt(packetHandle, "MIM", newPath);
  result = CheckLastError("MIM", gkFuncRefGet, result);

  return result;
}

int SetMIMBlinkingParams(LONG packetHandle, struct MIMBlinking value, char oldPath[])
{
  char newPath[300];
  int result;

  result = 0;

  snprintf(newPath, elcount(newPath), "%s.%s", oldPath, "vidRoPublicKey");
  C2xSetTokenInt64(packetHandle, "MIM", newPath, value.vidRoPublicKey);
  result = CheckLastError("MIM", gkFuncRefGet, result);

  snprintf(newPath, elcount(newPath), "%s.%s", oldPath, "codeLength");
  C2xSetTokenInt(packetHandle, "MIM", newPath, value.codeLength);
  result = CheckLastError("MIM", gkFuncRefGet, result);

  snprintf(newPath, elcount(newPath), "%s.%s", oldPath, "blinkingCommand");
  C2xSetTokenInt(packetHandle, "MIM", newPath, value.blinkingCommand);
  result = CheckLastError("MIM", gkFuncRefGet, result);

  return result;
}

int GetMIMVidRequestParams(LONG packetHandle, struct MIMVidRequest value, char oldPath[])
{
  char newPath[300];
  int result;

  result = 0;

  value.choice = C2xGetTokenInt(packetHandle, "MIM", oldPath);

  switch(value.choice)
  {
    case 0:
    {
      snprintf(newPath, elcount(newPath), "%s.%s", oldPath, "blinking");
      GetMIMBlinkingParams(packetHandle, value.blinking, newPath);
      result = CheckLastError("MIM", gkFuncRefGet, result);
    }
    break;
  }
  return result;
}

int SetMIMVidRequestParams(LONG packetHandle, struct MIMVidRequest value, char oldPath[])
{
  char newPath[300];
  int result;

  result = 0;

  switch(value.choice)
  {
    case 0:
    {
      snprintf(newPath, elcount(newPath), "%s.%s", oldPath, "blinking");
      SetMIMBlinkingParams(packetHandle, value.blinking, newPath);
      result = CheckLastError("MIM", gkFuncRefGet, result);
    }
    break;
  }
  return result;
}

int GetMIMDrivingPermissionParams(LONG packetHandle, struct MIMDrivingPermission value, char oldPath[])
{
  char newPath[300];
  int result;

  result = 0;

  snprintf(newPath, elcount(newPath), "%s.%s", oldPath, "expirationTime");
  value.expirationTime = C2xGetTokenInt64(packetHandle, "MIM", newPath);
  result = CheckLastError("MIM", gkFuncRefGet, result);

  snprintf(newPath, elcount(newPath), "%s.%s", oldPath, "velocityMax");
  value.velocityMax = C2xGetTokenInt(packetHandle, "MIM", newPath);
  result = CheckLastError("MIM", gkFuncRefGet, result);

  snprintf(newPath, elcount(newPath), "%s.%s", oldPath, "curvatureMin");
  value.curvatureMin = C2xGetTokenInt(packetHandle, "MIM", newPath);
  result = CheckLastError("MIM", gkFuncRefGet, result);

  snprintf(newPath, elcount(newPath), "%s.%s", oldPath, "curvatureMax");
  value.curvatureMax = C2xGetTokenInt(packetHandle, "MIM", newPath);
  result = CheckLastError("MIM", gkFuncRefGet, result);

  snprintf(newPath, elcount(newPath), "%s.%s", oldPath, "checksum");
  value.checksum = C2xGetTokenInt64(packetHandle, "MIM", newPath);
  result = CheckLastError("MIM", gkFuncRefGet, result);

  return result;
}

int SetMIMDrivingPermissionParams(LONG packetHandle, struct MIMDrivingPermission value, char oldPath[])
{
  char newPath[300];
  int result;

  result = 0;

  snprintf(newPath, elcount(newPath), "%s.%s", oldPath, "expirationTime");
  C2xSetTokenInt64(packetHandle, "MIM", newPath, value.expirationTime);
  result = CheckLastError("MIM", gkFuncRefGet, result);

  snprintf(newPath, elcount(newPath), "%s.%s", oldPath, "velocityMax");
  C2xSetTokenInt(packetHandle, "MIM", newPath, value.velocityMax);
  result = CheckLastError("MIM", gkFuncRefGet, result);

  snprintf(newPath, elcount(newPath), "%s.%s", oldPath, "curvatureMin");
  C2xSetTokenInt(packetHandle, "MIM", newPath, value.curvatureMin);
  result = CheckLastError("MIM", gkFuncRefGet, result);

  snprintf(newPath, elcount(newPath), "%s.%s", oldPath, "curvatureMax");
  C2xSetTokenInt(packetHandle, "MIM", newPath, value.curvatureMax);
  result = CheckLastError("MIM", gkFuncRefGet, result);

  snprintf(newPath, elcount(newPath), "%s.%s", oldPath, "checksum");
  C2xSetTokenInt64(packetHandle, "MIM", newPath, value.checksum);
  result = CheckLastError("MIM", gkFuncRefGet, result);

  return result;
}

int GetMIMSafetyTimeSyncRequestParams(LONG packetHandle, struct MIMSafetyTimeSyncRequest value, char oldPath[])
{
  char newPath[300];
  int result;

  result = 0;

  snprintf(newPath, elcount(newPath), "%s.%s", oldPath, "challenge");
  value.challenge = C2xGetTokenInt(packetHandle, "MIM", newPath);
  result = CheckLastError("MIM", gkFuncRefGet, result);

  snprintf(newPath, elcount(newPath), "%s.%s", oldPath, "checksum");
  value.checksum = C2xGetTokenInt64(packetHandle, "MIM", newPath);
  result = CheckLastError("MIM", gkFuncRefGet, result);

  return result;
}

int SetMIMSafetyTimeSyncRequestParams(LONG packetHandle, struct MIMSafetyTimeSyncRequest value, char oldPath[])
{
  char newPath[300];
  int result;

  result = 0;

  snprintf(newPath, elcount(newPath), "%s.%s", oldPath, "challenge");
  C2xSetTokenInt(packetHandle, "MIM", newPath, value.challenge);
  result = CheckLastError("MIM", gkFuncRefGet, result);

  snprintf(newPath, elcount(newPath), "%s.%s", oldPath, "checksum");
  C2xSetTokenInt64(packetHandle, "MIM", newPath, value.checksum);
  result = CheckLastError("MIM", gkFuncRefGet, result);

  return result;
}

int GetMIMDriveCommandParams(LONG packetHandle, struct MIMDriveCommand value, char oldPath[])
{
  char newPath[300];
  int result;

  result = 0;

  snprintf(newPath, elcount(newPath), "%s.%s", oldPath, "driveCommandAction");
  value.driveCommandAction = C2xGetTokenInt(packetHandle, "MIM", newPath);
  result = CheckLastError("MIM", gkFuncRefGet, result);

  snprintf(newPath, elcount(newPath), "%s.%s", oldPath, "terminateReason");
  value.terminateReason = C2xGetTokenInt(packetHandle, "MIM", newPath);
  result = CheckLastError("MIM", gkFuncRefGet, result);

  snprintf(newPath, elcount(newPath), "%s.%s", oldPath, "gearRequest");
  value.gearRequest.isValidFlag = C2xIsTokenAvailable(packetHandle, "MIM", newPath);
  if(value.gearRequest.isValidFlag==1)
  {
    value.gearRequest.value = C2xGetTokenInt(packetHandle, "MIM", newPath);
    result = CheckLastError("MIM", gkFuncRefGet, result);
  }
  snprintf(newPath, elcount(newPath), "%s.%s", oldPath, "directionIndicatorRequest");
  value.directionIndicatorRequest.isValidFlag = C2xIsTokenAvailable(packetHandle, "MIM", newPath);
  if(value.directionIndicatorRequest.isValidFlag==1)
  {
    value.directionIndicatorRequest.value = C2xGetTokenInt(packetHandle, "MIM", newPath);
    result = CheckLastError("MIM", gkFuncRefGet, result);
  }
  snprintf(newPath, elcount(newPath), "%s.%s", oldPath, "parkingBrakeRequest");
  value.parkingBrakeRequest.isValidFlag = C2xIsTokenAvailable(packetHandle, "MIM", newPath);
  if(value.parkingBrakeRequest.isValidFlag==1)
  {
    value.parkingBrakeRequest.value = C2xGetTokenInt(packetHandle, "MIM", newPath);
    result = CheckLastError("MIM", gkFuncRefGet, result);
  }
  snprintf(newPath, elcount(newPath), "%s.%s", oldPath, "motorSystemRequest");
  value.motorSystemRequest.isValidFlag = C2xIsTokenAvailable(packetHandle, "MIM", newPath);
  if(value.motorSystemRequest.isValidFlag==1)
  {
    value.motorSystemRequest.value = C2xGetTokenInt(packetHandle, "MIM", newPath);
    result = CheckLastError("MIM", gkFuncRefGet, result);
  }
  snprintf(newPath, elcount(newPath), "%s.%s", oldPath, "emergencyStopRequest");
  value.emergencyStopRequest.isValidFlag = C2xIsTokenAvailable(packetHandle, "MIM", newPath);
  if(value.emergencyStopRequest.isValidFlag==1)
  {
    value.emergencyStopRequest.value = C2xGetTokenInt(packetHandle, "MIM", newPath);
    result = CheckLastError("MIM", gkFuncRefGet, result);
  }
  snprintf(newPath, elcount(newPath), "%s.%s", oldPath, "interlockRequest");
  value.interlockRequest.isValidFlag = C2xIsTokenAvailable(packetHandle, "MIM", newPath);
  if(value.interlockRequest.isValidFlag==1)
  {
    value.interlockRequest.value = C2xGetTokenInt(packetHandle, "MIM", newPath);
    result = CheckLastError("MIM", gkFuncRefGet, result);
  }
  snprintf(newPath, elcount(newPath), "%s.%s", oldPath, "hornRequest");
  value.hornRequest.isValidFlag = C2xIsTokenAvailable(packetHandle, "MIM", newPath);
  if(value.hornRequest.isValidFlag==1)
  {
    value.hornRequest.value = C2xGetTokenInt(packetHandle, "MIM", newPath);
    result = CheckLastError("MIM", gkFuncRefGet, result);
  }
  return result;
}

int SetMIMDriveCommandParams(LONG packetHandle, struct MIMDriveCommand value, char oldPath[])
{
  char newPath[300];
  int result;

  result = 0;

  snprintf(newPath, elcount(newPath), "%s.%s", oldPath, "driveCommandAction");
  C2xSetTokenInt(packetHandle, "MIM", newPath, value.driveCommandAction);
  result = CheckLastError("MIM", gkFuncRefGet, result);

  snprintf(newPath, elcount(newPath), "%s.%s", oldPath, "terminateReason");
  C2xSetTokenInt(packetHandle, "MIM", newPath, value.terminateReason);
  result = CheckLastError("MIM", gkFuncRefGet, result);

  snprintf(newPath, elcount(newPath), "%s.%s", oldPath, "gearRequest");
  if(value.gearRequest.isValidFlag==1)
  {
    C2xSetTokenInt(packetHandle, "MIM", newPath, value.gearRequest.value);
    result = CheckLastError("MIM", gkFuncRefGet, result);
  }
  else
  {
    if( C2xIsTokenAvailable(packetHandle, "MIM", newPath) )
    {
      C2xRemoveToken(packetHandle, "MIM", newPath);
    }
  }

  snprintf(newPath, elcount(newPath), "%s.%s", oldPath, "directionIndicatorRequest");
  if(value.directionIndicatorRequest.isValidFlag==1)
  {
    C2xSetTokenInt(packetHandle, "MIM", newPath, value.directionIndicatorRequest.value);
    result = CheckLastError("MIM", gkFuncRefGet, result);
  }
  else
  {
    if( C2xIsTokenAvailable(packetHandle, "MIM", newPath) )
    {
      C2xRemoveToken(packetHandle, "MIM", newPath);
    }
  }

  snprintf(newPath, elcount(newPath), "%s.%s", oldPath, "parkingBrakeRequest");
  if(value.parkingBrakeRequest.isValidFlag==1)
  {
    C2xSetTokenInt(packetHandle, "MIM", newPath, value.parkingBrakeRequest.value);
    result = CheckLastError("MIM", gkFuncRefGet, result);
  }
  else
  {
    if( C2xIsTokenAvailable(packetHandle, "MIM", newPath) )
    {
      C2xRemoveToken(packetHandle, "MIM", newPath);
    }
  }

  snprintf(newPath, elcount(newPath), "%s.%s", oldPath, "motorSystemRequest");
  if(value.motorSystemRequest.isValidFlag==1)
  {
    C2xSetTokenInt(packetHandle, "MIM", newPath, value.motorSystemRequest.value);
    result = CheckLastError("MIM", gkFuncRefGet, result);
  }
  else
  {
    if( C2xIsTokenAvailable(packetHandle, "MIM", newPath) )
    {
      C2xRemoveToken(packetHandle, "MIM", newPath);
    }
  }

  snprintf(newPath, elcount(newPath), "%s.%s", oldPath, "emergencyStopRequest");
  if(value.emergencyStopRequest.isValidFlag==1)
  {
    C2xSetTokenInt(packetHandle, "MIM", newPath, value.emergencyStopRequest.value);
    result = CheckLastError("MIM", gkFuncRefGet, result);
  }
  else
  {
    if( C2xIsTokenAvailable(packetHandle, "MIM", newPath) )
    {
      C2xRemoveToken(packetHandle, "MIM", newPath);
    }
  }

  snprintf(newPath, elcount(newPath), "%s.%s", oldPath, "interlockRequest");
  if(value.interlockRequest.isValidFlag==1)
  {
    C2xSetTokenInt(packetHandle, "MIM", newPath, value.interlockRequest.value);
    result = CheckLastError("MIM", gkFuncRefGet, result);
  }
  else
  {
    if( C2xIsTokenAvailable(packetHandle, "MIM", newPath) )
    {
      C2xRemoveToken(packetHandle, "MIM", newPath);
    }
  }

  snprintf(newPath, elcount(newPath), "%s.%s", oldPath, "hornRequest");
  if(value.hornRequest.isValidFlag==1)
  {
    C2xSetTokenInt(packetHandle, "MIM", newPath, value.hornRequest.value);
    result = CheckLastError("MIM", gkFuncRefGet, result);
  }
  else
  {
    if( C2xIsTokenAvailable(packetHandle, "MIM", newPath) )
    {
      C2xRemoveToken(packetHandle, "MIM", newPath);
    }
  }

  return result;
}

int GetMIMPoseParams(LONG packetHandle, struct MIMPose value, char oldPath[])
{
  char newPath[300];
  int result;

  result = 0;

  snprintf(newPath, elcount(newPath), "%s.%s", oldPath, "x");
  value.x = C2xGetTokenInt(packetHandle, "MIM", newPath);
  result = CheckLastError("MIM", gkFuncRefGet, result);

  snprintf(newPath, elcount(newPath), "%s.%s", oldPath, "y");
  value.y = C2xGetTokenInt(packetHandle, "MIM", newPath);
  result = CheckLastError("MIM", gkFuncRefGet, result);

  snprintf(newPath, elcount(newPath), "%s.%s", oldPath, "psi");
  value.psi = C2xGetTokenInt(packetHandle, "MIM", newPath);
  result = CheckLastError("MIM", gkFuncRefGet, result);

  return result;
}

int SetMIMPoseParams(LONG packetHandle, struct MIMPose value, char oldPath[])
{
  char newPath[300];
  int result;

  result = 0;

  snprintf(newPath, elcount(newPath), "%s.%s", oldPath, "x");
  C2xSetTokenInt(packetHandle, "MIM", newPath, value.x);
  result = CheckLastError("MIM", gkFuncRefGet, result);

  snprintf(newPath, elcount(newPath), "%s.%s", oldPath, "y");
  C2xSetTokenInt(packetHandle, "MIM", newPath, value.y);
  result = CheckLastError("MIM", gkFuncRefGet, result);

  snprintf(newPath, elcount(newPath), "%s.%s", oldPath, "psi");
  C2xSetTokenInt(packetHandle, "MIM", newPath, value.psi);
  result = CheckLastError("MIM", gkFuncRefGet, result);

  return result;
}

int GetMIMDetectedVehiclePoseParams(LONG packetHandle, struct MIMDetectedVehiclePose value, char oldPath[])
{
  char newPath[300];
  int result;

  result = 0;

  snprintf(newPath, elcount(newPath), "%s.%s", oldPath, "detectedPose");
  GetMIMPoseParams(packetHandle, value.detectedPose, newPath);
  result = CheckLastError("MIM", gkFuncRefGet, result);

  snprintf(newPath, elcount(newPath), "%s.%s", oldPath, "poseMeasurementTime");
  value.poseMeasurementTime = C2xGetTokenInt64(packetHandle, "MIM", newPath);
  result = CheckLastError("MIM", gkFuncRefGet, result);

  return result;
}

int SetMIMDetectedVehiclePoseParams(LONG packetHandle, struct MIMDetectedVehiclePose value, char oldPath[])
{
  char newPath[300];
  int result;

  result = 0;

  snprintf(newPath, elcount(newPath), "%s.%s", oldPath, "detectedPose");
  SetMIMPoseParams(packetHandle, value.detectedPose, newPath);
  result = CheckLastError("MIM", gkFuncRefGet, result);

  snprintf(newPath, elcount(newPath), "%s.%s", oldPath, "poseMeasurementTime");
  C2xSetTokenInt64(packetHandle, "MIM", newPath, value.poseMeasurementTime);
  result = CheckLastError("MIM", gkFuncRefGet, result);

  return result;
}

int GetMIMWayPointParams(LONG packetHandle, struct MIMWayPoint value, char oldPath[])
{
  char newPath[300];
  int result;

  result = 0;

  snprintf(newPath, elcount(newPath), "%s.%s", oldPath, "index");
  value.index.isValidFlag = C2xIsTokenAvailable(packetHandle, "MIM", newPath);
  if(value.index.isValidFlag==1)
  {
    value.index.value = C2xGetTokenInt(packetHandle, "MIM", newPath);
    result = CheckLastError("MIM", gkFuncRefGet, result);
  }
  snprintf(newPath, elcount(newPath), "%s.%s", oldPath, "wayPointPose");
  GetMIMPoseParams(packetHandle, value.wayPointPose, newPath);
  result = CheckLastError("MIM", gkFuncRefGet, result);

  snprintf(newPath, elcount(newPath), "%s.%s", oldPath, "velocity");
  value.velocity = C2xGetTokenInt(packetHandle, "MIM", newPath);
  result = CheckLastError("MIM", gkFuncRefGet, result);

  snprintf(newPath, elcount(newPath), "%s.%s", oldPath, "curvature");
  value.curvature = C2xGetTokenInt(packetHandle, "MIM", newPath);
  result = CheckLastError("MIM", gkFuncRefGet, result);

  snprintf(newPath, elcount(newPath), "%s.%s", oldPath, "pitchAngle");
  value.pitchAngle.isValidFlag = C2xIsTokenAvailable(packetHandle, "MIM", newPath);
  if(value.pitchAngle.isValidFlag==1)
  {
    value.pitchAngle.value = C2xGetTokenInt(packetHandle, "MIM", newPath);
    result = CheckLastError("MIM", gkFuncRefGet, result);
  }
  return result;
}

int SetMIMWayPointParams(LONG packetHandle, struct MIMWayPoint value, char oldPath[])
{
  char newPath[300];
  int result;

  result = 0;

  snprintf(newPath, elcount(newPath), "%s.%s", oldPath, "index");
  if(value.index.isValidFlag==1)
  {
    C2xSetTokenInt(packetHandle, "MIM", newPath, value.index.value);
    result = CheckLastError("MIM", gkFuncRefGet, result);
  }
  else
  {
    if( C2xIsTokenAvailable(packetHandle, "MIM", newPath) )
    {
      C2xRemoveToken(packetHandle, "MIM", newPath);
    }
  }

  snprintf(newPath, elcount(newPath), "%s.%s", oldPath, "wayPointPose");
  SetMIMPoseParams(packetHandle, value.wayPointPose, newPath);
  result = CheckLastError("MIM", gkFuncRefGet, result);

  snprintf(newPath, elcount(newPath), "%s.%s", oldPath, "velocity");
  C2xSetTokenInt(packetHandle, "MIM", newPath, value.velocity);
  result = CheckLastError("MIM", gkFuncRefGet, result);

  snprintf(newPath, elcount(newPath), "%s.%s", oldPath, "curvature");
  C2xSetTokenInt(packetHandle, "MIM", newPath, value.curvature);
  result = CheckLastError("MIM", gkFuncRefGet, result);

  snprintf(newPath, elcount(newPath), "%s.%s", oldPath, "pitchAngle");
  if(value.pitchAngle.isValidFlag==1)
  {
    C2xSetTokenInt(packetHandle, "MIM", newPath, value.pitchAngle.value);
    result = CheckLastError("MIM", gkFuncRefGet, result);
  }
  else
  {
    if( C2xIsTokenAvailable(packetHandle, "MIM", newPath) )
    {
      C2xRemoveToken(packetHandle, "MIM", newPath);
    }
  }

  return result;
}

int GetMIMPathSnippetParams(LONG packetHandle, struct MIMPathSnippet value, char oldPath[])
{
  char newPath[300]; 
  int i;
  int result;

  result = 0;

  value.length = C2xGetTokenInt(packetHandle, "MIM", oldPath);
  if((result = CheckLastError("MIM", gkFuncRefGet, result))==0)
  {
    for(i=0; i<value.length; i++)
    {
      snprintf(newPath, elcount(newPath), "%s[%d]", oldPath, i);
      GetMIMWayPointParams(packetHandle, value.arrayValue[i], newPath);
      result = CheckLastError("MIM", gkFuncRefGet, result);
    }
  }
  return result;
}

int SetMIMPathSnippetParams(LONG packetHandle, struct MIMPathSnippet value, char oldPath[])
{
  char newPath[300]; 
  int i;
  int result;

  result = 0;

  C2xRemoveToken(packetHandle, "MIM", oldPath);
  for(i=0; i<value.length; i++)
  {
    snprintf(newPath, elcount(newPath), "%s[%d]", oldPath, i);
    SetMIMWayPointParams(packetHandle, value.arrayValue[i], newPath);
    result = CheckLastError("MIM", gkFuncRefGet, result);
  }
  return result;
}

int GetMIMPathControlParams(LONG packetHandle, struct MIMPathControl value, char oldPath[])
{
  char newPath[300];
  int result;

  result = 0;

  snprintf(newPath, elcount(newPath), "%s.%s", oldPath, "pathSnippet");
  value.pathSnippet.isValidFlag = C2xIsTokenAvailable(packetHandle, "MIM", newPath);
  if(value.pathSnippet.isValidFlag==1)
  {
    GetMIMPathSnippetParams(packetHandle, value.pathSnippet, newPath);
    result = CheckLastError("MIM", gkFuncRefGet, result);
  }
  snprintf(newPath, elcount(newPath), "%s.%s", oldPath, "clearedDistanceOnPath");
  value.clearedDistanceOnPath = C2xGetTokenInt(packetHandle, "MIM", newPath);
  result = CheckLastError("MIM", gkFuncRefGet, result);

  snprintf(newPath, elcount(newPath), "%s.%s", oldPath, "situationalVelocityLimit");
  value.situationalVelocityLimit.isValidFlag = C2xIsTokenAvailable(packetHandle, "MIM", newPath);
  if(value.situationalVelocityLimit.isValidFlag==1)
  {
    value.situationalVelocityLimit.value = C2xGetTokenInt(packetHandle, "MIM", newPath);
    result = CheckLastError("MIM", gkFuncRefGet, result);
  }
  return result;
}

int SetMIMPathControlParams(LONG packetHandle, struct MIMPathControl value, char oldPath[])
{
  char newPath[300];
  int result;

  result = 0;

  snprintf(newPath, elcount(newPath), "%s.%s", oldPath, "pathSnippet");
  if(value.pathSnippet.isValidFlag==1)
  {
    SetMIMPathSnippetParams(packetHandle, value.pathSnippet, newPath);
    result = CheckLastError("MIM", gkFuncRefGet, result);
  }
  else
  {
    if( C2xIsTokenAvailable(packetHandle, "MIM", newPath) )
    {
      C2xRemoveToken(packetHandle, "MIM", newPath);
    }
  }

  snprintf(newPath, elcount(newPath), "%s.%s", oldPath, "clearedDistanceOnPath");
  C2xSetTokenInt(packetHandle, "MIM", newPath, value.clearedDistanceOnPath);
  result = CheckLastError("MIM", gkFuncRefGet, result);

  snprintf(newPath, elcount(newPath), "%s.%s", oldPath, "situationalVelocityLimit");
  if(value.situationalVelocityLimit.isValidFlag==1)
  {
    C2xSetTokenInt(packetHandle, "MIM", newPath, value.situationalVelocityLimit.value);
    result = CheckLastError("MIM", gkFuncRefGet, result);
  }
  else
  {
    if( C2xIsTokenAvailable(packetHandle, "MIM", newPath) )
    {
      C2xRemoveToken(packetHandle, "MIM", newPath);
    }
  }

  return result;
}

int GetMIMControlVelocityParams(LONG packetHandle, struct MIMControlVelocity value, char oldPath[])
{
  char newPath[300];
  int result;

  result = 0;

  snprintf(newPath, elcount(newPath), "%s.%s", oldPath, "velocity");
  value.velocity = C2xGetTokenInt(packetHandle, "MIM", newPath);
  result = CheckLastError("MIM", gkFuncRefGet, result);

  snprintf(newPath, elcount(newPath), "%s.%s", oldPath, "distanceToStop");
  value.distanceToStop.isValidFlag = C2xIsTokenAvailable(packetHandle, "MIM", newPath);
  if(value.distanceToStop.isValidFlag==1)
  {
    value.distanceToStop.value = C2xGetTokenInt(packetHandle, "MIM", newPath);
    result = CheckLastError("MIM", gkFuncRefGet, result);
  }
  return result;
}

int SetMIMControlVelocityParams(LONG packetHandle, struct MIMControlVelocity value, char oldPath[])
{
  char newPath[300];
  int result;

  result = 0;

  snprintf(newPath, elcount(newPath), "%s.%s", oldPath, "velocity");
  C2xSetTokenInt(packetHandle, "MIM", newPath, value.velocity);
  result = CheckLastError("MIM", gkFuncRefGet, result);

  snprintf(newPath, elcount(newPath), "%s.%s", oldPath, "distanceToStop");
  if(value.distanceToStop.isValidFlag==1)
  {
    C2xSetTokenInt(packetHandle, "MIM", newPath, value.distanceToStop.value);
    result = CheckLastError("MIM", gkFuncRefGet, result);
  }
  else
  {
    if( C2xIsTokenAvailable(packetHandle, "MIM", newPath) )
    {
      C2xRemoveToken(packetHandle, "MIM", newPath);
    }
  }

  return result;
}

int GetMIMControlParameterParams(LONG packetHandle, struct MIMControlParameter value, char oldPath[])
{
  char newPath[300];
  int result;

  result = 0;

  value.choice = C2xGetTokenInt(packetHandle, "MIM", oldPath);

  switch(value.choice)
  {
    case 0:
    {
      snprintf(newPath, elcount(newPath), "%s.%s", oldPath, "controlAcceleration");
      value.controlAcceleration = C2xGetTokenInt(packetHandle, "MIM", newPath);
      result = CheckLastError("MIM", gkFuncRefGet, result);
    }
    break;
    case 1:
    {
      snprintf(newPath, elcount(newPath), "%s.%s", oldPath, "controlVelocity");
      GetMIMControlVelocityParams(packetHandle, value.controlVelocity, newPath);
      result = CheckLastError("MIM", gkFuncRefGet, result);
    }
    break;
  }
  return result;
}

int SetMIMControlParameterParams(LONG packetHandle, struct MIMControlParameter value, char oldPath[])
{
  char newPath[300];
  int result;

  result = 0;

  switch(value.choice)
  {
    case 0:
    {
      snprintf(newPath, elcount(newPath), "%s.%s", oldPath, "controlAcceleration");
      C2xSetTokenInt(packetHandle, "MIM", newPath, value.controlAcceleration);
      result = CheckLastError("MIM", gkFuncRefGet, result);
    }
    break;
    case 1:
    {
      snprintf(newPath, elcount(newPath), "%s.%s", oldPath, "controlVelocity");
      SetMIMControlVelocityParams(packetHandle, value.controlVelocity, newPath);
      result = CheckLastError("MIM", gkFuncRefGet, result);
    }
    break;
  }
  return result;
}

int GetMIMControlPointParams(LONG packetHandle, struct MIMControlPoint value, char oldPath[])
{
  char newPath[300];
  int result;

  result = 0;

  snprintf(newPath, elcount(newPath), "%s.%s", oldPath, "curvature");
  value.curvature = C2xGetTokenInt(packetHandle, "MIM", newPath);
  result = CheckLastError("MIM", gkFuncRefGet, result);

  snprintf(newPath, elcount(newPath), "%s.%s", oldPath, "controlParameter");
  GetMIMControlParameterParams(packetHandle, value.controlParameter, newPath);
  result = CheckLastError("MIM", gkFuncRefGet, result);

  return result;
}

int SetMIMControlPointParams(LONG packetHandle, struct MIMControlPoint value, char oldPath[])
{
  char newPath[300];
  int result;

  result = 0;

  snprintf(newPath, elcount(newPath), "%s.%s", oldPath, "curvature");
  C2xSetTokenInt(packetHandle, "MIM", newPath, value.curvature);
  result = CheckLastError("MIM", gkFuncRefGet, result);

  snprintf(newPath, elcount(newPath), "%s.%s", oldPath, "controlParameter");
  SetMIMControlParameterParams(packetHandle, value.controlParameter, newPath);
  result = CheckLastError("MIM", gkFuncRefGet, result);

  return result;
}

int GetMIMControlTrajectoryParams(LONG packetHandle, struct MIMControlTrajectory value, char oldPath[])
{
  char newPath[300]; 
  int i;
  int result;

  result = 0;

  value.length = C2xGetTokenInt(packetHandle, "MIM", oldPath);
  if((result = CheckLastError("MIM", gkFuncRefGet, result))==0)
  {
    for(i=0; i<value.length; i++)
    {
      snprintf(newPath, elcount(newPath), "%s[%d]", oldPath, i);
      GetMIMControlPointParams(packetHandle, value.arrayValue[i], newPath);
      result = CheckLastError("MIM", gkFuncRefGet, result);
    }
  }
  return result;
}

int SetMIMControlTrajectoryParams(LONG packetHandle, struct MIMControlTrajectory value, char oldPath[])
{
  char newPath[300]; 
  int i;
  int result;

  result = 0;

  C2xRemoveToken(packetHandle, "MIM", oldPath);
  for(i=0; i<value.length; i++)
  {
    snprintf(newPath, elcount(newPath), "%s[%d]", oldPath, i);
    SetMIMControlPointParams(packetHandle, value.arrayValue[i], newPath);
    result = CheckLastError("MIM", gkFuncRefGet, result);
  }
  return result;
}

int GetMIMStatePointParams(LONG packetHandle, struct MIMStatePoint value, char oldPath[])
{
  char newPath[300];
  int result;

  result = 0;

  snprintf(newPath, elcount(newPath), "%s.%s", oldPath, "statePose");
  GetMIMPoseParams(packetHandle, value.statePose, newPath);
  result = CheckLastError("MIM", gkFuncRefGet, result);

  snprintf(newPath, elcount(newPath), "%s.%s", oldPath, "velocity");
  value.velocity = C2xGetTokenInt(packetHandle, "MIM", newPath);
  result = CheckLastError("MIM", gkFuncRefGet, result);

  return result;
}

int SetMIMStatePointParams(LONG packetHandle, struct MIMStatePoint value, char oldPath[])
{
  char newPath[300];
  int result;

  result = 0;

  snprintf(newPath, elcount(newPath), "%s.%s", oldPath, "statePose");
  SetMIMPoseParams(packetHandle, value.statePose, newPath);
  result = CheckLastError("MIM", gkFuncRefGet, result);

  snprintf(newPath, elcount(newPath), "%s.%s", oldPath, "velocity");
  C2xSetTokenInt(packetHandle, "MIM", newPath, value.velocity);
  result = CheckLastError("MIM", gkFuncRefGet, result);

  return result;
}

int GetMIMStateTrajectoryParams(LONG packetHandle, struct MIMStateTrajectory value, char oldPath[])
{
  char newPath[300]; 
  int i;
  int result;

  result = 0;

  value.length = C2xGetTokenInt(packetHandle, "MIM", oldPath);
  if((result = CheckLastError("MIM", gkFuncRefGet, result))==0)
  {
    for(i=0; i<value.length; i++)
    {
      snprintf(newPath, elcount(newPath), "%s[%d]", oldPath, i);
      GetMIMStatePointParams(packetHandle, value.arrayValue[i], newPath);
      result = CheckLastError("MIM", gkFuncRefGet, result);
    }
  }
  return result;
}

int SetMIMStateTrajectoryParams(LONG packetHandle, struct MIMStateTrajectory value, char oldPath[])
{
  char newPath[300]; 
  int i;
  int result;

  result = 0;

  C2xRemoveToken(packetHandle, "MIM", oldPath);
  for(i=0; i<value.length; i++)
  {
    snprintf(newPath, elcount(newPath), "%s[%d]", oldPath, i);
    SetMIMStatePointParams(packetHandle, value.arrayValue[i], newPath);
    result = CheckLastError("MIM", gkFuncRefGet, result);
  }
  return result;
}

int GetMIMTrajectoryControlParams(LONG packetHandle, struct MIMTrajectoryControl value, char oldPath[])
{
  char newPath[300];
  int result;

  result = 0;

  snprintf(newPath, elcount(newPath), "%s.%s", oldPath, "timeReference");
  value.timeReference = C2xGetTokenInt64(packetHandle, "MIM", newPath);
  result = CheckLastError("MIM", gkFuncRefGet, result);

  snprintf(newPath, elcount(newPath), "%s.%s", oldPath, "driveDirection");
  value.driveDirection.isValidFlag = C2xIsTokenAvailable(packetHandle, "MIM", newPath);
  if(value.driveDirection.isValidFlag==1)
  {
    value.driveDirection.value = C2xGetTokenInt(packetHandle, "MIM", newPath);
    result = CheckLastError("MIM", gkFuncRefGet, result);
  }
  snprintf(newPath, elcount(newPath), "%s.%s", oldPath, "controlTrajectory");
  GetMIMControlTrajectoryParams(packetHandle, value.controlTrajectory, newPath);
  result = CheckLastError("MIM", gkFuncRefGet, result);

  snprintf(newPath, elcount(newPath), "%s.%s", oldPath, "stateTrajectory");
  value.stateTrajectory.isValidFlag = C2xIsTokenAvailable(packetHandle, "MIM", newPath);
  if(value.stateTrajectory.isValidFlag==1)
  {
    GetMIMStateTrajectoryParams(packetHandle, value.stateTrajectory, newPath);
    result = CheckLastError("MIM", gkFuncRefGet, result);
  }
  return result;
}

int SetMIMTrajectoryControlParams(LONG packetHandle, struct MIMTrajectoryControl value, char oldPath[])
{
  char newPath[300];
  int result;

  result = 0;

  snprintf(newPath, elcount(newPath), "%s.%s", oldPath, "timeReference");
  C2xSetTokenInt64(packetHandle, "MIM", newPath, value.timeReference);
  result = CheckLastError("MIM", gkFuncRefGet, result);

  snprintf(newPath, elcount(newPath), "%s.%s", oldPath, "driveDirection");
  if(value.driveDirection.isValidFlag==1)
  {
    C2xSetTokenInt(packetHandle, "MIM", newPath, value.driveDirection.value);
    result = CheckLastError("MIM", gkFuncRefGet, result);
  }
  else
  {
    if( C2xIsTokenAvailable(packetHandle, "MIM", newPath) )
    {
      C2xRemoveToken(packetHandle, "MIM", newPath);
    }
  }

  snprintf(newPath, elcount(newPath), "%s.%s", oldPath, "controlTrajectory");
  SetMIMControlTrajectoryParams(packetHandle, value.controlTrajectory, newPath);
  result = CheckLastError("MIM", gkFuncRefGet, result);

  snprintf(newPath, elcount(newPath), "%s.%s", oldPath, "stateTrajectory");
  if(value.stateTrajectory.isValidFlag==1)
  {
    SetMIMStateTrajectoryParams(packetHandle, value.stateTrajectory, newPath);
    result = CheckLastError("MIM", gkFuncRefGet, result);
  }
  else
  {
    if( C2xIsTokenAvailable(packetHandle, "MIM", newPath) )
    {
      C2xRemoveToken(packetHandle, "MIM", newPath);
    }
  }

  return result;
}

int GetMIMControlInterfaceParams(LONG packetHandle, struct MIMControlInterface value, char oldPath[])
{
  char newPath[300];
  int result;

  result = 0;

  value.choice = C2xGetTokenInt(packetHandle, "MIM", oldPath);

  switch(value.choice)
  {
    case 0:
    {
      snprintf(newPath, elcount(newPath), "%s.%s", oldPath, "pathControl");
      GetMIMPathControlParams(packetHandle, value.pathControl, newPath);
      result = CheckLastError("MIM", gkFuncRefGet, result);
    }
    break;
    case 1:
    {
      snprintf(newPath, elcount(newPath), "%s.%s", oldPath, "trajectoryControl");
      GetMIMTrajectoryControlParams(packetHandle, value.trajectoryControl, newPath);
      result = CheckLastError("MIM", gkFuncRefGet, result);
    }
    break;
  }
  return result;
}

int SetMIMControlInterfaceParams(LONG packetHandle, struct MIMControlInterface value, char oldPath[])
{
  char newPath[300];
  int result;

  result = 0;

  switch(value.choice)
  {
    case 0:
    {
      snprintf(newPath, elcount(newPath), "%s.%s", oldPath, "pathControl");
      SetMIMPathControlParams(packetHandle, value.pathControl, newPath);
      result = CheckLastError("MIM", gkFuncRefGet, result);
    }
    break;
    case 1:
    {
      snprintf(newPath, elcount(newPath), "%s.%s", oldPath, "trajectoryControl");
      SetMIMTrajectoryControlParams(packetHandle, value.trajectoryControl, newPath);
      result = CheckLastError("MIM", gkFuncRefGet, result);
    }
    break;
  }
  return result;
}

int GetMIMMimParams(LONG packetHandle, struct MIMMim value, char oldPath[])
{
  char newPath[300];
  int result;

  result = 0;

  snprintf(newPath, elcount(newPath), "%s.%s", oldPath, "mimDataControlField");
  value.mimDataControlField.isValidFlag = C2xIsTokenAvailable(packetHandle, "MIM", newPath);
  if(value.mimDataControlField.isValidFlag==1)
  {
    GetMIMMIMDataControlFieldParams(packetHandle, value.mimDataControlField, newPath);
    result = CheckLastError("MIM", gkFuncRefGet, result);
  }
  snprintf(newPath, elcount(newPath), "%s.%s", oldPath, "systemManagementData");
  value.systemManagementData.isValidFlag = C2xIsTokenAvailable(packetHandle, "MIM", newPath);
  if(value.systemManagementData.isValidFlag==1)
  {
    GetMIMSystemManagementDataParams(packetHandle, value.systemManagementData, newPath);
    result = CheckLastError("MIM", gkFuncRefGet, result);
  }
  snprintf(newPath, elcount(newPath), "%s.%s", oldPath, "vehicleIdentification");
  value.vehicleIdentification.isValidFlag = C2xIsTokenAvailable(packetHandle, "MIM", newPath);
  if(value.vehicleIdentification.isValidFlag==1)
  {
    GetMIMVidRequestParams(packetHandle, value.vehicleIdentification, newPath);
    result = CheckLastError("MIM", gkFuncRefGet, result);
  }
  snprintf(newPath, elcount(newPath), "%s.%s", oldPath, "drivingPermission");
  value.drivingPermission.isValidFlag = C2xIsTokenAvailable(packetHandle, "MIM", newPath);
  if(value.drivingPermission.isValidFlag==1)
  {
    GetMIMDrivingPermissionParams(packetHandle, value.drivingPermission, newPath);
    result = CheckLastError("MIM", gkFuncRefGet, result);
  }
  snprintf(newPath, elcount(newPath), "%s.%s", oldPath, "safetyTimeSyncRequest");
  value.safetyTimeSyncRequest.isValidFlag = C2xIsTokenAvailable(packetHandle, "MIM", newPath);
  if(value.safetyTimeSyncRequest.isValidFlag==1)
  {
    GetMIMSafetyTimeSyncRequestParams(packetHandle, value.safetyTimeSyncRequest, newPath);
    result = CheckLastError("MIM", gkFuncRefGet, result);
  }
  snprintf(newPath, elcount(newPath), "%s.%s", oldPath, "driveCommand");
  value.driveCommand.isValidFlag = C2xIsTokenAvailable(packetHandle, "MIM", newPath);
  if(value.driveCommand.isValidFlag==1)
  {
    GetMIMDriveCommandParams(packetHandle, value.driveCommand, newPath);
    result = CheckLastError("MIM", gkFuncRefGet, result);
  }
  snprintf(newPath, elcount(newPath), "%s.%s", oldPath, "detectedVehiclePose");
  value.detectedVehiclePose.isValidFlag = C2xIsTokenAvailable(packetHandle, "MIM", newPath);
  if(value.detectedVehiclePose.isValidFlag==1)
  {
    GetMIMDetectedVehiclePoseParams(packetHandle, value.detectedVehiclePose, newPath);
    result = CheckLastError("MIM", gkFuncRefGet, result);
  }
  snprintf(newPath, elcount(newPath), "%s.%s", oldPath, "controlInterface");
  value.controlInterface.isValidFlag = C2xIsTokenAvailable(packetHandle, "MIM", newPath);
  if(value.controlInterface.isValidFlag==1)
  {
    GetMIMControlInterfaceParams(packetHandle, value.controlInterface, newPath);
    result = CheckLastError("MIM", gkFuncRefGet, result);
  }
  return result;
}

int SetMIMMimParams(LONG packetHandle, struct MIMMim value, char oldPath[])
{
  char newPath[300];
  int result;

  result = 0;

  snprintf(newPath, elcount(newPath), "%s.%s", oldPath, "mimDataControlField");
  if(value.mimDataControlField.isValidFlag==1)
  {
    SetMIMMIMDataControlFieldParams(packetHandle, value.mimDataControlField, newPath);
    result = CheckLastError("MIM", gkFuncRefGet, result);
  }
  else
  {
    if( C2xIsTokenAvailable(packetHandle, "MIM", newPath) )
    {
      C2xRemoveToken(packetHandle, "MIM", newPath);
    }
  }

  snprintf(newPath, elcount(newPath), "%s.%s", oldPath, "systemManagementData");
  if(value.systemManagementData.isValidFlag==1)
  {
    SetMIMSystemManagementDataParams(packetHandle, value.systemManagementData, newPath);
    result = CheckLastError("MIM", gkFuncRefGet, result);
  }
  else
  {
    if( C2xIsTokenAvailable(packetHandle, "MIM", newPath) )
    {
      C2xRemoveToken(packetHandle, "MIM", newPath);
    }
  }

  snprintf(newPath, elcount(newPath), "%s.%s", oldPath, "vehicleIdentification");
  if(value.vehicleIdentification.isValidFlag==1)
  {
    SetMIMVidRequestParams(packetHandle, value.vehicleIdentification, newPath);
    result = CheckLastError("MIM", gkFuncRefGet, result);
  }
  else
  {
    if( C2xIsTokenAvailable(packetHandle, "MIM", newPath) )
    {
      C2xRemoveToken(packetHandle, "MIM", newPath);
    }
  }

  snprintf(newPath, elcount(newPath), "%s.%s", oldPath, "drivingPermission");
  if(value.drivingPermission.isValidFlag==1)
  {
    SetMIMDrivingPermissionParams(packetHandle, value.drivingPermission, newPath);
    result = CheckLastError("MIM", gkFuncRefGet, result);
  }
  else
  {
    if( C2xIsTokenAvailable(packetHandle, "MIM", newPath) )
    {
      C2xRemoveToken(packetHandle, "MIM", newPath);
    }
  }

  snprintf(newPath, elcount(newPath), "%s.%s", oldPath, "safetyTimeSyncRequest");
  if(value.safetyTimeSyncRequest.isValidFlag==1)
  {
    SetMIMSafetyTimeSyncRequestParams(packetHandle, value.safetyTimeSyncRequest, newPath);
    result = CheckLastError("MIM", gkFuncRefGet, result);
  }
  else
  {
    if( C2xIsTokenAvailable(packetHandle, "MIM", newPath) )
    {
      C2xRemoveToken(packetHandle, "MIM", newPath);
    }
  }

  snprintf(newPath, elcount(newPath), "%s.%s", oldPath, "driveCommand");
  if(value.driveCommand.isValidFlag==1)
  {
    SetMIMDriveCommandParams(packetHandle, value.driveCommand, newPath);
    result = CheckLastError("MIM", gkFuncRefGet, result);
  }
  else
  {
    if( C2xIsTokenAvailable(packetHandle, "MIM", newPath) )
    {
      C2xRemoveToken(packetHandle, "MIM", newPath);
    }
  }

  snprintf(newPath, elcount(newPath), "%s.%s", oldPath, "detectedVehiclePose");
  if(value.detectedVehiclePose.isValidFlag==1)
  {
    SetMIMDetectedVehiclePoseParams(packetHandle, value.detectedVehiclePose, newPath);
    result = CheckLastError("MIM", gkFuncRefGet, result);
  }
  else
  {
    if( C2xIsTokenAvailable(packetHandle, "MIM", newPath) )
    {
      C2xRemoveToken(packetHandle, "MIM", newPath);
    }
  }

  snprintf(newPath, elcount(newPath), "%s.%s", oldPath, "controlInterface");
  if(value.controlInterface.isValidFlag==1)
  {
    SetMIMControlInterfaceParams(packetHandle, value.controlInterface, newPath);
    result = CheckLastError("MIM", gkFuncRefGet, result);
  }
  else
  {
    if( C2xIsTokenAvailable(packetHandle, "MIM", newPath) )
    {
      C2xRemoveToken(packetHandle, "MIM", newPath);
    }
  }

  return result;
}

int GetMIMMIM_mimsParams(LONG packetHandle, struct MIMMIM_mims value, char oldPath[])
{
  char newPath[300]; 
  int i;
  int result;

  result = 0;

  value.length = C2xGetTokenInt(packetHandle, "MIM", oldPath);
  if((result = CheckLastError("MIM", gkFuncRefGet, result))==0)
  {
    for(i=0; i<value.length; i++)
    {
      snprintf(newPath, elcount(newPath), "%s[%d]", oldPath, i);
      GetMIMMimParams(packetHandle, value.arrayValue[i], newPath);
      result = CheckLastError("MIM", gkFuncRefGet, result);
    }
  }
  return result;
}

int SetMIMMIM_mimsParams(LONG packetHandle, struct MIMMIM_mims value, char oldPath[])
{
  char newPath[300]; 
  int i;
  int result;

  result = 0;

  C2xRemoveToken(packetHandle, "MIM", oldPath);
  for(i=0; i<value.length; i++)
  {
    snprintf(newPath, elcount(newPath), "%s[%d]", oldPath, i);
    SetMIMMimParams(packetHandle, value.arrayValue[i], newPath);
    result = CheckLastError("MIM", gkFuncRefGet, result);
  }
  return result;
}

int API_GetMIMParams(LONG packetHandle, struct MIM value)
{
  int result;
  result = 0;

  value.header.isValidFlag = 1;
  GetMIMItsPduHeaderParams(packetHandle, value.header, "header");
  result = CheckLastError("MIM", gkFuncRefGet, result);

  value.e2eProtection.isValidFlag = 1;
  GetMIMAvmE2EProtectionParams(packetHandle, value.e2eProtection, "e2eProtection");
  result = CheckLastError("MIM", gkFuncRefGet, result);

  value.mims.isValidFlag = 1;
  GetMIMMIM_mimsParams(packetHandle, value.mims, "mims");
  result = CheckLastError("MIM", gkFuncRefGet, result);

  return result;
}

int API_SetMIMParams(LONG packetHandle, struct MIM value)
{
  int result;
  result = 0;

  SetMIMItsPduHeaderParams(packetHandle, value.header, "header");
  result = CheckLastError("MIM", gkFuncRefGet, result);

  SetMIMAvmE2EProtectionParams(packetHandle, value.e2eProtection, "e2eProtection");
  result = CheckLastError("MIM", gkFuncRefGet, result);

  SetMIMMIM_mimsParams(packetHandle, value.mims, "mims");
  result = CheckLastError("MIM", gkFuncRefGet, result);

  return result;
}

