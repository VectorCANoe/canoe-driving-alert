/*@!Encoding:1252*/
/*
//  (c) Vector Informatik GmbH. All rights reserved.
//
//  This file contains definitions of structs and methods that may be used
//  to set and get the values of an ASN.1 defined packet's payload.
//
//  //This example demonstrates how to set a packet's payload:
//  LONG packetHandle;
//  struct DENM payload;
//  //you need to set the values of the variable "payload" yourself
//  packetHandle = API_InitDENMPacket();
//  if (packetHandle!=0) {
//    if (API_SetDENMParams(packetHandle, payload)==0) {
//      if (C2xCompletePacket(packetHandle)==0) {
//        C2xOutputPacket(packetHandle);
//      }
//    }
//  }
//                                                                             */
includes
{
 
}
variables
{
    struct DENMItsPduHeader {
        INT isValidFlag;   // necessary if this struct is used as an optional field of a SEQUENCE
        BYTE protocolVersion;  // INTEGER, 0..255;
        BYTE messageID;  // INTEGER, 0..255, denm(1), cam(2), poim(3), spatem(4), mapem(5), ivim(6), rfu1(7), rfu2(8), srem(9), ssem(10), evcsn(11), saem(12), rtcmem(13), cpm(14), imzm(15), vam(16), dsm(17), mim(18), mvm(19), mcm(20);
        DWORD stationID;  // INTEGER, 0..4294967295;
    };
    
    struct DENMActionID {
        INT isValidFlag;   // necessary if this struct is used as an optional field of a SEQUENCE
        DWORD originatingStationID;  // INTEGER, 0..4294967295;
        WORD sequenceNumber;  // INTEGER, 0..65535;
    };
    
    struct DENMPosConfidenceEllipse {
        INT isValidFlag;   // necessary if this struct is used as an optional field of a SEQUENCE
        WORD semiMajorConfidence;  // INTEGER, 0..4095, doNotUse(0), outOfRange(4094), unavailable(4095);
        WORD semiMinorConfidence;  // INTEGER, 0..4095, doNotUse(0), outOfRange(4094), unavailable(4095);
        WORD semiMajorOrientation;  // INTEGER, 0..3601, wgs84North(0), wgs84East(900), wgs84South(1800), wgs84West(2700), doNotUse(3600), unavailable(3601);
    };
    
    struct DENMAltitude {
        INT isValidFlag;   // necessary if this struct is used as an optional field of a SEQUENCE
        LONG altitudeValue;  // INTEGER, -100000..800001, negativeOutOfRange(-100000), postiveOutOfRange(800000), unavailable(800001);
        INT altitudeConfidence;  // ENUMERATED, alt_000_01(0), alt_000_02(1), alt_000_05(2), alt_000_10(3), alt_000_20(4), alt_000_50(5), alt_001_00(6), alt_002_00(7), alt_005_00(8), alt_010_00(9), alt_020_00(10), alt_050_00(11), alt_100_00(12), alt_200_00(13), outOfRange(14), unavailable(15);
    };
    
    struct DENMReferencePosition {
        INT isValidFlag;   // necessary if this struct is used as an optional field of a SEQUENCE
        LONG latitude;  // INTEGER, -900000000..900000001, unavailable(900000001);
        LONG longitude;  // INTEGER, -1800000000..1800000001, valueNotUsed(-1800000000), unavailable(1800000001);
        struct DENMPosConfidenceEllipse positionConfidenceEllipse;  // SEQUENCE;
        struct DENMAltitude altitude;  // SEQUENCE;
    };
    
    struct DENMManagementContainer {
        INT isValidFlag;   // necessary if this struct is used as an optional field of a SEQUENCE
        struct DENMActionID actionID;  // SEQUENCE;
        QWORD detectionTime;  // INTEGER, 0..4398046511103;
        QWORD referenceTime;  // INTEGER, 0..4398046511103;
        struct OPT_ENUM_ASN termination;  // ENUMERATED, OPTIONAL, isCancellation(0), isNegation(1);
        struct DENMReferencePosition eventPosition;  // SEQUENCE;
        struct OPT_ENUM_ASN relevanceDistance;  // ENUMERATED, OPTIONAL, lessThan50m(0), lessThan100m(1), lessThan200m(2), lessThan500m(3), lessThan1000m(4), lessThan5km(5), lessThan10km(6), over10km(7);
        struct OPT_ENUM_ASN relevanceTrafficDirection;  // ENUMERATED, OPTIONAL, allTrafficDirections(0), sameAsReferenceDirection_upstreamOfReferencePosition(1), sameAsReferenceDirection_downstreamOfReferencePosition(2), oppositeToReferenceDirection(3);
        struct OPT_DWORD_ASN validityDuration;  // INTEGER, OPTIONAL, 0..86400;
        struct OPT_WORD_ASN transmissionInterval;  // INTEGER, OPTIONAL, 1..10000;
        BYTE stationType;  // INTEGER, 0..255, unknown(0), pedestrian(1), cyclist(2), moped(3), motorcycle(4), passengerCar(5), bus(6), lightTruck(7), heavyTruck(8), trailer(9), specialVehicle(10), tram(11), lightVruVehicle(12), animal(13), roadSideUnit(15);
    };
    
    struct DENMCauseCode {
        INT isValidFlag;   // necessary if this struct is used as an optional field of a SEQUENCE
        BYTE causeCode;  // INTEGER, 0..255, trafficCondition(1), accident(2), roadworks(3), impassability(5), adverseWeatherCondition_Adhesion(6), aquaplaning(7), hazardousLocation_SurfaceCondition(9), hazardousLocation_ObstacleOnTheRoad(10), hazardousLocation_AnimalOnTheRoad(11), humanPresenceOnTheRoad(12), wrongWayDriving(14), rescueAndRecoveryWorkInProgress(15), adverseWeatherCondition_ExtremeWeatherCondition(17), adverseWeatherCondition_Visibility(18), adverseWeatherCondition_Precipitation(19), violence(20), slowVehicle(26), dangerousEndOfQueue(27), publicTransportVehicleApproaching(28), vehicleBreakdown(91), postCrash(92), humanProblem(93), stationaryVehicle(94), emergencyVehicleApproaching(95), hazardousLocation_DangerousCurve(96), collisionRisk(97), signalViolation(98), dangerousSituation(99), railwayLevelCrossing(100);
        BYTE subCauseCode;  // INTEGER, 0..255;
    };
    
    struct DENMDeltaReferencePosition {
        INT isValidFlag;   // necessary if this struct is used as an optional field of a SEQUENCE
        LONG deltaLatitude;  // INTEGER, -131071..131072, unavailable(131072);
        LONG deltaLongitude;  // INTEGER, -131071..131072, unavailable(131072);
        INT deltaAltitude;  // INTEGER, -12700..12800, negativeOutOfRange(-12700), positiveOutOfRange(12799), unavailable(12800);
    };
    
    struct DENMEventPoint {
        INT isValidFlag;   // necessary if this struct is used as an optional field of a SEQUENCE
        struct DENMDeltaReferencePosition eventPosition;  // SEQUENCE;
        struct OPT_WORD_ASN eventDeltaTime;  // INTEGER, OPTIONAL, 1..65535;
        BYTE informationQuality;  // INTEGER, 0..7;
    };
    
    struct DENMEventHistory {
        INT isValidFlag;   // necessary if this struct is used as an optional field of a SEQUENCE
        INT length;
        struct DENMEventPoint arrayValue[23];  // SEQUENCE;
    };
    
    struct DENMActionIdList {
        INT isValidFlag;   // necessary if this struct is used as an optional field of a SEQUENCE
        INT length;
        struct DENMActionID arrayValue[8];  // SEQUENCE;
    };
    
    struct DENMSituationContainer {
        INT isValidFlag;   // necessary if this struct is used as an optional field of a SEQUENCE
        BYTE informationQuality;  // INTEGER, 0..7;
        struct DENMCauseCode eventType;  // SEQUENCE;
        struct DENMCauseCode linkedCause;  // SEQUENCE, OPTIONAL;
        struct DENMEventHistory eventHistory;  // SEQUENCEOF, OPTIONAL;
        struct DENMActionIdList linkedDenms;  // SEQUENCEOF, OPTIONAL;
        struct OPT_INT_ASN eventEnd;  // INTEGER, OPTIONAL, -8190..8191, outOfRange(8190), unavailable(8191);
    };
    
    struct DENMSpeed {
        INT isValidFlag;   // necessary if this struct is used as an optional field of a SEQUENCE
        WORD speedValue;  // INTEGER, 0..16383, standstill(0), outOfRange(16382), unavailable(16383);
        BYTE speedConfidence;  // INTEGER, 1..127, outOfRange(126), unavailable(127);
    };
    
    struct DENMWgs84Angle {
        INT isValidFlag;   // necessary if this struct is used as an optional field of a SEQUENCE
        WORD headingValue;  // INTEGER, 0..3601, wgs84North(0), wgs84East(900), wgs84South(1800), wgs84West(2700), doNotUse(3600), unavailable(3601);
        BYTE headingConfidence;  // INTEGER, 1..127, outOfRange(126), unavailable(127);
    };
    
    struct DENMPathPoint {
        INT isValidFlag;   // necessary if this struct is used as an optional field of a SEQUENCE
        struct DENMDeltaReferencePosition pathPosition;  // SEQUENCE;
        struct OPT_WORD_ASN pathDeltaTime;  // INTEGER, OPTIONAL, 1..65535;
    };
    
    struct DENMPath {
        INT isValidFlag;   // necessary if this struct is used as an optional field of a SEQUENCE
        INT length;
        struct DENMPathPoint arrayValue[40];  // SEQUENCE;
    };
    
    struct DENMTraces {
        INT isValidFlag;   // necessary if this struct is used as an optional field of a SEQUENCE
        INT length;
        struct DENMPath arrayValue[7];  // SEQUENCEOF;
    };
    
    struct DENMLanePositionAndType {
        INT isValidFlag;   // necessary if this struct is used as an optional field of a SEQUENCE
        INT transversalPosition;  // INTEGER, -1..14, offTheRoad(-1), innerHardShoulder(0), outerHardShoulder(14);
        struct OPT_BYTE_ASN laneType;  // INTEGER, OPTIONAL, 0..31, traffic(0), through(1), reversible(2), acceleration(3), deceleration(4), leftHandTurning(5), rightHandTurning(6), dedicatedVehicle(7), bus(8), taxi(9), hov(10), hot(11), pedestrian(12), cycleLane(13), median(14), striping(15), trackedVehicle(16), parking(17), emergency(18), verge(19), minimumRiskManoeuvre(20), exclusiveCycleLane(21), unknown(31);
        struct OPT_BYTE_ASN direction;  // INTEGER, OPTIONAL, 0..3, sameDirection(0), oppositeDirection(1), bothDirections(2), unavailable(3);
    };
    
    struct DENMLanePositionWithLateralDetails {
        INT isValidFlag;   // necessary if this struct is used as an optional field of a SEQUENCE
        WORD distanceToLeftBorder;  // INTEGER, 0..511;
        WORD distanceToRightBorder;  // INTEGER, 0..511;
    };
    
    struct DENMTrafficIslandPosition {
        INT isValidFlag;   // necessary if this struct is used as an optional field of a SEQUENCE
        struct DENMLanePositionAndType oneSide;  // SEQUENCE;
        struct DENMLanePositionAndType otherSide;  // SEQUENCE;
    };
    
    struct DENMLanePositionOptions {
        INT isValidFlag;   // necessary if this struct is used as an optional field of a SEQUENCE
        INT choice;
        INT simplelanePosition;  // INTEGER, -1..14, offTheRoad(-1), innerHardShoulder(0), outerHardShoulder(14);
        BYTE simpleLaneType;  // INTEGER, 0..31, traffic(0), through(1), reversible(2), acceleration(3), deceleration(4), leftHandTurning(5), rightHandTurning(6), dedicatedVehicle(7), bus(8), taxi(9), hov(10), hot(11), pedestrian(12), cycleLane(13), median(14), striping(15), trackedVehicle(16), parking(17), emergency(18), verge(19), minimumRiskManoeuvre(20), exclusiveCycleLane(21), unknown(31);
        struct DENMLanePositionAndType detailedlanePosition;  // SEQUENCE;
        struct DENMLanePositionWithLateralDetails lanePositionWithLateralDetails;  // SEQUENCE;
        struct DENMTrafficIslandPosition trafficIslandPosition;  // SEQUENCE;
    };
    
    struct DENMRoadSegmentReferenceId {
        INT isValidFlag;   // necessary if this struct is used as an optional field of a SEQUENCE
        struct OPT_WORD_ASN region;  // INTEGER, OPTIONAL, 0..65535;
        WORD id;  // INTEGER, 0..65535;
    };
    
    struct DENMIntersectionReferenceId {
        INT isValidFlag;   // necessary if this struct is used as an optional field of a SEQUENCE
        struct OPT_WORD_ASN region;  // INTEGER, OPTIONAL, 0..65535;
        WORD id;  // INTEGER, 0..65535;
    };
    
    struct DENMMapReference {
        INT isValidFlag;   // necessary if this struct is used as an optional field of a SEQUENCE
        INT choice;
        struct DENMRoadSegmentReferenceId roadsegment;  // SEQUENCE;
        struct DENMIntersectionReferenceId intersection;  // SEQUENCE;
    };
    
    struct DENMLongitudinalLanePosition {
        INT isValidFlag;   // necessary if this struct is used as an optional field of a SEQUENCE
        WORD longitudinalLanePositionValue;  // INTEGER, 0..32767, outOfRange(32766), unavailable(32767);
        WORD longitudinalLanePositionConfidence;  // INTEGER, 0..1023, outOfRange(1022), unavailable(1023);
    };
    
    struct DENMMapPosition {
        INT isValidFlag;   // necessary if this struct is used as an optional field of a SEQUENCE
        struct DENMMapReference mapReference;  // CHOICE, OPTIONAL;
        struct OPT_BYTE_ASN laneId;  // INTEGER, OPTIONAL, 0..255;
        struct OPT_BYTE_ASN connectionId;  // INTEGER, OPTIONAL, 0..255;
        struct DENMLongitudinalLanePosition longitudinalLanePosition;  // SEQUENCE, OPTIONAL;
    };
    
    struct DENMSensorTypes {
        INT isValidFlag;   // necessary if this struct is used as an optional field of a SEQUENCE
        CHAR string[17];
        INT  stringLength;
    };
    
    struct DENMStoredInformationType {
        INT isValidFlag;   // necessary if this struct is used as an optional field of a SEQUENCE
        CHAR string[9];
        INT  stringLength;
    };
    
    struct DENMMetaInformation {
        INT isValidFlag;   // necessary if this struct is used as an optional field of a SEQUENCE
        struct DENMSensorTypes usedDetectionInformation;  // BITSTRING;
        struct DENMStoredInformationType usedStoredInformation;  // BITSTRING;
        struct OPT_BYTE_ASN confidenceValue;  // INTEGER, OPTIONAL, 1..101, unavailable(101);
    };
    
    struct DENMGeneralizedLanePosition {
        INT isValidFlag;   // necessary if this struct is used as an optional field of a SEQUENCE
        struct DENMLanePositionOptions lanePositionBased;  // CHOICE;
        struct DENMMapPosition mapBased;  // SEQUENCE, OPTIONAL;
        struct DENMMetaInformation confidence;  // SEQUENCE;
    };
    
    struct DENMGeneralizedLanePositions {
        INT isValidFlag;   // necessary if this struct is used as an optional field of a SEQUENCE
        INT length;
        struct DENMGeneralizedLanePosition arrayValue[4];  // SEQUENCE;
    };
    
    struct DENMOccupiedLanesWithConfidence_lanePositionBased {
        INT isValidFlag;   // necessary if this struct is used as an optional field of a SEQUENCE
        INT length;
        struct DENMLanePositionOptions arrayValue[4];  // CHOICE;
    };
    
    struct DENMOccupiedLanesWithConfidence_mapBased {
        INT isValidFlag;   // necessary if this struct is used as an optional field of a SEQUENCE
        INT length;
        struct DENMMapPosition arrayValue[4];  // SEQUENCE;
    };
    
    struct DENMOccupiedLanesWithConfidence {
        INT isValidFlag;   // necessary if this struct is used as an optional field of a SEQUENCE
        struct DENMOccupiedLanesWithConfidence_lanePositionBased lanePositionBased;  // SEQUENCEOF;
        struct DENMOccupiedLanesWithConfidence_mapBased mapBased;  // SEQUENCEOF, OPTIONAL;
        struct DENMMetaInformation confidence;  // SEQUENCE;
    };
    
    struct DENMCountryCode {
        INT isValidFlag;   // necessary if this struct is used as an optional field of a SEQUENCE
        CHAR string[11];
        INT  stringLength;
    };
    
    struct DENMProvider {
        INT isValidFlag;   // necessary if this struct is used as an optional field of a SEQUENCE
        struct DENMCountryCode countryCode;  // BITSTRING;
        WORD providerIdentifier;  // INTEGER, 0..16383;
    };
    
    struct DENMIvimReference {
        INT isValidFlag;   // necessary if this struct is used as an optional field of a SEQUENCE
        struct DENMProvider serviceProviderId;  // SEQUENCE;
        DWORD iviIdentificationNumber;  // INTEGER, 8388607..8388607;
    };
    
    struct DENMIvimReferences {
        INT isValidFlag;   // necessary if this struct is used as an optional field of a SEQUENCE
        INT length;
        struct DENMIvimReference arrayValue[8];  // SEQUENCE;
    };
    
    struct DENMMapReferences {
        INT isValidFlag;   // necessary if this struct is used as an optional field of a SEQUENCE
        INT length;
        struct DENMMapReference arrayValue[8];  // CHOICE;
    };
    
    struct DENMPathExtended {
        INT isValidFlag;   // necessary if this struct is used as an optional field of a SEQUENCE
        BYTE pointOfEventZone;  // INTEGER, 1..23;
        struct DENMPath path;  // SEQUENCEOF;
    };
    
    struct DENMTracesExtended {
        INT isValidFlag;   // necessary if this struct is used as an optional field of a SEQUENCE
        INT length;
        struct DENMPathExtended arrayValue[7];  // SEQUENCE;
    };
    
    struct DENMPathDeltaTimeChoice {
        INT isValidFlag;   // necessary if this struct is used as an optional field of a SEQUENCE
        INT choice;
        BYTE deltaTimeHighPrecision;  // INTEGER, 0..127, unavailable(127);
        BYTE deltaTimeBigRange;  // INTEGER, 0..127;
        DWORD deltaTimeMidRange;  // INTEGER, 0..86400;
    };
    
    struct DENMPathPointPredicted {
        INT isValidFlag;   // necessary if this struct is used as an optional field of a SEQUENCE
        LONG deltaLatitude;  // INTEGER, -131071..131072, unavailable(131072);
        LONG deltaLongitude;  // INTEGER, -131071..131072, unavailable(131072);
        struct DENMPosConfidenceEllipse horizontalPositionConfidence;  // SEQUENCE, OPTIONAL;
        struct OPT_INT_ASN deltaAltitude;  // INTEGER, OPTIONAL, -12700..12800, negativeOutOfRange(-12700), positiveOutOfRange(12799), unavailable(12800);
        struct OPT_ENUM_ASN altitudeConfidence;  // ENUMERATED, OPTIONAL, alt_000_01(0), alt_000_02(1), alt_000_05(2), alt_000_10(3), alt_000_20(4), alt_000_50(5), alt_001_00(6), alt_002_00(7), alt_005_00(8), alt_010_00(9), alt_020_00(10), alt_050_00(11), alt_100_00(12), alt_200_00(13), outOfRange(14), unavailable(15);
        struct DENMPathDeltaTimeChoice pathDeltaTime;  // CHOICE, OPTIONAL;
        struct OPT_WORD_ASN symmetricAreaOffset;  // INTEGER, OPTIONAL, 0..511;
        struct OPT_WORD_ASN asymmetricAreaOffset;  // INTEGER, OPTIONAL, 0..511;
    };
    
    struct DENMPathPredicted {
        INT isValidFlag;   // necessary if this struct is used as an optional field of a SEQUENCE
        INT length;
        struct DENMPathPointPredicted arrayValue[16];  // SEQUENCE;
    };
    
    struct DENMPathPredicted2 {
        INT isValidFlag;   // necessary if this struct is used as an optional field of a SEQUENCE
        struct DENMPathPredicted pathPredicted;  // SEQUENCEOF;
        INT usageIndication;  // ENUMERATED, noIndication(0), specialUse(1), rescueOperation(2), railroad(3), fixedRoute(4), restrictedRoute(5), adasAd(6), navigation(7);
        BYTE confidenceLevel;  // INTEGER, 1..101, unavailable(101);
    };
    
    struct DENMPathPredictedList {
        INT isValidFlag;   // necessary if this struct is used as an optional field of a SEQUENCE
        INT length;
        struct DENMPathPredicted2 arrayValue[16];  // SEQUENCE;
    };
    
    struct DENMLocationContainer {
        INT isValidFlag;   // necessary if this struct is used as an optional field of a SEQUENCE
        struct DENMSpeed eventSpeed;  // SEQUENCE, OPTIONAL;
        struct DENMWgs84Angle eventPositionHeading;  // SEQUENCE, OPTIONAL;
        struct DENMTraces traces;  // SEQUENCEOF;
        struct OPT_ENUM_ASN roadType;  // ENUMERATED, OPTIONAL, urban_NoStructuralSeparationToOppositeLanes(0), urban_WithStructuralSeparationToOppositeLanes(1), nonUrban_NoStructuralSeparationToOppositeLanes(2), nonUrban_WithStructuralSeparationToOppositeLanes(3);
        struct DENMGeneralizedLanePositions lanePositions;  // SEQUENCEOF, OPTIONAL;
        struct DENMOccupiedLanesWithConfidence occupiedLanes;  // SEQUENCE, OPTIONAL;
        struct DENMIvimReferences linkedIvims;  // SEQUENCEOF, OPTIONAL;
        struct DENMMapReferences linkedMapems;  // SEQUENCEOF, OPTIONAL;
        struct DENMTracesExtended detectionZonesToSpecifiedEventPoint;  // SEQUENCEOF, OPTIONAL;
        struct DENMPathPredictedList predictedPaths;  // SEQUENCEOF, OPTIONAL;
    };
    
    struct DENMPositionOfPillars {
        INT isValidFlag;   // necessary if this struct is used as an optional field of a SEQUENCE
        INT length;
        BYTE arrayValue[3];  // INTEGER, 1..30, outOfRange(29), unavailable(30);
    };
    
    struct DENMPositionOfOccupants {
        INT isValidFlag;   // necessary if this struct is used as an optional field of a SEQUENCE
        CHAR string[21];
        INT  stringLength;
    };
    
    struct DENMImpactReductionContainer {
        INT isValidFlag;   // necessary if this struct is used as an optional field of a SEQUENCE
        BYTE heightLonCarrLeft;  // INTEGER, 1..100, outOfRange(99), unavailable(100);
        BYTE heightLonCarrRight;  // INTEGER, 1..100, outOfRange(99), unavailable(100);
        BYTE posLonCarrLeft;  // INTEGER, 1..127, outOfRange(126), unavailable(127);
        BYTE posLonCarrRight;  // INTEGER, 1..127, outOfRange(126), unavailable(127);
        struct DENMPositionOfPillars positionOfPillars;  // SEQUENCEOF;
        BYTE posCentMass;  // INTEGER, 1..63, tenCentimetres(1), outOfRange(62), unavailable(63);
        BYTE wheelBaseVehicle;  // INTEGER, 1..127, outOfRange(126), unavailable(127);
        BYTE turningRadius;  // INTEGER, 1..255, outOfRange(254), unavailable(255);
        BYTE posFrontAx;  // INTEGER, 1..20, outOfRange(19), unavailable(20);
        struct DENMPositionOfOccupants positionOfOccupants;  // BITSTRING;
        WORD vehicleMass;  // INTEGER, 1..1024, outOfRange(1023), unavailable(1024);
        INT requestResponseIndication;  // ENUMERATED, request(0), response(1);
    };
    
    struct DENMLightBarSirenInUse {
        INT isValidFlag;   // necessary if this struct is used as an optional field of a SEQUENCE
        CHAR string[3];
        INT  stringLength;
    };
    
    struct DENMDrivingLaneStatus {
        INT isValidFlag;   // necessary if this struct is used as an optional field of a SEQUENCE
        CHAR string[14];
        INT  stringLength;
    };
    
    struct DENMClosedLanes {
        INT isValidFlag;   // necessary if this struct is used as an optional field of a SEQUENCE
        struct OPT_ENUM_ASN innerhardShoulderStatus;  // ENUMERATED, OPTIONAL, availableForStopping(0), closed(1), availableForDriving(2);
        struct OPT_ENUM_ASN outerhardShoulderStatus;  // ENUMERATED, OPTIONAL, availableForStopping(0), closed(1), availableForDriving(2);
        struct DENMDrivingLaneStatus drivingLaneStatus;  // BITSTRING, OPTIONAL;
    };
    
    struct DENMRestrictedTypes {
        INT isValidFlag;   // necessary if this struct is used as an optional field of a SEQUENCE
        INT length;
        BYTE arrayValue[3];  // INTEGER, 0..255, unknown(0), pedestrian(1), cyclist(2), moped(3), motorcycle(4), passengerCar(5), bus(6), lightTruck(7), heavyTruck(8), trailer(9), specialVehicle(10), tram(11), lightVruVehicle(12), animal(13), roadSideUnit(15);
    };
    
    struct DENMItineraryPath {
        INT isValidFlag;   // necessary if this struct is used as an optional field of a SEQUENCE
        INT length;
        struct DENMReferencePosition arrayValue[40];  // SEQUENCE;
    };
    
    struct DENMRoadWorksContainerExtended {
        INT isValidFlag;   // necessary if this struct is used as an optional field of a SEQUENCE
        struct DENMLightBarSirenInUse lightBarSirenInUse;  // BITSTRING, OPTIONAL;
        struct DENMClosedLanes closedLanes;  // SEQUENCE, OPTIONAL;
        struct DENMRestrictedTypes restriction;  // SEQUENCEOF, OPTIONAL;
        struct OPT_BYTE_ASN speedLimit;  // INTEGER, OPTIONAL, 1..255;
        struct DENMCauseCode incidentIndication;  // SEQUENCE, OPTIONAL;
        struct DENMItineraryPath recommendedPath;  // SEQUENCEOF, OPTIONAL;
        struct DENMDeltaReferencePosition startingPointSpeedLimit;  // SEQUENCE, OPTIONAL;
        struct OPT_ENUM_ASN trafficFlowRule;  // ENUMERATED, OPTIONAL, noPassing(0), noPassingForTrucks(1), passToRight(2), passToLeft(3), passToLeftOrRight(4);
        struct DENMActionIdList referenceDenms;  // SEQUENCEOF, OPTIONAL;
    };
    
    struct DENMDangerousGoodsExtended_emergencyActionCode {
        INT isValidFlag;   // necessary if this struct is used as an optional field of a SEQUENCE
        CHAR string[25];
        INT  stringLength;
    };
    
    struct DENMPhoneNumber {
        INT isValidFlag;   // necessary if this struct is used as an optional field of a SEQUENCE
        CHAR string[17];
        INT  stringLength;
    };
    
    struct DENMDangerousGoodsExtended_companyName {
        INT isValidFlag;   // necessary if this struct is used as an optional field of a SEQUENCE
        CHAR string[25];
        INT  stringLength;
    };
    
    struct DENMDangerousGoodsExtended {
        INT isValidFlag;   // necessary if this struct is used as an optional field of a SEQUENCE
        INT dangerousGoodsType;  // ENUMERATED, explosives1(0), explosives2(1), explosives3(2), explosives4(3), explosives5(4), explosives6(5), flammableGases(6), nonFlammableGases(7), toxicGases(8), flammableLiquids(9), flammableSolids(10), substancesLiableToSpontaneousCombustion(11), substancesEmittingFlammableGasesUponContactWithWater(12), oxidizingSubstances(13), organicPeroxides(14), toxicSubstances(15), infectiousSubstances(16), radioactiveMaterial(17), corrosiveSubstances(18), miscellaneousDangerousSubstances(19);
        WORD unNumber;  // INTEGER, 0..9999;
        INT elevatedTemperature;  // BOOLEAN;
        INT tunnelsRestricted;  // BOOLEAN;
        INT limitedQuantity;  // BOOLEAN;
        struct DENMDangerousGoodsExtended_emergencyActionCode emergencyActionCode;  // IA5STRING, OPTIONAL;
        struct DENMPhoneNumber phoneNumber;  // NUMERICSTRING, OPTIONAL;
        struct DENMDangerousGoodsExtended_companyName companyName;  // UTF8STRING, OPTIONAL;
    };
    
    struct DENMWMInumber {
        INT isValidFlag;   // necessary if this struct is used as an optional field of a SEQUENCE
        CHAR string[4];
        INT  stringLength;
    };
    
    struct DENMVDS {
        INT isValidFlag;   // necessary if this struct is used as an optional field of a SEQUENCE
        CHAR string[7];
        INT  stringLength;
    };
    
    struct DENMVehicleIdentification {
        INT isValidFlag;   // necessary if this struct is used as an optional field of a SEQUENCE
        struct DENMWMInumber wMInumber;  // IA5STRING, OPTIONAL;
        struct DENMVDS vDS;  // IA5STRING, OPTIONAL;
    };
    
    struct DENMEnergyStorageType {
        INT isValidFlag;   // necessary if this struct is used as an optional field of a SEQUENCE
        CHAR string[8];
        INT  stringLength;
    };
    
    struct DENMStationaryVehicleContainer {
        INT isValidFlag;   // necessary if this struct is used as an optional field of a SEQUENCE
        struct OPT_ENUM_ASN stationarySince;  // ENUMERATED, OPTIONAL, lessThan1Minute(0), lessThan2Minutes(1), lessThan15Minutes(2), equalOrGreater15Minutes(3);
        struct DENMCauseCode stationaryCause;  // SEQUENCE, OPTIONAL;
        struct DENMDangerousGoodsExtended carryingDangerousGoods;  // SEQUENCE, OPTIONAL;
        struct OPT_BYTE_ASN numberOfOccupants;  // INTEGER, OPTIONAL, 0..127, outOfRange(126), unavailable(127);
        struct DENMVehicleIdentification vehicleIdentification;  // SEQUENCE, OPTIONAL;
        struct DENMEnergyStorageType energyStorageType;  // BITSTRING, OPTIONAL;
    };
    
    struct DENMGeoPosition {
        INT isValidFlag;   // necessary if this struct is used as an optional field of a SEQUENCE
        LONG latitude;  // INTEGER, -900000000..900000001, unavailable(900000001);
        LONG longitude;  // INTEGER, -1800000000..1800000001, valueNotUsed(-1800000000), unavailable(1800000001);
        struct OPT_LONG_ASN altitude;  // INTEGER, OPTIONAL, -100000..800001, negativeOutOfRange(-100000), postiveOutOfRange(800000), unavailable(800001);
    };
    
    struct DENMPathReferences {
        INT isValidFlag;   // necessary if this struct is used as an optional field of a SEQUENCE
        INT length;
        BYTE arrayValue[14];  // INTEGER, 0..14, noPath(0), path1(1), path2(2), path3(3), path4(4), path5(5), path6(6), path7(7), pathExtended1(8), pathExtended2(9), pathExtended3(10), pathExtended4(11), pathExtended5(12), pathExtended6(13), pathExtended7(14);
    };
    
    struct DENMRoadSectionDefinition {
        INT isValidFlag;   // necessary if this struct is used as an optional field of a SEQUENCE
        struct DENMGeoPosition startingPointSection;  // SEQUENCE;
        struct OPT_WORD_ASN lengthOfSection;  // INTEGER, OPTIONAL, 0..65535;
        struct DENMGeoPosition endingPointSection;  // SEQUENCE, OPTIONAL;
        struct DENMPathReferences connectedPaths;  // SEQUENCEOF;
        struct DENMPathReferences includedPaths;  // SEQUENCEOF;
        INT isEventZoneIncluded;  // BOOLEAN;
        INT isEventZoneConnected;  // BOOLEAN;
    };
    
    struct DENMBasicLaneInformation {
        INT isValidFlag;   // necessary if this struct is used as an optional field of a SEQUENCE
        INT laneNumber;  // INTEGER, -1..14, offTheRoad(-1), innerHardShoulder(0), outerHardShoulder(14);
        BYTE direction;  // INTEGER, 0..3, sameDirection(0), oppositeDirection(1), bothDirections(2), unavailable(3);
        struct OPT_WORD_ASN laneWidth;  // INTEGER, OPTIONAL, 0..1023;
        struct OPT_INT_ASN connectingLane;  // INTEGER, OPTIONAL, -1..14, offTheRoad(-1), innerHardShoulder(0), outerHardShoulder(14);
        struct OPT_BYTE_ASN connectingRoadSection;  // INTEGER, OPTIONAL, 0..8;
    };
    
    struct DENMBasicLaneConfiguration {
        INT isValidFlag;   // necessary if this struct is used as an optional field of a SEQUENCE
        INT length;
        struct DENMBasicLaneInformation arrayValue[16];  // SEQUENCE;
    };
    
    struct DENMMapemLaneList {
        INT isValidFlag;   // necessary if this struct is used as an optional field of a SEQUENCE
        INT length;
        BYTE arrayValue[8];  // INTEGER, 0..255;
    };
    
    struct DENMMapemConnectionList {
        INT isValidFlag;   // necessary if this struct is used as an optional field of a SEQUENCE
        INT length;
        BYTE arrayValue[8];  // INTEGER, 0..255;
    };
    
    struct DENMMapemElementReference {
        INT isValidFlag;   // necessary if this struct is used as an optional field of a SEQUENCE
        struct DENMMapReference mapReference;  // CHOICE, OPTIONAL;
        struct DENMMapemLaneList laneIds;  // SEQUENCEOF, OPTIONAL;
        struct DENMMapemConnectionList connectionIds;  // SEQUENCEOF, OPTIONAL;
    };
    
    struct DENMMapemConfiguration {
        INT isValidFlag;   // necessary if this struct is used as an optional field of a SEQUENCE
        INT length;
        struct DENMMapemElementReference arrayValue[16];  // SEQUENCE;
    };
    
    struct DENMRoadConfigurationSection {
        INT isValidFlag;   // necessary if this struct is used as an optional field of a SEQUENCE
        struct DENMRoadSectionDefinition roadSectionDefinition;  // SEQUENCE;
        struct OPT_ENUM_ASN roadType;  // ENUMERATED, OPTIONAL, urban_NoStructuralSeparationToOppositeLanes(0), urban_WithStructuralSeparationToOppositeLanes(1), nonUrban_NoStructuralSeparationToOppositeLanes(2), nonUrban_WithStructuralSeparationToOppositeLanes(3);
        struct DENMBasicLaneConfiguration laneConfiguration;  // SEQUENCEOF, OPTIONAL;
        struct DENMMapemConfiguration mapemConfiguration;  // SEQUENCEOF, OPTIONAL;
    };
    
    struct DENMRoadConfigurationSectionList {
        INT isValidFlag;   // necessary if this struct is used as an optional field of a SEQUENCE
        INT length;
        struct DENMRoadConfigurationSection arrayValue[8];  // SEQUENCE;
    };
    
    struct DENMRoadConfigurationContainer {
        INT isValidFlag;   // necessary if this struct is used as an optional field of a SEQUENCE
        struct DENMMetaInformation roadConfigurationConfidence;  // SEQUENCE;
        struct DENMRoadConfigurationSectionList roadConfigurationSectionList;  // SEQUENCEOF;
    };
    
    struct DENMCartesianCoordinateWithConfidence {
        INT isValidFlag;   // necessary if this struct is used as an optional field of a SEQUENCE
        LONG value;  // INTEGER, -131072..131071, negativeOutOfRange(-131072), positiveOutOfRange(131071);
        WORD confidence;  // INTEGER, 1..4096, outOfRange(4095), unavailable(4096);
    };
    
    struct DENMCartesianPosition3dWithConfidence {
        INT isValidFlag;   // necessary if this struct is used as an optional field of a SEQUENCE
        struct DENMCartesianCoordinateWithConfidence xCoordinate;  // SEQUENCE;
        struct DENMCartesianCoordinateWithConfidence yCoordinate;  // SEQUENCE;
        struct DENMCartesianCoordinateWithConfidence zCoordinate;  // SEQUENCE, OPTIONAL;
    };
    
    struct DENMCartesianAngle {
        INT isValidFlag;   // necessary if this struct is used as an optional field of a SEQUENCE
        WORD value;  // INTEGER, 0..3601, valueNotUsed(3600), unavailable(3601);
        BYTE confidence;  // INTEGER, 1..127, outOfRange(126), unavailable(127);
    };
    
    struct DENMVelocityComponent {
        INT isValidFlag;   // necessary if this struct is used as an optional field of a SEQUENCE
        INT value;  // INTEGER, -16383..16383, negativeOutOfRange(-16383), positiveOutOfRange(16382), unavailable(16383);
        BYTE confidence;  // INTEGER, 1..127, outOfRange(126), unavailable(127);
    };
    
    struct DENMVelocityPolarWithZ {
        INT isValidFlag;   // necessary if this struct is used as an optional field of a SEQUENCE
        struct DENMSpeed velocityMagnitude;  // SEQUENCE;
        struct DENMCartesianAngle velocityDirection;  // SEQUENCE;
        struct DENMVelocityComponent zVelocity;  // SEQUENCE, OPTIONAL;
    };
    
    struct DENMVelocityCartesian {
        INT isValidFlag;   // necessary if this struct is used as an optional field of a SEQUENCE
        struct DENMVelocityComponent xVelocity;  // SEQUENCE;
        struct DENMVelocityComponent yVelocity;  // SEQUENCE;
        struct DENMVelocityComponent zVelocity;  // SEQUENCE, OPTIONAL;
    };
    
    struct DENMVelocity3dWithConfidence {
        INT isValidFlag;   // necessary if this struct is used as an optional field of a SEQUENCE
        INT choice;
        struct DENMVelocityPolarWithZ polarVelocity;  // SEQUENCE;
        struct DENMVelocityCartesian cartesianVelocity;  // SEQUENCE;
    };
    
    struct DENMAccelerationMagnitude {
        INT isValidFlag;   // necessary if this struct is used as an optional field of a SEQUENCE
        BYTE accelerationMagnitudeValue;  // INTEGER, 0..161, positiveOutOfRange(160), unavailable(161);
        BYTE accelerationConfidence;  // INTEGER, 0..102, outOfRange(101), unavailable(102);
    };
    
    struct DENMAccelerationComponent {
        INT isValidFlag;   // necessary if this struct is used as an optional field of a SEQUENCE
        INT value;  // INTEGER, -160..161, negativeOutOfRange(-160), positiveOutOfRange(160), unavailable(161);
        BYTE confidence;  // INTEGER, 0..102, outOfRange(101), unavailable(102);
    };
    
    struct DENMAccelerationPolarWithZ {
        INT isValidFlag;   // necessary if this struct is used as an optional field of a SEQUENCE
        struct DENMAccelerationMagnitude accelerationMagnitude;  // SEQUENCE;
        struct DENMCartesianAngle accelerationDirection;  // SEQUENCE;
        struct DENMAccelerationComponent zAcceleration;  // SEQUENCE, OPTIONAL;
    };
    
    struct DENMAccelerationCartesian {
        INT isValidFlag;   // necessary if this struct is used as an optional field of a SEQUENCE
        struct DENMAccelerationComponent xAcceleration;  // SEQUENCE;
        struct DENMAccelerationComponent yAcceleration;  // SEQUENCE;
        struct DENMAccelerationComponent zAcceleration;  // SEQUENCE, OPTIONAL;
    };
    
    struct DENMAcceleration3dWithConfidence {
        INT isValidFlag;   // necessary if this struct is used as an optional field of a SEQUENCE
        INT choice;
        struct DENMAccelerationPolarWithZ polarAcceleration;  // SEQUENCE;
        struct DENMAccelerationCartesian cartesianAcceleration;  // SEQUENCE;
    };
    
    struct DENMEulerAnglesWithConfidence {
        INT isValidFlag;   // necessary if this struct is used as an optional field of a SEQUENCE
        struct DENMCartesianAngle zAngle;  // SEQUENCE;
        struct DENMCartesianAngle yAngle;  // SEQUENCE, OPTIONAL;
        struct DENMCartesianAngle xAngle;  // SEQUENCE, OPTIONAL;
    };
    
    struct DENMCartesianAngularVelocityComponent {
        INT isValidFlag;   // necessary if this struct is used as an optional field of a SEQUENCE
        INT value;  // INTEGER, -255..256, negativeOutofRange(-255), positiveOutOfRange(255), unavailable(256);
        INT confidence;  // ENUMERATED, degSec_01(0), degSec_02(1), degSec_05(2), degSec_10(3), degSec_20(4), degSec_50(5), outOfRange(6), unavailable(7);
    };
    
    struct DENMMatrixIncludedComponents {
        INT isValidFlag;   // necessary if this struct is used as an optional field of a SEQUENCE
        CHAR string[14];
        INT  stringLength;
    };
    
    struct DENMCorrelationColumn {
        INT isValidFlag;   // necessary if this struct is used as an optional field of a SEQUENCE
        INT length;
        INT arrayValue[13];  // INTEGER, -100..101, full_negative_correlation(-100), no_correlation(0), full_positive_correlation(100), unavailable(101);
    };
    
    struct DENMLowerTriangularPositiveSemidefiniteMatrixColumns {
        INT isValidFlag;   // necessary if this struct is used as an optional field of a SEQUENCE
        INT length;
        struct DENMCorrelationColumn arrayValue[13];  // SEQUENCEOF;
    };
    
    struct DENMLowerTriangularPositiveSemidefiniteMatrix {
        INT isValidFlag;   // necessary if this struct is used as an optional field of a SEQUENCE
        struct DENMMatrixIncludedComponents componentsIncludedIntheMatrix;  // BITSTRING;
        struct DENMLowerTriangularPositiveSemidefiniteMatrixColumns matrix;  // SEQUENCEOF;
    };
    
    struct DENMLowerTriangularPositiveSemidefiniteMatrices {
        INT isValidFlag;   // necessary if this struct is used as an optional field of a SEQUENCE
        INT length;
        struct DENMLowerTriangularPositiveSemidefiniteMatrix arrayValue[4];  // SEQUENCE;
    };
    
    struct DENMObjectDimension {
        INT isValidFlag;   // necessary if this struct is used as an optional field of a SEQUENCE
        WORD value;  // INTEGER, 1..256, outOfRange(255), unavailable(256);
        BYTE confidence;  // INTEGER, 1..32, outOfRange(31), unavailable(32);
    };
    
    struct DENMSequenceOfIdentifier1B {
        INT isValidFlag;   // necessary if this struct is used as an optional field of a SEQUENCE
        INT length;
        BYTE arrayValue[128];  // INTEGER, 0..255;
    };
    
    struct DENMVruProfileAndSubprofile {
        INT isValidFlag;   // necessary if this struct is used as an optional field of a SEQUENCE
        INT choice;
        BYTE pedestrian;  // INTEGER, 0..15, unavailable(0), ordinary_pedestrian(1), road_worker(2), first_responder(3);
        BYTE bicyclistAndLightVruVehicle;  // INTEGER, 0..15, unavailable(0), bicyclist(1), wheelchair_user(2), horse_and_rider(3), rollerskater(4), e_scooter(5), personal_transporter(6), pedelec(7), speed_pedelec(8), roadbike(9), childrensbike(10);
        BYTE motorcyclist;  // INTEGER, 0..15, unavailable(0), moped(1), motorcycle(2), motorcycle_and_sidecar_right(3), motorcycle_and_sidecar_left(4);
        BYTE animal;  // INTEGER, 0..15, unavailable(0), wild_animal(1), farm_animal(2), service_animal(3);
    };
    
    struct DENMCartesianPosition3d {
        INT isValidFlag;   // necessary if this struct is used as an optional field of a SEQUENCE
        INT xCoordinate;  // INTEGER, -32768..32767, negativeOutOfRange(-32768), positiveOutOfRange(32767);
        INT yCoordinate;  // INTEGER, -32768..32767, negativeOutOfRange(-32768), positiveOutOfRange(32767);
        struct OPT_INT_ASN zCoordinate;  // INTEGER, OPTIONAL, -32768..32767, negativeOutOfRange(-32768), positiveOutOfRange(32767);
    };
    
    struct DENMRectangularShape {
        INT isValidFlag;   // necessary if this struct is used as an optional field of a SEQUENCE
        struct DENMCartesianPosition3d shapeReferencePoint;  // SEQUENCE, OPTIONAL;
        WORD semiLength;  // INTEGER, 0..4095;
        WORD semiBreadth;  // INTEGER, 0..4095;
        struct OPT_WORD_ASN orientation;  // INTEGER, OPTIONAL, 0..3601, valueNotUsed(3600), unavailable(3601);
        struct OPT_WORD_ASN height;  // INTEGER, OPTIONAL, 0..4095;
    };
    
    struct DENMCircularShape {
        INT isValidFlag;   // necessary if this struct is used as an optional field of a SEQUENCE
        struct DENMCartesianPosition3d shapeReferencePoint;  // SEQUENCE, OPTIONAL;
        WORD radius;  // INTEGER, 0..4095;
        struct OPT_WORD_ASN height;  // INTEGER, OPTIONAL, 0..4095;
    };
    
    struct DENMSequenceOfCartesianPosition3d {
        INT isValidFlag;   // necessary if this struct is used as an optional field of a SEQUENCE
        INT length;
        struct DENMCartesianPosition3d arrayValue[16];  // SEQUENCE;
    };
    
    struct DENMPolygonalShape {
        INT isValidFlag;   // necessary if this struct is used as an optional field of a SEQUENCE
        struct DENMCartesianPosition3d shapeReferencePoint;  // SEQUENCE, OPTIONAL;
        struct DENMSequenceOfCartesianPosition3d polygon;  // SEQUENCEOF;
        struct OPT_WORD_ASN height;  // INTEGER, OPTIONAL, 0..4095;
    };
    
    struct DENMEllipticalShape {
        INT isValidFlag;   // necessary if this struct is used as an optional field of a SEQUENCE
        struct DENMCartesianPosition3d shapeReferencePoint;  // SEQUENCE, OPTIONAL;
        WORD semiMajorAxisLength;  // INTEGER, 0..4095;
        WORD semiMinorAxisLength;  // INTEGER, 0..4095;
        struct OPT_WORD_ASN orientation;  // INTEGER, OPTIONAL, 0..3601, valueNotUsed(3600), unavailable(3601);
        struct OPT_WORD_ASN height;  // INTEGER, OPTIONAL, 0..4095;
    };
    
    struct DENMRadialShape {
        INT isValidFlag;   // necessary if this struct is used as an optional field of a SEQUENCE
        struct DENMCartesianPosition3d shapeReferencePoint;  // SEQUENCE, OPTIONAL;
        WORD range;  // INTEGER, 0..4095;
        WORD horizontalOpeningAngleStart;  // INTEGER, 0..3601, valueNotUsed(3600), unavailable(3601);
        WORD horizontalOpeningAngleEnd;  // INTEGER, 0..3601, valueNotUsed(3600), unavailable(3601);
        struct OPT_WORD_ASN verticalOpeningAngleStart;  // INTEGER, OPTIONAL, 0..3601, valueNotUsed(3600), unavailable(3601);
        struct OPT_WORD_ASN verticalOpeningAngleEnd;  // INTEGER, OPTIONAL, 0..3601, valueNotUsed(3600), unavailable(3601);
    };
    
    struct DENMRadialShapeDetails {
        INT isValidFlag;   // necessary if this struct is used as an optional field of a SEQUENCE
        WORD range;  // INTEGER, 0..4095;
        WORD horizontalOpeningAngleStart;  // INTEGER, 0..3601, valueNotUsed(3600), unavailable(3601);
        WORD horizontalOpeningAngleEnd;  // INTEGER, 0..3601, valueNotUsed(3600), unavailable(3601);
        struct OPT_WORD_ASN verticalOpeningAngleStart;  // INTEGER, OPTIONAL, 0..3601, valueNotUsed(3600), unavailable(3601);
        struct OPT_WORD_ASN verticalOpeningAngleEnd;  // INTEGER, OPTIONAL, 0..3601, valueNotUsed(3600), unavailable(3601);
    };
    
    struct DENMRadialShapesList {
        INT isValidFlag;   // necessary if this struct is used as an optional field of a SEQUENCE
        INT length;
        struct DENMRadialShapeDetails arrayValue[16];  // SEQUENCE;
    };
    
    struct DENMRadialShapes {
        INT isValidFlag;   // necessary if this struct is used as an optional field of a SEQUENCE
        BYTE refPointId;  // INTEGER, 0..255;
        INT xCoordinate;  // INTEGER, -3094..1001, negativeOutOfRange(-3094), positiveOutOfRange(1001);
        INT yCoordinate;  // INTEGER, -3094..1001, negativeOutOfRange(-3094), positiveOutOfRange(1001);
        struct OPT_INT_ASN zCoordinate;  // INTEGER, OPTIONAL, -3094..1001, negativeOutOfRange(-3094), positiveOutOfRange(1001);
        struct DENMRadialShapesList radialShapesList;  // SEQUENCEOF;
    };
    
    struct DENMShape {
        INT isValidFlag;   // necessary if this struct is used as an optional field of a SEQUENCE
        INT choice;
        struct DENMRectangularShape rectangular;  // SEQUENCE;
        struct DENMCircularShape circular;  // SEQUENCE;
        struct DENMPolygonalShape polygonal;  // SEQUENCE;
        struct DENMEllipticalShape elliptical;  // SEQUENCE;
        struct DENMRadialShape radial;  // SEQUENCE;
        struct DENMRadialShapes radialShapes;  // SEQUENCE;
    };
    
    struct DENMVruClusterProfiles {
        INT isValidFlag;   // necessary if this struct is used as an optional field of a SEQUENCE
        CHAR string[5];
        INT  stringLength;
    };
    
    struct DENMVruClusterInformation {
        INT isValidFlag;   // necessary if this struct is used as an optional field of a SEQUENCE
        struct OPT_BYTE_ASN clusterId;  // INTEGER, OPTIONAL, 0..255;
        struct DENMShape clusterBoundingBoxShape;  // CHOICE, OPTIONAL;
        BYTE clusterCardinalitySize;  // INTEGER, 0..255;
        struct DENMVruClusterProfiles clusterProfiles;  // BITSTRING, OPTIONAL;
    };
    
    struct DENMObjectClass {
        INT isValidFlag;   // necessary if this struct is used as an optional field of a SEQUENCE
        INT choice;
        BYTE vehicleSubClass;  // INTEGER, 0..255, unknown(0), pedestrian(1), cyclist(2), moped(3), motorcycle(4), passengerCar(5), bus(6), lightTruck(7), heavyTruck(8), trailer(9), specialVehicle(10), tram(11), lightVruVehicle(12), animal(13), agricultural(14), roadSideUnit(15);
        struct DENMVruProfileAndSubprofile vruSubClass;  // CHOICE;
        struct DENMVruClusterInformation groupSubClass;  // SEQUENCE;
        BYTE otherSubClass;  // INTEGER, 0..255, unknown(0), singleObject(1), multipleObjects(2), bulkMaterial(3);
    };
    
    struct DENMObjectClassWithConfidence {
        INT isValidFlag;   // necessary if this struct is used as an optional field of a SEQUENCE
        struct DENMObjectClass objectClass;  // CHOICE;
        BYTE confidence;  // INTEGER, 1..101, unavailable(101);
    };
    
    struct DENMObjectClassDescription {
        INT isValidFlag;   // necessary if this struct is used as an optional field of a SEQUENCE
        INT length;
        struct DENMObjectClassWithConfidence arrayValue[8];  // SEQUENCE;
    };
    
    struct DENMPerceivedObject {
        INT isValidFlag;   // necessary if this struct is used as an optional field of a SEQUENCE
        struct OPT_WORD_ASN objectID;  // INTEGER, OPTIONAL, 0..65535;
        INT measurementDeltaTime;  // INTEGER, -2048..2047;
        struct DENMCartesianPosition3dWithConfidence position;  // SEQUENCE;
        struct DENMVelocity3dWithConfidence velocity;  // CHOICE, OPTIONAL;
        struct DENMAcceleration3dWithConfidence acceleration;  // CHOICE, OPTIONAL;
        struct DENMEulerAnglesWithConfidence angles;  // SEQUENCE, OPTIONAL;
        struct DENMCartesianAngularVelocityComponent zAngularVelocity;  // SEQUENCE, OPTIONAL;
        struct DENMLowerTriangularPositiveSemidefiniteMatrices lowerTriangularCorrelationMatrices;  // SEQUENCEOF, OPTIONAL;
        struct DENMObjectDimension objectDimensionZ;  // SEQUENCE, OPTIONAL;
        struct DENMObjectDimension objectDimensionY;  // SEQUENCE, OPTIONAL;
        struct DENMObjectDimension objectDimensionX;  // SEQUENCE, OPTIONAL;
        struct OPT_INT_ASN objectAge;  // INTEGER, OPTIONAL, -2048..2047;
        struct OPT_BYTE_ASN objectPerceptionQuality;  // INTEGER, OPTIONAL, 0..15, noConfidence(0), fullConfidence(15);
        struct DENMSequenceOfIdentifier1B sensorIdList;  // SEQUENCEOF, OPTIONAL;
        struct DENMObjectClassDescription classification;  // SEQUENCEOF, OPTIONAL;
        struct DENMMapPosition mapPosition;  // SEQUENCE, OPTIONAL;
    };
    
    struct DENMPreCrashContainer {
        INT isValidFlag;   // necessary if this struct is used as an optional field of a SEQUENCE
        struct DENMPerceivedObject perceivedPreCrashObject;  // SEQUENCE;
        struct OPT_DWORD_ASN objectStationId;  // INTEGER, OPTIONAL, 0..4294967295;
        struct OPT_WORD_ASN timeToCollision;  // INTEGER, OPTIONAL, 1..10000;
        struct OPT_ENUM_ASN impactSection;  // ENUMERATED, OPTIONAL, front(0), sideLeftFront(1), sideLeftBack(2), sideRightFront(3), sideRightBack(4), back(5);
        struct OPT_WORD_ASN estimatedBrakingDistance;  // INTEGER, OPTIONAL, 0..4095;
    };
    
    struct DENMAlacarteContainer {
        INT isValidFlag;   // necessary if this struct is used as an optional field of a SEQUENCE
        struct OPT_INT_ASN lanePosition;  // INTEGER, OPTIONAL, -1..14, offTheRoad(-1), innerHardShoulder(0), outerHardShoulder(14);
        struct DENMImpactReductionContainer impactReduction;  // SEQUENCE, OPTIONAL;
        struct OPT_INT_ASN externalTemperature;  // INTEGER, OPTIONAL, -60..67, equalOrSmallerThanMinus60Deg(-60), equalOrGreaterThan67Deg(67);
        struct DENMRoadWorksContainerExtended roadWorks;  // SEQUENCE, OPTIONAL;
        struct OPT_ENUM_ASN positioningSolution;  // ENUMERATED, OPTIONAL, noPositioningSolution(0), sGNSS(1), dGNSS(2), sGNSSplusDR(3), dGNSSplusDR(4), dR(5), manuallyByOperator(6);
        struct DENMStationaryVehicleContainer stationaryVehicle;  // SEQUENCE, OPTIONAL;
        struct DENMRoadConfigurationContainer roadConfiguration;  // SEQUENCE, OPTIONAL;
        struct DENMPreCrashContainer preCrash;  // SEQUENCE, OPTIONAL;
    };
    
    struct DENMDenmPayload {
        INT isValidFlag;   // necessary if this struct is used as an optional field of a SEQUENCE
        struct DENMManagementContainer management;  // SEQUENCE;
        struct DENMSituationContainer situation;  // SEQUENCE, OPTIONAL;
        struct DENMLocationContainer location;  // SEQUENCE, OPTIONAL;
        struct DENMAlacarteContainer alacarte;  // SEQUENCE, OPTIONAL;
    };
    
    struct DENM {
        INT isValidFlag;   // necessary if this struct is used as an optional field of a SEQUENCE
        struct DENMItsPduHeader header;  // SEQUENCE;
        struct DENMDenmPayload denm;  // SEQUENCE;
    };
    
}

/*
// init function to create a simple packet handle
*/ 
LONG API_InitDENMPacket()
{
  return C2xInitPacket("DENM"); 
}

/*
// init function to create a simple packet handle and
// initialize the struct with valid data
*/ 
LONG API_InitDENMPacket(struct DENM msgStruct)
{
  long pktHandle;

  pktHandle = API_InitDENMPacket();

  if (pktHandle != 0)
  {
    // create valid message and application data
    if (C2xCompletePacket(pktHandle) == 0) 
    {
      API_GetDENMParams(pktHandle, msgStruct);
    }
  }
  return pktHandle;
}

/*
// init function to create a packet with security layer and
// initialize the struct with valid data
*/ 
LONG API_InitDENMPacket(struct DENM msgStruct, char packetTypeDesignator[], char certificateName[])
{
  long pktHandle, certHdl;

  // initialize the packet
  pktHandle = C2xInitPacket("DENM", packetTypeDesignator);

  if (pktHandle != 0)
  {
    certHdl = C2xSecCertificateGetHandle(certificateName);  // get the certificate handle for the cert with name "certificateName"
    if (certHdl != 0) 
    {
      C2xSecPacketSetSignerHandle(pktHandle, certHdl); // set the certHdl to the packet
    }

    // create valid message and application data
    if (C2xCompletePacket(pktHandle) == 0) 
    {
      // copy application data to the application structure
      API_GetDENMParams(pktHandle, msgStruct);
    }
  }
  return pktHandle;
}
    

int GetDENMItsPduHeaderParams(LONG packetHandle, struct DENMItsPduHeader value, char oldPath[])
{
  char newPath[300];
  int result;

  result = 0;

  snprintf(newPath, elcount(newPath), "%s.%s", oldPath, "protocolVersion");
  value.protocolVersion = C2xGetTokenInt(packetHandle, "DENM", newPath);
  result = CheckLastError("DENM", gkFuncRefGet, result);

  snprintf(newPath, elcount(newPath), "%s.%s", oldPath, "messageID");
  value.messageID = C2xGetTokenInt(packetHandle, "DENM", newPath);
  result = CheckLastError("DENM", gkFuncRefGet, result);

  snprintf(newPath, elcount(newPath), "%s.%s", oldPath, "stationID");
  value.stationID = C2xGetTokenInt64(packetHandle, "DENM", newPath);
  result = CheckLastError("DENM", gkFuncRefGet, result);

  return result;
}

int SetDENMItsPduHeaderParams(LONG packetHandle, struct DENMItsPduHeader value, char oldPath[])
{
  char newPath[300];
  int result;

  result = 0;

  snprintf(newPath, elcount(newPath), "%s.%s", oldPath, "protocolVersion");
  C2xSetTokenInt(packetHandle, "DENM", newPath, value.protocolVersion);
  result = CheckLastError("DENM", gkFuncRefGet, result);

  snprintf(newPath, elcount(newPath), "%s.%s", oldPath, "messageID");
  C2xSetTokenInt(packetHandle, "DENM", newPath, value.messageID);
  result = CheckLastError("DENM", gkFuncRefGet, result);

  snprintf(newPath, elcount(newPath), "%s.%s", oldPath, "stationID");
  C2xSetTokenInt64(packetHandle, "DENM", newPath, value.stationID);
  result = CheckLastError("DENM", gkFuncRefGet, result);

  return result;
}

int GetDENMActionIDParams(LONG packetHandle, struct DENMActionID value, char oldPath[])
{
  char newPath[300];
  int result;

  result = 0;

  snprintf(newPath, elcount(newPath), "%s.%s", oldPath, "originatingStationID");
  value.originatingStationID = C2xGetTokenInt64(packetHandle, "DENM", newPath);
  result = CheckLastError("DENM", gkFuncRefGet, result);

  snprintf(newPath, elcount(newPath), "%s.%s", oldPath, "sequenceNumber");
  value.sequenceNumber = C2xGetTokenInt(packetHandle, "DENM", newPath);
  result = CheckLastError("DENM", gkFuncRefGet, result);

  return result;
}

int SetDENMActionIDParams(LONG packetHandle, struct DENMActionID value, char oldPath[])
{
  char newPath[300];
  int result;

  result = 0;

  snprintf(newPath, elcount(newPath), "%s.%s", oldPath, "originatingStationID");
  C2xSetTokenInt64(packetHandle, "DENM", newPath, value.originatingStationID);
  result = CheckLastError("DENM", gkFuncRefGet, result);

  snprintf(newPath, elcount(newPath), "%s.%s", oldPath, "sequenceNumber");
  C2xSetTokenInt(packetHandle, "DENM", newPath, value.sequenceNumber);
  result = CheckLastError("DENM", gkFuncRefGet, result);

  return result;
}

int GetDENMPosConfidenceEllipseParams(LONG packetHandle, struct DENMPosConfidenceEllipse value, char oldPath[])
{
  char newPath[300];
  int result;

  result = 0;

  snprintf(newPath, elcount(newPath), "%s.%s", oldPath, "semiMajorConfidence");
  value.semiMajorConfidence = C2xGetTokenInt(packetHandle, "DENM", newPath);
  result = CheckLastError("DENM", gkFuncRefGet, result);

  snprintf(newPath, elcount(newPath), "%s.%s", oldPath, "semiMinorConfidence");
  value.semiMinorConfidence = C2xGetTokenInt(packetHandle, "DENM", newPath);
  result = CheckLastError("DENM", gkFuncRefGet, result);

  snprintf(newPath, elcount(newPath), "%s.%s", oldPath, "semiMajorOrientation");
  value.semiMajorOrientation = C2xGetTokenInt(packetHandle, "DENM", newPath);
  result = CheckLastError("DENM", gkFuncRefGet, result);

  return result;
}

int SetDENMPosConfidenceEllipseParams(LONG packetHandle, struct DENMPosConfidenceEllipse value, char oldPath[])
{
  char newPath[300];
  int result;

  result = 0;

  snprintf(newPath, elcount(newPath), "%s.%s", oldPath, "semiMajorConfidence");
  C2xSetTokenInt(packetHandle, "DENM", newPath, value.semiMajorConfidence);
  result = CheckLastError("DENM", gkFuncRefGet, result);

  snprintf(newPath, elcount(newPath), "%s.%s", oldPath, "semiMinorConfidence");
  C2xSetTokenInt(packetHandle, "DENM", newPath, value.semiMinorConfidence);
  result = CheckLastError("DENM", gkFuncRefGet, result);

  snprintf(newPath, elcount(newPath), "%s.%s", oldPath, "semiMajorOrientation");
  C2xSetTokenInt(packetHandle, "DENM", newPath, value.semiMajorOrientation);
  result = CheckLastError("DENM", gkFuncRefGet, result);

  return result;
}

int GetDENMAltitudeParams(LONG packetHandle, struct DENMAltitude value, char oldPath[])
{
  char newPath[300];
  int result;

  result = 0;

  snprintf(newPath, elcount(newPath), "%s.%s", oldPath, "altitudeValue");
  value.altitudeValue = C2xGetTokenInt(packetHandle, "DENM", newPath);
  result = CheckLastError("DENM", gkFuncRefGet, result);

  snprintf(newPath, elcount(newPath), "%s.%s", oldPath, "altitudeConfidence");
  value.altitudeConfidence = C2xGetTokenInt(packetHandle, "DENM", newPath);
  result = CheckLastError("DENM", gkFuncRefGet, result);

  return result;
}

int SetDENMAltitudeParams(LONG packetHandle, struct DENMAltitude value, char oldPath[])
{
  char newPath[300];
  int result;

  result = 0;

  snprintf(newPath, elcount(newPath), "%s.%s", oldPath, "altitudeValue");
  C2xSetTokenInt(packetHandle, "DENM", newPath, value.altitudeValue);
  result = CheckLastError("DENM", gkFuncRefGet, result);

  snprintf(newPath, elcount(newPath), "%s.%s", oldPath, "altitudeConfidence");
  C2xSetTokenInt(packetHandle, "DENM", newPath, value.altitudeConfidence);
  result = CheckLastError("DENM", gkFuncRefGet, result);

  return result;
}

int GetDENMReferencePositionParams(LONG packetHandle, struct DENMReferencePosition value, char oldPath[])
{
  char newPath[300];
  int result;

  result = 0;

  snprintf(newPath, elcount(newPath), "%s.%s", oldPath, "latitude");
  value.latitude = C2xGetTokenInt(packetHandle, "DENM", newPath);
  result = CheckLastError("DENM", gkFuncRefGet, result);

  snprintf(newPath, elcount(newPath), "%s.%s", oldPath, "longitude");
  value.longitude = C2xGetTokenInt(packetHandle, "DENM", newPath);
  result = CheckLastError("DENM", gkFuncRefGet, result);

  snprintf(newPath, elcount(newPath), "%s.%s", oldPath, "positionConfidenceEllipse");
  GetDENMPosConfidenceEllipseParams(packetHandle, value.positionConfidenceEllipse, newPath);
  result = CheckLastError("DENM", gkFuncRefGet, result);

  snprintf(newPath, elcount(newPath), "%s.%s", oldPath, "altitude");
  GetDENMAltitudeParams(packetHandle, value.altitude, newPath);
  result = CheckLastError("DENM", gkFuncRefGet, result);

  return result;
}

int SetDENMReferencePositionParams(LONG packetHandle, struct DENMReferencePosition value, char oldPath[])
{
  char newPath[300];
  int result;

  result = 0;

  snprintf(newPath, elcount(newPath), "%s.%s", oldPath, "latitude");
  C2xSetTokenInt(packetHandle, "DENM", newPath, value.latitude);
  result = CheckLastError("DENM", gkFuncRefGet, result);

  snprintf(newPath, elcount(newPath), "%s.%s", oldPath, "longitude");
  C2xSetTokenInt(packetHandle, "DENM", newPath, value.longitude);
  result = CheckLastError("DENM", gkFuncRefGet, result);

  snprintf(newPath, elcount(newPath), "%s.%s", oldPath, "positionConfidenceEllipse");
  SetDENMPosConfidenceEllipseParams(packetHandle, value.positionConfidenceEllipse, newPath);
  result = CheckLastError("DENM", gkFuncRefGet, result);

  snprintf(newPath, elcount(newPath), "%s.%s", oldPath, "altitude");
  SetDENMAltitudeParams(packetHandle, value.altitude, newPath);
  result = CheckLastError("DENM", gkFuncRefGet, result);

  return result;
}

int GetDENMManagementContainerParams(LONG packetHandle, struct DENMManagementContainer value, char oldPath[])
{
  char newPath[300];
  int result;

  result = 0;

  snprintf(newPath, elcount(newPath), "%s.%s", oldPath, "actionID");
  GetDENMActionIDParams(packetHandle, value.actionID, newPath);
  result = CheckLastError("DENM", gkFuncRefGet, result);

  snprintf(newPath, elcount(newPath), "%s.%s", oldPath, "detectionTime");
  value.detectionTime = C2xGetTokenInt64(packetHandle, "DENM", newPath);
  result = CheckLastError("DENM", gkFuncRefGet, result);

  snprintf(newPath, elcount(newPath), "%s.%s", oldPath, "referenceTime");
  value.referenceTime = C2xGetTokenInt64(packetHandle, "DENM", newPath);
  result = CheckLastError("DENM", gkFuncRefGet, result);

  snprintf(newPath, elcount(newPath), "%s.%s", oldPath, "termination");
  value.termination.isValidFlag = C2xIsTokenAvailable(packetHandle, "DENM", newPath);
  if(value.termination.isValidFlag==1)
  {
    value.termination.value = C2xGetTokenInt(packetHandle, "DENM", newPath);
    result = CheckLastError("DENM", gkFuncRefGet, result);
  }
  snprintf(newPath, elcount(newPath), "%s.%s", oldPath, "eventPosition");
  GetDENMReferencePositionParams(packetHandle, value.eventPosition, newPath);
  result = CheckLastError("DENM", gkFuncRefGet, result);

  snprintf(newPath, elcount(newPath), "%s.%s", oldPath, "relevanceDistance");
  value.relevanceDistance.isValidFlag = C2xIsTokenAvailable(packetHandle, "DENM", newPath);
  if(value.relevanceDistance.isValidFlag==1)
  {
    value.relevanceDistance.value = C2xGetTokenInt(packetHandle, "DENM", newPath);
    result = CheckLastError("DENM", gkFuncRefGet, result);
  }
  snprintf(newPath, elcount(newPath), "%s.%s", oldPath, "relevanceTrafficDirection");
  value.relevanceTrafficDirection.isValidFlag = C2xIsTokenAvailable(packetHandle, "DENM", newPath);
  if(value.relevanceTrafficDirection.isValidFlag==1)
  {
    value.relevanceTrafficDirection.value = C2xGetTokenInt(packetHandle, "DENM", newPath);
    result = CheckLastError("DENM", gkFuncRefGet, result);
  }
  snprintf(newPath, elcount(newPath), "%s.%s", oldPath, "validityDuration");
  value.validityDuration.isValidFlag = C2xIsTokenAvailable(packetHandle, "DENM", newPath);
  if(value.validityDuration.isValidFlag==1)
  {
    value.validityDuration.value = C2xGetTokenInt(packetHandle, "DENM", newPath);
    result = CheckLastError("DENM", gkFuncRefGet, result);
  }
  snprintf(newPath, elcount(newPath), "%s.%s", oldPath, "transmissionInterval");
  value.transmissionInterval.isValidFlag = C2xIsTokenAvailable(packetHandle, "DENM", newPath);
  if(value.transmissionInterval.isValidFlag==1)
  {
    value.transmissionInterval.value = C2xGetTokenInt(packetHandle, "DENM", newPath);
    result = CheckLastError("DENM", gkFuncRefGet, result);
  }
  snprintf(newPath, elcount(newPath), "%s.%s", oldPath, "stationType");
  value.stationType = C2xGetTokenInt(packetHandle, "DENM", newPath);
  result = CheckLastError("DENM", gkFuncRefGet, result);

  return result;
}

int SetDENMManagementContainerParams(LONG packetHandle, struct DENMManagementContainer value, char oldPath[])
{
  char newPath[300];
  int result;

  result = 0;

  snprintf(newPath, elcount(newPath), "%s.%s", oldPath, "actionID");
  SetDENMActionIDParams(packetHandle, value.actionID, newPath);
  result = CheckLastError("DENM", gkFuncRefGet, result);

  snprintf(newPath, elcount(newPath), "%s.%s", oldPath, "detectionTime");
  C2xSetTokenInt64(packetHandle, "DENM", newPath, value.detectionTime);
  result = CheckLastError("DENM", gkFuncRefGet, result);

  snprintf(newPath, elcount(newPath), "%s.%s", oldPath, "referenceTime");
  C2xSetTokenInt64(packetHandle, "DENM", newPath, value.referenceTime);
  result = CheckLastError("DENM", gkFuncRefGet, result);

  snprintf(newPath, elcount(newPath), "%s.%s", oldPath, "termination");
  if(value.termination.isValidFlag==1)
  {
    C2xSetTokenInt(packetHandle, "DENM", newPath, value.termination.value);
    result = CheckLastError("DENM", gkFuncRefGet, result);
  }
  else
  {
    if( C2xIsTokenAvailable(packetHandle, "DENM", newPath) )
    {
      C2xRemoveToken(packetHandle, "DENM", newPath);
    }
  }

  snprintf(newPath, elcount(newPath), "%s.%s", oldPath, "eventPosition");
  SetDENMReferencePositionParams(packetHandle, value.eventPosition, newPath);
  result = CheckLastError("DENM", gkFuncRefGet, result);

  snprintf(newPath, elcount(newPath), "%s.%s", oldPath, "relevanceDistance");
  if(value.relevanceDistance.isValidFlag==1)
  {
    C2xSetTokenInt(packetHandle, "DENM", newPath, value.relevanceDistance.value);
    result = CheckLastError("DENM", gkFuncRefGet, result);
  }
  else
  {
    if( C2xIsTokenAvailable(packetHandle, "DENM", newPath) )
    {
      C2xRemoveToken(packetHandle, "DENM", newPath);
    }
  }

  snprintf(newPath, elcount(newPath), "%s.%s", oldPath, "relevanceTrafficDirection");
  if(value.relevanceTrafficDirection.isValidFlag==1)
  {
    C2xSetTokenInt(packetHandle, "DENM", newPath, value.relevanceTrafficDirection.value);
    result = CheckLastError("DENM", gkFuncRefGet, result);
  }
  else
  {
    if( C2xIsTokenAvailable(packetHandle, "DENM", newPath) )
    {
      C2xRemoveToken(packetHandle, "DENM", newPath);
    }
  }

  snprintf(newPath, elcount(newPath), "%s.%s", oldPath, "validityDuration");
  if(value.validityDuration.isValidFlag==1)
  {
    C2xSetTokenInt(packetHandle, "DENM", newPath, value.validityDuration.value);
    result = CheckLastError("DENM", gkFuncRefGet, result);
  }
  else
  {
    if( C2xIsTokenAvailable(packetHandle, "DENM", newPath) )
    {
      C2xRemoveToken(packetHandle, "DENM", newPath);
    }
  }

  snprintf(newPath, elcount(newPath), "%s.%s", oldPath, "transmissionInterval");
  if(value.transmissionInterval.isValidFlag==1)
  {
    if (value.transmissionInterval.value < 1)
    {
        C2xSetTokenInt(packetHandle, "DENM", newPath, 1);
    }
    else if (value.transmissionInterval.value > 10000)
    {
        C2xSetTokenInt(packetHandle, "DENM", newPath, 10000);
    }
    else
    {
        C2xSetTokenInt(packetHandle, "DENM", newPath, value.transmissionInterval.value);
    }
    result = CheckLastError("DENM", gkFuncRefGet, result);
  }
  else
  {
    if( C2xIsTokenAvailable(packetHandle, "DENM", newPath) )
    {
      C2xRemoveToken(packetHandle, "DENM", newPath);
    }
  }

  snprintf(newPath, elcount(newPath), "%s.%s", oldPath, "stationType");
  C2xSetTokenInt(packetHandle, "DENM", newPath, value.stationType);
  result = CheckLastError("DENM", gkFuncRefGet, result);

  return result;
}

int GetDENMCauseCodeParams(LONG packetHandle, struct DENMCauseCode value, char oldPath[])
{
  char newPath[300];
  int result;

  result = 0;

  snprintf(newPath, elcount(newPath), "%s.%s", oldPath, "causeCode");
  value.causeCode = C2xGetTokenInt(packetHandle, "DENM", newPath);
  result = CheckLastError("DENM", gkFuncRefGet, result);

  snprintf(newPath, elcount(newPath), "%s.%s", oldPath, "subCauseCode");
  value.subCauseCode = C2xGetTokenInt(packetHandle, "DENM", newPath);
  result = CheckLastError("DENM", gkFuncRefGet, result);

  return result;
}

int SetDENMCauseCodeParams(LONG packetHandle, struct DENMCauseCode value, char oldPath[])
{
  char newPath[300];
  int result;

  result = 0;

  snprintf(newPath, elcount(newPath), "%s.%s", oldPath, "causeCode");
  C2xSetTokenInt(packetHandle, "DENM", newPath, value.causeCode);
  result = CheckLastError("DENM", gkFuncRefGet, result);

  snprintf(newPath, elcount(newPath), "%s.%s", oldPath, "subCauseCode");
  C2xSetTokenInt(packetHandle, "DENM", newPath, value.subCauseCode);
  result = CheckLastError("DENM", gkFuncRefGet, result);

  return result;
}

int GetDENMDeltaReferencePositionParams(LONG packetHandle, struct DENMDeltaReferencePosition value, char oldPath[])
{
  char newPath[300];
  int result;

  result = 0;

  snprintf(newPath, elcount(newPath), "%s.%s", oldPath, "deltaLatitude");
  value.deltaLatitude = C2xGetTokenInt(packetHandle, "DENM", newPath);
  result = CheckLastError("DENM", gkFuncRefGet, result);

  snprintf(newPath, elcount(newPath), "%s.%s", oldPath, "deltaLongitude");
  value.deltaLongitude = C2xGetTokenInt(packetHandle, "DENM", newPath);
  result = CheckLastError("DENM", gkFuncRefGet, result);

  snprintf(newPath, elcount(newPath), "%s.%s", oldPath, "deltaAltitude");
  value.deltaAltitude = C2xGetTokenInt(packetHandle, "DENM", newPath);
  result = CheckLastError("DENM", gkFuncRefGet, result);

  return result;
}

int SetDENMDeltaReferencePositionParams(LONG packetHandle, struct DENMDeltaReferencePosition value, char oldPath[])
{
  char newPath[300];
  int result;

  result = 0;

  snprintf(newPath, elcount(newPath), "%s.%s", oldPath, "deltaLatitude");
  C2xSetTokenInt(packetHandle, "DENM", newPath, value.deltaLatitude);
  result = CheckLastError("DENM", gkFuncRefGet, result);

  snprintf(newPath, elcount(newPath), "%s.%s", oldPath, "deltaLongitude");
  C2xSetTokenInt(packetHandle, "DENM", newPath, value.deltaLongitude);
  result = CheckLastError("DENM", gkFuncRefGet, result);

  snprintf(newPath, elcount(newPath), "%s.%s", oldPath, "deltaAltitude");
  C2xSetTokenInt(packetHandle, "DENM", newPath, value.deltaAltitude);
  result = CheckLastError("DENM", gkFuncRefGet, result);

  return result;
}

int GetDENMEventPointParams(LONG packetHandle, struct DENMEventPoint value, char oldPath[])
{
  char newPath[300];
  int result;

  result = 0;

  snprintf(newPath, elcount(newPath), "%s.%s", oldPath, "eventPosition");
  GetDENMDeltaReferencePositionParams(packetHandle, value.eventPosition, newPath);
  result = CheckLastError("DENM", gkFuncRefGet, result);

  snprintf(newPath, elcount(newPath), "%s.%s", oldPath, "eventDeltaTime");
  value.eventDeltaTime.isValidFlag = C2xIsTokenAvailable(packetHandle, "DENM", newPath);
  if(value.eventDeltaTime.isValidFlag==1)
  {
    value.eventDeltaTime.value = C2xGetTokenInt(packetHandle, "DENM", newPath);
    result = CheckLastError("DENM", gkFuncRefGet, result);
  }
  snprintf(newPath, elcount(newPath), "%s.%s", oldPath, "informationQuality");
  value.informationQuality = C2xGetTokenInt(packetHandle, "DENM", newPath);
  result = CheckLastError("DENM", gkFuncRefGet, result);

  return result;
}

int SetDENMEventPointParams(LONG packetHandle, struct DENMEventPoint value, char oldPath[])
{
  char newPath[300];
  int result;

  result = 0;

  snprintf(newPath, elcount(newPath), "%s.%s", oldPath, "eventPosition");
  SetDENMDeltaReferencePositionParams(packetHandle, value.eventPosition, newPath);
  result = CheckLastError("DENM", gkFuncRefGet, result);

  snprintf(newPath, elcount(newPath), "%s.%s", oldPath, "eventDeltaTime");
  if(value.eventDeltaTime.isValidFlag==1)
  {
    if (value.eventDeltaTime.value < 1)
    {
        C2xSetTokenInt(packetHandle, "DENM", newPath, 1);
    }
    else if (value.eventDeltaTime.value > 65535)
    {
        C2xSetTokenInt(packetHandle, "DENM", newPath, 65535);
    }
    else
    {
        C2xSetTokenInt(packetHandle, "DENM", newPath, value.eventDeltaTime.value);
    }
    result = CheckLastError("DENM", gkFuncRefGet, result);
  }
  else
  {
    if( C2xIsTokenAvailable(packetHandle, "DENM", newPath) )
    {
      C2xRemoveToken(packetHandle, "DENM", newPath);
    }
  }

  snprintf(newPath, elcount(newPath), "%s.%s", oldPath, "informationQuality");
  C2xSetTokenInt(packetHandle, "DENM", newPath, value.informationQuality);
  result = CheckLastError("DENM", gkFuncRefGet, result);

  return result;
}

int GetDENMEventHistoryParams(LONG packetHandle, struct DENMEventHistory value, char oldPath[])
{
  char newPath[300]; 
  int i;
  int result;

  result = 0;

  value.length = C2xGetTokenInt(packetHandle, "DENM", oldPath);
  if((result = CheckLastError("DENM", gkFuncRefGet, result))==0)
  {
    for(i=0; i<value.length; i++)
    {
      snprintf(newPath, elcount(newPath), "%s[%d]", oldPath, i);
      GetDENMEventPointParams(packetHandle, value.arrayValue[i], newPath);
      result = CheckLastError("DENM", gkFuncRefGet, result);
    }
  }
  return result;
}

int SetDENMEventHistoryParams(LONG packetHandle, struct DENMEventHistory value, char oldPath[])
{
  char newPath[300]; 
  int i;
  int result;

  result = 0;

  C2xRemoveToken(packetHandle, "DENM", oldPath);
  for(i=0; i<value.length; i++)
  {
    snprintf(newPath, elcount(newPath), "%s[%d]", oldPath, i);
    SetDENMEventPointParams(packetHandle, value.arrayValue[i], newPath);
    result = CheckLastError("DENM", gkFuncRefGet, result);
  }
  return result;
}

int GetDENMActionIdListParams(LONG packetHandle, struct DENMActionIdList value, char oldPath[])
{
  char newPath[300]; 
  int i;
  int result;

  result = 0;

  value.length = C2xGetTokenInt(packetHandle, "DENM", oldPath);
  if((result = CheckLastError("DENM", gkFuncRefGet, result))==0)
  {
    for(i=0; i<value.length; i++)
    {
      snprintf(newPath, elcount(newPath), "%s[%d]", oldPath, i);
      GetDENMActionIDParams(packetHandle, value.arrayValue[i], newPath);
      result = CheckLastError("DENM", gkFuncRefGet, result);
    }
  }
  return result;
}

int SetDENMActionIdListParams(LONG packetHandle, struct DENMActionIdList value, char oldPath[])
{
  char newPath[300]; 
  int i;
  int result;

  result = 0;

  C2xRemoveToken(packetHandle, "DENM", oldPath);
  for(i=0; i<value.length; i++)
  {
    snprintf(newPath, elcount(newPath), "%s[%d]", oldPath, i);
    SetDENMActionIDParams(packetHandle, value.arrayValue[i], newPath);
    result = CheckLastError("DENM", gkFuncRefGet, result);
  }
  return result;
}

int GetDENMSituationContainerParams(LONG packetHandle, struct DENMSituationContainer value, char oldPath[])
{
  char newPath[300];
  int result;

  result = 0;

  snprintf(newPath, elcount(newPath), "%s.%s", oldPath, "informationQuality");
  value.informationQuality = C2xGetTokenInt(packetHandle, "DENM", newPath);
  result = CheckLastError("DENM", gkFuncRefGet, result);

  snprintf(newPath, elcount(newPath), "%s.%s", oldPath, "eventType");
  GetDENMCauseCodeParams(packetHandle, value.eventType, newPath);
  result = CheckLastError("DENM", gkFuncRefGet, result);

  snprintf(newPath, elcount(newPath), "%s.%s", oldPath, "linkedCause");
  value.linkedCause.isValidFlag = C2xIsTokenAvailable(packetHandle, "DENM", newPath);
  if(value.linkedCause.isValidFlag==1)
  {
    GetDENMCauseCodeParams(packetHandle, value.linkedCause, newPath);
    result = CheckLastError("DENM", gkFuncRefGet, result);
  }
  snprintf(newPath, elcount(newPath), "%s.%s", oldPath, "eventHistory");
  value.eventHistory.isValidFlag = C2xIsTokenAvailable(packetHandle, "DENM", newPath);
  if(value.eventHistory.isValidFlag==1)
  {
    GetDENMEventHistoryParams(packetHandle, value.eventHistory, newPath);
    result = CheckLastError("DENM", gkFuncRefGet, result);
  }
  snprintf(newPath, elcount(newPath), "%s.%s", oldPath, "linkedDenms");
  value.linkedDenms.isValidFlag = C2xIsTokenAvailable(packetHandle, "DENM", newPath);
  if(value.linkedDenms.isValidFlag==1)
  {
    GetDENMActionIdListParams(packetHandle, value.linkedDenms, newPath);
    result = CheckLastError("DENM", gkFuncRefGet, result);
  }
  snprintf(newPath, elcount(newPath), "%s.%s", oldPath, "eventEnd");
  value.eventEnd.isValidFlag = C2xIsTokenAvailable(packetHandle, "DENM", newPath);
  if(value.eventEnd.isValidFlag==1)
  {
    value.eventEnd.value = C2xGetTokenInt(packetHandle, "DENM", newPath);
    result = CheckLastError("DENM", gkFuncRefGet, result);
  }
  return result;
}

int SetDENMSituationContainerParams(LONG packetHandle, struct DENMSituationContainer value, char oldPath[])
{
  char newPath[300];
  int result;

  result = 0;

  snprintf(newPath, elcount(newPath), "%s.%s", oldPath, "informationQuality");
  C2xSetTokenInt(packetHandle, "DENM", newPath, value.informationQuality);
  result = CheckLastError("DENM", gkFuncRefGet, result);

  snprintf(newPath, elcount(newPath), "%s.%s", oldPath, "eventType");
  SetDENMCauseCodeParams(packetHandle, value.eventType, newPath);
  result = CheckLastError("DENM", gkFuncRefGet, result);

  snprintf(newPath, elcount(newPath), "%s.%s", oldPath, "linkedCause");
  if(value.linkedCause.isValidFlag==1)
  {
    SetDENMCauseCodeParams(packetHandle, value.linkedCause, newPath);
    result = CheckLastError("DENM", gkFuncRefGet, result);
  }
  else
  {
    if( C2xIsTokenAvailable(packetHandle, "DENM", newPath) )
    {
      C2xRemoveToken(packetHandle, "DENM", newPath);
    }
  }

  snprintf(newPath, elcount(newPath), "%s.%s", oldPath, "eventHistory");
  if(value.eventHistory.isValidFlag==1)
  {
    SetDENMEventHistoryParams(packetHandle, value.eventHistory, newPath);
    result = CheckLastError("DENM", gkFuncRefGet, result);
  }
  else
  {
    if( C2xIsTokenAvailable(packetHandle, "DENM", newPath) )
    {
      C2xRemoveToken(packetHandle, "DENM", newPath);
    }
  }

  snprintf(newPath, elcount(newPath), "%s.%s", oldPath, "linkedDenms");
  if(value.linkedDenms.isValidFlag==1)
  {
    SetDENMActionIdListParams(packetHandle, value.linkedDenms, newPath);
    result = CheckLastError("DENM", gkFuncRefGet, result);
  }
  else
  {
    if( C2xIsTokenAvailable(packetHandle, "DENM", newPath) )
    {
      C2xRemoveToken(packetHandle, "DENM", newPath);
    }
  }

  snprintf(newPath, elcount(newPath), "%s.%s", oldPath, "eventEnd");
  if(value.eventEnd.isValidFlag==1)
  {
    C2xSetTokenInt(packetHandle, "DENM", newPath, value.eventEnd.value);
    result = CheckLastError("DENM", gkFuncRefGet, result);
  }
  else
  {
    if( C2xIsTokenAvailable(packetHandle, "DENM", newPath) )
    {
      C2xRemoveToken(packetHandle, "DENM", newPath);
    }
  }

  return result;
}

int GetDENMSpeedParams(LONG packetHandle, struct DENMSpeed value, char oldPath[])
{
  char newPath[300];
  int result;

  result = 0;

  snprintf(newPath, elcount(newPath), "%s.%s", oldPath, "speedValue");
  value.speedValue = C2xGetTokenInt(packetHandle, "DENM", newPath);
  result = CheckLastError("DENM", gkFuncRefGet, result);

  snprintf(newPath, elcount(newPath), "%s.%s", oldPath, "speedConfidence");
  value.speedConfidence = C2xGetTokenInt(packetHandle, "DENM", newPath);
  result = CheckLastError("DENM", gkFuncRefGet, result);

  return result;
}

int SetDENMSpeedParams(LONG packetHandle, struct DENMSpeed value, char oldPath[])
{
  char newPath[300];
  int result;

  result = 0;

  snprintf(newPath, elcount(newPath), "%s.%s", oldPath, "speedValue");
  C2xSetTokenInt(packetHandle, "DENM", newPath, value.speedValue);
  result = CheckLastError("DENM", gkFuncRefGet, result);

  snprintf(newPath, elcount(newPath), "%s.%s", oldPath, "speedConfidence");
  if (value.speedConfidence < 1)
  {
    C2xSetTokenInt(packetHandle, "DENM", newPath, 1);
  }
  else if (value.speedConfidence > 127)
  {
    C2xSetTokenInt(packetHandle, "DENM", newPath, 127);
  }
  else
  {
    C2xSetTokenInt(packetHandle, "DENM", newPath, value.speedConfidence);
  }
  result = CheckLastError("DENM", gkFuncRefGet, result);

  return result;
}

int GetDENMWgs84AngleParams(LONG packetHandle, struct DENMWgs84Angle value, char oldPath[])
{
  char newPath[300];
  int result;

  result = 0;

  snprintf(newPath, elcount(newPath), "%s.%s", oldPath, "headingValue");
  value.headingValue = C2xGetTokenInt(packetHandle, "DENM", newPath);
  result = CheckLastError("DENM", gkFuncRefGet, result);

  snprintf(newPath, elcount(newPath), "%s.%s", oldPath, "headingConfidence");
  value.headingConfidence = C2xGetTokenInt(packetHandle, "DENM", newPath);
  result = CheckLastError("DENM", gkFuncRefGet, result);

  return result;
}

int SetDENMWgs84AngleParams(LONG packetHandle, struct DENMWgs84Angle value, char oldPath[])
{
  char newPath[300];
  int result;

  result = 0;

  snprintf(newPath, elcount(newPath), "%s.%s", oldPath, "headingValue");
  C2xSetTokenInt(packetHandle, "DENM", newPath, value.headingValue);
  result = CheckLastError("DENM", gkFuncRefGet, result);

  snprintf(newPath, elcount(newPath), "%s.%s", oldPath, "headingConfidence");
  if (value.headingConfidence < 1)
  {
    C2xSetTokenInt(packetHandle, "DENM", newPath, 1);
  }
  else if (value.headingConfidence > 127)
  {
    C2xSetTokenInt(packetHandle, "DENM", newPath, 127);
  }
  else
  {
    C2xSetTokenInt(packetHandle, "DENM", newPath, value.headingConfidence);
  }
  result = CheckLastError("DENM", gkFuncRefGet, result);

  return result;
}

int GetDENMPathPointParams(LONG packetHandle, struct DENMPathPoint value, char oldPath[])
{
  char newPath[300];
  int result;

  result = 0;

  snprintf(newPath, elcount(newPath), "%s.%s", oldPath, "pathPosition");
  GetDENMDeltaReferencePositionParams(packetHandle, value.pathPosition, newPath);
  result = CheckLastError("DENM", gkFuncRefGet, result);

  snprintf(newPath, elcount(newPath), "%s.%s", oldPath, "pathDeltaTime");
  value.pathDeltaTime.isValidFlag = C2xIsTokenAvailable(packetHandle, "DENM", newPath);
  if(value.pathDeltaTime.isValidFlag==1)
  {
    value.pathDeltaTime.value = C2xGetTokenInt(packetHandle, "DENM", newPath);
    result = CheckLastError("DENM", gkFuncRefGet, result);
  }
  return result;
}

int SetDENMPathPointParams(LONG packetHandle, struct DENMPathPoint value, char oldPath[])
{
  char newPath[300];
  int result;

  result = 0;

  snprintf(newPath, elcount(newPath), "%s.%s", oldPath, "pathPosition");
  SetDENMDeltaReferencePositionParams(packetHandle, value.pathPosition, newPath);
  result = CheckLastError("DENM", gkFuncRefGet, result);

  snprintf(newPath, elcount(newPath), "%s.%s", oldPath, "pathDeltaTime");
  if(value.pathDeltaTime.isValidFlag==1)
  {
    if (value.pathDeltaTime.value < 1)
    {
        C2xSetTokenInt(packetHandle, "DENM", newPath, 1);
    }
    else if (value.pathDeltaTime.value > 65535)
    {
        C2xSetTokenInt(packetHandle, "DENM", newPath, 65535);
    }
    else
    {
        C2xSetTokenInt(packetHandle, "DENM", newPath, value.pathDeltaTime.value);
    }
    result = CheckLastError("DENM", gkFuncRefGet, result);
  }
  else
  {
    if( C2xIsTokenAvailable(packetHandle, "DENM", newPath) )
    {
      C2xRemoveToken(packetHandle, "DENM", newPath);
    }
  }

  return result;
}

int GetDENMPathParams(LONG packetHandle, struct DENMPath value, char oldPath[])
{
  char newPath[300]; 
  int i;
  int result;

  result = 0;

  value.length = C2xGetTokenInt(packetHandle, "DENM", oldPath);
  if((result = CheckLastError("DENM", gkFuncRefGet, result))==0)
  {
    for(i=0; i<value.length; i++)
    {
      snprintf(newPath, elcount(newPath), "%s[%d]", oldPath, i);
      GetDENMPathPointParams(packetHandle, value.arrayValue[i], newPath);
      result = CheckLastError("DENM", gkFuncRefGet, result);
    }
  }
  return result;
}

int SetDENMPathParams(LONG packetHandle, struct DENMPath value, char oldPath[])
{
  char newPath[300]; 
  int i;
  int result;

  result = 0;

  C2xRemoveToken(packetHandle, "DENM", oldPath);
  for(i=0; i<value.length; i++)
  {
    snprintf(newPath, elcount(newPath), "%s[%d]", oldPath, i);
    SetDENMPathPointParams(packetHandle, value.arrayValue[i], newPath);
    result = CheckLastError("DENM", gkFuncRefGet, result);
  }
  return result;
}

int GetDENMTracesParams(LONG packetHandle, struct DENMTraces value, char oldPath[])
{
  char newPath[300]; 
  int i;
  int result;

  result = 0;

  value.length = C2xGetTokenInt(packetHandle, "DENM", oldPath);
  if((result = CheckLastError("DENM", gkFuncRefGet, result))==0)
  {
    for(i=0; i<value.length; i++)
    {
      snprintf(newPath, elcount(newPath), "%s[%d]", oldPath, i);
      GetDENMPathParams(packetHandle, value.arrayValue[i], newPath);
      result = CheckLastError("DENM", gkFuncRefGet, result);
    }
  }
  return result;
}

int SetDENMTracesParams(LONG packetHandle, struct DENMTraces value, char oldPath[])
{
  char newPath[300]; 
  int i;
  int result;

  result = 0;

  C2xRemoveToken(packetHandle, "DENM", oldPath);
  for(i=0; i<value.length; i++)
  {
    snprintf(newPath, elcount(newPath), "%s[%d]", oldPath, i);
    SetDENMPathParams(packetHandle, value.arrayValue[i], newPath);
    result = CheckLastError("DENM", gkFuncRefGet, result);
  }
  return result;
}

int GetDENMLanePositionAndTypeParams(LONG packetHandle, struct DENMLanePositionAndType value, char oldPath[])
{
  char newPath[300];
  int result;

  result = 0;

  snprintf(newPath, elcount(newPath), "%s.%s", oldPath, "transversalPosition");
  value.transversalPosition = C2xGetTokenInt(packetHandle, "DENM", newPath);
  result = CheckLastError("DENM", gkFuncRefGet, result);

  snprintf(newPath, elcount(newPath), "%s.%s", oldPath, "laneType");
  value.laneType.isValidFlag = C2xIsTokenAvailable(packetHandle, "DENM", newPath);
  if(value.laneType.isValidFlag==1)
  {
    value.laneType.value = C2xGetTokenInt(packetHandle, "DENM", newPath);
    result = CheckLastError("DENM", gkFuncRefGet, result);
  }
  snprintf(newPath, elcount(newPath), "%s.%s", oldPath, "direction");
  value.direction.isValidFlag = C2xIsTokenAvailable(packetHandle, "DENM", newPath);
  if(value.direction.isValidFlag==1)
  {
    value.direction.value = C2xGetTokenInt(packetHandle, "DENM", newPath);
    result = CheckLastError("DENM", gkFuncRefGet, result);
  }
  return result;
}

int SetDENMLanePositionAndTypeParams(LONG packetHandle, struct DENMLanePositionAndType value, char oldPath[])
{
  char newPath[300];
  int result;

  result = 0;

  snprintf(newPath, elcount(newPath), "%s.%s", oldPath, "transversalPosition");
  C2xSetTokenInt(packetHandle, "DENM", newPath, value.transversalPosition);
  result = CheckLastError("DENM", gkFuncRefGet, result);

  snprintf(newPath, elcount(newPath), "%s.%s", oldPath, "laneType");
  if(value.laneType.isValidFlag==1)
  {
    C2xSetTokenInt(packetHandle, "DENM", newPath, value.laneType.value);
    result = CheckLastError("DENM", gkFuncRefGet, result);
  }
  else
  {
    if( C2xIsTokenAvailable(packetHandle, "DENM", newPath) )
    {
      C2xRemoveToken(packetHandle, "DENM", newPath);
    }
  }

  snprintf(newPath, elcount(newPath), "%s.%s", oldPath, "direction");
  if(value.direction.isValidFlag==1)
  {
    C2xSetTokenInt(packetHandle, "DENM", newPath, value.direction.value);
    result = CheckLastError("DENM", gkFuncRefGet, result);
  }
  else
  {
    if( C2xIsTokenAvailable(packetHandle, "DENM", newPath) )
    {
      C2xRemoveToken(packetHandle, "DENM", newPath);
    }
  }

  return result;
}

int GetDENMLanePositionWithLateralDetailsParams(LONG packetHandle, struct DENMLanePositionWithLateralDetails value, char oldPath[])
{
  char newPath[300];
  int result;

  result = 0;

  snprintf(newPath, elcount(newPath), "%s.%s", oldPath, "distanceToLeftBorder");
  value.distanceToLeftBorder = C2xGetTokenInt(packetHandle, "DENM", newPath);
  result = CheckLastError("DENM", gkFuncRefGet, result);

  snprintf(newPath, elcount(newPath), "%s.%s", oldPath, "distanceToRightBorder");
  value.distanceToRightBorder = C2xGetTokenInt(packetHandle, "DENM", newPath);
  result = CheckLastError("DENM", gkFuncRefGet, result);

  return result;
}

int SetDENMLanePositionWithLateralDetailsParams(LONG packetHandle, struct DENMLanePositionWithLateralDetails value, char oldPath[])
{
  char newPath[300];
  int result;

  result = 0;

  snprintf(newPath, elcount(newPath), "%s.%s", oldPath, "distanceToLeftBorder");
  C2xSetTokenInt(packetHandle, "DENM", newPath, value.distanceToLeftBorder);
  result = CheckLastError("DENM", gkFuncRefGet, result);

  snprintf(newPath, elcount(newPath), "%s.%s", oldPath, "distanceToRightBorder");
  C2xSetTokenInt(packetHandle, "DENM", newPath, value.distanceToRightBorder);
  result = CheckLastError("DENM", gkFuncRefGet, result);

  return result;
}

int GetDENMTrafficIslandPositionParams(LONG packetHandle, struct DENMTrafficIslandPosition value, char oldPath[])
{
  char newPath[300];
  int result;

  result = 0;

  snprintf(newPath, elcount(newPath), "%s.%s", oldPath, "oneSide");
  GetDENMLanePositionAndTypeParams(packetHandle, value.oneSide, newPath);
  result = CheckLastError("DENM", gkFuncRefGet, result);

  snprintf(newPath, elcount(newPath), "%s.%s", oldPath, "otherSide");
  GetDENMLanePositionAndTypeParams(packetHandle, value.otherSide, newPath);
  result = CheckLastError("DENM", gkFuncRefGet, result);

  return result;
}

int SetDENMTrafficIslandPositionParams(LONG packetHandle, struct DENMTrafficIslandPosition value, char oldPath[])
{
  char newPath[300];
  int result;

  result = 0;

  snprintf(newPath, elcount(newPath), "%s.%s", oldPath, "oneSide");
  SetDENMLanePositionAndTypeParams(packetHandle, value.oneSide, newPath);
  result = CheckLastError("DENM", gkFuncRefGet, result);

  snprintf(newPath, elcount(newPath), "%s.%s", oldPath, "otherSide");
  SetDENMLanePositionAndTypeParams(packetHandle, value.otherSide, newPath);
  result = CheckLastError("DENM", gkFuncRefGet, result);

  return result;
}

int GetDENMLanePositionOptionsParams(LONG packetHandle, struct DENMLanePositionOptions value, char oldPath[])
{
  char newPath[300];
  int result;

  result = 0;

  value.choice = C2xGetTokenInt(packetHandle, "DENM", oldPath);

  switch(value.choice)
  {
    case 0:
    {
      snprintf(newPath, elcount(newPath), "%s.%s", oldPath, "simplelanePosition");
      value.simplelanePosition = C2xGetTokenInt(packetHandle, "DENM", newPath);
      result = CheckLastError("DENM", gkFuncRefGet, result);
    }
    break;
    case 1:
    {
      snprintf(newPath, elcount(newPath), "%s.%s", oldPath, "simpleLaneType");
      value.simpleLaneType = C2xGetTokenInt(packetHandle, "DENM", newPath);
      result = CheckLastError("DENM", gkFuncRefGet, result);
    }
    break;
    case 2:
    {
      snprintf(newPath, elcount(newPath), "%s.%s", oldPath, "detailedlanePosition");
      GetDENMLanePositionAndTypeParams(packetHandle, value.detailedlanePosition, newPath);
      result = CheckLastError("DENM", gkFuncRefGet, result);
    }
    break;
    case 3:
    {
      snprintf(newPath, elcount(newPath), "%s.%s", oldPath, "lanePositionWithLateralDetails");
      GetDENMLanePositionWithLateralDetailsParams(packetHandle, value.lanePositionWithLateralDetails, newPath);
      result = CheckLastError("DENM", gkFuncRefGet, result);
    }
    break;
    case 4:
    {
      snprintf(newPath, elcount(newPath), "%s.%s", oldPath, "trafficIslandPosition");
      GetDENMTrafficIslandPositionParams(packetHandle, value.trafficIslandPosition, newPath);
      result = CheckLastError("DENM", gkFuncRefGet, result);
    }
    break;
  }
  return result;
}

int SetDENMLanePositionOptionsParams(LONG packetHandle, struct DENMLanePositionOptions value, char oldPath[])
{
  char newPath[300];
  int result;

  result = 0;

  switch(value.choice)
  {
    case 0:
    {
      snprintf(newPath, elcount(newPath), "%s.%s", oldPath, "simplelanePosition");
      C2xSetTokenInt(packetHandle, "DENM", newPath, value.simplelanePosition);
      result = CheckLastError("DENM", gkFuncRefGet, result);
    }
    break;
    case 1:
    {
      snprintf(newPath, elcount(newPath), "%s.%s", oldPath, "simpleLaneType");
      C2xSetTokenInt(packetHandle, "DENM", newPath, value.simpleLaneType);
      result = CheckLastError("DENM", gkFuncRefGet, result);
    }
    break;
    case 2:
    {
      snprintf(newPath, elcount(newPath), "%s.%s", oldPath, "detailedlanePosition");
      SetDENMLanePositionAndTypeParams(packetHandle, value.detailedlanePosition, newPath);
      result = CheckLastError("DENM", gkFuncRefGet, result);
    }
    break;
    case 3:
    {
      snprintf(newPath, elcount(newPath), "%s.%s", oldPath, "lanePositionWithLateralDetails");
      SetDENMLanePositionWithLateralDetailsParams(packetHandle, value.lanePositionWithLateralDetails, newPath);
      result = CheckLastError("DENM", gkFuncRefGet, result);
    }
    break;
    case 4:
    {
      snprintf(newPath, elcount(newPath), "%s.%s", oldPath, "trafficIslandPosition");
      SetDENMTrafficIslandPositionParams(packetHandle, value.trafficIslandPosition, newPath);
      result = CheckLastError("DENM", gkFuncRefGet, result);
    }
    break;
  }
  return result;
}

int GetDENMRoadSegmentReferenceIdParams(LONG packetHandle, struct DENMRoadSegmentReferenceId value, char oldPath[])
{
  char newPath[300];
  int result;

  result = 0;

  snprintf(newPath, elcount(newPath), "%s.%s", oldPath, "region");
  value.region.isValidFlag = C2xIsTokenAvailable(packetHandle, "DENM", newPath);
  if(value.region.isValidFlag==1)
  {
    value.region.value = C2xGetTokenInt(packetHandle, "DENM", newPath);
    result = CheckLastError("DENM", gkFuncRefGet, result);
  }
  snprintf(newPath, elcount(newPath), "%s.%s", oldPath, "id");
  value.id = C2xGetTokenInt(packetHandle, "DENM", newPath);
  result = CheckLastError("DENM", gkFuncRefGet, result);

  return result;
}

int SetDENMRoadSegmentReferenceIdParams(LONG packetHandle, struct DENMRoadSegmentReferenceId value, char oldPath[])
{
  char newPath[300];
  int result;

  result = 0;

  snprintf(newPath, elcount(newPath), "%s.%s", oldPath, "region");
  if(value.region.isValidFlag==1)
  {
    C2xSetTokenInt(packetHandle, "DENM", newPath, value.region.value);
    result = CheckLastError("DENM", gkFuncRefGet, result);
  }
  else
  {
    if( C2xIsTokenAvailable(packetHandle, "DENM", newPath) )
    {
      C2xRemoveToken(packetHandle, "DENM", newPath);
    }
  }

  snprintf(newPath, elcount(newPath), "%s.%s", oldPath, "id");
  C2xSetTokenInt(packetHandle, "DENM", newPath, value.id);
  result = CheckLastError("DENM", gkFuncRefGet, result);

  return result;
}

int GetDENMIntersectionReferenceIdParams(LONG packetHandle, struct DENMIntersectionReferenceId value, char oldPath[])
{
  char newPath[300];
  int result;

  result = 0;

  snprintf(newPath, elcount(newPath), "%s.%s", oldPath, "region");
  value.region.isValidFlag = C2xIsTokenAvailable(packetHandle, "DENM", newPath);
  if(value.region.isValidFlag==1)
  {
    value.region.value = C2xGetTokenInt(packetHandle, "DENM", newPath);
    result = CheckLastError("DENM", gkFuncRefGet, result);
  }
  snprintf(newPath, elcount(newPath), "%s.%s", oldPath, "id");
  value.id = C2xGetTokenInt(packetHandle, "DENM", newPath);
  result = CheckLastError("DENM", gkFuncRefGet, result);

  return result;
}

int SetDENMIntersectionReferenceIdParams(LONG packetHandle, struct DENMIntersectionReferenceId value, char oldPath[])
{
  char newPath[300];
  int result;

  result = 0;

  snprintf(newPath, elcount(newPath), "%s.%s", oldPath, "region");
  if(value.region.isValidFlag==1)
  {
    C2xSetTokenInt(packetHandle, "DENM", newPath, value.region.value);
    result = CheckLastError("DENM", gkFuncRefGet, result);
  }
  else
  {
    if( C2xIsTokenAvailable(packetHandle, "DENM", newPath) )
    {
      C2xRemoveToken(packetHandle, "DENM", newPath);
    }
  }

  snprintf(newPath, elcount(newPath), "%s.%s", oldPath, "id");
  C2xSetTokenInt(packetHandle, "DENM", newPath, value.id);
  result = CheckLastError("DENM", gkFuncRefGet, result);

  return result;
}

int GetDENMMapReferenceParams(LONG packetHandle, struct DENMMapReference value, char oldPath[])
{
  char newPath[300];
  int result;

  result = 0;

  value.choice = C2xGetTokenInt(packetHandle, "DENM", oldPath);

  switch(value.choice)
  {
    case 0:
    {
      snprintf(newPath, elcount(newPath), "%s.%s", oldPath, "roadsegment");
      GetDENMRoadSegmentReferenceIdParams(packetHandle, value.roadsegment, newPath);
      result = CheckLastError("DENM", gkFuncRefGet, result);
    }
    break;
    case 1:
    {
      snprintf(newPath, elcount(newPath), "%s.%s", oldPath, "intersection");
      GetDENMIntersectionReferenceIdParams(packetHandle, value.intersection, newPath);
      result = CheckLastError("DENM", gkFuncRefGet, result);
    }
    break;
  }
  return result;
}

int SetDENMMapReferenceParams(LONG packetHandle, struct DENMMapReference value, char oldPath[])
{
  char newPath[300];
  int result;

  result = 0;

  switch(value.choice)
  {
    case 0:
    {
      snprintf(newPath, elcount(newPath), "%s.%s", oldPath, "roadsegment");
      SetDENMRoadSegmentReferenceIdParams(packetHandle, value.roadsegment, newPath);
      result = CheckLastError("DENM", gkFuncRefGet, result);
    }
    break;
    case 1:
    {
      snprintf(newPath, elcount(newPath), "%s.%s", oldPath, "intersection");
      SetDENMIntersectionReferenceIdParams(packetHandle, value.intersection, newPath);
      result = CheckLastError("DENM", gkFuncRefGet, result);
    }
    break;
  }
  return result;
}

int GetDENMLongitudinalLanePositionParams(LONG packetHandle, struct DENMLongitudinalLanePosition value, char oldPath[])
{
  char newPath[300];
  int result;

  result = 0;

  snprintf(newPath, elcount(newPath), "%s.%s", oldPath, "longitudinalLanePositionValue");
  value.longitudinalLanePositionValue = C2xGetTokenInt(packetHandle, "DENM", newPath);
  result = CheckLastError("DENM", gkFuncRefGet, result);

  snprintf(newPath, elcount(newPath), "%s.%s", oldPath, "longitudinalLanePositionConfidence");
  value.longitudinalLanePositionConfidence = C2xGetTokenInt(packetHandle, "DENM", newPath);
  result = CheckLastError("DENM", gkFuncRefGet, result);

  return result;
}

int SetDENMLongitudinalLanePositionParams(LONG packetHandle, struct DENMLongitudinalLanePosition value, char oldPath[])
{
  char newPath[300];
  int result;

  result = 0;

  snprintf(newPath, elcount(newPath), "%s.%s", oldPath, "longitudinalLanePositionValue");
  C2xSetTokenInt(packetHandle, "DENM", newPath, value.longitudinalLanePositionValue);
  result = CheckLastError("DENM", gkFuncRefGet, result);

  snprintf(newPath, elcount(newPath), "%s.%s", oldPath, "longitudinalLanePositionConfidence");
  C2xSetTokenInt(packetHandle, "DENM", newPath, value.longitudinalLanePositionConfidence);
  result = CheckLastError("DENM", gkFuncRefGet, result);

  return result;
}

int GetDENMMapPositionParams(LONG packetHandle, struct DENMMapPosition value, char oldPath[])
{
  char newPath[300];
  int result;

  result = 0;

  snprintf(newPath, elcount(newPath), "%s.%s", oldPath, "mapReference");
  value.mapReference.isValidFlag = C2xIsTokenAvailable(packetHandle, "DENM", newPath);
  if(value.mapReference.isValidFlag==1)
  {
    GetDENMMapReferenceParams(packetHandle, value.mapReference, newPath);
    result = CheckLastError("DENM", gkFuncRefGet, result);
  }
  snprintf(newPath, elcount(newPath), "%s.%s", oldPath, "laneId");
  value.laneId.isValidFlag = C2xIsTokenAvailable(packetHandle, "DENM", newPath);
  if(value.laneId.isValidFlag==1)
  {
    value.laneId.value = C2xGetTokenInt(packetHandle, "DENM", newPath);
    result = CheckLastError("DENM", gkFuncRefGet, result);
  }
  snprintf(newPath, elcount(newPath), "%s.%s", oldPath, "connectionId");
  value.connectionId.isValidFlag = C2xIsTokenAvailable(packetHandle, "DENM", newPath);
  if(value.connectionId.isValidFlag==1)
  {
    value.connectionId.value = C2xGetTokenInt(packetHandle, "DENM", newPath);
    result = CheckLastError("DENM", gkFuncRefGet, result);
  }
  snprintf(newPath, elcount(newPath), "%s.%s", oldPath, "longitudinalLanePosition");
  value.longitudinalLanePosition.isValidFlag = C2xIsTokenAvailable(packetHandle, "DENM", newPath);
  if(value.longitudinalLanePosition.isValidFlag==1)
  {
    GetDENMLongitudinalLanePositionParams(packetHandle, value.longitudinalLanePosition, newPath);
    result = CheckLastError("DENM", gkFuncRefGet, result);
  }
  return result;
}

int SetDENMMapPositionParams(LONG packetHandle, struct DENMMapPosition value, char oldPath[])
{
  char newPath[300];
  int result;

  result = 0;

  snprintf(newPath, elcount(newPath), "%s.%s", oldPath, "mapReference");
  if(value.mapReference.isValidFlag==1)
  {
    SetDENMMapReferenceParams(packetHandle, value.mapReference, newPath);
    result = CheckLastError("DENM", gkFuncRefGet, result);
  }
  else
  {
    if( C2xIsTokenAvailable(packetHandle, "DENM", newPath) )
    {
      C2xRemoveToken(packetHandle, "DENM", newPath);
    }
  }

  snprintf(newPath, elcount(newPath), "%s.%s", oldPath, "laneId");
  if(value.laneId.isValidFlag==1)
  {
    C2xSetTokenInt(packetHandle, "DENM", newPath, value.laneId.value);
    result = CheckLastError("DENM", gkFuncRefGet, result);
  }
  else
  {
    if( C2xIsTokenAvailable(packetHandle, "DENM", newPath) )
    {
      C2xRemoveToken(packetHandle, "DENM", newPath);
    }
  }

  snprintf(newPath, elcount(newPath), "%s.%s", oldPath, "connectionId");
  if(value.connectionId.isValidFlag==1)
  {
    C2xSetTokenInt(packetHandle, "DENM", newPath, value.connectionId.value);
    result = CheckLastError("DENM", gkFuncRefGet, result);
  }
  else
  {
    if( C2xIsTokenAvailable(packetHandle, "DENM", newPath) )
    {
      C2xRemoveToken(packetHandle, "DENM", newPath);
    }
  }

  snprintf(newPath, elcount(newPath), "%s.%s", oldPath, "longitudinalLanePosition");
  if(value.longitudinalLanePosition.isValidFlag==1)
  {
    SetDENMLongitudinalLanePositionParams(packetHandle, value.longitudinalLanePosition, newPath);
    result = CheckLastError("DENM", gkFuncRefGet, result);
  }
  else
  {
    if( C2xIsTokenAvailable(packetHandle, "DENM", newPath) )
    {
      C2xRemoveToken(packetHandle, "DENM", newPath);
    }
  }

  return result;
}

int GetDENMMetaInformationParams(LONG packetHandle, struct DENMMetaInformation value, char oldPath[])
{
  char newPath[300]; 
  int j; 
  int k;
  int result;

  result = 0;

  snprintf(newPath, elcount(newPath), "%s.%s", oldPath, "usedDetectionInformation");
  value.usedDetectionInformation.isValidFlag = 1;
  value.usedDetectionInformation.stringLength = C2xGetTokenLengthBit(packetHandle, "DENM", newPath);
  if ((result = CheckLastError("DENM", gkFuncRefGet, result))==0)
  {
    if(value.usedDetectionInformation.stringLength > 0)
    {
      for(j=0; j<value.usedDetectionInformation.stringLength; j++)
      {
        if(C2xGetTokenBitOfBitString(packetHandle, "DENM", newPath, j) == 0)
        {
          value.usedDetectionInformation.string[j] = '0';
        }
        else if(C2xGetTokenBitOfBitString(packetHandle, "DENM", newPath, j) == 1)
        {
          value.usedDetectionInformation.string[j] = '1';
        }

        if(value.usedDetectionInformation.stringLength == 1)
        {
          value.usedDetectionInformation.string[1] = '0';
        }
        result = CheckLastError("DENM", gkFuncRefGet, result);
      }
    }
    else
    {
      for(k = value.usedDetectionInformation.stringLength+1; k > -1; k--)
      {
        if(value.usedDetectionInformation.string[k] == '1')
        {
          value.usedDetectionInformation.string[k] = '0';
        }
      }
    }
  }

  snprintf(newPath, elcount(newPath), "%s.%s", oldPath, "usedStoredInformation");
  value.usedStoredInformation.isValidFlag = 1;
  value.usedStoredInformation.stringLength = C2xGetTokenLengthBit(packetHandle, "DENM", newPath);
  if ((result = CheckLastError("DENM", gkFuncRefGet, result))==0)
  {
    if(value.usedStoredInformation.stringLength > 0)
    {
      for(j=0; j<value.usedStoredInformation.stringLength; j++)
      {
        if(C2xGetTokenBitOfBitString(packetHandle, "DENM", newPath, j) == 0)
        {
          value.usedStoredInformation.string[j] = '0';
        }
        else if(C2xGetTokenBitOfBitString(packetHandle, "DENM", newPath, j) == 1)
        {
          value.usedStoredInformation.string[j] = '1';
        }

        if(value.usedStoredInformation.stringLength == 1)
        {
          value.usedStoredInformation.string[1] = '0';
        }
        result = CheckLastError("DENM", gkFuncRefGet, result);
      }
    }
    else
    {
      for(k = value.usedStoredInformation.stringLength+1; k > -1; k--)
      {
        if(value.usedStoredInformation.string[k] == '1')
        {
          value.usedStoredInformation.string[k] = '0';
        }
      }
    }
  }

  snprintf(newPath, elcount(newPath), "%s.%s", oldPath, "confidenceValue");
  value.confidenceValue.isValidFlag = C2xIsTokenAvailable(packetHandle, "DENM", newPath);
  if(value.confidenceValue.isValidFlag==1)
  {
    value.confidenceValue.value = C2xGetTokenInt(packetHandle, "DENM", newPath);
    result = CheckLastError("DENM", gkFuncRefGet, result);
  }
  return result;
}

int SetDENMMetaInformationParams(LONG packetHandle, struct DENMMetaInformation value, char oldPath[])
{
  char newPath[300]; 
  int j;
  int result;

  result = 0;

  snprintf(newPath, elcount(newPath), "%s.%s", oldPath, "usedDetectionInformation");
    for(j=0; j<value.usedDetectionInformation.stringLength; j++)
    {
      if(value.usedDetectionInformation.string[j] == '0')
      {
        C2xSetTokenBitOfBitString(packetHandle, "DENM", newPath, j, 0);
      }
      else
      {
        C2xSetTokenBitOfBitString(packetHandle, "DENM", newPath, j, 1);
      }
      result = CheckLastError("DENM", gkFuncRefGet, result);
    }

  snprintf(newPath, elcount(newPath), "%s.%s", oldPath, "usedStoredInformation");
    for(j=0; j<value.usedStoredInformation.stringLength; j++)
    {
      if(value.usedStoredInformation.string[j] == '0')
      {
        C2xSetTokenBitOfBitString(packetHandle, "DENM", newPath, j, 0);
      }
      else
      {
        C2xSetTokenBitOfBitString(packetHandle, "DENM", newPath, j, 1);
      }
      result = CheckLastError("DENM", gkFuncRefGet, result);
    }

  snprintf(newPath, elcount(newPath), "%s.%s", oldPath, "confidenceValue");
  if(value.confidenceValue.isValidFlag==1)
  {
    if (value.confidenceValue.value < 1)
    {
        C2xSetTokenInt(packetHandle, "DENM", newPath, 1);
    }
    else if (value.confidenceValue.value > 101)
    {
        C2xSetTokenInt(packetHandle, "DENM", newPath, 101);
    }
    else
    {
        C2xSetTokenInt(packetHandle, "DENM", newPath, value.confidenceValue.value);
    }
    result = CheckLastError("DENM", gkFuncRefGet, result);
  }
  else
  {
    if( C2xIsTokenAvailable(packetHandle, "DENM", newPath) )
    {
      C2xRemoveToken(packetHandle, "DENM", newPath);
    }
  }

  return result;
}

int GetDENMGeneralizedLanePositionParams(LONG packetHandle, struct DENMGeneralizedLanePosition value, char oldPath[])
{
  char newPath[300];
  int result;

  result = 0;

  snprintf(newPath, elcount(newPath), "%s.%s", oldPath, "lanePositionBased");
  GetDENMLanePositionOptionsParams(packetHandle, value.lanePositionBased, newPath);
  result = CheckLastError("DENM", gkFuncRefGet, result);

  snprintf(newPath, elcount(newPath), "%s.%s", oldPath, "mapBased");
  value.mapBased.isValidFlag = C2xIsTokenAvailable(packetHandle, "DENM", newPath);
  if(value.mapBased.isValidFlag==1)
  {
    GetDENMMapPositionParams(packetHandle, value.mapBased, newPath);
    result = CheckLastError("DENM", gkFuncRefGet, result);
  }
  snprintf(newPath, elcount(newPath), "%s.%s", oldPath, "confidence");
  GetDENMMetaInformationParams(packetHandle, value.confidence, newPath);
  result = CheckLastError("DENM", gkFuncRefGet, result);

  return result;
}

int SetDENMGeneralizedLanePositionParams(LONG packetHandle, struct DENMGeneralizedLanePosition value, char oldPath[])
{
  char newPath[300];
  int result;

  result = 0;

  snprintf(newPath, elcount(newPath), "%s.%s", oldPath, "lanePositionBased");
  SetDENMLanePositionOptionsParams(packetHandle, value.lanePositionBased, newPath);
  result = CheckLastError("DENM", gkFuncRefGet, result);

  snprintf(newPath, elcount(newPath), "%s.%s", oldPath, "mapBased");
  if(value.mapBased.isValidFlag==1)
  {
    SetDENMMapPositionParams(packetHandle, value.mapBased, newPath);
    result = CheckLastError("DENM", gkFuncRefGet, result);
  }
  else
  {
    if( C2xIsTokenAvailable(packetHandle, "DENM", newPath) )
    {
      C2xRemoveToken(packetHandle, "DENM", newPath);
    }
  }

  snprintf(newPath, elcount(newPath), "%s.%s", oldPath, "confidence");
  SetDENMMetaInformationParams(packetHandle, value.confidence, newPath);
  result = CheckLastError("DENM", gkFuncRefGet, result);

  return result;
}

int GetDENMGeneralizedLanePositionsParams(LONG packetHandle, struct DENMGeneralizedLanePositions value, char oldPath[])
{
  char newPath[300]; 
  int i;
  int result;

  result = 0;

  value.length = C2xGetTokenInt(packetHandle, "DENM", oldPath);
  if((result = CheckLastError("DENM", gkFuncRefGet, result))==0)
  {
    for(i=0; i<value.length; i++)
    {
      snprintf(newPath, elcount(newPath), "%s[%d]", oldPath, i);
      GetDENMGeneralizedLanePositionParams(packetHandle, value.arrayValue[i], newPath);
      result = CheckLastError("DENM", gkFuncRefGet, result);
    }
  }
  return result;
}

int SetDENMGeneralizedLanePositionsParams(LONG packetHandle, struct DENMGeneralizedLanePositions value, char oldPath[])
{
  char newPath[300]; 
  int i;
  int result;

  result = 0;

  C2xRemoveToken(packetHandle, "DENM", oldPath);
  for(i=0; i<value.length; i++)
  {
    snprintf(newPath, elcount(newPath), "%s[%d]", oldPath, i);
    SetDENMGeneralizedLanePositionParams(packetHandle, value.arrayValue[i], newPath);
    result = CheckLastError("DENM", gkFuncRefGet, result);
  }
  return result;
}

int GetDENMOccupiedLanesWithConfidence_lanePositionBasedParams(LONG packetHandle, struct DENMOccupiedLanesWithConfidence_lanePositionBased value, char oldPath[])
{
  char newPath[300]; 
  int i;
  int result;

  result = 0;

  value.length = C2xGetTokenInt(packetHandle, "DENM", oldPath);
  if((result = CheckLastError("DENM", gkFuncRefGet, result))==0)
  {
    for(i=0; i<value.length; i++)
    {
      snprintf(newPath, elcount(newPath), "%s[%d]", oldPath, i);
      GetDENMLanePositionOptionsParams(packetHandle, value.arrayValue[i], newPath);
      result = CheckLastError("DENM", gkFuncRefGet, result);
    }
  }
  return result;
}

int SetDENMOccupiedLanesWithConfidence_lanePositionBasedParams(LONG packetHandle, struct DENMOccupiedLanesWithConfidence_lanePositionBased value, char oldPath[])
{
  char newPath[300]; 
  int i;
  int result;

  result = 0;

  C2xRemoveToken(packetHandle, "DENM", oldPath);
  for(i=0; i<value.length; i++)
  {
    snprintf(newPath, elcount(newPath), "%s[%d]", oldPath, i);
    SetDENMLanePositionOptionsParams(packetHandle, value.arrayValue[i], newPath);
    result = CheckLastError("DENM", gkFuncRefGet, result);
  }
  return result;
}

int GetDENMOccupiedLanesWithConfidence_mapBasedParams(LONG packetHandle, struct DENMOccupiedLanesWithConfidence_mapBased value, char oldPath[])
{
  char newPath[300]; 
  int i;
  int result;

  result = 0;

  value.length = C2xGetTokenInt(packetHandle, "DENM", oldPath);
  if((result = CheckLastError("DENM", gkFuncRefGet, result))==0)
  {
    for(i=0; i<value.length; i++)
    {
      snprintf(newPath, elcount(newPath), "%s[%d]", oldPath, i);
      GetDENMMapPositionParams(packetHandle, value.arrayValue[i], newPath);
      result = CheckLastError("DENM", gkFuncRefGet, result);
    }
  }
  return result;
}

int SetDENMOccupiedLanesWithConfidence_mapBasedParams(LONG packetHandle, struct DENMOccupiedLanesWithConfidence_mapBased value, char oldPath[])
{
  char newPath[300]; 
  int i;
  int result;

  result = 0;

  C2xRemoveToken(packetHandle, "DENM", oldPath);
  for(i=0; i<value.length; i++)
  {
    snprintf(newPath, elcount(newPath), "%s[%d]", oldPath, i);
    SetDENMMapPositionParams(packetHandle, value.arrayValue[i], newPath);
    result = CheckLastError("DENM", gkFuncRefGet, result);
  }
  return result;
}

int GetDENMOccupiedLanesWithConfidenceParams(LONG packetHandle, struct DENMOccupiedLanesWithConfidence value, char oldPath[])
{
  char newPath[300];
  int result;

  result = 0;

  snprintf(newPath, elcount(newPath), "%s.%s", oldPath, "lanePositionBased");
  GetDENMOccupiedLanesWithConfidence_lanePositionBasedParams(packetHandle, value.lanePositionBased, newPath);
  result = CheckLastError("DENM", gkFuncRefGet, result);

  snprintf(newPath, elcount(newPath), "%s.%s", oldPath, "mapBased");
  value.mapBased.isValidFlag = C2xIsTokenAvailable(packetHandle, "DENM", newPath);
  if(value.mapBased.isValidFlag==1)
  {
    GetDENMOccupiedLanesWithConfidence_mapBasedParams(packetHandle, value.mapBased, newPath);
    result = CheckLastError("DENM", gkFuncRefGet, result);
  }
  snprintf(newPath, elcount(newPath), "%s.%s", oldPath, "confidence");
  GetDENMMetaInformationParams(packetHandle, value.confidence, newPath);
  result = CheckLastError("DENM", gkFuncRefGet, result);

  return result;
}

int SetDENMOccupiedLanesWithConfidenceParams(LONG packetHandle, struct DENMOccupiedLanesWithConfidence value, char oldPath[])
{
  char newPath[300];
  int result;

  result = 0;

  snprintf(newPath, elcount(newPath), "%s.%s", oldPath, "lanePositionBased");
  SetDENMOccupiedLanesWithConfidence_lanePositionBasedParams(packetHandle, value.lanePositionBased, newPath);
  result = CheckLastError("DENM", gkFuncRefGet, result);

  snprintf(newPath, elcount(newPath), "%s.%s", oldPath, "mapBased");
  if(value.mapBased.isValidFlag==1)
  {
    SetDENMOccupiedLanesWithConfidence_mapBasedParams(packetHandle, value.mapBased, newPath);
    result = CheckLastError("DENM", gkFuncRefGet, result);
  }
  else
  {
    if( C2xIsTokenAvailable(packetHandle, "DENM", newPath) )
    {
      C2xRemoveToken(packetHandle, "DENM", newPath);
    }
  }

  snprintf(newPath, elcount(newPath), "%s.%s", oldPath, "confidence");
  SetDENMMetaInformationParams(packetHandle, value.confidence, newPath);
  result = CheckLastError("DENM", gkFuncRefGet, result);

  return result;
}

int GetDENMProviderParams(LONG packetHandle, struct DENMProvider value, char oldPath[])
{
  char newPath[300]; 
  int j; 
  int k;
  int result;

  result = 0;

  snprintf(newPath, elcount(newPath), "%s.%s", oldPath, "countryCode");
  value.countryCode.isValidFlag = 1;
  value.countryCode.stringLength = C2xGetTokenLengthBit(packetHandle, "DENM", newPath);
  if ((result = CheckLastError("DENM", gkFuncRefGet, result))==0)
  {
    if(value.countryCode.stringLength > 0)
    {
      for(j=0; j<value.countryCode.stringLength; j++)
      {
        if(C2xGetTokenBitOfBitString(packetHandle, "DENM", newPath, j) == 0)
        {
          value.countryCode.string[j] = '0';
        }
        else if(C2xGetTokenBitOfBitString(packetHandle, "DENM", newPath, j) == 1)
        {
          value.countryCode.string[j] = '1';
        }

        if(value.countryCode.stringLength == 1)
        {
          value.countryCode.string[1] = '0';
        }
        result = CheckLastError("DENM", gkFuncRefGet, result);
      }
    }
    else
    {
      for(k = value.countryCode.stringLength+1; k > -1; k--)
      {
        if(value.countryCode.string[k] == '1')
        {
          value.countryCode.string[k] = '0';
        }
      }
    }
  }

  snprintf(newPath, elcount(newPath), "%s.%s", oldPath, "providerIdentifier");
  value.providerIdentifier = C2xGetTokenInt(packetHandle, "DENM", newPath);
  result = CheckLastError("DENM", gkFuncRefGet, result);

  return result;
}

int SetDENMProviderParams(LONG packetHandle, struct DENMProvider value, char oldPath[])
{
  char newPath[300]; 
  int j;
  int result;

  result = 0;

  snprintf(newPath, elcount(newPath), "%s.%s", oldPath, "countryCode");
    for(j=0; j<value.countryCode.stringLength; j++)
    {
      if(value.countryCode.string[j] == '0')
      {
        C2xSetTokenBitOfBitString(packetHandle, "DENM", newPath, j, 0);
      }
      else
      {
        C2xSetTokenBitOfBitString(packetHandle, "DENM", newPath, j, 1);
      }
      result = CheckLastError("DENM", gkFuncRefGet, result);
    }

  snprintf(newPath, elcount(newPath), "%s.%s", oldPath, "providerIdentifier");
  C2xSetTokenInt(packetHandle, "DENM", newPath, value.providerIdentifier);
  result = CheckLastError("DENM", gkFuncRefGet, result);

  return result;
}

int GetDENMIvimReferenceParams(LONG packetHandle, struct DENMIvimReference value, char oldPath[])
{
  char newPath[300];
  int result;

  result = 0;

  snprintf(newPath, elcount(newPath), "%s.%s", oldPath, "serviceProviderId");
  GetDENMProviderParams(packetHandle, value.serviceProviderId, newPath);
  result = CheckLastError("DENM", gkFuncRefGet, result);

  snprintf(newPath, elcount(newPath), "%s.%s", oldPath, "iviIdentificationNumber");
  value.iviIdentificationNumber = C2xGetTokenInt(packetHandle, "DENM", newPath);
  result = CheckLastError("DENM", gkFuncRefGet, result);

  return result;
}

int SetDENMIvimReferenceParams(LONG packetHandle, struct DENMIvimReference value, char oldPath[])
{
  char newPath[300];
  int result;

  result = 0;

  snprintf(newPath, elcount(newPath), "%s.%s", oldPath, "serviceProviderId");
  SetDENMProviderParams(packetHandle, value.serviceProviderId, newPath);
  result = CheckLastError("DENM", gkFuncRefGet, result);

  snprintf(newPath, elcount(newPath), "%s.%s", oldPath, "iviIdentificationNumber");
  if (value.iviIdentificationNumber < 8388607)
  {
    C2xSetTokenInt(packetHandle, "DENM", newPath, 8388607);
  }
  else if (value.iviIdentificationNumber > 8388607)
  {
    C2xSetTokenInt(packetHandle, "DENM", newPath, 8388607);
  }
  else
  {
    C2xSetTokenInt(packetHandle, "DENM", newPath, value.iviIdentificationNumber);
  }
  result = CheckLastError("DENM", gkFuncRefGet, result);

  return result;
}

int GetDENMIvimReferencesParams(LONG packetHandle, struct DENMIvimReferences value, char oldPath[])
{
  char newPath[300]; 
  int i;
  int result;

  result = 0;

  value.length = C2xGetTokenInt(packetHandle, "DENM", oldPath);
  if((result = CheckLastError("DENM", gkFuncRefGet, result))==0)
  {
    for(i=0; i<value.length; i++)
    {
      snprintf(newPath, elcount(newPath), "%s[%d]", oldPath, i);
      GetDENMIvimReferenceParams(packetHandle, value.arrayValue[i], newPath);
      result = CheckLastError("DENM", gkFuncRefGet, result);
    }
  }
  return result;
}

int SetDENMIvimReferencesParams(LONG packetHandle, struct DENMIvimReferences value, char oldPath[])
{
  char newPath[300]; 
  int i;
  int result;

  result = 0;

  C2xRemoveToken(packetHandle, "DENM", oldPath);
  for(i=0; i<value.length; i++)
  {
    snprintf(newPath, elcount(newPath), "%s[%d]", oldPath, i);
    SetDENMIvimReferenceParams(packetHandle, value.arrayValue[i], newPath);
    result = CheckLastError("DENM", gkFuncRefGet, result);
  }
  return result;
}

int GetDENMMapReferencesParams(LONG packetHandle, struct DENMMapReferences value, char oldPath[])
{
  char newPath[300]; 
  int i;
  int result;

  result = 0;

  value.length = C2xGetTokenInt(packetHandle, "DENM", oldPath);
  if((result = CheckLastError("DENM", gkFuncRefGet, result))==0)
  {
    for(i=0; i<value.length; i++)
    {
      snprintf(newPath, elcount(newPath), "%s[%d]", oldPath, i);
      GetDENMMapReferenceParams(packetHandle, value.arrayValue[i], newPath);
      result = CheckLastError("DENM", gkFuncRefGet, result);
    }
  }
  return result;
}

int SetDENMMapReferencesParams(LONG packetHandle, struct DENMMapReferences value, char oldPath[])
{
  char newPath[300]; 
  int i;
  int result;

  result = 0;

  C2xRemoveToken(packetHandle, "DENM", oldPath);
  for(i=0; i<value.length; i++)
  {
    snprintf(newPath, elcount(newPath), "%s[%d]", oldPath, i);
    SetDENMMapReferenceParams(packetHandle, value.arrayValue[i], newPath);
    result = CheckLastError("DENM", gkFuncRefGet, result);
  }
  return result;
}

int GetDENMPathExtendedParams(LONG packetHandle, struct DENMPathExtended value, char oldPath[])
{
  char newPath[300];
  int result;

  result = 0;

  snprintf(newPath, elcount(newPath), "%s.%s", oldPath, "pointOfEventZone");
  value.pointOfEventZone = C2xGetTokenInt(packetHandle, "DENM", newPath);
  result = CheckLastError("DENM", gkFuncRefGet, result);

  snprintf(newPath, elcount(newPath), "%s.%s", oldPath, "path");
  GetDENMPathParams(packetHandle, value.path, newPath);
  result = CheckLastError("DENM", gkFuncRefGet, result);

  return result;
}

int SetDENMPathExtendedParams(LONG packetHandle, struct DENMPathExtended value, char oldPath[])
{
  char newPath[300];
  int result;

  result = 0;

  snprintf(newPath, elcount(newPath), "%s.%s", oldPath, "pointOfEventZone");
  if (value.pointOfEventZone < 1)
  {
    C2xSetTokenInt(packetHandle, "DENM", newPath, 1);
  }
  else if (value.pointOfEventZone > 23)
  {
    C2xSetTokenInt(packetHandle, "DENM", newPath, 23);
  }
  else
  {
    C2xSetTokenInt(packetHandle, "DENM", newPath, value.pointOfEventZone);
  }
  result = CheckLastError("DENM", gkFuncRefGet, result);

  snprintf(newPath, elcount(newPath), "%s.%s", oldPath, "path");
  SetDENMPathParams(packetHandle, value.path, newPath);
  result = CheckLastError("DENM", gkFuncRefGet, result);

  return result;
}

int GetDENMTracesExtendedParams(LONG packetHandle, struct DENMTracesExtended value, char oldPath[])
{
  char newPath[300]; 
  int i;
  int result;

  result = 0;

  value.length = C2xGetTokenInt(packetHandle, "DENM", oldPath);
  if((result = CheckLastError("DENM", gkFuncRefGet, result))==0)
  {
    for(i=0; i<value.length; i++)
    {
      snprintf(newPath, elcount(newPath), "%s[%d]", oldPath, i);
      GetDENMPathExtendedParams(packetHandle, value.arrayValue[i], newPath);
      result = CheckLastError("DENM", gkFuncRefGet, result);
    }
  }
  return result;
}

int SetDENMTracesExtendedParams(LONG packetHandle, struct DENMTracesExtended value, char oldPath[])
{
  char newPath[300]; 
  int i;
  int result;

  result = 0;

  C2xRemoveToken(packetHandle, "DENM", oldPath);
  for(i=0; i<value.length; i++)
  {
    snprintf(newPath, elcount(newPath), "%s[%d]", oldPath, i);
    SetDENMPathExtendedParams(packetHandle, value.arrayValue[i], newPath);
    result = CheckLastError("DENM", gkFuncRefGet, result);
  }
  return result;
}

int GetDENMPathDeltaTimeChoiceParams(LONG packetHandle, struct DENMPathDeltaTimeChoice value, char oldPath[])
{
  char newPath[300];
  int result;

  result = 0;

  value.choice = C2xGetTokenInt(packetHandle, "DENM", oldPath);

  switch(value.choice)
  {
    case 0:
    {
      snprintf(newPath, elcount(newPath), "%s.%s", oldPath, "deltaTimeHighPrecision");
      value.deltaTimeHighPrecision = C2xGetTokenInt(packetHandle, "DENM", newPath);
      result = CheckLastError("DENM", gkFuncRefGet, result);
    }
    break;
    case 1:
    {
      snprintf(newPath, elcount(newPath), "%s.%s", oldPath, "deltaTimeBigRange");
      value.deltaTimeBigRange = C2xGetTokenInt(packetHandle, "DENM", newPath);
      result = CheckLastError("DENM", gkFuncRefGet, result);
    }
    break;
    case 2:
    {
      snprintf(newPath, elcount(newPath), "%s.%s", oldPath, "deltaTimeMidRange");
      value.deltaTimeMidRange = C2xGetTokenInt(packetHandle, "DENM", newPath);
      result = CheckLastError("DENM", gkFuncRefGet, result);
    }
    break;
  }
  return result;
}

int SetDENMPathDeltaTimeChoiceParams(LONG packetHandle, struct DENMPathDeltaTimeChoice value, char oldPath[])
{
  char newPath[300];
  int result;

  result = 0;

  switch(value.choice)
  {
    case 0:
    {
      snprintf(newPath, elcount(newPath), "%s.%s", oldPath, "deltaTimeHighPrecision");
      C2xSetTokenInt(packetHandle, "DENM", newPath, value.deltaTimeHighPrecision);
      result = CheckLastError("DENM", gkFuncRefGet, result);
    }
    break;
    case 1:
    {
      snprintf(newPath, elcount(newPath), "%s.%s", oldPath, "deltaTimeBigRange");
      C2xSetTokenInt(packetHandle, "DENM", newPath, value.deltaTimeBigRange);
      result = CheckLastError("DENM", gkFuncRefGet, result);
    }
    break;
    case 2:
    {
      snprintf(newPath, elcount(newPath), "%s.%s", oldPath, "deltaTimeMidRange");
      C2xSetTokenInt(packetHandle, "DENM", newPath, value.deltaTimeMidRange);
      result = CheckLastError("DENM", gkFuncRefGet, result);
    }
    break;
  }
  return result;
}

int GetDENMPathPointPredictedParams(LONG packetHandle, struct DENMPathPointPredicted value, char oldPath[])
{
  char newPath[300];
  int result;

  result = 0;

  snprintf(newPath, elcount(newPath), "%s.%s", oldPath, "deltaLatitude");
  value.deltaLatitude = C2xGetTokenInt(packetHandle, "DENM", newPath);
  result = CheckLastError("DENM", gkFuncRefGet, result);

  snprintf(newPath, elcount(newPath), "%s.%s", oldPath, "deltaLongitude");
  value.deltaLongitude = C2xGetTokenInt(packetHandle, "DENM", newPath);
  result = CheckLastError("DENM", gkFuncRefGet, result);

  snprintf(newPath, elcount(newPath), "%s.%s", oldPath, "horizontalPositionConfidence");
  value.horizontalPositionConfidence.isValidFlag = C2xIsTokenAvailable(packetHandle, "DENM", newPath);
  if(value.horizontalPositionConfidence.isValidFlag==1)
  {
    GetDENMPosConfidenceEllipseParams(packetHandle, value.horizontalPositionConfidence, newPath);
    result = CheckLastError("DENM", gkFuncRefGet, result);
  }
  snprintf(newPath, elcount(newPath), "%s.%s", oldPath, "deltaAltitude");
  value.deltaAltitude.isValidFlag = C2xIsTokenAvailable(packetHandle, "DENM", newPath);
  if(value.deltaAltitude.isValidFlag==1)
  {
    value.deltaAltitude.value = C2xGetTokenInt(packetHandle, "DENM", newPath);
    result = CheckLastError("DENM", gkFuncRefGet, result);
  }
  snprintf(newPath, elcount(newPath), "%s.%s", oldPath, "altitudeConfidence");
  value.altitudeConfidence.isValidFlag = C2xIsTokenAvailable(packetHandle, "DENM", newPath);
  if(value.altitudeConfidence.isValidFlag==1)
  {
    value.altitudeConfidence.value = C2xGetTokenInt(packetHandle, "DENM", newPath);
    result = CheckLastError("DENM", gkFuncRefGet, result);
  }
  snprintf(newPath, elcount(newPath), "%s.%s", oldPath, "pathDeltaTime");
  value.pathDeltaTime.isValidFlag = C2xIsTokenAvailable(packetHandle, "DENM", newPath);
  if(value.pathDeltaTime.isValidFlag==1)
  {
    GetDENMPathDeltaTimeChoiceParams(packetHandle, value.pathDeltaTime, newPath);
    result = CheckLastError("DENM", gkFuncRefGet, result);
  }
  snprintf(newPath, elcount(newPath), "%s.%s", oldPath, "symmetricAreaOffset");
  value.symmetricAreaOffset.isValidFlag = C2xIsTokenAvailable(packetHandle, "DENM", newPath);
  if(value.symmetricAreaOffset.isValidFlag==1)
  {
    value.symmetricAreaOffset.value = C2xGetTokenInt(packetHandle, "DENM", newPath);
    result = CheckLastError("DENM", gkFuncRefGet, result);
  }
  snprintf(newPath, elcount(newPath), "%s.%s", oldPath, "asymmetricAreaOffset");
  value.asymmetricAreaOffset.isValidFlag = C2xIsTokenAvailable(packetHandle, "DENM", newPath);
  if(value.asymmetricAreaOffset.isValidFlag==1)
  {
    value.asymmetricAreaOffset.value = C2xGetTokenInt(packetHandle, "DENM", newPath);
    result = CheckLastError("DENM", gkFuncRefGet, result);
  }
  return result;
}

int SetDENMPathPointPredictedParams(LONG packetHandle, struct DENMPathPointPredicted value, char oldPath[])
{
  char newPath[300];
  int result;

  result = 0;

  snprintf(newPath, elcount(newPath), "%s.%s", oldPath, "deltaLatitude");
  C2xSetTokenInt(packetHandle, "DENM", newPath, value.deltaLatitude);
  result = CheckLastError("DENM", gkFuncRefGet, result);

  snprintf(newPath, elcount(newPath), "%s.%s", oldPath, "deltaLongitude");
  C2xSetTokenInt(packetHandle, "DENM", newPath, value.deltaLongitude);
  result = CheckLastError("DENM", gkFuncRefGet, result);

  snprintf(newPath, elcount(newPath), "%s.%s", oldPath, "horizontalPositionConfidence");
  if(value.horizontalPositionConfidence.isValidFlag==1)
  {
    SetDENMPosConfidenceEllipseParams(packetHandle, value.horizontalPositionConfidence, newPath);
    result = CheckLastError("DENM", gkFuncRefGet, result);
  }
  else
  {
    if( C2xIsTokenAvailable(packetHandle, "DENM", newPath) )
    {
      C2xRemoveToken(packetHandle, "DENM", newPath);
    }
  }

  snprintf(newPath, elcount(newPath), "%s.%s", oldPath, "deltaAltitude");
  if(value.deltaAltitude.isValidFlag==1)
  {
    C2xSetTokenInt(packetHandle, "DENM", newPath, value.deltaAltitude.value);
    result = CheckLastError("DENM", gkFuncRefGet, result);
  }
  else
  {
    if( C2xIsTokenAvailable(packetHandle, "DENM", newPath) )
    {
      C2xRemoveToken(packetHandle, "DENM", newPath);
    }
  }

  snprintf(newPath, elcount(newPath), "%s.%s", oldPath, "altitudeConfidence");
  if(value.altitudeConfidence.isValidFlag==1)
  {
    C2xSetTokenInt(packetHandle, "DENM", newPath, value.altitudeConfidence.value);
    result = CheckLastError("DENM", gkFuncRefGet, result);
  }
  else
  {
    if( C2xIsTokenAvailable(packetHandle, "DENM", newPath) )
    {
      C2xRemoveToken(packetHandle, "DENM", newPath);
    }
  }

  snprintf(newPath, elcount(newPath), "%s.%s", oldPath, "pathDeltaTime");
  if(value.pathDeltaTime.isValidFlag==1)
  {
    SetDENMPathDeltaTimeChoiceParams(packetHandle, value.pathDeltaTime, newPath);
    result = CheckLastError("DENM", gkFuncRefGet, result);
  }
  else
  {
    if( C2xIsTokenAvailable(packetHandle, "DENM", newPath) )
    {
      C2xRemoveToken(packetHandle, "DENM", newPath);
    }
  }

  snprintf(newPath, elcount(newPath), "%s.%s", oldPath, "symmetricAreaOffset");
  if(value.symmetricAreaOffset.isValidFlag==1)
  {
    C2xSetTokenInt(packetHandle, "DENM", newPath, value.symmetricAreaOffset.value);
    result = CheckLastError("DENM", gkFuncRefGet, result);
  }
  else
  {
    if( C2xIsTokenAvailable(packetHandle, "DENM", newPath) )
    {
      C2xRemoveToken(packetHandle, "DENM", newPath);
    }
  }

  snprintf(newPath, elcount(newPath), "%s.%s", oldPath, "asymmetricAreaOffset");
  if(value.asymmetricAreaOffset.isValidFlag==1)
  {
    C2xSetTokenInt(packetHandle, "DENM", newPath, value.asymmetricAreaOffset.value);
    result = CheckLastError("DENM", gkFuncRefGet, result);
  }
  else
  {
    if( C2xIsTokenAvailable(packetHandle, "DENM", newPath) )
    {
      C2xRemoveToken(packetHandle, "DENM", newPath);
    }
  }

  return result;
}

int GetDENMPathPredictedParams(LONG packetHandle, struct DENMPathPredicted value, char oldPath[])
{
  char newPath[300]; 
  int i;
  int result;

  result = 0;

  value.length = C2xGetTokenInt(packetHandle, "DENM", oldPath);
  if((result = CheckLastError("DENM", gkFuncRefGet, result))==0)
  {
    for(i=0; i<value.length; i++)
    {
      snprintf(newPath, elcount(newPath), "%s[%d]", oldPath, i);
      GetDENMPathPointPredictedParams(packetHandle, value.arrayValue[i], newPath);
      result = CheckLastError("DENM", gkFuncRefGet, result);
    }
  }
  return result;
}

int SetDENMPathPredictedParams(LONG packetHandle, struct DENMPathPredicted value, char oldPath[])
{
  char newPath[300]; 
  int i;
  int result;

  result = 0;

  C2xRemoveToken(packetHandle, "DENM", oldPath);
  for(i=0; i<value.length; i++)
  {
    snprintf(newPath, elcount(newPath), "%s[%d]", oldPath, i);
    SetDENMPathPointPredictedParams(packetHandle, value.arrayValue[i], newPath);
    result = CheckLastError("DENM", gkFuncRefGet, result);
  }
  return result;
}

int GetDENMPathPredicted2Params(LONG packetHandle, struct DENMPathPredicted2 value, char oldPath[])
{
  char newPath[300];
  int result;

  result = 0;

  snprintf(newPath, elcount(newPath), "%s.%s", oldPath, "pathPredicted");
  GetDENMPathPredictedParams(packetHandle, value.pathPredicted, newPath);
  result = CheckLastError("DENM", gkFuncRefGet, result);

  snprintf(newPath, elcount(newPath), "%s.%s", oldPath, "usageIndication");
  value.usageIndication = C2xGetTokenInt(packetHandle, "DENM", newPath);
  result = CheckLastError("DENM", gkFuncRefGet, result);

  snprintf(newPath, elcount(newPath), "%s.%s", oldPath, "confidenceLevel");
  value.confidenceLevel = C2xGetTokenInt(packetHandle, "DENM", newPath);
  result = CheckLastError("DENM", gkFuncRefGet, result);

  return result;
}

int SetDENMPathPredicted2Params(LONG packetHandle, struct DENMPathPredicted2 value, char oldPath[])
{
  char newPath[300];
  int result;

  result = 0;

  snprintf(newPath, elcount(newPath), "%s.%s", oldPath, "pathPredicted");
  SetDENMPathPredictedParams(packetHandle, value.pathPredicted, newPath);
  result = CheckLastError("DENM", gkFuncRefGet, result);

  snprintf(newPath, elcount(newPath), "%s.%s", oldPath, "usageIndication");
  C2xSetTokenInt(packetHandle, "DENM", newPath, value.usageIndication);
  result = CheckLastError("DENM", gkFuncRefGet, result);

  snprintf(newPath, elcount(newPath), "%s.%s", oldPath, "confidenceLevel");
  if (value.confidenceLevel < 1)
  {
    C2xSetTokenInt(packetHandle, "DENM", newPath, 1);
  }
  else if (value.confidenceLevel > 101)
  {
    C2xSetTokenInt(packetHandle, "DENM", newPath, 101);
  }
  else
  {
    C2xSetTokenInt(packetHandle, "DENM", newPath, value.confidenceLevel);
  }
  result = CheckLastError("DENM", gkFuncRefGet, result);

  return result;
}

int GetDENMPathPredictedListParams(LONG packetHandle, struct DENMPathPredictedList value, char oldPath[])
{
  char newPath[300]; 
  int i;
  int result;

  result = 0;

  value.length = C2xGetTokenInt(packetHandle, "DENM", oldPath);
  if((result = CheckLastError("DENM", gkFuncRefGet, result))==0)
  {
    for(i=0; i<value.length; i++)
    {
      snprintf(newPath, elcount(newPath), "%s[%d]", oldPath, i);
      GetDENMPathPredicted2Params(packetHandle, value.arrayValue[i], newPath);
      result = CheckLastError("DENM", gkFuncRefGet, result);
    }
  }
  return result;
}

int SetDENMPathPredictedListParams(LONG packetHandle, struct DENMPathPredictedList value, char oldPath[])
{
  char newPath[300]; 
  int i;
  int result;

  result = 0;

  C2xRemoveToken(packetHandle, "DENM", oldPath);
  for(i=0; i<value.length; i++)
  {
    snprintf(newPath, elcount(newPath), "%s[%d]", oldPath, i);
    SetDENMPathPredicted2Params(packetHandle, value.arrayValue[i], newPath);
    result = CheckLastError("DENM", gkFuncRefGet, result);
  }
  return result;
}

int GetDENMLocationContainerParams(LONG packetHandle, struct DENMLocationContainer value, char oldPath[])
{
  char newPath[300];
  int result;

  result = 0;

  snprintf(newPath, elcount(newPath), "%s.%s", oldPath, "eventSpeed");
  value.eventSpeed.isValidFlag = C2xIsTokenAvailable(packetHandle, "DENM", newPath);
  if(value.eventSpeed.isValidFlag==1)
  {
    GetDENMSpeedParams(packetHandle, value.eventSpeed, newPath);
    result = CheckLastError("DENM", gkFuncRefGet, result);
  }
  snprintf(newPath, elcount(newPath), "%s.%s", oldPath, "eventPositionHeading");
  value.eventPositionHeading.isValidFlag = C2xIsTokenAvailable(packetHandle, "DENM", newPath);
  if(value.eventPositionHeading.isValidFlag==1)
  {
    GetDENMWgs84AngleParams(packetHandle, value.eventPositionHeading, newPath);
    result = CheckLastError("DENM", gkFuncRefGet, result);
  }
  snprintf(newPath, elcount(newPath), "%s.%s", oldPath, "traces");
  GetDENMTracesParams(packetHandle, value.traces, newPath);
  result = CheckLastError("DENM", gkFuncRefGet, result);

  snprintf(newPath, elcount(newPath), "%s.%s", oldPath, "roadType");
  value.roadType.isValidFlag = C2xIsTokenAvailable(packetHandle, "DENM", newPath);
  if(value.roadType.isValidFlag==1)
  {
    value.roadType.value = C2xGetTokenInt(packetHandle, "DENM", newPath);
    result = CheckLastError("DENM", gkFuncRefGet, result);
  }
  snprintf(newPath, elcount(newPath), "%s.%s", oldPath, "lanePositions");
  value.lanePositions.isValidFlag = C2xIsTokenAvailable(packetHandle, "DENM", newPath);
  if(value.lanePositions.isValidFlag==1)
  {
    GetDENMGeneralizedLanePositionsParams(packetHandle, value.lanePositions, newPath);
    result = CheckLastError("DENM", gkFuncRefGet, result);
  }
  snprintf(newPath, elcount(newPath), "%s.%s", oldPath, "occupiedLanes");
  value.occupiedLanes.isValidFlag = C2xIsTokenAvailable(packetHandle, "DENM", newPath);
  if(value.occupiedLanes.isValidFlag==1)
  {
    GetDENMOccupiedLanesWithConfidenceParams(packetHandle, value.occupiedLanes, newPath);
    result = CheckLastError("DENM", gkFuncRefGet, result);
  }
  snprintf(newPath, elcount(newPath), "%s.%s", oldPath, "linkedIvims");
  value.linkedIvims.isValidFlag = C2xIsTokenAvailable(packetHandle, "DENM", newPath);
  if(value.linkedIvims.isValidFlag==1)
  {
    GetDENMIvimReferencesParams(packetHandle, value.linkedIvims, newPath);
    result = CheckLastError("DENM", gkFuncRefGet, result);
  }
  snprintf(newPath, elcount(newPath), "%s.%s", oldPath, "linkedMapems");
  value.linkedMapems.isValidFlag = C2xIsTokenAvailable(packetHandle, "DENM", newPath);
  if(value.linkedMapems.isValidFlag==1)
  {
    GetDENMMapReferencesParams(packetHandle, value.linkedMapems, newPath);
    result = CheckLastError("DENM", gkFuncRefGet, result);
  }
  snprintf(newPath, elcount(newPath), "%s.%s", oldPath, "detectionZonesToSpecifiedEventPoint");
  value.detectionZonesToSpecifiedEventPoint.isValidFlag = C2xIsTokenAvailable(packetHandle, "DENM", newPath);
  if(value.detectionZonesToSpecifiedEventPoint.isValidFlag==1)
  {
    GetDENMTracesExtendedParams(packetHandle, value.detectionZonesToSpecifiedEventPoint, newPath);
    result = CheckLastError("DENM", gkFuncRefGet, result);
  }
  snprintf(newPath, elcount(newPath), "%s.%s", oldPath, "predictedPaths");
  value.predictedPaths.isValidFlag = C2xIsTokenAvailable(packetHandle, "DENM", newPath);
  if(value.predictedPaths.isValidFlag==1)
  {
    GetDENMPathPredictedListParams(packetHandle, value.predictedPaths, newPath);
    result = CheckLastError("DENM", gkFuncRefGet, result);
  }
  return result;
}

int SetDENMLocationContainerParams(LONG packetHandle, struct DENMLocationContainer value, char oldPath[])
{
  char newPath[300];
  int result;

  result = 0;

  snprintf(newPath, elcount(newPath), "%s.%s", oldPath, "eventSpeed");
  if(value.eventSpeed.isValidFlag==1)
  {
    SetDENMSpeedParams(packetHandle, value.eventSpeed, newPath);
    result = CheckLastError("DENM", gkFuncRefGet, result);
  }
  else
  {
    if( C2xIsTokenAvailable(packetHandle, "DENM", newPath) )
    {
      C2xRemoveToken(packetHandle, "DENM", newPath);
    }
  }

  snprintf(newPath, elcount(newPath), "%s.%s", oldPath, "eventPositionHeading");
  if(value.eventPositionHeading.isValidFlag==1)
  {
    SetDENMWgs84AngleParams(packetHandle, value.eventPositionHeading, newPath);
    result = CheckLastError("DENM", gkFuncRefGet, result);
  }
  else
  {
    if( C2xIsTokenAvailable(packetHandle, "DENM", newPath) )
    {
      C2xRemoveToken(packetHandle, "DENM", newPath);
    }
  }

  snprintf(newPath, elcount(newPath), "%s.%s", oldPath, "traces");
  SetDENMTracesParams(packetHandle, value.traces, newPath);
  result = CheckLastError("DENM", gkFuncRefGet, result);

  snprintf(newPath, elcount(newPath), "%s.%s", oldPath, "roadType");
  if(value.roadType.isValidFlag==1)
  {
    C2xSetTokenInt(packetHandle, "DENM", newPath, value.roadType.value);
    result = CheckLastError("DENM", gkFuncRefGet, result);
  }
  else
  {
    if( C2xIsTokenAvailable(packetHandle, "DENM", newPath) )
    {
      C2xRemoveToken(packetHandle, "DENM", newPath);
    }
  }

  snprintf(newPath, elcount(newPath), "%s.%s", oldPath, "lanePositions");
  if(value.lanePositions.isValidFlag==1)
  {
    SetDENMGeneralizedLanePositionsParams(packetHandle, value.lanePositions, newPath);
    result = CheckLastError("DENM", gkFuncRefGet, result);
  }
  else
  {
    if( C2xIsTokenAvailable(packetHandle, "DENM", newPath) )
    {
      C2xRemoveToken(packetHandle, "DENM", newPath);
    }
  }

  snprintf(newPath, elcount(newPath), "%s.%s", oldPath, "occupiedLanes");
  if(value.occupiedLanes.isValidFlag==1)
  {
    SetDENMOccupiedLanesWithConfidenceParams(packetHandle, value.occupiedLanes, newPath);
    result = CheckLastError("DENM", gkFuncRefGet, result);
  }
  else
  {
    if( C2xIsTokenAvailable(packetHandle, "DENM", newPath) )
    {
      C2xRemoveToken(packetHandle, "DENM", newPath);
    }
  }

  snprintf(newPath, elcount(newPath), "%s.%s", oldPath, "linkedIvims");
  if(value.linkedIvims.isValidFlag==1)
  {
    SetDENMIvimReferencesParams(packetHandle, value.linkedIvims, newPath);
    result = CheckLastError("DENM", gkFuncRefGet, result);
  }
  else
  {
    if( C2xIsTokenAvailable(packetHandle, "DENM", newPath) )
    {
      C2xRemoveToken(packetHandle, "DENM", newPath);
    }
  }

  snprintf(newPath, elcount(newPath), "%s.%s", oldPath, "linkedMapems");
  if(value.linkedMapems.isValidFlag==1)
  {
    SetDENMMapReferencesParams(packetHandle, value.linkedMapems, newPath);
    result = CheckLastError("DENM", gkFuncRefGet, result);
  }
  else
  {
    if( C2xIsTokenAvailable(packetHandle, "DENM", newPath) )
    {
      C2xRemoveToken(packetHandle, "DENM", newPath);
    }
  }

  snprintf(newPath, elcount(newPath), "%s.%s", oldPath, "detectionZonesToSpecifiedEventPoint");
  if(value.detectionZonesToSpecifiedEventPoint.isValidFlag==1)
  {
    SetDENMTracesExtendedParams(packetHandle, value.detectionZonesToSpecifiedEventPoint, newPath);
    result = CheckLastError("DENM", gkFuncRefGet, result);
  }
  else
  {
    if( C2xIsTokenAvailable(packetHandle, "DENM", newPath) )
    {
      C2xRemoveToken(packetHandle, "DENM", newPath);
    }
  }

  snprintf(newPath, elcount(newPath), "%s.%s", oldPath, "predictedPaths");
  if(value.predictedPaths.isValidFlag==1)
  {
    SetDENMPathPredictedListParams(packetHandle, value.predictedPaths, newPath);
    result = CheckLastError("DENM", gkFuncRefGet, result);
  }
  else
  {
    if( C2xIsTokenAvailable(packetHandle, "DENM", newPath) )
    {
      C2xRemoveToken(packetHandle, "DENM", newPath);
    }
  }

  return result;
}

int GetDENMPositionOfPillarsParams(LONG packetHandle, struct DENMPositionOfPillars value, char oldPath[])
{
  char newPath[300]; 
  int i;
  int result;

  result = 0;

  value.length = C2xGetTokenInt(packetHandle, "DENM", oldPath);
  if((result = CheckLastError("DENM", gkFuncRefGet, result))==0)
  {
    for(i=0; i<value.length; i++)
    {
      snprintf(newPath, elcount(newPath), "%s[%d]", oldPath, i);
      value.arrayValue[i] = C2xGetTokenInt64(packetHandle, "DENM", newPath);
      result = CheckLastError("DENM", gkFuncRefGet, result);
    }
  }
  return result;
}

int SetDENMPositionOfPillarsParams(LONG packetHandle, struct DENMPositionOfPillars value, char oldPath[])
{
  char newPath[300]; 
  int i;
  int result;

  result = 0;

  C2xRemoveToken(packetHandle, "DENM", oldPath);
  for(i=0; i<value.length; i++)
  {
    snprintf(newPath, elcount(newPath), "%s[%d]", oldPath, i);
    C2xSetTokenInt64(packetHandle, "DENM", newPath, value.arrayValue[i]);
    result = CheckLastError("DENM", gkFuncRefGet, result);
  }
  return result;
}

int GetDENMImpactReductionContainerParams(LONG packetHandle, struct DENMImpactReductionContainer value, char oldPath[])
{
  char newPath[300]; 
  int j; 
  int k;
  int result;

  result = 0;

  snprintf(newPath, elcount(newPath), "%s.%s", oldPath, "heightLonCarrLeft");
  value.heightLonCarrLeft = C2xGetTokenInt(packetHandle, "DENM", newPath);
  result = CheckLastError("DENM", gkFuncRefGet, result);

  snprintf(newPath, elcount(newPath), "%s.%s", oldPath, "heightLonCarrRight");
  value.heightLonCarrRight = C2xGetTokenInt(packetHandle, "DENM", newPath);
  result = CheckLastError("DENM", gkFuncRefGet, result);

  snprintf(newPath, elcount(newPath), "%s.%s", oldPath, "posLonCarrLeft");
  value.posLonCarrLeft = C2xGetTokenInt(packetHandle, "DENM", newPath);
  result = CheckLastError("DENM", gkFuncRefGet, result);

  snprintf(newPath, elcount(newPath), "%s.%s", oldPath, "posLonCarrRight");
  value.posLonCarrRight = C2xGetTokenInt(packetHandle, "DENM", newPath);
  result = CheckLastError("DENM", gkFuncRefGet, result);

  snprintf(newPath, elcount(newPath), "%s.%s", oldPath, "positionOfPillars");
  GetDENMPositionOfPillarsParams(packetHandle, value.positionOfPillars, newPath);
  result = CheckLastError("DENM", gkFuncRefGet, result);

  snprintf(newPath, elcount(newPath), "%s.%s", oldPath, "posCentMass");
  value.posCentMass = C2xGetTokenInt(packetHandle, "DENM", newPath);
  result = CheckLastError("DENM", gkFuncRefGet, result);

  snprintf(newPath, elcount(newPath), "%s.%s", oldPath, "wheelBaseVehicle");
  value.wheelBaseVehicle = C2xGetTokenInt(packetHandle, "DENM", newPath);
  result = CheckLastError("DENM", gkFuncRefGet, result);

  snprintf(newPath, elcount(newPath), "%s.%s", oldPath, "turningRadius");
  value.turningRadius = C2xGetTokenInt(packetHandle, "DENM", newPath);
  result = CheckLastError("DENM", gkFuncRefGet, result);

  snprintf(newPath, elcount(newPath), "%s.%s", oldPath, "posFrontAx");
  value.posFrontAx = C2xGetTokenInt(packetHandle, "DENM", newPath);
  result = CheckLastError("DENM", gkFuncRefGet, result);

  snprintf(newPath, elcount(newPath), "%s.%s", oldPath, "positionOfOccupants");
  value.positionOfOccupants.isValidFlag = 1;
  value.positionOfOccupants.stringLength = C2xGetTokenLengthBit(packetHandle, "DENM", newPath);
  if ((result = CheckLastError("DENM", gkFuncRefGet, result))==0)
  {
    if(value.positionOfOccupants.stringLength > 0)
    {
      for(j=0; j<value.positionOfOccupants.stringLength; j++)
      {
        if(C2xGetTokenBitOfBitString(packetHandle, "DENM", newPath, j) == 0)
        {
          value.positionOfOccupants.string[j] = '0';
        }
        else if(C2xGetTokenBitOfBitString(packetHandle, "DENM", newPath, j) == 1)
        {
          value.positionOfOccupants.string[j] = '1';
        }

        if(value.positionOfOccupants.stringLength == 1)
        {
          value.positionOfOccupants.string[1] = '0';
        }
        result = CheckLastError("DENM", gkFuncRefGet, result);
      }
    }
    else
    {
      for(k = value.positionOfOccupants.stringLength+1; k > -1; k--)
      {
        if(value.positionOfOccupants.string[k] == '1')
        {
          value.positionOfOccupants.string[k] = '0';
        }
      }
    }
  }

  snprintf(newPath, elcount(newPath), "%s.%s", oldPath, "vehicleMass");
  value.vehicleMass = C2xGetTokenInt(packetHandle, "DENM", newPath);
  result = CheckLastError("DENM", gkFuncRefGet, result);

  snprintf(newPath, elcount(newPath), "%s.%s", oldPath, "requestResponseIndication");
  value.requestResponseIndication = C2xGetTokenInt(packetHandle, "DENM", newPath);
  result = CheckLastError("DENM", gkFuncRefGet, result);

  return result;
}

int SetDENMImpactReductionContainerParams(LONG packetHandle, struct DENMImpactReductionContainer value, char oldPath[])
{
  char newPath[300]; 
  int j;
  int result;

  result = 0;

  snprintf(newPath, elcount(newPath), "%s.%s", oldPath, "heightLonCarrLeft");
  if (value.heightLonCarrLeft < 1)
  {
    C2xSetTokenInt(packetHandle, "DENM", newPath, 1);
  }
  else if (value.heightLonCarrLeft > 100)
  {
    C2xSetTokenInt(packetHandle, "DENM", newPath, 100);
  }
  else
  {
    C2xSetTokenInt(packetHandle, "DENM", newPath, value.heightLonCarrLeft);
  }
  result = CheckLastError("DENM", gkFuncRefGet, result);

  snprintf(newPath, elcount(newPath), "%s.%s", oldPath, "heightLonCarrRight");
  if (value.heightLonCarrRight < 1)
  {
    C2xSetTokenInt(packetHandle, "DENM", newPath, 1);
  }
  else if (value.heightLonCarrRight > 100)
  {
    C2xSetTokenInt(packetHandle, "DENM", newPath, 100);
  }
  else
  {
    C2xSetTokenInt(packetHandle, "DENM", newPath, value.heightLonCarrRight);
  }
  result = CheckLastError("DENM", gkFuncRefGet, result);

  snprintf(newPath, elcount(newPath), "%s.%s", oldPath, "posLonCarrLeft");
  if (value.posLonCarrLeft < 1)
  {
    C2xSetTokenInt(packetHandle, "DENM", newPath, 1);
  }
  else if (value.posLonCarrLeft > 127)
  {
    C2xSetTokenInt(packetHandle, "DENM", newPath, 127);
  }
  else
  {
    C2xSetTokenInt(packetHandle, "DENM", newPath, value.posLonCarrLeft);
  }
  result = CheckLastError("DENM", gkFuncRefGet, result);

  snprintf(newPath, elcount(newPath), "%s.%s", oldPath, "posLonCarrRight");
  if (value.posLonCarrRight < 1)
  {
    C2xSetTokenInt(packetHandle, "DENM", newPath, 1);
  }
  else if (value.posLonCarrRight > 127)
  {
    C2xSetTokenInt(packetHandle, "DENM", newPath, 127);
  }
  else
  {
    C2xSetTokenInt(packetHandle, "DENM", newPath, value.posLonCarrRight);
  }
  result = CheckLastError("DENM", gkFuncRefGet, result);

  snprintf(newPath, elcount(newPath), "%s.%s", oldPath, "positionOfPillars");
  SetDENMPositionOfPillarsParams(packetHandle, value.positionOfPillars, newPath);
  result = CheckLastError("DENM", gkFuncRefGet, result);

  snprintf(newPath, elcount(newPath), "%s.%s", oldPath, "posCentMass");
  if (value.posCentMass < 1)
  {
    C2xSetTokenInt(packetHandle, "DENM", newPath, 1);
  }
  else if (value.posCentMass > 63)
  {
    C2xSetTokenInt(packetHandle, "DENM", newPath, 63);
  }
  else
  {
    C2xSetTokenInt(packetHandle, "DENM", newPath, value.posCentMass);
  }
  result = CheckLastError("DENM", gkFuncRefGet, result);

  snprintf(newPath, elcount(newPath), "%s.%s", oldPath, "wheelBaseVehicle");
  if (value.wheelBaseVehicle < 1)
  {
    C2xSetTokenInt(packetHandle, "DENM", newPath, 1);
  }
  else if (value.wheelBaseVehicle > 127)
  {
    C2xSetTokenInt(packetHandle, "DENM", newPath, 127);
  }
  else
  {
    C2xSetTokenInt(packetHandle, "DENM", newPath, value.wheelBaseVehicle);
  }
  result = CheckLastError("DENM", gkFuncRefGet, result);

  snprintf(newPath, elcount(newPath), "%s.%s", oldPath, "turningRadius");
  if (value.turningRadius < 1)
  {
    C2xSetTokenInt(packetHandle, "DENM", newPath, 1);
  }
  else if (value.turningRadius > 255)
  {
    C2xSetTokenInt(packetHandle, "DENM", newPath, 255);
  }
  else
  {
    C2xSetTokenInt(packetHandle, "DENM", newPath, value.turningRadius);
  }
  result = CheckLastError("DENM", gkFuncRefGet, result);

  snprintf(newPath, elcount(newPath), "%s.%s", oldPath, "posFrontAx");
  if (value.posFrontAx < 1)
  {
    C2xSetTokenInt(packetHandle, "DENM", newPath, 1);
  }
  else if (value.posFrontAx > 20)
  {
    C2xSetTokenInt(packetHandle, "DENM", newPath, 20);
  }
  else
  {
    C2xSetTokenInt(packetHandle, "DENM", newPath, value.posFrontAx);
  }
  result = CheckLastError("DENM", gkFuncRefGet, result);

  snprintf(newPath, elcount(newPath), "%s.%s", oldPath, "positionOfOccupants");
    for(j=0; j<value.positionOfOccupants.stringLength; j++)
    {
      if(value.positionOfOccupants.string[j] == '0')
      {
        C2xSetTokenBitOfBitString(packetHandle, "DENM", newPath, j, 0);
      }
      else
      {
        C2xSetTokenBitOfBitString(packetHandle, "DENM", newPath, j, 1);
      }
      result = CheckLastError("DENM", gkFuncRefGet, result);
    }

  snprintf(newPath, elcount(newPath), "%s.%s", oldPath, "vehicleMass");
  if (value.vehicleMass < 1)
  {
    C2xSetTokenInt(packetHandle, "DENM", newPath, 1);
  }
  else if (value.vehicleMass > 1024)
  {
    C2xSetTokenInt(packetHandle, "DENM", newPath, 1024);
  }
  else
  {
    C2xSetTokenInt(packetHandle, "DENM", newPath, value.vehicleMass);
  }
  result = CheckLastError("DENM", gkFuncRefGet, result);

  snprintf(newPath, elcount(newPath), "%s.%s", oldPath, "requestResponseIndication");
  C2xSetTokenInt(packetHandle, "DENM", newPath, value.requestResponseIndication);
  result = CheckLastError("DENM", gkFuncRefGet, result);

  return result;
}

int GetDENMClosedLanesParams(LONG packetHandle, struct DENMClosedLanes value, char oldPath[])
{
  char newPath[300]; 
  int j; 
  int k;
  int result;

  result = 0;

  snprintf(newPath, elcount(newPath), "%s.%s", oldPath, "innerhardShoulderStatus");
  value.innerhardShoulderStatus.isValidFlag = C2xIsTokenAvailable(packetHandle, "DENM", newPath);
  if(value.innerhardShoulderStatus.isValidFlag==1)
  {
    value.innerhardShoulderStatus.value = C2xGetTokenInt(packetHandle, "DENM", newPath);
    result = CheckLastError("DENM", gkFuncRefGet, result);
  }
  snprintf(newPath, elcount(newPath), "%s.%s", oldPath, "outerhardShoulderStatus");
  value.outerhardShoulderStatus.isValidFlag = C2xIsTokenAvailable(packetHandle, "DENM", newPath);
  if(value.outerhardShoulderStatus.isValidFlag==1)
  {
    value.outerhardShoulderStatus.value = C2xGetTokenInt(packetHandle, "DENM", newPath);
    result = CheckLastError("DENM", gkFuncRefGet, result);
  }
  snprintf(newPath, elcount(newPath), "%s.%s", oldPath, "drivingLaneStatus");
  value.drivingLaneStatus.isValidFlag = C2xIsTokenAvailable(packetHandle, "DENM", newPath);
  if(value.drivingLaneStatus.isValidFlag==1)
  {
    value.drivingLaneStatus.isValidFlag = 1;
    value.drivingLaneStatus.stringLength = C2xGetTokenLengthBit(packetHandle, "DENM", newPath);
    if ((result = CheckLastError("DENM", gkFuncRefGet, result))==0)
    {
      if(value.drivingLaneStatus.stringLength > 0)
      {
        for(j=0; j<value.drivingLaneStatus.stringLength; j++)
        {
          if(C2xGetTokenBitOfBitString(packetHandle, "DENM", newPath, j) == 0)
          {
            value.drivingLaneStatus.string[j] = '0';
          }
          else if(C2xGetTokenBitOfBitString(packetHandle, "DENM", newPath, j) == 1)
          {
            value.drivingLaneStatus.string[j] = '1';
          }

          if(value.drivingLaneStatus.stringLength == 1)
          {
            value.drivingLaneStatus.string[1] = '0';
          }
          result = CheckLastError("DENM", gkFuncRefGet, result);
        }
      }
      else
      {
        for(k = value.drivingLaneStatus.stringLength+1; k > -1; k--)
        {
          if(value.drivingLaneStatus.string[k] == '1')
          {
            value.drivingLaneStatus.string[k] = '0';
          }
        }
      }
    }

  }
  return result;
}

int SetDENMClosedLanesParams(LONG packetHandle, struct DENMClosedLanes value, char oldPath[])
{
  char newPath[300]; 
  int j;
  int result;

  result = 0;

  snprintf(newPath, elcount(newPath), "%s.%s", oldPath, "innerhardShoulderStatus");
  if(value.innerhardShoulderStatus.isValidFlag==1)
  {
    C2xSetTokenInt(packetHandle, "DENM", newPath, value.innerhardShoulderStatus.value);
    result = CheckLastError("DENM", gkFuncRefGet, result);
  }
  else
  {
    if( C2xIsTokenAvailable(packetHandle, "DENM", newPath) )
    {
      C2xRemoveToken(packetHandle, "DENM", newPath);
    }
  }

  snprintf(newPath, elcount(newPath), "%s.%s", oldPath, "outerhardShoulderStatus");
  if(value.outerhardShoulderStatus.isValidFlag==1)
  {
    C2xSetTokenInt(packetHandle, "DENM", newPath, value.outerhardShoulderStatus.value);
    result = CheckLastError("DENM", gkFuncRefGet, result);
  }
  else
  {
    if( C2xIsTokenAvailable(packetHandle, "DENM", newPath) )
    {
      C2xRemoveToken(packetHandle, "DENM", newPath);
    }
  }

  snprintf(newPath, elcount(newPath), "%s.%s", oldPath, "drivingLaneStatus");
  if(value.drivingLaneStatus.isValidFlag==1)
  {
      for(j=0; j<value.drivingLaneStatus.stringLength; j++)
      {
        if(value.drivingLaneStatus.string[j] == '0')
        {
          C2xSetTokenBitOfBitString(packetHandle, "DENM", newPath, j, 0);
        }
        else
        {
          C2xSetTokenBitOfBitString(packetHandle, "DENM", newPath, j, 1);
        }
        result = CheckLastError("DENM", gkFuncRefGet, result);
      }
  }
  else
  {
    if( C2xIsTokenAvailable(packetHandle, "DENM", newPath) )
    {
      C2xRemoveToken(packetHandle, "DENM", newPath);
    }
  }

  return result;
}

int GetDENMRestrictedTypesParams(LONG packetHandle, struct DENMRestrictedTypes value, char oldPath[])
{
  char newPath[300]; 
  int i;
  int result;

  result = 0;

  value.length = C2xGetTokenInt(packetHandle, "DENM", oldPath);
  if((result = CheckLastError("DENM", gkFuncRefGet, result))==0)
  {
    for(i=0; i<value.length; i++)
    {
      snprintf(newPath, elcount(newPath), "%s[%d]", oldPath, i);
      value.arrayValue[i] = C2xGetTokenInt64(packetHandle, "DENM", newPath);
      result = CheckLastError("DENM", gkFuncRefGet, result);
    }
  }
  return result;
}

int SetDENMRestrictedTypesParams(LONG packetHandle, struct DENMRestrictedTypes value, char oldPath[])
{
  char newPath[300]; 
  int i;
  int result;

  result = 0;

  C2xRemoveToken(packetHandle, "DENM", oldPath);
  for(i=0; i<value.length; i++)
  {
    snprintf(newPath, elcount(newPath), "%s[%d]", oldPath, i);
    C2xSetTokenInt64(packetHandle, "DENM", newPath, value.arrayValue[i]);
    result = CheckLastError("DENM", gkFuncRefGet, result);
  }
  return result;
}

int GetDENMItineraryPathParams(LONG packetHandle, struct DENMItineraryPath value, char oldPath[])
{
  char newPath[300]; 
  int i;
  int result;

  result = 0;

  value.length = C2xGetTokenInt(packetHandle, "DENM", oldPath);
  if((result = CheckLastError("DENM", gkFuncRefGet, result))==0)
  {
    for(i=0; i<value.length; i++)
    {
      snprintf(newPath, elcount(newPath), "%s[%d]", oldPath, i);
      GetDENMReferencePositionParams(packetHandle, value.arrayValue[i], newPath);
      result = CheckLastError("DENM", gkFuncRefGet, result);
    }
  }
  return result;
}

int SetDENMItineraryPathParams(LONG packetHandle, struct DENMItineraryPath value, char oldPath[])
{
  char newPath[300]; 
  int i;
  int result;

  result = 0;

  C2xRemoveToken(packetHandle, "DENM", oldPath);
  for(i=0; i<value.length; i++)
  {
    snprintf(newPath, elcount(newPath), "%s[%d]", oldPath, i);
    SetDENMReferencePositionParams(packetHandle, value.arrayValue[i], newPath);
    result = CheckLastError("DENM", gkFuncRefGet, result);
  }
  return result;
}

int GetDENMRoadWorksContainerExtendedParams(LONG packetHandle, struct DENMRoadWorksContainerExtended value, char oldPath[])
{
  char newPath[300]; 
  int j; 
  int k;
  int result;

  result = 0;

  snprintf(newPath, elcount(newPath), "%s.%s", oldPath, "lightBarSirenInUse");
  value.lightBarSirenInUse.isValidFlag = C2xIsTokenAvailable(packetHandle, "DENM", newPath);
  if(value.lightBarSirenInUse.isValidFlag==1)
  {
    value.lightBarSirenInUse.isValidFlag = 1;
    value.lightBarSirenInUse.stringLength = C2xGetTokenLengthBit(packetHandle, "DENM", newPath);
    if ((result = CheckLastError("DENM", gkFuncRefGet, result))==0)
    {
      if(value.lightBarSirenInUse.stringLength > 0)
      {
        for(j=0; j<value.lightBarSirenInUse.stringLength; j++)
        {
          if(C2xGetTokenBitOfBitString(packetHandle, "DENM", newPath, j) == 0)
          {
            value.lightBarSirenInUse.string[j] = '0';
          }
          else if(C2xGetTokenBitOfBitString(packetHandle, "DENM", newPath, j) == 1)
          {
            value.lightBarSirenInUse.string[j] = '1';
          }

          if(value.lightBarSirenInUse.stringLength == 1)
          {
            value.lightBarSirenInUse.string[1] = '0';
          }
          result = CheckLastError("DENM", gkFuncRefGet, result);
        }
      }
      else
      {
        for(k = value.lightBarSirenInUse.stringLength+1; k > -1; k--)
        {
          if(value.lightBarSirenInUse.string[k] == '1')
          {
            value.lightBarSirenInUse.string[k] = '0';
          }
        }
      }
    }

  }
  snprintf(newPath, elcount(newPath), "%s.%s", oldPath, "closedLanes");
  value.closedLanes.isValidFlag = C2xIsTokenAvailable(packetHandle, "DENM", newPath);
  if(value.closedLanes.isValidFlag==1)
  {
    GetDENMClosedLanesParams(packetHandle, value.closedLanes, newPath);
    result = CheckLastError("DENM", gkFuncRefGet, result);
  }
  snprintf(newPath, elcount(newPath), "%s.%s", oldPath, "restriction");
  value.restriction.isValidFlag = C2xIsTokenAvailable(packetHandle, "DENM", newPath);
  if(value.restriction.isValidFlag==1)
  {
    GetDENMRestrictedTypesParams(packetHandle, value.restriction, newPath);
    result = CheckLastError("DENM", gkFuncRefGet, result);
  }
  snprintf(newPath, elcount(newPath), "%s.%s", oldPath, "speedLimit");
  value.speedLimit.isValidFlag = C2xIsTokenAvailable(packetHandle, "DENM", newPath);
  if(value.speedLimit.isValidFlag==1)
  {
    value.speedLimit.value = C2xGetTokenInt(packetHandle, "DENM", newPath);
    result = CheckLastError("DENM", gkFuncRefGet, result);
  }
  snprintf(newPath, elcount(newPath), "%s.%s", oldPath, "incidentIndication");
  value.incidentIndication.isValidFlag = C2xIsTokenAvailable(packetHandle, "DENM", newPath);
  if(value.incidentIndication.isValidFlag==1)
  {
    GetDENMCauseCodeParams(packetHandle, value.incidentIndication, newPath);
    result = CheckLastError("DENM", gkFuncRefGet, result);
  }
  snprintf(newPath, elcount(newPath), "%s.%s", oldPath, "recommendedPath");
  value.recommendedPath.isValidFlag = C2xIsTokenAvailable(packetHandle, "DENM", newPath);
  if(value.recommendedPath.isValidFlag==1)
  {
    GetDENMItineraryPathParams(packetHandle, value.recommendedPath, newPath);
    result = CheckLastError("DENM", gkFuncRefGet, result);
  }
  snprintf(newPath, elcount(newPath), "%s.%s", oldPath, "startingPointSpeedLimit");
  value.startingPointSpeedLimit.isValidFlag = C2xIsTokenAvailable(packetHandle, "DENM", newPath);
  if(value.startingPointSpeedLimit.isValidFlag==1)
  {
    GetDENMDeltaReferencePositionParams(packetHandle, value.startingPointSpeedLimit, newPath);
    result = CheckLastError("DENM", gkFuncRefGet, result);
  }
  snprintf(newPath, elcount(newPath), "%s.%s", oldPath, "trafficFlowRule");
  value.trafficFlowRule.isValidFlag = C2xIsTokenAvailable(packetHandle, "DENM", newPath);
  if(value.trafficFlowRule.isValidFlag==1)
  {
    value.trafficFlowRule.value = C2xGetTokenInt(packetHandle, "DENM", newPath);
    result = CheckLastError("DENM", gkFuncRefGet, result);
  }
  snprintf(newPath, elcount(newPath), "%s.%s", oldPath, "referenceDenms");
  value.referenceDenms.isValidFlag = C2xIsTokenAvailable(packetHandle, "DENM", newPath);
  if(value.referenceDenms.isValidFlag==1)
  {
    GetDENMActionIdListParams(packetHandle, value.referenceDenms, newPath);
    result = CheckLastError("DENM", gkFuncRefGet, result);
  }
  return result;
}

int SetDENMRoadWorksContainerExtendedParams(LONG packetHandle, struct DENMRoadWorksContainerExtended value, char oldPath[])
{
  char newPath[300]; 
  int j;
  int result;

  result = 0;

  snprintf(newPath, elcount(newPath), "%s.%s", oldPath, "lightBarSirenInUse");
  if(value.lightBarSirenInUse.isValidFlag==1)
  {
      for(j=0; j<value.lightBarSirenInUse.stringLength; j++)
      {
        if(value.lightBarSirenInUse.string[j] == '0')
        {
          C2xSetTokenBitOfBitString(packetHandle, "DENM", newPath, j, 0);
        }
        else
        {
          C2xSetTokenBitOfBitString(packetHandle, "DENM", newPath, j, 1);
        }
        result = CheckLastError("DENM", gkFuncRefGet, result);
      }
  }
  else
  {
    if( C2xIsTokenAvailable(packetHandle, "DENM", newPath) )
    {
      C2xRemoveToken(packetHandle, "DENM", newPath);
    }
  }

  snprintf(newPath, elcount(newPath), "%s.%s", oldPath, "closedLanes");
  if(value.closedLanes.isValidFlag==1)
  {
    SetDENMClosedLanesParams(packetHandle, value.closedLanes, newPath);
    result = CheckLastError("DENM", gkFuncRefGet, result);
  }
  else
  {
    if( C2xIsTokenAvailable(packetHandle, "DENM", newPath) )
    {
      C2xRemoveToken(packetHandle, "DENM", newPath);
    }
  }

  snprintf(newPath, elcount(newPath), "%s.%s", oldPath, "restriction");
  if(value.restriction.isValidFlag==1)
  {
    SetDENMRestrictedTypesParams(packetHandle, value.restriction, newPath);
    result = CheckLastError("DENM", gkFuncRefGet, result);
  }
  else
  {
    if( C2xIsTokenAvailable(packetHandle, "DENM", newPath) )
    {
      C2xRemoveToken(packetHandle, "DENM", newPath);
    }
  }

  snprintf(newPath, elcount(newPath), "%s.%s", oldPath, "speedLimit");
  if(value.speedLimit.isValidFlag==1)
  {
    if (value.speedLimit.value < 1)
    {
        C2xSetTokenInt(packetHandle, "DENM", newPath, 1);
    }
    else if (value.speedLimit.value > 255)
    {
        C2xSetTokenInt(packetHandle, "DENM", newPath, 255);
    }
    else
    {
        C2xSetTokenInt(packetHandle, "DENM", newPath, value.speedLimit.value);
    }
    result = CheckLastError("DENM", gkFuncRefGet, result);
  }
  else
  {
    if( C2xIsTokenAvailable(packetHandle, "DENM", newPath) )
    {
      C2xRemoveToken(packetHandle, "DENM", newPath);
    }
  }

  snprintf(newPath, elcount(newPath), "%s.%s", oldPath, "incidentIndication");
  if(value.incidentIndication.isValidFlag==1)
  {
    SetDENMCauseCodeParams(packetHandle, value.incidentIndication, newPath);
    result = CheckLastError("DENM", gkFuncRefGet, result);
  }
  else
  {
    if( C2xIsTokenAvailable(packetHandle, "DENM", newPath) )
    {
      C2xRemoveToken(packetHandle, "DENM", newPath);
    }
  }

  snprintf(newPath, elcount(newPath), "%s.%s", oldPath, "recommendedPath");
  if(value.recommendedPath.isValidFlag==1)
  {
    SetDENMItineraryPathParams(packetHandle, value.recommendedPath, newPath);
    result = CheckLastError("DENM", gkFuncRefGet, result);
  }
  else
  {
    if( C2xIsTokenAvailable(packetHandle, "DENM", newPath) )
    {
      C2xRemoveToken(packetHandle, "DENM", newPath);
    }
  }

  snprintf(newPath, elcount(newPath), "%s.%s", oldPath, "startingPointSpeedLimit");
  if(value.startingPointSpeedLimit.isValidFlag==1)
  {
    SetDENMDeltaReferencePositionParams(packetHandle, value.startingPointSpeedLimit, newPath);
    result = CheckLastError("DENM", gkFuncRefGet, result);
  }
  else
  {
    if( C2xIsTokenAvailable(packetHandle, "DENM", newPath) )
    {
      C2xRemoveToken(packetHandle, "DENM", newPath);
    }
  }

  snprintf(newPath, elcount(newPath), "%s.%s", oldPath, "trafficFlowRule");
  if(value.trafficFlowRule.isValidFlag==1)
  {
    C2xSetTokenInt(packetHandle, "DENM", newPath, value.trafficFlowRule.value);
    result = CheckLastError("DENM", gkFuncRefGet, result);
  }
  else
  {
    if( C2xIsTokenAvailable(packetHandle, "DENM", newPath) )
    {
      C2xRemoveToken(packetHandle, "DENM", newPath);
    }
  }

  snprintf(newPath, elcount(newPath), "%s.%s", oldPath, "referenceDenms");
  if(value.referenceDenms.isValidFlag==1)
  {
    SetDENMActionIdListParams(packetHandle, value.referenceDenms, newPath);
    result = CheckLastError("DENM", gkFuncRefGet, result);
  }
  else
  {
    if( C2xIsTokenAvailable(packetHandle, "DENM", newPath) )
    {
      C2xRemoveToken(packetHandle, "DENM", newPath);
    }
  }

  return result;
}

int GetDENMDangerousGoodsExtendedParams(LONG packetHandle, struct DENMDangerousGoodsExtended value, char oldPath[])
{
  char newPath[300];
  int result;

  result = 0;

  snprintf(newPath, elcount(newPath), "%s.%s", oldPath, "dangerousGoodsType");
  value.dangerousGoodsType = C2xGetTokenInt(packetHandle, "DENM", newPath);
  result = CheckLastError("DENM", gkFuncRefGet, result);

  snprintf(newPath, elcount(newPath), "%s.%s", oldPath, "unNumber");
  value.unNumber = C2xGetTokenInt(packetHandle, "DENM", newPath);
  result = CheckLastError("DENM", gkFuncRefGet, result);

  snprintf(newPath, elcount(newPath), "%s.%s", oldPath, "elevatedTemperature");
  value.elevatedTemperature = C2xGetTokenInt64(packetHandle, "DENM", newPath);
  result = CheckLastError("DENM", gkFuncRefGet, result);

  snprintf(newPath, elcount(newPath), "%s.%s", oldPath, "tunnelsRestricted");
  value.tunnelsRestricted = C2xGetTokenInt64(packetHandle, "DENM", newPath);
  result = CheckLastError("DENM", gkFuncRefGet, result);

  snprintf(newPath, elcount(newPath), "%s.%s", oldPath, "limitedQuantity");
  value.limitedQuantity = C2xGetTokenInt64(packetHandle, "DENM", newPath);
  result = CheckLastError("DENM", gkFuncRefGet, result);

  snprintf(newPath, elcount(newPath), "%s.%s", oldPath, "emergencyActionCode");
  value.emergencyActionCode.isValidFlag = C2xIsTokenAvailable(packetHandle, "DENM", newPath);
  if(value.emergencyActionCode.isValidFlag==1)
  {
    value.emergencyActionCode.stringLength = C2xGetTokenData(packetHandle, "DENM", newPath, elcount(value.emergencyActionCode.string), value.emergencyActionCode.string);
    result = CheckLastError("DENM", gkFuncRefGet, result);
  }
  snprintf(newPath, elcount(newPath), "%s.%s", oldPath, "phoneNumber");
  value.phoneNumber.isValidFlag = C2xIsTokenAvailable(packetHandle, "DENM", newPath);
  if(value.phoneNumber.isValidFlag==1)
  {
    value.phoneNumber.stringLength = C2xGetTokenData(packetHandle, "DENM", newPath, elcount(value.phoneNumber.string), value.phoneNumber.string);
    result = CheckLastError("DENM", gkFuncRefGet, result);
  }
  snprintf(newPath, elcount(newPath), "%s.%s", oldPath, "companyName");
  value.companyName.isValidFlag = C2xIsTokenAvailable(packetHandle, "DENM", newPath);
  if(value.companyName.isValidFlag==1)
  {
    value.companyName.stringLength = C2xGetTokenData(packetHandle, "DENM", newPath, elcount(value.companyName.string), value.companyName.string);
    result = CheckLastError("DENM", gkFuncRefGet, result);
  }
  return result;
}

int SetDENMDangerousGoodsExtendedParams(LONG packetHandle, struct DENMDangerousGoodsExtended value, char oldPath[])
{
  char newPath[300];
  int result;

  result = 0;

  snprintf(newPath, elcount(newPath), "%s.%s", oldPath, "dangerousGoodsType");
  C2xSetTokenInt(packetHandle, "DENM", newPath, value.dangerousGoodsType);
  result = CheckLastError("DENM", gkFuncRefGet, result);

  snprintf(newPath, elcount(newPath), "%s.%s", oldPath, "unNumber");
  C2xSetTokenInt(packetHandle, "DENM", newPath, value.unNumber);
  result = CheckLastError("DENM", gkFuncRefGet, result);

  snprintf(newPath, elcount(newPath), "%s.%s", oldPath, "elevatedTemperature");
  C2xSetTokenInt64(packetHandle, "DENM", newPath, value.elevatedTemperature);
  result = CheckLastError("DENM", gkFuncRefGet, result);

  snprintf(newPath, elcount(newPath), "%s.%s", oldPath, "tunnelsRestricted");
  C2xSetTokenInt64(packetHandle, "DENM", newPath, value.tunnelsRestricted);
  result = CheckLastError("DENM", gkFuncRefGet, result);

  snprintf(newPath, elcount(newPath), "%s.%s", oldPath, "limitedQuantity");
  C2xSetTokenInt64(packetHandle, "DENM", newPath, value.limitedQuantity);
  result = CheckLastError("DENM", gkFuncRefGet, result);

  snprintf(newPath, elcount(newPath), "%s.%s", oldPath, "emergencyActionCode");
  if(value.emergencyActionCode.isValidFlag==1)
  {
    C2xSetTokenData(packetHandle, "DENM", newPath, value.emergencyActionCode.stringLength, value.emergencyActionCode.string);
    result = CheckLastError("DENM", gkFuncRefGet, result);
  }
  else
  {
    if( C2xIsTokenAvailable(packetHandle, "DENM", newPath) )
    {
      C2xRemoveToken(packetHandle, "DENM", newPath);
    }
  }

  snprintf(newPath, elcount(newPath), "%s.%s", oldPath, "phoneNumber");
  if(value.phoneNumber.isValidFlag==1)
  {
    C2xSetTokenData(packetHandle, "DENM", newPath, value.phoneNumber.stringLength, value.phoneNumber.string);
    result = CheckLastError("DENM", gkFuncRefGet, result);
  }
  else
  {
    if( C2xIsTokenAvailable(packetHandle, "DENM", newPath) )
    {
      C2xRemoveToken(packetHandle, "DENM", newPath);
    }
  }

  snprintf(newPath, elcount(newPath), "%s.%s", oldPath, "companyName");
  if(value.companyName.isValidFlag==1)
  {
    C2xSetTokenData(packetHandle, "DENM", newPath, value.companyName.stringLength, value.companyName.string);
    result = CheckLastError("DENM", gkFuncRefGet, result);
  }
  else
  {
    if( C2xIsTokenAvailable(packetHandle, "DENM", newPath) )
    {
      C2xRemoveToken(packetHandle, "DENM", newPath);
    }
  }

  return result;
}

int GetDENMVehicleIdentificationParams(LONG packetHandle, struct DENMVehicleIdentification value, char oldPath[])
{
  char newPath[300];
  int result;

  result = 0;

  snprintf(newPath, elcount(newPath), "%s.%s", oldPath, "wMInumber");
  value.wMInumber.isValidFlag = C2xIsTokenAvailable(packetHandle, "DENM", newPath);
  if(value.wMInumber.isValidFlag==1)
  {
    value.wMInumber.stringLength = C2xGetTokenData(packetHandle, "DENM", newPath, elcount(value.wMInumber.string), value.wMInumber.string);
    result = CheckLastError("DENM", gkFuncRefGet, result);
  }
  snprintf(newPath, elcount(newPath), "%s.%s", oldPath, "vDS");
  value.vDS.isValidFlag = C2xIsTokenAvailable(packetHandle, "DENM", newPath);
  if(value.vDS.isValidFlag==1)
  {
    value.vDS.stringLength = C2xGetTokenData(packetHandle, "DENM", newPath, elcount(value.vDS.string), value.vDS.string);
    result = CheckLastError("DENM", gkFuncRefGet, result);
  }
  return result;
}

int SetDENMVehicleIdentificationParams(LONG packetHandle, struct DENMVehicleIdentification value, char oldPath[])
{
  char newPath[300];
  int result;

  result = 0;

  snprintf(newPath, elcount(newPath), "%s.%s", oldPath, "wMInumber");
  if(value.wMInumber.isValidFlag==1)
  {
    C2xSetTokenData(packetHandle, "DENM", newPath, value.wMInumber.stringLength, value.wMInumber.string);
    result = CheckLastError("DENM", gkFuncRefGet, result);
  }
  else
  {
    if( C2xIsTokenAvailable(packetHandle, "DENM", newPath) )
    {
      C2xRemoveToken(packetHandle, "DENM", newPath);
    }
  }

  snprintf(newPath, elcount(newPath), "%s.%s", oldPath, "vDS");
  if(value.vDS.isValidFlag==1)
  {
    C2xSetTokenData(packetHandle, "DENM", newPath, value.vDS.stringLength, value.vDS.string);
    result = CheckLastError("DENM", gkFuncRefGet, result);
  }
  else
  {
    if( C2xIsTokenAvailable(packetHandle, "DENM", newPath) )
    {
      C2xRemoveToken(packetHandle, "DENM", newPath);
    }
  }

  return result;
}

int GetDENMStationaryVehicleContainerParams(LONG packetHandle, struct DENMStationaryVehicleContainer value, char oldPath[])
{
  char newPath[300]; 
  int j; 
  int k;
  int result;

  result = 0;

  snprintf(newPath, elcount(newPath), "%s.%s", oldPath, "stationarySince");
  value.stationarySince.isValidFlag = C2xIsTokenAvailable(packetHandle, "DENM", newPath);
  if(value.stationarySince.isValidFlag==1)
  {
    value.stationarySince.value = C2xGetTokenInt(packetHandle, "DENM", newPath);
    result = CheckLastError("DENM", gkFuncRefGet, result);
  }
  snprintf(newPath, elcount(newPath), "%s.%s", oldPath, "stationaryCause");
  value.stationaryCause.isValidFlag = C2xIsTokenAvailable(packetHandle, "DENM", newPath);
  if(value.stationaryCause.isValidFlag==1)
  {
    GetDENMCauseCodeParams(packetHandle, value.stationaryCause, newPath);
    result = CheckLastError("DENM", gkFuncRefGet, result);
  }
  snprintf(newPath, elcount(newPath), "%s.%s", oldPath, "carryingDangerousGoods");
  value.carryingDangerousGoods.isValidFlag = C2xIsTokenAvailable(packetHandle, "DENM", newPath);
  if(value.carryingDangerousGoods.isValidFlag==1)
  {
    GetDENMDangerousGoodsExtendedParams(packetHandle, value.carryingDangerousGoods, newPath);
    result = CheckLastError("DENM", gkFuncRefGet, result);
  }
  snprintf(newPath, elcount(newPath), "%s.%s", oldPath, "numberOfOccupants");
  value.numberOfOccupants.isValidFlag = C2xIsTokenAvailable(packetHandle, "DENM", newPath);
  if(value.numberOfOccupants.isValidFlag==1)
  {
    value.numberOfOccupants.value = C2xGetTokenInt(packetHandle, "DENM", newPath);
    result = CheckLastError("DENM", gkFuncRefGet, result);
  }
  snprintf(newPath, elcount(newPath), "%s.%s", oldPath, "vehicleIdentification");
  value.vehicleIdentification.isValidFlag = C2xIsTokenAvailable(packetHandle, "DENM", newPath);
  if(value.vehicleIdentification.isValidFlag==1)
  {
    GetDENMVehicleIdentificationParams(packetHandle, value.vehicleIdentification, newPath);
    result = CheckLastError("DENM", gkFuncRefGet, result);
  }
  snprintf(newPath, elcount(newPath), "%s.%s", oldPath, "energyStorageType");
  value.energyStorageType.isValidFlag = C2xIsTokenAvailable(packetHandle, "DENM", newPath);
  if(value.energyStorageType.isValidFlag==1)
  {
    value.energyStorageType.isValidFlag = 1;
    value.energyStorageType.stringLength = C2xGetTokenLengthBit(packetHandle, "DENM", newPath);
    if ((result = CheckLastError("DENM", gkFuncRefGet, result))==0)
    {
      if(value.energyStorageType.stringLength > 0)
      {
        for(j=0; j<value.energyStorageType.stringLength; j++)
        {
          if(C2xGetTokenBitOfBitString(packetHandle, "DENM", newPath, j) == 0)
          {
            value.energyStorageType.string[j] = '0';
          }
          else if(C2xGetTokenBitOfBitString(packetHandle, "DENM", newPath, j) == 1)
          {
            value.energyStorageType.string[j] = '1';
          }

          if(value.energyStorageType.stringLength == 1)
          {
            value.energyStorageType.string[1] = '0';
          }
          result = CheckLastError("DENM", gkFuncRefGet, result);
        }
      }
      else
      {
        for(k = value.energyStorageType.stringLength+1; k > -1; k--)
        {
          if(value.energyStorageType.string[k] == '1')
          {
            value.energyStorageType.string[k] = '0';
          }
        }
      }
    }

  }
  return result;
}

int SetDENMStationaryVehicleContainerParams(LONG packetHandle, struct DENMStationaryVehicleContainer value, char oldPath[])
{
  char newPath[300]; 
  int j;
  int result;

  result = 0;

  snprintf(newPath, elcount(newPath), "%s.%s", oldPath, "stationarySince");
  if(value.stationarySince.isValidFlag==1)
  {
    C2xSetTokenInt(packetHandle, "DENM", newPath, value.stationarySince.value);
    result = CheckLastError("DENM", gkFuncRefGet, result);
  }
  else
  {
    if( C2xIsTokenAvailable(packetHandle, "DENM", newPath) )
    {
      C2xRemoveToken(packetHandle, "DENM", newPath);
    }
  }

  snprintf(newPath, elcount(newPath), "%s.%s", oldPath, "stationaryCause");
  if(value.stationaryCause.isValidFlag==1)
  {
    SetDENMCauseCodeParams(packetHandle, value.stationaryCause, newPath);
    result = CheckLastError("DENM", gkFuncRefGet, result);
  }
  else
  {
    if( C2xIsTokenAvailable(packetHandle, "DENM", newPath) )
    {
      C2xRemoveToken(packetHandle, "DENM", newPath);
    }
  }

  snprintf(newPath, elcount(newPath), "%s.%s", oldPath, "carryingDangerousGoods");
  if(value.carryingDangerousGoods.isValidFlag==1)
  {
    SetDENMDangerousGoodsExtendedParams(packetHandle, value.carryingDangerousGoods, newPath);
    result = CheckLastError("DENM", gkFuncRefGet, result);
  }
  else
  {
    if( C2xIsTokenAvailable(packetHandle, "DENM", newPath) )
    {
      C2xRemoveToken(packetHandle, "DENM", newPath);
    }
  }

  snprintf(newPath, elcount(newPath), "%s.%s", oldPath, "numberOfOccupants");
  if(value.numberOfOccupants.isValidFlag==1)
  {
    C2xSetTokenInt(packetHandle, "DENM", newPath, value.numberOfOccupants.value);
    result = CheckLastError("DENM", gkFuncRefGet, result);
  }
  else
  {
    if( C2xIsTokenAvailable(packetHandle, "DENM", newPath) )
    {
      C2xRemoveToken(packetHandle, "DENM", newPath);
    }
  }

  snprintf(newPath, elcount(newPath), "%s.%s", oldPath, "vehicleIdentification");
  if(value.vehicleIdentification.isValidFlag==1)
  {
    SetDENMVehicleIdentificationParams(packetHandle, value.vehicleIdentification, newPath);
    result = CheckLastError("DENM", gkFuncRefGet, result);
  }
  else
  {
    if( C2xIsTokenAvailable(packetHandle, "DENM", newPath) )
    {
      C2xRemoveToken(packetHandle, "DENM", newPath);
    }
  }

  snprintf(newPath, elcount(newPath), "%s.%s", oldPath, "energyStorageType");
  if(value.energyStorageType.isValidFlag==1)
  {
      for(j=0; j<value.energyStorageType.stringLength; j++)
      {
        if(value.energyStorageType.string[j] == '0')
        {
          C2xSetTokenBitOfBitString(packetHandle, "DENM", newPath, j, 0);
        }
        else
        {
          C2xSetTokenBitOfBitString(packetHandle, "DENM", newPath, j, 1);
        }
        result = CheckLastError("DENM", gkFuncRefGet, result);
      }
  }
  else
  {
    if( C2xIsTokenAvailable(packetHandle, "DENM", newPath) )
    {
      C2xRemoveToken(packetHandle, "DENM", newPath);
    }
  }

  return result;
}

int GetDENMGeoPositionParams(LONG packetHandle, struct DENMGeoPosition value, char oldPath[])
{
  char newPath[300];
  int result;

  result = 0;

  snprintf(newPath, elcount(newPath), "%s.%s", oldPath, "latitude");
  value.latitude = C2xGetTokenInt(packetHandle, "DENM", newPath);
  result = CheckLastError("DENM", gkFuncRefGet, result);

  snprintf(newPath, elcount(newPath), "%s.%s", oldPath, "longitude");
  value.longitude = C2xGetTokenInt(packetHandle, "DENM", newPath);
  result = CheckLastError("DENM", gkFuncRefGet, result);

  snprintf(newPath, elcount(newPath), "%s.%s", oldPath, "altitude");
  value.altitude.isValidFlag = C2xIsTokenAvailable(packetHandle, "DENM", newPath);
  if(value.altitude.isValidFlag==1)
  {
    value.altitude.value = C2xGetTokenInt(packetHandle, "DENM", newPath);
    result = CheckLastError("DENM", gkFuncRefGet, result);
  }
  return result;
}

int SetDENMGeoPositionParams(LONG packetHandle, struct DENMGeoPosition value, char oldPath[])
{
  char newPath[300];
  int result;

  result = 0;

  snprintf(newPath, elcount(newPath), "%s.%s", oldPath, "latitude");
  C2xSetTokenInt(packetHandle, "DENM", newPath, value.latitude);
  result = CheckLastError("DENM", gkFuncRefGet, result);

  snprintf(newPath, elcount(newPath), "%s.%s", oldPath, "longitude");
  C2xSetTokenInt(packetHandle, "DENM", newPath, value.longitude);
  result = CheckLastError("DENM", gkFuncRefGet, result);

  snprintf(newPath, elcount(newPath), "%s.%s", oldPath, "altitude");
  if(value.altitude.isValidFlag==1)
  {
    C2xSetTokenInt(packetHandle, "DENM", newPath, value.altitude.value);
    result = CheckLastError("DENM", gkFuncRefGet, result);
  }
  else
  {
    if( C2xIsTokenAvailable(packetHandle, "DENM", newPath) )
    {
      C2xRemoveToken(packetHandle, "DENM", newPath);
    }
  }

  return result;
}

int GetDENMPathReferencesParams(LONG packetHandle, struct DENMPathReferences value, char oldPath[])
{
  char newPath[300]; 
  int i;
  int result;

  result = 0;

  value.length = C2xGetTokenInt(packetHandle, "DENM", oldPath);
  if((result = CheckLastError("DENM", gkFuncRefGet, result))==0)
  {
    for(i=0; i<value.length; i++)
    {
      snprintf(newPath, elcount(newPath), "%s[%d]", oldPath, i);
      value.arrayValue[i] = C2xGetTokenInt64(packetHandle, "DENM", newPath);
      result = CheckLastError("DENM", gkFuncRefGet, result);
    }
  }
  return result;
}

int SetDENMPathReferencesParams(LONG packetHandle, struct DENMPathReferences value, char oldPath[])
{
  char newPath[300]; 
  int i;
  int result;

  result = 0;

  C2xRemoveToken(packetHandle, "DENM", oldPath);
  for(i=0; i<value.length; i++)
  {
    snprintf(newPath, elcount(newPath), "%s[%d]", oldPath, i);
    C2xSetTokenInt64(packetHandle, "DENM", newPath, value.arrayValue[i]);
    result = CheckLastError("DENM", gkFuncRefGet, result);
  }
  return result;
}

int GetDENMRoadSectionDefinitionParams(LONG packetHandle, struct DENMRoadSectionDefinition value, char oldPath[])
{
  char newPath[300];
  int result;

  result = 0;

  snprintf(newPath, elcount(newPath), "%s.%s", oldPath, "startingPointSection");
  GetDENMGeoPositionParams(packetHandle, value.startingPointSection, newPath);
  result = CheckLastError("DENM", gkFuncRefGet, result);

  snprintf(newPath, elcount(newPath), "%s.%s", oldPath, "lengthOfSection");
  value.lengthOfSection.isValidFlag = C2xIsTokenAvailable(packetHandle, "DENM", newPath);
  if(value.lengthOfSection.isValidFlag==1)
  {
    value.lengthOfSection.value = C2xGetTokenInt(packetHandle, "DENM", newPath);
    result = CheckLastError("DENM", gkFuncRefGet, result);
  }
  snprintf(newPath, elcount(newPath), "%s.%s", oldPath, "endingPointSection");
  value.endingPointSection.isValidFlag = C2xIsTokenAvailable(packetHandle, "DENM", newPath);
  if(value.endingPointSection.isValidFlag==1)
  {
    GetDENMGeoPositionParams(packetHandle, value.endingPointSection, newPath);
    result = CheckLastError("DENM", gkFuncRefGet, result);
  }
  snprintf(newPath, elcount(newPath), "%s.%s", oldPath, "connectedPaths");
  GetDENMPathReferencesParams(packetHandle, value.connectedPaths, newPath);
  result = CheckLastError("DENM", gkFuncRefGet, result);

  snprintf(newPath, elcount(newPath), "%s.%s", oldPath, "includedPaths");
  GetDENMPathReferencesParams(packetHandle, value.includedPaths, newPath);
  result = CheckLastError("DENM", gkFuncRefGet, result);

  snprintf(newPath, elcount(newPath), "%s.%s", oldPath, "isEventZoneIncluded");
  value.isEventZoneIncluded = C2xGetTokenInt64(packetHandle, "DENM", newPath);
  result = CheckLastError("DENM", gkFuncRefGet, result);

  snprintf(newPath, elcount(newPath), "%s.%s", oldPath, "isEventZoneConnected");
  value.isEventZoneConnected = C2xGetTokenInt64(packetHandle, "DENM", newPath);
  result = CheckLastError("DENM", gkFuncRefGet, result);

  return result;
}

int SetDENMRoadSectionDefinitionParams(LONG packetHandle, struct DENMRoadSectionDefinition value, char oldPath[])
{
  char newPath[300];
  int result;

  result = 0;

  snprintf(newPath, elcount(newPath), "%s.%s", oldPath, "startingPointSection");
  SetDENMGeoPositionParams(packetHandle, value.startingPointSection, newPath);
  result = CheckLastError("DENM", gkFuncRefGet, result);

  snprintf(newPath, elcount(newPath), "%s.%s", oldPath, "lengthOfSection");
  if(value.lengthOfSection.isValidFlag==1)
  {
    C2xSetTokenInt(packetHandle, "DENM", newPath, value.lengthOfSection.value);
    result = CheckLastError("DENM", gkFuncRefGet, result);
  }
  else
  {
    if( C2xIsTokenAvailable(packetHandle, "DENM", newPath) )
    {
      C2xRemoveToken(packetHandle, "DENM", newPath);
    }
  }

  snprintf(newPath, elcount(newPath), "%s.%s", oldPath, "endingPointSection");
  if(value.endingPointSection.isValidFlag==1)
  {
    SetDENMGeoPositionParams(packetHandle, value.endingPointSection, newPath);
    result = CheckLastError("DENM", gkFuncRefGet, result);
  }
  else
  {
    if( C2xIsTokenAvailable(packetHandle, "DENM", newPath) )
    {
      C2xRemoveToken(packetHandle, "DENM", newPath);
    }
  }

  snprintf(newPath, elcount(newPath), "%s.%s", oldPath, "connectedPaths");
  SetDENMPathReferencesParams(packetHandle, value.connectedPaths, newPath);
  result = CheckLastError("DENM", gkFuncRefGet, result);

  snprintf(newPath, elcount(newPath), "%s.%s", oldPath, "includedPaths");
  SetDENMPathReferencesParams(packetHandle, value.includedPaths, newPath);
  result = CheckLastError("DENM", gkFuncRefGet, result);

  snprintf(newPath, elcount(newPath), "%s.%s", oldPath, "isEventZoneIncluded");
  C2xSetTokenInt64(packetHandle, "DENM", newPath, value.isEventZoneIncluded);
  result = CheckLastError("DENM", gkFuncRefGet, result);

  snprintf(newPath, elcount(newPath), "%s.%s", oldPath, "isEventZoneConnected");
  C2xSetTokenInt64(packetHandle, "DENM", newPath, value.isEventZoneConnected);
  result = CheckLastError("DENM", gkFuncRefGet, result);

  return result;
}

int GetDENMBasicLaneInformationParams(LONG packetHandle, struct DENMBasicLaneInformation value, char oldPath[])
{
  char newPath[300];
  int result;

  result = 0;

  snprintf(newPath, elcount(newPath), "%s.%s", oldPath, "laneNumber");
  value.laneNumber = C2xGetTokenInt(packetHandle, "DENM", newPath);
  result = CheckLastError("DENM", gkFuncRefGet, result);

  snprintf(newPath, elcount(newPath), "%s.%s", oldPath, "direction");
  value.direction = C2xGetTokenInt(packetHandle, "DENM", newPath);
  result = CheckLastError("DENM", gkFuncRefGet, result);

  snprintf(newPath, elcount(newPath), "%s.%s", oldPath, "laneWidth");
  value.laneWidth.isValidFlag = C2xIsTokenAvailable(packetHandle, "DENM", newPath);
  if(value.laneWidth.isValidFlag==1)
  {
    value.laneWidth.value = C2xGetTokenInt(packetHandle, "DENM", newPath);
    result = CheckLastError("DENM", gkFuncRefGet, result);
  }
  snprintf(newPath, elcount(newPath), "%s.%s", oldPath, "connectingLane");
  value.connectingLane.isValidFlag = C2xIsTokenAvailable(packetHandle, "DENM", newPath);
  if(value.connectingLane.isValidFlag==1)
  {
    value.connectingLane.value = C2xGetTokenInt(packetHandle, "DENM", newPath);
    result = CheckLastError("DENM", gkFuncRefGet, result);
  }
  snprintf(newPath, elcount(newPath), "%s.%s", oldPath, "connectingRoadSection");
  value.connectingRoadSection.isValidFlag = C2xIsTokenAvailable(packetHandle, "DENM", newPath);
  if(value.connectingRoadSection.isValidFlag==1)
  {
    value.connectingRoadSection.value = C2xGetTokenInt(packetHandle, "DENM", newPath);
    result = CheckLastError("DENM", gkFuncRefGet, result);
  }
  return result;
}

int SetDENMBasicLaneInformationParams(LONG packetHandle, struct DENMBasicLaneInformation value, char oldPath[])
{
  char newPath[300];
  int result;

  result = 0;

  snprintf(newPath, elcount(newPath), "%s.%s", oldPath, "laneNumber");
  C2xSetTokenInt(packetHandle, "DENM", newPath, value.laneNumber);
  result = CheckLastError("DENM", gkFuncRefGet, result);

  snprintf(newPath, elcount(newPath), "%s.%s", oldPath, "direction");
  C2xSetTokenInt(packetHandle, "DENM", newPath, value.direction);
  result = CheckLastError("DENM", gkFuncRefGet, result);

  snprintf(newPath, elcount(newPath), "%s.%s", oldPath, "laneWidth");
  if(value.laneWidth.isValidFlag==1)
  {
    C2xSetTokenInt(packetHandle, "DENM", newPath, value.laneWidth.value);
    result = CheckLastError("DENM", gkFuncRefGet, result);
  }
  else
  {
    if( C2xIsTokenAvailable(packetHandle, "DENM", newPath) )
    {
      C2xRemoveToken(packetHandle, "DENM", newPath);
    }
  }

  snprintf(newPath, elcount(newPath), "%s.%s", oldPath, "connectingLane");
  if(value.connectingLane.isValidFlag==1)
  {
    C2xSetTokenInt(packetHandle, "DENM", newPath, value.connectingLane.value);
    result = CheckLastError("DENM", gkFuncRefGet, result);
  }
  else
  {
    if( C2xIsTokenAvailable(packetHandle, "DENM", newPath) )
    {
      C2xRemoveToken(packetHandle, "DENM", newPath);
    }
  }

  snprintf(newPath, elcount(newPath), "%s.%s", oldPath, "connectingRoadSection");
  if(value.connectingRoadSection.isValidFlag==1)
  {
    C2xSetTokenInt(packetHandle, "DENM", newPath, value.connectingRoadSection.value);
    result = CheckLastError("DENM", gkFuncRefGet, result);
  }
  else
  {
    if( C2xIsTokenAvailable(packetHandle, "DENM", newPath) )
    {
      C2xRemoveToken(packetHandle, "DENM", newPath);
    }
  }

  return result;
}

int GetDENMBasicLaneConfigurationParams(LONG packetHandle, struct DENMBasicLaneConfiguration value, char oldPath[])
{
  char newPath[300]; 
  int i;
  int result;

  result = 0;

  value.length = C2xGetTokenInt(packetHandle, "DENM", oldPath);
  if((result = CheckLastError("DENM", gkFuncRefGet, result))==0)
  {
    for(i=0; i<value.length; i++)
    {
      snprintf(newPath, elcount(newPath), "%s[%d]", oldPath, i);
      GetDENMBasicLaneInformationParams(packetHandle, value.arrayValue[i], newPath);
      result = CheckLastError("DENM", gkFuncRefGet, result);
    }
  }
  return result;
}

int SetDENMBasicLaneConfigurationParams(LONG packetHandle, struct DENMBasicLaneConfiguration value, char oldPath[])
{
  char newPath[300]; 
  int i;
  int result;

  result = 0;

  C2xRemoveToken(packetHandle, "DENM", oldPath);
  for(i=0; i<value.length; i++)
  {
    snprintf(newPath, elcount(newPath), "%s[%d]", oldPath, i);
    SetDENMBasicLaneInformationParams(packetHandle, value.arrayValue[i], newPath);
    result = CheckLastError("DENM", gkFuncRefGet, result);
  }
  return result;
}

int GetDENMMapemLaneListParams(LONG packetHandle, struct DENMMapemLaneList value, char oldPath[])
{
  char newPath[300]; 
  int i;
  int result;

  result = 0;

  value.length = C2xGetTokenInt(packetHandle, "DENM", oldPath);
  if((result = CheckLastError("DENM", gkFuncRefGet, result))==0)
  {
    for(i=0; i<value.length; i++)
    {
      snprintf(newPath, elcount(newPath), "%s[%d]", oldPath, i);
      value.arrayValue[i] = C2xGetTokenInt64(packetHandle, "DENM", newPath);
      result = CheckLastError("DENM", gkFuncRefGet, result);
    }
  }
  return result;
}

int SetDENMMapemLaneListParams(LONG packetHandle, struct DENMMapemLaneList value, char oldPath[])
{
  char newPath[300]; 
  int i;
  int result;

  result = 0;

  C2xRemoveToken(packetHandle, "DENM", oldPath);
  for(i=0; i<value.length; i++)
  {
    snprintf(newPath, elcount(newPath), "%s[%d]", oldPath, i);
    C2xSetTokenInt64(packetHandle, "DENM", newPath, value.arrayValue[i]);
    result = CheckLastError("DENM", gkFuncRefGet, result);
  }
  return result;
}

int GetDENMMapemConnectionListParams(LONG packetHandle, struct DENMMapemConnectionList value, char oldPath[])
{
  char newPath[300]; 
  int i;
  int result;

  result = 0;

  value.length = C2xGetTokenInt(packetHandle, "DENM", oldPath);
  if((result = CheckLastError("DENM", gkFuncRefGet, result))==0)
  {
    for(i=0; i<value.length; i++)
    {
      snprintf(newPath, elcount(newPath), "%s[%d]", oldPath, i);
      value.arrayValue[i] = C2xGetTokenInt64(packetHandle, "DENM", newPath);
      result = CheckLastError("DENM", gkFuncRefGet, result);
    }
  }
  return result;
}

int SetDENMMapemConnectionListParams(LONG packetHandle, struct DENMMapemConnectionList value, char oldPath[])
{
  char newPath[300]; 
  int i;
  int result;

  result = 0;

  C2xRemoveToken(packetHandle, "DENM", oldPath);
  for(i=0; i<value.length; i++)
  {
    snprintf(newPath, elcount(newPath), "%s[%d]", oldPath, i);
    C2xSetTokenInt64(packetHandle, "DENM", newPath, value.arrayValue[i]);
    result = CheckLastError("DENM", gkFuncRefGet, result);
  }
  return result;
}

int GetDENMMapemElementReferenceParams(LONG packetHandle, struct DENMMapemElementReference value, char oldPath[])
{
  char newPath[300];
  int result;

  result = 0;

  snprintf(newPath, elcount(newPath), "%s.%s", oldPath, "mapReference");
  value.mapReference.isValidFlag = C2xIsTokenAvailable(packetHandle, "DENM", newPath);
  if(value.mapReference.isValidFlag==1)
  {
    GetDENMMapReferenceParams(packetHandle, value.mapReference, newPath);
    result = CheckLastError("DENM", gkFuncRefGet, result);
  }
  snprintf(newPath, elcount(newPath), "%s.%s", oldPath, "laneIds");
  value.laneIds.isValidFlag = C2xIsTokenAvailable(packetHandle, "DENM", newPath);
  if(value.laneIds.isValidFlag==1)
  {
    GetDENMMapemLaneListParams(packetHandle, value.laneIds, newPath);
    result = CheckLastError("DENM", gkFuncRefGet, result);
  }
  snprintf(newPath, elcount(newPath), "%s.%s", oldPath, "connectionIds");
  value.connectionIds.isValidFlag = C2xIsTokenAvailable(packetHandle, "DENM", newPath);
  if(value.connectionIds.isValidFlag==1)
  {
    GetDENMMapemConnectionListParams(packetHandle, value.connectionIds, newPath);
    result = CheckLastError("DENM", gkFuncRefGet, result);
  }
  return result;
}

int SetDENMMapemElementReferenceParams(LONG packetHandle, struct DENMMapemElementReference value, char oldPath[])
{
  char newPath[300];
  int result;

  result = 0;

  snprintf(newPath, elcount(newPath), "%s.%s", oldPath, "mapReference");
  if(value.mapReference.isValidFlag==1)
  {
    SetDENMMapReferenceParams(packetHandle, value.mapReference, newPath);
    result = CheckLastError("DENM", gkFuncRefGet, result);
  }
  else
  {
    if( C2xIsTokenAvailable(packetHandle, "DENM", newPath) )
    {
      C2xRemoveToken(packetHandle, "DENM", newPath);
    }
  }

  snprintf(newPath, elcount(newPath), "%s.%s", oldPath, "laneIds");
  if(value.laneIds.isValidFlag==1)
  {
    SetDENMMapemLaneListParams(packetHandle, value.laneIds, newPath);
    result = CheckLastError("DENM", gkFuncRefGet, result);
  }
  else
  {
    if( C2xIsTokenAvailable(packetHandle, "DENM", newPath) )
    {
      C2xRemoveToken(packetHandle, "DENM", newPath);
    }
  }

  snprintf(newPath, elcount(newPath), "%s.%s", oldPath, "connectionIds");
  if(value.connectionIds.isValidFlag==1)
  {
    SetDENMMapemConnectionListParams(packetHandle, value.connectionIds, newPath);
    result = CheckLastError("DENM", gkFuncRefGet, result);
  }
  else
  {
    if( C2xIsTokenAvailable(packetHandle, "DENM", newPath) )
    {
      C2xRemoveToken(packetHandle, "DENM", newPath);
    }
  }

  return result;
}

int GetDENMMapemConfigurationParams(LONG packetHandle, struct DENMMapemConfiguration value, char oldPath[])
{
  char newPath[300]; 
  int i;
  int result;

  result = 0;

  value.length = C2xGetTokenInt(packetHandle, "DENM", oldPath);
  if((result = CheckLastError("DENM", gkFuncRefGet, result))==0)
  {
    for(i=0; i<value.length; i++)
    {
      snprintf(newPath, elcount(newPath), "%s[%d]", oldPath, i);
      GetDENMMapemElementReferenceParams(packetHandle, value.arrayValue[i], newPath);
      result = CheckLastError("DENM", gkFuncRefGet, result);
    }
  }
  return result;
}

int SetDENMMapemConfigurationParams(LONG packetHandle, struct DENMMapemConfiguration value, char oldPath[])
{
  char newPath[300]; 
  int i;
  int result;

  result = 0;

  C2xRemoveToken(packetHandle, "DENM", oldPath);
  for(i=0; i<value.length; i++)
  {
    snprintf(newPath, elcount(newPath), "%s[%d]", oldPath, i);
    SetDENMMapemElementReferenceParams(packetHandle, value.arrayValue[i], newPath);
    result = CheckLastError("DENM", gkFuncRefGet, result);
  }
  return result;
}

int GetDENMRoadConfigurationSectionParams(LONG packetHandle, struct DENMRoadConfigurationSection value, char oldPath[])
{
  char newPath[300];
  int result;

  result = 0;

  snprintf(newPath, elcount(newPath), "%s.%s", oldPath, "roadSectionDefinition");
  GetDENMRoadSectionDefinitionParams(packetHandle, value.roadSectionDefinition, newPath);
  result = CheckLastError("DENM", gkFuncRefGet, result);

  snprintf(newPath, elcount(newPath), "%s.%s", oldPath, "roadType");
  value.roadType.isValidFlag = C2xIsTokenAvailable(packetHandle, "DENM", newPath);
  if(value.roadType.isValidFlag==1)
  {
    value.roadType.value = C2xGetTokenInt(packetHandle, "DENM", newPath);
    result = CheckLastError("DENM", gkFuncRefGet, result);
  }
  snprintf(newPath, elcount(newPath), "%s.%s", oldPath, "laneConfiguration");
  value.laneConfiguration.isValidFlag = C2xIsTokenAvailable(packetHandle, "DENM", newPath);
  if(value.laneConfiguration.isValidFlag==1)
  {
    GetDENMBasicLaneConfigurationParams(packetHandle, value.laneConfiguration, newPath);
    result = CheckLastError("DENM", gkFuncRefGet, result);
  }
  snprintf(newPath, elcount(newPath), "%s.%s", oldPath, "mapemConfiguration");
  value.mapemConfiguration.isValidFlag = C2xIsTokenAvailable(packetHandle, "DENM", newPath);
  if(value.mapemConfiguration.isValidFlag==1)
  {
    GetDENMMapemConfigurationParams(packetHandle, value.mapemConfiguration, newPath);
    result = CheckLastError("DENM", gkFuncRefGet, result);
  }
  return result;
}

int SetDENMRoadConfigurationSectionParams(LONG packetHandle, struct DENMRoadConfigurationSection value, char oldPath[])
{
  char newPath[300];
  int result;

  result = 0;

  snprintf(newPath, elcount(newPath), "%s.%s", oldPath, "roadSectionDefinition");
  SetDENMRoadSectionDefinitionParams(packetHandle, value.roadSectionDefinition, newPath);
  result = CheckLastError("DENM", gkFuncRefGet, result);

  snprintf(newPath, elcount(newPath), "%s.%s", oldPath, "roadType");
  if(value.roadType.isValidFlag==1)
  {
    C2xSetTokenInt(packetHandle, "DENM", newPath, value.roadType.value);
    result = CheckLastError("DENM", gkFuncRefGet, result);
  }
  else
  {
    if( C2xIsTokenAvailable(packetHandle, "DENM", newPath) )
    {
      C2xRemoveToken(packetHandle, "DENM", newPath);
    }
  }

  snprintf(newPath, elcount(newPath), "%s.%s", oldPath, "laneConfiguration");
  if(value.laneConfiguration.isValidFlag==1)
  {
    SetDENMBasicLaneConfigurationParams(packetHandle, value.laneConfiguration, newPath);
    result = CheckLastError("DENM", gkFuncRefGet, result);
  }
  else
  {
    if( C2xIsTokenAvailable(packetHandle, "DENM", newPath) )
    {
      C2xRemoveToken(packetHandle, "DENM", newPath);
    }
  }

  snprintf(newPath, elcount(newPath), "%s.%s", oldPath, "mapemConfiguration");
  if(value.mapemConfiguration.isValidFlag==1)
  {
    SetDENMMapemConfigurationParams(packetHandle, value.mapemConfiguration, newPath);
    result = CheckLastError("DENM", gkFuncRefGet, result);
  }
  else
  {
    if( C2xIsTokenAvailable(packetHandle, "DENM", newPath) )
    {
      C2xRemoveToken(packetHandle, "DENM", newPath);
    }
  }

  return result;
}

int GetDENMRoadConfigurationSectionListParams(LONG packetHandle, struct DENMRoadConfigurationSectionList value, char oldPath[])
{
  char newPath[300]; 
  int i;
  int result;

  result = 0;

  value.length = C2xGetTokenInt(packetHandle, "DENM", oldPath);
  if((result = CheckLastError("DENM", gkFuncRefGet, result))==0)
  {
    for(i=0; i<value.length; i++)
    {
      snprintf(newPath, elcount(newPath), "%s[%d]", oldPath, i);
      GetDENMRoadConfigurationSectionParams(packetHandle, value.arrayValue[i], newPath);
      result = CheckLastError("DENM", gkFuncRefGet, result);
    }
  }
  return result;
}

int SetDENMRoadConfigurationSectionListParams(LONG packetHandle, struct DENMRoadConfigurationSectionList value, char oldPath[])
{
  char newPath[300]; 
  int i;
  int result;

  result = 0;

  C2xRemoveToken(packetHandle, "DENM", oldPath);
  for(i=0; i<value.length; i++)
  {
    snprintf(newPath, elcount(newPath), "%s[%d]", oldPath, i);
    SetDENMRoadConfigurationSectionParams(packetHandle, value.arrayValue[i], newPath);
    result = CheckLastError("DENM", gkFuncRefGet, result);
  }
  return result;
}

int GetDENMRoadConfigurationContainerParams(LONG packetHandle, struct DENMRoadConfigurationContainer value, char oldPath[])
{
  char newPath[300];
  int result;

  result = 0;

  snprintf(newPath, elcount(newPath), "%s.%s", oldPath, "roadConfigurationConfidence");
  GetDENMMetaInformationParams(packetHandle, value.roadConfigurationConfidence, newPath);
  result = CheckLastError("DENM", gkFuncRefGet, result);

  snprintf(newPath, elcount(newPath), "%s.%s", oldPath, "roadConfigurationSectionList");
  GetDENMRoadConfigurationSectionListParams(packetHandle, value.roadConfigurationSectionList, newPath);
  result = CheckLastError("DENM", gkFuncRefGet, result);

  return result;
}

int SetDENMRoadConfigurationContainerParams(LONG packetHandle, struct DENMRoadConfigurationContainer value, char oldPath[])
{
  char newPath[300];
  int result;

  result = 0;

  snprintf(newPath, elcount(newPath), "%s.%s", oldPath, "roadConfigurationConfidence");
  SetDENMMetaInformationParams(packetHandle, value.roadConfigurationConfidence, newPath);
  result = CheckLastError("DENM", gkFuncRefGet, result);

  snprintf(newPath, elcount(newPath), "%s.%s", oldPath, "roadConfigurationSectionList");
  SetDENMRoadConfigurationSectionListParams(packetHandle, value.roadConfigurationSectionList, newPath);
  result = CheckLastError("DENM", gkFuncRefGet, result);

  return result;
}

int GetDENMCartesianCoordinateWithConfidenceParams(LONG packetHandle, struct DENMCartesianCoordinateWithConfidence value, char oldPath[])
{
  char newPath[300];
  int result;

  result = 0;

  snprintf(newPath, elcount(newPath), "%s.%s", oldPath, "value");
  value.value = C2xGetTokenInt(packetHandle, "DENM", newPath);
  result = CheckLastError("DENM", gkFuncRefGet, result);

  snprintf(newPath, elcount(newPath), "%s.%s", oldPath, "confidence");
  value.confidence = C2xGetTokenInt(packetHandle, "DENM", newPath);
  result = CheckLastError("DENM", gkFuncRefGet, result);

  return result;
}

int SetDENMCartesianCoordinateWithConfidenceParams(LONG packetHandle, struct DENMCartesianCoordinateWithConfidence value, char oldPath[])
{
  char newPath[300];
  int result;

  result = 0;

  snprintf(newPath, elcount(newPath), "%s.%s", oldPath, "value");
  C2xSetTokenInt(packetHandle, "DENM", newPath, value.value);
  result = CheckLastError("DENM", gkFuncRefGet, result);

  snprintf(newPath, elcount(newPath), "%s.%s", oldPath, "confidence");
  if (value.confidence < 1)
  {
    C2xSetTokenInt(packetHandle, "DENM", newPath, 1);
  }
  else if (value.confidence > 4096)
  {
    C2xSetTokenInt(packetHandle, "DENM", newPath, 4096);
  }
  else
  {
    C2xSetTokenInt(packetHandle, "DENM", newPath, value.confidence);
  }
  result = CheckLastError("DENM", gkFuncRefGet, result);

  return result;
}

int GetDENMCartesianPosition3dWithConfidenceParams(LONG packetHandle, struct DENMCartesianPosition3dWithConfidence value, char oldPath[])
{
  char newPath[300];
  int result;

  result = 0;

  snprintf(newPath, elcount(newPath), "%s.%s", oldPath, "xCoordinate");
  GetDENMCartesianCoordinateWithConfidenceParams(packetHandle, value.xCoordinate, newPath);
  result = CheckLastError("DENM", gkFuncRefGet, result);

  snprintf(newPath, elcount(newPath), "%s.%s", oldPath, "yCoordinate");
  GetDENMCartesianCoordinateWithConfidenceParams(packetHandle, value.yCoordinate, newPath);
  result = CheckLastError("DENM", gkFuncRefGet, result);

  snprintf(newPath, elcount(newPath), "%s.%s", oldPath, "zCoordinate");
  value.zCoordinate.isValidFlag = C2xIsTokenAvailable(packetHandle, "DENM", newPath);
  if(value.zCoordinate.isValidFlag==1)
  {
    GetDENMCartesianCoordinateWithConfidenceParams(packetHandle, value.zCoordinate, newPath);
    result = CheckLastError("DENM", gkFuncRefGet, result);
  }
  return result;
}

int SetDENMCartesianPosition3dWithConfidenceParams(LONG packetHandle, struct DENMCartesianPosition3dWithConfidence value, char oldPath[])
{
  char newPath[300];
  int result;

  result = 0;

  snprintf(newPath, elcount(newPath), "%s.%s", oldPath, "xCoordinate");
  SetDENMCartesianCoordinateWithConfidenceParams(packetHandle, value.xCoordinate, newPath);
  result = CheckLastError("DENM", gkFuncRefGet, result);

  snprintf(newPath, elcount(newPath), "%s.%s", oldPath, "yCoordinate");
  SetDENMCartesianCoordinateWithConfidenceParams(packetHandle, value.yCoordinate, newPath);
  result = CheckLastError("DENM", gkFuncRefGet, result);

  snprintf(newPath, elcount(newPath), "%s.%s", oldPath, "zCoordinate");
  if(value.zCoordinate.isValidFlag==1)
  {
    SetDENMCartesianCoordinateWithConfidenceParams(packetHandle, value.zCoordinate, newPath);
    result = CheckLastError("DENM", gkFuncRefGet, result);
  }
  else
  {
    if( C2xIsTokenAvailable(packetHandle, "DENM", newPath) )
    {
      C2xRemoveToken(packetHandle, "DENM", newPath);
    }
  }

  return result;
}

int GetDENMCartesianAngleParams(LONG packetHandle, struct DENMCartesianAngle value, char oldPath[])
{
  char newPath[300];
  int result;

  result = 0;

  snprintf(newPath, elcount(newPath), "%s.%s", oldPath, "value");
  value.value = C2xGetTokenInt(packetHandle, "DENM", newPath);
  result = CheckLastError("DENM", gkFuncRefGet, result);

  snprintf(newPath, elcount(newPath), "%s.%s", oldPath, "confidence");
  value.confidence = C2xGetTokenInt(packetHandle, "DENM", newPath);
  result = CheckLastError("DENM", gkFuncRefGet, result);

  return result;
}

int SetDENMCartesianAngleParams(LONG packetHandle, struct DENMCartesianAngle value, char oldPath[])
{
  char newPath[300];
  int result;

  result = 0;

  snprintf(newPath, elcount(newPath), "%s.%s", oldPath, "value");
  C2xSetTokenInt(packetHandle, "DENM", newPath, value.value);
  result = CheckLastError("DENM", gkFuncRefGet, result);

  snprintf(newPath, elcount(newPath), "%s.%s", oldPath, "confidence");
  if (value.confidence < 1)
  {
    C2xSetTokenInt(packetHandle, "DENM", newPath, 1);
  }
  else if (value.confidence > 127)
  {
    C2xSetTokenInt(packetHandle, "DENM", newPath, 127);
  }
  else
  {
    C2xSetTokenInt(packetHandle, "DENM", newPath, value.confidence);
  }
  result = CheckLastError("DENM", gkFuncRefGet, result);

  return result;
}

int GetDENMVelocityComponentParams(LONG packetHandle, struct DENMVelocityComponent value, char oldPath[])
{
  char newPath[300];
  int result;

  result = 0;

  snprintf(newPath, elcount(newPath), "%s.%s", oldPath, "value");
  value.value = C2xGetTokenInt(packetHandle, "DENM", newPath);
  result = CheckLastError("DENM", gkFuncRefGet, result);

  snprintf(newPath, elcount(newPath), "%s.%s", oldPath, "confidence");
  value.confidence = C2xGetTokenInt(packetHandle, "DENM", newPath);
  result = CheckLastError("DENM", gkFuncRefGet, result);

  return result;
}

int SetDENMVelocityComponentParams(LONG packetHandle, struct DENMVelocityComponent value, char oldPath[])
{
  char newPath[300];
  int result;

  result = 0;

  snprintf(newPath, elcount(newPath), "%s.%s", oldPath, "value");
  C2xSetTokenInt(packetHandle, "DENM", newPath, value.value);
  result = CheckLastError("DENM", gkFuncRefGet, result);

  snprintf(newPath, elcount(newPath), "%s.%s", oldPath, "confidence");
  if (value.confidence < 1)
  {
    C2xSetTokenInt(packetHandle, "DENM", newPath, 1);
  }
  else if (value.confidence > 127)
  {
    C2xSetTokenInt(packetHandle, "DENM", newPath, 127);
  }
  else
  {
    C2xSetTokenInt(packetHandle, "DENM", newPath, value.confidence);
  }
  result = CheckLastError("DENM", gkFuncRefGet, result);

  return result;
}

int GetDENMVelocityPolarWithZParams(LONG packetHandle, struct DENMVelocityPolarWithZ value, char oldPath[])
{
  char newPath[300];
  int result;

  result = 0;

  snprintf(newPath, elcount(newPath), "%s.%s", oldPath, "velocityMagnitude");
  GetDENMSpeedParams(packetHandle, value.velocityMagnitude, newPath);
  result = CheckLastError("DENM", gkFuncRefGet, result);

  snprintf(newPath, elcount(newPath), "%s.%s", oldPath, "velocityDirection");
  GetDENMCartesianAngleParams(packetHandle, value.velocityDirection, newPath);
  result = CheckLastError("DENM", gkFuncRefGet, result);

  snprintf(newPath, elcount(newPath), "%s.%s", oldPath, "zVelocity");
  value.zVelocity.isValidFlag = C2xIsTokenAvailable(packetHandle, "DENM", newPath);
  if(value.zVelocity.isValidFlag==1)
  {
    GetDENMVelocityComponentParams(packetHandle, value.zVelocity, newPath);
    result = CheckLastError("DENM", gkFuncRefGet, result);
  }
  return result;
}

int SetDENMVelocityPolarWithZParams(LONG packetHandle, struct DENMVelocityPolarWithZ value, char oldPath[])
{
  char newPath[300];
  int result;

  result = 0;

  snprintf(newPath, elcount(newPath), "%s.%s", oldPath, "velocityMagnitude");
  SetDENMSpeedParams(packetHandle, value.velocityMagnitude, newPath);
  result = CheckLastError("DENM", gkFuncRefGet, result);

  snprintf(newPath, elcount(newPath), "%s.%s", oldPath, "velocityDirection");
  SetDENMCartesianAngleParams(packetHandle, value.velocityDirection, newPath);
  result = CheckLastError("DENM", gkFuncRefGet, result);

  snprintf(newPath, elcount(newPath), "%s.%s", oldPath, "zVelocity");
  if(value.zVelocity.isValidFlag==1)
  {
    SetDENMVelocityComponentParams(packetHandle, value.zVelocity, newPath);
    result = CheckLastError("DENM", gkFuncRefGet, result);
  }
  else
  {
    if( C2xIsTokenAvailable(packetHandle, "DENM", newPath) )
    {
      C2xRemoveToken(packetHandle, "DENM", newPath);
    }
  }

  return result;
}

int GetDENMVelocityCartesianParams(LONG packetHandle, struct DENMVelocityCartesian value, char oldPath[])
{
  char newPath[300];
  int result;

  result = 0;

  snprintf(newPath, elcount(newPath), "%s.%s", oldPath, "xVelocity");
  GetDENMVelocityComponentParams(packetHandle, value.xVelocity, newPath);
  result = CheckLastError("DENM", gkFuncRefGet, result);

  snprintf(newPath, elcount(newPath), "%s.%s", oldPath, "yVelocity");
  GetDENMVelocityComponentParams(packetHandle, value.yVelocity, newPath);
  result = CheckLastError("DENM", gkFuncRefGet, result);

  snprintf(newPath, elcount(newPath), "%s.%s", oldPath, "zVelocity");
  value.zVelocity.isValidFlag = C2xIsTokenAvailable(packetHandle, "DENM", newPath);
  if(value.zVelocity.isValidFlag==1)
  {
    GetDENMVelocityComponentParams(packetHandle, value.zVelocity, newPath);
    result = CheckLastError("DENM", gkFuncRefGet, result);
  }
  return result;
}

int SetDENMVelocityCartesianParams(LONG packetHandle, struct DENMVelocityCartesian value, char oldPath[])
{
  char newPath[300];
  int result;

  result = 0;

  snprintf(newPath, elcount(newPath), "%s.%s", oldPath, "xVelocity");
  SetDENMVelocityComponentParams(packetHandle, value.xVelocity, newPath);
  result = CheckLastError("DENM", gkFuncRefGet, result);

  snprintf(newPath, elcount(newPath), "%s.%s", oldPath, "yVelocity");
  SetDENMVelocityComponentParams(packetHandle, value.yVelocity, newPath);
  result = CheckLastError("DENM", gkFuncRefGet, result);

  snprintf(newPath, elcount(newPath), "%s.%s", oldPath, "zVelocity");
  if(value.zVelocity.isValidFlag==1)
  {
    SetDENMVelocityComponentParams(packetHandle, value.zVelocity, newPath);
    result = CheckLastError("DENM", gkFuncRefGet, result);
  }
  else
  {
    if( C2xIsTokenAvailable(packetHandle, "DENM", newPath) )
    {
      C2xRemoveToken(packetHandle, "DENM", newPath);
    }
  }

  return result;
}

int GetDENMVelocity3dWithConfidenceParams(LONG packetHandle, struct DENMVelocity3dWithConfidence value, char oldPath[])
{
  char newPath[300];
  int result;

  result = 0;

  value.choice = C2xGetTokenInt(packetHandle, "DENM", oldPath);

  switch(value.choice)
  {
    case 0:
    {
      snprintf(newPath, elcount(newPath), "%s.%s", oldPath, "polarVelocity");
      GetDENMVelocityPolarWithZParams(packetHandle, value.polarVelocity, newPath);
      result = CheckLastError("DENM", gkFuncRefGet, result);
    }
    break;
    case 1:
    {
      snprintf(newPath, elcount(newPath), "%s.%s", oldPath, "cartesianVelocity");
      GetDENMVelocityCartesianParams(packetHandle, value.cartesianVelocity, newPath);
      result = CheckLastError("DENM", gkFuncRefGet, result);
    }
    break;
  }
  return result;
}

int SetDENMVelocity3dWithConfidenceParams(LONG packetHandle, struct DENMVelocity3dWithConfidence value, char oldPath[])
{
  char newPath[300];
  int result;

  result = 0;

  switch(value.choice)
  {
    case 0:
    {
      snprintf(newPath, elcount(newPath), "%s.%s", oldPath, "polarVelocity");
      SetDENMVelocityPolarWithZParams(packetHandle, value.polarVelocity, newPath);
      result = CheckLastError("DENM", gkFuncRefGet, result);
    }
    break;
    case 1:
    {
      snprintf(newPath, elcount(newPath), "%s.%s", oldPath, "cartesianVelocity");
      SetDENMVelocityCartesianParams(packetHandle, value.cartesianVelocity, newPath);
      result = CheckLastError("DENM", gkFuncRefGet, result);
    }
    break;
  }
  return result;
}

int GetDENMAccelerationMagnitudeParams(LONG packetHandle, struct DENMAccelerationMagnitude value, char oldPath[])
{
  char newPath[300];
  int result;

  result = 0;

  snprintf(newPath, elcount(newPath), "%s.%s", oldPath, "accelerationMagnitudeValue");
  value.accelerationMagnitudeValue = C2xGetTokenInt(packetHandle, "DENM", newPath);
  result = CheckLastError("DENM", gkFuncRefGet, result);

  snprintf(newPath, elcount(newPath), "%s.%s", oldPath, "accelerationConfidence");
  value.accelerationConfidence = C2xGetTokenInt(packetHandle, "DENM", newPath);
  result = CheckLastError("DENM", gkFuncRefGet, result);

  return result;
}

int SetDENMAccelerationMagnitudeParams(LONG packetHandle, struct DENMAccelerationMagnitude value, char oldPath[])
{
  char newPath[300];
  int result;

  result = 0;

  snprintf(newPath, elcount(newPath), "%s.%s", oldPath, "accelerationMagnitudeValue");
  C2xSetTokenInt(packetHandle, "DENM", newPath, value.accelerationMagnitudeValue);
  result = CheckLastError("DENM", gkFuncRefGet, result);

  snprintf(newPath, elcount(newPath), "%s.%s", oldPath, "accelerationConfidence");
  C2xSetTokenInt(packetHandle, "DENM", newPath, value.accelerationConfidence);
  result = CheckLastError("DENM", gkFuncRefGet, result);

  return result;
}

int GetDENMAccelerationComponentParams(LONG packetHandle, struct DENMAccelerationComponent value, char oldPath[])
{
  char newPath[300];
  int result;

  result = 0;

  snprintf(newPath, elcount(newPath), "%s.%s", oldPath, "value");
  value.value = C2xGetTokenInt(packetHandle, "DENM", newPath);
  result = CheckLastError("DENM", gkFuncRefGet, result);

  snprintf(newPath, elcount(newPath), "%s.%s", oldPath, "confidence");
  value.confidence = C2xGetTokenInt(packetHandle, "DENM", newPath);
  result = CheckLastError("DENM", gkFuncRefGet, result);

  return result;
}

int SetDENMAccelerationComponentParams(LONG packetHandle, struct DENMAccelerationComponent value, char oldPath[])
{
  char newPath[300];
  int result;

  result = 0;

  snprintf(newPath, elcount(newPath), "%s.%s", oldPath, "value");
  C2xSetTokenInt(packetHandle, "DENM", newPath, value.value);
  result = CheckLastError("DENM", gkFuncRefGet, result);

  snprintf(newPath, elcount(newPath), "%s.%s", oldPath, "confidence");
  C2xSetTokenInt(packetHandle, "DENM", newPath, value.confidence);
  result = CheckLastError("DENM", gkFuncRefGet, result);

  return result;
}

int GetDENMAccelerationPolarWithZParams(LONG packetHandle, struct DENMAccelerationPolarWithZ value, char oldPath[])
{
  char newPath[300];
  int result;

  result = 0;

  snprintf(newPath, elcount(newPath), "%s.%s", oldPath, "accelerationMagnitude");
  GetDENMAccelerationMagnitudeParams(packetHandle, value.accelerationMagnitude, newPath);
  result = CheckLastError("DENM", gkFuncRefGet, result);

  snprintf(newPath, elcount(newPath), "%s.%s", oldPath, "accelerationDirection");
  GetDENMCartesianAngleParams(packetHandle, value.accelerationDirection, newPath);
  result = CheckLastError("DENM", gkFuncRefGet, result);

  snprintf(newPath, elcount(newPath), "%s.%s", oldPath, "zAcceleration");
  value.zAcceleration.isValidFlag = C2xIsTokenAvailable(packetHandle, "DENM", newPath);
  if(value.zAcceleration.isValidFlag==1)
  {
    GetDENMAccelerationComponentParams(packetHandle, value.zAcceleration, newPath);
    result = CheckLastError("DENM", gkFuncRefGet, result);
  }
  return result;
}

int SetDENMAccelerationPolarWithZParams(LONG packetHandle, struct DENMAccelerationPolarWithZ value, char oldPath[])
{
  char newPath[300];
  int result;

  result = 0;

  snprintf(newPath, elcount(newPath), "%s.%s", oldPath, "accelerationMagnitude");
  SetDENMAccelerationMagnitudeParams(packetHandle, value.accelerationMagnitude, newPath);
  result = CheckLastError("DENM", gkFuncRefGet, result);

  snprintf(newPath, elcount(newPath), "%s.%s", oldPath, "accelerationDirection");
  SetDENMCartesianAngleParams(packetHandle, value.accelerationDirection, newPath);
  result = CheckLastError("DENM", gkFuncRefGet, result);

  snprintf(newPath, elcount(newPath), "%s.%s", oldPath, "zAcceleration");
  if(value.zAcceleration.isValidFlag==1)
  {
    SetDENMAccelerationComponentParams(packetHandle, value.zAcceleration, newPath);
    result = CheckLastError("DENM", gkFuncRefGet, result);
  }
  else
  {
    if( C2xIsTokenAvailable(packetHandle, "DENM", newPath) )
    {
      C2xRemoveToken(packetHandle, "DENM", newPath);
    }
  }

  return result;
}

int GetDENMAccelerationCartesianParams(LONG packetHandle, struct DENMAccelerationCartesian value, char oldPath[])
{
  char newPath[300];
  int result;

  result = 0;

  snprintf(newPath, elcount(newPath), "%s.%s", oldPath, "xAcceleration");
  GetDENMAccelerationComponentParams(packetHandle, value.xAcceleration, newPath);
  result = CheckLastError("DENM", gkFuncRefGet, result);

  snprintf(newPath, elcount(newPath), "%s.%s", oldPath, "yAcceleration");
  GetDENMAccelerationComponentParams(packetHandle, value.yAcceleration, newPath);
  result = CheckLastError("DENM", gkFuncRefGet, result);

  snprintf(newPath, elcount(newPath), "%s.%s", oldPath, "zAcceleration");
  value.zAcceleration.isValidFlag = C2xIsTokenAvailable(packetHandle, "DENM", newPath);
  if(value.zAcceleration.isValidFlag==1)
  {
    GetDENMAccelerationComponentParams(packetHandle, value.zAcceleration, newPath);
    result = CheckLastError("DENM", gkFuncRefGet, result);
  }
  return result;
}

int SetDENMAccelerationCartesianParams(LONG packetHandle, struct DENMAccelerationCartesian value, char oldPath[])
{
  char newPath[300];
  int result;

  result = 0;

  snprintf(newPath, elcount(newPath), "%s.%s", oldPath, "xAcceleration");
  SetDENMAccelerationComponentParams(packetHandle, value.xAcceleration, newPath);
  result = CheckLastError("DENM", gkFuncRefGet, result);

  snprintf(newPath, elcount(newPath), "%s.%s", oldPath, "yAcceleration");
  SetDENMAccelerationComponentParams(packetHandle, value.yAcceleration, newPath);
  result = CheckLastError("DENM", gkFuncRefGet, result);

  snprintf(newPath, elcount(newPath), "%s.%s", oldPath, "zAcceleration");
  if(value.zAcceleration.isValidFlag==1)
  {
    SetDENMAccelerationComponentParams(packetHandle, value.zAcceleration, newPath);
    result = CheckLastError("DENM", gkFuncRefGet, result);
  }
  else
  {
    if( C2xIsTokenAvailable(packetHandle, "DENM", newPath) )
    {
      C2xRemoveToken(packetHandle, "DENM", newPath);
    }
  }

  return result;
}

int GetDENMAcceleration3dWithConfidenceParams(LONG packetHandle, struct DENMAcceleration3dWithConfidence value, char oldPath[])
{
  char newPath[300];
  int result;

  result = 0;

  value.choice = C2xGetTokenInt(packetHandle, "DENM", oldPath);

  switch(value.choice)
  {
    case 0:
    {
      snprintf(newPath, elcount(newPath), "%s.%s", oldPath, "polarAcceleration");
      GetDENMAccelerationPolarWithZParams(packetHandle, value.polarAcceleration, newPath);
      result = CheckLastError("DENM", gkFuncRefGet, result);
    }
    break;
    case 1:
    {
      snprintf(newPath, elcount(newPath), "%s.%s", oldPath, "cartesianAcceleration");
      GetDENMAccelerationCartesianParams(packetHandle, value.cartesianAcceleration, newPath);
      result = CheckLastError("DENM", gkFuncRefGet, result);
    }
    break;
  }
  return result;
}

int SetDENMAcceleration3dWithConfidenceParams(LONG packetHandle, struct DENMAcceleration3dWithConfidence value, char oldPath[])
{
  char newPath[300];
  int result;

  result = 0;

  switch(value.choice)
  {
    case 0:
    {
      snprintf(newPath, elcount(newPath), "%s.%s", oldPath, "polarAcceleration");
      SetDENMAccelerationPolarWithZParams(packetHandle, value.polarAcceleration, newPath);
      result = CheckLastError("DENM", gkFuncRefGet, result);
    }
    break;
    case 1:
    {
      snprintf(newPath, elcount(newPath), "%s.%s", oldPath, "cartesianAcceleration");
      SetDENMAccelerationCartesianParams(packetHandle, value.cartesianAcceleration, newPath);
      result = CheckLastError("DENM", gkFuncRefGet, result);
    }
    break;
  }
  return result;
}

int GetDENMEulerAnglesWithConfidenceParams(LONG packetHandle, struct DENMEulerAnglesWithConfidence value, char oldPath[])
{
  char newPath[300];
  int result;

  result = 0;

  snprintf(newPath, elcount(newPath), "%s.%s", oldPath, "zAngle");
  GetDENMCartesianAngleParams(packetHandle, value.zAngle, newPath);
  result = CheckLastError("DENM", gkFuncRefGet, result);

  snprintf(newPath, elcount(newPath), "%s.%s", oldPath, "yAngle");
  value.yAngle.isValidFlag = C2xIsTokenAvailable(packetHandle, "DENM", newPath);
  if(value.yAngle.isValidFlag==1)
  {
    GetDENMCartesianAngleParams(packetHandle, value.yAngle, newPath);
    result = CheckLastError("DENM", gkFuncRefGet, result);
  }
  snprintf(newPath, elcount(newPath), "%s.%s", oldPath, "xAngle");
  value.xAngle.isValidFlag = C2xIsTokenAvailable(packetHandle, "DENM", newPath);
  if(value.xAngle.isValidFlag==1)
  {
    GetDENMCartesianAngleParams(packetHandle, value.xAngle, newPath);
    result = CheckLastError("DENM", gkFuncRefGet, result);
  }
  return result;
}

int SetDENMEulerAnglesWithConfidenceParams(LONG packetHandle, struct DENMEulerAnglesWithConfidence value, char oldPath[])
{
  char newPath[300];
  int result;

  result = 0;

  snprintf(newPath, elcount(newPath), "%s.%s", oldPath, "zAngle");
  SetDENMCartesianAngleParams(packetHandle, value.zAngle, newPath);
  result = CheckLastError("DENM", gkFuncRefGet, result);

  snprintf(newPath, elcount(newPath), "%s.%s", oldPath, "yAngle");
  if(value.yAngle.isValidFlag==1)
  {
    SetDENMCartesianAngleParams(packetHandle, value.yAngle, newPath);
    result = CheckLastError("DENM", gkFuncRefGet, result);
  }
  else
  {
    if( C2xIsTokenAvailable(packetHandle, "DENM", newPath) )
    {
      C2xRemoveToken(packetHandle, "DENM", newPath);
    }
  }

  snprintf(newPath, elcount(newPath), "%s.%s", oldPath, "xAngle");
  if(value.xAngle.isValidFlag==1)
  {
    SetDENMCartesianAngleParams(packetHandle, value.xAngle, newPath);
    result = CheckLastError("DENM", gkFuncRefGet, result);
  }
  else
  {
    if( C2xIsTokenAvailable(packetHandle, "DENM", newPath) )
    {
      C2xRemoveToken(packetHandle, "DENM", newPath);
    }
  }

  return result;
}

int GetDENMCartesianAngularVelocityComponentParams(LONG packetHandle, struct DENMCartesianAngularVelocityComponent value, char oldPath[])
{
  char newPath[300];
  int result;

  result = 0;

  snprintf(newPath, elcount(newPath), "%s.%s", oldPath, "value");
  value.value = C2xGetTokenInt(packetHandle, "DENM", newPath);
  result = CheckLastError("DENM", gkFuncRefGet, result);

  snprintf(newPath, elcount(newPath), "%s.%s", oldPath, "confidence");
  value.confidence = C2xGetTokenInt(packetHandle, "DENM", newPath);
  result = CheckLastError("DENM", gkFuncRefGet, result);

  return result;
}

int SetDENMCartesianAngularVelocityComponentParams(LONG packetHandle, struct DENMCartesianAngularVelocityComponent value, char oldPath[])
{
  char newPath[300];
  int result;

  result = 0;

  snprintf(newPath, elcount(newPath), "%s.%s", oldPath, "value");
  C2xSetTokenInt(packetHandle, "DENM", newPath, value.value);
  result = CheckLastError("DENM", gkFuncRefGet, result);

  snprintf(newPath, elcount(newPath), "%s.%s", oldPath, "confidence");
  C2xSetTokenInt(packetHandle, "DENM", newPath, value.confidence);
  result = CheckLastError("DENM", gkFuncRefGet, result);

  return result;
}

int GetDENMCorrelationColumnParams(LONG packetHandle, struct DENMCorrelationColumn value, char oldPath[])
{
  char newPath[300]; 
  int i;
  int result;

  result = 0;

  value.length = C2xGetTokenInt(packetHandle, "DENM", oldPath);
  if((result = CheckLastError("DENM", gkFuncRefGet, result))==0)
  {
    for(i=0; i<value.length; i++)
    {
      snprintf(newPath, elcount(newPath), "%s[%d]", oldPath, i);
      value.arrayValue[i] = C2xGetTokenInt64(packetHandle, "DENM", newPath);
      result = CheckLastError("DENM", gkFuncRefGet, result);
    }
  }
  return result;
}

int SetDENMCorrelationColumnParams(LONG packetHandle, struct DENMCorrelationColumn value, char oldPath[])
{
  char newPath[300]; 
  int i;
  int result;

  result = 0;

  C2xRemoveToken(packetHandle, "DENM", oldPath);
  for(i=0; i<value.length; i++)
  {
    snprintf(newPath, elcount(newPath), "%s[%d]", oldPath, i);
    C2xSetTokenInt64(packetHandle, "DENM", newPath, value.arrayValue[i]);
    result = CheckLastError("DENM", gkFuncRefGet, result);
  }
  return result;
}

int GetDENMLowerTriangularPositiveSemidefiniteMatrixColumnsParams(LONG packetHandle, struct DENMLowerTriangularPositiveSemidefiniteMatrixColumns value, char oldPath[])
{
  char newPath[300]; 
  int i;
  int result;

  result = 0;

  value.length = C2xGetTokenInt(packetHandle, "DENM", oldPath);
  if((result = CheckLastError("DENM", gkFuncRefGet, result))==0)
  {
    for(i=0; i<value.length; i++)
    {
      snprintf(newPath, elcount(newPath), "%s[%d]", oldPath, i);
      GetDENMCorrelationColumnParams(packetHandle, value.arrayValue[i], newPath);
      result = CheckLastError("DENM", gkFuncRefGet, result);
    }
  }
  return result;
}

int SetDENMLowerTriangularPositiveSemidefiniteMatrixColumnsParams(LONG packetHandle, struct DENMLowerTriangularPositiveSemidefiniteMatrixColumns value, char oldPath[])
{
  char newPath[300]; 
  int i;
  int result;

  result = 0;

  C2xRemoveToken(packetHandle, "DENM", oldPath);
  for(i=0; i<value.length; i++)
  {
    snprintf(newPath, elcount(newPath), "%s[%d]", oldPath, i);
    SetDENMCorrelationColumnParams(packetHandle, value.arrayValue[i], newPath);
    result = CheckLastError("DENM", gkFuncRefGet, result);
  }
  return result;
}

int GetDENMLowerTriangularPositiveSemidefiniteMatrixParams(LONG packetHandle, struct DENMLowerTriangularPositiveSemidefiniteMatrix value, char oldPath[])
{
  char newPath[300]; 
  int j; 
  int k;
  int result;

  result = 0;

  snprintf(newPath, elcount(newPath), "%s.%s", oldPath, "componentsIncludedIntheMatrix");
  value.componentsIncludedIntheMatrix.isValidFlag = 1;
  value.componentsIncludedIntheMatrix.stringLength = C2xGetTokenLengthBit(packetHandle, "DENM", newPath);
  if ((result = CheckLastError("DENM", gkFuncRefGet, result))==0)
  {
    if(value.componentsIncludedIntheMatrix.stringLength > 0)
    {
      for(j=0; j<value.componentsIncludedIntheMatrix.stringLength; j++)
      {
        if(C2xGetTokenBitOfBitString(packetHandle, "DENM", newPath, j) == 0)
        {
          value.componentsIncludedIntheMatrix.string[j] = '0';
        }
        else if(C2xGetTokenBitOfBitString(packetHandle, "DENM", newPath, j) == 1)
        {
          value.componentsIncludedIntheMatrix.string[j] = '1';
        }

        if(value.componentsIncludedIntheMatrix.stringLength == 1)
        {
          value.componentsIncludedIntheMatrix.string[1] = '0';
        }
        result = CheckLastError("DENM", gkFuncRefGet, result);
      }
    }
    else
    {
      for(k = value.componentsIncludedIntheMatrix.stringLength+1; k > -1; k--)
      {
        if(value.componentsIncludedIntheMatrix.string[k] == '1')
        {
          value.componentsIncludedIntheMatrix.string[k] = '0';
        }
      }
    }
  }

  snprintf(newPath, elcount(newPath), "%s.%s", oldPath, "matrix");
  GetDENMLowerTriangularPositiveSemidefiniteMatrixColumnsParams(packetHandle, value.matrix, newPath);
  result = CheckLastError("DENM", gkFuncRefGet, result);

  return result;
}

int SetDENMLowerTriangularPositiveSemidefiniteMatrixParams(LONG packetHandle, struct DENMLowerTriangularPositiveSemidefiniteMatrix value, char oldPath[])
{
  char newPath[300]; 
  int j;
  int result;

  result = 0;

  snprintf(newPath, elcount(newPath), "%s.%s", oldPath, "componentsIncludedIntheMatrix");
    for(j=0; j<value.componentsIncludedIntheMatrix.stringLength; j++)
    {
      if(value.componentsIncludedIntheMatrix.string[j] == '0')
      {
        C2xSetTokenBitOfBitString(packetHandle, "DENM", newPath, j, 0);
      }
      else
      {
        C2xSetTokenBitOfBitString(packetHandle, "DENM", newPath, j, 1);
      }
      result = CheckLastError("DENM", gkFuncRefGet, result);
    }

  snprintf(newPath, elcount(newPath), "%s.%s", oldPath, "matrix");
  SetDENMLowerTriangularPositiveSemidefiniteMatrixColumnsParams(packetHandle, value.matrix, newPath);
  result = CheckLastError("DENM", gkFuncRefGet, result);

  return result;
}

int GetDENMLowerTriangularPositiveSemidefiniteMatricesParams(LONG packetHandle, struct DENMLowerTriangularPositiveSemidefiniteMatrices value, char oldPath[])
{
  char newPath[300]; 
  int i;
  int result;

  result = 0;

  value.length = C2xGetTokenInt(packetHandle, "DENM", oldPath);
  if((result = CheckLastError("DENM", gkFuncRefGet, result))==0)
  {
    for(i=0; i<value.length; i++)
    {
      snprintf(newPath, elcount(newPath), "%s[%d]", oldPath, i);
      GetDENMLowerTriangularPositiveSemidefiniteMatrixParams(packetHandle, value.arrayValue[i], newPath);
      result = CheckLastError("DENM", gkFuncRefGet, result);
    }
  }
  return result;
}

int SetDENMLowerTriangularPositiveSemidefiniteMatricesParams(LONG packetHandle, struct DENMLowerTriangularPositiveSemidefiniteMatrices value, char oldPath[])
{
  char newPath[300]; 
  int i;
  int result;

  result = 0;

  C2xRemoveToken(packetHandle, "DENM", oldPath);
  for(i=0; i<value.length; i++)
  {
    snprintf(newPath, elcount(newPath), "%s[%d]", oldPath, i);
    SetDENMLowerTriangularPositiveSemidefiniteMatrixParams(packetHandle, value.arrayValue[i], newPath);
    result = CheckLastError("DENM", gkFuncRefGet, result);
  }
  return result;
}

int GetDENMObjectDimensionParams(LONG packetHandle, struct DENMObjectDimension value, char oldPath[])
{
  char newPath[300];
  int result;

  result = 0;

  snprintf(newPath, elcount(newPath), "%s.%s", oldPath, "value");
  value.value = C2xGetTokenInt(packetHandle, "DENM", newPath);
  result = CheckLastError("DENM", gkFuncRefGet, result);

  snprintf(newPath, elcount(newPath), "%s.%s", oldPath, "confidence");
  value.confidence = C2xGetTokenInt(packetHandle, "DENM", newPath);
  result = CheckLastError("DENM", gkFuncRefGet, result);

  return result;
}

int SetDENMObjectDimensionParams(LONG packetHandle, struct DENMObjectDimension value, char oldPath[])
{
  char newPath[300];
  int result;

  result = 0;

  snprintf(newPath, elcount(newPath), "%s.%s", oldPath, "value");
  if (value.value < 1)
  {
    C2xSetTokenInt(packetHandle, "DENM", newPath, 1);
  }
  else if (value.value > 256)
  {
    C2xSetTokenInt(packetHandle, "DENM", newPath, 256);
  }
  else
  {
    C2xSetTokenInt(packetHandle, "DENM", newPath, value.value);
  }
  result = CheckLastError("DENM", gkFuncRefGet, result);

  snprintf(newPath, elcount(newPath), "%s.%s", oldPath, "confidence");
  if (value.confidence < 1)
  {
    C2xSetTokenInt(packetHandle, "DENM", newPath, 1);
  }
  else if (value.confidence > 32)
  {
    C2xSetTokenInt(packetHandle, "DENM", newPath, 32);
  }
  else
  {
    C2xSetTokenInt(packetHandle, "DENM", newPath, value.confidence);
  }
  result = CheckLastError("DENM", gkFuncRefGet, result);

  return result;
}

int GetDENMSequenceOfIdentifier1BParams(LONG packetHandle, struct DENMSequenceOfIdentifier1B value, char oldPath[])
{
  char newPath[300]; 
  int i;
  int result;

  result = 0;

  value.length = C2xGetTokenInt(packetHandle, "DENM", oldPath);
  if((result = CheckLastError("DENM", gkFuncRefGet, result))==0)
  {
    for(i=0; i<value.length; i++)
    {
      snprintf(newPath, elcount(newPath), "%s[%d]", oldPath, i);
      value.arrayValue[i] = C2xGetTokenInt64(packetHandle, "DENM", newPath);
      result = CheckLastError("DENM", gkFuncRefGet, result);
    }
  }
  return result;
}

int SetDENMSequenceOfIdentifier1BParams(LONG packetHandle, struct DENMSequenceOfIdentifier1B value, char oldPath[])
{
  char newPath[300]; 
  int i;
  int result;

  result = 0;

  C2xRemoveToken(packetHandle, "DENM", oldPath);
  for(i=0; i<value.length; i++)
  {
    snprintf(newPath, elcount(newPath), "%s[%d]", oldPath, i);
    C2xSetTokenInt64(packetHandle, "DENM", newPath, value.arrayValue[i]);
    result = CheckLastError("DENM", gkFuncRefGet, result);
  }
  return result;
}

int GetDENMVruProfileAndSubprofileParams(LONG packetHandle, struct DENMVruProfileAndSubprofile value, char oldPath[])
{
  char newPath[300];
  int result;

  result = 0;

  value.choice = C2xGetTokenInt(packetHandle, "DENM", oldPath);

  switch(value.choice)
  {
    case 0:
    {
      snprintf(newPath, elcount(newPath), "%s.%s", oldPath, "pedestrian");
      value.pedestrian = C2xGetTokenInt(packetHandle, "DENM", newPath);
      result = CheckLastError("DENM", gkFuncRefGet, result);
    }
    break;
    case 1:
    {
      snprintf(newPath, elcount(newPath), "%s.%s", oldPath, "bicyclistAndLightVruVehicle");
      value.bicyclistAndLightVruVehicle = C2xGetTokenInt(packetHandle, "DENM", newPath);
      result = CheckLastError("DENM", gkFuncRefGet, result);
    }
    break;
    case 2:
    {
      snprintf(newPath, elcount(newPath), "%s.%s", oldPath, "motorcyclist");
      value.motorcyclist = C2xGetTokenInt(packetHandle, "DENM", newPath);
      result = CheckLastError("DENM", gkFuncRefGet, result);
    }
    break;
    case 3:
    {
      snprintf(newPath, elcount(newPath), "%s.%s", oldPath, "animal");
      value.animal = C2xGetTokenInt(packetHandle, "DENM", newPath);
      result = CheckLastError("DENM", gkFuncRefGet, result);
    }
    break;
  }
  return result;
}

int SetDENMVruProfileAndSubprofileParams(LONG packetHandle, struct DENMVruProfileAndSubprofile value, char oldPath[])
{
  char newPath[300];
  int result;

  result = 0;

  switch(value.choice)
  {
    case 0:
    {
      snprintf(newPath, elcount(newPath), "%s.%s", oldPath, "pedestrian");
      C2xSetTokenInt(packetHandle, "DENM", newPath, value.pedestrian);
      result = CheckLastError("DENM", gkFuncRefGet, result);
    }
    break;
    case 1:
    {
      snprintf(newPath, elcount(newPath), "%s.%s", oldPath, "bicyclistAndLightVruVehicle");
      C2xSetTokenInt(packetHandle, "DENM", newPath, value.bicyclistAndLightVruVehicle);
      result = CheckLastError("DENM", gkFuncRefGet, result);
    }
    break;
    case 2:
    {
      snprintf(newPath, elcount(newPath), "%s.%s", oldPath, "motorcyclist");
      C2xSetTokenInt(packetHandle, "DENM", newPath, value.motorcyclist);
      result = CheckLastError("DENM", gkFuncRefGet, result);
    }
    break;
    case 3:
    {
      snprintf(newPath, elcount(newPath), "%s.%s", oldPath, "animal");
      C2xSetTokenInt(packetHandle, "DENM", newPath, value.animal);
      result = CheckLastError("DENM", gkFuncRefGet, result);
    }
    break;
  }
  return result;
}

int GetDENMCartesianPosition3dParams(LONG packetHandle, struct DENMCartesianPosition3d value, char oldPath[])
{
  char newPath[300];
  int result;

  result = 0;

  snprintf(newPath, elcount(newPath), "%s.%s", oldPath, "xCoordinate");
  value.xCoordinate = C2xGetTokenInt(packetHandle, "DENM", newPath);
  result = CheckLastError("DENM", gkFuncRefGet, result);

  snprintf(newPath, elcount(newPath), "%s.%s", oldPath, "yCoordinate");
  value.yCoordinate = C2xGetTokenInt(packetHandle, "DENM", newPath);
  result = CheckLastError("DENM", gkFuncRefGet, result);

  snprintf(newPath, elcount(newPath), "%s.%s", oldPath, "zCoordinate");
  value.zCoordinate.isValidFlag = C2xIsTokenAvailable(packetHandle, "DENM", newPath);
  if(value.zCoordinate.isValidFlag==1)
  {
    value.zCoordinate.value = C2xGetTokenInt(packetHandle, "DENM", newPath);
    result = CheckLastError("DENM", gkFuncRefGet, result);
  }
  return result;
}

int SetDENMCartesianPosition3dParams(LONG packetHandle, struct DENMCartesianPosition3d value, char oldPath[])
{
  char newPath[300];
  int result;

  result = 0;

  snprintf(newPath, elcount(newPath), "%s.%s", oldPath, "xCoordinate");
  C2xSetTokenInt(packetHandle, "DENM", newPath, value.xCoordinate);
  result = CheckLastError("DENM", gkFuncRefGet, result);

  snprintf(newPath, elcount(newPath), "%s.%s", oldPath, "yCoordinate");
  C2xSetTokenInt(packetHandle, "DENM", newPath, value.yCoordinate);
  result = CheckLastError("DENM", gkFuncRefGet, result);

  snprintf(newPath, elcount(newPath), "%s.%s", oldPath, "zCoordinate");
  if(value.zCoordinate.isValidFlag==1)
  {
    C2xSetTokenInt(packetHandle, "DENM", newPath, value.zCoordinate.value);
    result = CheckLastError("DENM", gkFuncRefGet, result);
  }
  else
  {
    if( C2xIsTokenAvailable(packetHandle, "DENM", newPath) )
    {
      C2xRemoveToken(packetHandle, "DENM", newPath);
    }
  }

  return result;
}

int GetDENMRectangularShapeParams(LONG packetHandle, struct DENMRectangularShape value, char oldPath[])
{
  char newPath[300];
  int result;

  result = 0;

  snprintf(newPath, elcount(newPath), "%s.%s", oldPath, "shapeReferencePoint");
  value.shapeReferencePoint.isValidFlag = C2xIsTokenAvailable(packetHandle, "DENM", newPath);
  if(value.shapeReferencePoint.isValidFlag==1)
  {
    GetDENMCartesianPosition3dParams(packetHandle, value.shapeReferencePoint, newPath);
    result = CheckLastError("DENM", gkFuncRefGet, result);
  }
  snprintf(newPath, elcount(newPath), "%s.%s", oldPath, "semiLength");
  value.semiLength = C2xGetTokenInt(packetHandle, "DENM", newPath);
  result = CheckLastError("DENM", gkFuncRefGet, result);

  snprintf(newPath, elcount(newPath), "%s.%s", oldPath, "semiBreadth");
  value.semiBreadth = C2xGetTokenInt(packetHandle, "DENM", newPath);
  result = CheckLastError("DENM", gkFuncRefGet, result);

  snprintf(newPath, elcount(newPath), "%s.%s", oldPath, "orientation");
  value.orientation.isValidFlag = C2xIsTokenAvailable(packetHandle, "DENM", newPath);
  if(value.orientation.isValidFlag==1)
  {
    value.orientation.value = C2xGetTokenInt(packetHandle, "DENM", newPath);
    result = CheckLastError("DENM", gkFuncRefGet, result);
  }
  snprintf(newPath, elcount(newPath), "%s.%s", oldPath, "height");
  value.height.isValidFlag = C2xIsTokenAvailable(packetHandle, "DENM", newPath);
  if(value.height.isValidFlag==1)
  {
    value.height.value = C2xGetTokenInt(packetHandle, "DENM", newPath);
    result = CheckLastError("DENM", gkFuncRefGet, result);
  }
  return result;
}

int SetDENMRectangularShapeParams(LONG packetHandle, struct DENMRectangularShape value, char oldPath[])
{
  char newPath[300];
  int result;

  result = 0;

  snprintf(newPath, elcount(newPath), "%s.%s", oldPath, "shapeReferencePoint");
  if(value.shapeReferencePoint.isValidFlag==1)
  {
    SetDENMCartesianPosition3dParams(packetHandle, value.shapeReferencePoint, newPath);
    result = CheckLastError("DENM", gkFuncRefGet, result);
  }
  else
  {
    if( C2xIsTokenAvailable(packetHandle, "DENM", newPath) )
    {
      C2xRemoveToken(packetHandle, "DENM", newPath);
    }
  }

  snprintf(newPath, elcount(newPath), "%s.%s", oldPath, "semiLength");
  C2xSetTokenInt(packetHandle, "DENM", newPath, value.semiLength);
  result = CheckLastError("DENM", gkFuncRefGet, result);

  snprintf(newPath, elcount(newPath), "%s.%s", oldPath, "semiBreadth");
  C2xSetTokenInt(packetHandle, "DENM", newPath, value.semiBreadth);
  result = CheckLastError("DENM", gkFuncRefGet, result);

  snprintf(newPath, elcount(newPath), "%s.%s", oldPath, "orientation");
  if(value.orientation.isValidFlag==1)
  {
    C2xSetTokenInt(packetHandle, "DENM", newPath, value.orientation.value);
    result = CheckLastError("DENM", gkFuncRefGet, result);
  }
  else
  {
    if( C2xIsTokenAvailable(packetHandle, "DENM", newPath) )
    {
      C2xRemoveToken(packetHandle, "DENM", newPath);
    }
  }

  snprintf(newPath, elcount(newPath), "%s.%s", oldPath, "height");
  if(value.height.isValidFlag==1)
  {
    C2xSetTokenInt(packetHandle, "DENM", newPath, value.height.value);
    result = CheckLastError("DENM", gkFuncRefGet, result);
  }
  else
  {
    if( C2xIsTokenAvailable(packetHandle, "DENM", newPath) )
    {
      C2xRemoveToken(packetHandle, "DENM", newPath);
    }
  }

  return result;
}

int GetDENMCircularShapeParams(LONG packetHandle, struct DENMCircularShape value, char oldPath[])
{
  char newPath[300];
  int result;

  result = 0;

  snprintf(newPath, elcount(newPath), "%s.%s", oldPath, "shapeReferencePoint");
  value.shapeReferencePoint.isValidFlag = C2xIsTokenAvailable(packetHandle, "DENM", newPath);
  if(value.shapeReferencePoint.isValidFlag==1)
  {
    GetDENMCartesianPosition3dParams(packetHandle, value.shapeReferencePoint, newPath);
    result = CheckLastError("DENM", gkFuncRefGet, result);
  }
  snprintf(newPath, elcount(newPath), "%s.%s", oldPath, "radius");
  value.radius = C2xGetTokenInt(packetHandle, "DENM", newPath);
  result = CheckLastError("DENM", gkFuncRefGet, result);

  snprintf(newPath, elcount(newPath), "%s.%s", oldPath, "height");
  value.height.isValidFlag = C2xIsTokenAvailable(packetHandle, "DENM", newPath);
  if(value.height.isValidFlag==1)
  {
    value.height.value = C2xGetTokenInt(packetHandle, "DENM", newPath);
    result = CheckLastError("DENM", gkFuncRefGet, result);
  }
  return result;
}

int SetDENMCircularShapeParams(LONG packetHandle, struct DENMCircularShape value, char oldPath[])
{
  char newPath[300];
  int result;

  result = 0;

  snprintf(newPath, elcount(newPath), "%s.%s", oldPath, "shapeReferencePoint");
  if(value.shapeReferencePoint.isValidFlag==1)
  {
    SetDENMCartesianPosition3dParams(packetHandle, value.shapeReferencePoint, newPath);
    result = CheckLastError("DENM", gkFuncRefGet, result);
  }
  else
  {
    if( C2xIsTokenAvailable(packetHandle, "DENM", newPath) )
    {
      C2xRemoveToken(packetHandle, "DENM", newPath);
    }
  }

  snprintf(newPath, elcount(newPath), "%s.%s", oldPath, "radius");
  C2xSetTokenInt(packetHandle, "DENM", newPath, value.radius);
  result = CheckLastError("DENM", gkFuncRefGet, result);

  snprintf(newPath, elcount(newPath), "%s.%s", oldPath, "height");
  if(value.height.isValidFlag==1)
  {
    C2xSetTokenInt(packetHandle, "DENM", newPath, value.height.value);
    result = CheckLastError("DENM", gkFuncRefGet, result);
  }
  else
  {
    if( C2xIsTokenAvailable(packetHandle, "DENM", newPath) )
    {
      C2xRemoveToken(packetHandle, "DENM", newPath);
    }
  }

  return result;
}

int GetDENMSequenceOfCartesianPosition3dParams(LONG packetHandle, struct DENMSequenceOfCartesianPosition3d value, char oldPath[])
{
  char newPath[300]; 
  int i;
  int result;

  result = 0;

  value.length = C2xGetTokenInt(packetHandle, "DENM", oldPath);
  if((result = CheckLastError("DENM", gkFuncRefGet, result))==0)
  {
    for(i=0; i<value.length; i++)
    {
      snprintf(newPath, elcount(newPath), "%s[%d]", oldPath, i);
      GetDENMCartesianPosition3dParams(packetHandle, value.arrayValue[i], newPath);
      result = CheckLastError("DENM", gkFuncRefGet, result);
    }
  }
  return result;
}

int SetDENMSequenceOfCartesianPosition3dParams(LONG packetHandle, struct DENMSequenceOfCartesianPosition3d value, char oldPath[])
{
  char newPath[300]; 
  int i;
  int result;

  result = 0;

  C2xRemoveToken(packetHandle, "DENM", oldPath);
  for(i=0; i<value.length; i++)
  {
    snprintf(newPath, elcount(newPath), "%s[%d]", oldPath, i);
    SetDENMCartesianPosition3dParams(packetHandle, value.arrayValue[i], newPath);
    result = CheckLastError("DENM", gkFuncRefGet, result);
  }
  return result;
}

int GetDENMPolygonalShapeParams(LONG packetHandle, struct DENMPolygonalShape value, char oldPath[])
{
  char newPath[300];
  int result;

  result = 0;

  snprintf(newPath, elcount(newPath), "%s.%s", oldPath, "shapeReferencePoint");
  value.shapeReferencePoint.isValidFlag = C2xIsTokenAvailable(packetHandle, "DENM", newPath);
  if(value.shapeReferencePoint.isValidFlag==1)
  {
    GetDENMCartesianPosition3dParams(packetHandle, value.shapeReferencePoint, newPath);
    result = CheckLastError("DENM", gkFuncRefGet, result);
  }
  snprintf(newPath, elcount(newPath), "%s.%s", oldPath, "polygon");
  GetDENMSequenceOfCartesianPosition3dParams(packetHandle, value.polygon, newPath);
  result = CheckLastError("DENM", gkFuncRefGet, result);

  snprintf(newPath, elcount(newPath), "%s.%s", oldPath, "height");
  value.height.isValidFlag = C2xIsTokenAvailable(packetHandle, "DENM", newPath);
  if(value.height.isValidFlag==1)
  {
    value.height.value = C2xGetTokenInt(packetHandle, "DENM", newPath);
    result = CheckLastError("DENM", gkFuncRefGet, result);
  }
  return result;
}

int SetDENMPolygonalShapeParams(LONG packetHandle, struct DENMPolygonalShape value, char oldPath[])
{
  char newPath[300];
  int result;

  result = 0;

  snprintf(newPath, elcount(newPath), "%s.%s", oldPath, "shapeReferencePoint");
  if(value.shapeReferencePoint.isValidFlag==1)
  {
    SetDENMCartesianPosition3dParams(packetHandle, value.shapeReferencePoint, newPath);
    result = CheckLastError("DENM", gkFuncRefGet, result);
  }
  else
  {
    if( C2xIsTokenAvailable(packetHandle, "DENM", newPath) )
    {
      C2xRemoveToken(packetHandle, "DENM", newPath);
    }
  }

  snprintf(newPath, elcount(newPath), "%s.%s", oldPath, "polygon");
  SetDENMSequenceOfCartesianPosition3dParams(packetHandle, value.polygon, newPath);
  result = CheckLastError("DENM", gkFuncRefGet, result);

  snprintf(newPath, elcount(newPath), "%s.%s", oldPath, "height");
  if(value.height.isValidFlag==1)
  {
    C2xSetTokenInt(packetHandle, "DENM", newPath, value.height.value);
    result = CheckLastError("DENM", gkFuncRefGet, result);
  }
  else
  {
    if( C2xIsTokenAvailable(packetHandle, "DENM", newPath) )
    {
      C2xRemoveToken(packetHandle, "DENM", newPath);
    }
  }

  return result;
}

int GetDENMEllipticalShapeParams(LONG packetHandle, struct DENMEllipticalShape value, char oldPath[])
{
  char newPath[300];
  int result;

  result = 0;

  snprintf(newPath, elcount(newPath), "%s.%s", oldPath, "shapeReferencePoint");
  value.shapeReferencePoint.isValidFlag = C2xIsTokenAvailable(packetHandle, "DENM", newPath);
  if(value.shapeReferencePoint.isValidFlag==1)
  {
    GetDENMCartesianPosition3dParams(packetHandle, value.shapeReferencePoint, newPath);
    result = CheckLastError("DENM", gkFuncRefGet, result);
  }
  snprintf(newPath, elcount(newPath), "%s.%s", oldPath, "semiMajorAxisLength");
  value.semiMajorAxisLength = C2xGetTokenInt(packetHandle, "DENM", newPath);
  result = CheckLastError("DENM", gkFuncRefGet, result);

  snprintf(newPath, elcount(newPath), "%s.%s", oldPath, "semiMinorAxisLength");
  value.semiMinorAxisLength = C2xGetTokenInt(packetHandle, "DENM", newPath);
  result = CheckLastError("DENM", gkFuncRefGet, result);

  snprintf(newPath, elcount(newPath), "%s.%s", oldPath, "orientation");
  value.orientation.isValidFlag = C2xIsTokenAvailable(packetHandle, "DENM", newPath);
  if(value.orientation.isValidFlag==1)
  {
    value.orientation.value = C2xGetTokenInt(packetHandle, "DENM", newPath);
    result = CheckLastError("DENM", gkFuncRefGet, result);
  }
  snprintf(newPath, elcount(newPath), "%s.%s", oldPath, "height");
  value.height.isValidFlag = C2xIsTokenAvailable(packetHandle, "DENM", newPath);
  if(value.height.isValidFlag==1)
  {
    value.height.value = C2xGetTokenInt(packetHandle, "DENM", newPath);
    result = CheckLastError("DENM", gkFuncRefGet, result);
  }
  return result;
}

int SetDENMEllipticalShapeParams(LONG packetHandle, struct DENMEllipticalShape value, char oldPath[])
{
  char newPath[300];
  int result;

  result = 0;

  snprintf(newPath, elcount(newPath), "%s.%s", oldPath, "shapeReferencePoint");
  if(value.shapeReferencePoint.isValidFlag==1)
  {
    SetDENMCartesianPosition3dParams(packetHandle, value.shapeReferencePoint, newPath);
    result = CheckLastError("DENM", gkFuncRefGet, result);
  }
  else
  {
    if( C2xIsTokenAvailable(packetHandle, "DENM", newPath) )
    {
      C2xRemoveToken(packetHandle, "DENM", newPath);
    }
  }

  snprintf(newPath, elcount(newPath), "%s.%s", oldPath, "semiMajorAxisLength");
  C2xSetTokenInt(packetHandle, "DENM", newPath, value.semiMajorAxisLength);
  result = CheckLastError("DENM", gkFuncRefGet, result);

  snprintf(newPath, elcount(newPath), "%s.%s", oldPath, "semiMinorAxisLength");
  C2xSetTokenInt(packetHandle, "DENM", newPath, value.semiMinorAxisLength);
  result = CheckLastError("DENM", gkFuncRefGet, result);

  snprintf(newPath, elcount(newPath), "%s.%s", oldPath, "orientation");
  if(value.orientation.isValidFlag==1)
  {
    C2xSetTokenInt(packetHandle, "DENM", newPath, value.orientation.value);
    result = CheckLastError("DENM", gkFuncRefGet, result);
  }
  else
  {
    if( C2xIsTokenAvailable(packetHandle, "DENM", newPath) )
    {
      C2xRemoveToken(packetHandle, "DENM", newPath);
    }
  }

  snprintf(newPath, elcount(newPath), "%s.%s", oldPath, "height");
  if(value.height.isValidFlag==1)
  {
    C2xSetTokenInt(packetHandle, "DENM", newPath, value.height.value);
    result = CheckLastError("DENM", gkFuncRefGet, result);
  }
  else
  {
    if( C2xIsTokenAvailable(packetHandle, "DENM", newPath) )
    {
      C2xRemoveToken(packetHandle, "DENM", newPath);
    }
  }

  return result;
}

int GetDENMRadialShapeParams(LONG packetHandle, struct DENMRadialShape value, char oldPath[])
{
  char newPath[300];
  int result;

  result = 0;

  snprintf(newPath, elcount(newPath), "%s.%s", oldPath, "shapeReferencePoint");
  value.shapeReferencePoint.isValidFlag = C2xIsTokenAvailable(packetHandle, "DENM", newPath);
  if(value.shapeReferencePoint.isValidFlag==1)
  {
    GetDENMCartesianPosition3dParams(packetHandle, value.shapeReferencePoint, newPath);
    result = CheckLastError("DENM", gkFuncRefGet, result);
  }
  snprintf(newPath, elcount(newPath), "%s.%s", oldPath, "range");
  value.range = C2xGetTokenInt(packetHandle, "DENM", newPath);
  result = CheckLastError("DENM", gkFuncRefGet, result);

  snprintf(newPath, elcount(newPath), "%s.%s", oldPath, "horizontalOpeningAngleStart");
  value.horizontalOpeningAngleStart = C2xGetTokenInt(packetHandle, "DENM", newPath);
  result = CheckLastError("DENM", gkFuncRefGet, result);

  snprintf(newPath, elcount(newPath), "%s.%s", oldPath, "horizontalOpeningAngleEnd");
  value.horizontalOpeningAngleEnd = C2xGetTokenInt(packetHandle, "DENM", newPath);
  result = CheckLastError("DENM", gkFuncRefGet, result);

  snprintf(newPath, elcount(newPath), "%s.%s", oldPath, "verticalOpeningAngleStart");
  value.verticalOpeningAngleStart.isValidFlag = C2xIsTokenAvailable(packetHandle, "DENM", newPath);
  if(value.verticalOpeningAngleStart.isValidFlag==1)
  {
    value.verticalOpeningAngleStart.value = C2xGetTokenInt(packetHandle, "DENM", newPath);
    result = CheckLastError("DENM", gkFuncRefGet, result);
  }
  snprintf(newPath, elcount(newPath), "%s.%s", oldPath, "verticalOpeningAngleEnd");
  value.verticalOpeningAngleEnd.isValidFlag = C2xIsTokenAvailable(packetHandle, "DENM", newPath);
  if(value.verticalOpeningAngleEnd.isValidFlag==1)
  {
    value.verticalOpeningAngleEnd.value = C2xGetTokenInt(packetHandle, "DENM", newPath);
    result = CheckLastError("DENM", gkFuncRefGet, result);
  }
  return result;
}

int SetDENMRadialShapeParams(LONG packetHandle, struct DENMRadialShape value, char oldPath[])
{
  char newPath[300];
  int result;

  result = 0;

  snprintf(newPath, elcount(newPath), "%s.%s", oldPath, "shapeReferencePoint");
  if(value.shapeReferencePoint.isValidFlag==1)
  {
    SetDENMCartesianPosition3dParams(packetHandle, value.shapeReferencePoint, newPath);
    result = CheckLastError("DENM", gkFuncRefGet, result);
  }
  else
  {
    if( C2xIsTokenAvailable(packetHandle, "DENM", newPath) )
    {
      C2xRemoveToken(packetHandle, "DENM", newPath);
    }
  }

  snprintf(newPath, elcount(newPath), "%s.%s", oldPath, "range");
  C2xSetTokenInt(packetHandle, "DENM", newPath, value.range);
  result = CheckLastError("DENM", gkFuncRefGet, result);

  snprintf(newPath, elcount(newPath), "%s.%s", oldPath, "horizontalOpeningAngleStart");
  C2xSetTokenInt(packetHandle, "DENM", newPath, value.horizontalOpeningAngleStart);
  result = CheckLastError("DENM", gkFuncRefGet, result);

  snprintf(newPath, elcount(newPath), "%s.%s", oldPath, "horizontalOpeningAngleEnd");
  C2xSetTokenInt(packetHandle, "DENM", newPath, value.horizontalOpeningAngleEnd);
  result = CheckLastError("DENM", gkFuncRefGet, result);

  snprintf(newPath, elcount(newPath), "%s.%s", oldPath, "verticalOpeningAngleStart");
  if(value.verticalOpeningAngleStart.isValidFlag==1)
  {
    C2xSetTokenInt(packetHandle, "DENM", newPath, value.verticalOpeningAngleStart.value);
    result = CheckLastError("DENM", gkFuncRefGet, result);
  }
  else
  {
    if( C2xIsTokenAvailable(packetHandle, "DENM", newPath) )
    {
      C2xRemoveToken(packetHandle, "DENM", newPath);
    }
  }

  snprintf(newPath, elcount(newPath), "%s.%s", oldPath, "verticalOpeningAngleEnd");
  if(value.verticalOpeningAngleEnd.isValidFlag==1)
  {
    C2xSetTokenInt(packetHandle, "DENM", newPath, value.verticalOpeningAngleEnd.value);
    result = CheckLastError("DENM", gkFuncRefGet, result);
  }
  else
  {
    if( C2xIsTokenAvailable(packetHandle, "DENM", newPath) )
    {
      C2xRemoveToken(packetHandle, "DENM", newPath);
    }
  }

  return result;
}

int GetDENMRadialShapeDetailsParams(LONG packetHandle, struct DENMRadialShapeDetails value, char oldPath[])
{
  char newPath[300];
  int result;

  result = 0;

  snprintf(newPath, elcount(newPath), "%s.%s", oldPath, "range");
  value.range = C2xGetTokenInt(packetHandle, "DENM", newPath);
  result = CheckLastError("DENM", gkFuncRefGet, result);

  snprintf(newPath, elcount(newPath), "%s.%s", oldPath, "horizontalOpeningAngleStart");
  value.horizontalOpeningAngleStart = C2xGetTokenInt(packetHandle, "DENM", newPath);
  result = CheckLastError("DENM", gkFuncRefGet, result);

  snprintf(newPath, elcount(newPath), "%s.%s", oldPath, "horizontalOpeningAngleEnd");
  value.horizontalOpeningAngleEnd = C2xGetTokenInt(packetHandle, "DENM", newPath);
  result = CheckLastError("DENM", gkFuncRefGet, result);

  snprintf(newPath, elcount(newPath), "%s.%s", oldPath, "verticalOpeningAngleStart");
  value.verticalOpeningAngleStart.isValidFlag = C2xIsTokenAvailable(packetHandle, "DENM", newPath);
  if(value.verticalOpeningAngleStart.isValidFlag==1)
  {
    value.verticalOpeningAngleStart.value = C2xGetTokenInt(packetHandle, "DENM", newPath);
    result = CheckLastError("DENM", gkFuncRefGet, result);
  }
  snprintf(newPath, elcount(newPath), "%s.%s", oldPath, "verticalOpeningAngleEnd");
  value.verticalOpeningAngleEnd.isValidFlag = C2xIsTokenAvailable(packetHandle, "DENM", newPath);
  if(value.verticalOpeningAngleEnd.isValidFlag==1)
  {
    value.verticalOpeningAngleEnd.value = C2xGetTokenInt(packetHandle, "DENM", newPath);
    result = CheckLastError("DENM", gkFuncRefGet, result);
  }
  return result;
}

int SetDENMRadialShapeDetailsParams(LONG packetHandle, struct DENMRadialShapeDetails value, char oldPath[])
{
  char newPath[300];
  int result;

  result = 0;

  snprintf(newPath, elcount(newPath), "%s.%s", oldPath, "range");
  C2xSetTokenInt(packetHandle, "DENM", newPath, value.range);
  result = CheckLastError("DENM", gkFuncRefGet, result);

  snprintf(newPath, elcount(newPath), "%s.%s", oldPath, "horizontalOpeningAngleStart");
  C2xSetTokenInt(packetHandle, "DENM", newPath, value.horizontalOpeningAngleStart);
  result = CheckLastError("DENM", gkFuncRefGet, result);

  snprintf(newPath, elcount(newPath), "%s.%s", oldPath, "horizontalOpeningAngleEnd");
  C2xSetTokenInt(packetHandle, "DENM", newPath, value.horizontalOpeningAngleEnd);
  result = CheckLastError("DENM", gkFuncRefGet, result);

  snprintf(newPath, elcount(newPath), "%s.%s", oldPath, "verticalOpeningAngleStart");
  if(value.verticalOpeningAngleStart.isValidFlag==1)
  {
    C2xSetTokenInt(packetHandle, "DENM", newPath, value.verticalOpeningAngleStart.value);
    result = CheckLastError("DENM", gkFuncRefGet, result);
  }
  else
  {
    if( C2xIsTokenAvailable(packetHandle, "DENM", newPath) )
    {
      C2xRemoveToken(packetHandle, "DENM", newPath);
    }
  }

  snprintf(newPath, elcount(newPath), "%s.%s", oldPath, "verticalOpeningAngleEnd");
  if(value.verticalOpeningAngleEnd.isValidFlag==1)
  {
    C2xSetTokenInt(packetHandle, "DENM", newPath, value.verticalOpeningAngleEnd.value);
    result = CheckLastError("DENM", gkFuncRefGet, result);
  }
  else
  {
    if( C2xIsTokenAvailable(packetHandle, "DENM", newPath) )
    {
      C2xRemoveToken(packetHandle, "DENM", newPath);
    }
  }

  return result;
}

int GetDENMRadialShapesListParams(LONG packetHandle, struct DENMRadialShapesList value, char oldPath[])
{
  char newPath[300]; 
  int i;
  int result;

  result = 0;

  value.length = C2xGetTokenInt(packetHandle, "DENM", oldPath);
  if((result = CheckLastError("DENM", gkFuncRefGet, result))==0)
  {
    for(i=0; i<value.length; i++)
    {
      snprintf(newPath, elcount(newPath), "%s[%d]", oldPath, i);
      GetDENMRadialShapeDetailsParams(packetHandle, value.arrayValue[i], newPath);
      result = CheckLastError("DENM", gkFuncRefGet, result);
    }
  }
  return result;
}

int SetDENMRadialShapesListParams(LONG packetHandle, struct DENMRadialShapesList value, char oldPath[])
{
  char newPath[300]; 
  int i;
  int result;

  result = 0;

  C2xRemoveToken(packetHandle, "DENM", oldPath);
  for(i=0; i<value.length; i++)
  {
    snprintf(newPath, elcount(newPath), "%s[%d]", oldPath, i);
    SetDENMRadialShapeDetailsParams(packetHandle, value.arrayValue[i], newPath);
    result = CheckLastError("DENM", gkFuncRefGet, result);
  }
  return result;
}

int GetDENMRadialShapesParams(LONG packetHandle, struct DENMRadialShapes value, char oldPath[])
{
  char newPath[300];
  int result;

  result = 0;

  snprintf(newPath, elcount(newPath), "%s.%s", oldPath, "refPointId");
  value.refPointId = C2xGetTokenInt(packetHandle, "DENM", newPath);
  result = CheckLastError("DENM", gkFuncRefGet, result);

  snprintf(newPath, elcount(newPath), "%s.%s", oldPath, "xCoordinate");
  value.xCoordinate = C2xGetTokenInt(packetHandle, "DENM", newPath);
  result = CheckLastError("DENM", gkFuncRefGet, result);

  snprintf(newPath, elcount(newPath), "%s.%s", oldPath, "yCoordinate");
  value.yCoordinate = C2xGetTokenInt(packetHandle, "DENM", newPath);
  result = CheckLastError("DENM", gkFuncRefGet, result);

  snprintf(newPath, elcount(newPath), "%s.%s", oldPath, "zCoordinate");
  value.zCoordinate.isValidFlag = C2xIsTokenAvailable(packetHandle, "DENM", newPath);
  if(value.zCoordinate.isValidFlag==1)
  {
    value.zCoordinate.value = C2xGetTokenInt(packetHandle, "DENM", newPath);
    result = CheckLastError("DENM", gkFuncRefGet, result);
  }
  snprintf(newPath, elcount(newPath), "%s.%s", oldPath, "radialShapesList");
  GetDENMRadialShapesListParams(packetHandle, value.radialShapesList, newPath);
  result = CheckLastError("DENM", gkFuncRefGet, result);

  return result;
}

int SetDENMRadialShapesParams(LONG packetHandle, struct DENMRadialShapes value, char oldPath[])
{
  char newPath[300];
  int result;

  result = 0;

  snprintf(newPath, elcount(newPath), "%s.%s", oldPath, "refPointId");
  C2xSetTokenInt(packetHandle, "DENM", newPath, value.refPointId);
  result = CheckLastError("DENM", gkFuncRefGet, result);

  snprintf(newPath, elcount(newPath), "%s.%s", oldPath, "xCoordinate");
  C2xSetTokenInt(packetHandle, "DENM", newPath, value.xCoordinate);
  result = CheckLastError("DENM", gkFuncRefGet, result);

  snprintf(newPath, elcount(newPath), "%s.%s", oldPath, "yCoordinate");
  C2xSetTokenInt(packetHandle, "DENM", newPath, value.yCoordinate);
  result = CheckLastError("DENM", gkFuncRefGet, result);

  snprintf(newPath, elcount(newPath), "%s.%s", oldPath, "zCoordinate");
  if(value.zCoordinate.isValidFlag==1)
  {
    C2xSetTokenInt(packetHandle, "DENM", newPath, value.zCoordinate.value);
    result = CheckLastError("DENM", gkFuncRefGet, result);
  }
  else
  {
    if( C2xIsTokenAvailable(packetHandle, "DENM", newPath) )
    {
      C2xRemoveToken(packetHandle, "DENM", newPath);
    }
  }

  snprintf(newPath, elcount(newPath), "%s.%s", oldPath, "radialShapesList");
  SetDENMRadialShapesListParams(packetHandle, value.radialShapesList, newPath);
  result = CheckLastError("DENM", gkFuncRefGet, result);

  return result;
}

int GetDENMShapeParams(LONG packetHandle, struct DENMShape value, char oldPath[])
{
  char newPath[300];
  int result;

  result = 0;

  value.choice = C2xGetTokenInt(packetHandle, "DENM", oldPath);

  switch(value.choice)
  {
    case 0:
    {
      snprintf(newPath, elcount(newPath), "%s.%s", oldPath, "rectangular");
      GetDENMRectangularShapeParams(packetHandle, value.rectangular, newPath);
      result = CheckLastError("DENM", gkFuncRefGet, result);
    }
    break;
    case 1:
    {
      snprintf(newPath, elcount(newPath), "%s.%s", oldPath, "circular");
      GetDENMCircularShapeParams(packetHandle, value.circular, newPath);
      result = CheckLastError("DENM", gkFuncRefGet, result);
    }
    break;
    case 2:
    {
      snprintf(newPath, elcount(newPath), "%s.%s", oldPath, "polygonal");
      GetDENMPolygonalShapeParams(packetHandle, value.polygonal, newPath);
      result = CheckLastError("DENM", gkFuncRefGet, result);
    }
    break;
    case 3:
    {
      snprintf(newPath, elcount(newPath), "%s.%s", oldPath, "elliptical");
      GetDENMEllipticalShapeParams(packetHandle, value.elliptical, newPath);
      result = CheckLastError("DENM", gkFuncRefGet, result);
    }
    break;
    case 4:
    {
      snprintf(newPath, elcount(newPath), "%s.%s", oldPath, "radial");
      GetDENMRadialShapeParams(packetHandle, value.radial, newPath);
      result = CheckLastError("DENM", gkFuncRefGet, result);
    }
    break;
    case 5:
    {
      snprintf(newPath, elcount(newPath), "%s.%s", oldPath, "radialShapes");
      GetDENMRadialShapesParams(packetHandle, value.radialShapes, newPath);
      result = CheckLastError("DENM", gkFuncRefGet, result);
    }
    break;
  }
  return result;
}

int SetDENMShapeParams(LONG packetHandle, struct DENMShape value, char oldPath[])
{
  char newPath[300];
  int result;

  result = 0;

  switch(value.choice)
  {
    case 0:
    {
      snprintf(newPath, elcount(newPath), "%s.%s", oldPath, "rectangular");
      SetDENMRectangularShapeParams(packetHandle, value.rectangular, newPath);
      result = CheckLastError("DENM", gkFuncRefGet, result);
    }
    break;
    case 1:
    {
      snprintf(newPath, elcount(newPath), "%s.%s", oldPath, "circular");
      SetDENMCircularShapeParams(packetHandle, value.circular, newPath);
      result = CheckLastError("DENM", gkFuncRefGet, result);
    }
    break;
    case 2:
    {
      snprintf(newPath, elcount(newPath), "%s.%s", oldPath, "polygonal");
      SetDENMPolygonalShapeParams(packetHandle, value.polygonal, newPath);
      result = CheckLastError("DENM", gkFuncRefGet, result);
    }
    break;
    case 3:
    {
      snprintf(newPath, elcount(newPath), "%s.%s", oldPath, "elliptical");
      SetDENMEllipticalShapeParams(packetHandle, value.elliptical, newPath);
      result = CheckLastError("DENM", gkFuncRefGet, result);
    }
    break;
    case 4:
    {
      snprintf(newPath, elcount(newPath), "%s.%s", oldPath, "radial");
      SetDENMRadialShapeParams(packetHandle, value.radial, newPath);
      result = CheckLastError("DENM", gkFuncRefGet, result);
    }
    break;
    case 5:
    {
      snprintf(newPath, elcount(newPath), "%s.%s", oldPath, "radialShapes");
      SetDENMRadialShapesParams(packetHandle, value.radialShapes, newPath);
      result = CheckLastError("DENM", gkFuncRefGet, result);
    }
    break;
  }
  return result;
}

int GetDENMVruClusterInformationParams(LONG packetHandle, struct DENMVruClusterInformation value, char oldPath[])
{
  char newPath[300]; 
  int j; 
  int k;
  int result;

  result = 0;

  snprintf(newPath, elcount(newPath), "%s.%s", oldPath, "clusterId");
  value.clusterId.isValidFlag = C2xIsTokenAvailable(packetHandle, "DENM", newPath);
  if(value.clusterId.isValidFlag==1)
  {
    value.clusterId.value = C2xGetTokenInt(packetHandle, "DENM", newPath);
    result = CheckLastError("DENM", gkFuncRefGet, result);
  }
  snprintf(newPath, elcount(newPath), "%s.%s", oldPath, "clusterBoundingBoxShape");
  value.clusterBoundingBoxShape.isValidFlag = C2xIsTokenAvailable(packetHandle, "DENM", newPath);
  if(value.clusterBoundingBoxShape.isValidFlag==1)
  {
    GetDENMShapeParams(packetHandle, value.clusterBoundingBoxShape, newPath);
    result = CheckLastError("DENM", gkFuncRefGet, result);
  }
  snprintf(newPath, elcount(newPath), "%s.%s", oldPath, "clusterCardinalitySize");
  value.clusterCardinalitySize = C2xGetTokenInt(packetHandle, "DENM", newPath);
  result = CheckLastError("DENM", gkFuncRefGet, result);

  snprintf(newPath, elcount(newPath), "%s.%s", oldPath, "clusterProfiles");
  value.clusterProfiles.isValidFlag = C2xIsTokenAvailable(packetHandle, "DENM", newPath);
  if(value.clusterProfiles.isValidFlag==1)
  {
    value.clusterProfiles.isValidFlag = 1;
    value.clusterProfiles.stringLength = C2xGetTokenLengthBit(packetHandle, "DENM", newPath);
    if ((result = CheckLastError("DENM", gkFuncRefGet, result))==0)
    {
      if(value.clusterProfiles.stringLength > 0)
      {
        for(j=0; j<value.clusterProfiles.stringLength; j++)
        {
          if(C2xGetTokenBitOfBitString(packetHandle, "DENM", newPath, j) == 0)
          {
            value.clusterProfiles.string[j] = '0';
          }
          else if(C2xGetTokenBitOfBitString(packetHandle, "DENM", newPath, j) == 1)
          {
            value.clusterProfiles.string[j] = '1';
          }

          if(value.clusterProfiles.stringLength == 1)
          {
            value.clusterProfiles.string[1] = '0';
          }
          result = CheckLastError("DENM", gkFuncRefGet, result);
        }
      }
      else
      {
        for(k = value.clusterProfiles.stringLength+1; k > -1; k--)
        {
          if(value.clusterProfiles.string[k] == '1')
          {
            value.clusterProfiles.string[k] = '0';
          }
        }
      }
    }

  }
  return result;
}

int SetDENMVruClusterInformationParams(LONG packetHandle, struct DENMVruClusterInformation value, char oldPath[])
{
  char newPath[300]; 
  int j;
  int result;

  result = 0;

  snprintf(newPath, elcount(newPath), "%s.%s", oldPath, "clusterId");
  if(value.clusterId.isValidFlag==1)
  {
    C2xSetTokenInt(packetHandle, "DENM", newPath, value.clusterId.value);
    result = CheckLastError("DENM", gkFuncRefGet, result);
  }
  else
  {
    if( C2xIsTokenAvailable(packetHandle, "DENM", newPath) )
    {
      C2xRemoveToken(packetHandle, "DENM", newPath);
    }
  }

  snprintf(newPath, elcount(newPath), "%s.%s", oldPath, "clusterBoundingBoxShape");
  if(value.clusterBoundingBoxShape.isValidFlag==1)
  {
    SetDENMShapeParams(packetHandle, value.clusterBoundingBoxShape, newPath);
    result = CheckLastError("DENM", gkFuncRefGet, result);
  }
  else
  {
    if( C2xIsTokenAvailable(packetHandle, "DENM", newPath) )
    {
      C2xRemoveToken(packetHandle, "DENM", newPath);
    }
  }

  snprintf(newPath, elcount(newPath), "%s.%s", oldPath, "clusterCardinalitySize");
  C2xSetTokenInt(packetHandle, "DENM", newPath, value.clusterCardinalitySize);
  result = CheckLastError("DENM", gkFuncRefGet, result);

  snprintf(newPath, elcount(newPath), "%s.%s", oldPath, "clusterProfiles");
  if(value.clusterProfiles.isValidFlag==1)
  {
      for(j=0; j<value.clusterProfiles.stringLength; j++)
      {
        if(value.clusterProfiles.string[j] == '0')
        {
          C2xSetTokenBitOfBitString(packetHandle, "DENM", newPath, j, 0);
        }
        else
        {
          C2xSetTokenBitOfBitString(packetHandle, "DENM", newPath, j, 1);
        }
        result = CheckLastError("DENM", gkFuncRefGet, result);
      }
  }
  else
  {
    if( C2xIsTokenAvailable(packetHandle, "DENM", newPath) )
    {
      C2xRemoveToken(packetHandle, "DENM", newPath);
    }
  }

  return result;
}

int GetDENMObjectClassParams(LONG packetHandle, struct DENMObjectClass value, char oldPath[])
{
  char newPath[300];
  int result;

  result = 0;

  value.choice = C2xGetTokenInt(packetHandle, "DENM", oldPath);

  switch(value.choice)
  {
    case 0:
    {
      snprintf(newPath, elcount(newPath), "%s.%s", oldPath, "vehicleSubClass");
      value.vehicleSubClass = C2xGetTokenInt(packetHandle, "DENM", newPath);
      result = CheckLastError("DENM", gkFuncRefGet, result);
    }
    break;
    case 1:
    {
      snprintf(newPath, elcount(newPath), "%s.%s", oldPath, "vruSubClass");
      GetDENMVruProfileAndSubprofileParams(packetHandle, value.vruSubClass, newPath);
      result = CheckLastError("DENM", gkFuncRefGet, result);
    }
    break;
    case 2:
    {
      snprintf(newPath, elcount(newPath), "%s.%s", oldPath, "groupSubClass");
      GetDENMVruClusterInformationParams(packetHandle, value.groupSubClass, newPath);
      result = CheckLastError("DENM", gkFuncRefGet, result);
    }
    break;
    case 3:
    {
      snprintf(newPath, elcount(newPath), "%s.%s", oldPath, "otherSubClass");
      value.otherSubClass = C2xGetTokenInt(packetHandle, "DENM", newPath);
      result = CheckLastError("DENM", gkFuncRefGet, result);
    }
    break;
  }
  return result;
}

int SetDENMObjectClassParams(LONG packetHandle, struct DENMObjectClass value, char oldPath[])
{
  char newPath[300];
  int result;

  result = 0;

  switch(value.choice)
  {
    case 0:
    {
      snprintf(newPath, elcount(newPath), "%s.%s", oldPath, "vehicleSubClass");
      C2xSetTokenInt(packetHandle, "DENM", newPath, value.vehicleSubClass);
      result = CheckLastError("DENM", gkFuncRefGet, result);
    }
    break;
    case 1:
    {
      snprintf(newPath, elcount(newPath), "%s.%s", oldPath, "vruSubClass");
      SetDENMVruProfileAndSubprofileParams(packetHandle, value.vruSubClass, newPath);
      result = CheckLastError("DENM", gkFuncRefGet, result);
    }
    break;
    case 2:
    {
      snprintf(newPath, elcount(newPath), "%s.%s", oldPath, "groupSubClass");
      SetDENMVruClusterInformationParams(packetHandle, value.groupSubClass, newPath);
      result = CheckLastError("DENM", gkFuncRefGet, result);
    }
    break;
    case 3:
    {
      snprintf(newPath, elcount(newPath), "%s.%s", oldPath, "otherSubClass");
      C2xSetTokenInt(packetHandle, "DENM", newPath, value.otherSubClass);
      result = CheckLastError("DENM", gkFuncRefGet, result);
    }
    break;
  }
  return result;
}

int GetDENMObjectClassWithConfidenceParams(LONG packetHandle, struct DENMObjectClassWithConfidence value, char oldPath[])
{
  char newPath[300];
  int result;

  result = 0;

  snprintf(newPath, elcount(newPath), "%s.%s", oldPath, "objectClass");
  GetDENMObjectClassParams(packetHandle, value.objectClass, newPath);
  result = CheckLastError("DENM", gkFuncRefGet, result);

  snprintf(newPath, elcount(newPath), "%s.%s", oldPath, "confidence");
  value.confidence = C2xGetTokenInt(packetHandle, "DENM", newPath);
  result = CheckLastError("DENM", gkFuncRefGet, result);

  return result;
}

int SetDENMObjectClassWithConfidenceParams(LONG packetHandle, struct DENMObjectClassWithConfidence value, char oldPath[])
{
  char newPath[300];
  int result;

  result = 0;

  snprintf(newPath, elcount(newPath), "%s.%s", oldPath, "objectClass");
  SetDENMObjectClassParams(packetHandle, value.objectClass, newPath);
  result = CheckLastError("DENM", gkFuncRefGet, result);

  snprintf(newPath, elcount(newPath), "%s.%s", oldPath, "confidence");
  if (value.confidence < 1)
  {
    C2xSetTokenInt(packetHandle, "DENM", newPath, 1);
  }
  else if (value.confidence > 101)
  {
    C2xSetTokenInt(packetHandle, "DENM", newPath, 101);
  }
  else
  {
    C2xSetTokenInt(packetHandle, "DENM", newPath, value.confidence);
  }
  result = CheckLastError("DENM", gkFuncRefGet, result);

  return result;
}

int GetDENMObjectClassDescriptionParams(LONG packetHandle, struct DENMObjectClassDescription value, char oldPath[])
{
  char newPath[300]; 
  int i;
  int result;

  result = 0;

  value.length = C2xGetTokenInt(packetHandle, "DENM", oldPath);
  if((result = CheckLastError("DENM", gkFuncRefGet, result))==0)
  {
    for(i=0; i<value.length; i++)
    {
      snprintf(newPath, elcount(newPath), "%s[%d]", oldPath, i);
      GetDENMObjectClassWithConfidenceParams(packetHandle, value.arrayValue[i], newPath);
      result = CheckLastError("DENM", gkFuncRefGet, result);
    }
  }
  return result;
}

int SetDENMObjectClassDescriptionParams(LONG packetHandle, struct DENMObjectClassDescription value, char oldPath[])
{
  char newPath[300]; 
  int i;
  int result;

  result = 0;

  C2xRemoveToken(packetHandle, "DENM", oldPath);
  for(i=0; i<value.length; i++)
  {
    snprintf(newPath, elcount(newPath), "%s[%d]", oldPath, i);
    SetDENMObjectClassWithConfidenceParams(packetHandle, value.arrayValue[i], newPath);
    result = CheckLastError("DENM", gkFuncRefGet, result);
  }
  return result;
}

int GetDENMPerceivedObjectParams(LONG packetHandle, struct DENMPerceivedObject value, char oldPath[])
{
  char newPath[300];
  int result;

  result = 0;

  snprintf(newPath, elcount(newPath), "%s.%s", oldPath, "objectID");
  value.objectID.isValidFlag = C2xIsTokenAvailable(packetHandle, "DENM", newPath);
  if(value.objectID.isValidFlag==1)
  {
    value.objectID.value = C2xGetTokenInt(packetHandle, "DENM", newPath);
    result = CheckLastError("DENM", gkFuncRefGet, result);
  }
  snprintf(newPath, elcount(newPath), "%s.%s", oldPath, "measurementDeltaTime");
  value.measurementDeltaTime = C2xGetTokenInt(packetHandle, "DENM", newPath);
  result = CheckLastError("DENM", gkFuncRefGet, result);

  snprintf(newPath, elcount(newPath), "%s.%s", oldPath, "position");
  GetDENMCartesianPosition3dWithConfidenceParams(packetHandle, value.position, newPath);
  result = CheckLastError("DENM", gkFuncRefGet, result);

  snprintf(newPath, elcount(newPath), "%s.%s", oldPath, "velocity");
  value.velocity.isValidFlag = C2xIsTokenAvailable(packetHandle, "DENM", newPath);
  if(value.velocity.isValidFlag==1)
  {
    GetDENMVelocity3dWithConfidenceParams(packetHandle, value.velocity, newPath);
    result = CheckLastError("DENM", gkFuncRefGet, result);
  }
  snprintf(newPath, elcount(newPath), "%s.%s", oldPath, "acceleration");
  value.acceleration.isValidFlag = C2xIsTokenAvailable(packetHandle, "DENM", newPath);
  if(value.acceleration.isValidFlag==1)
  {
    GetDENMAcceleration3dWithConfidenceParams(packetHandle, value.acceleration, newPath);
    result = CheckLastError("DENM", gkFuncRefGet, result);
  }
  snprintf(newPath, elcount(newPath), "%s.%s", oldPath, "angles");
  value.angles.isValidFlag = C2xIsTokenAvailable(packetHandle, "DENM", newPath);
  if(value.angles.isValidFlag==1)
  {
    GetDENMEulerAnglesWithConfidenceParams(packetHandle, value.angles, newPath);
    result = CheckLastError("DENM", gkFuncRefGet, result);
  }
  snprintf(newPath, elcount(newPath), "%s.%s", oldPath, "zAngularVelocity");
  value.zAngularVelocity.isValidFlag = C2xIsTokenAvailable(packetHandle, "DENM", newPath);
  if(value.zAngularVelocity.isValidFlag==1)
  {
    GetDENMCartesianAngularVelocityComponentParams(packetHandle, value.zAngularVelocity, newPath);
    result = CheckLastError("DENM", gkFuncRefGet, result);
  }
  snprintf(newPath, elcount(newPath), "%s.%s", oldPath, "lowerTriangularCorrelationMatrices");
  value.lowerTriangularCorrelationMatrices.isValidFlag = C2xIsTokenAvailable(packetHandle, "DENM", newPath);
  if(value.lowerTriangularCorrelationMatrices.isValidFlag==1)
  {
    GetDENMLowerTriangularPositiveSemidefiniteMatricesParams(packetHandle, value.lowerTriangularCorrelationMatrices, newPath);
    result = CheckLastError("DENM", gkFuncRefGet, result);
  }
  snprintf(newPath, elcount(newPath), "%s.%s", oldPath, "objectDimensionZ");
  value.objectDimensionZ.isValidFlag = C2xIsTokenAvailable(packetHandle, "DENM", newPath);
  if(value.objectDimensionZ.isValidFlag==1)
  {
    GetDENMObjectDimensionParams(packetHandle, value.objectDimensionZ, newPath);
    result = CheckLastError("DENM", gkFuncRefGet, result);
  }
  snprintf(newPath, elcount(newPath), "%s.%s", oldPath, "objectDimensionY");
  value.objectDimensionY.isValidFlag = C2xIsTokenAvailable(packetHandle, "DENM", newPath);
  if(value.objectDimensionY.isValidFlag==1)
  {
    GetDENMObjectDimensionParams(packetHandle, value.objectDimensionY, newPath);
    result = CheckLastError("DENM", gkFuncRefGet, result);
  }
  snprintf(newPath, elcount(newPath), "%s.%s", oldPath, "objectDimensionX");
  value.objectDimensionX.isValidFlag = C2xIsTokenAvailable(packetHandle, "DENM", newPath);
  if(value.objectDimensionX.isValidFlag==1)
  {
    GetDENMObjectDimensionParams(packetHandle, value.objectDimensionX, newPath);
    result = CheckLastError("DENM", gkFuncRefGet, result);
  }
  snprintf(newPath, elcount(newPath), "%s.%s", oldPath, "objectAge");
  value.objectAge.isValidFlag = C2xIsTokenAvailable(packetHandle, "DENM", newPath);
  if(value.objectAge.isValidFlag==1)
  {
    value.objectAge.value = C2xGetTokenInt(packetHandle, "DENM", newPath);
    result = CheckLastError("DENM", gkFuncRefGet, result);
  }
  snprintf(newPath, elcount(newPath), "%s.%s", oldPath, "objectPerceptionQuality");
  value.objectPerceptionQuality.isValidFlag = C2xIsTokenAvailable(packetHandle, "DENM", newPath);
  if(value.objectPerceptionQuality.isValidFlag==1)
  {
    value.objectPerceptionQuality.value = C2xGetTokenInt(packetHandle, "DENM", newPath);
    result = CheckLastError("DENM", gkFuncRefGet, result);
  }
  snprintf(newPath, elcount(newPath), "%s.%s", oldPath, "sensorIdList");
  value.sensorIdList.isValidFlag = C2xIsTokenAvailable(packetHandle, "DENM", newPath);
  if(value.sensorIdList.isValidFlag==1)
  {
    GetDENMSequenceOfIdentifier1BParams(packetHandle, value.sensorIdList, newPath);
    result = CheckLastError("DENM", gkFuncRefGet, result);
  }
  snprintf(newPath, elcount(newPath), "%s.%s", oldPath, "classification");
  value.classification.isValidFlag = C2xIsTokenAvailable(packetHandle, "DENM", newPath);
  if(value.classification.isValidFlag==1)
  {
    GetDENMObjectClassDescriptionParams(packetHandle, value.classification, newPath);
    result = CheckLastError("DENM", gkFuncRefGet, result);
  }
  snprintf(newPath, elcount(newPath), "%s.%s", oldPath, "mapPosition");
  value.mapPosition.isValidFlag = C2xIsTokenAvailable(packetHandle, "DENM", newPath);
  if(value.mapPosition.isValidFlag==1)
  {
    GetDENMMapPositionParams(packetHandle, value.mapPosition, newPath);
    result = CheckLastError("DENM", gkFuncRefGet, result);
  }
  return result;
}

int SetDENMPerceivedObjectParams(LONG packetHandle, struct DENMPerceivedObject value, char oldPath[])
{
  char newPath[300];
  int result;

  result = 0;

  snprintf(newPath, elcount(newPath), "%s.%s", oldPath, "objectID");
  if(value.objectID.isValidFlag==1)
  {
    C2xSetTokenInt(packetHandle, "DENM", newPath, value.objectID.value);
    result = CheckLastError("DENM", gkFuncRefGet, result);
  }
  else
  {
    if( C2xIsTokenAvailable(packetHandle, "DENM", newPath) )
    {
      C2xRemoveToken(packetHandle, "DENM", newPath);
    }
  }

  snprintf(newPath, elcount(newPath), "%s.%s", oldPath, "measurementDeltaTime");
  C2xSetTokenInt(packetHandle, "DENM", newPath, value.measurementDeltaTime);
  result = CheckLastError("DENM", gkFuncRefGet, result);

  snprintf(newPath, elcount(newPath), "%s.%s", oldPath, "position");
  SetDENMCartesianPosition3dWithConfidenceParams(packetHandle, value.position, newPath);
  result = CheckLastError("DENM", gkFuncRefGet, result);

  snprintf(newPath, elcount(newPath), "%s.%s", oldPath, "velocity");
  if(value.velocity.isValidFlag==1)
  {
    SetDENMVelocity3dWithConfidenceParams(packetHandle, value.velocity, newPath);
    result = CheckLastError("DENM", gkFuncRefGet, result);
  }
  else
  {
    if( C2xIsTokenAvailable(packetHandle, "DENM", newPath) )
    {
      C2xRemoveToken(packetHandle, "DENM", newPath);
    }
  }

  snprintf(newPath, elcount(newPath), "%s.%s", oldPath, "acceleration");
  if(value.acceleration.isValidFlag==1)
  {
    SetDENMAcceleration3dWithConfidenceParams(packetHandle, value.acceleration, newPath);
    result = CheckLastError("DENM", gkFuncRefGet, result);
  }
  else
  {
    if( C2xIsTokenAvailable(packetHandle, "DENM", newPath) )
    {
      C2xRemoveToken(packetHandle, "DENM", newPath);
    }
  }

  snprintf(newPath, elcount(newPath), "%s.%s", oldPath, "angles");
  if(value.angles.isValidFlag==1)
  {
    SetDENMEulerAnglesWithConfidenceParams(packetHandle, value.angles, newPath);
    result = CheckLastError("DENM", gkFuncRefGet, result);
  }
  else
  {
    if( C2xIsTokenAvailable(packetHandle, "DENM", newPath) )
    {
      C2xRemoveToken(packetHandle, "DENM", newPath);
    }
  }

  snprintf(newPath, elcount(newPath), "%s.%s", oldPath, "zAngularVelocity");
  if(value.zAngularVelocity.isValidFlag==1)
  {
    SetDENMCartesianAngularVelocityComponentParams(packetHandle, value.zAngularVelocity, newPath);
    result = CheckLastError("DENM", gkFuncRefGet, result);
  }
  else
  {
    if( C2xIsTokenAvailable(packetHandle, "DENM", newPath) )
    {
      C2xRemoveToken(packetHandle, "DENM", newPath);
    }
  }

  snprintf(newPath, elcount(newPath), "%s.%s", oldPath, "lowerTriangularCorrelationMatrices");
  if(value.lowerTriangularCorrelationMatrices.isValidFlag==1)
  {
    SetDENMLowerTriangularPositiveSemidefiniteMatricesParams(packetHandle, value.lowerTriangularCorrelationMatrices, newPath);
    result = CheckLastError("DENM", gkFuncRefGet, result);
  }
  else
  {
    if( C2xIsTokenAvailable(packetHandle, "DENM", newPath) )
    {
      C2xRemoveToken(packetHandle, "DENM", newPath);
    }
  }

  snprintf(newPath, elcount(newPath), "%s.%s", oldPath, "objectDimensionZ");
  if(value.objectDimensionZ.isValidFlag==1)
  {
    SetDENMObjectDimensionParams(packetHandle, value.objectDimensionZ, newPath);
    result = CheckLastError("DENM", gkFuncRefGet, result);
  }
  else
  {
    if( C2xIsTokenAvailable(packetHandle, "DENM", newPath) )
    {
      C2xRemoveToken(packetHandle, "DENM", newPath);
    }
  }

  snprintf(newPath, elcount(newPath), "%s.%s", oldPath, "objectDimensionY");
  if(value.objectDimensionY.isValidFlag==1)
  {
    SetDENMObjectDimensionParams(packetHandle, value.objectDimensionY, newPath);
    result = CheckLastError("DENM", gkFuncRefGet, result);
  }
  else
  {
    if( C2xIsTokenAvailable(packetHandle, "DENM", newPath) )
    {
      C2xRemoveToken(packetHandle, "DENM", newPath);
    }
  }

  snprintf(newPath, elcount(newPath), "%s.%s", oldPath, "objectDimensionX");
  if(value.objectDimensionX.isValidFlag==1)
  {
    SetDENMObjectDimensionParams(packetHandle, value.objectDimensionX, newPath);
    result = CheckLastError("DENM", gkFuncRefGet, result);
  }
  else
  {
    if( C2xIsTokenAvailable(packetHandle, "DENM", newPath) )
    {
      C2xRemoveToken(packetHandle, "DENM", newPath);
    }
  }

  snprintf(newPath, elcount(newPath), "%s.%s", oldPath, "objectAge");
  if(value.objectAge.isValidFlag==1)
  {
    C2xSetTokenInt(packetHandle, "DENM", newPath, value.objectAge.value);
    result = CheckLastError("DENM", gkFuncRefGet, result);
  }
  else
  {
    if( C2xIsTokenAvailable(packetHandle, "DENM", newPath) )
    {
      C2xRemoveToken(packetHandle, "DENM", newPath);
    }
  }

  snprintf(newPath, elcount(newPath), "%s.%s", oldPath, "objectPerceptionQuality");
  if(value.objectPerceptionQuality.isValidFlag==1)
  {
    C2xSetTokenInt(packetHandle, "DENM", newPath, value.objectPerceptionQuality.value);
    result = CheckLastError("DENM", gkFuncRefGet, result);
  }
  else
  {
    if( C2xIsTokenAvailable(packetHandle, "DENM", newPath) )
    {
      C2xRemoveToken(packetHandle, "DENM", newPath);
    }
  }

  snprintf(newPath, elcount(newPath), "%s.%s", oldPath, "sensorIdList");
  if(value.sensorIdList.isValidFlag==1)
  {
    SetDENMSequenceOfIdentifier1BParams(packetHandle, value.sensorIdList, newPath);
    result = CheckLastError("DENM", gkFuncRefGet, result);
  }
  else
  {
    if( C2xIsTokenAvailable(packetHandle, "DENM", newPath) )
    {
      C2xRemoveToken(packetHandle, "DENM", newPath);
    }
  }

  snprintf(newPath, elcount(newPath), "%s.%s", oldPath, "classification");
  if(value.classification.isValidFlag==1)
  {
    SetDENMObjectClassDescriptionParams(packetHandle, value.classification, newPath);
    result = CheckLastError("DENM", gkFuncRefGet, result);
  }
  else
  {
    if( C2xIsTokenAvailable(packetHandle, "DENM", newPath) )
    {
      C2xRemoveToken(packetHandle, "DENM", newPath);
    }
  }

  snprintf(newPath, elcount(newPath), "%s.%s", oldPath, "mapPosition");
  if(value.mapPosition.isValidFlag==1)
  {
    SetDENMMapPositionParams(packetHandle, value.mapPosition, newPath);
    result = CheckLastError("DENM", gkFuncRefGet, result);
  }
  else
  {
    if( C2xIsTokenAvailable(packetHandle, "DENM", newPath) )
    {
      C2xRemoveToken(packetHandle, "DENM", newPath);
    }
  }

  return result;
}

int GetDENMPreCrashContainerParams(LONG packetHandle, struct DENMPreCrashContainer value, char oldPath[])
{
  char newPath[300];
  int result;

  result = 0;

  snprintf(newPath, elcount(newPath), "%s.%s", oldPath, "perceivedPreCrashObject");
  GetDENMPerceivedObjectParams(packetHandle, value.perceivedPreCrashObject, newPath);
  result = CheckLastError("DENM", gkFuncRefGet, result);

  snprintf(newPath, elcount(newPath), "%s.%s", oldPath, "objectStationId");
  value.objectStationId.isValidFlag = C2xIsTokenAvailable(packetHandle, "DENM", newPath);
  if(value.objectStationId.isValidFlag==1)
  {
    value.objectStationId.value = C2xGetTokenInt64(packetHandle, "DENM", newPath);
    result = CheckLastError("DENM", gkFuncRefGet, result);
  }
  snprintf(newPath, elcount(newPath), "%s.%s", oldPath, "timeToCollision");
  value.timeToCollision.isValidFlag = C2xIsTokenAvailable(packetHandle, "DENM", newPath);
  if(value.timeToCollision.isValidFlag==1)
  {
    value.timeToCollision.value = C2xGetTokenInt(packetHandle, "DENM", newPath);
    result = CheckLastError("DENM", gkFuncRefGet, result);
  }
  snprintf(newPath, elcount(newPath), "%s.%s", oldPath, "impactSection");
  value.impactSection.isValidFlag = C2xIsTokenAvailable(packetHandle, "DENM", newPath);
  if(value.impactSection.isValidFlag==1)
  {
    value.impactSection.value = C2xGetTokenInt(packetHandle, "DENM", newPath);
    result = CheckLastError("DENM", gkFuncRefGet, result);
  }
  snprintf(newPath, elcount(newPath), "%s.%s", oldPath, "estimatedBrakingDistance");
  value.estimatedBrakingDistance.isValidFlag = C2xIsTokenAvailable(packetHandle, "DENM", newPath);
  if(value.estimatedBrakingDistance.isValidFlag==1)
  {
    value.estimatedBrakingDistance.value = C2xGetTokenInt(packetHandle, "DENM", newPath);
    result = CheckLastError("DENM", gkFuncRefGet, result);
  }
  return result;
}

int SetDENMPreCrashContainerParams(LONG packetHandle, struct DENMPreCrashContainer value, char oldPath[])
{
  char newPath[300];
  int result;

  result = 0;

  snprintf(newPath, elcount(newPath), "%s.%s", oldPath, "perceivedPreCrashObject");
  SetDENMPerceivedObjectParams(packetHandle, value.perceivedPreCrashObject, newPath);
  result = CheckLastError("DENM", gkFuncRefGet, result);

  snprintf(newPath, elcount(newPath), "%s.%s", oldPath, "objectStationId");
  if(value.objectStationId.isValidFlag==1)
  {
    C2xSetTokenInt64(packetHandle, "DENM", newPath, value.objectStationId.value);
    result = CheckLastError("DENM", gkFuncRefGet, result);
  }
  else
  {
    if( C2xIsTokenAvailable(packetHandle, "DENM", newPath) )
    {
      C2xRemoveToken(packetHandle, "DENM", newPath);
    }
  }

  snprintf(newPath, elcount(newPath), "%s.%s", oldPath, "timeToCollision");
  if(value.timeToCollision.isValidFlag==1)
  {
    if (value.timeToCollision.value < 1)
    {
        C2xSetTokenInt(packetHandle, "DENM", newPath, 1);
    }
    else if (value.timeToCollision.value > 10000)
    {
        C2xSetTokenInt(packetHandle, "DENM", newPath, 10000);
    }
    else
    {
        C2xSetTokenInt(packetHandle, "DENM", newPath, value.timeToCollision.value);
    }
    result = CheckLastError("DENM", gkFuncRefGet, result);
  }
  else
  {
    if( C2xIsTokenAvailable(packetHandle, "DENM", newPath) )
    {
      C2xRemoveToken(packetHandle, "DENM", newPath);
    }
  }

  snprintf(newPath, elcount(newPath), "%s.%s", oldPath, "impactSection");
  if(value.impactSection.isValidFlag==1)
  {
    C2xSetTokenInt(packetHandle, "DENM", newPath, value.impactSection.value);
    result = CheckLastError("DENM", gkFuncRefGet, result);
  }
  else
  {
    if( C2xIsTokenAvailable(packetHandle, "DENM", newPath) )
    {
      C2xRemoveToken(packetHandle, "DENM", newPath);
    }
  }

  snprintf(newPath, elcount(newPath), "%s.%s", oldPath, "estimatedBrakingDistance");
  if(value.estimatedBrakingDistance.isValidFlag==1)
  {
    C2xSetTokenInt(packetHandle, "DENM", newPath, value.estimatedBrakingDistance.value);
    result = CheckLastError("DENM", gkFuncRefGet, result);
  }
  else
  {
    if( C2xIsTokenAvailable(packetHandle, "DENM", newPath) )
    {
      C2xRemoveToken(packetHandle, "DENM", newPath);
    }
  }

  return result;
}

int GetDENMAlacarteContainerParams(LONG packetHandle, struct DENMAlacarteContainer value, char oldPath[])
{
  char newPath[300];
  int result;

  result = 0;

  snprintf(newPath, elcount(newPath), "%s.%s", oldPath, "lanePosition");
  value.lanePosition.isValidFlag = C2xIsTokenAvailable(packetHandle, "DENM", newPath);
  if(value.lanePosition.isValidFlag==1)
  {
    value.lanePosition.value = C2xGetTokenInt(packetHandle, "DENM", newPath);
    result = CheckLastError("DENM", gkFuncRefGet, result);
  }
  snprintf(newPath, elcount(newPath), "%s.%s", oldPath, "impactReduction");
  value.impactReduction.isValidFlag = C2xIsTokenAvailable(packetHandle, "DENM", newPath);
  if(value.impactReduction.isValidFlag==1)
  {
    GetDENMImpactReductionContainerParams(packetHandle, value.impactReduction, newPath);
    result = CheckLastError("DENM", gkFuncRefGet, result);
  }
  snprintf(newPath, elcount(newPath), "%s.%s", oldPath, "externalTemperature");
  value.externalTemperature.isValidFlag = C2xIsTokenAvailable(packetHandle, "DENM", newPath);
  if(value.externalTemperature.isValidFlag==1)
  {
    value.externalTemperature.value = C2xGetTokenInt(packetHandle, "DENM", newPath);
    result = CheckLastError("DENM", gkFuncRefGet, result);
  }
  snprintf(newPath, elcount(newPath), "%s.%s", oldPath, "roadWorks");
  value.roadWorks.isValidFlag = C2xIsTokenAvailable(packetHandle, "DENM", newPath);
  if(value.roadWorks.isValidFlag==1)
  {
    GetDENMRoadWorksContainerExtendedParams(packetHandle, value.roadWorks, newPath);
    result = CheckLastError("DENM", gkFuncRefGet, result);
  }
  snprintf(newPath, elcount(newPath), "%s.%s", oldPath, "positioningSolution");
  value.positioningSolution.isValidFlag = C2xIsTokenAvailable(packetHandle, "DENM", newPath);
  if(value.positioningSolution.isValidFlag==1)
  {
    value.positioningSolution.value = C2xGetTokenInt(packetHandle, "DENM", newPath);
    result = CheckLastError("DENM", gkFuncRefGet, result);
  }
  snprintf(newPath, elcount(newPath), "%s.%s", oldPath, "stationaryVehicle");
  value.stationaryVehicle.isValidFlag = C2xIsTokenAvailable(packetHandle, "DENM", newPath);
  if(value.stationaryVehicle.isValidFlag==1)
  {
    GetDENMStationaryVehicleContainerParams(packetHandle, value.stationaryVehicle, newPath);
    result = CheckLastError("DENM", gkFuncRefGet, result);
  }
  snprintf(newPath, elcount(newPath), "%s.%s", oldPath, "roadConfiguration");
  value.roadConfiguration.isValidFlag = C2xIsTokenAvailable(packetHandle, "DENM", newPath);
  if(value.roadConfiguration.isValidFlag==1)
  {
    GetDENMRoadConfigurationContainerParams(packetHandle, value.roadConfiguration, newPath);
    result = CheckLastError("DENM", gkFuncRefGet, result);
  }
  snprintf(newPath, elcount(newPath), "%s.%s", oldPath, "preCrash");
  value.preCrash.isValidFlag = C2xIsTokenAvailable(packetHandle, "DENM", newPath);
  if(value.preCrash.isValidFlag==1)
  {
    GetDENMPreCrashContainerParams(packetHandle, value.preCrash, newPath);
    result = CheckLastError("DENM", gkFuncRefGet, result);
  }
  return result;
}

int SetDENMAlacarteContainerParams(LONG packetHandle, struct DENMAlacarteContainer value, char oldPath[])
{
  char newPath[300];
  int result;

  result = 0;

  snprintf(newPath, elcount(newPath), "%s.%s", oldPath, "lanePosition");
  if(value.lanePosition.isValidFlag==1)
  {
    C2xSetTokenInt(packetHandle, "DENM", newPath, value.lanePosition.value);
    result = CheckLastError("DENM", gkFuncRefGet, result);
  }
  else
  {
    if( C2xIsTokenAvailable(packetHandle, "DENM", newPath) )
    {
      C2xRemoveToken(packetHandle, "DENM", newPath);
    }
  }

  snprintf(newPath, elcount(newPath), "%s.%s", oldPath, "impactReduction");
  if(value.impactReduction.isValidFlag==1)
  {
    SetDENMImpactReductionContainerParams(packetHandle, value.impactReduction, newPath);
    result = CheckLastError("DENM", gkFuncRefGet, result);
  }
  else
  {
    if( C2xIsTokenAvailable(packetHandle, "DENM", newPath) )
    {
      C2xRemoveToken(packetHandle, "DENM", newPath);
    }
  }

  snprintf(newPath, elcount(newPath), "%s.%s", oldPath, "externalTemperature");
  if(value.externalTemperature.isValidFlag==1)
  {
    C2xSetTokenInt(packetHandle, "DENM", newPath, value.externalTemperature.value);
    result = CheckLastError("DENM", gkFuncRefGet, result);
  }
  else
  {
    if( C2xIsTokenAvailable(packetHandle, "DENM", newPath) )
    {
      C2xRemoveToken(packetHandle, "DENM", newPath);
    }
  }

  snprintf(newPath, elcount(newPath), "%s.%s", oldPath, "roadWorks");
  if(value.roadWorks.isValidFlag==1)
  {
    SetDENMRoadWorksContainerExtendedParams(packetHandle, value.roadWorks, newPath);
    result = CheckLastError("DENM", gkFuncRefGet, result);
  }
  else
  {
    if( C2xIsTokenAvailable(packetHandle, "DENM", newPath) )
    {
      C2xRemoveToken(packetHandle, "DENM", newPath);
    }
  }

  snprintf(newPath, elcount(newPath), "%s.%s", oldPath, "positioningSolution");
  if(value.positioningSolution.isValidFlag==1)
  {
    C2xSetTokenInt(packetHandle, "DENM", newPath, value.positioningSolution.value);
    result = CheckLastError("DENM", gkFuncRefGet, result);
  }
  else
  {
    if( C2xIsTokenAvailable(packetHandle, "DENM", newPath) )
    {
      C2xRemoveToken(packetHandle, "DENM", newPath);
    }
  }

  snprintf(newPath, elcount(newPath), "%s.%s", oldPath, "stationaryVehicle");
  if(value.stationaryVehicle.isValidFlag==1)
  {
    SetDENMStationaryVehicleContainerParams(packetHandle, value.stationaryVehicle, newPath);
    result = CheckLastError("DENM", gkFuncRefGet, result);
  }
  else
  {
    if( C2xIsTokenAvailable(packetHandle, "DENM", newPath) )
    {
      C2xRemoveToken(packetHandle, "DENM", newPath);
    }
  }

  snprintf(newPath, elcount(newPath), "%s.%s", oldPath, "roadConfiguration");
  if(value.roadConfiguration.isValidFlag==1)
  {
    SetDENMRoadConfigurationContainerParams(packetHandle, value.roadConfiguration, newPath);
    result = CheckLastError("DENM", gkFuncRefGet, result);
  }
  else
  {
    if( C2xIsTokenAvailable(packetHandle, "DENM", newPath) )
    {
      C2xRemoveToken(packetHandle, "DENM", newPath);
    }
  }

  snprintf(newPath, elcount(newPath), "%s.%s", oldPath, "preCrash");
  if(value.preCrash.isValidFlag==1)
  {
    SetDENMPreCrashContainerParams(packetHandle, value.preCrash, newPath);
    result = CheckLastError("DENM", gkFuncRefGet, result);
  }
  else
  {
    if( C2xIsTokenAvailable(packetHandle, "DENM", newPath) )
    {
      C2xRemoveToken(packetHandle, "DENM", newPath);
    }
  }

  return result;
}

int GetDENMDenmPayloadParams(LONG packetHandle, struct DENMDenmPayload value, char oldPath[])
{
  char newPath[300];
  int result;

  result = 0;

  snprintf(newPath, elcount(newPath), "%s.%s", oldPath, "management");
  GetDENMManagementContainerParams(packetHandle, value.management, newPath);
  result = CheckLastError("DENM", gkFuncRefGet, result);

  snprintf(newPath, elcount(newPath), "%s.%s", oldPath, "situation");
  value.situation.isValidFlag = C2xIsTokenAvailable(packetHandle, "DENM", newPath);
  if(value.situation.isValidFlag==1)
  {
    GetDENMSituationContainerParams(packetHandle, value.situation, newPath);
    result = CheckLastError("DENM", gkFuncRefGet, result);
  }
  snprintf(newPath, elcount(newPath), "%s.%s", oldPath, "location");
  value.location.isValidFlag = C2xIsTokenAvailable(packetHandle, "DENM", newPath);
  if(value.location.isValidFlag==1)
  {
    GetDENMLocationContainerParams(packetHandle, value.location, newPath);
    result = CheckLastError("DENM", gkFuncRefGet, result);
  }
  snprintf(newPath, elcount(newPath), "%s.%s", oldPath, "alacarte");
  value.alacarte.isValidFlag = C2xIsTokenAvailable(packetHandle, "DENM", newPath);
  if(value.alacarte.isValidFlag==1)
  {
    GetDENMAlacarteContainerParams(packetHandle, value.alacarte, newPath);
    result = CheckLastError("DENM", gkFuncRefGet, result);
  }
  return result;
}

int SetDENMDenmPayloadParams(LONG packetHandle, struct DENMDenmPayload value, char oldPath[])
{
  char newPath[300];
  int result;

  result = 0;

  snprintf(newPath, elcount(newPath), "%s.%s", oldPath, "management");
  SetDENMManagementContainerParams(packetHandle, value.management, newPath);
  result = CheckLastError("DENM", gkFuncRefGet, result);

  snprintf(newPath, elcount(newPath), "%s.%s", oldPath, "situation");
  if(value.situation.isValidFlag==1)
  {
    SetDENMSituationContainerParams(packetHandle, value.situation, newPath);
    result = CheckLastError("DENM", gkFuncRefGet, result);
  }
  else
  {
    if( C2xIsTokenAvailable(packetHandle, "DENM", newPath) )
    {
      C2xRemoveToken(packetHandle, "DENM", newPath);
    }
  }

  snprintf(newPath, elcount(newPath), "%s.%s", oldPath, "location");
  if(value.location.isValidFlag==1)
  {
    SetDENMLocationContainerParams(packetHandle, value.location, newPath);
    result = CheckLastError("DENM", gkFuncRefGet, result);
  }
  else
  {
    if( C2xIsTokenAvailable(packetHandle, "DENM", newPath) )
    {
      C2xRemoveToken(packetHandle, "DENM", newPath);
    }
  }

  snprintf(newPath, elcount(newPath), "%s.%s", oldPath, "alacarte");
  if(value.alacarte.isValidFlag==1)
  {
    SetDENMAlacarteContainerParams(packetHandle, value.alacarte, newPath);
    result = CheckLastError("DENM", gkFuncRefGet, result);
  }
  else
  {
    if( C2xIsTokenAvailable(packetHandle, "DENM", newPath) )
    {
      C2xRemoveToken(packetHandle, "DENM", newPath);
    }
  }

  return result;
}

int API_GetDENMParams(LONG packetHandle, struct DENM value)
{
  int result;
  result = 0;

  value.header.isValidFlag = 1;
  GetDENMItsPduHeaderParams(packetHandle, value.header, "header");
  result = CheckLastError("DENM", gkFuncRefGet, result);

  value.denm.isValidFlag = 1;
  GetDENMDenmPayloadParams(packetHandle, value.denm, "denm");
  result = CheckLastError("DENM", gkFuncRefGet, result);

  return result;
}

int API_SetDENMParams(LONG packetHandle, struct DENM value)
{
  int result;
  result = 0;

  SetDENMItsPduHeaderParams(packetHandle, value.header, "header");
  result = CheckLastError("DENM", gkFuncRefGet, result);

  SetDENMDenmPayloadParams(packetHandle, value.denm, "denm");
  result = CheckLastError("DENM", gkFuncRefGet, result);

  return result;
}

