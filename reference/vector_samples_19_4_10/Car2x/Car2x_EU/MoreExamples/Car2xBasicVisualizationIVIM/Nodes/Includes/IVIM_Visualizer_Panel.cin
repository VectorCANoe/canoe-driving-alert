/*@!Encoding:1252*/
//////////////////////////////
////// MoveToIVIM Panel //////
//////////////////////////////

void VisualizeIVIMArea(float areaPosLat, float areaPosLon, float distanceA)
{
  // Area position
  if (gAreaPositionHandle == 0)
  {
    gAreaPositionHandle = CreateMapObject(Cross);
  }
  SetMapObjectPosition(gAreaPositionHandle, areaPosLat, areaPosLon);
  SetMapObjectSize(gAreaPositionHandle, 5);
  SetMapObjectPenWidth(gAreaPositionHandle, 3);
  SetMapObjectLineColor(gAreaPositionHandle, makeRGB(255, 0, 0));
  DrawMapObject(gAreaPositionHandle);
  
  // Area perimeter
  if (gAreaPerimeterHandle == 0)
  {
    gAreaPerimeterHandle = CreateMapObject(Ellipse);
  }
  SetMapObjectPosition(gAreaPerimeterHandle, areaPosLat, areaPosLon);
  SetMapObjectSize(gAreaPerimeterHandle, distanceA * 2, distanceA * 2);
  SetMapObjectLineColor(gAreaPerimeterHandle, makeRGB(255, 0, 0));
  DrawMapObject(gAreaPerimeterHandle);
}

void VisualizeIVIMAreaForId(float areaPosLat, float areaPosLon, float distanceA)
{
  // Area position
  if (gAreaPositionHandleForId == 0)
  {
    gAreaPositionHandleForId = CreateMapObject(Cross);
  }
  SetMapObjectPosition(gAreaPositionHandleForId, areaPosLat, areaPosLon);
  SetMapObjectSize(gAreaPositionHandleForId, 5);
  SetMapObjectPenWidth(gAreaPositionHandleForId, 3);
  SetMapObjectLineColor(gAreaPositionHandleForId, makeRGB(0, 0, 255));
  DrawMapObject(gAreaPositionHandleForId);
  
  // Area perimeter
  if (gAreaPerimeterHandleForId == 0)
  {
    gAreaPerimeterHandleForId = CreateMapObject(Ellipse);
  }
  SetMapObjectPosition(gAreaPerimeterHandleForId, areaPosLat, areaPosLon);
  SetMapObjectSize(gAreaPerimeterHandleForId, distanceA * 2, distanceA * 2);
  SetMapObjectLineColor(gAreaPerimeterHandleForId, makeRGB(0, 0, 255));
  DrawMapObject(gAreaPerimeterHandleForId);
}

void MoveToPosition(float latitude, float longitude)
{
  if (latitude != 0 && longitude != 0)
  {
    SetMapPosition(latitude, longitude);
  }
}

on sysvar_update IVIM01::moveToPressed
{
  MoveToPosition(@sysvar::IVIM01::lat, @sysvar::IVIM01::lon);
  VisualizeIVIMAreaForId((float)@sysvar::IVIM01::areaPosLat / 10000000, (float)@sysvar::IVIM01::areaPosLon / 10000000, (float)@sysvar::IVIM01::areaDistanceA);
}

on sysvar_update IVIM02::moveToPressed
{
  MoveToPosition(@sysvar::IVIM02::lat, @sysvar::IVIM02::lon);
  VisualizeIVIMAreaForId((float)@sysvar::IVIM02::areaPosLat / 10000000, (float)@sysvar::IVIM02::areaPosLon / 10000000, (float)@sysvar::IVIM02::areaDistanceA);
}

on sysvar_update IVIM03::moveToPressed
{
  MoveToPosition(@sysvar::IVIM03::lat, @sysvar::IVIM03::lon);
  VisualizeIVIMAreaForId((float)@sysvar::IVIM03::areaPosLat / 10000000, (float)@sysvar::IVIM03::areaPosLon / 10000000, (float)@sysvar::IVIM03::areaDistanceA);
}

on sysvar_update IVIM04::moveToPressed
{
  MoveToPosition(@sysvar::IVIM04::lat, @sysvar::IVIM04::lon);
  VisualizeIVIMAreaForId((float)@sysvar::IVIM04::areaPosLat / 10000000, (float)@sysvar::IVIM04::areaPosLon / 10000000, (float)@sysvar::IVIM04::areaDistanceA);
}

on sysvar_update IVIM05::moveToPressed
{
  MoveToPosition(@sysvar::IVIM05::lat, @sysvar::IVIM05::lon);
  VisualizeIVIMAreaForId((float)@sysvar::IVIM05::areaPosLat / 10000000, (float)@sysvar::IVIM05::areaPosLon / 10000000, (float)@sysvar::IVIM05::areaDistanceA);
}

on sysvar_update IVIM06::moveToPressed
{
  MoveToPosition(@sysvar::IVIM06::lat, @sysvar::IVIM06::lon);
  VisualizeIVIMAreaForId((float)@sysvar::IVIM06::areaPosLat / 10000000, (float)@sysvar::IVIM06::areaPosLon / 10000000, (float)@sysvar::IVIM06::areaDistanceA);
}

on sysvar_update IVIM07::moveToPressed
{
  MoveToPosition(@sysvar::IVIM07::lat, @sysvar::IVIM07::lon);
  VisualizeIVIMAreaForId((float)@sysvar::IVIM07::areaPosLat / 10000000, (float)@sysvar::IVIM07::areaPosLon / 10000000, (float)@sysvar::IVIM07::areaDistanceA);
}

on sysvar_update IVIM08::moveToPressed
{
  MoveToPosition(@sysvar::IVIM08::lat, @sysvar::IVIM08::lon);
  VisualizeIVIMAreaForId((float)@sysvar::IVIM08::areaPosLat / 10000000, (float)@sysvar::IVIM08::areaPosLon / 10000000, (float)@sysvar::IVIM08::areaDistanceA);
}

on sysvar_update IVIM09::moveToPressed
{
  MoveToPosition(@sysvar::IVIM09::lat, @sysvar::IVIM09::lon);
  VisualizeIVIMAreaForId((float)@sysvar::IVIM09::areaPosLat / 10000000, (float)@sysvar::IVIM09::areaPosLon / 10000000, (float)@sysvar::IVIM09::areaDistanceA);
}

on sysvar_update IVIM10::moveToPressed
{
  MoveToPosition(@sysvar::IVIM10::lat, @sysvar::IVIM10::lon);
  VisualizeIVIMAreaForId((float)@sysvar::IVIM10::areaPosLat / 10000000, (float)@sysvar::IVIM10::areaPosLon / 10000000, (float)@sysvar::IVIM10::areaDistanceA);
}

void UpdatePanelForId(int id, int iviStatus, char stationName[], long stationType, double timeStamp)
{
  char defaultStr[4] = "N/A";
  char currentName[1024];
  
  if (@sysvar::IVIM01::id == id)
  {
    sysGetVariableString(sysvar::IVIM01::station, currentName, elcount(currentName));
    if (strncmp(defaultStr, currentName, strlen(defaultStr)) != 0 && strncmp(stationName, currentName, strlen(stationName)) != 0)
    {
      @sysvar::IVIM01::multipleSenders = 1;
    }
    sysSetVariableString(sysvar::IVIM01::station, stationName);
    
    @sysvar::IVIM01::stationType = stationType;
    @sysvar::IVIM01::timeStamp = timeStamp / 1000000000;
    @sysvar::IVIM01::statusIndicator = iviStatus;
    switch (iviStatus)
    {
      case 0: // New
      {
        sysSetVariableString(sysvar::IVIM01::statusString, "New");
      }
      break;
      case 1: // Update
      {
        sysSetVariableString(sysvar::IVIM01::statusString, "Update");
      }
      break;
      case 2: // Cancellation
      {
        sysSetVariableString(sysvar::IVIM01::statusString, "Canceled");
      }
      break;
    }
  }
  else if (@sysvar::IVIM02::id == id)
  {
    sysGetVariableString(sysvar::IVIM02::station, currentName, elcount(currentName));
    if (strncmp(defaultStr, currentName, strlen(defaultStr)) != 0 && strncmp(stationName, currentName, strlen(stationName)) != 0)
    {
      @sysvar::IVIM02::multipleSenders = 1;
    }
    sysSetVariableString(sysvar::IVIM02::station, stationName);
    
    @sysvar::IVIM02::stationType = stationType;
    @sysvar::IVIM02::timeStamp = timeStamp / 1000000000;
    @sysvar::IVIM02::statusIndicator = iviStatus;
    switch (iviStatus)
    {
      case 0: // New
      {
        sysSetVariableString(sysvar::IVIM02::statusString, "New");
      }
      break;
      case 1: // Update
      {
        sysSetVariableString(sysvar::IVIM02::statusString, "Update");
      }
      break;
      case 2: // Cancellation
      {
        sysSetVariableString(sysvar::IVIM02::statusString, "Canceled");
      }
      break;
    }
  }
  else if (@sysvar::IVIM03::id == id)
  {
    sysGetVariableString(sysvar::IVIM03::station, currentName, elcount(currentName));
    if (strncmp(defaultStr, currentName, strlen(defaultStr)) != 0 && strncmp(stationName, currentName, strlen(stationName)) != 0)
    {
      @sysvar::IVIM03::multipleSenders = 1;
    }
    sysSetVariableString(sysvar::IVIM03::station, stationName);
    
    @sysvar::IVIM03::stationType = stationType;
    @sysvar::IVIM03::timeStamp = timeStamp / 1000000000;
    @sysvar::IVIM03::statusIndicator = iviStatus;
    switch (iviStatus)
    {
      case 0: // New
      {
        sysSetVariableString(sysvar::IVIM03::statusString, "New");
      }
      break;
      case 1: // Update
      {
        sysSetVariableString(sysvar::IVIM03::statusString, "Update");
      }
      break;
      case 2: // Cancellation
      {
        sysSetVariableString(sysvar::IVIM03::statusString, "Canceled");
      }
      break;
    }
  }
  else if (@sysvar::IVIM04::id == id)
  {
    sysGetVariableString(sysvar::IVIM04::station, currentName, elcount(currentName));
    if (strncmp(defaultStr, currentName, strlen(defaultStr)) != 0 && strncmp(stationName, currentName, strlen(stationName)) != 0)
    {
      @sysvar::IVIM04::multipleSenders = 1;
    }
    sysSetVariableString(sysvar::IVIM04::station, stationName);
    
    @sysvar::IVIM04::stationType = stationType;
    @sysvar::IVIM04::timeStamp = timeStamp / 1000000000;
    @sysvar::IVIM04::statusIndicator = iviStatus;
    switch (iviStatus)
    {
      case 0: // New
      {
        sysSetVariableString(sysvar::IVIM04::statusString, "New");
      }
      break;
      case 1: // Update
      {
        sysSetVariableString(sysvar::IVIM04::statusString, "Update");
      }
      break;
      case 2: // Cancellation
      {
        sysSetVariableString(sysvar::IVIM04::statusString, "Canceled");
      }
      break;
    }
  }
  else if (@sysvar::IVIM05::id == id)
  {
    sysGetVariableString(sysvar::IVIM05::station, currentName, elcount(currentName));
    if (strncmp(defaultStr, currentName, strlen(defaultStr)) != 0 && strncmp(stationName, currentName, strlen(stationName)) != 0)
    {
      @sysvar::IVIM05::multipleSenders = 1;
    }
    sysSetVariableString(sysvar::IVIM05::station, stationName);
    
    @sysvar::IVIM05::stationType = stationType;
    @sysvar::IVIM05::timeStamp = timeStamp / 1000000000;
    @sysvar::IVIM05::statusIndicator = iviStatus;
    switch (iviStatus)
    {
      case 0: // New
      {
        sysSetVariableString(sysvar::IVIM05::statusString, "New");
      }
      break;
      case 1: // Update
      {
        sysSetVariableString(sysvar::IVIM05::statusString, "Update");
      }
      break;
      case 2: // Cancellation
      {
        sysSetVariableString(sysvar::IVIM05::statusString, "Canceled");
      }
      break;
    }
  }
  else if (@sysvar::IVIM06::id == id)
  {
    sysGetVariableString(sysvar::IVIM06::station, currentName, elcount(currentName));
    if (strncmp(defaultStr, currentName, strlen(defaultStr)) != 0 && strncmp(stationName, currentName, strlen(stationName)) != 0)
    {
      @sysvar::IVIM06::multipleSenders = 1;
    }
    sysSetVariableString(sysvar::IVIM06::station, stationName);
    
    @sysvar::IVIM06::stationType = stationType;
    @sysvar::IVIM06::timeStamp = timeStamp / 1000000000;
    @sysvar::IVIM06::statusIndicator = iviStatus;
    switch (iviStatus)
    {
      case 0: // New
      {
        sysSetVariableString(sysvar::IVIM06::statusString, "New");
      }
      break;
      case 1: // Update
      {
        sysSetVariableString(sysvar::IVIM06::statusString, "Update");
      }
      break;
      case 2: // Cancellation
      {
        sysSetVariableString(sysvar::IVIM06::statusString, "Canceled");
      }
      break;
    }
  }
  else if (@sysvar::IVIM07::id == id)
  {
    sysGetVariableString(sysvar::IVIM07::station, currentName, elcount(currentName));
    if (strncmp(defaultStr, currentName, strlen(defaultStr)) != 0 && strncmp(stationName, currentName, strlen(stationName)) != 0)
    {
      @sysvar::IVIM07::multipleSenders = 1;
    }
    sysSetVariableString(sysvar::IVIM07::station, stationName);
    
    @sysvar::IVIM07::stationType = stationType;
    @sysvar::IVIM07::timeStamp = timeStamp / 1000000000;
    @sysvar::IVIM07::statusIndicator = iviStatus;
    switch (iviStatus)
    {
      case 0: // New
      {
        sysSetVariableString(sysvar::IVIM07::statusString, "New");
      }
      break;
      case 1: // Update
      {
        sysSetVariableString(sysvar::IVIM07::statusString, "Update");
      }
      break;
      case 2: // Cancellation
      {
        sysSetVariableString(sysvar::IVIM07::statusString, "Canceled");
      }
      break;
    }
  }
  else if (@sysvar::IVIM08::id == id)
  {
    sysGetVariableString(sysvar::IVIM08::station, currentName, elcount(currentName));
    if (strncmp(defaultStr, currentName, strlen(defaultStr)) != 0 && strncmp(stationName, currentName, strlen(stationName)) != 0)
    {
      @sysvar::IVIM08::multipleSenders = 1;
    }
    sysSetVariableString(sysvar::IVIM08::station, stationName);
    
    @sysvar::IVIM08::stationType = stationType;
    @sysvar::IVIM08::timeStamp = timeStamp / 1000000000;
    @sysvar::IVIM08::statusIndicator = iviStatus;
    switch (iviStatus)
    {
      case 0: // New
      {
        sysSetVariableString(sysvar::IVIM08::statusString, "New");
      }
      break;
      case 1: // Update
      {
        sysSetVariableString(sysvar::IVIM08::statusString, "Update");
      }
      break;
      case 2: // Cancellation
      {
        sysSetVariableString(sysvar::IVIM08::statusString, "Canceled");
      }
      break;
    }
  }
  else if (@sysvar::IVIM09::id == id)
  {
    sysGetVariableString(sysvar::IVIM09::station, currentName, elcount(currentName));
    if (strncmp(defaultStr, currentName, strlen(defaultStr)) != 0 && strncmp(stationName, currentName, strlen(stationName)) != 0)
    {
      @sysvar::IVIM09::multipleSenders = 1;
    }
    sysSetVariableString(sysvar::IVIM09::station, stationName);
    
    @sysvar::IVIM09::stationType = stationType;
    @sysvar::IVIM09::timeStamp = timeStamp / 1000000000;
    @sysvar::IVIM09::statusIndicator = iviStatus;
    switch (iviStatus)
    {
      case 0: // New
      {
        sysSetVariableString(sysvar::IVIM09::statusString, "New");
      }
      break;
      case 1: // Update
      {
        sysSetVariableString(sysvar::IVIM09::statusString, "Update");
      }
      break;
      case 2: // Cancellation
      {
        sysSetVariableString(sysvar::IVIM09::statusString, "Canceled");
      }
      break;
    }
  }
  else if (@sysvar::IVIM10::id == id)
  {
    sysGetVariableString(sysvar::IVIM10::station, currentName, elcount(currentName));
    if (strncmp(defaultStr, currentName, strlen(defaultStr)) != 0 && strncmp(stationName, currentName, strlen(stationName)) != 0)
    {
      @sysvar::IVIM10::multipleSenders = 1;
    }
    sysSetVariableString(sysvar::IVIM10::station, stationName);
    
    @sysvar::IVIM10::stationType = stationType;
    @sysvar::IVIM10::timeStamp = timeStamp / 1000000000;
    @sysvar::IVIM10::statusIndicator = iviStatus;
    switch (iviStatus)
    {
      case 0: // New
      {
        sysSetVariableString(sysvar::IVIM10::statusString, "New");
      }
      break;
      case 1: // Update
      {
        sysSetVariableString(sysvar::IVIM10::statusString, "Update");
      }
      break;
      case 2: // Cancellation
      {
        sysSetVariableString(sysvar::IVIM10::statusString, "Canceled");
      }
      break;
    }
  }
}

void FillPanel(int iviNr, int glcNr, int glcCount, int givCount, int rccCount, int tcCount, int avcCount, float areaPosLat, float areaPosLon, float areaDistanceA)
{
  float refPosLat, refPosLon;
  
  refPosLat = iviParams[iviNr].glc[glcNr].refLat / gFactorGeoPos;
  refPosLon = iviParams[iviNr].glc[glcNr].refLon / gFactorGeoPos;
  
  FillNextPanelField(iviParams[iviNr].id, refPosLat, refPosLon, glcCount, givCount, rccCount, tcCount, avcCount, areaPosLat, areaPosLon, areaDistanceA);
}

void FillNextPanelField(int ivimId, float lat, float lon, int glcCount, int givCount, int rccCount, int tcCount, int avcCount, float areaPosLat, float areaPosLon, float areaDistanceA)
{
  if (gPanelCurrentIndex > 9)
  {
    return;
  }
  
  switch (gPanelCurrentIndex)
  {
    case 0:
      {
        @sysvar::IVIM01::id = ivimId;
        @sysvar::IVIM01::lat = lat;
        @sysvar::IVIM01::lon = lon;
        @sysvar::IVIM01::countGLC = glcCount;
        @sysvar::IVIM01::countGIV = givCount;
        @sysvar::IVIM01::countRCC = rccCount;
        @sysvar::IVIM01::countTC = tcCount;
        @sysvar::IVIM01::countAVC = avcCount;
        @sysvar::IVIM01::areaPosLat = areaPosLat;
        @sysvar::IVIM01::areaPosLon = areaPosLon;
        @sysvar::IVIM01::areaDistanceA = areaDistanceA;
      }
      break;
    case 1:
      {
        @sysvar::IVIM02::id = ivimId;
        @sysvar::IVIM02::lat = lat;
        @sysvar::IVIM02::lon = lon;
        @sysvar::IVIM02::countGLC = glcCount;
        @sysvar::IVIM02::countGIV = givCount;
        @sysvar::IVIM02::countRCC = rccCount;
        @sysvar::IVIM02::countTC = tcCount;
        @sysvar::IVIM02::countAVC = avcCount;
        @sysvar::IVIM02::areaPosLat = areaPosLat;
        @sysvar::IVIM02::areaPosLon = areaPosLon;
        @sysvar::IVIM02::areaDistanceA = areaDistanceA;
      }
      break;
    case 2:
      {
        @sysvar::IVIM03::id = ivimId;
        @sysvar::IVIM03::lat = lat;
        @sysvar::IVIM03::lon = lon;
        @sysvar::IVIM03::countGLC = glcCount;
        @sysvar::IVIM03::countGIV = givCount;
        @sysvar::IVIM03::countRCC = rccCount;
        @sysvar::IVIM03::countTC = tcCount;
        @sysvar::IVIM03::countAVC = avcCount;
        @sysvar::IVIM03::areaPosLat = areaPosLat;
        @sysvar::IVIM03::areaPosLon = areaPosLon;
        @sysvar::IVIM03::areaDistanceA = areaDistanceA;
      }
      break;
    case 3:
      {
        @sysvar::IVIM04::id = ivimId;
        @sysvar::IVIM04::lat = lat;
        @sysvar::IVIM04::lon = lon;
        @sysvar::IVIM04::countGLC = glcCount;
        @sysvar::IVIM04::countGIV = givCount;
        @sysvar::IVIM04::countRCC = rccCount;
        @sysvar::IVIM04::countTC = tcCount;
        @sysvar::IVIM04::countAVC = avcCount;
        @sysvar::IVIM04::areaPosLat = areaPosLat;
        @sysvar::IVIM04::areaPosLon = areaPosLon;
        @sysvar::IVIM04::areaDistanceA = areaDistanceA;
      }
      break;
    case 4:
      {
        @sysvar::IVIM05::id = ivimId;
        @sysvar::IVIM05::lat = lat;
        @sysvar::IVIM05::lon = lon;
        @sysvar::IVIM05::countGLC = glcCount;
        @sysvar::IVIM05::countGIV = givCount;
        @sysvar::IVIM05::countRCC = rccCount;
        @sysvar::IVIM05::countTC = tcCount;
        @sysvar::IVIM05::countAVC = avcCount;
        @sysvar::IVIM05::areaPosLat = areaPosLat;
        @sysvar::IVIM05::areaPosLon = areaPosLon;
        @sysvar::IVIM05::areaDistanceA = areaDistanceA;
      }
      break;
    case 5:
      {
        @sysvar::IVIM06::id = ivimId;
        @sysvar::IVIM06::lat = lat;
        @sysvar::IVIM06::lon = lon;
        @sysvar::IVIM06::countGLC = glcCount;
        @sysvar::IVIM06::countGIV = givCount;
        @sysvar::IVIM06::countRCC = rccCount;
        @sysvar::IVIM06::countTC = tcCount;
        @sysvar::IVIM06::countAVC = avcCount;
        @sysvar::IVIM06::areaPosLat = areaPosLat;
        @sysvar::IVIM06::areaPosLon = areaPosLon;
        @sysvar::IVIM06::areaDistanceA = areaDistanceA;
      }
      break;
    case 6:
      {
        @sysvar::IVIM07::id = ivimId;
        @sysvar::IVIM07::lat = lat;
        @sysvar::IVIM07::lon = lon;
        @sysvar::IVIM07::countGLC = glcCount;
        @sysvar::IVIM07::countGIV = givCount;
        @sysvar::IVIM07::countRCC = rccCount;
        @sysvar::IVIM07::countTC = tcCount;
        @sysvar::IVIM07::countAVC = avcCount;
        @sysvar::IVIM07::areaPosLat = areaPosLat;
        @sysvar::IVIM07::areaPosLon = areaPosLon;
        @sysvar::IVIM07::areaDistanceA = areaDistanceA;
      }
      break;
    case 7:
      {
        @sysvar::IVIM08::id = ivimId;
        @sysvar::IVIM08::lat = lat;
        @sysvar::IVIM08::lon = lon;
        @sysvar::IVIM08::countGLC = glcCount;
        @sysvar::IVIM08::countGIV = givCount;
        @sysvar::IVIM08::countRCC = rccCount;
        @sysvar::IVIM08::countTC = tcCount;
        @sysvar::IVIM08::countAVC = avcCount;
        @sysvar::IVIM08::areaPosLat = areaPosLat;
        @sysvar::IVIM08::areaPosLon = areaPosLon;
        @sysvar::IVIM08::areaDistanceA = areaDistanceA;
      }
      break;
    case 8:
      {
        @sysvar::IVIM09::id = ivimId;
        @sysvar::IVIM09::lat = lat;
        @sysvar::IVIM09::lon = lon;
        @sysvar::IVIM09::countGLC = glcCount;
        @sysvar::IVIM09::countGIV = givCount;
        @sysvar::IVIM09::countRCC = rccCount;
        @sysvar::IVIM09::countTC = tcCount;
        @sysvar::IVIM09::countAVC = avcCount;
        @sysvar::IVIM09::areaPosLat = areaPosLat;
        @sysvar::IVIM09::areaPosLon = areaPosLon;
        @sysvar::IVIM09::areaDistanceA = areaDistanceA;
      }
      break;
    case 9:
      {
        @sysvar::IVIM10::id = ivimId;
        @sysvar::IVIM10::lat = lat;
        @sysvar::IVIM10::lon = lon;
        @sysvar::IVIM10::countGLC = glcCount;
        @sysvar::IVIM10::countGIV = givCount;
        @sysvar::IVIM10::countRCC = rccCount;
        @sysvar::IVIM10::countTC = tcCount;
        @sysvar::IVIM10::countAVC = avcCount;
        @sysvar::IVIM10::areaPosLat = areaPosLat;
        @sysvar::IVIM10::areaPosLon = areaPosLon;
        @sysvar::IVIM10::areaDistanceA = areaDistanceA;
      }
      break;
  }
  
  gPanelCurrentIndex++;
}

void UpdateContainerCounters(int iviNr, int glcCount, int givCount, int rccCount, int tcCount, int avcCount)
{  
  if (@sysvar::IVIM01::id == iviParams[iviNr].id)
  {
    @sysvar::IVIM01::countGLC = glcCount;
    @sysvar::IVIM01::countGIV = givCount;
    @sysvar::IVIM01::countRCC = rccCount;
    @sysvar::IVIM01::countTC = tcCount;
    @sysvar::IVIM01::countAVC = avcCount;
  }
  else if (@sysvar::IVIM02::id == iviParams[iviNr].id)
  {
    @sysvar::IVIM02::countGLC = glcCount;
    @sysvar::IVIM02::countGIV = givCount;
    @sysvar::IVIM02::countRCC = rccCount;
    @sysvar::IVIM02::countTC = tcCount;
    @sysvar::IVIM02::countAVC = avcCount;
  }
  else if (@sysvar::IVIM03::id == iviParams[iviNr].id)
  {
    @sysvar::IVIM03::countGLC = glcCount;
    @sysvar::IVIM03::countGIV = givCount;
    @sysvar::IVIM03::countRCC = rccCount;
    @sysvar::IVIM03::countTC = tcCount;
    @sysvar::IVIM03::countAVC = avcCount;
  }
  else if (@sysvar::IVIM04::id == iviParams[iviNr].id)
  {
    @sysvar::IVIM04::countGLC = glcCount;
    @sysvar::IVIM04::countGIV = givCount;
    @sysvar::IVIM04::countRCC = rccCount;
    @sysvar::IVIM04::countTC = tcCount;
    @sysvar::IVIM04::countAVC = avcCount;
  }
  else if (@sysvar::IVIM05::id == iviParams[iviNr].id)
  {
    @sysvar::IVIM05::countGLC = glcCount;
    @sysvar::IVIM05::countGIV = givCount;
    @sysvar::IVIM05::countRCC = rccCount;
    @sysvar::IVIM05::countTC = tcCount;
    @sysvar::IVIM05::countAVC = avcCount;
  }
  else if (@sysvar::IVIM06::id == iviParams[iviNr].id)
  {
    @sysvar::IVIM06::countGLC = glcCount;
    @sysvar::IVIM06::countGIV = givCount;
    @sysvar::IVIM06::countRCC = rccCount;
    @sysvar::IVIM06::countTC = tcCount;
    @sysvar::IVIM06::countAVC = avcCount;
  }
  else if (@sysvar::IVIM07::id == iviParams[iviNr].id)
  {
    @sysvar::IVIM07::countGLC = glcCount;
    @sysvar::IVIM07::countGIV = givCount;
    @sysvar::IVIM07::countRCC = rccCount;
    @sysvar::IVIM07::countTC = tcCount;
    @sysvar::IVIM07::countAVC = avcCount;
  }
  else if (@sysvar::IVIM08::id == iviParams[iviNr].id)
  {
    @sysvar::IVIM08::countGLC = glcCount;
    @sysvar::IVIM08::countGIV = givCount;
    @sysvar::IVIM08::countRCC = rccCount;
    @sysvar::IVIM08::countTC = tcCount;
    @sysvar::IVIM08::countAVC = avcCount;
  }
  else if (@sysvar::IVIM09::id == iviParams[iviNr].id)
  {
    @sysvar::IVIM09::countGLC = glcCount;
    @sysvar::IVIM09::countGIV = givCount;
    @sysvar::IVIM09::countRCC = rccCount;
    @sysvar::IVIM09::countTC = tcCount;
    @sysvar::IVIM09::countAVC = avcCount;
  }
  else if (@sysvar::IVIM10::id == iviParams[iviNr].id)
  {
    @sysvar::IVIM10::countGLC = glcCount;
    @sysvar::IVIM10::countGIV = givCount;
    @sysvar::IVIM10::countRCC = rccCount;
    @sysvar::IVIM10::countTC = tcCount;
    @sysvar::IVIM10::countAVC = avcCount;
  }
}
