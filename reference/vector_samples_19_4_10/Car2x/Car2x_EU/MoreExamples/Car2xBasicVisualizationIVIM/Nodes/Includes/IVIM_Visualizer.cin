/*@!Encoding:1252*/
includes
{
  #include "IVIM_Visualizer_Variables.cin"
  #include "IVIM_Visualizer_Pictograms.cin"
  #include "IVIM_Visualizer_Panel.cin"
}

void VisualizeIVIM(struct IVIM ivim, float areaPosLat, float areaPosLon, float areaDistanceA)
{ 
  int isIviKnown, iviNr, optionalFieldsNr, glcCount, glcNr, givCount, givNr, rccCount, tcCount, avcCount;
  
  glcCount = 0;
  givCount = 0;
  rccCount = 0;
  tcCount = 0;
  avcCount = 0;
  
  switch (ivim.ivi.mandatory.iviStatus)
  {
    case 0: // New
    case 1: // Update
      {
        isIviKnown = 0;
        
        for (iviNr = 0; iviNr < gIviCount; iviNr++)
        {
          if (iviNr < gMaxIviNr && iviParams[iviNr].id == ivim.ivi.mandatory.iviIdentificationNumber) // IVIM has been seen before
          {
            isIviKnown = 1;
            break;
          }
        }

        if (iviNr < gMaxIviNr)
        {
          iviParams[iviNr].id = ivim.ivi.mandatory.iviIdentificationNumber;
          
          for (optionalFieldsNr = 0; optionalFieldsNr < ivim.ivi.optional.length; optionalFieldsNr++)
          {
            switch (ivim.ivi.optional.arrayValue[optionalFieldsNr].choice)
            {
              case 0: // GLC
                {
                  iviParams[iviNr].glcCount = glcCount = ivim.ivi.optional.length - 1;
                  for (glcNr = 0; glcNr < glcCount; glcNr++)
                  {
                    ExtractGLC(ivim.ivi.optional.arrayValue[glcNr].glc, iviNr, glcNr);
                  }
                }
                break;

              case 1: // GIV
                {
                  iviParams[iviNr].givCount = givCount = ivim.ivi.optional.arrayValue[optionalFieldsNr].giv.length;
                  for (givNr = 0; givNr < givCount; givNr++)
                  {
                    ExtractGIV(ivim.ivi.optional.arrayValue[optionalFieldsNr].giv, iviNr, givNr);
                  }
                }
                break;
              
              case 2: // RCC
                {
                  iviParams[iviNr].rccCount = rccCount = ivim.ivi.optional.arrayValue[optionalFieldsNr].rcc.length;
                }
                break;
                
              case 3: // TC
                {
                  iviParams[iviNr].tcCount = tcCount = ivim.ivi.optional.arrayValue[optionalFieldsNr].tc.length;
                }
                break;
                
              case 4: // LAC
                break;
                
              case 5: // AVC
                {
                  iviParams[iviNr].avcCount = avcCount = ivim.ivi.optional.arrayValue[optionalFieldsNr].avc.length;
                }
                break;
            }
          }
          
          if (isIviKnown == 0)
          {
            gIviCount++;
            
            // Draw GLCs
            for (glcNr = 0; glcNr < glcCount; glcNr++)
            {
              DrawGLC(iviNr, glcNr);
            }
          
            // Draw GIVs
            DrawGIV(iviNr);
          
            FillPanel(iviNr, 0, glcCount, givCount, rccCount, tcCount, avcCount, areaPosLat, areaPosLon, areaDistanceA);
          }
          else
          {
            UpdateContainerCounters(iviNr, glcCount, givCount, rccCount, tcCount, avcCount);
          }
        }
      }
      break;
    
    case 2: // Cancellation
      {
        glcCount = ivim.ivi.optional.length - 1;
        
        for (iviNr = 0; iviNr < gIviCount; iviNr++)
        {
          if (iviNr < gMaxIviNr && iviParams[iviNr].id == ivim.ivi.mandatory.iviIdentificationNumber) // IVIM has been seen before, so delete it
          {
            //for (glcNr = 0; glcNr < glcCount; glcNr++)
            //{
            //  DeleteDrawnGLC(iviNr, glcNr);
            //}
            
            //DeleteDrawnGIV(iviNr);
            //break;
          }
        }
      }
      break;
  }
}

void ExtractGLC(struct IVIMGeographicLocationContainer glc, int iviNr, int glcNr)
{
  int  partCount, deltaCount, absoluteCount, partNr, deltaNr, absoluteNr;
  long zoneId;
  
  // Reference position
  iviParams[iviNr].glc[glcNr].refLat = glc.referencePosition.latitude;
  iviParams[iviNr].glc[glcNr].refLon = glc.referencePosition.longitude;

  // Parts
  iviParams[iviNr].glc[glcNr].partsCount = partCount = glc.parts.length;
  for (partNr = 0; partNr < partCount; partNr++)
  {
    zoneId = glc.parts.arrayValue[partNr].zoneId;
    if (iviParams[iviNr].glc[glcNr].parts[partNr].zoneId != zoneId) // New Zone
    {
      iviParams[iviNr].glc[glcNr].parts[partNr].zoneId = zoneId;
      
      // Delta positions
      iviParams[iviNr].glc[glcNr].parts[partNr].deltaPositionsCount = deltaCount = glc.parts.arrayValue[partNr].zone.segment_carriagewayOrLane.line.deltaPositions.length;      
      for (deltaNr = 0; deltaNr < deltaCount; deltaNr++)
      {
        iviParams[iviNr].glc[glcNr].parts[partNr].deltaPositions[deltaNr].lat = glc.parts.arrayValue[partNr].zone.segment_carriagewayOrLane.line.deltaPositions.arrayValue[deltaNr].deltaLatitude;
        iviParams[iviNr].glc[glcNr].parts[partNr].deltaPositions[deltaNr].lon = glc.parts.arrayValue[partNr].zone.segment_carriagewayOrLane.line.deltaPositions.arrayValue[deltaNr].deltaLongitude;
      }
      
      // Absolute positions
      iviParams[iviNr].glc[glcNr].parts[partNr].absolutePositionsCount = absoluteCount = glc.parts.arrayValue[partNr].zone.segment_carriagewayOrLane.line.absolutePositions.length;
      for (absoluteNr = 0; absoluteNr < absoluteCount; absoluteNr++)
      {
        iviParams[iviNr].glc[glcNr].parts[partNr].absolutePositions[absoluteNr].lat = glc.parts.arrayValue[partNr].zone.segment_carriagewayOrLane.line.absolutePositions.arrayValue[absoluteNr].latitude;
        iviParams[iviNr].glc[glcNr].parts[partNr].absolutePositions[absoluteNr].lon = glc.parts.arrayValue[partNr].zone.segment_carriagewayOrLane.line.absolutePositions.arrayValue[absoluteNr].longitude;
      }
    }
  }
}

void ExtractGIV(struct IVIMGeneralIviContainer giv, int iviNr, int givNr)
{
  int roadSignCount, attributeCount, detectionZoneNr, relevanceZoneNr, roadSignNr, attributeNr;
  
  // Detection zones
  for (detectionZoneNr = 0; detectionZoneNr < giv.arrayValue[givNr].detectionZoneIds.length; detectionZoneNr++)
  {
    iviParams[iviNr].giv[givNr].detectionZoneIds[detectionZoneNr] = giv.arrayValue[givNr].detectionZoneIds.arrayValue[detectionZoneNr];
    iviParams[iviNr].giv[givNr].detectionZoneIdsCount++;
  }

  // Relevance zones
  for (relevanceZoneNr = 0; relevanceZoneNr < giv.arrayValue[givNr].relevanceZoneIds.length; relevanceZoneNr++)
  {
    iviParams[iviNr].giv[givNr].relevanceZoneIds[relevanceZoneNr] = giv.arrayValue[givNr].relevanceZoneIds.arrayValue[relevanceZoneNr];
    iviParams[iviNr].giv[givNr].relevanceZoneIdsCount++;
  }

  // Road signs
  iviParams[iviNr].giv[givNr].roadSignsCount = roadSignCount = giv.arrayValue[givNr].roadSignCodes.length;
  for (roadSignNr = 0; roadSignNr < roadSignCount; roadSignNr++)
  {
    // ISO14823 Service category
    iviParams[iviNr].giv[givNr].roadSigns[roadSignNr].pictogramServiceCategory = GetServiceCategory(giv, iviNr, givNr, roadSignNr);
    
    // ISO14823 Pictogram category
    iviParams[iviNr].giv[givNr].roadSigns[roadSignNr].pictogramNature          = giv.arrayValue[givNr].roadSignCodes.arrayValue[roadSignNr].code.iso14823.pictogramCode.pictogramCategoryCode.nature;
    iviParams[iviNr].giv[givNr].roadSigns[roadSignNr].pictogramSerial          = giv.arrayValue[givNr].roadSignCodes.arrayValue[roadSignNr].code.iso14823.pictogramCode.pictogramCategoryCode.serialNumber;
    
    // ISO14823 Attributes
    iviParams[iviNr].giv[givNr].roadSigns[roadSignNr].pictogramAttributesCount = attributeCount = giv.arrayValue[givNr].roadSignCodes.arrayValue[roadSignNr].code.iso14823.attributes.length;
    for (attributeNr = 0; attributeNr < attributeCount; attributeNr++)
    {
      iviParams[iviNr].giv[givNr].roadSigns[roadSignNr].pictogramAttributes[attributeNr].speed = giv.arrayValue[givNr].roadSignCodes.arrayValue[roadSignNr].code.iso14823.attributes.arrayValue[attributeNr].spe.speedLimitMax.value;
    }
  }
}

long GetServiceCategory(struct IVIMGeneralIviContainer giv, int iviNr, int givNr, int roadSignNr)
{
  int firstCode, secondCode;
  
  firstCode = giv.arrayValue[givNr].roadSignCodes.arrayValue[roadSignNr].code.iso14823.pictogramCode.serviceCategoryCode.choice + 1;
  
  switch (firstCode)
  {
    case 1: // Traffic sign
    {
      secondCode = giv.arrayValue[givNr].roadSignCodes.arrayValue[roadSignNr].code.iso14823.pictogramCode.serviceCategoryCode.trafficSignPictogram + 1;
    }
    break;
    case 2: // Public facilities sign
    {
      secondCode = giv.arrayValue[givNr].roadSignCodes.arrayValue[roadSignNr].code.iso14823.pictogramCode.serviceCategoryCode.publicFacilitiesPictogram + 1;
    }
    break;
    case 3: // Ambient or road condition pictogram
    {
      secondCode = giv.arrayValue[givNr].roadSignCodes.arrayValue[roadSignNr].code.iso14823.pictogramCode.serviceCategoryCode.ambientOrRoadConditionPictogram + 1;
    }
    break;
  }
  
  return firstCode * 10 + secondCode;
}

void DrawGLC(int iviNr, int glcNr)
{
  int   partNr;
  long  refPosHandle, iviTextHandle;
  float refPosLat, refPosLon, iviTextPosLat, iviTextPosLon;
  char  iviText[20], refPosBmp[100];
  
  // Draw reference position
  snprintf(refPosBmp, elCount(refPosBmp), "Images\\Inner\\Arrow.png");
  refPosLat = iviParams[iviNr].glc[glcNr].refLat / gFactorGeoPos;
  refPosLon = iviParams[iviNr].glc[glcNr].refLon / gFactorGeoPos;
  
  iviParams[iviNr].drawHandles.refPos = refPosHandle = CreateMapObject(Bitmap);
  SetMapObjectBmpFilePath(refPosHandle, refPosBmp);
  SetMapObjectHeading    (refPosHandle, CalculateHeading(iviNr, glcNr));
  SetMapObjectPosition   (refPosHandle, refPosLat, refPosLon);
  SetMapObjectSize       (refPosHandle, gRefPosSize);
  DrawMapObject          (refPosHandle);
  
  // Draw ID text
  snprintf(iviText, elCount(iviText), "ID %i", iviParams[iviNr].id);
  iviTextPosLat = iviParams[iviNr].glc[glcNr].refLat / gFactorGeoPos + gIviTextOffsetLat;
  iviTextPosLon = iviParams[iviNr].glc[glcNr].refLon / gFactorGeoPos + gIviTextOffsetLon;
  
  iviParams[iviNr].drawHandles.textId = iviTextHandle = CreateMapObject(Text);
  SetMapObjectPosition (iviTextHandle, iviTextPosLat, iviTextPosLon);
  SetMapObjectSize     (iviTextHandle, gIviTextSize);
  SetMapObjectLineColor(iviTextHandle, makeRGB(255, 255, 255)); // White
  SetMapObjectText     (iviTextHandle, iviText);
  DrawMapObject        (iviTextHandle);

  // Draw parts
  for (partNr = 0; partNr < iviParams[iviNr].glc[glcNr].partsCount; partNr++)
  {
    if (iviParams[iviNr].glc[glcNr].parts[partNr].absolutePositionsCount > 0)
    {
      DrawPart(iviNr, glcNr, partNr, 1); // Use absolute positions
    }
    else
    {
      DrawPart(iviNr, glcNr, partNr, 0); // Use relative positions
    }
  }
}

int GetFirstRelevanceZoneId(int iviNr, int glcNr)
{
  if (iviParams[iviNr].givCount > 0 && glcNr < iviParams[iviNr].givCount)
  {
    if (iviParams[iviNr].giv[glcNr].relevanceZoneIdsCount > 0)
    {
      return iviParams[iviNr].giv[glcNr].relevanceZoneIds[0];
    }
  }
  
  return -1;
}

int GetPartNrOfFirstRelevanceZone(int iviNr, int glcNr, int zoneId)
{
  int partNr;
  
  for (partNr = 0; partNr < iviParams[iviNr].glc[glcNr].partsCount; partNr++)
  {
    if (iviParams[iviNr].glc[glcNr].parts[partNr].zoneId == zoneId)
    {
      return partNr;
    }
  }
  
  return -1;
}

int GetIndexOfFirstValidAbsolutePosition(int iviNr, int glcNr, int partNr)
{
  int index;
  
  for (index = 0; index < iviParams[iviNr].glc[glcNr].parts[partNr].absolutePositionsCount; index++)
  {
    if (iviParams[iviNr].glc[glcNr].parts[partNr].absolutePositions[index].lat != 0 &&
        iviParams[iviNr].glc[glcNr].parts[partNr].absolutePositions[index].lon != 0)
    {
      return index;
    }
  }
  
  return -1;
}

int GetIndexOfFirstValidDeltaPosition(int iviNr, int glcNr, int partNr)
{
  int index;
  
  for (index = 0; index < iviParams[iviNr].glc[glcNr].parts[partNr].deltaPositionsCount; index++)
  {
    if (iviParams[iviNr].glc[glcNr].parts[partNr].deltaPositions[index].lat != 0 &&
        iviParams[iviNr].glc[glcNr].parts[partNr].deltaPositions[index].lon != 0)
    {
      return index;
    }
  }
  
  return -1;
}

float CalculateHeading(int iviNr, int glcNr)
{
  int zoneId, partNr, posIndex;
  float latPos1, lonPos1, latPos2, lonPos2;
  
  if (iviParams[iviNr].glc[glcNr].partsCount == 0)
  {
    return 0;
  }

  zoneId = GetFirstRelevanceZoneId(iviNr, glcNr);
  if (zoneId == -1)
  {
    return 0;
  }
  
  partNr = GetPartNrOfFirstRelevanceZone(iviNr, glcNr, zoneId);
  if (partNr == -1)
  {
    return 0;
  }
  
  latPos1 = iviParams[iviNr].glc[glcNr].refLat / gFactorGeoPos;
  lonPos1 = iviParams[iviNr].glc[glcNr].refLon / gFactorGeoPos;
  
  if (iviParams[iviNr].glc[glcNr].parts[partNr].absolutePositionsCount > 0)
  {
    // Use absolute positions
    posIndex = GetIndexOfFirstValidAbsolutePosition(iviNr, glcNr, partNr);
    if (posIndex == -1)
    {
      return 0;
    }
    
    latPos2 = iviParams[iviNr].glc[glcNr].parts[partNr].absolutePositions[posIndex].lat / gFactorGeoPos;
    lonPos2 = iviParams[iviNr].glc[glcNr].parts[partNr].absolutePositions[posIndex].lon / gFactorGeoPos;
  }
  else
  {
    // Use relative positions
    posIndex = GetIndexOfFirstValidDeltaPosition(iviNr, glcNr, partNr);
    if (posIndex == -1)
    {
      return 0;
    }
    
    latPos2 = latPos1 + iviParams[iviNr].glc[glcNr].parts[partNr].deltaPositions[posIndex].lat / gFactorGeoPos;
    lonPos2 = lonPos1 + iviParams[iviNr].glc[glcNr].parts[partNr].deltaPositions[posIndex].lon / gFactorGeoPos;
  }
  
  return DLLGetGeoAngle(latPos1, lonPos1, latPos2, lonPos2);
}

void DrawPart(int iviNr, int glcNr, int partNr, int useAbsolutePositions)
{
  int   zonesCount, zoneNr, givNr, detectionZoneNr, relevanceZoneNr;
  long  zoneHandle;
  float currentLat, currentLon, nextLat, nextLon, startPosLat, startPosLon, endPosLat, endPosLon, offsetLat, offsetLon;
  
  currentLat = iviParams[iviNr].glc[glcNr].refLat;
  currentLon = iviParams[iviNr].glc[glcNr].refLon;
  
  if (useAbsolutePositions)
  {
    zonesCount = iviParams[iviNr].glc[glcNr].parts[partNr].absolutePositionsCount;
  }
  else // Use relative positions
  {
    zonesCount = iviParams[iviNr].glc[glcNr].parts[partNr].deltaPositionsCount;
  }
  
  // Draw zones
  for (zoneNr = 0; zoneNr < zonesCount; zoneNr++)
  {
    zoneHandle = CreateMapObject(Line);
    
    if (useAbsolutePositions)
    {
      iviParams[iviNr].drawHandles.absoluteZones[zoneNr] = zoneHandle;
      
      nextLat = iviParams[iviNr].glc[glcNr].parts[partNr].absolutePositions[zoneNr].lat;
      nextLon = iviParams[iviNr].glc[glcNr].parts[partNr].absolutePositions[zoneNr].lon;
    }
    else // Use relative positions
    {
      iviParams[iviNr].drawHandles.deltaZones[zoneNr] = zoneHandle;
      
      nextLat = currentLat + iviParams[iviNr].glc[glcNr].parts[partNr].deltaPositions[zoneNr].lat;
      nextLon = currentLon + iviParams[iviNr].glc[glcNr].parts[partNr].deltaPositions[zoneNr].lon;
    }
    
    // Determine whether zone is detection or relevance zone
    for (givNr = 0; givNr < iviParams[iviNr].givCount; givNr++)
    {
      // Detection zones
      for (detectionZoneNr = 0; detectionZoneNr < iviParams[iviNr].giv[givNr].detectionZoneIdsCount; detectionZoneNr++)
      {
        if (iviParams[iviNr].giv[givNr].detectionZoneIds[detectionZoneNr] == iviParams[iviNr].glc[glcNr].parts[partNr].zoneId)
        {
          SetMapObjectLineColor(zoneHandle, makeRGB(0, 0, 255)); // Blue
          SetMapObjectPenWidth(zoneHandle, gZonePenWidth);
          
          // Add a small offset so that overlaps with relevance zones become visible
          offsetLat = gDetectionZoneOffsetLat;
          offsetLon = gDetectionZoneOffsetLon;
          break;
        }
      }
        
      // Relevance zones
      for (relevanceZoneNr = 0; relevanceZoneNr < iviParams[iviNr].giv[givNr].relevanceZoneIdsCount; relevanceZoneNr++)
      {
        if (iviParams[iviNr].giv[givNr].relevanceZoneIds[relevanceZoneNr] == iviParams[iviNr].glc[glcNr].parts[partNr].zoneId)
        {
          SetMapObjectLineColor(zoneHandle, makeRGB(0, 255, 0)); // Green
          SetMapObjectPenWidth(zoneHandle, gZonePenWidth * 2);
          
          // Add a small offset so that overlaps with detection zones become visible
          offsetLat = gRelevanceZoneOffsetLat;
          offsetLon = gRelevanceZoneOffsetLon;
          break;
        }
      } 
    }

    startPosLat = currentLat / gFactorGeoPos + offsetLat;
    startPosLon = currentLon / gFactorGeoPos + offsetLon;
    endPosLat   = nextLat    / gFactorGeoPos + offsetLat;
    endPosLon   = nextLon    / gFactorGeoPos + offsetLon;
    
    SetMapObjectPosition(zoneHandle, startPosLat, startPosLon, endPosLat, endPosLon);
    DrawMapObject       (zoneHandle);
      
    currentLat = nextLat;
    currentLon = nextLon;
  }
}

void DrawGIV(int iviNr)
{
  int   givNr, roadSignNr;
  long  pictoHandle, pictoServiceCategory, pictoNature, pictoSerial, pictoAttributesCount;
  float pictoPosLat, pictoPosLon;
  char  pictoPath[1024];

  // Draw pictograms
  for (givNr = 0; givNr < iviParams[iviNr].givCount; givNr++)
  {
    for (roadSignNr = 0; roadSignNr < iviParams[iviNr].giv[givNr].roadSignsCount; roadSignNr++)
    {      
      iviParams[iviNr].drawHandles.pictograms[roadSignNr] = pictoHandle = CreateMapObject(Bitmap);
      
      pictoPosLat          = iviParams[iviNr].glc[givNr].refLat / gFactorGeoPos + gPictogramOffsetLat + gPictogramGapLat;
      pictoPosLon          = iviParams[iviNr].glc[givNr].refLon / gFactorGeoPos + gPictogramOffsetLon + gPictogramGapLon;
      pictoServiceCategory = iviParams[iviNr].giv[givNr].roadSigns[roadSignNr].pictogramServiceCategory;
      pictoNature          = iviParams[iviNr].giv[givNr].roadSigns[roadSignNr].pictogramNature;
      pictoSerial          = iviParams[iviNr].giv[givNr].roadSigns[roadSignNr].pictogramSerial;
      pictoAttributesCount = iviParams[iviNr].giv[givNr].roadSigns[roadSignNr].pictogramAttributesCount;
      
      CreatePictogram(pictoPath, pictoServiceCategory, pictoNature, pictoSerial, pictoAttributesCount, iviParams[iviNr].giv[givNr].roadSigns[roadSignNr].pictogramAttributes);
      
      SetMapObjectBmpFilePath(pictoHandle, pictoPath);
      SetMapObjectPosition   (pictoHandle, pictoPosLat, pictoPosLon);
      SetMapObjectSize       (pictoHandle, gPictogramSize);
      DrawMapObject          (pictoHandle);
    }
  }
}

void DeleteDrawnGLC(int iviNr, int glcNr)
{
  int partNr, zoneNr;

  // Delete reference position
  DeleteMapObject(iviParams[iviNr].drawHandles.refPos);
  
  // Delete ID text
  DeleteMapObject(iviParams[iviNr].drawHandles.textId);

  // Delete delta zones
  for (partNr = 0; partNr < iviParams[iviNr].glc[glcNr].partsCount; partNr++)
  {
    for (zoneNr = 0; zoneNr < iviParams[iviNr].glc[glcNr].parts[partNr].deltaPositionsCount; zoneNr++)
    {
      DeleteMapObject(iviParams[iviNr].drawHandles.deltaZones[zoneNr]);
    }
  }
  
  // Delete absolute zones
  for (partNr = 0; partNr < iviParams[iviNr].glc[glcNr].partsCount; partNr++)
  {
    for (zoneNr = 0; zoneNr < iviParams[iviNr].glc[glcNr].parts[partNr].absolutePositionsCount; zoneNr++)
    {
      DeleteMapObject(iviParams[iviNr].drawHandles.absoluteZones[zoneNr]);
    }
  }
}

void DeleteDrawnGIV(int iviNr)
{
  int givNr, roadSignNr;
  
  // Delete pictograms
  for (givNr = 0; givNr < iviParams[iviNr].givCount; givNr++)
  {
    for (roadSignNr = 0; roadSignNr < iviParams[iviNr].giv[givNr].roadSignsCount; roadSignNr++)
    {
      DeleteMapObject(iviParams[iviNr].drawHandles.pictograms[roadSignNr]);
    }
  }
}