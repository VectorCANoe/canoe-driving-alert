/*@!Encoding:1252*/
includes
{
  #include "Includes\IVIM_Visualizer.cin"
}

variables
{
  struct IVIM ivim;
}

on start
{
  enum CallbackType {OnRx, PreTx};
  C2xRegisterCallback(OnRx, "OnRxIVIM", "IVIM");
}

void OnRxIVIM(long channel, long dir, long radioChannel, long signalStrength, long signalQuality, long packet)
{
  long stationHdl;
  char stationName[1024] = "N/A";
  long stationType;
  
  long areaPosLat;
  long areaPosLon;
  long distanceA;

  // Extract geo_eh data from packet and visualize
  areaPosLat = C2xGetTokenInt(packet, "geo_eh", "areaPosLatitude");
  areaPosLon = C2xGetTokenInt(packet, "geo_eh", "areaPosLongitude");
  distanceA = C2xGetTokenInt(packet, "geo_eh", "distanceA");
  VisualizeIVIMArea((float)areaPosLat / 10000000, (float)areaPosLon / 10000000, (float)distanceA);
  
  // Extract IVIM data from packet and visualize
  API_GetIVIMParams(packet, ivim);
  VisualizeIVIM(ivim, areaPosLat, areaPosLon, distanceA);
  
  // Update panel
  stationHdl = C2xGetStationHandle(packet);
  C2xGetStationName(stationHdl, elcount(stationName), stationName);
  stationType = C2xGetTokenInt(packet, "geo_eh", "lpvGNAddrStationType");
  UpdatePanelForId(ivim.ivi.mandatory.iviIdentificationNumber, ivim.ivi.mandatory.iviStatus, stationName, stationType, timeNowNS());
}