/*@!Encoding:1252*/
/*
//  (c) Vector Informatik GmbH. All rights reserved.
//
//  This file contains definitions of structs and methods that may be used
//  to set and get the values of an ASN.1 defined packet's payload.
//
//  //This example demonstrates how to set a packet's payload:
//  LONG packetHandle;
//  struct IVIM payload;
//  //you need to set the values of the variable "payload" yourself
//  packetHandle = API_InitIVIMPacket();
//  if (packetHandle!=0) {
//    if (API_SetIVIMParams(packetHandle, payload)==0) {
//      if (C2xCompletePacket(packetHandle)==0) {
//        C2xOutputPacket(packetHandle);
//      }
//    }
//  }
//                                                                             */
includes
{

}
variables
{
    struct IVIMItsPduHeader {
        INT isValidFlag;   // necessary if this struct is used as an optional field of a SEQUENCE
        BYTE protocolVersion;  // INTEGER, 0..255;
        BYTE messageID;  // INTEGER, 0..255, denm(1), cam(2), poi(3), spatem(4), mapem(5), ivim(6), ev_rsr(7), tistpgtransaction(8), srem(9), ssem(10), evcsn(11), saem(12), rtcmem(13);
        DWORD stationID;  // INTEGER, 0..4294967295;
    };
    
    struct IVIMCountryCode {
        INT isValidFlag;   // necessary if this struct is used as an optional field of a SEQUENCE
        CHAR string[11];
        INT  stringLength;
    };
    
    struct IVIMProvider {
        INT isValidFlag;   // necessary if this struct is used as an optional field of a SEQUENCE
        struct IVIMCountryCode countryCode;  // BITSTRING;
        WORD providerIdentifier;  // INTEGER, 0..16383;
    };
    
    struct IVIMIviIdentificationNumbers {
        INT isValidFlag;   // necessary if this struct is used as an optional field of a SEQUENCE
        INT length;
        DWORD arrayValue[8];  // INTEGER, 1..32767;
    };
    
    struct IVIMActionID {
        INT isValidFlag;   // necessary if this struct is used as an optional field of a SEQUENCE
        DWORD originatingStationID;  // INTEGER, 0..4294967295;
        WORD sequenceNumber;  // INTEGER, 0..65535;
    };
    
    struct IVIMConnectedDenms {
        INT isValidFlag;   // necessary if this struct is used as an optional field of a SEQUENCE
        INT length;
        struct IVIMActionID arrayValue[8];  // SEQUENCE;
    };
    
    struct IVIMIviManagementContainer {
        INT isValidFlag;   // necessary if this struct is used as an optional field of a SEQUENCE
        struct IVIMProvider serviceProviderId;  // SEQUENCE;
        WORD iviIdentificationNumber;  // INTEGER, 1..32767;
        struct OPT_QWORD_ASN timeStamp;  // INTEGER, OPTIONAL, 0..4398046511103, utcStartOf2004(0), oneMillisecAfterUTCStartOf2004(1);
        struct OPT_QWORD_ASN validFrom;  // INTEGER, OPTIONAL, 0..4398046511103, utcStartOf2004(0), oneMillisecAfterUTCStartOf2004(1);
        struct OPT_QWORD_ASN validTo;  // INTEGER, OPTIONAL, 0..4398046511103, utcStartOf2004(0), oneMillisecAfterUTCStartOf2004(1);
        struct IVIMIviIdentificationNumbers connectedIviStructures;  // SEQUENCEOF, OPTIONAL;
        BYTE iviStatus;  // INTEGER, 0..7, new(0), update(1), cancellation(2), negation(3);
        struct IVIMConnectedDenms connectedDenms;  // SEQUENCEOF, OPTIONAL;
    };
    
    struct IVIMPosConfidenceEllipse {
        INT isValidFlag;   // necessary if this struct is used as an optional field of a SEQUENCE
        WORD semiMajorConfidence;  // INTEGER, 0..4095, oneCentimeter(1), outOfRange(4094), unavailable(4095);
        WORD semiMinorConfidence;  // INTEGER, 0..4095, oneCentimeter(1), outOfRange(4094), unavailable(4095);
        WORD semiMajorOrientation;  // INTEGER, 0..3601, unavailable(3601);
    };
    
    struct IVIMAltitude {
        INT isValidFlag;   // necessary if this struct is used as an optional field of a SEQUENCE
        LONG altitudeValue;  // INTEGER, -100000..800001, unavailable(800001);
        INT altitudeConfidence;  // ENUMERATED, alt_000_01(0), alt_000_02(1), alt_000_05(2), alt_000_10(3), alt_000_20(4), alt_000_50(5), alt_001_00(6), alt_002_00(7), alt_005_00(8), alt_010_00(9), alt_020_00(10), alt_050_00(11), alt_100_00(12), alt_200_00(13), outOfRange(14), unavailable(15);
    };
    
    struct IVIMReferencePosition {
        INT isValidFlag;   // necessary if this struct is used as an optional field of a SEQUENCE
        LONG latitude;  // INTEGER, -900000000..900000001, unavailable(900000001);
        LONG longitude;  // INTEGER, -1800000000..1800000001, unavailable(1800000001);
        struct IVIMPosConfidenceEllipse positionConfidenceEllipse;  // SEQUENCE;
        struct IVIMAltitude altitude;  // SEQUENCE;
    };
    
    struct IVIMHeading {
        INT isValidFlag;   // necessary if this struct is used as an optional field of a SEQUENCE
        WORD headingValue;  // INTEGER, 0..3601, unavailable(3601);
        BYTE headingConfidence;  // INTEGER, 1..127, equalOrWithinZeroPointOneDegree(1), equalOrWithinOneDegree(10), outOfRange(126), unavailable(127);
    };
    
    struct IVIMSpeed {
        INT isValidFlag;   // necessary if this struct is used as an optional field of a SEQUENCE
        WORD speedValue;  // INTEGER, 0..16383, unavailable(16383);
        BYTE speedConfidence;  // INTEGER, 1..127, equalOrWithinOneCentimeterPerSec(1), equalOrWithinOneMeterPerSec(100), outOfRange(126), unavailable(127);
    };
    
    struct IVIMDeltaPosition {
        INT isValidFlag;   // necessary if this struct is used as an optional field of a SEQUENCE
        LONG deltaLatitude;  // INTEGER, -131071..131072, oneMicrodegreeNorth(10), oneMicrodegreeSouth(-10), unavailable(131072);
        LONG deltaLongitude;  // INTEGER, -131071..131072, oneMicrodegreeEast(10), oneMicrodegreeWest(-10), unavailable(131072);
    };
    
    struct IVIMDeltaPositions {
        INT isValidFlag;   // necessary if this struct is used as an optional field of a SEQUENCE
        INT length;
        struct IVIMDeltaPosition arrayValue[100];  // SEQUENCE;
    };
    
    struct IVIMDeltaReferencePosition {
        INT isValidFlag;   // necessary if this struct is used as an optional field of a SEQUENCE
        LONG deltaLatitude;  // INTEGER, -131071..131072, oneMicrodegreeNorth(10), oneMicrodegreeSouth(-10), unavailable(131072);
        LONG deltaLongitude;  // INTEGER, -131071..131072, oneMicrodegreeEast(10), oneMicrodegreeWest(-10), unavailable(131072);
        INT deltaAltitude;  // INTEGER, -12700..12800, oneCentimeterUp(1), oneCentimeterDown(-1), unavailable(12800);
    };
    
    struct IVIMDeltaReferencePositions {
        INT isValidFlag;   // necessary if this struct is used as an optional field of a SEQUENCE
        INT length;
        struct IVIMDeltaReferencePosition arrayValue[100];  // SEQUENCE;
    };
    
    struct IVIMAbsolutePosition {
        INT isValidFlag;   // necessary if this struct is used as an optional field of a SEQUENCE
        LONG latitude;  // INTEGER, -900000000..900000001, unavailable(900000001);
        LONG longitude;  // INTEGER, -1800000000..1800000001, unavailable(1800000001);
    };
    
    struct IVIMAbsolutePositions {
        INT isValidFlag;   // necessary if this struct is used as an optional field of a SEQUENCE
        INT length;
        struct IVIMAbsolutePosition arrayValue[8];  // SEQUENCE;
    };
    
    struct IVIMAbsolutePositionWAltitude {
        INT isValidFlag;   // necessary if this struct is used as an optional field of a SEQUENCE
        LONG latitude;  // INTEGER, -900000000..900000001, unavailable(900000001);
        LONG longitude;  // INTEGER, -1800000000..1800000001, unavailable(1800000001);
        struct IVIMAltitude altitude;  // SEQUENCE;
    };
    
    struct IVIMAbsolutePositionsWAltitude {
        INT isValidFlag;   // necessary if this struct is used as an optional field of a SEQUENCE
        INT length;
        struct IVIMAbsolutePositionWAltitude arrayValue[8];  // SEQUENCE;
    };
    
    struct IVIMPolygonalLine {
        INT isValidFlag;   // necessary if this struct is used as an optional field of a SEQUENCE
        INT choice;
        struct IVIMDeltaPositions deltaPositions;  // SEQUENCEOF;
        struct IVIMDeltaReferencePositions deltaPositionsWithAltitude;  // SEQUENCEOF;
        struct IVIMAbsolutePositions absolutePositions;  // SEQUENCEOF;
        struct IVIMAbsolutePositionsWAltitude absolutePositionsWithAltitude;  // SEQUENCEOF;
    };
    
    struct IVIMSegment {
        INT isValidFlag;   // necessary if this struct is used as an optional field of a SEQUENCE
        struct IVIMPolygonalLine line;  // CHOICE;
        struct OPT_WORD_ASN laneWidth;  // INTEGER, OPTIONAL, 0..1023;
    };
    
    struct IVIMComputedSegment {
        INT isValidFlag;   // necessary if this struct is used as an optional field of a SEQUENCE
        BYTE zoneId;  // INTEGER, 1..32;
        INT laneNumber;  // INTEGER, -1..14, offTheRoad(-1), innerHardShoulder(0), innermostDrivingLane(1), secondLaneFromInside(2), outerHardShoulder(14);
        WORD laneWidth;  // INTEGER, 0..1023;
        struct OPT_INT_ASN offsetDistance;  // INTEGER, OPTIONAL, -32768..32767;
        struct IVIMDeltaReferencePosition offsetPosition;  // SEQUENCE, OPTIONAL;
    };
    
    struct IVIMZone {
        INT isValidFlag;   // necessary if this struct is used as an optional field of a SEQUENCE
        INT choice;
        struct IVIMSegment segment;  // SEQUENCE;
        struct IVIMPolygonalLine area;  // CHOICE;
        struct IVIMComputedSegment computedSegment;  // SEQUENCE;
    };
    
    struct IVIMGlcPart {
        INT isValidFlag;   // necessary if this struct is used as an optional field of a SEQUENCE
        BYTE zoneId;  // INTEGER, 1..32;
        struct OPT_INT_ASN laneNumber;  // INTEGER, OPTIONAL, -1..14, offTheRoad(-1), innerHardShoulder(0), innermostDrivingLane(1), secondLaneFromInside(2), outerHardShoulder(14);
        struct OPT_BYTE_ASN zoneExtension;  // INTEGER, OPTIONAL, 0..255;
        struct OPT_WORD_ASN zoneHeading;  // INTEGER, OPTIONAL, 0..3601, unavailable(3601);
        struct IVIMZone zone;  // CHOICE, OPTIONAL;
    };
    
    struct IVIMGlcParts {
        INT isValidFlag;   // necessary if this struct is used as an optional field of a SEQUENCE
        INT length;
        struct IVIMGlcPart arrayValue[16];  // SEQUENCE;
    };
    
    struct IVIMGeographicLocationContainer {
        INT isValidFlag;   // necessary if this struct is used as an optional field of a SEQUENCE
        struct IVIMReferencePosition referencePosition;  // SEQUENCE;
        struct OPT_QWORD_ASN referencePositionTime;  // INTEGER, OPTIONAL, 0..4398046511103, utcStartOf2004(0), oneMillisecAfterUTCStartOf2004(1);
        struct IVIMHeading referencePositionHeading;  // SEQUENCE, OPTIONAL;
        struct IVIMSpeed referencePositionSpeed;  // SEQUENCE, OPTIONAL;
        struct IVIMGlcParts parts;  // SEQUENCEOF;
    };
    
    struct IVIMZoneIds {
        INT isValidFlag;   // necessary if this struct is used as an optional field of a SEQUENCE
        INT length;
        BYTE arrayValue[8];  // INTEGER, 1..32;
    };
    
    struct IVIMExt2 {
        INT isValidFlag;   // necessary if this struct is used as an optional field of a SEQUENCE
        INT choice;
        DWORD content;  // INTEGER, 16512..2113663;
        DWORD extension;  // INTEGER, 2113664..270549119;
    };
    
    struct IVIMExt1 {
        INT isValidFlag;   // necessary if this struct is used as an optional field of a SEQUENCE
        INT choice;
        WORD content;  // INTEGER, 128..16511;
        struct IVIMExt2 extension;  // CHOICE;
    };
    
    struct IVIMVarLengthNumber {
        INT isValidFlag;   // necessary if this struct is used as an optional field of a SEQUENCE
        INT choice;
        BYTE content;  // INTEGER, 0..127;
        struct IVIMExt1 extension;  // CHOICE;
    };
    
    struct IVIMLanePositions {
        INT isValidFlag;   // necessary if this struct is used as an optional field of a SEQUENCE
        INT length;
        INT arrayValue[8];  // INTEGER, -1..14, offTheRoad(-1), innerHardShoulder(0), innermostDrivingLane(1), secondLaneFromInside(2), outerHardShoulder(14);
    };
    
    struct IVIMEuVehicleCategoryCode {
        INT isValidFlag;   // necessary if this struct is used as an optional field of a SEQUENCE
        INT choice;
        INT euVehicleCategoryL;  // ENUMERATED, l1(0), l2(1), l3(2), l4(3), l5(4), l6(5), l7(6);
        INT euVehicleCategoryM;  // ENUMERATED, m1(0), m2(1), m3(2);
        INT euVehicleCategoryN;  // ENUMERATED, n1(0), n2(1), n3(2);
        INT euVehicleCategoryO;  // ENUMERATED, o1(0), o2(1), o3(2), o4(3);
    };
    
    struct IVIMEnvironmentalCharacteristics {
        INT isValidFlag;   // necessary if this struct is used as an optional field of a SEQUENCE
        INT euroValue;  // ENUMERATED, noEntry(0), euro_1(1), euro_2(2), euro_3(3), euro_4(4), euro_5(5), euro_6(6), reservedForUse1(7), reservedForUse2(8), reservedForUse3(9), reservedForUse4(10), reservedForUse5(11), reservedForUse6(12), reservedForUse7(13), reservedForUse8(14), eev(15);
        INT copValue;  // ENUMERATED, noEntry(0), co2class1(1), co2class2(2), co2class3(3), co2class4(4), co2class5(5), co2class6(6), co2class7(7), reservedforUse(8);
    };
    
    struct IVIMSpecialTransportType {
        INT isValidFlag;   // necessary if this struct is used as an optional field of a SEQUENCE
        CHAR string[5];
        INT  stringLength;
    };
    
    struct IVIMLoadType {
        INT isValidFlag;   // necessary if this struct is used as an optional field of a SEQUENCE
        BYTE goodsType;  // INTEGER, 0..15, ammunition(0), chemicals(1), empty(2), fuel(3), glass(4), dangerous(5), liquid(6), liveStock(7), dangerousForPeople(8), dangerousForTheEnvironment(9), dangerousForWater(10), perishableProducts(11), pharmaceutical(12), vehicles(13);
        INT dangerousGoodsType;  // ENUMERATED, explosives1(0), explosives2(1), explosives3(2), explosives4(3), explosives5(4), explosives6(5), flammableGases(6), nonFlammableGases(7), toxicGases(8), flammableLiquids(9), flammableSolids(10), substancesLiableToSpontaneousCombustion(11), substancesEmittingFlammableGasesUponContactWithWater(12), oxidizingSubstances(13), organicPeroxides(14), toxicSubstances(15), infectiousSubstances(16), radioactiveMaterial(17), corrosiveSubstances(18), miscellaneousDangerousSubstances(19);
        struct IVIMSpecialTransportType specialTransportType;  // BITSTRING;
    };
    
    struct IVIMVehicleCharacteristicsFixValues {
        INT isValidFlag;   // necessary if this struct is used as an optional field of a SEQUENCE
        INT choice;
        BYTE simpleVehicleType;  // INTEGER, 0..255, unknown(0), pedestrian(1), cyclist(2), moped(3), motorcycle(4), passengerCar(5), bus(6), lightTruck(7), heavyTruck(8), trailer(9), specialVehicles(10), tram(11), roadSideUnit(15);
        struct IVIMEuVehicleCategoryCode euVehicleCategoryCode;  // CHOICE;
        BYTE iso3833VehicleType;  // INTEGER, 0..255, passengerCar(0), saloon(1), convertibleSaloon(2), pullmanSaloon(3), stationWagon(4), truckStationWagon(5), coupe(6), convertible(7), multipurposePassengerCar(8), forwardControlPassengerCar(9), specialPassengerCar(10), bus(11), minibus(12), urbanBus(13), interurbanCoach(14), longDistanceCoach(15), articulatedBus(16), trolleyBus(17), specialBus(18), commercialVehicle(19), specialCommercialVehicle(20), specialVehicle(21), trailingTowingVehicle(22), semiTrailerTowingVehicle(23), trailer(24), busTrailer(25), generalPurposeTrailer(26), caravan(27), specialTrailer(28), semiTrailer(29), busSemiTrailer(30), generalPurposeSemiTrailer(31), specialSemiTrailer(32), roadTrain(33), passengerRoadTrain(34), articulatedRoadTrain(35), doubleRoadTrain(36), compositeRoadTrain(37), specialRoadTrain(38), moped(39), motorCycle(40);
        struct IVIMEnvironmentalCharacteristics euroAndCo2value;  // SEQUENCE;
        BYTE engineCharacteristics;  // INTEGER, 0..255, noEntry(0), noEngine(1), petrolUnleaded(2), petrolLeaded(3), diesel(4), lPG(5), battery(6), solar(7), hybrid(8), hydrogen(9);
        struct IVIMLoadType loadType;  // SEQUENCE;
        INT usage;  // ENUMERATED, default(0), publicTransport(1), specialTransport(2), dangerousGoods(3), roadWork(4), rescue(5), emergency(6), safetyCar(7), agriculture(8), commercial(9), military(10), roadOperator(11), taxi(12), reserved1(13), reserved2(14), reserved3(15);
    };
    
    struct IVIMVehicleCharacteristicsFixValuesList {
        INT isValidFlag;   // necessary if this struct is used as an optional field of a SEQUENCE
        INT length;
        struct IVIMVehicleCharacteristicsFixValues arrayValue[4];  // CHOICE;
    };
    
    struct IVIMVehicleDimensions {
        INT isValidFlag;   // necessary if this struct is used as an optional field of a SEQUENCE
        BYTE vehicleLengthOverall;  // INTEGER, 0..255;
        BYTE vehicleHeigthOverall;  // INTEGER, 0..255;
        BYTE vehicleWidthOverall;  // INTEGER, 0..255;
    };
    
    struct IVIMVehicleWeightLimits {
        INT isValidFlag;   // necessary if this struct is used as an optional field of a SEQUENCE
        WORD vehicleMaxLadenWeight;  // INTEGER, 0..65535;
        WORD vehicleTrainMaximumWeight;  // INTEGER, 0..65535;
        WORD vehicleWeightUnladen;  // INTEGER, 0..65535;
    };
    
    struct IVIMAxleWeightLimits {
        INT isValidFlag;   // necessary if this struct is used as an optional field of a SEQUENCE
        WORD maxLadenweightOnAxle1;  // INTEGER, 0..65535;
        WORD maxLadenweightOnAxle2;  // INTEGER, 0..65535;
        WORD maxLadenweightOnAxle3;  // INTEGER, 0..65535;
        WORD maxLadenweightOnAxle4;  // INTEGER, 0..65535;
        WORD maxLadenweightOnAxle5;  // INTEGER, 0..65535;
    };
    
    struct IVIMPassengerCapacity {
        INT isValidFlag;   // necessary if this struct is used as an optional field of a SEQUENCE
        BYTE numberOfSeats;  // INTEGER, 0..255;
        BYTE numberOfStandingPlaces;  // INTEGER, 0..255;
    };
    
    struct IVIMExhaustEmissionValues {
        INT isValidFlag;   // necessary if this struct is used as an optional field of a SEQUENCE
        INT unitType;  // ENUMERATED, mg_km(0), mg_kWh(1);
        WORD emissionCO;  // INTEGER, 0..32767;
        WORD emissionHC;  // INTEGER, 0..65535;
        WORD emissionNOX;  // INTEGER, 0..65535;
        WORD emissionHCNOX;  // INTEGER, 0..65535;
    };
    
    struct IVIMDieselEmissionValues_particulate {
        INT isValidFlag;   // necessary if this struct is used as an optional field of a SEQUENCE
        INT unitType;  // ENUMERATED, mg_km(0), mg_kWh(1);
        WORD value;  // INTEGER, 0..32767;
    };
    
    struct IVIMDieselEmissionValues {
        INT isValidFlag;   // necessary if this struct is used as an optional field of a SEQUENCE
        struct IVIMDieselEmissionValues_particulate particulate;  // SEQUENCE;
        WORD absorptionCoeff;  // INTEGER, 0..65535;
    };
    
    struct IVIMSoundLevel {
        INT isValidFlag;   // necessary if this struct is used as an optional field of a SEQUENCE
        BYTE soundstationary;  // INTEGER, 0..255;
        BYTE sounddriveby;  // INTEGER, 0..255;
    };
    
    struct IVIMVehicleCharacteristicsRanges_limits {
        INT isValidFlag;   // necessary if this struct is used as an optional field of a SEQUENCE
        INT choice;
        BYTE numberOfAxles;  // INTEGER, 0..7;
        struct IVIMVehicleDimensions vehicleDimensions;  // SEQUENCE;
        struct IVIMVehicleWeightLimits vehicleWeightLimits;  // SEQUENCE;
        struct IVIMAxleWeightLimits axleWeightLimits;  // SEQUENCE;
        struct IVIMPassengerCapacity passengerCapacity;  // SEQUENCE;
        struct IVIMExhaustEmissionValues exhaustEmissionValues;  // SEQUENCE;
        struct IVIMDieselEmissionValues dieselEmissionValues;  // SEQUENCE;
        struct IVIMSoundLevel soundLevel;  // SEQUENCE;
    };
    
    struct IVIMVehicleCharacteristicsRanges {
        INT isValidFlag;   // necessary if this struct is used as an optional field of a SEQUENCE
        BYTE comparisonOperator;  // INTEGER, 0..3, greaterThan(0), greaterThanOrEqualTo(1), lessThan(2), lessThanOrEqualTo(3);
        struct IVIMVehicleCharacteristicsRanges_limits limits;  // CHOICE;
    };
    
    struct IVIMVehicleCharacteristicsRangesList {
        INT isValidFlag;   // necessary if this struct is used as an optional field of a SEQUENCE
        INT length;
        struct IVIMVehicleCharacteristicsRanges arrayValue[4];  // SEQUENCE;
    };
    
    struct IVIMTractorCharacteristics {
        INT isValidFlag;   // necessary if this struct is used as an optional field of a SEQUENCE
        struct IVIMVehicleCharacteristicsFixValuesList equalTo;  // SEQUENCEOF, OPTIONAL;
        struct IVIMVehicleCharacteristicsFixValuesList notEqualTo;  // SEQUENCEOF, OPTIONAL;
        struct IVIMVehicleCharacteristicsRangesList ranges;  // SEQUENCEOF, OPTIONAL;
    };
    
    struct IVIMTrailerCharacteristicsFixValuesList {
        INT isValidFlag;   // necessary if this struct is used as an optional field of a SEQUENCE
        INT length;
        struct IVIMVehicleCharacteristicsFixValues arrayValue[4];  // CHOICE;
    };
    
    struct IVIMTrailerCharacteristicsRangesList {
        INT isValidFlag;   // necessary if this struct is used as an optional field of a SEQUENCE
        INT length;
        struct IVIMVehicleCharacteristicsRanges arrayValue[4];  // SEQUENCE;
    };
    
    struct IVIMTrailerCharacteristics {
        INT isValidFlag;   // necessary if this struct is used as an optional field of a SEQUENCE
        struct IVIMTrailerCharacteristicsFixValuesList equalTo;  // SEQUENCEOF, OPTIONAL;
        struct IVIMTrailerCharacteristicsFixValuesList notEqualTo;  // SEQUENCEOF, OPTIONAL;
        struct IVIMTrailerCharacteristicsRangesList ranges;  // SEQUENCEOF, OPTIONAL;
    };
    
    struct IVIMTrailerCharacteristicsList {
        INT isValidFlag;   // necessary if this struct is used as an optional field of a SEQUENCE
        INT length;
        struct IVIMTrailerCharacteristics arrayValue[3];  // SEQUENCE;
    };
    
    struct IVIMCompleteVehicleCharacteristics {
        INT isValidFlag;   // necessary if this struct is used as an optional field of a SEQUENCE
        struct IVIMTractorCharacteristics tractor;  // SEQUENCE, OPTIONAL;
        struct IVIMTrailerCharacteristicsList trailer;  // SEQUENCEOF, OPTIONAL;
        struct IVIMTractorCharacteristics train;  // SEQUENCE, OPTIONAL;
    };
    
    struct IVIMVehicleCharacteristicsList {
        INT isValidFlag;   // necessary if this struct is used as an optional field of a SEQUENCE
        INT length;
        struct IVIMCompleteVehicleCharacteristics arrayValue[8];  // SEQUENCE;
    };
    
    struct IVIMInternationalSign_applicablePeriod_year {
        INT isValidFlag;   // necessary if this struct is used as an optional field of a SEQUENCE
        WORD yearRangeStartYear;  // INTEGER, 2000..2127;
        WORD yearRangeEndYear;  // INTEGER, 2000..2127;
    };
    
    struct IVIMMonthDay {
        INT isValidFlag;   // necessary if this struct is used as an optional field of a SEQUENCE
        BYTE month;  // INTEGER, 1..12;
        BYTE day;  // INTEGER, 1..31;
    };
    
    struct IVIMInternationalSign_applicablePeriod_month_day {
        INT isValidFlag;   // necessary if this struct is used as an optional field of a SEQUENCE
        struct IVIMMonthDay dateRangeStartMonthDay;  // SEQUENCE;
        struct IVIMMonthDay dateRangeEndMonthDay;  // SEQUENCE;
    };
    
    struct IVIMRepeatingPeriodDayTypes {
        INT isValidFlag;   // necessary if this struct is used as an optional field of a SEQUENCE
        CHAR string[5];
        INT  stringLength;
    };
    
    struct IVIMHoursMinutes {
        INT isValidFlag;   // necessary if this struct is used as an optional field of a SEQUENCE
        BYTE hours;  // INTEGER, 0..23;
        BYTE mins;  // INTEGER, 0..59;
    };
    
    struct IVIMInternationalSign_applicablePeriod_hourMinutes {
        INT isValidFlag;   // necessary if this struct is used as an optional field of a SEQUENCE
        struct IVIMHoursMinutes timeRangeStartTime;  // SEQUENCE;
        struct IVIMHoursMinutes timeRangeEndTime;  // SEQUENCE;
    };
    
    struct IVIMDayOfWeek {
        INT isValidFlag;   // necessary if this struct is used as an optional field of a SEQUENCE
        CHAR string[9];
        INT  stringLength;
    };
    
    struct IVIMInternationalSign_applicablePeriod {
        INT isValidFlag;   // necessary if this struct is used as an optional field of a SEQUENCE
        struct IVIMInternationalSign_applicablePeriod_year year;  // SEQUENCE, OPTIONAL;
        struct IVIMInternationalSign_applicablePeriod_month_day month_day;  // SEQUENCE, OPTIONAL;
        struct IVIMRepeatingPeriodDayTypes repeatingPeriodDayTypes;  // BITSTRING, OPTIONAL;
        struct IVIMInternationalSign_applicablePeriod_hourMinutes hourMinutes;  // SEQUENCE, OPTIONAL;
        struct IVIMDayOfWeek dateRangeOfWeek;  // BITSTRING, OPTIONAL;
        struct IVIMHoursMinutes durationHourMinute;  // SEQUENCE, OPTIONAL;
    };
    
    struct IVIMValidityPeriods {
        INT isValidFlag;   // necessary if this struct is used as an optional field of a SEQUENCE
        INT length;
        struct IVIMInternationalSign_applicablePeriod arrayValue[8];  // SEQUENCE;
    };
    
    struct IVIMVcCode {
        INT isValidFlag;   // necessary if this struct is used as an optional field of a SEQUENCE
        BYTE roadSignClass;  // INTEGER, 0..7, classA(0), classB(1), classC(2), classD(3), classE(4), classF(5), classG(6), classH(7);
        BYTE roadSignCode;  // INTEGER, 1..64;
        BYTE vcOption;  // INTEGER, 0..7, none(0), a(1), b(2), c(3), d(4), e(5), f(6), g(7);
        struct IVIMValidityPeriods validity;  // SEQUENCEOF, OPTIONAL;
        struct OPT_WORD_ASN value;  // INTEGER, OPTIONAL, 0..65535;
        struct OPT_BYTE_ASN unit;  // INTEGER, OPTIONAL, 0..15, kmperh(0), milesperh(1), kilometer(2), meter(3), decimeter(4), centimeter(5), mile(6), yard(7), foot(8), minutesOfTime(9), tonnes(10), hundredkg(11), pound(12), rateOfIncline(13);
    };
    
    struct IVIMISO14823Code_pictogramCode_countryCode {
        INT isValidFlag;   // necessary if this struct is used as an optional field of a SEQUENCE
        CHAR string[3];
        INT  stringLength;
    };
    
    struct IVIMISO14823Code_pictogramCode_serviceCategoryCode {
        INT isValidFlag;   // necessary if this struct is used as an optional field of a SEQUENCE
        INT choice;
        INT trafficSignPictogram;  // ENUMERATED, dangerWarning(0), regulatory(1), informative(2);
        INT publicFacilitiesPictogram;  // ENUMERATED, publicFacilities(0);
        INT ambientOrRoadConditionPictogram;  // ENUMERATED, ambientCondition(0), roadCondition(1);
    };
    
    struct IVIMISO14823Code_pictogramCode_pictogramCategoryCode {
        INT isValidFlag;   // necessary if this struct is used as an optional field of a SEQUENCE
        BYTE nature;  // INTEGER, 1..9;
        BYTE serialNumber;  // INTEGER, 0..99;
    };
    
    struct IVIMISO14823Code_pictogramCode {
        INT isValidFlag;   // necessary if this struct is used as an optional field of a SEQUENCE
        struct IVIMISO14823Code_pictogramCode_countryCode countryCode;  // OCTETSTRING, OPTIONAL;
        struct IVIMISO14823Code_pictogramCode_serviceCategoryCode serviceCategoryCode;  // CHOICE;
        struct IVIMISO14823Code_pictogramCode_pictogramCategoryCode pictogramCategoryCode;  // SEQUENCE;
    };
    
    struct IVIMDistance {
        INT isValidFlag;   // necessary if this struct is used as an optional field of a SEQUENCE
        WORD value;  // INTEGER, 1..16384;
        BYTE unit;  // INTEGER, 2..8, kilometre(2), metre(3), decimetre(4), mile(6), yard(7), foot(8);
    };
    
    struct IVIMWeight {
        INT isValidFlag;   // necessary if this struct is used as an optional field of a SEQUENCE
        WORD value;  // INTEGER, 1..16384;
        BYTE unit;  // INTEGER, 10..12, tonnes(10), hundredkg(11), pound(12);
    };
    
    struct IVIMInternationalSign_applicableVehicleDimensions {
        INT isValidFlag;   // necessary if this struct is used as an optional field of a SEQUENCE
        struct IVIMDistance vehicleHeight;  // SEQUENCE, OPTIONAL;
        struct IVIMDistance vehicleWidth;  // SEQUENCE, OPTIONAL;
        struct IVIMDistance vehicleLength;  // SEQUENCE, OPTIONAL;
        struct IVIMWeight vehicleWeight;  // SEQUENCE, OPTIONAL;
    };
    
    struct IVIMInternationalSign_speedLimits {
        INT isValidFlag;   // necessary if this struct is used as an optional field of a SEQUENCE
        struct OPT_BYTE_ASN speedLimitMax;  // INTEGER, OPTIONAL, 0..250;
        struct OPT_BYTE_ASN speedLimitMin;  // INTEGER, OPTIONAL, 0..250;
        BYTE unit;  // INTEGER, 0..1, kmperh(0), milesperh(1);
    };
    
    struct IVIMGddStructure_pictogramCode_countryCode {
        INT isValidFlag;   // necessary if this struct is used as an optional field of a SEQUENCE
        CHAR string[3];
        INT  stringLength;
    };
    
    struct IVIMGddStructure_pictogramCode_serviceCategoryCode {
        INT isValidFlag;   // necessary if this struct is used as an optional field of a SEQUENCE
        INT choice;
        INT trafficSignPictogram;  // ENUMERATED, dangerWarning(0), regulatory(1), informative(2);
        INT publicFacilitiesPictogram;  // ENUMERATED, publicFacilities(0);
        INT ambientOrRoadConditionPictogram;  // ENUMERATED, ambientCondition(0), roadCondition(1);
    };
    
    struct IVIMGddStructure_pictogramCode_pictogramCategoryCode {
        INT isValidFlag;   // necessary if this struct is used as an optional field of a SEQUENCE
        BYTE nature;  // INTEGER, 1..9;
        BYTE serialNumber;  // INTEGER, 0..99;
    };
    
    struct IVIMGddStructure_pictogramCode {
        INT isValidFlag;   // necessary if this struct is used as an optional field of a SEQUENCE
        struct IVIMGddStructure_pictogramCode_countryCode countryCode;  // OCTETSTRING, OPTIONAL;
        struct IVIMGddStructure_pictogramCode_serviceCategoryCode serviceCategoryCode;  // CHOICE;
        struct IVIMGddStructure_pictogramCode_pictogramCategoryCode pictogramCategoryCode;  // SEQUENCE;
    };
    
    struct IVIMInternationalSign_destinationInformation {
        INT isValidFlag;   // necessary if this struct is used as an optional field of a SEQUENCE
        struct OPT_BYTE_ASN junctionDirection;  // INTEGER, OPTIONAL, 1..128;
        struct OPT_BYTE_ASN roundaboutCwDirection;  // INTEGER, OPTIONAL, 1..128;
        struct OPT_BYTE_ASN roundaboutCcwDirection;  // INTEGER, OPTIONAL, 1..128;
        //struct IVIMDDD_IO_LIST ioList;  // SEQUENCEOF;  // Loop, not supported
    };
    
    struct IVIMInternationalSign_section {
        INT isValidFlag;   // necessary if this struct is used as an optional field of a SEQUENCE
        struct IVIMDistance startingPointLength;  // SEQUENCE, OPTIONAL;
        struct IVIMDistance continuityLength;  // SEQUENCE, OPTIONAL;
    };
    
    struct IVIMGddAttribute {
        INT isValidFlag;   // necessary if this struct is used as an optional field of a SEQUENCE
        INT choice;
        struct IVIMInternationalSign_applicablePeriod dtm;  // SEQUENCE;
        struct IVIMInternationalSign_applicablePeriod edt;  // SEQUENCE;
        BYTE dfl;  // INTEGER, 1..8, sDL(1), sLT(2), sRT(3), lTO(4), rTO(5), cLL(6), cRI(7), oVL(8);
        struct IVIMInternationalSign_applicableVehicleDimensions ved;  // SEQUENCE;
        struct IVIMInternationalSign_speedLimits spe;  // SEQUENCE;
        BYTE roi;  // INTEGER, 1..32;
        struct IVIMDistance dbv;  // SEQUENCE;
        struct IVIMInternationalSign_destinationInformation ddd;  // SEQUENCE;
        struct IVIMInternationalSign_section set;  // SEQUENCE;
        BYTE nol;  // INTEGER, 0..99;
    };
    
    struct IVIMGddAttributes {
        INT isValidFlag;   // necessary if this struct is used as an optional field of a SEQUENCE
        INT length;
        struct IVIMGddAttribute arrayValue[8];  // CHOICE;
    };
    
    struct IVIMGddStructure {
        INT isValidFlag;   // necessary if this struct is used as an optional field of a SEQUENCE
        struct IVIMGddStructure_pictogramCode pictogramCode;  // SEQUENCE;
        struct IVIMGddAttributes attributes;  // SEQUENCEOF, OPTIONAL;
    };
    
    struct IVIMDestinationPlace_destBlob {
        INT isValidFlag;   // necessary if this struct is used as an optional field of a SEQUENCE
        CHAR string[256];
        INT  stringLength;
    };
    
    struct IVIMDestinationPlace_placeNameText {
        INT isValidFlag;   // necessary if this struct is used as an optional field of a SEQUENCE
        CHAR string[256];
        INT  stringLength;
    };
    
    struct IVIMDestinationPlace {
        INT isValidFlag;   // necessary if this struct is used as an optional field of a SEQUENCE
        BYTE destType;  // INTEGER, 0..15, none(0), importantArea(1), principalArea(2), generalArea(3), wellKnownPoint(4), country(5), city(6), street(7), industrialArea(8), historicArea(9), touristicArea(10), culturalArea(11), touristicRoute(12), recommendedRoute(13), touristicAttraction(14), geographicArea(15);
        struct IVIMGddStructure destRSCode;  // SEQUENCE, OPTIONAL;
        struct IVIMDestinationPlace_destBlob destBlob;  // OCTETSTRING, OPTIONAL;
        struct OPT_WORD_ASN placeNameIdentification;  // INTEGER, OPTIONAL, 1..999;
        struct IVIMDestinationPlace_placeNameText placeNameText;  // UTF8STRING, OPTIONAL;
    };
    
    struct IVIMDestinationPlaces {
        INT isValidFlag;   // necessary if this struct is used as an optional field of a SEQUENCE
        INT length;
        struct IVIMDestinationPlace arrayValue[4];  // SEQUENCE;
    };
    
    struct IVIMDestinationRoad_roadNumberText {
        INT isValidFlag;   // necessary if this struct is used as an optional field of a SEQUENCE
        CHAR string[256];
        INT  stringLength;
    };
    
    struct IVIMDestinationRoad {
        INT isValidFlag;   // necessary if this struct is used as an optional field of a SEQUENCE
        BYTE derType;  // INTEGER, 0..15, none(0), nationalHighway(1), localHighway(2), tollExpresswayMotorway(3), internationalHighway(4), highway(5), expressway(6), nationalRoad(7), regionalProvincialRoad(8), localRoad(9), motorwayJunction(10), diversion(11), rfu1(12), rfu2(13), rfu3(14), rfu4(15);
        struct OPT_WORD_ASN roadNumberIdentifier;  // INTEGER, OPTIONAL, 1..999;
        struct IVIMDestinationRoad_roadNumberText roadNumberText;  // UTF8STRING, OPTIONAL;
    };
    
    struct IVIMDestinationRoads {
        INT isValidFlag;   // necessary if this struct is used as an optional field of a SEQUENCE
        INT length;
        struct IVIMDestinationRoad arrayValue[4];  // SEQUENCE;
    };
    
    struct IVIMDDD_IO_streetNameText {
        INT isValidFlag;   // necessary if this struct is used as an optional field of a SEQUENCE
        CHAR string[256];
        INT  stringLength;
    };
    
    struct IVIMDistanceOrDuration {
        INT isValidFlag;   // necessary if this struct is used as an optional field of a SEQUENCE
        WORD value;  // INTEGER, 1..16384;
        BYTE unit;  // INTEGER, 2..9, kilometre(2), metre(3), decimetre(4), centimetre(5), mile(6), yard(7), foot(8), minutesOfTime(9);
    };
    
    struct IVIMDDD_IO {
        INT isValidFlag;   // necessary if this struct is used as an optional field of a SEQUENCE
        BYTE arrowDirection;  // INTEGER, 0..7;
        struct IVIMDestinationPlaces destPlace;  // SEQUENCEOF, OPTIONAL;
        struct IVIMDestinationRoads destRoad;  // SEQUENCEOF, OPTIONAL;
        struct OPT_WORD_ASN roadNumberIdentifier;  // INTEGER, OPTIONAL, 1..999;
        struct OPT_WORD_ASN streetName;  // INTEGER, OPTIONAL, 1..999;
        struct IVIMDDD_IO_streetNameText streetNameText;  // UTF8STRING, OPTIONAL;
        struct IVIMDistanceOrDuration distanceToDivergingPoint;  // SEQUENCE, OPTIONAL;
        struct IVIMDistanceOrDuration distanceToDestinationPlace;  // SEQUENCE, OPTIONAL;
    };
    
    struct IVIMDDD_IO_LIST {
        INT isValidFlag;   // necessary if this struct is used as an optional field of a SEQUENCE
        INT length;
        struct IVIMDDD_IO arrayValue[8];  // SEQUENCE;
    };
    
    struct IVIMISO14823Attribute {
        INT isValidFlag;   // necessary if this struct is used as an optional field of a SEQUENCE
        INT choice;
        struct IVIMInternationalSign_applicablePeriod dtm;  // SEQUENCE;
        struct IVIMInternationalSign_applicablePeriod edt;  // SEQUENCE;
        BYTE dfl;  // INTEGER, 1..8, sDL(1), sLT(2), sRT(3), lTO(4), rTO(5), cLL(6), cRI(7), oVL(8);
        struct IVIMInternationalSign_applicableVehicleDimensions ved;  // SEQUENCE;
        struct IVIMInternationalSign_speedLimits spe;  // SEQUENCE;
        BYTE roi;  // INTEGER, 1..32;
        struct IVIMDistance dbv;  // SEQUENCE;
        struct IVIMInternationalSign_destinationInformation ddd;  // SEQUENCE;
    };
    
    struct IVIMISO14823Attributes {
        INT isValidFlag;   // necessary if this struct is used as an optional field of a SEQUENCE
        INT length;
        struct IVIMISO14823Attribute arrayValue[8];  // CHOICE;
    };
    
    struct IVIMISO14823Code {
        INT isValidFlag;   // necessary if this struct is used as an optional field of a SEQUENCE
        struct IVIMISO14823Code_pictogramCode pictogramCode;  // SEQUENCE;
        struct IVIMISO14823Attributes attributes;  // SEQUENCEOF, OPTIONAL;
    };
    
    struct IVIMAnyCatalogue {
        INT isValidFlag;   // necessary if this struct is used as an optional field of a SEQUENCE
        struct IVIMProvider owner;  // SEQUENCE;
        BYTE version;  // INTEGER, 0..255;
        WORD pictogramCode;  // INTEGER, 0..65535;
        struct OPT_WORD_ASN value;  // INTEGER, OPTIONAL, 0..65535;
        struct OPT_BYTE_ASN unit;  // INTEGER, OPTIONAL, 0..15, kmperh(0), milesperh(1), kilometer(2), meter(3), decimeter(4), centimeter(5), mile(6), yard(7), foot(8), minutesOfTime(9), tonnes(10), hundredkg(11), pound(12), rateOfIncline(13);
        struct IVIMISO14823Attributes attributes;  // SEQUENCEOF, OPTIONAL;
    };
    
    struct IVIMRSCode_code {
        INT isValidFlag;   // necessary if this struct is used as an optional field of a SEQUENCE
        INT choice;
        struct IVIMVcCode viennaConvention;  // SEQUENCE;
        struct IVIMISO14823Code iso14823;  // SEQUENCE;
        WORD itisCodes;  // INTEGER, 0..65535;
        struct IVIMAnyCatalogue anyCatalogue;  // SEQUENCE;
    };
    
    struct IVIMRSCode {
        INT isValidFlag;   // necessary if this struct is used as an optional field of a SEQUENCE
        struct OPT_BYTE_ASN layoutComponentId;  // INTEGER, OPTIONAL, 1..4;
        struct IVIMRSCode_code code;  // CHOICE;
    };
    
    struct IVIMRoadSignCodes {
        INT isValidFlag;   // necessary if this struct is used as an optional field of a SEQUENCE
        INT length;
        struct IVIMRSCode arrayValue[4];  // SEQUENCE;
    };
    
    struct IVIMText_language {
        INT isValidFlag;   // necessary if this struct is used as an optional field of a SEQUENCE
        CHAR string[11];
        INT  stringLength;
    };
    
    struct IVIMText_textContent {
        INT isValidFlag;   // necessary if this struct is used as an optional field of a SEQUENCE
        CHAR string[256];
        INT  stringLength;
    };
    
    struct IVIMText {
        INT isValidFlag;   // necessary if this struct is used as an optional field of a SEQUENCE
        struct OPT_BYTE_ASN layoutComponentId;  // INTEGER, OPTIONAL, 1..4;
        struct IVIMText_language language;  // BITSTRING;
        struct IVIMText_textContent textContent;  // UTF8STRING;
    };
    
    struct IVIMConstraintTextLines1 {
        INT isValidFlag;   // necessary if this struct is used as an optional field of a SEQUENCE
        INT length;
        struct IVIMText arrayValue[4];  // SEQUENCE;
    };
    
    struct IVIMGicPart {
        INT isValidFlag;   // necessary if this struct is used as an optional field of a SEQUENCE
        struct IVIMZoneIds detectionZoneIds;  // SEQUENCEOF, OPTIONAL;
        struct IVIMVarLengthNumber its_Rrid;  // CHOICE, OPTIONAL;
        struct IVIMZoneIds relevanceZoneIds;  // SEQUENCEOF, OPTIONAL;
        struct OPT_BYTE_ASN direction;  // INTEGER, OPTIONAL, 0..3, sameDirection(0), oppositeDirection(1), bothDirections(2), valueNotUsed(3);
        struct IVIMZoneIds driverAwarenessZoneIds;  // SEQUENCEOF, OPTIONAL;
        struct OPT_BYTE_ASN minimumAwarenessTime;  // INTEGER, OPTIONAL, 0..255;
        struct IVIMLanePositions applicableLanes;  // SEQUENCEOF, OPTIONAL;
        BYTE iviType;  // INTEGER, 0..7, immediateDangerWarningMessages(0), regulatoryMessages(1), trafficRelatedInformationMessages(2), pollutionMessages(3), notTrafficRelatedInformationMessages(4);
        struct OPT_BYTE_ASN iviPurpose;  // INTEGER, OPTIONAL, 0..3, safety(0), environmental(1), trafficOptimisation(2);
        struct OPT_BYTE_ASN laneStatus;  // INTEGER, OPTIONAL, 0..7, open(0), closed(1), mergeR(2), mergeL(3), mergeLR(4), provisionallyOpen(5), diverging(6);
        struct IVIMVehicleCharacteristicsList vehicleCharacteristics;  // SEQUENCEOF, OPTIONAL;
        struct OPT_BYTE_ASN driverCharacteristics;  // INTEGER, OPTIONAL, 0..3, unexperiencedDrivers(0), experiencedDrivers(1), rfu1(2), rfu2(3);
        struct OPT_BYTE_ASN layoutId;  // INTEGER, OPTIONAL, 1..4;
        struct OPT_BYTE_ASN preStoredlayoutId;  // INTEGER, OPTIONAL, 1..64;
        struct IVIMRoadSignCodes roadSignCodes;  // SEQUENCEOF;
        struct IVIMConstraintTextLines1 extraText;  // SEQUENCEOF, OPTIONAL;
    };
    
    struct IVIMGeneralIviContainer {
        INT isValidFlag;   // necessary if this struct is used as an optional field of a SEQUENCE
        INT length;
        struct IVIMGicPart arrayValue[16];  // SEQUENCE;
    };
    
    struct IVIMLaneCharacteristics {
        INT isValidFlag;   // necessary if this struct is used as an optional field of a SEQUENCE
        BYTE zoneDefinitionAccuracy;  // INTEGER, 0..7, oneCm(0), twoCm(1), fiveCm(2), tenCm(3), twentyCm(4), fiftyCm(5), oneMeter(6), unavailable(7);
        INT existinglaneMarkingStatus;  // BOOLEAN;
        BYTE newlaneMarkingColour;  // INTEGER, 0..7, white(0), yellow(1), orange(2), red(3), blue(4), unavailable(7);
        BYTE laneDelimitationLeft;  // INTEGER, 0..7, noDelimitation(0), lowLaneSeparator(1), highLaneSeparator(2), wall(3), curb(4), unpaved(5), guardrail(6);
        BYTE laneDelimitationRight;  // INTEGER, 0..7, noDelimitation(0), lowLaneSeparator(1), highLaneSeparator(2), wall(3), curb(4), unpaved(5), guardrail(6);
        BYTE mergingWith;  // INTEGER, 1..32;
    };
    
    struct IVIMRoadSurfaceStaticCharacteristics {
        INT isValidFlag;   // necessary if this struct is used as an optional field of a SEQUENCE
        BYTE frictionCoefficient;  // INTEGER, 0..101;
        BYTE material;  // INTEGER, 0..7, asphalt(0), concrete(1), cobblestone(2), gravel(3), unavailable(7);
        BYTE wear;  // INTEGER, 0..7, new(0), good(1), bad(2), hasPotholes(3), unavailable(7);
        INT avBankingAngle;  // INTEGER, -20..21;
    };
    
    struct IVIMRoadSurfaceDynamicCharacteristics {
        INT isValidFlag;   // necessary if this struct is used as an optional field of a SEQUENCE
        BYTE condition;  // INTEGER, 0..15, dry(0), moist(1), wet(2), standingWater(3), frost(4), ice(5), snow(6), slush(7), unvailable(8);
        INT temperature;  // INTEGER, -100..151;
        BYTE iceOrWaterDepth;  // INTEGER, 0..255;
        BYTE treatment;  // INTEGER, 0..7, no(0), antiskid(1), anti_icing(2), de_icing(3), unavailable(7);
    };
    
    struct IVIMLaneInformation {
        INT isValidFlag;   // necessary if this struct is used as an optional field of a SEQUENCE
        INT laneNumber;  // INTEGER, -1..14, offTheRoad(-1), innerHardShoulder(0), innermostDrivingLane(1), secondLaneFromInside(2), outerHardShoulder(14);
        BYTE direction;  // INTEGER, 0..3, sameDirection(0), oppositeDirection(1), bothDirections(2), valueNotUsed(3);
        struct IVIMInternationalSign_applicablePeriod validity;  // SEQUENCE, OPTIONAL;
        BYTE laneType;  // INTEGER, 0..31, traffic(0), through(1), reversible(2), acceleration(3), deceleration(4), leftHandTurning(5), rightHandTurning(6), dedicatedVehicle(7), bus(8), taxi(9), hov(10), hot(11), pedestrian(12), bikeLane(13), median(14), striping(15), trackedVehicle(16), parking(17), emergency(18), verge(19), minimumRiskManoeuvre(20);
        struct IVIMCompleteVehicleCharacteristics laneTypeQualifier;  // SEQUENCE, OPTIONAL;
        BYTE laneStatus;  // INTEGER, 0..7, open(0), closed(1), mergeR(2), mergeL(3), mergeLR(4), provisionallyOpen(5), diverging(6);
        struct OPT_WORD_ASN laneWidth;  // INTEGER, OPTIONAL, 0..1023;
        struct IVIMZoneIds detectionZoneIds;  // SEQUENCEOF, OPTIONAL;
        struct IVIMZoneIds relevanceZoneIds;  // SEQUENCEOF, OPTIONAL;
        struct IVIMLaneCharacteristics laneCharacteristics;  // SEQUENCE, OPTIONAL;
        struct IVIMRoadSurfaceStaticCharacteristics laneSurfaceStaticCharacteristics;  // SEQUENCE, OPTIONAL;
        struct IVIMRoadSurfaceDynamicCharacteristics laneSurfaceDynamicCharacteristics;  // SEQUENCE, OPTIONAL;
    };
    
    struct IVIMLaneConfiguration {
        INT isValidFlag;   // necessary if this struct is used as an optional field of a SEQUENCE
        INT length;
        struct IVIMLaneInformation arrayValue[16];  // SEQUENCE;
    };
    
    struct IVIMRccPart {
        INT isValidFlag;   // necessary if this struct is used as an optional field of a SEQUENCE
        struct IVIMZoneIds relevanceZoneIds;  // SEQUENCEOF;
        INT roadType;  // ENUMERATED, urban_NoStructuralSeparationToOppositeLanes(0), urban_WithStructuralSeparationToOppositeLanes(1), nonUrban_NoStructuralSeparationToOppositeLanes(2), nonUrban_WithStructuralSeparationToOppositeLanes(3);
        struct IVIMLaneConfiguration laneConfiguration;  // SEQUENCEOF;
    };
    
    struct IVIMRoadConfigurationContainer {
        INT isValidFlag;   // necessary if this struct is used as an optional field of a SEQUENCE
        INT length;
        struct IVIMRccPart arrayValue[16];  // SEQUENCE;
    };
    
    struct IVIMTextLines {
        INT isValidFlag;   // necessary if this struct is used as an optional field of a SEQUENCE
        INT length;
        struct IVIMText arrayValue[4];  // SEQUENCE;
    };
    
    struct IVIMTcPart_data {
        INT isValidFlag;   // necessary if this struct is used as an optional field of a SEQUENCE
        CHAR string[256];
        INT  stringLength;
    };
    
    struct IVIMTcPart {
        INT isValidFlag;   // necessary if this struct is used as an optional field of a SEQUENCE
        struct IVIMZoneIds detectionZoneIds;  // SEQUENCEOF, OPTIONAL;
        struct IVIMZoneIds relevanceZoneIds;  // SEQUENCEOF;
        struct OPT_BYTE_ASN direction;  // INTEGER, OPTIONAL, 0..3, sameDirection(0), oppositeDirection(1), bothDirections(2), valueNotUsed(3);
        struct IVIMZoneIds driverAwarenessZoneIds;  // SEQUENCEOF, OPTIONAL;
        struct OPT_BYTE_ASN minimumAwarenessTime;  // INTEGER, OPTIONAL, 0..255;
        struct IVIMLanePositions applicableLanes;  // SEQUENCEOF, OPTIONAL;
        struct OPT_BYTE_ASN layoutId;  // INTEGER, OPTIONAL, 1..4;
        struct OPT_BYTE_ASN preStoredlayoutId;  // INTEGER, OPTIONAL, 1..64;
        struct IVIMTextLines text;  // SEQUENCEOF, OPTIONAL;
        struct IVIMTcPart_data data;  // OCTETSTRING;
        BYTE iviType;  // INTEGER, 0..7, immediateDangerWarningMessages(0), regulatoryMessages(1), trafficRelatedInformationMessages(2), pollutionMessages(3), notTrafficRelatedInformationMessages(4);
        struct OPT_BYTE_ASN laneStatus;  // INTEGER, OPTIONAL, 0..7, open(0), closed(1), mergeR(2), mergeL(3), mergeLR(4), provisionallyOpen(5), diverging(6);
        struct IVIMVehicleCharacteristicsList vehicleCharacteristics;  // SEQUENCEOF, OPTIONAL;
    };
    
    struct IVIMTextContainer {
        INT isValidFlag;   // necessary if this struct is used as an optional field of a SEQUENCE
        INT length;
        struct IVIMTcPart arrayValue[16];  // SEQUENCE;
    };
    
    struct IVIMLayoutComponent {
        INT isValidFlag;   // necessary if this struct is used as an optional field of a SEQUENCE
        BYTE layoutComponentId;  // INTEGER, 1..8;
        BYTE height;  // INTEGER, 10..73;
        WORD width;  // INTEGER, 10..265;
        WORD x;  // INTEGER, 10..265;
        BYTE y;  // INTEGER, 10..73;
        BYTE textScripting;  // INTEGER, 0..1, horizontal(0), vertical(1);
    };
    
    struct IVIMLayoutComponents {
        INT isValidFlag;   // necessary if this struct is used as an optional field of a SEQUENCE
        INT length;
        struct IVIMLayoutComponent arrayValue[4];  // SEQUENCE;
    };
    
    struct IVIMLayoutContainer {
        INT isValidFlag;   // necessary if this struct is used as an optional field of a SEQUENCE
        BYTE layoutId;  // INTEGER, 1..4;
        struct OPT_BYTE_ASN height;  // INTEGER, OPTIONAL, 10..73;
        struct OPT_WORD_ASN width;  // INTEGER, OPTIONAL, 10..265;
        struct IVIMLayoutComponents layoutComponents;  // SEQUENCEOF;
    };
    
    struct IVIMSaeAutomationLevels {
        INT isValidFlag;   // necessary if this struct is used as an optional field of a SEQUENCE
        INT length;
        BYTE arrayValue[6];  // INTEGER, 0..5;
    };
    
    struct IVIMConstraintTextLines2 {
        INT isValidFlag;   // necessary if this struct is used as an optional field of a SEQUENCE
        INT length;
        struct IVIMText arrayValue[4];  // SEQUENCE;
    };
    
    struct IVIMAutomatedVehicleRule {
        INT isValidFlag;   // necessary if this struct is used as an optional field of a SEQUENCE
        BYTE priority;  // INTEGER, 0..2;
        struct IVIMSaeAutomationLevels allowedSaeAutomationLevels;  // SEQUENCEOF;
        struct OPT_BYTE_ASN minGapBetweenVehicles;  // INTEGER, OPTIONAL, 0..255;
        struct OPT_BYTE_ASN recGapBetweenVehicles;  // INTEGER, OPTIONAL, 0..255;
        struct OPT_WORD_ASN automatedVehicleMaxSpeedLimit;  // INTEGER, OPTIONAL, 0..16383, unavailable(16383);
        struct OPT_WORD_ASN automatedVehicleMinSpeedLimit;  // INTEGER, OPTIONAL, 0..16383, unavailable(16383);
        struct OPT_WORD_ASN automatedVehicleSpeedRecommendation;  // INTEGER, OPTIONAL, 0..16383, unavailable(16383);
        struct IVIMRoadSignCodes roadSignCodes;  // SEQUENCEOF, OPTIONAL;
        struct IVIMConstraintTextLines2 extraText;  // SEQUENCEOF, OPTIONAL;
    };
    
    struct IVIMAutomatedVehicleRules {
        INT isValidFlag;   // necessary if this struct is used as an optional field of a SEQUENCE
        INT length;
        struct IVIMAutomatedVehicleRule arrayValue[5];  // SEQUENCE;
    };
    
    struct IVIMPlatooningRule {
        INT isValidFlag;   // necessary if this struct is used as an optional field of a SEQUENCE
        BYTE priority;  // INTEGER, 0..2;
        struct IVIMSaeAutomationLevels allowedSaeAutomationLevels;  // SEQUENCEOF;
        struct OPT_BYTE_ASN maxNoOfVehicles;  // INTEGER, OPTIONAL, 2..64;
        struct OPT_BYTE_ASN maxLenghtOfPlatoon;  // INTEGER, OPTIONAL, 1..64;
        struct OPT_BYTE_ASN minGapBetweenVehicles;  // INTEGER, OPTIONAL, 0..255;
        struct OPT_WORD_ASN platoonMaxSpeedLimit;  // INTEGER, OPTIONAL, 0..16383, unavailable(16383);
        struct OPT_WORD_ASN platoonMinSpeedLimit;  // INTEGER, OPTIONAL, 0..16383, unavailable(16383);
        struct OPT_WORD_ASN platoonSpeedRecommendation;  // INTEGER, OPTIONAL, 0..16383, unavailable(16383);
        struct IVIMRoadSignCodes roadSignCodes;  // SEQUENCEOF, OPTIONAL;
        struct IVIMConstraintTextLines2 extraText;  // SEQUENCEOF, OPTIONAL;
    };
    
    struct IVIMPlatooningRules {
        INT isValidFlag;   // necessary if this struct is used as an optional field of a SEQUENCE
        INT length;
        struct IVIMPlatooningRule arrayValue[5];  // SEQUENCE;
    };
    
    struct IVIMAvcPart {
        INT isValidFlag;   // necessary if this struct is used as an optional field of a SEQUENCE
        struct IVIMZoneIds detectionZoneIds;  // SEQUENCEOF, OPTIONAL;
        struct IVIMZoneIds relevanceZoneIds;  // SEQUENCEOF;
        struct OPT_BYTE_ASN direction;  // INTEGER, OPTIONAL, 0..3, sameDirection(0), oppositeDirection(1), bothDirections(2), valueNotUsed(3);
        struct IVIMLanePositions applicableLanes;  // SEQUENCEOF, OPTIONAL;
        struct IVIMVehicleCharacteristicsList vehicleCharacteristics;  // SEQUENCEOF, OPTIONAL;
        struct IVIMAutomatedVehicleRules automatedVehicleRules;  // SEQUENCEOF, OPTIONAL;
        struct IVIMPlatooningRules platooningRules;  // SEQUENCEOF, OPTIONAL;
    };
    
    struct IVIMAutomatedVehicleContainer {
        INT isValidFlag;   // necessary if this struct is used as an optional field of a SEQUENCE
        INT length;
        struct IVIMAvcPart arrayValue[16];  // SEQUENCE;
    };
    
    struct IVIMRoadSegmentReferenceID {
        INT isValidFlag;   // necessary if this struct is used as an optional field of a SEQUENCE
        struct OPT_WORD_ASN region;  // INTEGER, OPTIONAL, 0..65535;
        WORD id;  // INTEGER, 0..65535;
    };
    
    struct IVIMIntersectionReferenceID {
        INT isValidFlag;   // necessary if this struct is used as an optional field of a SEQUENCE
        struct OPT_WORD_ASN region;  // INTEGER, OPTIONAL, 0..65535;
        WORD id;  // INTEGER, 0..65535;
    };
    
    struct IVIMMapReference {
        INT isValidFlag;   // necessary if this struct is used as an optional field of a SEQUENCE
        INT choice;
        struct IVIMRoadSegmentReferenceID roadsegment;  // SEQUENCE;
        struct IVIMIntersectionReferenceID intersection;  // SEQUENCE;
    };
    
    struct IVIMLaneIds {
        INT isValidFlag;   // necessary if this struct is used as an optional field of a SEQUENCE
        INT length;
        BYTE arrayValue[16];  // INTEGER, 0..255;
    };
    
    struct IVIMMlcPart {
        INT isValidFlag;   // necessary if this struct is used as an optional field of a SEQUENCE
        BYTE zoneId;  // INTEGER, 1..32;
        struct IVIMLaneIds laneIds;  // SEQUENCEOF, OPTIONAL;
    };
    
    struct IVIMMlcParts {
        INT isValidFlag;   // necessary if this struct is used as an optional field of a SEQUENCE
        INT length;
        struct IVIMMlcPart arrayValue[16];  // SEQUENCE;
    };
    
    struct IVIMMapLocationContainer {
        INT isValidFlag;   // necessary if this struct is used as an optional field of a SEQUENCE
        struct IVIMMapReference reference;  // CHOICE;
        struct IVIMMlcParts parts;  // SEQUENCEOF;
    };
    
    struct IVIMRscPart {
        INT isValidFlag;   // necessary if this struct is used as an optional field of a SEQUENCE
        struct IVIMZoneIds detectionZoneIds;  // SEQUENCEOF, OPTIONAL;
        struct IVIMZoneIds relevanceZoneIds;  // SEQUENCEOF;
        struct OPT_BYTE_ASN direction;  // INTEGER, OPTIONAL, 0..3, sameDirection(0), oppositeDirection(1), bothDirections(2), valueNotUsed(3);
        struct IVIMRoadSurfaceStaticCharacteristics roadSurfaceStaticCharacteristics;  // SEQUENCE, OPTIONAL;
        struct IVIMRoadSurfaceDynamicCharacteristics roadSurfaceDynamicCharacteristics;  // SEQUENCE, OPTIONAL;
    };
    
    struct IVIMRoadSurfaceContainer {
        INT isValidFlag;   // necessary if this struct is used as an optional field of a SEQUENCE
        INT length;
        struct IVIMRscPart arrayValue[16];  // SEQUENCE;
    };
    
    struct IVIMIviContainer {
        INT isValidFlag;   // necessary if this struct is used as an optional field of a SEQUENCE
        INT choice;
        struct IVIMGeographicLocationContainer glc;  // SEQUENCE;
        struct IVIMGeneralIviContainer giv;  // SEQUENCEOF;
        struct IVIMRoadConfigurationContainer rcc;  // SEQUENCEOF;
        struct IVIMTextContainer tc;  // SEQUENCEOF;
        struct IVIMLayoutContainer lac;  // SEQUENCE;
        struct IVIMAutomatedVehicleContainer avc;  // SEQUENCEOF;
        struct IVIMMapLocationContainer mlc;  // SEQUENCE;
        struct IVIMRoadSurfaceContainer rsc;  // SEQUENCEOF;
    };
    
    struct IVIMIviContainers {
        INT isValidFlag;   // necessary if this struct is used as an optional field of a SEQUENCE
        INT length;
        struct IVIMIviContainer arrayValue[8];  // CHOICE;
    };
    
    struct IVIMIviStructure {
        INT isValidFlag;   // necessary if this struct is used as an optional field of a SEQUENCE
        struct IVIMIviManagementContainer mandatory;  // SEQUENCE;
        struct IVIMIviContainers optional;  // SEQUENCEOF, OPTIONAL;
    };
    
    struct IVIM {
        INT isValidFlag;   // necessary if this struct is used as an optional field of a SEQUENCE
        struct IVIMItsPduHeader header;  // SEQUENCE;
        struct IVIMIviStructure ivi;  // SEQUENCE;
    };
    
}

/*
// init function to create a simple packet handle
*/ 
LONG API_InitIVIMPacket()
{
  return C2xInitPacket("IVIM"); 
}

/*
// init function to create a simple packet handle and
// initialize the struct with valid data
*/ 
LONG API_InitIVIMPacket(struct IVIM msgStruct)
{
  long pktHandle;

  pktHandle = API_InitIVIMPacket();

  if (pktHandle != 0)
  {
    // create valid message and application data
    if (C2xCompletePacket(pktHandle) == 0) 
    {
      API_GetIVIMParams(pktHandle, msgStruct);
    }
  }
  return pktHandle;
}

/*
// init function to create a packet with security layer and
// initialize the struct with valid data
*/ 
LONG API_InitIVIMPacket(struct IVIM msgStruct, char packetTypeDesignator[], char certificateName[])
{
  long pktHandle, certHdl;

  // initialize the packet
  pktHandle = C2xInitPacket("IVIM", packetTypeDesignator);

  if (pktHandle != 0)
  {
    certHdl = C2xSecCertificateGetHandle(certificateName);  // get the certificate handle for the cert with name "certificateName"
    if (certHdl != 0) 
    {
      C2xSecPacketSetSignerHandle(pktHandle, certHdl); // set the certHdl to the packet
    }

    // create valid message and application data
    if (C2xCompletePacket(pktHandle) == 0) 
    {
      // copy application data to the application structure
      API_GetIVIMParams(pktHandle, msgStruct);
    }
  }
  return pktHandle;
}
    

int GetIVIMItsPduHeaderParams(LONG packetHandle, struct IVIMItsPduHeader value, char oldPath[])
{
  char newPath[300];
  int result;

  result = 0;

  snprintf(newPath, elcount(newPath), "%s.%s", oldPath, "protocolVersion");
  value.protocolVersion = C2xGetTokenInt(packetHandle, "IVIM", newPath);
  result = CheckLastError("IVIM", gkFuncRefGet, result);

  snprintf(newPath, elcount(newPath), "%s.%s", oldPath, "messageID");
  value.messageID = C2xGetTokenInt(packetHandle, "IVIM", newPath);
  result = CheckLastError("IVIM", gkFuncRefGet, result);

  snprintf(newPath, elcount(newPath), "%s.%s", oldPath, "stationID");
  value.stationID = C2xGetTokenInt64(packetHandle, "IVIM", newPath);
  result = CheckLastError("IVIM", gkFuncRefGet, result);

  return result;
}

int SetIVIMItsPduHeaderParams(LONG packetHandle, struct IVIMItsPduHeader value, char oldPath[])
{
  char newPath[300];
  int result;

  result = 0;

  snprintf(newPath, elcount(newPath), "%s.%s", oldPath, "protocolVersion");
  C2xSetTokenInt(packetHandle, "IVIM", newPath, value.protocolVersion);
  result = CheckLastError("IVIM", gkFuncRefGet, result);

  snprintf(newPath, elcount(newPath), "%s.%s", oldPath, "messageID");
  C2xSetTokenInt(packetHandle, "IVIM", newPath, value.messageID);
  result = CheckLastError("IVIM", gkFuncRefGet, result);

  snprintf(newPath, elcount(newPath), "%s.%s", oldPath, "stationID");
  C2xSetTokenInt64(packetHandle, "IVIM", newPath, value.stationID);
  result = CheckLastError("IVIM", gkFuncRefGet, result);

  return result;
}

int GetIVIMProviderParams(LONG packetHandle, struct IVIMProvider value, char oldPath[])
{
  char newPath[300]; 
  int j; 
  int k;
  int result;

  result = 0;

  snprintf(newPath, elcount(newPath), "%s.%s", oldPath, "countryCode");
  value.countryCode.isValidFlag = 1;
  value.countryCode.stringLength = C2xGetTokenLengthBit(packetHandle, "IVIM", newPath);
  if ((result = CheckLastError("IVIM", gkFuncRefGet, result))==0)
  {
    if(value.countryCode.stringLength > 0)
    {
      for(j=0; j<value.countryCode.stringLength; j++)
      {
        if(C2xGetTokenBitOfBitString(packetHandle, "IVIM", newPath, j) == 0)
        {
          value.countryCode.string[j] = '0';
        }
        else if(C2xGetTokenBitOfBitString(packetHandle, "IVIM", newPath, j) == 1)
        {
          value.countryCode.string[j] = '1';
        }

        if(value.countryCode.stringLength == 1)
        {
          value.countryCode.string[1] = '0';
        }
        result = CheckLastError("IVIM", gkFuncRefGet, result);
      }
    }
    else
    {
      for(k = value.countryCode.stringLength+1; k > -1; k--)
      {
        if(value.countryCode.string[k] == '1')
        {
          value.countryCode.string[k] = '0';
        }
      }
    }
  }

  snprintf(newPath, elcount(newPath), "%s.%s", oldPath, "providerIdentifier");
  value.providerIdentifier = C2xGetTokenInt(packetHandle, "IVIM", newPath);
  result = CheckLastError("IVIM", gkFuncRefGet, result);

  return result;
}

int SetIVIMProviderParams(LONG packetHandle, struct IVIMProvider value, char oldPath[])
{
  char newPath[300]; 
  int j;
  int result;

  result = 0;

  snprintf(newPath, elcount(newPath), "%s.%s", oldPath, "countryCode");
    for(j=0; j<value.countryCode.stringLength; j++)
    {
      if(value.countryCode.string[j] == '0')
      {
        C2xSetTokenBitOfBitString(packetHandle, "IVIM", newPath, j, 0);
      }
      else
      {
        C2xSetTokenBitOfBitString(packetHandle, "IVIM", newPath, j, 1);
      }
      result = CheckLastError("IVIM", gkFuncRefGet, result);
    }

  snprintf(newPath, elcount(newPath), "%s.%s", oldPath, "providerIdentifier");
  C2xSetTokenInt(packetHandle, "IVIM", newPath, value.providerIdentifier);
  result = CheckLastError("IVIM", gkFuncRefGet, result);

  return result;
}

int GetIVIMIviIdentificationNumbersParams(LONG packetHandle, struct IVIMIviIdentificationNumbers value, char oldPath[])
{
  char newPath[300]; 
  int i;
  int result;

  result = 0;

  value.length = C2xGetTokenInt(packetHandle, "IVIM", oldPath);
  if((result = CheckLastError("IVIM", gkFuncRefGet, result))==0)
  {
    for(i=0; i<value.length; i++)
    {
      snprintf(newPath, elcount(newPath), "%s[%d]", oldPath, i);
      value.arrayValue[i] = C2xGetTokenInt64(packetHandle, "IVIM", newPath);
      result = CheckLastError("IVIM", gkFuncRefGet, result);
    }
  }
  return result;
}

int SetIVIMIviIdentificationNumbersParams(LONG packetHandle, struct IVIMIviIdentificationNumbers value, char oldPath[])
{
  char newPath[300]; 
  int i;
  int result;

  result = 0;

  C2xRemoveToken(packetHandle, "IVIM", oldPath);
  for(i=0; i<value.length; i++)
  {
    snprintf(newPath, elcount(newPath), "%s[%d]", oldPath, i);
    C2xSetTokenInt64(packetHandle, "IVIM", newPath, value.arrayValue[i]);
    result = CheckLastError("IVIM", gkFuncRefGet, result);
  }
  return result;
}

int GetIVIMActionIDParams(LONG packetHandle, struct IVIMActionID value, char oldPath[])
{
  char newPath[300];
  int result;

  result = 0;

  snprintf(newPath, elcount(newPath), "%s.%s", oldPath, "originatingStationID");
  value.originatingStationID = C2xGetTokenInt64(packetHandle, "IVIM", newPath);
  result = CheckLastError("IVIM", gkFuncRefGet, result);

  snprintf(newPath, elcount(newPath), "%s.%s", oldPath, "sequenceNumber");
  value.sequenceNumber = C2xGetTokenInt(packetHandle, "IVIM", newPath);
  result = CheckLastError("IVIM", gkFuncRefGet, result);

  return result;
}

int SetIVIMActionIDParams(LONG packetHandle, struct IVIMActionID value, char oldPath[])
{
  char newPath[300];
  int result;

  result = 0;

  snprintf(newPath, elcount(newPath), "%s.%s", oldPath, "originatingStationID");
  C2xSetTokenInt64(packetHandle, "IVIM", newPath, value.originatingStationID);
  result = CheckLastError("IVIM", gkFuncRefGet, result);

  snprintf(newPath, elcount(newPath), "%s.%s", oldPath, "sequenceNumber");
  C2xSetTokenInt(packetHandle, "IVIM", newPath, value.sequenceNumber);
  result = CheckLastError("IVIM", gkFuncRefGet, result);

  return result;
}

int GetIVIMConnectedDenmsParams(LONG packetHandle, struct IVIMConnectedDenms value, char oldPath[])
{
  char newPath[300]; 
  int i;
  int result;

  result = 0;

  value.length = C2xGetTokenInt(packetHandle, "IVIM", oldPath);
  if((result = CheckLastError("IVIM", gkFuncRefGet, result))==0)
  {
    for(i=0; i<value.length; i++)
    {
      snprintf(newPath, elcount(newPath), "%s[%d]", oldPath, i);
      GetIVIMActionIDParams(packetHandle, value.arrayValue[i], newPath);
      result = CheckLastError("IVIM", gkFuncRefGet, result);
    }
  }
  return result;
}

int SetIVIMConnectedDenmsParams(LONG packetHandle, struct IVIMConnectedDenms value, char oldPath[])
{
  char newPath[300]; 
  int i;
  int result;

  result = 0;

  C2xRemoveToken(packetHandle, "IVIM", oldPath);
  for(i=0; i<value.length; i++)
  {
    snprintf(newPath, elcount(newPath), "%s[%d]", oldPath, i);
    SetIVIMActionIDParams(packetHandle, value.arrayValue[i], newPath);
    result = CheckLastError("IVIM", gkFuncRefGet, result);
  }
  return result;
}

int GetIVIMIviManagementContainerParams(LONG packetHandle, struct IVIMIviManagementContainer value, char oldPath[])
{
  char newPath[300];
  int result;

  result = 0;

  snprintf(newPath, elcount(newPath), "%s.%s", oldPath, "serviceProviderId");
  GetIVIMProviderParams(packetHandle, value.serviceProviderId, newPath);
  result = CheckLastError("IVIM", gkFuncRefGet, result);

  snprintf(newPath, elcount(newPath), "%s.%s", oldPath, "iviIdentificationNumber");
  value.iviIdentificationNumber = C2xGetTokenInt(packetHandle, "IVIM", newPath);
  result = CheckLastError("IVIM", gkFuncRefGet, result);

  snprintf(newPath, elcount(newPath), "%s.%s", oldPath, "timeStamp");
  value.timeStamp.isValidFlag = C2xIsTokenAvailable(packetHandle, "IVIM", newPath);
  if(value.timeStamp.isValidFlag==1)
  {
    value.timeStamp.value = C2xGetTokenInt64(packetHandle, "IVIM", newPath);
    result = CheckLastError("IVIM", gkFuncRefGet, result);
  }
  snprintf(newPath, elcount(newPath), "%s.%s", oldPath, "validFrom");
  value.validFrom.isValidFlag = C2xIsTokenAvailable(packetHandle, "IVIM", newPath);
  if(value.validFrom.isValidFlag==1)
  {
    value.validFrom.value = C2xGetTokenInt64(packetHandle, "IVIM", newPath);
    result = CheckLastError("IVIM", gkFuncRefGet, result);
  }
  snprintf(newPath, elcount(newPath), "%s.%s", oldPath, "validTo");
  value.validTo.isValidFlag = C2xIsTokenAvailable(packetHandle, "IVIM", newPath);
  if(value.validTo.isValidFlag==1)
  {
    value.validTo.value = C2xGetTokenInt64(packetHandle, "IVIM", newPath);
    result = CheckLastError("IVIM", gkFuncRefGet, result);
  }
  snprintf(newPath, elcount(newPath), "%s.%s", oldPath, "connectedIviStructures");
  value.connectedIviStructures.isValidFlag = C2xIsTokenAvailable(packetHandle, "IVIM", newPath);
  if(value.connectedIviStructures.isValidFlag==1)
  {
    GetIVIMIviIdentificationNumbersParams(packetHandle, value.connectedIviStructures, newPath);
    result = CheckLastError("IVIM", gkFuncRefGet, result);
  }
  snprintf(newPath, elcount(newPath), "%s.%s", oldPath, "iviStatus");
  value.iviStatus = C2xGetTokenInt(packetHandle, "IVIM", newPath);
  result = CheckLastError("IVIM", gkFuncRefGet, result);

  snprintf(newPath, elcount(newPath), "%s.%s", oldPath, "connectedDenms");
  value.connectedDenms.isValidFlag = C2xIsTokenAvailable(packetHandle, "IVIM", newPath);
  if(value.connectedDenms.isValidFlag==1)
  {
    GetIVIMConnectedDenmsParams(packetHandle, value.connectedDenms, newPath);
    result = CheckLastError("IVIM", gkFuncRefGet, result);
  }
  return result;
}

int SetIVIMIviManagementContainerParams(LONG packetHandle, struct IVIMIviManagementContainer value, char oldPath[])
{
  char newPath[300];
  int result;

  result = 0;

  snprintf(newPath, elcount(newPath), "%s.%s", oldPath, "serviceProviderId");
  SetIVIMProviderParams(packetHandle, value.serviceProviderId, newPath);
  result = CheckLastError("IVIM", gkFuncRefGet, result);

  snprintf(newPath, elcount(newPath), "%s.%s", oldPath, "iviIdentificationNumber");
  if (value.iviIdentificationNumber < 1)
  {
    C2xSetTokenInt(packetHandle, "IVIM", newPath, 1);
  }
  else if (value.iviIdentificationNumber > 32767)
  {
    C2xSetTokenInt(packetHandle, "IVIM", newPath, 32767);
  }
  else
  {
    C2xSetTokenInt(packetHandle, "IVIM", newPath, value.iviIdentificationNumber);
  }
  result = CheckLastError("IVIM", gkFuncRefGet, result);

  snprintf(newPath, elcount(newPath), "%s.%s", oldPath, "timeStamp");
  if(value.timeStamp.isValidFlag==1)
  {
    C2xSetTokenInt64(packetHandle, "IVIM", newPath, value.timeStamp.value);
    result = CheckLastError("IVIM", gkFuncRefGet, result);
  }
  else
  {
    if( C2xIsTokenAvailable(packetHandle, "IVIM", newPath) )
    {
      C2xRemoveToken(packetHandle, "IVIM", newPath);
    }
  }

  snprintf(newPath, elcount(newPath), "%s.%s", oldPath, "validFrom");
  if(value.validFrom.isValidFlag==1)
  {
    C2xSetTokenInt64(packetHandle, "IVIM", newPath, value.validFrom.value);
    result = CheckLastError("IVIM", gkFuncRefGet, result);
  }
  else
  {
    if( C2xIsTokenAvailable(packetHandle, "IVIM", newPath) )
    {
      C2xRemoveToken(packetHandle, "IVIM", newPath);
    }
  }

  snprintf(newPath, elcount(newPath), "%s.%s", oldPath, "validTo");
  if(value.validTo.isValidFlag==1)
  {
    C2xSetTokenInt64(packetHandle, "IVIM", newPath, value.validTo.value);
    result = CheckLastError("IVIM", gkFuncRefGet, result);
  }
  else
  {
    if( C2xIsTokenAvailable(packetHandle, "IVIM", newPath) )
    {
      C2xRemoveToken(packetHandle, "IVIM", newPath);
    }
  }

  snprintf(newPath, elcount(newPath), "%s.%s", oldPath, "connectedIviStructures");
  if(value.connectedIviStructures.isValidFlag==1)
  {
    SetIVIMIviIdentificationNumbersParams(packetHandle, value.connectedIviStructures, newPath);
    result = CheckLastError("IVIM", gkFuncRefGet, result);
  }
  else
  {
    if( C2xIsTokenAvailable(packetHandle, "IVIM", newPath) )
    {
      C2xRemoveToken(packetHandle, "IVIM", newPath);
    }
  }

  snprintf(newPath, elcount(newPath), "%s.%s", oldPath, "iviStatus");
  C2xSetTokenInt(packetHandle, "IVIM", newPath, value.iviStatus);
  result = CheckLastError("IVIM", gkFuncRefGet, result);

  snprintf(newPath, elcount(newPath), "%s.%s", oldPath, "connectedDenms");
  if(value.connectedDenms.isValidFlag==1)
  {
    SetIVIMConnectedDenmsParams(packetHandle, value.connectedDenms, newPath);
    result = CheckLastError("IVIM", gkFuncRefGet, result);
  }
  else
  {
    if( C2xIsTokenAvailable(packetHandle, "IVIM", newPath) )
    {
      C2xRemoveToken(packetHandle, "IVIM", newPath);
    }
  }

  return result;
}

int GetIVIMPosConfidenceEllipseParams(LONG packetHandle, struct IVIMPosConfidenceEllipse value, char oldPath[])
{
  char newPath[300];
  int result;

  result = 0;

  snprintf(newPath, elcount(newPath), "%s.%s", oldPath, "semiMajorConfidence");
  value.semiMajorConfidence = C2xGetTokenInt(packetHandle, "IVIM", newPath);
  result = CheckLastError("IVIM", gkFuncRefGet, result);

  snprintf(newPath, elcount(newPath), "%s.%s", oldPath, "semiMinorConfidence");
  value.semiMinorConfidence = C2xGetTokenInt(packetHandle, "IVIM", newPath);
  result = CheckLastError("IVIM", gkFuncRefGet, result);

  snprintf(newPath, elcount(newPath), "%s.%s", oldPath, "semiMajorOrientation");
  value.semiMajorOrientation = C2xGetTokenInt(packetHandle, "IVIM", newPath);
  result = CheckLastError("IVIM", gkFuncRefGet, result);

  return result;
}

int SetIVIMPosConfidenceEllipseParams(LONG packetHandle, struct IVIMPosConfidenceEllipse value, char oldPath[])
{
  char newPath[300];
  int result;

  result = 0;

  snprintf(newPath, elcount(newPath), "%s.%s", oldPath, "semiMajorConfidence");
  C2xSetTokenInt(packetHandle, "IVIM", newPath, value.semiMajorConfidence);
  result = CheckLastError("IVIM", gkFuncRefGet, result);

  snprintf(newPath, elcount(newPath), "%s.%s", oldPath, "semiMinorConfidence");
  C2xSetTokenInt(packetHandle, "IVIM", newPath, value.semiMinorConfidence);
  result = CheckLastError("IVIM", gkFuncRefGet, result);

  snprintf(newPath, elcount(newPath), "%s.%s", oldPath, "semiMajorOrientation");
  C2xSetTokenInt(packetHandle, "IVIM", newPath, value.semiMajorOrientation);
  result = CheckLastError("IVIM", gkFuncRefGet, result);

  return result;
}

int GetIVIMAltitudeParams(LONG packetHandle, struct IVIMAltitude value, char oldPath[])
{
  char newPath[300];
  int result;

  result = 0;

  snprintf(newPath, elcount(newPath), "%s.%s", oldPath, "altitudeValue");
  value.altitudeValue = C2xGetTokenInt(packetHandle, "IVIM", newPath);
  result = CheckLastError("IVIM", gkFuncRefGet, result);

  snprintf(newPath, elcount(newPath), "%s.%s", oldPath, "altitudeConfidence");
  value.altitudeConfidence = C2xGetTokenInt(packetHandle, "IVIM", newPath);
  result = CheckLastError("IVIM", gkFuncRefGet, result);

  return result;
}

int SetIVIMAltitudeParams(LONG packetHandle, struct IVIMAltitude value, char oldPath[])
{
  char newPath[300];
  int result;

  result = 0;

  snprintf(newPath, elcount(newPath), "%s.%s", oldPath, "altitudeValue");
  C2xSetTokenInt(packetHandle, "IVIM", newPath, value.altitudeValue);
  result = CheckLastError("IVIM", gkFuncRefGet, result);

  snprintf(newPath, elcount(newPath), "%s.%s", oldPath, "altitudeConfidence");
  C2xSetTokenInt(packetHandle, "IVIM", newPath, value.altitudeConfidence);
  result = CheckLastError("IVIM", gkFuncRefGet, result);

  return result;
}

int GetIVIMReferencePositionParams(LONG packetHandle, struct IVIMReferencePosition value, char oldPath[])
{
  char newPath[300];
  int result;

  result = 0;

  snprintf(newPath, elcount(newPath), "%s.%s", oldPath, "latitude");
  value.latitude = C2xGetTokenInt(packetHandle, "IVIM", newPath);
  result = CheckLastError("IVIM", gkFuncRefGet, result);

  snprintf(newPath, elcount(newPath), "%s.%s", oldPath, "longitude");
  value.longitude = C2xGetTokenInt(packetHandle, "IVIM", newPath);
  result = CheckLastError("IVIM", gkFuncRefGet, result);

  snprintf(newPath, elcount(newPath), "%s.%s", oldPath, "positionConfidenceEllipse");
  GetIVIMPosConfidenceEllipseParams(packetHandle, value.positionConfidenceEllipse, newPath);
  result = CheckLastError("IVIM", gkFuncRefGet, result);

  snprintf(newPath, elcount(newPath), "%s.%s", oldPath, "altitude");
  GetIVIMAltitudeParams(packetHandle, value.altitude, newPath);
  result = CheckLastError("IVIM", gkFuncRefGet, result);

  return result;
}

int SetIVIMReferencePositionParams(LONG packetHandle, struct IVIMReferencePosition value, char oldPath[])
{
  char newPath[300];
  int result;

  result = 0;

  snprintf(newPath, elcount(newPath), "%s.%s", oldPath, "latitude");
  C2xSetTokenInt(packetHandle, "IVIM", newPath, value.latitude);
  result = CheckLastError("IVIM", gkFuncRefGet, result);

  snprintf(newPath, elcount(newPath), "%s.%s", oldPath, "longitude");
  C2xSetTokenInt(packetHandle, "IVIM", newPath, value.longitude);
  result = CheckLastError("IVIM", gkFuncRefGet, result);

  snprintf(newPath, elcount(newPath), "%s.%s", oldPath, "positionConfidenceEllipse");
  SetIVIMPosConfidenceEllipseParams(packetHandle, value.positionConfidenceEllipse, newPath);
  result = CheckLastError("IVIM", gkFuncRefGet, result);

  snprintf(newPath, elcount(newPath), "%s.%s", oldPath, "altitude");
  SetIVIMAltitudeParams(packetHandle, value.altitude, newPath);
  result = CheckLastError("IVIM", gkFuncRefGet, result);

  return result;
}

int GetIVIMHeadingParams(LONG packetHandle, struct IVIMHeading value, char oldPath[])
{
  char newPath[300];
  int result;

  result = 0;

  snprintf(newPath, elcount(newPath), "%s.%s", oldPath, "headingValue");
  value.headingValue = C2xGetTokenInt(packetHandle, "IVIM", newPath);
  result = CheckLastError("IVIM", gkFuncRefGet, result);

  snprintf(newPath, elcount(newPath), "%s.%s", oldPath, "headingConfidence");
  value.headingConfidence = C2xGetTokenInt(packetHandle, "IVIM", newPath);
  result = CheckLastError("IVIM", gkFuncRefGet, result);

  return result;
}

int SetIVIMHeadingParams(LONG packetHandle, struct IVIMHeading value, char oldPath[])
{
  char newPath[300];
  int result;

  result = 0;

  snprintf(newPath, elcount(newPath), "%s.%s", oldPath, "headingValue");
  C2xSetTokenInt(packetHandle, "IVIM", newPath, value.headingValue);
  result = CheckLastError("IVIM", gkFuncRefGet, result);

  snprintf(newPath, elcount(newPath), "%s.%s", oldPath, "headingConfidence");
  if (value.headingConfidence < 1)
  {
    C2xSetTokenInt(packetHandle, "IVIM", newPath, 1);
  }
  else if (value.headingConfidence > 127)
  {
    C2xSetTokenInt(packetHandle, "IVIM", newPath, 127);
  }
  else
  {
    C2xSetTokenInt(packetHandle, "IVIM", newPath, value.headingConfidence);
  }
  result = CheckLastError("IVIM", gkFuncRefGet, result);

  return result;
}

int GetIVIMSpeedParams(LONG packetHandle, struct IVIMSpeed value, char oldPath[])
{
  char newPath[300];
  int result;

  result = 0;

  snprintf(newPath, elcount(newPath), "%s.%s", oldPath, "speedValue");
  value.speedValue = C2xGetTokenInt(packetHandle, "IVIM", newPath);
  result = CheckLastError("IVIM", gkFuncRefGet, result);

  snprintf(newPath, elcount(newPath), "%s.%s", oldPath, "speedConfidence");
  value.speedConfidence = C2xGetTokenInt(packetHandle, "IVIM", newPath);
  result = CheckLastError("IVIM", gkFuncRefGet, result);

  return result;
}

int SetIVIMSpeedParams(LONG packetHandle, struct IVIMSpeed value, char oldPath[])
{
  char newPath[300];
  int result;

  result = 0;

  snprintf(newPath, elcount(newPath), "%s.%s", oldPath, "speedValue");
  C2xSetTokenInt(packetHandle, "IVIM", newPath, value.speedValue);
  result = CheckLastError("IVIM", gkFuncRefGet, result);

  snprintf(newPath, elcount(newPath), "%s.%s", oldPath, "speedConfidence");
  if (value.speedConfidence < 1)
  {
    C2xSetTokenInt(packetHandle, "IVIM", newPath, 1);
  }
  else if (value.speedConfidence > 127)
  {
    C2xSetTokenInt(packetHandle, "IVIM", newPath, 127);
  }
  else
  {
    C2xSetTokenInt(packetHandle, "IVIM", newPath, value.speedConfidence);
  }
  result = CheckLastError("IVIM", gkFuncRefGet, result);

  return result;
}

int GetIVIMDeltaPositionParams(LONG packetHandle, struct IVIMDeltaPosition value, char oldPath[])
{
  char newPath[300];
  int result;

  result = 0;

  snprintf(newPath, elcount(newPath), "%s.%s", oldPath, "deltaLatitude");
  value.deltaLatitude = C2xGetTokenInt(packetHandle, "IVIM", newPath);
  result = CheckLastError("IVIM", gkFuncRefGet, result);

  snprintf(newPath, elcount(newPath), "%s.%s", oldPath, "deltaLongitude");
  value.deltaLongitude = C2xGetTokenInt(packetHandle, "IVIM", newPath);
  result = CheckLastError("IVIM", gkFuncRefGet, result);

  return result;
}

int SetIVIMDeltaPositionParams(LONG packetHandle, struct IVIMDeltaPosition value, char oldPath[])
{
  char newPath[300];
  int result;

  result = 0;

  snprintf(newPath, elcount(newPath), "%s.%s", oldPath, "deltaLatitude");
  C2xSetTokenInt(packetHandle, "IVIM", newPath, value.deltaLatitude);
  result = CheckLastError("IVIM", gkFuncRefGet, result);

  snprintf(newPath, elcount(newPath), "%s.%s", oldPath, "deltaLongitude");
  C2xSetTokenInt(packetHandle, "IVIM", newPath, value.deltaLongitude);
  result = CheckLastError("IVIM", gkFuncRefGet, result);

  return result;
}

int GetIVIMDeltaPositionsParams(LONG packetHandle, struct IVIMDeltaPositions value, char oldPath[])
{
  char newPath[300]; 
  int i;
  int result;

  result = 0;

  value.length = C2xGetTokenInt(packetHandle, "IVIM", oldPath);
  if((result = CheckLastError("IVIM", gkFuncRefGet, result))==0)
  {
    for(i=0; i<value.length; i++)
    {
      snprintf(newPath, elcount(newPath), "%s[%d]", oldPath, i);
      GetIVIMDeltaPositionParams(packetHandle, value.arrayValue[i], newPath);
      result = CheckLastError("IVIM", gkFuncRefGet, result);
    }
  }
  return result;
}

int SetIVIMDeltaPositionsParams(LONG packetHandle, struct IVIMDeltaPositions value, char oldPath[])
{
  char newPath[300]; 
  int i;
  int result;

  result = 0;

  C2xRemoveToken(packetHandle, "IVIM", oldPath);
  for(i=0; i<value.length; i++)
  {
    snprintf(newPath, elcount(newPath), "%s[%d]", oldPath, i);
    SetIVIMDeltaPositionParams(packetHandle, value.arrayValue[i], newPath);
    result = CheckLastError("IVIM", gkFuncRefGet, result);
  }
  return result;
}

int GetIVIMDeltaReferencePositionParams(LONG packetHandle, struct IVIMDeltaReferencePosition value, char oldPath[])
{
  char newPath[300];
  int result;

  result = 0;

  snprintf(newPath, elcount(newPath), "%s.%s", oldPath, "deltaLatitude");
  value.deltaLatitude = C2xGetTokenInt(packetHandle, "IVIM", newPath);
  result = CheckLastError("IVIM", gkFuncRefGet, result);

  snprintf(newPath, elcount(newPath), "%s.%s", oldPath, "deltaLongitude");
  value.deltaLongitude = C2xGetTokenInt(packetHandle, "IVIM", newPath);
  result = CheckLastError("IVIM", gkFuncRefGet, result);

  snprintf(newPath, elcount(newPath), "%s.%s", oldPath, "deltaAltitude");
  value.deltaAltitude = C2xGetTokenInt(packetHandle, "IVIM", newPath);
  result = CheckLastError("IVIM", gkFuncRefGet, result);

  return result;
}

int SetIVIMDeltaReferencePositionParams(LONG packetHandle, struct IVIMDeltaReferencePosition value, char oldPath[])
{
  char newPath[300];
  int result;

  result = 0;

  snprintf(newPath, elcount(newPath), "%s.%s", oldPath, "deltaLatitude");
  C2xSetTokenInt(packetHandle, "IVIM", newPath, value.deltaLatitude);
  result = CheckLastError("IVIM", gkFuncRefGet, result);

  snprintf(newPath, elcount(newPath), "%s.%s", oldPath, "deltaLongitude");
  C2xSetTokenInt(packetHandle, "IVIM", newPath, value.deltaLongitude);
  result = CheckLastError("IVIM", gkFuncRefGet, result);

  snprintf(newPath, elcount(newPath), "%s.%s", oldPath, "deltaAltitude");
  C2xSetTokenInt(packetHandle, "IVIM", newPath, value.deltaAltitude);
  result = CheckLastError("IVIM", gkFuncRefGet, result);

  return result;
}

int GetIVIMDeltaReferencePositionsParams(LONG packetHandle, struct IVIMDeltaReferencePositions value, char oldPath[])
{
  char newPath[300]; 
  int i;
  int result;

  result = 0;

  value.length = C2xGetTokenInt(packetHandle, "IVIM", oldPath);
  if((result = CheckLastError("IVIM", gkFuncRefGet, result))==0)
  {
    for(i=0; i<value.length; i++)
    {
      snprintf(newPath, elcount(newPath), "%s[%d]", oldPath, i);
      GetIVIMDeltaReferencePositionParams(packetHandle, value.arrayValue[i], newPath);
      result = CheckLastError("IVIM", gkFuncRefGet, result);
    }
  }
  return result;
}

int SetIVIMDeltaReferencePositionsParams(LONG packetHandle, struct IVIMDeltaReferencePositions value, char oldPath[])
{
  char newPath[300]; 
  int i;
  int result;

  result = 0;

  C2xRemoveToken(packetHandle, "IVIM", oldPath);
  for(i=0; i<value.length; i++)
  {
    snprintf(newPath, elcount(newPath), "%s[%d]", oldPath, i);
    SetIVIMDeltaReferencePositionParams(packetHandle, value.arrayValue[i], newPath);
    result = CheckLastError("IVIM", gkFuncRefGet, result);
  }
  return result;
}

int GetIVIMAbsolutePositionParams(LONG packetHandle, struct IVIMAbsolutePosition value, char oldPath[])
{
  char newPath[300];
  int result;

  result = 0;

  snprintf(newPath, elcount(newPath), "%s.%s", oldPath, "latitude");
  value.latitude = C2xGetTokenInt(packetHandle, "IVIM", newPath);
  result = CheckLastError("IVIM", gkFuncRefGet, result);

  snprintf(newPath, elcount(newPath), "%s.%s", oldPath, "longitude");
  value.longitude = C2xGetTokenInt(packetHandle, "IVIM", newPath);
  result = CheckLastError("IVIM", gkFuncRefGet, result);

  return result;
}

int SetIVIMAbsolutePositionParams(LONG packetHandle, struct IVIMAbsolutePosition value, char oldPath[])
{
  char newPath[300];
  int result;

  result = 0;

  snprintf(newPath, elcount(newPath), "%s.%s", oldPath, "latitude");
  C2xSetTokenInt(packetHandle, "IVIM", newPath, value.latitude);
  result = CheckLastError("IVIM", gkFuncRefGet, result);

  snprintf(newPath, elcount(newPath), "%s.%s", oldPath, "longitude");
  C2xSetTokenInt(packetHandle, "IVIM", newPath, value.longitude);
  result = CheckLastError("IVIM", gkFuncRefGet, result);

  return result;
}

int GetIVIMAbsolutePositionsParams(LONG packetHandle, struct IVIMAbsolutePositions value, char oldPath[])
{
  char newPath[300]; 
  int i;
  int result;

  result = 0;

  value.length = C2xGetTokenInt(packetHandle, "IVIM", oldPath);
  if((result = CheckLastError("IVIM", gkFuncRefGet, result))==0)
  {
    for(i=0; i<value.length; i++)
    {
      snprintf(newPath, elcount(newPath), "%s[%d]", oldPath, i);
      GetIVIMAbsolutePositionParams(packetHandle, value.arrayValue[i], newPath);
      result = CheckLastError("IVIM", gkFuncRefGet, result);
    }
  }
  return result;
}

int SetIVIMAbsolutePositionsParams(LONG packetHandle, struct IVIMAbsolutePositions value, char oldPath[])
{
  char newPath[300]; 
  int i;
  int result;

  result = 0;

  C2xRemoveToken(packetHandle, "IVIM", oldPath);
  for(i=0; i<value.length; i++)
  {
    snprintf(newPath, elcount(newPath), "%s[%d]", oldPath, i);
    SetIVIMAbsolutePositionParams(packetHandle, value.arrayValue[i], newPath);
    result = CheckLastError("IVIM", gkFuncRefGet, result);
  }
  return result;
}

int GetIVIMAbsolutePositionWAltitudeParams(LONG packetHandle, struct IVIMAbsolutePositionWAltitude value, char oldPath[])
{
  char newPath[300];
  int result;

  result = 0;

  snprintf(newPath, elcount(newPath), "%s.%s", oldPath, "latitude");
  value.latitude = C2xGetTokenInt(packetHandle, "IVIM", newPath);
  result = CheckLastError("IVIM", gkFuncRefGet, result);

  snprintf(newPath, elcount(newPath), "%s.%s", oldPath, "longitude");
  value.longitude = C2xGetTokenInt(packetHandle, "IVIM", newPath);
  result = CheckLastError("IVIM", gkFuncRefGet, result);

  snprintf(newPath, elcount(newPath), "%s.%s", oldPath, "altitude");
  GetIVIMAltitudeParams(packetHandle, value.altitude, newPath);
  result = CheckLastError("IVIM", gkFuncRefGet, result);

  return result;
}

int SetIVIMAbsolutePositionWAltitudeParams(LONG packetHandle, struct IVIMAbsolutePositionWAltitude value, char oldPath[])
{
  char newPath[300];
  int result;

  result = 0;

  snprintf(newPath, elcount(newPath), "%s.%s", oldPath, "latitude");
  C2xSetTokenInt(packetHandle, "IVIM", newPath, value.latitude);
  result = CheckLastError("IVIM", gkFuncRefGet, result);

  snprintf(newPath, elcount(newPath), "%s.%s", oldPath, "longitude");
  C2xSetTokenInt(packetHandle, "IVIM", newPath, value.longitude);
  result = CheckLastError("IVIM", gkFuncRefGet, result);

  snprintf(newPath, elcount(newPath), "%s.%s", oldPath, "altitude");
  SetIVIMAltitudeParams(packetHandle, value.altitude, newPath);
  result = CheckLastError("IVIM", gkFuncRefGet, result);

  return result;
}

int GetIVIMAbsolutePositionsWAltitudeParams(LONG packetHandle, struct IVIMAbsolutePositionsWAltitude value, char oldPath[])
{
  char newPath[300]; 
  int i;
  int result;

  result = 0;

  value.length = C2xGetTokenInt(packetHandle, "IVIM", oldPath);
  if((result = CheckLastError("IVIM", gkFuncRefGet, result))==0)
  {
    for(i=0; i<value.length; i++)
    {
      snprintf(newPath, elcount(newPath), "%s[%d]", oldPath, i);
      GetIVIMAbsolutePositionWAltitudeParams(packetHandle, value.arrayValue[i], newPath);
      result = CheckLastError("IVIM", gkFuncRefGet, result);
    }
  }
  return result;
}

int SetIVIMAbsolutePositionsWAltitudeParams(LONG packetHandle, struct IVIMAbsolutePositionsWAltitude value, char oldPath[])
{
  char newPath[300]; 
  int i;
  int result;

  result = 0;

  C2xRemoveToken(packetHandle, "IVIM", oldPath);
  for(i=0; i<value.length; i++)
  {
    snprintf(newPath, elcount(newPath), "%s[%d]", oldPath, i);
    SetIVIMAbsolutePositionWAltitudeParams(packetHandle, value.arrayValue[i], newPath);
    result = CheckLastError("IVIM", gkFuncRefGet, result);
  }
  return result;
}

int GetIVIMPolygonalLineParams(LONG packetHandle, struct IVIMPolygonalLine value, char oldPath[])
{
  char newPath[300];
  int result;

  result = 0;

  value.choice = C2xGetTokenInt(packetHandle, "IVIM", oldPath);

  switch(value.choice)
  {
    case 0:
    {
      snprintf(newPath, elcount(newPath), "%s.%s", oldPath, "deltaPositions");
      GetIVIMDeltaPositionsParams(packetHandle, value.deltaPositions, newPath);
      result = CheckLastError("IVIM", gkFuncRefGet, result);
    }
    break;
    case 1:
    {
      snprintf(newPath, elcount(newPath), "%s.%s", oldPath, "deltaPositionsWithAltitude");
      GetIVIMDeltaReferencePositionsParams(packetHandle, value.deltaPositionsWithAltitude, newPath);
      result = CheckLastError("IVIM", gkFuncRefGet, result);
    }
    break;
    case 2:
    {
      snprintf(newPath, elcount(newPath), "%s.%s", oldPath, "absolutePositions");
      GetIVIMAbsolutePositionsParams(packetHandle, value.absolutePositions, newPath);
      result = CheckLastError("IVIM", gkFuncRefGet, result);
    }
    break;
    case 3:
    {
      snprintf(newPath, elcount(newPath), "%s.%s", oldPath, "absolutePositionsWithAltitude");
      GetIVIMAbsolutePositionsWAltitudeParams(packetHandle, value.absolutePositionsWithAltitude, newPath);
      result = CheckLastError("IVIM", gkFuncRefGet, result);
    }
    break;
  }
  return result;
}

int SetIVIMPolygonalLineParams(LONG packetHandle, struct IVIMPolygonalLine value, char oldPath[])
{
  char newPath[300];
  int result;

  result = 0;

  switch(value.choice)
  {
    case 0:
    {
      snprintf(newPath, elcount(newPath), "%s.%s", oldPath, "deltaPositions");
      SetIVIMDeltaPositionsParams(packetHandle, value.deltaPositions, newPath);
      result = CheckLastError("IVIM", gkFuncRefGet, result);
    }
    break;
    case 1:
    {
      snprintf(newPath, elcount(newPath), "%s.%s", oldPath, "deltaPositionsWithAltitude");
      SetIVIMDeltaReferencePositionsParams(packetHandle, value.deltaPositionsWithAltitude, newPath);
      result = CheckLastError("IVIM", gkFuncRefGet, result);
    }
    break;
    case 2:
    {
      snprintf(newPath, elcount(newPath), "%s.%s", oldPath, "absolutePositions");
      SetIVIMAbsolutePositionsParams(packetHandle, value.absolutePositions, newPath);
      result = CheckLastError("IVIM", gkFuncRefGet, result);
    }
    break;
    case 3:
    {
      snprintf(newPath, elcount(newPath), "%s.%s", oldPath, "absolutePositionsWithAltitude");
      SetIVIMAbsolutePositionsWAltitudeParams(packetHandle, value.absolutePositionsWithAltitude, newPath);
      result = CheckLastError("IVIM", gkFuncRefGet, result);
    }
    break;
  }
  return result;
}

int GetIVIMSegmentParams(LONG packetHandle, struct IVIMSegment value, char oldPath[])
{
  char newPath[300];
  int result;

  result = 0;

  snprintf(newPath, elcount(newPath), "%s.%s", oldPath, "line");
  GetIVIMPolygonalLineParams(packetHandle, value.line, newPath);
  result = CheckLastError("IVIM", gkFuncRefGet, result);

  snprintf(newPath, elcount(newPath), "%s.%s", oldPath, "laneWidth");
  value.laneWidth.isValidFlag = C2xIsTokenAvailable(packetHandle, "IVIM", newPath);
  if(value.laneWidth.isValidFlag==1)
  {
    value.laneWidth.value = C2xGetTokenInt(packetHandle, "IVIM", newPath);
    result = CheckLastError("IVIM", gkFuncRefGet, result);
  }
  return result;
}

int SetIVIMSegmentParams(LONG packetHandle, struct IVIMSegment value, char oldPath[])
{
  char newPath[300];
  int result;

  result = 0;

  snprintf(newPath, elcount(newPath), "%s.%s", oldPath, "line");
  SetIVIMPolygonalLineParams(packetHandle, value.line, newPath);
  result = CheckLastError("IVIM", gkFuncRefGet, result);

  snprintf(newPath, elcount(newPath), "%s.%s", oldPath, "laneWidth");
  if(value.laneWidth.isValidFlag==1)
  {
    C2xSetTokenInt(packetHandle, "IVIM", newPath, value.laneWidth.value);
    result = CheckLastError("IVIM", gkFuncRefGet, result);
  }
  else
  {
    if( C2xIsTokenAvailable(packetHandle, "IVIM", newPath) )
    {
      C2xRemoveToken(packetHandle, "IVIM", newPath);
    }
  }

  return result;
}

int GetIVIMComputedSegmentParams(LONG packetHandle, struct IVIMComputedSegment value, char oldPath[])
{
  char newPath[300];
  int result;

  result = 0;

  snprintf(newPath, elcount(newPath), "%s.%s", oldPath, "zoneId");
  value.zoneId = C2xGetTokenInt(packetHandle, "IVIM", newPath);
  result = CheckLastError("IVIM", gkFuncRefGet, result);

  snprintf(newPath, elcount(newPath), "%s.%s", oldPath, "laneNumber");
  value.laneNumber = C2xGetTokenInt(packetHandle, "IVIM", newPath);
  result = CheckLastError("IVIM", gkFuncRefGet, result);

  snprintf(newPath, elcount(newPath), "%s.%s", oldPath, "laneWidth");
  value.laneWidth = C2xGetTokenInt(packetHandle, "IVIM", newPath);
  result = CheckLastError("IVIM", gkFuncRefGet, result);

  snprintf(newPath, elcount(newPath), "%s.%s", oldPath, "offsetDistance");
  value.offsetDistance.isValidFlag = C2xIsTokenAvailable(packetHandle, "IVIM", newPath);
  if(value.offsetDistance.isValidFlag==1)
  {
    value.offsetDistance.value = C2xGetTokenInt(packetHandle, "IVIM", newPath);
    result = CheckLastError("IVIM", gkFuncRefGet, result);
  }
  snprintf(newPath, elcount(newPath), "%s.%s", oldPath, "offsetPosition");
  value.offsetPosition.isValidFlag = C2xIsTokenAvailable(packetHandle, "IVIM", newPath);
  if(value.offsetPosition.isValidFlag==1)
  {
    GetIVIMDeltaReferencePositionParams(packetHandle, value.offsetPosition, newPath);
    result = CheckLastError("IVIM", gkFuncRefGet, result);
  }
  return result;
}

int SetIVIMComputedSegmentParams(LONG packetHandle, struct IVIMComputedSegment value, char oldPath[])
{
  char newPath[300];
  int result;

  result = 0;

  snprintf(newPath, elcount(newPath), "%s.%s", oldPath, "zoneId");
  if (value.zoneId < 1)
  {
    C2xSetTokenInt(packetHandle, "IVIM", newPath, 1);
  }
  else if (value.zoneId > 32)
  {
    C2xSetTokenInt(packetHandle, "IVIM", newPath, 32);
  }
  else
  {
    C2xSetTokenInt(packetHandle, "IVIM", newPath, value.zoneId);
  }
  result = CheckLastError("IVIM", gkFuncRefGet, result);

  snprintf(newPath, elcount(newPath), "%s.%s", oldPath, "laneNumber");
  C2xSetTokenInt(packetHandle, "IVIM", newPath, value.laneNumber);
  result = CheckLastError("IVIM", gkFuncRefGet, result);

  snprintf(newPath, elcount(newPath), "%s.%s", oldPath, "laneWidth");
  C2xSetTokenInt(packetHandle, "IVIM", newPath, value.laneWidth);
  result = CheckLastError("IVIM", gkFuncRefGet, result);

  snprintf(newPath, elcount(newPath), "%s.%s", oldPath, "offsetDistance");
  if(value.offsetDistance.isValidFlag==1)
  {
    C2xSetTokenInt(packetHandle, "IVIM", newPath, value.offsetDistance.value);
    result = CheckLastError("IVIM", gkFuncRefGet, result);
  }
  else
  {
    if( C2xIsTokenAvailable(packetHandle, "IVIM", newPath) )
    {
      C2xRemoveToken(packetHandle, "IVIM", newPath);
    }
  }

  snprintf(newPath, elcount(newPath), "%s.%s", oldPath, "offsetPosition");
  if(value.offsetPosition.isValidFlag==1)
  {
    SetIVIMDeltaReferencePositionParams(packetHandle, value.offsetPosition, newPath);
    result = CheckLastError("IVIM", gkFuncRefGet, result);
  }
  else
  {
    if( C2xIsTokenAvailable(packetHandle, "IVIM", newPath) )
    {
      C2xRemoveToken(packetHandle, "IVIM", newPath);
    }
  }

  return result;
}

int GetIVIMZoneParams(LONG packetHandle, struct IVIMZone value, char oldPath[])
{
  char newPath[300];
  int result;

  result = 0;

  value.choice = C2xGetTokenInt(packetHandle, "IVIM", oldPath);

  switch(value.choice)
  {
    case 0:
    {
      snprintf(newPath, elcount(newPath), "%s.%s", oldPath, "segment");
      GetIVIMSegmentParams(packetHandle, value.segment, newPath);
      result = CheckLastError("IVIM", gkFuncRefGet, result);
    }
    break;
    case 1:
    {
      snprintf(newPath, elcount(newPath), "%s.%s", oldPath, "area");
      GetIVIMPolygonalLineParams(packetHandle, value.area, newPath);
      result = CheckLastError("IVIM", gkFuncRefGet, result);
    }
    break;
    case 2:
    {
      snprintf(newPath, elcount(newPath), "%s.%s", oldPath, "computedSegment");
      GetIVIMComputedSegmentParams(packetHandle, value.computedSegment, newPath);
      result = CheckLastError("IVIM", gkFuncRefGet, result);
    }
    break;
  }
  return result;
}

int SetIVIMZoneParams(LONG packetHandle, struct IVIMZone value, char oldPath[])
{
  char newPath[300];
  int result;

  result = 0;

  switch(value.choice)
  {
    case 0:
    {
      snprintf(newPath, elcount(newPath), "%s.%s", oldPath, "segment");
      SetIVIMSegmentParams(packetHandle, value.segment, newPath);
      result = CheckLastError("IVIM", gkFuncRefGet, result);
    }
    break;
    case 1:
    {
      snprintf(newPath, elcount(newPath), "%s.%s", oldPath, "area");
      SetIVIMPolygonalLineParams(packetHandle, value.area, newPath);
      result = CheckLastError("IVIM", gkFuncRefGet, result);
    }
    break;
    case 2:
    {
      snprintf(newPath, elcount(newPath), "%s.%s", oldPath, "computedSegment");
      SetIVIMComputedSegmentParams(packetHandle, value.computedSegment, newPath);
      result = CheckLastError("IVIM", gkFuncRefGet, result);
    }
    break;
  }
  return result;
}

int GetIVIMGlcPartParams(LONG packetHandle, struct IVIMGlcPart value, char oldPath[])
{
  char newPath[300];
  int result;

  result = 0;

  snprintf(newPath, elcount(newPath), "%s.%s", oldPath, "zoneId");
  value.zoneId = C2xGetTokenInt(packetHandle, "IVIM", newPath);
  result = CheckLastError("IVIM", gkFuncRefGet, result);

  snprintf(newPath, elcount(newPath), "%s.%s", oldPath, "laneNumber");
  value.laneNumber.isValidFlag = C2xIsTokenAvailable(packetHandle, "IVIM", newPath);
  if(value.laneNumber.isValidFlag==1)
  {
    value.laneNumber.value = C2xGetTokenInt(packetHandle, "IVIM", newPath);
    result = CheckLastError("IVIM", gkFuncRefGet, result);
  }
  snprintf(newPath, elcount(newPath), "%s.%s", oldPath, "zoneExtension");
  value.zoneExtension.isValidFlag = C2xIsTokenAvailable(packetHandle, "IVIM", newPath);
  if(value.zoneExtension.isValidFlag==1)
  {
    value.zoneExtension.value = C2xGetTokenInt(packetHandle, "IVIM", newPath);
    result = CheckLastError("IVIM", gkFuncRefGet, result);
  }
  snprintf(newPath, elcount(newPath), "%s.%s", oldPath, "zoneHeading");
  value.zoneHeading.isValidFlag = C2xIsTokenAvailable(packetHandle, "IVIM", newPath);
  if(value.zoneHeading.isValidFlag==1)
  {
    value.zoneHeading.value = C2xGetTokenInt(packetHandle, "IVIM", newPath);
    result = CheckLastError("IVIM", gkFuncRefGet, result);
  }
  snprintf(newPath, elcount(newPath), "%s.%s", oldPath, "zone");
  value.zone.isValidFlag = C2xIsTokenAvailable(packetHandle, "IVIM", newPath);
  if(value.zone.isValidFlag==1)
  {
    GetIVIMZoneParams(packetHandle, value.zone, newPath);
    result = CheckLastError("IVIM", gkFuncRefGet, result);
  }
  return result;
}

int SetIVIMGlcPartParams(LONG packetHandle, struct IVIMGlcPart value, char oldPath[])
{
  char newPath[300];
  int result;

  result = 0;

  snprintf(newPath, elcount(newPath), "%s.%s", oldPath, "zoneId");
  if (value.zoneId < 1)
  {
    C2xSetTokenInt(packetHandle, "IVIM", newPath, 1);
  }
  else if (value.zoneId > 32)
  {
    C2xSetTokenInt(packetHandle, "IVIM", newPath, 32);
  }
  else
  {
    C2xSetTokenInt(packetHandle, "IVIM", newPath, value.zoneId);
  }
  result = CheckLastError("IVIM", gkFuncRefGet, result);

  snprintf(newPath, elcount(newPath), "%s.%s", oldPath, "laneNumber");
  if(value.laneNumber.isValidFlag==1)
  {
    C2xSetTokenInt(packetHandle, "IVIM", newPath, value.laneNumber.value);
    result = CheckLastError("IVIM", gkFuncRefGet, result);
  }
  else
  {
    if( C2xIsTokenAvailable(packetHandle, "IVIM", newPath) )
    {
      C2xRemoveToken(packetHandle, "IVIM", newPath);
    }
  }

  snprintf(newPath, elcount(newPath), "%s.%s", oldPath, "zoneExtension");
  if(value.zoneExtension.isValidFlag==1)
  {
    C2xSetTokenInt(packetHandle, "IVIM", newPath, value.zoneExtension.value);
    result = CheckLastError("IVIM", gkFuncRefGet, result);
  }
  else
  {
    if( C2xIsTokenAvailable(packetHandle, "IVIM", newPath) )
    {
      C2xRemoveToken(packetHandle, "IVIM", newPath);
    }
  }

  snprintf(newPath, elcount(newPath), "%s.%s", oldPath, "zoneHeading");
  if(value.zoneHeading.isValidFlag==1)
  {
    C2xSetTokenInt(packetHandle, "IVIM", newPath, value.zoneHeading.value);
    result = CheckLastError("IVIM", gkFuncRefGet, result);
  }
  else
  {
    if( C2xIsTokenAvailable(packetHandle, "IVIM", newPath) )
    {
      C2xRemoveToken(packetHandle, "IVIM", newPath);
    }
  }

  snprintf(newPath, elcount(newPath), "%s.%s", oldPath, "zone");
  if(value.zone.isValidFlag==1)
  {
    SetIVIMZoneParams(packetHandle, value.zone, newPath);
    result = CheckLastError("IVIM", gkFuncRefGet, result);
  }
  else
  {
    if( C2xIsTokenAvailable(packetHandle, "IVIM", newPath) )
    {
      C2xRemoveToken(packetHandle, "IVIM", newPath);
    }
  }

  return result;
}

int GetIVIMGlcPartsParams(LONG packetHandle, struct IVIMGlcParts value, char oldPath[])
{
  char newPath[300]; 
  int i;
  int result;

  result = 0;

  value.length = C2xGetTokenInt(packetHandle, "IVIM", oldPath);
  if((result = CheckLastError("IVIM", gkFuncRefGet, result))==0)
  {
    for(i=0; i<value.length; i++)
    {
      snprintf(newPath, elcount(newPath), "%s[%d]", oldPath, i);
      GetIVIMGlcPartParams(packetHandle, value.arrayValue[i], newPath);
      result = CheckLastError("IVIM", gkFuncRefGet, result);
    }
  }
  return result;
}

int SetIVIMGlcPartsParams(LONG packetHandle, struct IVIMGlcParts value, char oldPath[])
{
  char newPath[300]; 
  int i;
  int result;

  result = 0;

  C2xRemoveToken(packetHandle, "IVIM", oldPath);
  for(i=0; i<value.length; i++)
  {
    snprintf(newPath, elcount(newPath), "%s[%d]", oldPath, i);
    SetIVIMGlcPartParams(packetHandle, value.arrayValue[i], newPath);
    result = CheckLastError("IVIM", gkFuncRefGet, result);
  }
  return result;
}

int GetIVIMGeographicLocationContainerParams(LONG packetHandle, struct IVIMGeographicLocationContainer value, char oldPath[])
{
  char newPath[300];
  int result;

  result = 0;

  snprintf(newPath, elcount(newPath), "%s.%s", oldPath, "referencePosition");
  GetIVIMReferencePositionParams(packetHandle, value.referencePosition, newPath);
  result = CheckLastError("IVIM", gkFuncRefGet, result);

  snprintf(newPath, elcount(newPath), "%s.%s", oldPath, "referencePositionTime");
  value.referencePositionTime.isValidFlag = C2xIsTokenAvailable(packetHandle, "IVIM", newPath);
  if(value.referencePositionTime.isValidFlag==1)
  {
    value.referencePositionTime.value = C2xGetTokenInt64(packetHandle, "IVIM", newPath);
    result = CheckLastError("IVIM", gkFuncRefGet, result);
  }
  snprintf(newPath, elcount(newPath), "%s.%s", oldPath, "referencePositionHeading");
  value.referencePositionHeading.isValidFlag = C2xIsTokenAvailable(packetHandle, "IVIM", newPath);
  if(value.referencePositionHeading.isValidFlag==1)
  {
    GetIVIMHeadingParams(packetHandle, value.referencePositionHeading, newPath);
    result = CheckLastError("IVIM", gkFuncRefGet, result);
  }
  snprintf(newPath, elcount(newPath), "%s.%s", oldPath, "referencePositionSpeed");
  value.referencePositionSpeed.isValidFlag = C2xIsTokenAvailable(packetHandle, "IVIM", newPath);
  if(value.referencePositionSpeed.isValidFlag==1)
  {
    GetIVIMSpeedParams(packetHandle, value.referencePositionSpeed, newPath);
    result = CheckLastError("IVIM", gkFuncRefGet, result);
  }
  snprintf(newPath, elcount(newPath), "%s.%s", oldPath, "parts");
  GetIVIMGlcPartsParams(packetHandle, value.parts, newPath);
  result = CheckLastError("IVIM", gkFuncRefGet, result);

  return result;
}

int SetIVIMGeographicLocationContainerParams(LONG packetHandle, struct IVIMGeographicLocationContainer value, char oldPath[])
{
  char newPath[300];
  int result;

  result = 0;

  snprintf(newPath, elcount(newPath), "%s.%s", oldPath, "referencePosition");
  SetIVIMReferencePositionParams(packetHandle, value.referencePosition, newPath);
  result = CheckLastError("IVIM", gkFuncRefGet, result);

  snprintf(newPath, elcount(newPath), "%s.%s", oldPath, "referencePositionTime");
  if(value.referencePositionTime.isValidFlag==1)
  {
    C2xSetTokenInt64(packetHandle, "IVIM", newPath, value.referencePositionTime.value);
    result = CheckLastError("IVIM", gkFuncRefGet, result);
  }
  else
  {
    if( C2xIsTokenAvailable(packetHandle, "IVIM", newPath) )
    {
      C2xRemoveToken(packetHandle, "IVIM", newPath);
    }
  }

  snprintf(newPath, elcount(newPath), "%s.%s", oldPath, "referencePositionHeading");
  if(value.referencePositionHeading.isValidFlag==1)
  {
    SetIVIMHeadingParams(packetHandle, value.referencePositionHeading, newPath);
    result = CheckLastError("IVIM", gkFuncRefGet, result);
  }
  else
  {
    if( C2xIsTokenAvailable(packetHandle, "IVIM", newPath) )
    {
      C2xRemoveToken(packetHandle, "IVIM", newPath);
    }
  }

  snprintf(newPath, elcount(newPath), "%s.%s", oldPath, "referencePositionSpeed");
  if(value.referencePositionSpeed.isValidFlag==1)
  {
    SetIVIMSpeedParams(packetHandle, value.referencePositionSpeed, newPath);
    result = CheckLastError("IVIM", gkFuncRefGet, result);
  }
  else
  {
    if( C2xIsTokenAvailable(packetHandle, "IVIM", newPath) )
    {
      C2xRemoveToken(packetHandle, "IVIM", newPath);
    }
  }

  snprintf(newPath, elcount(newPath), "%s.%s", oldPath, "parts");
  SetIVIMGlcPartsParams(packetHandle, value.parts, newPath);
  result = CheckLastError("IVIM", gkFuncRefGet, result);

  return result;
}

int GetIVIMZoneIdsParams(LONG packetHandle, struct IVIMZoneIds value, char oldPath[])
{
  char newPath[300]; 
  int i;
  int result;

  result = 0;

  value.length = C2xGetTokenInt(packetHandle, "IVIM", oldPath);
  if((result = CheckLastError("IVIM", gkFuncRefGet, result))==0)
  {
    for(i=0; i<value.length; i++)
    {
      snprintf(newPath, elcount(newPath), "%s[%d]", oldPath, i);
      value.arrayValue[i] = C2xGetTokenInt64(packetHandle, "IVIM", newPath);
      result = CheckLastError("IVIM", gkFuncRefGet, result);
    }
  }
  return result;
}

int SetIVIMZoneIdsParams(LONG packetHandle, struct IVIMZoneIds value, char oldPath[])
{
  char newPath[300]; 
  int i;
  int result;

  result = 0;

  C2xRemoveToken(packetHandle, "IVIM", oldPath);
  for(i=0; i<value.length; i++)
  {
    snprintf(newPath, elcount(newPath), "%s[%d]", oldPath, i);
    C2xSetTokenInt64(packetHandle, "IVIM", newPath, value.arrayValue[i]);
    result = CheckLastError("IVIM", gkFuncRefGet, result);
  }
  return result;
}

int GetIVIMExt2Params(LONG packetHandle, struct IVIMExt2 value, char oldPath[])
{
  char newPath[300];
  int result;

  result = 0;

  value.choice = C2xGetTokenInt(packetHandle, "IVIM", oldPath);

  switch(value.choice)
  {
    case 0:
    {
      snprintf(newPath, elcount(newPath), "%s.%s", oldPath, "content");
      value.content = C2xGetTokenInt(packetHandle, "IVIM", newPath);
      result = CheckLastError("IVIM", gkFuncRefGet, result);
    }
    break;
    case 1:
    {
      snprintf(newPath, elcount(newPath), "%s.%s", oldPath, "extension");
      value.extension = C2xGetTokenInt(packetHandle, "IVIM", newPath);
      result = CheckLastError("IVIM", gkFuncRefGet, result);
    }
    break;
  }
  return result;
}

int SetIVIMExt2Params(LONG packetHandle, struct IVIMExt2 value, char oldPath[])
{
  char newPath[300];
  int result;

  result = 0;

  switch(value.choice)
  {
    case 0:
    {
      snprintf(newPath, elcount(newPath), "%s.%s", oldPath, "content");
      C2xSetTokenInt(packetHandle, "IVIM", newPath, value.content);
      result = CheckLastError("IVIM", gkFuncRefGet, result);
    }
    break;
    case 1:
    {
      snprintf(newPath, elcount(newPath), "%s.%s", oldPath, "extension");
      C2xSetTokenInt(packetHandle, "IVIM", newPath, value.extension);
      result = CheckLastError("IVIM", gkFuncRefGet, result);
    }
    break;
  }
  return result;
}

int GetIVIMExt1Params(LONG packetHandle, struct IVIMExt1 value, char oldPath[])
{
  char newPath[300];
  int result;

  result = 0;

  value.choice = C2xGetTokenInt(packetHandle, "IVIM", oldPath);

  switch(value.choice)
  {
    case 0:
    {
      snprintf(newPath, elcount(newPath), "%s.%s", oldPath, "content");
      value.content = C2xGetTokenInt(packetHandle, "IVIM", newPath);
      result = CheckLastError("IVIM", gkFuncRefGet, result);
    }
    break;
    case 1:
    {
      snprintf(newPath, elcount(newPath), "%s.%s", oldPath, "extension");
      GetIVIMExt2Params(packetHandle, value.extension, newPath);
      result = CheckLastError("IVIM", gkFuncRefGet, result);
    }
    break;
  }
  return result;
}

int SetIVIMExt1Params(LONG packetHandle, struct IVIMExt1 value, char oldPath[])
{
  char newPath[300];
  int result;

  result = 0;

  switch(value.choice)
  {
    case 0:
    {
      snprintf(newPath, elcount(newPath), "%s.%s", oldPath, "content");
      C2xSetTokenInt(packetHandle, "IVIM", newPath, value.content);
      result = CheckLastError("IVIM", gkFuncRefGet, result);
    }
    break;
    case 1:
    {
      snprintf(newPath, elcount(newPath), "%s.%s", oldPath, "extension");
      SetIVIMExt2Params(packetHandle, value.extension, newPath);
      result = CheckLastError("IVIM", gkFuncRefGet, result);
    }
    break;
  }
  return result;
}

int GetIVIMVarLengthNumberParams(LONG packetHandle, struct IVIMVarLengthNumber value, char oldPath[])
{
  char newPath[300];
  int result;

  result = 0;

  value.choice = C2xGetTokenInt(packetHandle, "IVIM", oldPath);

  switch(value.choice)
  {
    case 0:
    {
      snprintf(newPath, elcount(newPath), "%s.%s", oldPath, "content");
      value.content = C2xGetTokenInt(packetHandle, "IVIM", newPath);
      result = CheckLastError("IVIM", gkFuncRefGet, result);
    }
    break;
    case 1:
    {
      snprintf(newPath, elcount(newPath), "%s.%s", oldPath, "extension");
      GetIVIMExt1Params(packetHandle, value.extension, newPath);
      result = CheckLastError("IVIM", gkFuncRefGet, result);
    }
    break;
  }
  return result;
}

int SetIVIMVarLengthNumberParams(LONG packetHandle, struct IVIMVarLengthNumber value, char oldPath[])
{
  char newPath[300];
  int result;

  result = 0;

  switch(value.choice)
  {
    case 0:
    {
      snprintf(newPath, elcount(newPath), "%s.%s", oldPath, "content");
      C2xSetTokenInt(packetHandle, "IVIM", newPath, value.content);
      result = CheckLastError("IVIM", gkFuncRefGet, result);
    }
    break;
    case 1:
    {
      snprintf(newPath, elcount(newPath), "%s.%s", oldPath, "extension");
      SetIVIMExt1Params(packetHandle, value.extension, newPath);
      result = CheckLastError("IVIM", gkFuncRefGet, result);
    }
    break;
  }
  return result;
}

int GetIVIMLanePositionsParams(LONG packetHandle, struct IVIMLanePositions value, char oldPath[])
{
  char newPath[300]; 
  int i;
  int result;

  result = 0;

  value.length = C2xGetTokenInt(packetHandle, "IVIM", oldPath);
  if((result = CheckLastError("IVIM", gkFuncRefGet, result))==0)
  {
    for(i=0; i<value.length; i++)
    {
      snprintf(newPath, elcount(newPath), "%s[%d]", oldPath, i);
      value.arrayValue[i] = C2xGetTokenInt64(packetHandle, "IVIM", newPath);
      result = CheckLastError("IVIM", gkFuncRefGet, result);
    }
  }
  return result;
}

int SetIVIMLanePositionsParams(LONG packetHandle, struct IVIMLanePositions value, char oldPath[])
{
  char newPath[300]; 
  int i;
  int result;

  result = 0;

  C2xRemoveToken(packetHandle, "IVIM", oldPath);
  for(i=0; i<value.length; i++)
  {
    snprintf(newPath, elcount(newPath), "%s[%d]", oldPath, i);
    C2xSetTokenInt64(packetHandle, "IVIM", newPath, value.arrayValue[i]);
    result = CheckLastError("IVIM", gkFuncRefGet, result);
  }
  return result;
}

int GetIVIMEuVehicleCategoryCodeParams(LONG packetHandle, struct IVIMEuVehicleCategoryCode value, char oldPath[])
{
  char newPath[300];
  int result;

  result = 0;

  value.choice = C2xGetTokenInt(packetHandle, "IVIM", oldPath);

  switch(value.choice)
  {
    case 0:
    {
      snprintf(newPath, elcount(newPath), "%s.%s", oldPath, "euVehicleCategoryL");
      value.euVehicleCategoryL = C2xGetTokenInt(packetHandle, "IVIM", newPath);
      result = CheckLastError("IVIM", gkFuncRefGet, result);
    }
    break;
    case 1:
    {
      snprintf(newPath, elcount(newPath), "%s.%s", oldPath, "euVehicleCategoryM");
      value.euVehicleCategoryM = C2xGetTokenInt(packetHandle, "IVIM", newPath);
      result = CheckLastError("IVIM", gkFuncRefGet, result);
    }
    break;
    case 2:
    {
      snprintf(newPath, elcount(newPath), "%s.%s", oldPath, "euVehicleCategoryN");
      value.euVehicleCategoryN = C2xGetTokenInt(packetHandle, "IVIM", newPath);
      result = CheckLastError("IVIM", gkFuncRefGet, result);
    }
    break;
    case 3:
    {
      snprintf(newPath, elcount(newPath), "%s.%s", oldPath, "euVehicleCategoryO");
      value.euVehicleCategoryO = C2xGetTokenInt(packetHandle, "IVIM", newPath);
      result = CheckLastError("IVIM", gkFuncRefGet, result);
    }
    break;
  }
  return result;
}

int SetIVIMEuVehicleCategoryCodeParams(LONG packetHandle, struct IVIMEuVehicleCategoryCode value, char oldPath[])
{
  char newPath[300];
  int result;

  result = 0;

  switch(value.choice)
  {
    case 0:
    {
      snprintf(newPath, elcount(newPath), "%s.%s", oldPath, "euVehicleCategoryL");
      C2xSetTokenInt(packetHandle, "IVIM", newPath, value.euVehicleCategoryL);
      result = CheckLastError("IVIM", gkFuncRefGet, result);
    }
    break;
    case 1:
    {
      snprintf(newPath, elcount(newPath), "%s.%s", oldPath, "euVehicleCategoryM");
      C2xSetTokenInt(packetHandle, "IVIM", newPath, value.euVehicleCategoryM);
      result = CheckLastError("IVIM", gkFuncRefGet, result);
    }
    break;
    case 2:
    {
      snprintf(newPath, elcount(newPath), "%s.%s", oldPath, "euVehicleCategoryN");
      C2xSetTokenInt(packetHandle, "IVIM", newPath, value.euVehicleCategoryN);
      result = CheckLastError("IVIM", gkFuncRefGet, result);
    }
    break;
    case 3:
    {
      snprintf(newPath, elcount(newPath), "%s.%s", oldPath, "euVehicleCategoryO");
      C2xSetTokenInt(packetHandle, "IVIM", newPath, value.euVehicleCategoryO);
      result = CheckLastError("IVIM", gkFuncRefGet, result);
    }
    break;
  }
  return result;
}

int GetIVIMEnvironmentalCharacteristicsParams(LONG packetHandle, struct IVIMEnvironmentalCharacteristics value, char oldPath[])
{
  char newPath[300];
  int result;

  result = 0;

  snprintf(newPath, elcount(newPath), "%s.%s", oldPath, "euroValue");
  value.euroValue = C2xGetTokenInt(packetHandle, "IVIM", newPath);
  result = CheckLastError("IVIM", gkFuncRefGet, result);

  snprintf(newPath, elcount(newPath), "%s.%s", oldPath, "copValue");
  value.copValue = C2xGetTokenInt(packetHandle, "IVIM", newPath);
  result = CheckLastError("IVIM", gkFuncRefGet, result);

  return result;
}

int SetIVIMEnvironmentalCharacteristicsParams(LONG packetHandle, struct IVIMEnvironmentalCharacteristics value, char oldPath[])
{
  char newPath[300];
  int result;

  result = 0;

  snprintf(newPath, elcount(newPath), "%s.%s", oldPath, "euroValue");
  C2xSetTokenInt(packetHandle, "IVIM", newPath, value.euroValue);
  result = CheckLastError("IVIM", gkFuncRefGet, result);

  snprintf(newPath, elcount(newPath), "%s.%s", oldPath, "copValue");
  C2xSetTokenInt(packetHandle, "IVIM", newPath, value.copValue);
  result = CheckLastError("IVIM", gkFuncRefGet, result);

  return result;
}

int GetIVIMLoadTypeParams(LONG packetHandle, struct IVIMLoadType value, char oldPath[])
{
  char newPath[300]; 
  int j; 
  int k;
  int result;

  result = 0;

  snprintf(newPath, elcount(newPath), "%s.%s", oldPath, "goodsType");
  value.goodsType = C2xGetTokenInt(packetHandle, "IVIM", newPath);
  result = CheckLastError("IVIM", gkFuncRefGet, result);

  snprintf(newPath, elcount(newPath), "%s.%s", oldPath, "dangerousGoodsType");
  value.dangerousGoodsType = C2xGetTokenInt(packetHandle, "IVIM", newPath);
  result = CheckLastError("IVIM", gkFuncRefGet, result);

  snprintf(newPath, elcount(newPath), "%s.%s", oldPath, "specialTransportType");
  value.specialTransportType.isValidFlag = 1;
  value.specialTransportType.stringLength = C2xGetTokenLengthBit(packetHandle, "IVIM", newPath);
  if ((result = CheckLastError("IVIM", gkFuncRefGet, result))==0)
  {
    if(value.specialTransportType.stringLength > 0)
    {
      for(j=0; j<value.specialTransportType.stringLength; j++)
      {
        if(C2xGetTokenBitOfBitString(packetHandle, "IVIM", newPath, j) == 0)
        {
          value.specialTransportType.string[j] = '0';
        }
        else if(C2xGetTokenBitOfBitString(packetHandle, "IVIM", newPath, j) == 1)
        {
          value.specialTransportType.string[j] = '1';
        }

        if(value.specialTransportType.stringLength == 1)
        {
          value.specialTransportType.string[1] = '0';
        }
        result = CheckLastError("IVIM", gkFuncRefGet, result);
      }
    }
    else
    {
      for(k = value.specialTransportType.stringLength+1; k > -1; k--)
      {
        if(value.specialTransportType.string[k] == '1')
        {
          value.specialTransportType.string[k] = '0';
        }
      }
    }
  }

  return result;
}

int SetIVIMLoadTypeParams(LONG packetHandle, struct IVIMLoadType value, char oldPath[])
{
  char newPath[300]; 
  int j;
  int result;

  result = 0;

  snprintf(newPath, elcount(newPath), "%s.%s", oldPath, "goodsType");
  C2xSetTokenInt(packetHandle, "IVIM", newPath, value.goodsType);
  result = CheckLastError("IVIM", gkFuncRefGet, result);

  snprintf(newPath, elcount(newPath), "%s.%s", oldPath, "dangerousGoodsType");
  C2xSetTokenInt(packetHandle, "IVIM", newPath, value.dangerousGoodsType);
  result = CheckLastError("IVIM", gkFuncRefGet, result);

  snprintf(newPath, elcount(newPath), "%s.%s", oldPath, "specialTransportType");
    for(j=0; j<value.specialTransportType.stringLength; j++)
    {
      if(value.specialTransportType.string[j] == '0')
      {
        C2xSetTokenBitOfBitString(packetHandle, "IVIM", newPath, j, 0);
      }
      else
      {
        C2xSetTokenBitOfBitString(packetHandle, "IVIM", newPath, j, 1);
      }
      result = CheckLastError("IVIM", gkFuncRefGet, result);
    }

  return result;
}

int GetIVIMVehicleCharacteristicsFixValuesParams(LONG packetHandle, struct IVIMVehicleCharacteristicsFixValues value, char oldPath[])
{
  char newPath[300];
  int result;

  result = 0;

  value.choice = C2xGetTokenInt(packetHandle, "IVIM", oldPath);

  switch(value.choice)
  {
    case 0:
    {
      snprintf(newPath, elcount(newPath), "%s.%s", oldPath, "simpleVehicleType");
      value.simpleVehicleType = C2xGetTokenInt(packetHandle, "IVIM", newPath);
      result = CheckLastError("IVIM", gkFuncRefGet, result);
    }
    break;
    case 1:
    {
      snprintf(newPath, elcount(newPath), "%s.%s", oldPath, "euVehicleCategoryCode");
      GetIVIMEuVehicleCategoryCodeParams(packetHandle, value.euVehicleCategoryCode, newPath);
      result = CheckLastError("IVIM", gkFuncRefGet, result);
    }
    break;
    case 2:
    {
      snprintf(newPath, elcount(newPath), "%s.%s", oldPath, "iso3833VehicleType");
      value.iso3833VehicleType = C2xGetTokenInt(packetHandle, "IVIM", newPath);
      result = CheckLastError("IVIM", gkFuncRefGet, result);
    }
    break;
    case 3:
    {
      snprintf(newPath, elcount(newPath), "%s.%s", oldPath, "euroAndCo2value");
      GetIVIMEnvironmentalCharacteristicsParams(packetHandle, value.euroAndCo2value, newPath);
      result = CheckLastError("IVIM", gkFuncRefGet, result);
    }
    break;
    case 4:
    {
      snprintf(newPath, elcount(newPath), "%s.%s", oldPath, "engineCharacteristics");
      value.engineCharacteristics = C2xGetTokenInt(packetHandle, "IVIM", newPath);
      result = CheckLastError("IVIM", gkFuncRefGet, result);
    }
    break;
    case 5:
    {
      snprintf(newPath, elcount(newPath), "%s.%s", oldPath, "loadType");
      GetIVIMLoadTypeParams(packetHandle, value.loadType, newPath);
      result = CheckLastError("IVIM", gkFuncRefGet, result);
    }
    break;
    case 6:
    {
      snprintf(newPath, elcount(newPath), "%s.%s", oldPath, "usage");
      value.usage = C2xGetTokenInt(packetHandle, "IVIM", newPath);
      result = CheckLastError("IVIM", gkFuncRefGet, result);
    }
    break;
  }
  return result;
}

int SetIVIMVehicleCharacteristicsFixValuesParams(LONG packetHandle, struct IVIMVehicleCharacteristicsFixValues value, char oldPath[])
{
  char newPath[300];
  int result;

  result = 0;

  switch(value.choice)
  {
    case 0:
    {
      snprintf(newPath, elcount(newPath), "%s.%s", oldPath, "simpleVehicleType");
      C2xSetTokenInt(packetHandle, "IVIM", newPath, value.simpleVehicleType);
      result = CheckLastError("IVIM", gkFuncRefGet, result);
    }
    break;
    case 1:
    {
      snprintf(newPath, elcount(newPath), "%s.%s", oldPath, "euVehicleCategoryCode");
      SetIVIMEuVehicleCategoryCodeParams(packetHandle, value.euVehicleCategoryCode, newPath);
      result = CheckLastError("IVIM", gkFuncRefGet, result);
    }
    break;
    case 2:
    {
      snprintf(newPath, elcount(newPath), "%s.%s", oldPath, "iso3833VehicleType");
      C2xSetTokenInt(packetHandle, "IVIM", newPath, value.iso3833VehicleType);
      result = CheckLastError("IVIM", gkFuncRefGet, result);
    }
    break;
    case 3:
    {
      snprintf(newPath, elcount(newPath), "%s.%s", oldPath, "euroAndCo2value");
      SetIVIMEnvironmentalCharacteristicsParams(packetHandle, value.euroAndCo2value, newPath);
      result = CheckLastError("IVIM", gkFuncRefGet, result);
    }
    break;
    case 4:
    {
      snprintf(newPath, elcount(newPath), "%s.%s", oldPath, "engineCharacteristics");
      C2xSetTokenInt(packetHandle, "IVIM", newPath, value.engineCharacteristics);
      result = CheckLastError("IVIM", gkFuncRefGet, result);
    }
    break;
    case 5:
    {
      snprintf(newPath, elcount(newPath), "%s.%s", oldPath, "loadType");
      SetIVIMLoadTypeParams(packetHandle, value.loadType, newPath);
      result = CheckLastError("IVIM", gkFuncRefGet, result);
    }
    break;
    case 6:
    {
      snprintf(newPath, elcount(newPath), "%s.%s", oldPath, "usage");
      C2xSetTokenInt(packetHandle, "IVIM", newPath, value.usage);
      result = CheckLastError("IVIM", gkFuncRefGet, result);
    }
    break;
  }
  return result;
}

int GetIVIMVehicleCharacteristicsFixValuesListParams(LONG packetHandle, struct IVIMVehicleCharacteristicsFixValuesList value, char oldPath[])
{
  char newPath[300]; 
  int i;
  int result;

  result = 0;

  value.length = C2xGetTokenInt(packetHandle, "IVIM", oldPath);
  if((result = CheckLastError("IVIM", gkFuncRefGet, result))==0)
  {
    for(i=0; i<value.length; i++)
    {
      snprintf(newPath, elcount(newPath), "%s[%d]", oldPath, i);
      GetIVIMVehicleCharacteristicsFixValuesParams(packetHandle, value.arrayValue[i], newPath);
      result = CheckLastError("IVIM", gkFuncRefGet, result);
    }
  }
  return result;
}

int SetIVIMVehicleCharacteristicsFixValuesListParams(LONG packetHandle, struct IVIMVehicleCharacteristicsFixValuesList value, char oldPath[])
{
  char newPath[300]; 
  int i;
  int result;

  result = 0;

  C2xRemoveToken(packetHandle, "IVIM", oldPath);
  for(i=0; i<value.length; i++)
  {
    snprintf(newPath, elcount(newPath), "%s[%d]", oldPath, i);
    SetIVIMVehicleCharacteristicsFixValuesParams(packetHandle, value.arrayValue[i], newPath);
    result = CheckLastError("IVIM", gkFuncRefGet, result);
  }
  return result;
}

int GetIVIMVehicleDimensionsParams(LONG packetHandle, struct IVIMVehicleDimensions value, char oldPath[])
{
  char newPath[300];
  int result;

  result = 0;

  snprintf(newPath, elcount(newPath), "%s.%s", oldPath, "vehicleLengthOverall");
  value.vehicleLengthOverall = C2xGetTokenInt(packetHandle, "IVIM", newPath);
  result = CheckLastError("IVIM", gkFuncRefGet, result);

  snprintf(newPath, elcount(newPath), "%s.%s", oldPath, "vehicleHeigthOverall");
  value.vehicleHeigthOverall = C2xGetTokenInt(packetHandle, "IVIM", newPath);
  result = CheckLastError("IVIM", gkFuncRefGet, result);

  snprintf(newPath, elcount(newPath), "%s.%s", oldPath, "vehicleWidthOverall");
  value.vehicleWidthOverall = C2xGetTokenInt(packetHandle, "IVIM", newPath);
  result = CheckLastError("IVIM", gkFuncRefGet, result);

  return result;
}

int SetIVIMVehicleDimensionsParams(LONG packetHandle, struct IVIMVehicleDimensions value, char oldPath[])
{
  char newPath[300];
  int result;

  result = 0;

  snprintf(newPath, elcount(newPath), "%s.%s", oldPath, "vehicleLengthOverall");
  C2xSetTokenInt(packetHandle, "IVIM", newPath, value.vehicleLengthOverall);
  result = CheckLastError("IVIM", gkFuncRefGet, result);

  snprintf(newPath, elcount(newPath), "%s.%s", oldPath, "vehicleHeigthOverall");
  C2xSetTokenInt(packetHandle, "IVIM", newPath, value.vehicleHeigthOverall);
  result = CheckLastError("IVIM", gkFuncRefGet, result);

  snprintf(newPath, elcount(newPath), "%s.%s", oldPath, "vehicleWidthOverall");
  C2xSetTokenInt(packetHandle, "IVIM", newPath, value.vehicleWidthOverall);
  result = CheckLastError("IVIM", gkFuncRefGet, result);

  return result;
}

int GetIVIMVehicleWeightLimitsParams(LONG packetHandle, struct IVIMVehicleWeightLimits value, char oldPath[])
{
  char newPath[300];
  int result;

  result = 0;

  snprintf(newPath, elcount(newPath), "%s.%s", oldPath, "vehicleMaxLadenWeight");
  value.vehicleMaxLadenWeight = C2xGetTokenInt(packetHandle, "IVIM", newPath);
  result = CheckLastError("IVIM", gkFuncRefGet, result);

  snprintf(newPath, elcount(newPath), "%s.%s", oldPath, "vehicleTrainMaximumWeight");
  value.vehicleTrainMaximumWeight = C2xGetTokenInt(packetHandle, "IVIM", newPath);
  result = CheckLastError("IVIM", gkFuncRefGet, result);

  snprintf(newPath, elcount(newPath), "%s.%s", oldPath, "vehicleWeightUnladen");
  value.vehicleWeightUnladen = C2xGetTokenInt(packetHandle, "IVIM", newPath);
  result = CheckLastError("IVIM", gkFuncRefGet, result);

  return result;
}

int SetIVIMVehicleWeightLimitsParams(LONG packetHandle, struct IVIMVehicleWeightLimits value, char oldPath[])
{
  char newPath[300];
  int result;

  result = 0;

  snprintf(newPath, elcount(newPath), "%s.%s", oldPath, "vehicleMaxLadenWeight");
  C2xSetTokenInt(packetHandle, "IVIM", newPath, value.vehicleMaxLadenWeight);
  result = CheckLastError("IVIM", gkFuncRefGet, result);

  snprintf(newPath, elcount(newPath), "%s.%s", oldPath, "vehicleTrainMaximumWeight");
  C2xSetTokenInt(packetHandle, "IVIM", newPath, value.vehicleTrainMaximumWeight);
  result = CheckLastError("IVIM", gkFuncRefGet, result);

  snprintf(newPath, elcount(newPath), "%s.%s", oldPath, "vehicleWeightUnladen");
  C2xSetTokenInt(packetHandle, "IVIM", newPath, value.vehicleWeightUnladen);
  result = CheckLastError("IVIM", gkFuncRefGet, result);

  return result;
}

int GetIVIMAxleWeightLimitsParams(LONG packetHandle, struct IVIMAxleWeightLimits value, char oldPath[])
{
  char newPath[300];
  int result;

  result = 0;

  snprintf(newPath, elcount(newPath), "%s.%s", oldPath, "maxLadenweightOnAxle1");
  value.maxLadenweightOnAxle1 = C2xGetTokenInt(packetHandle, "IVIM", newPath);
  result = CheckLastError("IVIM", gkFuncRefGet, result);

  snprintf(newPath, elcount(newPath), "%s.%s", oldPath, "maxLadenweightOnAxle2");
  value.maxLadenweightOnAxle2 = C2xGetTokenInt(packetHandle, "IVIM", newPath);
  result = CheckLastError("IVIM", gkFuncRefGet, result);

  snprintf(newPath, elcount(newPath), "%s.%s", oldPath, "maxLadenweightOnAxle3");
  value.maxLadenweightOnAxle3 = C2xGetTokenInt(packetHandle, "IVIM", newPath);
  result = CheckLastError("IVIM", gkFuncRefGet, result);

  snprintf(newPath, elcount(newPath), "%s.%s", oldPath, "maxLadenweightOnAxle4");
  value.maxLadenweightOnAxle4 = C2xGetTokenInt(packetHandle, "IVIM", newPath);
  result = CheckLastError("IVIM", gkFuncRefGet, result);

  snprintf(newPath, elcount(newPath), "%s.%s", oldPath, "maxLadenweightOnAxle5");
  value.maxLadenweightOnAxle5 = C2xGetTokenInt(packetHandle, "IVIM", newPath);
  result = CheckLastError("IVIM", gkFuncRefGet, result);

  return result;
}

int SetIVIMAxleWeightLimitsParams(LONG packetHandle, struct IVIMAxleWeightLimits value, char oldPath[])
{
  char newPath[300];
  int result;

  result = 0;

  snprintf(newPath, elcount(newPath), "%s.%s", oldPath, "maxLadenweightOnAxle1");
  C2xSetTokenInt(packetHandle, "IVIM", newPath, value.maxLadenweightOnAxle1);
  result = CheckLastError("IVIM", gkFuncRefGet, result);

  snprintf(newPath, elcount(newPath), "%s.%s", oldPath, "maxLadenweightOnAxle2");
  C2xSetTokenInt(packetHandle, "IVIM", newPath, value.maxLadenweightOnAxle2);
  result = CheckLastError("IVIM", gkFuncRefGet, result);

  snprintf(newPath, elcount(newPath), "%s.%s", oldPath, "maxLadenweightOnAxle3");
  C2xSetTokenInt(packetHandle, "IVIM", newPath, value.maxLadenweightOnAxle3);
  result = CheckLastError("IVIM", gkFuncRefGet, result);

  snprintf(newPath, elcount(newPath), "%s.%s", oldPath, "maxLadenweightOnAxle4");
  C2xSetTokenInt(packetHandle, "IVIM", newPath, value.maxLadenweightOnAxle4);
  result = CheckLastError("IVIM", gkFuncRefGet, result);

  snprintf(newPath, elcount(newPath), "%s.%s", oldPath, "maxLadenweightOnAxle5");
  C2xSetTokenInt(packetHandle, "IVIM", newPath, value.maxLadenweightOnAxle5);
  result = CheckLastError("IVIM", gkFuncRefGet, result);

  return result;
}

int GetIVIMPassengerCapacityParams(LONG packetHandle, struct IVIMPassengerCapacity value, char oldPath[])
{
  char newPath[300];
  int result;

  result = 0;

  snprintf(newPath, elcount(newPath), "%s.%s", oldPath, "numberOfSeats");
  value.numberOfSeats = C2xGetTokenInt(packetHandle, "IVIM", newPath);
  result = CheckLastError("IVIM", gkFuncRefGet, result);

  snprintf(newPath, elcount(newPath), "%s.%s", oldPath, "numberOfStandingPlaces");
  value.numberOfStandingPlaces = C2xGetTokenInt(packetHandle, "IVIM", newPath);
  result = CheckLastError("IVIM", gkFuncRefGet, result);

  return result;
}

int SetIVIMPassengerCapacityParams(LONG packetHandle, struct IVIMPassengerCapacity value, char oldPath[])
{
  char newPath[300];
  int result;

  result = 0;

  snprintf(newPath, elcount(newPath), "%s.%s", oldPath, "numberOfSeats");
  C2xSetTokenInt(packetHandle, "IVIM", newPath, value.numberOfSeats);
  result = CheckLastError("IVIM", gkFuncRefGet, result);

  snprintf(newPath, elcount(newPath), "%s.%s", oldPath, "numberOfStandingPlaces");
  C2xSetTokenInt(packetHandle, "IVIM", newPath, value.numberOfStandingPlaces);
  result = CheckLastError("IVIM", gkFuncRefGet, result);

  return result;
}

int GetIVIMExhaustEmissionValuesParams(LONG packetHandle, struct IVIMExhaustEmissionValues value, char oldPath[])
{
  char newPath[300];
  int result;

  result = 0;

  snprintf(newPath, elcount(newPath), "%s.%s", oldPath, "unitType");
  value.unitType = C2xGetTokenInt(packetHandle, "IVIM", newPath);
  result = CheckLastError("IVIM", gkFuncRefGet, result);

  snprintf(newPath, elcount(newPath), "%s.%s", oldPath, "emissionCO");
  value.emissionCO = C2xGetTokenInt(packetHandle, "IVIM", newPath);
  result = CheckLastError("IVIM", gkFuncRefGet, result);

  snprintf(newPath, elcount(newPath), "%s.%s", oldPath, "emissionHC");
  value.emissionHC = C2xGetTokenInt(packetHandle, "IVIM", newPath);
  result = CheckLastError("IVIM", gkFuncRefGet, result);

  snprintf(newPath, elcount(newPath), "%s.%s", oldPath, "emissionNOX");
  value.emissionNOX = C2xGetTokenInt(packetHandle, "IVIM", newPath);
  result = CheckLastError("IVIM", gkFuncRefGet, result);

  snprintf(newPath, elcount(newPath), "%s.%s", oldPath, "emissionHCNOX");
  value.emissionHCNOX = C2xGetTokenInt(packetHandle, "IVIM", newPath);
  result = CheckLastError("IVIM", gkFuncRefGet, result);

  return result;
}

int SetIVIMExhaustEmissionValuesParams(LONG packetHandle, struct IVIMExhaustEmissionValues value, char oldPath[])
{
  char newPath[300];
  int result;

  result = 0;

  snprintf(newPath, elcount(newPath), "%s.%s", oldPath, "unitType");
  C2xSetTokenInt(packetHandle, "IVIM", newPath, value.unitType);
  result = CheckLastError("IVIM", gkFuncRefGet, result);

  snprintf(newPath, elcount(newPath), "%s.%s", oldPath, "emissionCO");
  C2xSetTokenInt(packetHandle, "IVIM", newPath, value.emissionCO);
  result = CheckLastError("IVIM", gkFuncRefGet, result);

  snprintf(newPath, elcount(newPath), "%s.%s", oldPath, "emissionHC");
  C2xSetTokenInt(packetHandle, "IVIM", newPath, value.emissionHC);
  result = CheckLastError("IVIM", gkFuncRefGet, result);

  snprintf(newPath, elcount(newPath), "%s.%s", oldPath, "emissionNOX");
  C2xSetTokenInt(packetHandle, "IVIM", newPath, value.emissionNOX);
  result = CheckLastError("IVIM", gkFuncRefGet, result);

  snprintf(newPath, elcount(newPath), "%s.%s", oldPath, "emissionHCNOX");
  C2xSetTokenInt(packetHandle, "IVIM", newPath, value.emissionHCNOX);
  result = CheckLastError("IVIM", gkFuncRefGet, result);

  return result;
}

int GetIVIMDieselEmissionValues_particulateParams(LONG packetHandle, struct IVIMDieselEmissionValues_particulate value, char oldPath[])
{
  char newPath[300];
  int result;

  result = 0;

  snprintf(newPath, elcount(newPath), "%s.%s", oldPath, "unitType");
  value.unitType = C2xGetTokenInt(packetHandle, "IVIM", newPath);
  result = CheckLastError("IVIM", gkFuncRefGet, result);

  snprintf(newPath, elcount(newPath), "%s.%s", oldPath, "value");
  value.value = C2xGetTokenInt(packetHandle, "IVIM", newPath);
  result = CheckLastError("IVIM", gkFuncRefGet, result);

  return result;
}

int SetIVIMDieselEmissionValues_particulateParams(LONG packetHandle, struct IVIMDieselEmissionValues_particulate value, char oldPath[])
{
  char newPath[300];
  int result;

  result = 0;

  snprintf(newPath, elcount(newPath), "%s.%s", oldPath, "unitType");
  C2xSetTokenInt(packetHandle, "IVIM", newPath, value.unitType);
  result = CheckLastError("IVIM", gkFuncRefGet, result);

  snprintf(newPath, elcount(newPath), "%s.%s", oldPath, "value");
  C2xSetTokenInt(packetHandle, "IVIM", newPath, value.value);
  result = CheckLastError("IVIM", gkFuncRefGet, result);

  return result;
}

int GetIVIMDieselEmissionValuesParams(LONG packetHandle, struct IVIMDieselEmissionValues value, char oldPath[])
{
  char newPath[300];
  int result;

  result = 0;

  snprintf(newPath, elcount(newPath), "%s.%s", oldPath, "particulate");
  GetIVIMDieselEmissionValues_particulateParams(packetHandle, value.particulate, newPath);
  result = CheckLastError("IVIM", gkFuncRefGet, result);

  snprintf(newPath, elcount(newPath), "%s.%s", oldPath, "absorptionCoeff");
  value.absorptionCoeff = C2xGetTokenInt(packetHandle, "IVIM", newPath);
  result = CheckLastError("IVIM", gkFuncRefGet, result);

  return result;
}

int SetIVIMDieselEmissionValuesParams(LONG packetHandle, struct IVIMDieselEmissionValues value, char oldPath[])
{
  char newPath[300];
  int result;

  result = 0;

  snprintf(newPath, elcount(newPath), "%s.%s", oldPath, "particulate");
  SetIVIMDieselEmissionValues_particulateParams(packetHandle, value.particulate, newPath);
  result = CheckLastError("IVIM", gkFuncRefGet, result);

  snprintf(newPath, elcount(newPath), "%s.%s", oldPath, "absorptionCoeff");
  C2xSetTokenInt(packetHandle, "IVIM", newPath, value.absorptionCoeff);
  result = CheckLastError("IVIM", gkFuncRefGet, result);

  return result;
}

int GetIVIMSoundLevelParams(LONG packetHandle, struct IVIMSoundLevel value, char oldPath[])
{
  char newPath[300];
  int result;

  result = 0;

  snprintf(newPath, elcount(newPath), "%s.%s", oldPath, "soundstationary");
  value.soundstationary = C2xGetTokenInt(packetHandle, "IVIM", newPath);
  result = CheckLastError("IVIM", gkFuncRefGet, result);

  snprintf(newPath, elcount(newPath), "%s.%s", oldPath, "sounddriveby");
  value.sounddriveby = C2xGetTokenInt(packetHandle, "IVIM", newPath);
  result = CheckLastError("IVIM", gkFuncRefGet, result);

  return result;
}

int SetIVIMSoundLevelParams(LONG packetHandle, struct IVIMSoundLevel value, char oldPath[])
{
  char newPath[300];
  int result;

  result = 0;

  snprintf(newPath, elcount(newPath), "%s.%s", oldPath, "soundstationary");
  C2xSetTokenInt(packetHandle, "IVIM", newPath, value.soundstationary);
  result = CheckLastError("IVIM", gkFuncRefGet, result);

  snprintf(newPath, elcount(newPath), "%s.%s", oldPath, "sounddriveby");
  C2xSetTokenInt(packetHandle, "IVIM", newPath, value.sounddriveby);
  result = CheckLastError("IVIM", gkFuncRefGet, result);

  return result;
}

int GetIVIMVehicleCharacteristicsRanges_limitsParams(LONG packetHandle, struct IVIMVehicleCharacteristicsRanges_limits value, char oldPath[])
{
  char newPath[300];
  int result;

  result = 0;

  value.choice = C2xGetTokenInt(packetHandle, "IVIM", oldPath);

  switch(value.choice)
  {
    case 0:
    {
      snprintf(newPath, elcount(newPath), "%s.%s", oldPath, "numberOfAxles");
      value.numberOfAxles = C2xGetTokenInt(packetHandle, "IVIM", newPath);
      result = CheckLastError("IVIM", gkFuncRefGet, result);
    }
    break;
    case 1:
    {
      snprintf(newPath, elcount(newPath), "%s.%s", oldPath, "vehicleDimensions");
      GetIVIMVehicleDimensionsParams(packetHandle, value.vehicleDimensions, newPath);
      result = CheckLastError("IVIM", gkFuncRefGet, result);
    }
    break;
    case 2:
    {
      snprintf(newPath, elcount(newPath), "%s.%s", oldPath, "vehicleWeightLimits");
      GetIVIMVehicleWeightLimitsParams(packetHandle, value.vehicleWeightLimits, newPath);
      result = CheckLastError("IVIM", gkFuncRefGet, result);
    }
    break;
    case 3:
    {
      snprintf(newPath, elcount(newPath), "%s.%s", oldPath, "axleWeightLimits");
      GetIVIMAxleWeightLimitsParams(packetHandle, value.axleWeightLimits, newPath);
      result = CheckLastError("IVIM", gkFuncRefGet, result);
    }
    break;
    case 4:
    {
      snprintf(newPath, elcount(newPath), "%s.%s", oldPath, "passengerCapacity");
      GetIVIMPassengerCapacityParams(packetHandle, value.passengerCapacity, newPath);
      result = CheckLastError("IVIM", gkFuncRefGet, result);
    }
    break;
    case 5:
    {
      snprintf(newPath, elcount(newPath), "%s.%s", oldPath, "exhaustEmissionValues");
      GetIVIMExhaustEmissionValuesParams(packetHandle, value.exhaustEmissionValues, newPath);
      result = CheckLastError("IVIM", gkFuncRefGet, result);
    }
    break;
    case 6:
    {
      snprintf(newPath, elcount(newPath), "%s.%s", oldPath, "dieselEmissionValues");
      GetIVIMDieselEmissionValuesParams(packetHandle, value.dieselEmissionValues, newPath);
      result = CheckLastError("IVIM", gkFuncRefGet, result);
    }
    break;
    case 7:
    {
      snprintf(newPath, elcount(newPath), "%s.%s", oldPath, "soundLevel");
      GetIVIMSoundLevelParams(packetHandle, value.soundLevel, newPath);
      result = CheckLastError("IVIM", gkFuncRefGet, result);
    }
    break;
  }
  return result;
}

int SetIVIMVehicleCharacteristicsRanges_limitsParams(LONG packetHandle, struct IVIMVehicleCharacteristicsRanges_limits value, char oldPath[])
{
  char newPath[300];
  int result;

  result = 0;

  switch(value.choice)
  {
    case 0:
    {
      snprintf(newPath, elcount(newPath), "%s.%s", oldPath, "numberOfAxles");
      C2xSetTokenInt(packetHandle, "IVIM", newPath, value.numberOfAxles);
      result = CheckLastError("IVIM", gkFuncRefGet, result);
    }
    break;
    case 1:
    {
      snprintf(newPath, elcount(newPath), "%s.%s", oldPath, "vehicleDimensions");
      SetIVIMVehicleDimensionsParams(packetHandle, value.vehicleDimensions, newPath);
      result = CheckLastError("IVIM", gkFuncRefGet, result);
    }
    break;
    case 2:
    {
      snprintf(newPath, elcount(newPath), "%s.%s", oldPath, "vehicleWeightLimits");
      SetIVIMVehicleWeightLimitsParams(packetHandle, value.vehicleWeightLimits, newPath);
      result = CheckLastError("IVIM", gkFuncRefGet, result);
    }
    break;
    case 3:
    {
      snprintf(newPath, elcount(newPath), "%s.%s", oldPath, "axleWeightLimits");
      SetIVIMAxleWeightLimitsParams(packetHandle, value.axleWeightLimits, newPath);
      result = CheckLastError("IVIM", gkFuncRefGet, result);
    }
    break;
    case 4:
    {
      snprintf(newPath, elcount(newPath), "%s.%s", oldPath, "passengerCapacity");
      SetIVIMPassengerCapacityParams(packetHandle, value.passengerCapacity, newPath);
      result = CheckLastError("IVIM", gkFuncRefGet, result);
    }
    break;
    case 5:
    {
      snprintf(newPath, elcount(newPath), "%s.%s", oldPath, "exhaustEmissionValues");
      SetIVIMExhaustEmissionValuesParams(packetHandle, value.exhaustEmissionValues, newPath);
      result = CheckLastError("IVIM", gkFuncRefGet, result);
    }
    break;
    case 6:
    {
      snprintf(newPath, elcount(newPath), "%s.%s", oldPath, "dieselEmissionValues");
      SetIVIMDieselEmissionValuesParams(packetHandle, value.dieselEmissionValues, newPath);
      result = CheckLastError("IVIM", gkFuncRefGet, result);
    }
    break;
    case 7:
    {
      snprintf(newPath, elcount(newPath), "%s.%s", oldPath, "soundLevel");
      SetIVIMSoundLevelParams(packetHandle, value.soundLevel, newPath);
      result = CheckLastError("IVIM", gkFuncRefGet, result);
    }
    break;
  }
  return result;
}

int GetIVIMVehicleCharacteristicsRangesParams(LONG packetHandle, struct IVIMVehicleCharacteristicsRanges value, char oldPath[])
{
  char newPath[300];
  int result;

  result = 0;

  snprintf(newPath, elcount(newPath), "%s.%s", oldPath, "comparisonOperator");
  value.comparisonOperator = C2xGetTokenInt(packetHandle, "IVIM", newPath);
  result = CheckLastError("IVIM", gkFuncRefGet, result);

  snprintf(newPath, elcount(newPath), "%s.%s", oldPath, "limits");
  GetIVIMVehicleCharacteristicsRanges_limitsParams(packetHandle, value.limits, newPath);
  result = CheckLastError("IVIM", gkFuncRefGet, result);

  return result;
}

int SetIVIMVehicleCharacteristicsRangesParams(LONG packetHandle, struct IVIMVehicleCharacteristicsRanges value, char oldPath[])
{
  char newPath[300];
  int result;

  result = 0;

  snprintf(newPath, elcount(newPath), "%s.%s", oldPath, "comparisonOperator");
  C2xSetTokenInt(packetHandle, "IVIM", newPath, value.comparisonOperator);
  result = CheckLastError("IVIM", gkFuncRefGet, result);

  snprintf(newPath, elcount(newPath), "%s.%s", oldPath, "limits");
  SetIVIMVehicleCharacteristicsRanges_limitsParams(packetHandle, value.limits, newPath);
  result = CheckLastError("IVIM", gkFuncRefGet, result);

  return result;
}

int GetIVIMVehicleCharacteristicsRangesListParams(LONG packetHandle, struct IVIMVehicleCharacteristicsRangesList value, char oldPath[])
{
  char newPath[300]; 
  int i;
  int result;

  result = 0;

  value.length = C2xGetTokenInt(packetHandle, "IVIM", oldPath);
  if((result = CheckLastError("IVIM", gkFuncRefGet, result))==0)
  {
    for(i=0; i<value.length; i++)
    {
      snprintf(newPath, elcount(newPath), "%s[%d]", oldPath, i);
      GetIVIMVehicleCharacteristicsRangesParams(packetHandle, value.arrayValue[i], newPath);
      result = CheckLastError("IVIM", gkFuncRefGet, result);
    }
  }
  return result;
}

int SetIVIMVehicleCharacteristicsRangesListParams(LONG packetHandle, struct IVIMVehicleCharacteristicsRangesList value, char oldPath[])
{
  char newPath[300]; 
  int i;
  int result;

  result = 0;

  C2xRemoveToken(packetHandle, "IVIM", oldPath);
  for(i=0; i<value.length; i++)
  {
    snprintf(newPath, elcount(newPath), "%s[%d]", oldPath, i);
    SetIVIMVehicleCharacteristicsRangesParams(packetHandle, value.arrayValue[i], newPath);
    result = CheckLastError("IVIM", gkFuncRefGet, result);
  }
  return result;
}

int GetIVIMTractorCharacteristicsParams(LONG packetHandle, struct IVIMTractorCharacteristics value, char oldPath[])
{
  char newPath[300];
  int result;

  result = 0;

  snprintf(newPath, elcount(newPath), "%s.%s", oldPath, "equalTo");
  value.equalTo.isValidFlag = C2xIsTokenAvailable(packetHandle, "IVIM", newPath);
  if(value.equalTo.isValidFlag==1)
  {
    GetIVIMVehicleCharacteristicsFixValuesListParams(packetHandle, value.equalTo, newPath);
    result = CheckLastError("IVIM", gkFuncRefGet, result);
  }
  snprintf(newPath, elcount(newPath), "%s.%s", oldPath, "notEqualTo");
  value.notEqualTo.isValidFlag = C2xIsTokenAvailable(packetHandle, "IVIM", newPath);
  if(value.notEqualTo.isValidFlag==1)
  {
    GetIVIMVehicleCharacteristicsFixValuesListParams(packetHandle, value.notEqualTo, newPath);
    result = CheckLastError("IVIM", gkFuncRefGet, result);
  }
  snprintf(newPath, elcount(newPath), "%s.%s", oldPath, "ranges");
  value.ranges.isValidFlag = C2xIsTokenAvailable(packetHandle, "IVIM", newPath);
  if(value.ranges.isValidFlag==1)
  {
    GetIVIMVehicleCharacteristicsRangesListParams(packetHandle, value.ranges, newPath);
    result = CheckLastError("IVIM", gkFuncRefGet, result);
  }
  return result;
}

int SetIVIMTractorCharacteristicsParams(LONG packetHandle, struct IVIMTractorCharacteristics value, char oldPath[])
{
  char newPath[300];
  int result;

  result = 0;

  snprintf(newPath, elcount(newPath), "%s.%s", oldPath, "equalTo");
  if(value.equalTo.isValidFlag==1)
  {
    SetIVIMVehicleCharacteristicsFixValuesListParams(packetHandle, value.equalTo, newPath);
    result = CheckLastError("IVIM", gkFuncRefGet, result);
  }
  else
  {
    if( C2xIsTokenAvailable(packetHandle, "IVIM", newPath) )
    {
      C2xRemoveToken(packetHandle, "IVIM", newPath);
    }
  }

  snprintf(newPath, elcount(newPath), "%s.%s", oldPath, "notEqualTo");
  if(value.notEqualTo.isValidFlag==1)
  {
    SetIVIMVehicleCharacteristicsFixValuesListParams(packetHandle, value.notEqualTo, newPath);
    result = CheckLastError("IVIM", gkFuncRefGet, result);
  }
  else
  {
    if( C2xIsTokenAvailable(packetHandle, "IVIM", newPath) )
    {
      C2xRemoveToken(packetHandle, "IVIM", newPath);
    }
  }

  snprintf(newPath, elcount(newPath), "%s.%s", oldPath, "ranges");
  if(value.ranges.isValidFlag==1)
  {
    SetIVIMVehicleCharacteristicsRangesListParams(packetHandle, value.ranges, newPath);
    result = CheckLastError("IVIM", gkFuncRefGet, result);
  }
  else
  {
    if( C2xIsTokenAvailable(packetHandle, "IVIM", newPath) )
    {
      C2xRemoveToken(packetHandle, "IVIM", newPath);
    }
  }

  return result;
}

int GetIVIMTrailerCharacteristicsFixValuesListParams(LONG packetHandle, struct IVIMTrailerCharacteristicsFixValuesList value, char oldPath[])
{
  char newPath[300]; 
  int i;
  int result;

  result = 0;

  value.length = C2xGetTokenInt(packetHandle, "IVIM", oldPath);
  if((result = CheckLastError("IVIM", gkFuncRefGet, result))==0)
  {
    for(i=0; i<value.length; i++)
    {
      snprintf(newPath, elcount(newPath), "%s[%d]", oldPath, i);
      GetIVIMVehicleCharacteristicsFixValuesParams(packetHandle, value.arrayValue[i], newPath);
      result = CheckLastError("IVIM", gkFuncRefGet, result);
    }
  }
  return result;
}

int SetIVIMTrailerCharacteristicsFixValuesListParams(LONG packetHandle, struct IVIMTrailerCharacteristicsFixValuesList value, char oldPath[])
{
  char newPath[300]; 
  int i;
  int result;

  result = 0;

  C2xRemoveToken(packetHandle, "IVIM", oldPath);
  for(i=0; i<value.length; i++)
  {
    snprintf(newPath, elcount(newPath), "%s[%d]", oldPath, i);
    SetIVIMVehicleCharacteristicsFixValuesParams(packetHandle, value.arrayValue[i], newPath);
    result = CheckLastError("IVIM", gkFuncRefGet, result);
  }
  return result;
}

int GetIVIMTrailerCharacteristicsRangesListParams(LONG packetHandle, struct IVIMTrailerCharacteristicsRangesList value, char oldPath[])
{
  char newPath[300]; 
  int i;
  int result;

  result = 0;

  value.length = C2xGetTokenInt(packetHandle, "IVIM", oldPath);
  if((result = CheckLastError("IVIM", gkFuncRefGet, result))==0)
  {
    for(i=0; i<value.length; i++)
    {
      snprintf(newPath, elcount(newPath), "%s[%d]", oldPath, i);
      GetIVIMVehicleCharacteristicsRangesParams(packetHandle, value.arrayValue[i], newPath);
      result = CheckLastError("IVIM", gkFuncRefGet, result);
    }
  }
  return result;
}

int SetIVIMTrailerCharacteristicsRangesListParams(LONG packetHandle, struct IVIMTrailerCharacteristicsRangesList value, char oldPath[])
{
  char newPath[300]; 
  int i;
  int result;

  result = 0;

  C2xRemoveToken(packetHandle, "IVIM", oldPath);
  for(i=0; i<value.length; i++)
  {
    snprintf(newPath, elcount(newPath), "%s[%d]", oldPath, i);
    SetIVIMVehicleCharacteristicsRangesParams(packetHandle, value.arrayValue[i], newPath);
    result = CheckLastError("IVIM", gkFuncRefGet, result);
  }
  return result;
}

int GetIVIMTrailerCharacteristicsParams(LONG packetHandle, struct IVIMTrailerCharacteristics value, char oldPath[])
{
  char newPath[300];
  int result;

  result = 0;

  snprintf(newPath, elcount(newPath), "%s.%s", oldPath, "equalTo");
  value.equalTo.isValidFlag = C2xIsTokenAvailable(packetHandle, "IVIM", newPath);
  if(value.equalTo.isValidFlag==1)
  {
    GetIVIMTrailerCharacteristicsFixValuesListParams(packetHandle, value.equalTo, newPath);
    result = CheckLastError("IVIM", gkFuncRefGet, result);
  }
  snprintf(newPath, elcount(newPath), "%s.%s", oldPath, "notEqualTo");
  value.notEqualTo.isValidFlag = C2xIsTokenAvailable(packetHandle, "IVIM", newPath);
  if(value.notEqualTo.isValidFlag==1)
  {
    GetIVIMTrailerCharacteristicsFixValuesListParams(packetHandle, value.notEqualTo, newPath);
    result = CheckLastError("IVIM", gkFuncRefGet, result);
  }
  snprintf(newPath, elcount(newPath), "%s.%s", oldPath, "ranges");
  value.ranges.isValidFlag = C2xIsTokenAvailable(packetHandle, "IVIM", newPath);
  if(value.ranges.isValidFlag==1)
  {
    GetIVIMTrailerCharacteristicsRangesListParams(packetHandle, value.ranges, newPath);
    result = CheckLastError("IVIM", gkFuncRefGet, result);
  }
  return result;
}

int SetIVIMTrailerCharacteristicsParams(LONG packetHandle, struct IVIMTrailerCharacteristics value, char oldPath[])
{
  char newPath[300];
  int result;

  result = 0;

  snprintf(newPath, elcount(newPath), "%s.%s", oldPath, "equalTo");
  if(value.equalTo.isValidFlag==1)
  {
    SetIVIMTrailerCharacteristicsFixValuesListParams(packetHandle, value.equalTo, newPath);
    result = CheckLastError("IVIM", gkFuncRefGet, result);
  }
  else
  {
    if( C2xIsTokenAvailable(packetHandle, "IVIM", newPath) )
    {
      C2xRemoveToken(packetHandle, "IVIM", newPath);
    }
  }

  snprintf(newPath, elcount(newPath), "%s.%s", oldPath, "notEqualTo");
  if(value.notEqualTo.isValidFlag==1)
  {
    SetIVIMTrailerCharacteristicsFixValuesListParams(packetHandle, value.notEqualTo, newPath);
    result = CheckLastError("IVIM", gkFuncRefGet, result);
  }
  else
  {
    if( C2xIsTokenAvailable(packetHandle, "IVIM", newPath) )
    {
      C2xRemoveToken(packetHandle, "IVIM", newPath);
    }
  }

  snprintf(newPath, elcount(newPath), "%s.%s", oldPath, "ranges");
  if(value.ranges.isValidFlag==1)
  {
    SetIVIMTrailerCharacteristicsRangesListParams(packetHandle, value.ranges, newPath);
    result = CheckLastError("IVIM", gkFuncRefGet, result);
  }
  else
  {
    if( C2xIsTokenAvailable(packetHandle, "IVIM", newPath) )
    {
      C2xRemoveToken(packetHandle, "IVIM", newPath);
    }
  }

  return result;
}

int GetIVIMTrailerCharacteristicsListParams(LONG packetHandle, struct IVIMTrailerCharacteristicsList value, char oldPath[])
{
  char newPath[300]; 
  int i;
  int result;

  result = 0;

  value.length = C2xGetTokenInt(packetHandle, "IVIM", oldPath);
  if((result = CheckLastError("IVIM", gkFuncRefGet, result))==0)
  {
    for(i=0; i<value.length; i++)
    {
      snprintf(newPath, elcount(newPath), "%s[%d]", oldPath, i);
      GetIVIMTrailerCharacteristicsParams(packetHandle, value.arrayValue[i], newPath);
      result = CheckLastError("IVIM", gkFuncRefGet, result);
    }
  }
  return result;
}

int SetIVIMTrailerCharacteristicsListParams(LONG packetHandle, struct IVIMTrailerCharacteristicsList value, char oldPath[])
{
  char newPath[300]; 
  int i;
  int result;

  result = 0;

  C2xRemoveToken(packetHandle, "IVIM", oldPath);
  for(i=0; i<value.length; i++)
  {
    snprintf(newPath, elcount(newPath), "%s[%d]", oldPath, i);
    SetIVIMTrailerCharacteristicsParams(packetHandle, value.arrayValue[i], newPath);
    result = CheckLastError("IVIM", gkFuncRefGet, result);
  }
  return result;
}

int GetIVIMCompleteVehicleCharacteristicsParams(LONG packetHandle, struct IVIMCompleteVehicleCharacteristics value, char oldPath[])
{
  char newPath[300];
  int result;

  result = 0;

  snprintf(newPath, elcount(newPath), "%s.%s", oldPath, "tractor");
  value.tractor.isValidFlag = C2xIsTokenAvailable(packetHandle, "IVIM", newPath);
  if(value.tractor.isValidFlag==1)
  {
    GetIVIMTractorCharacteristicsParams(packetHandle, value.tractor, newPath);
    result = CheckLastError("IVIM", gkFuncRefGet, result);
  }
  snprintf(newPath, elcount(newPath), "%s.%s", oldPath, "trailer");
  value.trailer.isValidFlag = C2xIsTokenAvailable(packetHandle, "IVIM", newPath);
  if(value.trailer.isValidFlag==1)
  {
    GetIVIMTrailerCharacteristicsListParams(packetHandle, value.trailer, newPath);
    result = CheckLastError("IVIM", gkFuncRefGet, result);
  }
  snprintf(newPath, elcount(newPath), "%s.%s", oldPath, "train");
  value.train.isValidFlag = C2xIsTokenAvailable(packetHandle, "IVIM", newPath);
  if(value.train.isValidFlag==1)
  {
    GetIVIMTractorCharacteristicsParams(packetHandle, value.train, newPath);
    result = CheckLastError("IVIM", gkFuncRefGet, result);
  }
  return result;
}

int SetIVIMCompleteVehicleCharacteristicsParams(LONG packetHandle, struct IVIMCompleteVehicleCharacteristics value, char oldPath[])
{
  char newPath[300];
  int result;

  result = 0;

  snprintf(newPath, elcount(newPath), "%s.%s", oldPath, "tractor");
  if(value.tractor.isValidFlag==1)
  {
    SetIVIMTractorCharacteristicsParams(packetHandle, value.tractor, newPath);
    result = CheckLastError("IVIM", gkFuncRefGet, result);
  }
  else
  {
    if( C2xIsTokenAvailable(packetHandle, "IVIM", newPath) )
    {
      C2xRemoveToken(packetHandle, "IVIM", newPath);
    }
  }

  snprintf(newPath, elcount(newPath), "%s.%s", oldPath, "trailer");
  if(value.trailer.isValidFlag==1)
  {
    SetIVIMTrailerCharacteristicsListParams(packetHandle, value.trailer, newPath);
    result = CheckLastError("IVIM", gkFuncRefGet, result);
  }
  else
  {
    if( C2xIsTokenAvailable(packetHandle, "IVIM", newPath) )
    {
      C2xRemoveToken(packetHandle, "IVIM", newPath);
    }
  }

  snprintf(newPath, elcount(newPath), "%s.%s", oldPath, "train");
  if(value.train.isValidFlag==1)
  {
    SetIVIMTractorCharacteristicsParams(packetHandle, value.train, newPath);
    result = CheckLastError("IVIM", gkFuncRefGet, result);
  }
  else
  {
    if( C2xIsTokenAvailable(packetHandle, "IVIM", newPath) )
    {
      C2xRemoveToken(packetHandle, "IVIM", newPath);
    }
  }

  return result;
}

int GetIVIMVehicleCharacteristicsListParams(LONG packetHandle, struct IVIMVehicleCharacteristicsList value, char oldPath[])
{
  char newPath[300]; 
  int i;
  int result;

  result = 0;

  value.length = C2xGetTokenInt(packetHandle, "IVIM", oldPath);
  if((result = CheckLastError("IVIM", gkFuncRefGet, result))==0)
  {
    for(i=0; i<value.length; i++)
    {
      snprintf(newPath, elcount(newPath), "%s[%d]", oldPath, i);
      GetIVIMCompleteVehicleCharacteristicsParams(packetHandle, value.arrayValue[i], newPath);
      result = CheckLastError("IVIM", gkFuncRefGet, result);
    }
  }
  return result;
}

int SetIVIMVehicleCharacteristicsListParams(LONG packetHandle, struct IVIMVehicleCharacteristicsList value, char oldPath[])
{
  char newPath[300]; 
  int i;
  int result;

  result = 0;

  C2xRemoveToken(packetHandle, "IVIM", oldPath);
  for(i=0; i<value.length; i++)
  {
    snprintf(newPath, elcount(newPath), "%s[%d]", oldPath, i);
    SetIVIMCompleteVehicleCharacteristicsParams(packetHandle, value.arrayValue[i], newPath);
    result = CheckLastError("IVIM", gkFuncRefGet, result);
  }
  return result;
}

int GetIVIMInternationalSign_applicablePeriod_yearParams(LONG packetHandle, struct IVIMInternationalSign_applicablePeriod_year value, char oldPath[])
{
  char newPath[300];
  int result;

  result = 0;

  snprintf(newPath, elcount(newPath), "%s.%s", oldPath, "yearRangeStartYear");
  value.yearRangeStartYear = C2xGetTokenInt(packetHandle, "IVIM", newPath);
  result = CheckLastError("IVIM", gkFuncRefGet, result);

  snprintf(newPath, elcount(newPath), "%s.%s", oldPath, "yearRangeEndYear");
  value.yearRangeEndYear = C2xGetTokenInt(packetHandle, "IVIM", newPath);
  result = CheckLastError("IVIM", gkFuncRefGet, result);

  return result;
}

int SetIVIMInternationalSign_applicablePeriod_yearParams(LONG packetHandle, struct IVIMInternationalSign_applicablePeriod_year value, char oldPath[])
{
  char newPath[300];
  int result;

  result = 0;

  snprintf(newPath, elcount(newPath), "%s.%s", oldPath, "yearRangeStartYear");
  if (value.yearRangeStartYear < 2000)
  {
    C2xSetTokenInt(packetHandle, "IVIM", newPath, 2000);
  }
  else if (value.yearRangeStartYear > 2127)
  {
    C2xSetTokenInt(packetHandle, "IVIM", newPath, 2127);
  }
  else
  {
    C2xSetTokenInt(packetHandle, "IVIM", newPath, value.yearRangeStartYear);
  }
  result = CheckLastError("IVIM", gkFuncRefGet, result);

  snprintf(newPath, elcount(newPath), "%s.%s", oldPath, "yearRangeEndYear");
  if (value.yearRangeEndYear < 2000)
  {
    C2xSetTokenInt(packetHandle, "IVIM", newPath, 2000);
  }
  else if (value.yearRangeEndYear > 2127)
  {
    C2xSetTokenInt(packetHandle, "IVIM", newPath, 2127);
  }
  else
  {
    C2xSetTokenInt(packetHandle, "IVIM", newPath, value.yearRangeEndYear);
  }
  result = CheckLastError("IVIM", gkFuncRefGet, result);

  return result;
}

int GetIVIMMonthDayParams(LONG packetHandle, struct IVIMMonthDay value, char oldPath[])
{
  char newPath[300];
  int result;

  result = 0;

  snprintf(newPath, elcount(newPath), "%s.%s", oldPath, "month");
  value.month = C2xGetTokenInt(packetHandle, "IVIM", newPath);
  result = CheckLastError("IVIM", gkFuncRefGet, result);

  snprintf(newPath, elcount(newPath), "%s.%s", oldPath, "day");
  value.day = C2xGetTokenInt(packetHandle, "IVIM", newPath);
  result = CheckLastError("IVIM", gkFuncRefGet, result);

  return result;
}

int SetIVIMMonthDayParams(LONG packetHandle, struct IVIMMonthDay value, char oldPath[])
{
  char newPath[300];
  int result;

  result = 0;

  snprintf(newPath, elcount(newPath), "%s.%s", oldPath, "month");
  if (value.month < 1)
  {
    C2xSetTokenInt(packetHandle, "IVIM", newPath, 1);
  }
  else if (value.month > 12)
  {
    C2xSetTokenInt(packetHandle, "IVIM", newPath, 12);
  }
  else
  {
    C2xSetTokenInt(packetHandle, "IVIM", newPath, value.month);
  }
  result = CheckLastError("IVIM", gkFuncRefGet, result);

  snprintf(newPath, elcount(newPath), "%s.%s", oldPath, "day");
  if (value.day < 1)
  {
    C2xSetTokenInt(packetHandle, "IVIM", newPath, 1);
  }
  else if (value.day > 31)
  {
    C2xSetTokenInt(packetHandle, "IVIM", newPath, 31);
  }
  else
  {
    C2xSetTokenInt(packetHandle, "IVIM", newPath, value.day);
  }
  result = CheckLastError("IVIM", gkFuncRefGet, result);

  return result;
}

int GetIVIMInternationalSign_applicablePeriod_month_dayParams(LONG packetHandle, struct IVIMInternationalSign_applicablePeriod_month_day value, char oldPath[])
{
  char newPath[300];
  int result;

  result = 0;

  snprintf(newPath, elcount(newPath), "%s.%s", oldPath, "dateRangeStartMonthDay");
  GetIVIMMonthDayParams(packetHandle, value.dateRangeStartMonthDay, newPath);
  result = CheckLastError("IVIM", gkFuncRefGet, result);

  snprintf(newPath, elcount(newPath), "%s.%s", oldPath, "dateRangeEndMonthDay");
  GetIVIMMonthDayParams(packetHandle, value.dateRangeEndMonthDay, newPath);
  result = CheckLastError("IVIM", gkFuncRefGet, result);

  return result;
}

int SetIVIMInternationalSign_applicablePeriod_month_dayParams(LONG packetHandle, struct IVIMInternationalSign_applicablePeriod_month_day value, char oldPath[])
{
  char newPath[300];
  int result;

  result = 0;

  snprintf(newPath, elcount(newPath), "%s.%s", oldPath, "dateRangeStartMonthDay");
  SetIVIMMonthDayParams(packetHandle, value.dateRangeStartMonthDay, newPath);
  result = CheckLastError("IVIM", gkFuncRefGet, result);

  snprintf(newPath, elcount(newPath), "%s.%s", oldPath, "dateRangeEndMonthDay");
  SetIVIMMonthDayParams(packetHandle, value.dateRangeEndMonthDay, newPath);
  result = CheckLastError("IVIM", gkFuncRefGet, result);

  return result;
}

int GetIVIMHoursMinutesParams(LONG packetHandle, struct IVIMHoursMinutes value, char oldPath[])
{
  char newPath[300];
  int result;

  result = 0;

  snprintf(newPath, elcount(newPath), "%s.%s", oldPath, "hours");
  value.hours = C2xGetTokenInt(packetHandle, "IVIM", newPath);
  result = CheckLastError("IVIM", gkFuncRefGet, result);

  snprintf(newPath, elcount(newPath), "%s.%s", oldPath, "mins");
  value.mins = C2xGetTokenInt(packetHandle, "IVIM", newPath);
  result = CheckLastError("IVIM", gkFuncRefGet, result);

  return result;
}

int SetIVIMHoursMinutesParams(LONG packetHandle, struct IVIMHoursMinutes value, char oldPath[])
{
  char newPath[300];
  int result;

  result = 0;

  snprintf(newPath, elcount(newPath), "%s.%s", oldPath, "hours");
  C2xSetTokenInt(packetHandle, "IVIM", newPath, value.hours);
  result = CheckLastError("IVIM", gkFuncRefGet, result);

  snprintf(newPath, elcount(newPath), "%s.%s", oldPath, "mins");
  C2xSetTokenInt(packetHandle, "IVIM", newPath, value.mins);
  result = CheckLastError("IVIM", gkFuncRefGet, result);

  return result;
}

int GetIVIMInternationalSign_applicablePeriod_hourMinutesParams(LONG packetHandle, struct IVIMInternationalSign_applicablePeriod_hourMinutes value, char oldPath[])
{
  char newPath[300];
  int result;

  result = 0;

  snprintf(newPath, elcount(newPath), "%s.%s", oldPath, "timeRangeStartTime");
  GetIVIMHoursMinutesParams(packetHandle, value.timeRangeStartTime, newPath);
  result = CheckLastError("IVIM", gkFuncRefGet, result);

  snprintf(newPath, elcount(newPath), "%s.%s", oldPath, "timeRangeEndTime");
  GetIVIMHoursMinutesParams(packetHandle, value.timeRangeEndTime, newPath);
  result = CheckLastError("IVIM", gkFuncRefGet, result);

  return result;
}

int SetIVIMInternationalSign_applicablePeriod_hourMinutesParams(LONG packetHandle, struct IVIMInternationalSign_applicablePeriod_hourMinutes value, char oldPath[])
{
  char newPath[300];
  int result;

  result = 0;

  snprintf(newPath, elcount(newPath), "%s.%s", oldPath, "timeRangeStartTime");
  SetIVIMHoursMinutesParams(packetHandle, value.timeRangeStartTime, newPath);
  result = CheckLastError("IVIM", gkFuncRefGet, result);

  snprintf(newPath, elcount(newPath), "%s.%s", oldPath, "timeRangeEndTime");
  SetIVIMHoursMinutesParams(packetHandle, value.timeRangeEndTime, newPath);
  result = CheckLastError("IVIM", gkFuncRefGet, result);

  return result;
}

int GetIVIMInternationalSign_applicablePeriodParams(LONG packetHandle, struct IVIMInternationalSign_applicablePeriod value, char oldPath[])
{
  char newPath[300]; 
  int j; 
  int k;
  int result;

  result = 0;

  snprintf(newPath, elcount(newPath), "%s.%s", oldPath, "year");
  value.year.isValidFlag = C2xIsTokenAvailable(packetHandle, "IVIM", newPath);
  if(value.year.isValidFlag==1)
  {
    GetIVIMInternationalSign_applicablePeriod_yearParams(packetHandle, value.year, newPath);
    result = CheckLastError("IVIM", gkFuncRefGet, result);
  }
  snprintf(newPath, elcount(newPath), "%s.%s", oldPath, "month_day");
  value.month_day.isValidFlag = C2xIsTokenAvailable(packetHandle, "IVIM", newPath);
  if(value.month_day.isValidFlag==1)
  {
    GetIVIMInternationalSign_applicablePeriod_month_dayParams(packetHandle, value.month_day, newPath);
    result = CheckLastError("IVIM", gkFuncRefGet, result);
  }
  snprintf(newPath, elcount(newPath), "%s.%s", oldPath, "repeatingPeriodDayTypes");
  value.repeatingPeriodDayTypes.isValidFlag = C2xIsTokenAvailable(packetHandle, "IVIM", newPath);
  if(value.repeatingPeriodDayTypes.isValidFlag==1)
  {
    value.repeatingPeriodDayTypes.isValidFlag = 1;
    value.repeatingPeriodDayTypes.stringLength = C2xGetTokenLengthBit(packetHandle, "IVIM", newPath);
    if ((result = CheckLastError("IVIM", gkFuncRefGet, result))==0)
    {
      if(value.repeatingPeriodDayTypes.stringLength > 0)
      {
        for(j=0; j<value.repeatingPeriodDayTypes.stringLength; j++)
        {
          if(C2xGetTokenBitOfBitString(packetHandle, "IVIM", newPath, j) == 0)
          {
            value.repeatingPeriodDayTypes.string[j] = '0';
          }
          else if(C2xGetTokenBitOfBitString(packetHandle, "IVIM", newPath, j) == 1)
          {
            value.repeatingPeriodDayTypes.string[j] = '1';
          }

          if(value.repeatingPeriodDayTypes.stringLength == 1)
          {
            value.repeatingPeriodDayTypes.string[1] = '0';
          }
          result = CheckLastError("IVIM", gkFuncRefGet, result);
        }
      }
      else
      {
        for(k = value.repeatingPeriodDayTypes.stringLength+1; k > -1; k--)
        {
          if(value.repeatingPeriodDayTypes.string[k] == '1')
          {
            value.repeatingPeriodDayTypes.string[k] = '0';
          }
        }
      }
    }

  }
  snprintf(newPath, elcount(newPath), "%s.%s", oldPath, "hourMinutes");
  value.hourMinutes.isValidFlag = C2xIsTokenAvailable(packetHandle, "IVIM", newPath);
  if(value.hourMinutes.isValidFlag==1)
  {
    GetIVIMInternationalSign_applicablePeriod_hourMinutesParams(packetHandle, value.hourMinutes, newPath);
    result = CheckLastError("IVIM", gkFuncRefGet, result);
  }
  snprintf(newPath, elcount(newPath), "%s.%s", oldPath, "dateRangeOfWeek");
  value.dateRangeOfWeek.isValidFlag = C2xIsTokenAvailable(packetHandle, "IVIM", newPath);
  if(value.dateRangeOfWeek.isValidFlag==1)
  {
    value.dateRangeOfWeek.isValidFlag = 1;
    value.dateRangeOfWeek.stringLength = C2xGetTokenLengthBit(packetHandle, "IVIM", newPath);
    if ((result = CheckLastError("IVIM", gkFuncRefGet, result))==0)
    {
      if(value.dateRangeOfWeek.stringLength > 0)
      {
        for(j=0; j<value.dateRangeOfWeek.stringLength; j++)
        {
          if(C2xGetTokenBitOfBitString(packetHandle, "IVIM", newPath, j) == 0)
          {
            value.dateRangeOfWeek.string[j] = '0';
          }
          else if(C2xGetTokenBitOfBitString(packetHandle, "IVIM", newPath, j) == 1)
          {
            value.dateRangeOfWeek.string[j] = '1';
          }

          if(value.dateRangeOfWeek.stringLength == 1)
          {
            value.dateRangeOfWeek.string[1] = '0';
          }
          result = CheckLastError("IVIM", gkFuncRefGet, result);
        }
      }
      else
      {
        for(k = value.dateRangeOfWeek.stringLength+1; k > -1; k--)
        {
          if(value.dateRangeOfWeek.string[k] == '1')
          {
            value.dateRangeOfWeek.string[k] = '0';
          }
        }
      }
    }

  }
  snprintf(newPath, elcount(newPath), "%s.%s", oldPath, "durationHourMinute");
  value.durationHourMinute.isValidFlag = C2xIsTokenAvailable(packetHandle, "IVIM", newPath);
  if(value.durationHourMinute.isValidFlag==1)
  {
    GetIVIMHoursMinutesParams(packetHandle, value.durationHourMinute, newPath);
    result = CheckLastError("IVIM", gkFuncRefGet, result);
  }
  return result;
}

int SetIVIMInternationalSign_applicablePeriodParams(LONG packetHandle, struct IVIMInternationalSign_applicablePeriod value, char oldPath[])
{
  char newPath[300]; 
  int j;
  int result;

  result = 0;

  snprintf(newPath, elcount(newPath), "%s.%s", oldPath, "year");
  if(value.year.isValidFlag==1)
  {
    SetIVIMInternationalSign_applicablePeriod_yearParams(packetHandle, value.year, newPath);
    result = CheckLastError("IVIM", gkFuncRefGet, result);
  }
  else
  {
    if( C2xIsTokenAvailable(packetHandle, "IVIM", newPath) )
    {
      C2xRemoveToken(packetHandle, "IVIM", newPath);
    }
  }

  snprintf(newPath, elcount(newPath), "%s.%s", oldPath, "month_day");
  if(value.month_day.isValidFlag==1)
  {
    SetIVIMInternationalSign_applicablePeriod_month_dayParams(packetHandle, value.month_day, newPath);
    result = CheckLastError("IVIM", gkFuncRefGet, result);
  }
  else
  {
    if( C2xIsTokenAvailable(packetHandle, "IVIM", newPath) )
    {
      C2xRemoveToken(packetHandle, "IVIM", newPath);
    }
  }

  snprintf(newPath, elcount(newPath), "%s.%s", oldPath, "repeatingPeriodDayTypes");
  if(value.repeatingPeriodDayTypes.isValidFlag==1)
  {
      for(j=0; j<value.repeatingPeriodDayTypes.stringLength; j++)
      {
        if(value.repeatingPeriodDayTypes.string[j] == '0')
        {
          C2xSetTokenBitOfBitString(packetHandle, "IVIM", newPath, j, 0);
        }
        else
        {
          C2xSetTokenBitOfBitString(packetHandle, "IVIM", newPath, j, 1);
        }
        result = CheckLastError("IVIM", gkFuncRefGet, result);
      }
  }
  else
  {
    if( C2xIsTokenAvailable(packetHandle, "IVIM", newPath) )
    {
      C2xRemoveToken(packetHandle, "IVIM", newPath);
    }
  }

  snprintf(newPath, elcount(newPath), "%s.%s", oldPath, "hourMinutes");
  if(value.hourMinutes.isValidFlag==1)
  {
    SetIVIMInternationalSign_applicablePeriod_hourMinutesParams(packetHandle, value.hourMinutes, newPath);
    result = CheckLastError("IVIM", gkFuncRefGet, result);
  }
  else
  {
    if( C2xIsTokenAvailable(packetHandle, "IVIM", newPath) )
    {
      C2xRemoveToken(packetHandle, "IVIM", newPath);
    }
  }

  snprintf(newPath, elcount(newPath), "%s.%s", oldPath, "dateRangeOfWeek");
  if(value.dateRangeOfWeek.isValidFlag==1)
  {
      for(j=0; j<value.dateRangeOfWeek.stringLength; j++)
      {
        if(value.dateRangeOfWeek.string[j] == '0')
        {
          C2xSetTokenBitOfBitString(packetHandle, "IVIM", newPath, j, 0);
        }
        else
        {
          C2xSetTokenBitOfBitString(packetHandle, "IVIM", newPath, j, 1);
        }
        result = CheckLastError("IVIM", gkFuncRefGet, result);
      }
  }
  else
  {
    if( C2xIsTokenAvailable(packetHandle, "IVIM", newPath) )
    {
      C2xRemoveToken(packetHandle, "IVIM", newPath);
    }
  }

  snprintf(newPath, elcount(newPath), "%s.%s", oldPath, "durationHourMinute");
  if(value.durationHourMinute.isValidFlag==1)
  {
    SetIVIMHoursMinutesParams(packetHandle, value.durationHourMinute, newPath);
    result = CheckLastError("IVIM", gkFuncRefGet, result);
  }
  else
  {
    if( C2xIsTokenAvailable(packetHandle, "IVIM", newPath) )
    {
      C2xRemoveToken(packetHandle, "IVIM", newPath);
    }
  }

  return result;
}

int GetIVIMValidityPeriodsParams(LONG packetHandle, struct IVIMValidityPeriods value, char oldPath[])
{
  char newPath[300]; 
  int i;
  int result;

  result = 0;

  value.length = C2xGetTokenInt(packetHandle, "IVIM", oldPath);
  if((result = CheckLastError("IVIM", gkFuncRefGet, result))==0)
  {
    for(i=0; i<value.length; i++)
    {
      snprintf(newPath, elcount(newPath), "%s[%d]", oldPath, i);
      GetIVIMInternationalSign_applicablePeriodParams(packetHandle, value.arrayValue[i], newPath);
      result = CheckLastError("IVIM", gkFuncRefGet, result);
    }
  }
  return result;
}

int SetIVIMValidityPeriodsParams(LONG packetHandle, struct IVIMValidityPeriods value, char oldPath[])
{
  char newPath[300]; 
  int i;
  int result;

  result = 0;

  C2xRemoveToken(packetHandle, "IVIM", oldPath);
  for(i=0; i<value.length; i++)
  {
    snprintf(newPath, elcount(newPath), "%s[%d]", oldPath, i);
    SetIVIMInternationalSign_applicablePeriodParams(packetHandle, value.arrayValue[i], newPath);
    result = CheckLastError("IVIM", gkFuncRefGet, result);
  }
  return result;
}

int GetIVIMVcCodeParams(LONG packetHandle, struct IVIMVcCode value, char oldPath[])
{
  char newPath[300];
  int result;

  result = 0;

  snprintf(newPath, elcount(newPath), "%s.%s", oldPath, "roadSignClass");
  value.roadSignClass = C2xGetTokenInt(packetHandle, "IVIM", newPath);
  result = CheckLastError("IVIM", gkFuncRefGet, result);

  snprintf(newPath, elcount(newPath), "%s.%s", oldPath, "roadSignCode");
  value.roadSignCode = C2xGetTokenInt(packetHandle, "IVIM", newPath);
  result = CheckLastError("IVIM", gkFuncRefGet, result);

  snprintf(newPath, elcount(newPath), "%s.%s", oldPath, "vcOption");
  value.vcOption = C2xGetTokenInt(packetHandle, "IVIM", newPath);
  result = CheckLastError("IVIM", gkFuncRefGet, result);

  snprintf(newPath, elcount(newPath), "%s.%s", oldPath, "validity");
  value.validity.isValidFlag = C2xIsTokenAvailable(packetHandle, "IVIM", newPath);
  if(value.validity.isValidFlag==1)
  {
    GetIVIMValidityPeriodsParams(packetHandle, value.validity, newPath);
    result = CheckLastError("IVIM", gkFuncRefGet, result);
  }
  snprintf(newPath, elcount(newPath), "%s.%s", oldPath, "value");
  value.value.isValidFlag = C2xIsTokenAvailable(packetHandle, "IVIM", newPath);
  if(value.value.isValidFlag==1)
  {
    value.value.value = C2xGetTokenInt(packetHandle, "IVIM", newPath);
    result = CheckLastError("IVIM", gkFuncRefGet, result);
  }
  snprintf(newPath, elcount(newPath), "%s.%s", oldPath, "unit");
  value.unit.isValidFlag = C2xIsTokenAvailable(packetHandle, "IVIM", newPath);
  if(value.unit.isValidFlag==1)
  {
    value.unit.value = C2xGetTokenInt(packetHandle, "IVIM", newPath);
    result = CheckLastError("IVIM", gkFuncRefGet, result);
  }
  return result;
}

int SetIVIMVcCodeParams(LONG packetHandle, struct IVIMVcCode value, char oldPath[])
{
  char newPath[300];
  int result;

  result = 0;

  snprintf(newPath, elcount(newPath), "%s.%s", oldPath, "roadSignClass");
  C2xSetTokenInt(packetHandle, "IVIM", newPath, value.roadSignClass);
  result = CheckLastError("IVIM", gkFuncRefGet, result);

  snprintf(newPath, elcount(newPath), "%s.%s", oldPath, "roadSignCode");
  if (value.roadSignCode < 1)
  {
    C2xSetTokenInt(packetHandle, "IVIM", newPath, 1);
  }
  else if (value.roadSignCode > 64)
  {
    C2xSetTokenInt(packetHandle, "IVIM", newPath, 64);
  }
  else
  {
    C2xSetTokenInt(packetHandle, "IVIM", newPath, value.roadSignCode);
  }
  result = CheckLastError("IVIM", gkFuncRefGet, result);

  snprintf(newPath, elcount(newPath), "%s.%s", oldPath, "vcOption");
  C2xSetTokenInt(packetHandle, "IVIM", newPath, value.vcOption);
  result = CheckLastError("IVIM", gkFuncRefGet, result);

  snprintf(newPath, elcount(newPath), "%s.%s", oldPath, "validity");
  if(value.validity.isValidFlag==1)
  {
    SetIVIMValidityPeriodsParams(packetHandle, value.validity, newPath);
    result = CheckLastError("IVIM", gkFuncRefGet, result);
  }
  else
  {
    if( C2xIsTokenAvailable(packetHandle, "IVIM", newPath) )
    {
      C2xRemoveToken(packetHandle, "IVIM", newPath);
    }
  }

  snprintf(newPath, elcount(newPath), "%s.%s", oldPath, "value");
  if(value.value.isValidFlag==1)
  {
    C2xSetTokenInt(packetHandle, "IVIM", newPath, value.value.value);
    result = CheckLastError("IVIM", gkFuncRefGet, result);
  }
  else
  {
    if( C2xIsTokenAvailable(packetHandle, "IVIM", newPath) )
    {
      C2xRemoveToken(packetHandle, "IVIM", newPath);
    }
  }

  snprintf(newPath, elcount(newPath), "%s.%s", oldPath, "unit");
  if(value.unit.isValidFlag==1)
  {
    C2xSetTokenInt(packetHandle, "IVIM", newPath, value.unit.value);
    result = CheckLastError("IVIM", gkFuncRefGet, result);
  }
  else
  {
    if( C2xIsTokenAvailable(packetHandle, "IVIM", newPath) )
    {
      C2xRemoveToken(packetHandle, "IVIM", newPath);
    }
  }

  return result;
}

int GetIVIMISO14823Code_pictogramCode_serviceCategoryCodeParams(LONG packetHandle, struct IVIMISO14823Code_pictogramCode_serviceCategoryCode value, char oldPath[])
{
  char newPath[300];
  int result;

  result = 0;

  value.choice = C2xGetTokenInt(packetHandle, "IVIM", oldPath);

  switch(value.choice)
  {
    case 0:
    {
      snprintf(newPath, elcount(newPath), "%s.%s", oldPath, "trafficSignPictogram");
      value.trafficSignPictogram = C2xGetTokenInt(packetHandle, "IVIM", newPath);
      result = CheckLastError("IVIM", gkFuncRefGet, result);
    }
    break;
    case 1:
    {
      snprintf(newPath, elcount(newPath), "%s.%s", oldPath, "publicFacilitiesPictogram");
      value.publicFacilitiesPictogram = C2xGetTokenInt(packetHandle, "IVIM", newPath);
      result = CheckLastError("IVIM", gkFuncRefGet, result);
    }
    break;
    case 2:
    {
      snprintf(newPath, elcount(newPath), "%s.%s", oldPath, "ambientOrRoadConditionPictogram");
      value.ambientOrRoadConditionPictogram = C2xGetTokenInt(packetHandle, "IVIM", newPath);
      result = CheckLastError("IVIM", gkFuncRefGet, result);
    }
    break;
  }
  return result;
}

int SetIVIMISO14823Code_pictogramCode_serviceCategoryCodeParams(LONG packetHandle, struct IVIMISO14823Code_pictogramCode_serviceCategoryCode value, char oldPath[])
{
  char newPath[300];
  int result;

  result = 0;

  switch(value.choice)
  {
    case 0:
    {
      snprintf(newPath, elcount(newPath), "%s.%s", oldPath, "trafficSignPictogram");
      C2xSetTokenInt(packetHandle, "IVIM", newPath, value.trafficSignPictogram);
      result = CheckLastError("IVIM", gkFuncRefGet, result);
    }
    break;
    case 1:
    {
      snprintf(newPath, elcount(newPath), "%s.%s", oldPath, "publicFacilitiesPictogram");
      C2xSetTokenInt(packetHandle, "IVIM", newPath, value.publicFacilitiesPictogram);
      result = CheckLastError("IVIM", gkFuncRefGet, result);
    }
    break;
    case 2:
    {
      snprintf(newPath, elcount(newPath), "%s.%s", oldPath, "ambientOrRoadConditionPictogram");
      C2xSetTokenInt(packetHandle, "IVIM", newPath, value.ambientOrRoadConditionPictogram);
      result = CheckLastError("IVIM", gkFuncRefGet, result);
    }
    break;
  }
  return result;
}

int GetIVIMISO14823Code_pictogramCode_pictogramCategoryCodeParams(LONG packetHandle, struct IVIMISO14823Code_pictogramCode_pictogramCategoryCode value, char oldPath[])
{
  char newPath[300];
  int result;

  result = 0;

  snprintf(newPath, elcount(newPath), "%s.%s", oldPath, "nature");
  value.nature = C2xGetTokenInt(packetHandle, "IVIM", newPath);
  result = CheckLastError("IVIM", gkFuncRefGet, result);

  snprintf(newPath, elcount(newPath), "%s.%s", oldPath, "serialNumber");
  value.serialNumber = C2xGetTokenInt(packetHandle, "IVIM", newPath);
  result = CheckLastError("IVIM", gkFuncRefGet, result);

  return result;
}

int SetIVIMISO14823Code_pictogramCode_pictogramCategoryCodeParams(LONG packetHandle, struct IVIMISO14823Code_pictogramCode_pictogramCategoryCode value, char oldPath[])
{
  char newPath[300];
  int result;

  result = 0;

  snprintf(newPath, elcount(newPath), "%s.%s", oldPath, "nature");
  if (value.nature < 1)
  {
    C2xSetTokenInt(packetHandle, "IVIM", newPath, 1);
  }
  else if (value.nature > 9)
  {
    C2xSetTokenInt(packetHandle, "IVIM", newPath, 9);
  }
  else
  {
    C2xSetTokenInt(packetHandle, "IVIM", newPath, value.nature);
  }
  result = CheckLastError("IVIM", gkFuncRefGet, result);

  snprintf(newPath, elcount(newPath), "%s.%s", oldPath, "serialNumber");
  C2xSetTokenInt(packetHandle, "IVIM", newPath, value.serialNumber);
  result = CheckLastError("IVIM", gkFuncRefGet, result);

  return result;
}

int GetIVIMISO14823Code_pictogramCodeParams(LONG packetHandle, struct IVIMISO14823Code_pictogramCode value, char oldPath[])
{
  char newPath[300];
  char buffer[300];
  int result;

  result = 0;

  snprintf(newPath, elcount(newPath), "%s.%s", oldPath, "countryCode");
  value.countryCode.isValidFlag = C2xIsTokenAvailable(packetHandle, "IVIM", newPath);
  if(value.countryCode.isValidFlag==1)
  {
    value.countryCode.isValidFlag = 1;
    value.countryCode.stringLength = C2xGetTokenData(packetHandle, "IVIM", newPath, elcount(value.countryCode.string), value.countryCode.string);
  }
  snprintf(newPath, elcount(newPath), "%s.%s", oldPath, "serviceCategoryCode");
  GetIVIMISO14823Code_pictogramCode_serviceCategoryCodeParams(packetHandle, value.serviceCategoryCode, newPath);
  result = CheckLastError("IVIM", gkFuncRefGet, result);

  snprintf(newPath, elcount(newPath), "%s.%s", oldPath, "pictogramCategoryCode");
  GetIVIMISO14823Code_pictogramCode_pictogramCategoryCodeParams(packetHandle, value.pictogramCategoryCode, newPath);
  result = CheckLastError("IVIM", gkFuncRefGet, result);

  return result;
}

int SetIVIMISO14823Code_pictogramCodeParams(LONG packetHandle, struct IVIMISO14823Code_pictogramCode value, char oldPath[])
{
  char newPath[300];
  char buffer[300];
  int result;

  result = 0;

  snprintf(newPath, elcount(newPath), "%s.%s", oldPath, "countryCode");
  if(value.countryCode.isValidFlag==1)
  {
    C2xSetTokenData(packetHandle, "IVIM", newPath, value.countryCode.stringLength, value.countryCode.string);
  }
  else
  {
    if( C2xIsTokenAvailable(packetHandle, "IVIM", newPath) )
    {
      C2xRemoveToken(packetHandle, "IVIM", newPath);
    }
  }

  snprintf(newPath, elcount(newPath), "%s.%s", oldPath, "serviceCategoryCode");
  SetIVIMISO14823Code_pictogramCode_serviceCategoryCodeParams(packetHandle, value.serviceCategoryCode, newPath);
  result = CheckLastError("IVIM", gkFuncRefGet, result);

  snprintf(newPath, elcount(newPath), "%s.%s", oldPath, "pictogramCategoryCode");
  SetIVIMISO14823Code_pictogramCode_pictogramCategoryCodeParams(packetHandle, value.pictogramCategoryCode, newPath);
  result = CheckLastError("IVIM", gkFuncRefGet, result);

  return result;
}

int GetIVIMDistanceParams(LONG packetHandle, struct IVIMDistance value, char oldPath[])
{
  char newPath[300];
  int result;

  result = 0;

  snprintf(newPath, elcount(newPath), "%s.%s", oldPath, "value");
  value.value = C2xGetTokenInt(packetHandle, "IVIM", newPath);
  result = CheckLastError("IVIM", gkFuncRefGet, result);

  snprintf(newPath, elcount(newPath), "%s.%s", oldPath, "unit");
  value.unit = C2xGetTokenInt(packetHandle, "IVIM", newPath);
  result = CheckLastError("IVIM", gkFuncRefGet, result);

  return result;
}

int SetIVIMDistanceParams(LONG packetHandle, struct IVIMDistance value, char oldPath[])
{
  char newPath[300];
  int result;

  result = 0;

  snprintf(newPath, elcount(newPath), "%s.%s", oldPath, "value");
  if (value.value < 1)
  {
    C2xSetTokenInt(packetHandle, "IVIM", newPath, 1);
  }
  else if (value.value > 16384)
  {
    C2xSetTokenInt(packetHandle, "IVIM", newPath, 16384);
  }
  else
  {
    C2xSetTokenInt(packetHandle, "IVIM", newPath, value.value);
  }
  result = CheckLastError("IVIM", gkFuncRefGet, result);

  snprintf(newPath, elcount(newPath), "%s.%s", oldPath, "unit");
  if (value.unit < 2)
  {
    C2xSetTokenInt(packetHandle, "IVIM", newPath, 2);
  }
  else if (value.unit > 8)
  {
    C2xSetTokenInt(packetHandle, "IVIM", newPath, 8);
  }
  else
  {
    C2xSetTokenInt(packetHandle, "IVIM", newPath, value.unit);
  }
  result = CheckLastError("IVIM", gkFuncRefGet, result);

  return result;
}

int GetIVIMWeightParams(LONG packetHandle, struct IVIMWeight value, char oldPath[])
{
  char newPath[300];
  int result;

  result = 0;

  snprintf(newPath, elcount(newPath), "%s.%s", oldPath, "value");
  value.value = C2xGetTokenInt(packetHandle, "IVIM", newPath);
  result = CheckLastError("IVIM", gkFuncRefGet, result);

  snprintf(newPath, elcount(newPath), "%s.%s", oldPath, "unit");
  value.unit = C2xGetTokenInt(packetHandle, "IVIM", newPath);
  result = CheckLastError("IVIM", gkFuncRefGet, result);

  return result;
}

int SetIVIMWeightParams(LONG packetHandle, struct IVIMWeight value, char oldPath[])
{
  char newPath[300];
  int result;

  result = 0;

  snprintf(newPath, elcount(newPath), "%s.%s", oldPath, "value");
  if (value.value < 1)
  {
    C2xSetTokenInt(packetHandle, "IVIM", newPath, 1);
  }
  else if (value.value > 16384)
  {
    C2xSetTokenInt(packetHandle, "IVIM", newPath, 16384);
  }
  else
  {
    C2xSetTokenInt(packetHandle, "IVIM", newPath, value.value);
  }
  result = CheckLastError("IVIM", gkFuncRefGet, result);

  snprintf(newPath, elcount(newPath), "%s.%s", oldPath, "unit");
  if (value.unit < 10)
  {
    C2xSetTokenInt(packetHandle, "IVIM", newPath, 10);
  }
  else if (value.unit > 12)
  {
    C2xSetTokenInt(packetHandle, "IVIM", newPath, 12);
  }
  else
  {
    C2xSetTokenInt(packetHandle, "IVIM", newPath, value.unit);
  }
  result = CheckLastError("IVIM", gkFuncRefGet, result);

  return result;
}

int GetIVIMInternationalSign_applicableVehicleDimensionsParams(LONG packetHandle, struct IVIMInternationalSign_applicableVehicleDimensions value, char oldPath[])
{
  char newPath[300];
  int result;

  result = 0;

  snprintf(newPath, elcount(newPath), "%s.%s", oldPath, "vehicleHeight");
  value.vehicleHeight.isValidFlag = C2xIsTokenAvailable(packetHandle, "IVIM", newPath);
  if(value.vehicleHeight.isValidFlag==1)
  {
    GetIVIMDistanceParams(packetHandle, value.vehicleHeight, newPath);
    result = CheckLastError("IVIM", gkFuncRefGet, result);
  }
  snprintf(newPath, elcount(newPath), "%s.%s", oldPath, "vehicleWidth");
  value.vehicleWidth.isValidFlag = C2xIsTokenAvailable(packetHandle, "IVIM", newPath);
  if(value.vehicleWidth.isValidFlag==1)
  {
    GetIVIMDistanceParams(packetHandle, value.vehicleWidth, newPath);
    result = CheckLastError("IVIM", gkFuncRefGet, result);
  }
  snprintf(newPath, elcount(newPath), "%s.%s", oldPath, "vehicleLength");
  value.vehicleLength.isValidFlag = C2xIsTokenAvailable(packetHandle, "IVIM", newPath);
  if(value.vehicleLength.isValidFlag==1)
  {
    GetIVIMDistanceParams(packetHandle, value.vehicleLength, newPath);
    result = CheckLastError("IVIM", gkFuncRefGet, result);
  }
  snprintf(newPath, elcount(newPath), "%s.%s", oldPath, "vehicleWeight");
  value.vehicleWeight.isValidFlag = C2xIsTokenAvailable(packetHandle, "IVIM", newPath);
  if(value.vehicleWeight.isValidFlag==1)
  {
    GetIVIMWeightParams(packetHandle, value.vehicleWeight, newPath);
    result = CheckLastError("IVIM", gkFuncRefGet, result);
  }
  return result;
}

int SetIVIMInternationalSign_applicableVehicleDimensionsParams(LONG packetHandle, struct IVIMInternationalSign_applicableVehicleDimensions value, char oldPath[])
{
  char newPath[300];
  int result;

  result = 0;

  snprintf(newPath, elcount(newPath), "%s.%s", oldPath, "vehicleHeight");
  if(value.vehicleHeight.isValidFlag==1)
  {
    SetIVIMDistanceParams(packetHandle, value.vehicleHeight, newPath);
    result = CheckLastError("IVIM", gkFuncRefGet, result);
  }
  else
  {
    if( C2xIsTokenAvailable(packetHandle, "IVIM", newPath) )
    {
      C2xRemoveToken(packetHandle, "IVIM", newPath);
    }
  }

  snprintf(newPath, elcount(newPath), "%s.%s", oldPath, "vehicleWidth");
  if(value.vehicleWidth.isValidFlag==1)
  {
    SetIVIMDistanceParams(packetHandle, value.vehicleWidth, newPath);
    result = CheckLastError("IVIM", gkFuncRefGet, result);
  }
  else
  {
    if( C2xIsTokenAvailable(packetHandle, "IVIM", newPath) )
    {
      C2xRemoveToken(packetHandle, "IVIM", newPath);
    }
  }

  snprintf(newPath, elcount(newPath), "%s.%s", oldPath, "vehicleLength");
  if(value.vehicleLength.isValidFlag==1)
  {
    SetIVIMDistanceParams(packetHandle, value.vehicleLength, newPath);
    result = CheckLastError("IVIM", gkFuncRefGet, result);
  }
  else
  {
    if( C2xIsTokenAvailable(packetHandle, "IVIM", newPath) )
    {
      C2xRemoveToken(packetHandle, "IVIM", newPath);
    }
  }

  snprintf(newPath, elcount(newPath), "%s.%s", oldPath, "vehicleWeight");
  if(value.vehicleWeight.isValidFlag==1)
  {
    SetIVIMWeightParams(packetHandle, value.vehicleWeight, newPath);
    result = CheckLastError("IVIM", gkFuncRefGet, result);
  }
  else
  {
    if( C2xIsTokenAvailable(packetHandle, "IVIM", newPath) )
    {
      C2xRemoveToken(packetHandle, "IVIM", newPath);
    }
  }

  return result;
}

int GetIVIMInternationalSign_speedLimitsParams(LONG packetHandle, struct IVIMInternationalSign_speedLimits value, char oldPath[])
{
  char newPath[300];
  int result;

  result = 0;

  snprintf(newPath, elcount(newPath), "%s.%s", oldPath, "speedLimitMax");
  value.speedLimitMax.isValidFlag = C2xIsTokenAvailable(packetHandle, "IVIM", newPath);
  if(value.speedLimitMax.isValidFlag==1)
  {
    value.speedLimitMax.value = C2xGetTokenInt(packetHandle, "IVIM", newPath);
    result = CheckLastError("IVIM", gkFuncRefGet, result);
  }
  snprintf(newPath, elcount(newPath), "%s.%s", oldPath, "speedLimitMin");
  value.speedLimitMin.isValidFlag = C2xIsTokenAvailable(packetHandle, "IVIM", newPath);
  if(value.speedLimitMin.isValidFlag==1)
  {
    value.speedLimitMin.value = C2xGetTokenInt(packetHandle, "IVIM", newPath);
    result = CheckLastError("IVIM", gkFuncRefGet, result);
  }
  snprintf(newPath, elcount(newPath), "%s.%s", oldPath, "unit");
  value.unit = C2xGetTokenInt(packetHandle, "IVIM", newPath);
  result = CheckLastError("IVIM", gkFuncRefGet, result);

  return result;
}

int SetIVIMInternationalSign_speedLimitsParams(LONG packetHandle, struct IVIMInternationalSign_speedLimits value, char oldPath[])
{
  char newPath[300];
  int result;

  result = 0;

  snprintf(newPath, elcount(newPath), "%s.%s", oldPath, "speedLimitMax");
  if(value.speedLimitMax.isValidFlag==1)
  {
    C2xSetTokenInt(packetHandle, "IVIM", newPath, value.speedLimitMax.value);
    result = CheckLastError("IVIM", gkFuncRefGet, result);
  }
  else
  {
    if( C2xIsTokenAvailable(packetHandle, "IVIM", newPath) )
    {
      C2xRemoveToken(packetHandle, "IVIM", newPath);
    }
  }

  snprintf(newPath, elcount(newPath), "%s.%s", oldPath, "speedLimitMin");
  if(value.speedLimitMin.isValidFlag==1)
  {
    C2xSetTokenInt(packetHandle, "IVIM", newPath, value.speedLimitMin.value);
    result = CheckLastError("IVIM", gkFuncRefGet, result);
  }
  else
  {
    if( C2xIsTokenAvailable(packetHandle, "IVIM", newPath) )
    {
      C2xRemoveToken(packetHandle, "IVIM", newPath);
    }
  }

  snprintf(newPath, elcount(newPath), "%s.%s", oldPath, "unit");
  C2xSetTokenInt(packetHandle, "IVIM", newPath, value.unit);
  result = CheckLastError("IVIM", gkFuncRefGet, result);

  return result;
}

int GetIVIMGddStructure_pictogramCode_serviceCategoryCodeParams(LONG packetHandle, struct IVIMGddStructure_pictogramCode_serviceCategoryCode value, char oldPath[])
{
  char newPath[300];
  int result;

  result = 0;

  value.choice = C2xGetTokenInt(packetHandle, "IVIM", oldPath);

  switch(value.choice)
  {
    case 0:
    {
      snprintf(newPath, elcount(newPath), "%s.%s", oldPath, "trafficSignPictogram");
      value.trafficSignPictogram = C2xGetTokenInt(packetHandle, "IVIM", newPath);
      result = CheckLastError("IVIM", gkFuncRefGet, result);
    }
    break;
    case 1:
    {
      snprintf(newPath, elcount(newPath), "%s.%s", oldPath, "publicFacilitiesPictogram");
      value.publicFacilitiesPictogram = C2xGetTokenInt(packetHandle, "IVIM", newPath);
      result = CheckLastError("IVIM", gkFuncRefGet, result);
    }
    break;
    case 2:
    {
      snprintf(newPath, elcount(newPath), "%s.%s", oldPath, "ambientOrRoadConditionPictogram");
      value.ambientOrRoadConditionPictogram = C2xGetTokenInt(packetHandle, "IVIM", newPath);
      result = CheckLastError("IVIM", gkFuncRefGet, result);
    }
    break;
  }
  return result;
}

int SetIVIMGddStructure_pictogramCode_serviceCategoryCodeParams(LONG packetHandle, struct IVIMGddStructure_pictogramCode_serviceCategoryCode value, char oldPath[])
{
  char newPath[300];
  int result;

  result = 0;

  switch(value.choice)
  {
    case 0:
    {
      snprintf(newPath, elcount(newPath), "%s.%s", oldPath, "trafficSignPictogram");
      C2xSetTokenInt(packetHandle, "IVIM", newPath, value.trafficSignPictogram);
      result = CheckLastError("IVIM", gkFuncRefGet, result);
    }
    break;
    case 1:
    {
      snprintf(newPath, elcount(newPath), "%s.%s", oldPath, "publicFacilitiesPictogram");
      C2xSetTokenInt(packetHandle, "IVIM", newPath, value.publicFacilitiesPictogram);
      result = CheckLastError("IVIM", gkFuncRefGet, result);
    }
    break;
    case 2:
    {
      snprintf(newPath, elcount(newPath), "%s.%s", oldPath, "ambientOrRoadConditionPictogram");
      C2xSetTokenInt(packetHandle, "IVIM", newPath, value.ambientOrRoadConditionPictogram);
      result = CheckLastError("IVIM", gkFuncRefGet, result);
    }
    break;
  }
  return result;
}

int GetIVIMGddStructure_pictogramCode_pictogramCategoryCodeParams(LONG packetHandle, struct IVIMGddStructure_pictogramCode_pictogramCategoryCode value, char oldPath[])
{
  char newPath[300];
  int result;

  result = 0;

  snprintf(newPath, elcount(newPath), "%s.%s", oldPath, "nature");
  value.nature = C2xGetTokenInt(packetHandle, "IVIM", newPath);
  result = CheckLastError("IVIM", gkFuncRefGet, result);

  snprintf(newPath, elcount(newPath), "%s.%s", oldPath, "serialNumber");
  value.serialNumber = C2xGetTokenInt(packetHandle, "IVIM", newPath);
  result = CheckLastError("IVIM", gkFuncRefGet, result);

  return result;
}

int SetIVIMGddStructure_pictogramCode_pictogramCategoryCodeParams(LONG packetHandle, struct IVIMGddStructure_pictogramCode_pictogramCategoryCode value, char oldPath[])
{
  char newPath[300];
  int result;

  result = 0;

  snprintf(newPath, elcount(newPath), "%s.%s", oldPath, "nature");
  if (value.nature < 1)
  {
    C2xSetTokenInt(packetHandle, "IVIM", newPath, 1);
  }
  else if (value.nature > 9)
  {
    C2xSetTokenInt(packetHandle, "IVIM", newPath, 9);
  }
  else
  {
    C2xSetTokenInt(packetHandle, "IVIM", newPath, value.nature);
  }
  result = CheckLastError("IVIM", gkFuncRefGet, result);

  snprintf(newPath, elcount(newPath), "%s.%s", oldPath, "serialNumber");
  C2xSetTokenInt(packetHandle, "IVIM", newPath, value.serialNumber);
  result = CheckLastError("IVIM", gkFuncRefGet, result);

  return result;
}

int GetIVIMGddStructure_pictogramCodeParams(LONG packetHandle, struct IVIMGddStructure_pictogramCode value, char oldPath[])
{
  char newPath[300];
  char buffer[300];
  int result;

  result = 0;

  snprintf(newPath, elcount(newPath), "%s.%s", oldPath, "countryCode");
  value.countryCode.isValidFlag = C2xIsTokenAvailable(packetHandle, "IVIM", newPath);
  if(value.countryCode.isValidFlag==1)
  {
    value.countryCode.isValidFlag = 1;
    value.countryCode.stringLength = C2xGetTokenData(packetHandle, "IVIM", newPath, elcount(value.countryCode.string), value.countryCode.string);
  }
  snprintf(newPath, elcount(newPath), "%s.%s", oldPath, "serviceCategoryCode");
  GetIVIMGddStructure_pictogramCode_serviceCategoryCodeParams(packetHandle, value.serviceCategoryCode, newPath);
  result = CheckLastError("IVIM", gkFuncRefGet, result);

  snprintf(newPath, elcount(newPath), "%s.%s", oldPath, "pictogramCategoryCode");
  GetIVIMGddStructure_pictogramCode_pictogramCategoryCodeParams(packetHandle, value.pictogramCategoryCode, newPath);
  result = CheckLastError("IVIM", gkFuncRefGet, result);

  return result;
}

int SetIVIMGddStructure_pictogramCodeParams(LONG packetHandle, struct IVIMGddStructure_pictogramCode value, char oldPath[])
{
  char newPath[300];
  char buffer[300];
  int result;

  result = 0;

  snprintf(newPath, elcount(newPath), "%s.%s", oldPath, "countryCode");
  if(value.countryCode.isValidFlag==1)
  {
    C2xSetTokenData(packetHandle, "IVIM", newPath, value.countryCode.stringLength, value.countryCode.string);
  }
  else
  {
    if( C2xIsTokenAvailable(packetHandle, "IVIM", newPath) )
    {
      C2xRemoveToken(packetHandle, "IVIM", newPath);
    }
  }

  snprintf(newPath, elcount(newPath), "%s.%s", oldPath, "serviceCategoryCode");
  SetIVIMGddStructure_pictogramCode_serviceCategoryCodeParams(packetHandle, value.serviceCategoryCode, newPath);
  result = CheckLastError("IVIM", gkFuncRefGet, result);

  snprintf(newPath, elcount(newPath), "%s.%s", oldPath, "pictogramCategoryCode");
  SetIVIMGddStructure_pictogramCode_pictogramCategoryCodeParams(packetHandle, value.pictogramCategoryCode, newPath);
  result = CheckLastError("IVIM", gkFuncRefGet, result);

  return result;
}

int GetIVIMInternationalSign_destinationInformationParams(LONG packetHandle, struct IVIMInternationalSign_destinationInformation value, char oldPath[])
{
  char newPath[300];
  int result;

  result = 0;

  snprintf(newPath, elcount(newPath), "%s.%s", oldPath, "junctionDirection");
  value.junctionDirection.isValidFlag = C2xIsTokenAvailable(packetHandle, "IVIM", newPath);
  if(value.junctionDirection.isValidFlag==1)
  {
    value.junctionDirection.value = C2xGetTokenInt(packetHandle, "IVIM", newPath);
    result = CheckLastError("IVIM", gkFuncRefGet, result);
  }
  snprintf(newPath, elcount(newPath), "%s.%s", oldPath, "roundaboutCwDirection");
  value.roundaboutCwDirection.isValidFlag = C2xIsTokenAvailable(packetHandle, "IVIM", newPath);
  if(value.roundaboutCwDirection.isValidFlag==1)
  {
    value.roundaboutCwDirection.value = C2xGetTokenInt(packetHandle, "IVIM", newPath);
    result = CheckLastError("IVIM", gkFuncRefGet, result);
  }
  snprintf(newPath, elcount(newPath), "%s.%s", oldPath, "roundaboutCcwDirection");
  value.roundaboutCcwDirection.isValidFlag = C2xIsTokenAvailable(packetHandle, "IVIM", newPath);
  if(value.roundaboutCcwDirection.isValidFlag==1)
  {
    value.roundaboutCcwDirection.value = C2xGetTokenInt(packetHandle, "IVIM", newPath);
    result = CheckLastError("IVIM", gkFuncRefGet, result);
  }
  snprintf(newPath, elcount(newPath), "%s.%s", oldPath, "ioList");
  //GetIVIMDDD_IO_LISTParams(packetHandle, value.ioList, newPath);  // Loop, not supported
  result = CheckLastError("IVIM", gkFuncRefGet, result);

  return result;
}

int SetIVIMInternationalSign_destinationInformationParams(LONG packetHandle, struct IVIMInternationalSign_destinationInformation value, char oldPath[])
{
  char newPath[300];
  int result;

  result = 0;

  snprintf(newPath, elcount(newPath), "%s.%s", oldPath, "junctionDirection");
  if(value.junctionDirection.isValidFlag==1)
  {
    if (value.junctionDirection.value < 1)
    {
        C2xSetTokenInt(packetHandle, "IVIM", newPath, 1);
    }
    else if (value.junctionDirection.value > 128)
    {
        C2xSetTokenInt(packetHandle, "IVIM", newPath, 128);
    }
    else
    {
        C2xSetTokenInt(packetHandle, "IVIM", newPath, value.junctionDirection.value);
    }
    result = CheckLastError("IVIM", gkFuncRefGet, result);
  }
  else
  {
    if( C2xIsTokenAvailable(packetHandle, "IVIM", newPath) )
    {
      C2xRemoveToken(packetHandle, "IVIM", newPath);
    }
  }

  snprintf(newPath, elcount(newPath), "%s.%s", oldPath, "roundaboutCwDirection");
  if(value.roundaboutCwDirection.isValidFlag==1)
  {
    if (value.roundaboutCwDirection.value < 1)
    {
        C2xSetTokenInt(packetHandle, "IVIM", newPath, 1);
    }
    else if (value.roundaboutCwDirection.value > 128)
    {
        C2xSetTokenInt(packetHandle, "IVIM", newPath, 128);
    }
    else
    {
        C2xSetTokenInt(packetHandle, "IVIM", newPath, value.roundaboutCwDirection.value);
    }
    result = CheckLastError("IVIM", gkFuncRefGet, result);
  }
  else
  {
    if( C2xIsTokenAvailable(packetHandle, "IVIM", newPath) )
    {
      C2xRemoveToken(packetHandle, "IVIM", newPath);
    }
  }

  snprintf(newPath, elcount(newPath), "%s.%s", oldPath, "roundaboutCcwDirection");
  if(value.roundaboutCcwDirection.isValidFlag==1)
  {
    if (value.roundaboutCcwDirection.value < 1)
    {
        C2xSetTokenInt(packetHandle, "IVIM", newPath, 1);
    }
    else if (value.roundaboutCcwDirection.value > 128)
    {
        C2xSetTokenInt(packetHandle, "IVIM", newPath, 128);
    }
    else
    {
        C2xSetTokenInt(packetHandle, "IVIM", newPath, value.roundaboutCcwDirection.value);
    }
    result = CheckLastError("IVIM", gkFuncRefGet, result);
  }
  else
  {
    if( C2xIsTokenAvailable(packetHandle, "IVIM", newPath) )
    {
      C2xRemoveToken(packetHandle, "IVIM", newPath);
    }
  }

  snprintf(newPath, elcount(newPath), "%s.%s", oldPath, "ioList");
  //SetIVIMDDD_IO_LISTParams(packetHandle, value.ioList, newPath);  // Loop, not supported
  result = CheckLastError("IVIM", gkFuncRefGet, result);

  return result;
}

int GetIVIMInternationalSign_sectionParams(LONG packetHandle, struct IVIMInternationalSign_section value, char oldPath[])
{
  char newPath[300];
  int result;

  result = 0;

  snprintf(newPath, elcount(newPath), "%s.%s", oldPath, "startingPointLength");
  value.startingPointLength.isValidFlag = C2xIsTokenAvailable(packetHandle, "IVIM", newPath);
  if(value.startingPointLength.isValidFlag==1)
  {
    GetIVIMDistanceParams(packetHandle, value.startingPointLength, newPath);
    result = CheckLastError("IVIM", gkFuncRefGet, result);
  }
  snprintf(newPath, elcount(newPath), "%s.%s", oldPath, "continuityLength");
  value.continuityLength.isValidFlag = C2xIsTokenAvailable(packetHandle, "IVIM", newPath);
  if(value.continuityLength.isValidFlag==1)
  {
    GetIVIMDistanceParams(packetHandle, value.continuityLength, newPath);
    result = CheckLastError("IVIM", gkFuncRefGet, result);
  }
  return result;
}

int SetIVIMInternationalSign_sectionParams(LONG packetHandle, struct IVIMInternationalSign_section value, char oldPath[])
{
  char newPath[300];
  int result;

  result = 0;

  snprintf(newPath, elcount(newPath), "%s.%s", oldPath, "startingPointLength");
  if(value.startingPointLength.isValidFlag==1)
  {
    SetIVIMDistanceParams(packetHandle, value.startingPointLength, newPath);
    result = CheckLastError("IVIM", gkFuncRefGet, result);
  }
  else
  {
    if( C2xIsTokenAvailable(packetHandle, "IVIM", newPath) )
    {
      C2xRemoveToken(packetHandle, "IVIM", newPath);
    }
  }

  snprintf(newPath, elcount(newPath), "%s.%s", oldPath, "continuityLength");
  if(value.continuityLength.isValidFlag==1)
  {
    SetIVIMDistanceParams(packetHandle, value.continuityLength, newPath);
    result = CheckLastError("IVIM", gkFuncRefGet, result);
  }
  else
  {
    if( C2xIsTokenAvailable(packetHandle, "IVIM", newPath) )
    {
      C2xRemoveToken(packetHandle, "IVIM", newPath);
    }
  }

  return result;
}

int GetIVIMGddAttributeParams(LONG packetHandle, struct IVIMGddAttribute value, char oldPath[])
{
  char newPath[300];
  int result;

  result = 0;

  value.choice = C2xGetTokenInt(packetHandle, "IVIM", oldPath);

  switch(value.choice)
  {
    case 0:
    {
      snprintf(newPath, elcount(newPath), "%s.%s", oldPath, "dtm");
      GetIVIMInternationalSign_applicablePeriodParams(packetHandle, value.dtm, newPath);
      result = CheckLastError("IVIM", gkFuncRefGet, result);
    }
    break;
    case 1:
    {
      snprintf(newPath, elcount(newPath), "%s.%s", oldPath, "edt");
      GetIVIMInternationalSign_applicablePeriodParams(packetHandle, value.edt, newPath);
      result = CheckLastError("IVIM", gkFuncRefGet, result);
    }
    break;
    case 2:
    {
      snprintf(newPath, elcount(newPath), "%s.%s", oldPath, "dfl");
      value.dfl = C2xGetTokenInt(packetHandle, "IVIM", newPath);
      result = CheckLastError("IVIM", gkFuncRefGet, result);
    }
    break;
    case 3:
    {
      snprintf(newPath, elcount(newPath), "%s.%s", oldPath, "ved");
      GetIVIMInternationalSign_applicableVehicleDimensionsParams(packetHandle, value.ved, newPath);
      result = CheckLastError("IVIM", gkFuncRefGet, result);
    }
    break;
    case 4:
    {
      snprintf(newPath, elcount(newPath), "%s.%s", oldPath, "spe");
      GetIVIMInternationalSign_speedLimitsParams(packetHandle, value.spe, newPath);
      result = CheckLastError("IVIM", gkFuncRefGet, result);
    }
    break;
    case 5:
    {
      snprintf(newPath, elcount(newPath), "%s.%s", oldPath, "roi");
      value.roi = C2xGetTokenInt(packetHandle, "IVIM", newPath);
      result = CheckLastError("IVIM", gkFuncRefGet, result);
    }
    break;
    case 6:
    {
      snprintf(newPath, elcount(newPath), "%s.%s", oldPath, "dbv");
      GetIVIMDistanceParams(packetHandle, value.dbv, newPath);
      result = CheckLastError("IVIM", gkFuncRefGet, result);
    }
    break;
    case 7:
    {
      snprintf(newPath, elcount(newPath), "%s.%s", oldPath, "ddd");
      GetIVIMInternationalSign_destinationInformationParams(packetHandle, value.ddd, newPath);
      result = CheckLastError("IVIM", gkFuncRefGet, result);
    }
    break;
    case 8:
    {
      snprintf(newPath, elcount(newPath), "%s.%s", oldPath, "set");
      GetIVIMInternationalSign_sectionParams(packetHandle, value.set, newPath);
      result = CheckLastError("IVIM", gkFuncRefGet, result);
    }
    break;
    case 9:
    {
      snprintf(newPath, elcount(newPath), "%s.%s", oldPath, "nol");
      value.nol = C2xGetTokenInt(packetHandle, "IVIM", newPath);
      result = CheckLastError("IVIM", gkFuncRefGet, result);
    }
    break;
  }
  return result;
}

int SetIVIMGddAttributeParams(LONG packetHandle, struct IVIMGddAttribute value, char oldPath[])
{
  char newPath[300];
  int result;

  result = 0;

  switch(value.choice)
  {
    case 0:
    {
      snprintf(newPath, elcount(newPath), "%s.%s", oldPath, "dtm");
      SetIVIMInternationalSign_applicablePeriodParams(packetHandle, value.dtm, newPath);
      result = CheckLastError("IVIM", gkFuncRefGet, result);
    }
    break;
    case 1:
    {
      snprintf(newPath, elcount(newPath), "%s.%s", oldPath, "edt");
      SetIVIMInternationalSign_applicablePeriodParams(packetHandle, value.edt, newPath);
      result = CheckLastError("IVIM", gkFuncRefGet, result);
    }
    break;
    case 2:
    {
      snprintf(newPath, elcount(newPath), "%s.%s", oldPath, "dfl");
      C2xSetTokenInt(packetHandle, "IVIM", newPath, value.dfl);
      result = CheckLastError("IVIM", gkFuncRefGet, result);
    }
    break;
    case 3:
    {
      snprintf(newPath, elcount(newPath), "%s.%s", oldPath, "ved");
      SetIVIMInternationalSign_applicableVehicleDimensionsParams(packetHandle, value.ved, newPath);
      result = CheckLastError("IVIM", gkFuncRefGet, result);
    }
    break;
    case 4:
    {
      snprintf(newPath, elcount(newPath), "%s.%s", oldPath, "spe");
      SetIVIMInternationalSign_speedLimitsParams(packetHandle, value.spe, newPath);
      result = CheckLastError("IVIM", gkFuncRefGet, result);
    }
    break;
    case 5:
    {
      snprintf(newPath, elcount(newPath), "%s.%s", oldPath, "roi");
      C2xSetTokenInt(packetHandle, "IVIM", newPath, value.roi);
      result = CheckLastError("IVIM", gkFuncRefGet, result);
    }
    break;
    case 6:
    {
      snprintf(newPath, elcount(newPath), "%s.%s", oldPath, "dbv");
      SetIVIMDistanceParams(packetHandle, value.dbv, newPath);
      result = CheckLastError("IVIM", gkFuncRefGet, result);
    }
    break;
    case 7:
    {
      snprintf(newPath, elcount(newPath), "%s.%s", oldPath, "ddd");
      SetIVIMInternationalSign_destinationInformationParams(packetHandle, value.ddd, newPath);
      result = CheckLastError("IVIM", gkFuncRefGet, result);
    }
    break;
    case 8:
    {
      snprintf(newPath, elcount(newPath), "%s.%s", oldPath, "set");
      SetIVIMInternationalSign_sectionParams(packetHandle, value.set, newPath);
      result = CheckLastError("IVIM", gkFuncRefGet, result);
    }
    break;
    case 9:
    {
      snprintf(newPath, elcount(newPath), "%s.%s", oldPath, "nol");
      C2xSetTokenInt(packetHandle, "IVIM", newPath, value.nol);
      result = CheckLastError("IVIM", gkFuncRefGet, result);
    }
    break;
  }
  return result;
}

int GetIVIMGddAttributesParams(LONG packetHandle, struct IVIMGddAttributes value, char oldPath[])
{
  char newPath[300]; 
  int i;
  int result;

  result = 0;

  value.length = C2xGetTokenInt(packetHandle, "IVIM", oldPath);
  if((result = CheckLastError("IVIM", gkFuncRefGet, result))==0)
  {
    for(i=0; i<value.length; i++)
    {
      snprintf(newPath, elcount(newPath), "%s[%d]", oldPath, i);
      GetIVIMGddAttributeParams(packetHandle, value.arrayValue[i], newPath);
      result = CheckLastError("IVIM", gkFuncRefGet, result);
    }
  }
  return result;
}

int SetIVIMGddAttributesParams(LONG packetHandle, struct IVIMGddAttributes value, char oldPath[])
{
  char newPath[300]; 
  int i;
  int result;

  result = 0;

  C2xRemoveToken(packetHandle, "IVIM", oldPath);
  for(i=0; i<value.length; i++)
  {
    snprintf(newPath, elcount(newPath), "%s[%d]", oldPath, i);
    SetIVIMGddAttributeParams(packetHandle, value.arrayValue[i], newPath);
    result = CheckLastError("IVIM", gkFuncRefGet, result);
  }
  return result;
}

int GetIVIMGddStructureParams(LONG packetHandle, struct IVIMGddStructure value, char oldPath[])
{
  char newPath[300];
  int result;

  result = 0;

  snprintf(newPath, elcount(newPath), "%s.%s", oldPath, "pictogramCode");
  GetIVIMGddStructure_pictogramCodeParams(packetHandle, value.pictogramCode, newPath);
  result = CheckLastError("IVIM", gkFuncRefGet, result);

  snprintf(newPath, elcount(newPath), "%s.%s", oldPath, "attributes");
  value.attributes.isValidFlag = C2xIsTokenAvailable(packetHandle, "IVIM", newPath);
  if(value.attributes.isValidFlag==1)
  {
    GetIVIMGddAttributesParams(packetHandle, value.attributes, newPath);
    result = CheckLastError("IVIM", gkFuncRefGet, result);
  }
  return result;
}

int SetIVIMGddStructureParams(LONG packetHandle, struct IVIMGddStructure value, char oldPath[])
{
  char newPath[300];
  int result;

  result = 0;

  snprintf(newPath, elcount(newPath), "%s.%s", oldPath, "pictogramCode");
  SetIVIMGddStructure_pictogramCodeParams(packetHandle, value.pictogramCode, newPath);
  result = CheckLastError("IVIM", gkFuncRefGet, result);

  snprintf(newPath, elcount(newPath), "%s.%s", oldPath, "attributes");
  if(value.attributes.isValidFlag==1)
  {
    SetIVIMGddAttributesParams(packetHandle, value.attributes, newPath);
    result = CheckLastError("IVIM", gkFuncRefGet, result);
  }
  else
  {
    if( C2xIsTokenAvailable(packetHandle, "IVIM", newPath) )
    {
      C2xRemoveToken(packetHandle, "IVIM", newPath);
    }
  }

  return result;
}

int GetIVIMDestinationPlaceParams(LONG packetHandle, struct IVIMDestinationPlace value, char oldPath[])
{
  char newPath[300];
  int result;

  result = 0;

  snprintf(newPath, elcount(newPath), "%s.%s", oldPath, "destType");
  value.destType = C2xGetTokenInt(packetHandle, "IVIM", newPath);
  result = CheckLastError("IVIM", gkFuncRefGet, result);

  snprintf(newPath, elcount(newPath), "%s.%s", oldPath, "destRSCode");
  value.destRSCode.isValidFlag = C2xIsTokenAvailable(packetHandle, "IVIM", newPath);
  if(value.destRSCode.isValidFlag==1)
  {
    GetIVIMGddStructureParams(packetHandle, value.destRSCode, newPath);
    result = CheckLastError("IVIM", gkFuncRefGet, result);
  }
  snprintf(newPath, elcount(newPath), "%s.%s", oldPath, "destBlob");
  value.destBlob.isValidFlag = C2xIsTokenAvailable(packetHandle, "IVIM", newPath);
  if(value.destBlob.isValidFlag==1)
  {
    value.destBlob.isValidFlag = 1;
    value.destBlob.stringLength = C2xGetTokenData(packetHandle, "IVIM", newPath, elcount(value.destBlob.string), value.destBlob.string);
  }
  snprintf(newPath, elcount(newPath), "%s.%s", oldPath, "placeNameIdentification");
  value.placeNameIdentification.isValidFlag = C2xIsTokenAvailable(packetHandle, "IVIM", newPath);
  if(value.placeNameIdentification.isValidFlag==1)
  {
    value.placeNameIdentification.value = C2xGetTokenInt(packetHandle, "IVIM", newPath);
    result = CheckLastError("IVIM", gkFuncRefGet, result);
  }
  snprintf(newPath, elcount(newPath), "%s.%s", oldPath, "placeNameText");
  value.placeNameText.isValidFlag = C2xIsTokenAvailable(packetHandle, "IVIM", newPath);
  if(value.placeNameText.isValidFlag==1)
  {
    value.placeNameText.stringLength = C2xGetTokenData(packetHandle, "IVIM", newPath, elcount(value.placeNameText.string), value.placeNameText.string);
    result = CheckLastError("IVIM", gkFuncRefGet, result);
  }
  return result;
}

int SetIVIMDestinationPlaceParams(LONG packetHandle, struct IVIMDestinationPlace value, char oldPath[])
{
  char newPath[300];
  int result;

  result = 0;

  snprintf(newPath, elcount(newPath), "%s.%s", oldPath, "destType");
  C2xSetTokenInt(packetHandle, "IVIM", newPath, value.destType);
  result = CheckLastError("IVIM", gkFuncRefGet, result);

  snprintf(newPath, elcount(newPath), "%s.%s", oldPath, "destRSCode");
  if(value.destRSCode.isValidFlag==1)
  {
    SetIVIMGddStructureParams(packetHandle, value.destRSCode, newPath);
    result = CheckLastError("IVIM", gkFuncRefGet, result);
  }
  else
  {
    if( C2xIsTokenAvailable(packetHandle, "IVIM", newPath) )
    {
      C2xRemoveToken(packetHandle, "IVIM", newPath);
    }
  }

  snprintf(newPath, elcount(newPath), "%s.%s", oldPath, "destBlob");
  if(value.destBlob.isValidFlag==1)
  {
    C2xSetTokenData(packetHandle, "IVIM", newPath, value.destBlob.stringLength, value.destBlob.string);
  }
  else
  {
    if( C2xIsTokenAvailable(packetHandle, "IVIM", newPath) )
    {
      C2xRemoveToken(packetHandle, "IVIM", newPath);
    }
  }

  snprintf(newPath, elcount(newPath), "%s.%s", oldPath, "placeNameIdentification");
  if(value.placeNameIdentification.isValidFlag==1)
  {
    if (value.placeNameIdentification.value < 1)
    {
        C2xSetTokenInt(packetHandle, "IVIM", newPath, 1);
    }
    else if (value.placeNameIdentification.value > 999)
    {
        C2xSetTokenInt(packetHandle, "IVIM", newPath, 999);
    }
    else
    {
        C2xSetTokenInt(packetHandle, "IVIM", newPath, value.placeNameIdentification.value);
    }
    result = CheckLastError("IVIM", gkFuncRefGet, result);
  }
  else
  {
    if( C2xIsTokenAvailable(packetHandle, "IVIM", newPath) )
    {
      C2xRemoveToken(packetHandle, "IVIM", newPath);
    }
  }

  snprintf(newPath, elcount(newPath), "%s.%s", oldPath, "placeNameText");
  if(value.placeNameText.isValidFlag==1)
  {
    C2xSetTokenData(packetHandle, "IVIM", newPath, value.placeNameText.stringLength, value.placeNameText.string);
    result = CheckLastError("IVIM", gkFuncRefGet, result);
  }
  else
  {
    if( C2xIsTokenAvailable(packetHandle, "IVIM", newPath) )
    {
      C2xRemoveToken(packetHandle, "IVIM", newPath);
    }
  }

  return result;
}

int GetIVIMDestinationPlacesParams(LONG packetHandle, struct IVIMDestinationPlaces value, char oldPath[])
{
  char newPath[300]; 
  int i;
  int result;

  result = 0;

  value.length = C2xGetTokenInt(packetHandle, "IVIM", oldPath);
  if((result = CheckLastError("IVIM", gkFuncRefGet, result))==0)
  {
    for(i=0; i<value.length; i++)
    {
      snprintf(newPath, elcount(newPath), "%s[%d]", oldPath, i);
      GetIVIMDestinationPlaceParams(packetHandle, value.arrayValue[i], newPath);
      result = CheckLastError("IVIM", gkFuncRefGet, result);
    }
  }
  return result;
}

int SetIVIMDestinationPlacesParams(LONG packetHandle, struct IVIMDestinationPlaces value, char oldPath[])
{
  char newPath[300]; 
  int i;
  int result;

  result = 0;

  C2xRemoveToken(packetHandle, "IVIM", oldPath);
  for(i=0; i<value.length; i++)
  {
    snprintf(newPath, elcount(newPath), "%s[%d]", oldPath, i);
    SetIVIMDestinationPlaceParams(packetHandle, value.arrayValue[i], newPath);
    result = CheckLastError("IVIM", gkFuncRefGet, result);
  }
  return result;
}

int GetIVIMDestinationRoadParams(LONG packetHandle, struct IVIMDestinationRoad value, char oldPath[])
{
  char newPath[300];
  int result;

  result = 0;

  snprintf(newPath, elcount(newPath), "%s.%s", oldPath, "derType");
  value.derType = C2xGetTokenInt(packetHandle, "IVIM", newPath);
  result = CheckLastError("IVIM", gkFuncRefGet, result);

  snprintf(newPath, elcount(newPath), "%s.%s", oldPath, "roadNumberIdentifier");
  value.roadNumberIdentifier.isValidFlag = C2xIsTokenAvailable(packetHandle, "IVIM", newPath);
  if(value.roadNumberIdentifier.isValidFlag==1)
  {
    value.roadNumberIdentifier.value = C2xGetTokenInt(packetHandle, "IVIM", newPath);
    result = CheckLastError("IVIM", gkFuncRefGet, result);
  }
  snprintf(newPath, elcount(newPath), "%s.%s", oldPath, "roadNumberText");
  value.roadNumberText.isValidFlag = C2xIsTokenAvailable(packetHandle, "IVIM", newPath);
  if(value.roadNumberText.isValidFlag==1)
  {
    value.roadNumberText.stringLength = C2xGetTokenData(packetHandle, "IVIM", newPath, elcount(value.roadNumberText.string), value.roadNumberText.string);
    result = CheckLastError("IVIM", gkFuncRefGet, result);
  }
  return result;
}

int SetIVIMDestinationRoadParams(LONG packetHandle, struct IVIMDestinationRoad value, char oldPath[])
{
  char newPath[300];
  int result;

  result = 0;

  snprintf(newPath, elcount(newPath), "%s.%s", oldPath, "derType");
  C2xSetTokenInt(packetHandle, "IVIM", newPath, value.derType);
  result = CheckLastError("IVIM", gkFuncRefGet, result);

  snprintf(newPath, elcount(newPath), "%s.%s", oldPath, "roadNumberIdentifier");
  if(value.roadNumberIdentifier.isValidFlag==1)
  {
    if (value.roadNumberIdentifier.value < 1)
    {
        C2xSetTokenInt(packetHandle, "IVIM", newPath, 1);
    }
    else if (value.roadNumberIdentifier.value > 999)
    {
        C2xSetTokenInt(packetHandle, "IVIM", newPath, 999);
    }
    else
    {
        C2xSetTokenInt(packetHandle, "IVIM", newPath, value.roadNumberIdentifier.value);
    }
    result = CheckLastError("IVIM", gkFuncRefGet, result);
  }
  else
  {
    if( C2xIsTokenAvailable(packetHandle, "IVIM", newPath) )
    {
      C2xRemoveToken(packetHandle, "IVIM", newPath);
    }
  }

  snprintf(newPath, elcount(newPath), "%s.%s", oldPath, "roadNumberText");
  if(value.roadNumberText.isValidFlag==1)
  {
    C2xSetTokenData(packetHandle, "IVIM", newPath, value.roadNumberText.stringLength, value.roadNumberText.string);
    result = CheckLastError("IVIM", gkFuncRefGet, result);
  }
  else
  {
    if( C2xIsTokenAvailable(packetHandle, "IVIM", newPath) )
    {
      C2xRemoveToken(packetHandle, "IVIM", newPath);
    }
  }

  return result;
}

int GetIVIMDestinationRoadsParams(LONG packetHandle, struct IVIMDestinationRoads value, char oldPath[])
{
  char newPath[300]; 
  int i;
  int result;

  result = 0;

  value.length = C2xGetTokenInt(packetHandle, "IVIM", oldPath);
  if((result = CheckLastError("IVIM", gkFuncRefGet, result))==0)
  {
    for(i=0; i<value.length; i++)
    {
      snprintf(newPath, elcount(newPath), "%s[%d]", oldPath, i);
      GetIVIMDestinationRoadParams(packetHandle, value.arrayValue[i], newPath);
      result = CheckLastError("IVIM", gkFuncRefGet, result);
    }
  }
  return result;
}

int SetIVIMDestinationRoadsParams(LONG packetHandle, struct IVIMDestinationRoads value, char oldPath[])
{
  char newPath[300]; 
  int i;
  int result;

  result = 0;

  C2xRemoveToken(packetHandle, "IVIM", oldPath);
  for(i=0; i<value.length; i++)
  {
    snprintf(newPath, elcount(newPath), "%s[%d]", oldPath, i);
    SetIVIMDestinationRoadParams(packetHandle, value.arrayValue[i], newPath);
    result = CheckLastError("IVIM", gkFuncRefGet, result);
  }
  return result;
}

int GetIVIMDistanceOrDurationParams(LONG packetHandle, struct IVIMDistanceOrDuration value, char oldPath[])
{
  char newPath[300];
  int result;

  result = 0;

  snprintf(newPath, elcount(newPath), "%s.%s", oldPath, "value");
  value.value = C2xGetTokenInt(packetHandle, "IVIM", newPath);
  result = CheckLastError("IVIM", gkFuncRefGet, result);

  snprintf(newPath, elcount(newPath), "%s.%s", oldPath, "unit");
  value.unit = C2xGetTokenInt(packetHandle, "IVIM", newPath);
  result = CheckLastError("IVIM", gkFuncRefGet, result);

  return result;
}

int SetIVIMDistanceOrDurationParams(LONG packetHandle, struct IVIMDistanceOrDuration value, char oldPath[])
{
  char newPath[300];
  int result;

  result = 0;

  snprintf(newPath, elcount(newPath), "%s.%s", oldPath, "value");
  if (value.value < 1)
  {
    C2xSetTokenInt(packetHandle, "IVIM", newPath, 1);
  }
  else if (value.value > 16384)
  {
    C2xSetTokenInt(packetHandle, "IVIM", newPath, 16384);
  }
  else
  {
    C2xSetTokenInt(packetHandle, "IVIM", newPath, value.value);
  }
  result = CheckLastError("IVIM", gkFuncRefGet, result);

  snprintf(newPath, elcount(newPath), "%s.%s", oldPath, "unit");
  if (value.unit < 2)
  {
    C2xSetTokenInt(packetHandle, "IVIM", newPath, 2);
  }
  else if (value.unit > 9)
  {
    C2xSetTokenInt(packetHandle, "IVIM", newPath, 9);
  }
  else
  {
    C2xSetTokenInt(packetHandle, "IVIM", newPath, value.unit);
  }
  result = CheckLastError("IVIM", gkFuncRefGet, result);

  return result;
}

int GetIVIMDDD_IOParams(LONG packetHandle, struct IVIMDDD_IO value, char oldPath[])
{
  char newPath[300];
  int result;

  result = 0;

  snprintf(newPath, elcount(newPath), "%s.%s", oldPath, "arrowDirection");
  value.arrowDirection = C2xGetTokenInt(packetHandle, "IVIM", newPath);
  result = CheckLastError("IVIM", gkFuncRefGet, result);

  snprintf(newPath, elcount(newPath), "%s.%s", oldPath, "destPlace");
  value.destPlace.isValidFlag = C2xIsTokenAvailable(packetHandle, "IVIM", newPath);
  if(value.destPlace.isValidFlag==1)
  {
    GetIVIMDestinationPlacesParams(packetHandle, value.destPlace, newPath);
    result = CheckLastError("IVIM", gkFuncRefGet, result);
  }
  snprintf(newPath, elcount(newPath), "%s.%s", oldPath, "destRoad");
  value.destRoad.isValidFlag = C2xIsTokenAvailable(packetHandle, "IVIM", newPath);
  if(value.destRoad.isValidFlag==1)
  {
    GetIVIMDestinationRoadsParams(packetHandle, value.destRoad, newPath);
    result = CheckLastError("IVIM", gkFuncRefGet, result);
  }
  snprintf(newPath, elcount(newPath), "%s.%s", oldPath, "roadNumberIdentifier");
  value.roadNumberIdentifier.isValidFlag = C2xIsTokenAvailable(packetHandle, "IVIM", newPath);
  if(value.roadNumberIdentifier.isValidFlag==1)
  {
    value.roadNumberIdentifier.value = C2xGetTokenInt(packetHandle, "IVIM", newPath);
    result = CheckLastError("IVIM", gkFuncRefGet, result);
  }
  snprintf(newPath, elcount(newPath), "%s.%s", oldPath, "streetName");
  value.streetName.isValidFlag = C2xIsTokenAvailable(packetHandle, "IVIM", newPath);
  if(value.streetName.isValidFlag==1)
  {
    value.streetName.value = C2xGetTokenInt(packetHandle, "IVIM", newPath);
    result = CheckLastError("IVIM", gkFuncRefGet, result);
  }
  snprintf(newPath, elcount(newPath), "%s.%s", oldPath, "streetNameText");
  value.streetNameText.isValidFlag = C2xIsTokenAvailable(packetHandle, "IVIM", newPath);
  if(value.streetNameText.isValidFlag==1)
  {
    value.streetNameText.stringLength = C2xGetTokenData(packetHandle, "IVIM", newPath, elcount(value.streetNameText.string), value.streetNameText.string);
    result = CheckLastError("IVIM", gkFuncRefGet, result);
  }
  snprintf(newPath, elcount(newPath), "%s.%s", oldPath, "distanceToDivergingPoint");
  value.distanceToDivergingPoint.isValidFlag = C2xIsTokenAvailable(packetHandle, "IVIM", newPath);
  if(value.distanceToDivergingPoint.isValidFlag==1)
  {
    GetIVIMDistanceOrDurationParams(packetHandle, value.distanceToDivergingPoint, newPath);
    result = CheckLastError("IVIM", gkFuncRefGet, result);
  }
  snprintf(newPath, elcount(newPath), "%s.%s", oldPath, "distanceToDestinationPlace");
  value.distanceToDestinationPlace.isValidFlag = C2xIsTokenAvailable(packetHandle, "IVIM", newPath);
  if(value.distanceToDestinationPlace.isValidFlag==1)
  {
    GetIVIMDistanceOrDurationParams(packetHandle, value.distanceToDestinationPlace, newPath);
    result = CheckLastError("IVIM", gkFuncRefGet, result);
  }
  return result;
}

int SetIVIMDDD_IOParams(LONG packetHandle, struct IVIMDDD_IO value, char oldPath[])
{
  char newPath[300];
  int result;

  result = 0;

  snprintf(newPath, elcount(newPath), "%s.%s", oldPath, "arrowDirection");
  C2xSetTokenInt(packetHandle, "IVIM", newPath, value.arrowDirection);
  result = CheckLastError("IVIM", gkFuncRefGet, result);

  snprintf(newPath, elcount(newPath), "%s.%s", oldPath, "destPlace");
  if(value.destPlace.isValidFlag==1)
  {
    SetIVIMDestinationPlacesParams(packetHandle, value.destPlace, newPath);
    result = CheckLastError("IVIM", gkFuncRefGet, result);
  }
  else
  {
    if( C2xIsTokenAvailable(packetHandle, "IVIM", newPath) )
    {
      C2xRemoveToken(packetHandle, "IVIM", newPath);
    }
  }

  snprintf(newPath, elcount(newPath), "%s.%s", oldPath, "destRoad");
  if(value.destRoad.isValidFlag==1)
  {
    SetIVIMDestinationRoadsParams(packetHandle, value.destRoad, newPath);
    result = CheckLastError("IVIM", gkFuncRefGet, result);
  }
  else
  {
    if( C2xIsTokenAvailable(packetHandle, "IVIM", newPath) )
    {
      C2xRemoveToken(packetHandle, "IVIM", newPath);
    }
  }

  snprintf(newPath, elcount(newPath), "%s.%s", oldPath, "roadNumberIdentifier");
  if(value.roadNumberIdentifier.isValidFlag==1)
  {
    if (value.roadNumberIdentifier.value < 1)
    {
        C2xSetTokenInt(packetHandle, "IVIM", newPath, 1);
    }
    else if (value.roadNumberIdentifier.value > 999)
    {
        C2xSetTokenInt(packetHandle, "IVIM", newPath, 999);
    }
    else
    {
        C2xSetTokenInt(packetHandle, "IVIM", newPath, value.roadNumberIdentifier.value);
    }
    result = CheckLastError("IVIM", gkFuncRefGet, result);
  }
  else
  {
    if( C2xIsTokenAvailable(packetHandle, "IVIM", newPath) )
    {
      C2xRemoveToken(packetHandle, "IVIM", newPath);
    }
  }

  snprintf(newPath, elcount(newPath), "%s.%s", oldPath, "streetName");
  if(value.streetName.isValidFlag==1)
  {
    if (value.streetName.value < 1)
    {
        C2xSetTokenInt(packetHandle, "IVIM", newPath, 1);
    }
    else if (value.streetName.value > 999)
    {
        C2xSetTokenInt(packetHandle, "IVIM", newPath, 999);
    }
    else
    {
        C2xSetTokenInt(packetHandle, "IVIM", newPath, value.streetName.value);
    }
    result = CheckLastError("IVIM", gkFuncRefGet, result);
  }
  else
  {
    if( C2xIsTokenAvailable(packetHandle, "IVIM", newPath) )
    {
      C2xRemoveToken(packetHandle, "IVIM", newPath);
    }
  }

  snprintf(newPath, elcount(newPath), "%s.%s", oldPath, "streetNameText");
  if(value.streetNameText.isValidFlag==1)
  {
    C2xSetTokenData(packetHandle, "IVIM", newPath, value.streetNameText.stringLength, value.streetNameText.string);
    result = CheckLastError("IVIM", gkFuncRefGet, result);
  }
  else
  {
    if( C2xIsTokenAvailable(packetHandle, "IVIM", newPath) )
    {
      C2xRemoveToken(packetHandle, "IVIM", newPath);
    }
  }

  snprintf(newPath, elcount(newPath), "%s.%s", oldPath, "distanceToDivergingPoint");
  if(value.distanceToDivergingPoint.isValidFlag==1)
  {
    SetIVIMDistanceOrDurationParams(packetHandle, value.distanceToDivergingPoint, newPath);
    result = CheckLastError("IVIM", gkFuncRefGet, result);
  }
  else
  {
    if( C2xIsTokenAvailable(packetHandle, "IVIM", newPath) )
    {
      C2xRemoveToken(packetHandle, "IVIM", newPath);
    }
  }

  snprintf(newPath, elcount(newPath), "%s.%s", oldPath, "distanceToDestinationPlace");
  if(value.distanceToDestinationPlace.isValidFlag==1)
  {
    SetIVIMDistanceOrDurationParams(packetHandle, value.distanceToDestinationPlace, newPath);
    result = CheckLastError("IVIM", gkFuncRefGet, result);
  }
  else
  {
    if( C2xIsTokenAvailable(packetHandle, "IVIM", newPath) )
    {
      C2xRemoveToken(packetHandle, "IVIM", newPath);
    }
  }

  return result;
}

int GetIVIMDDD_IO_LISTParams(LONG packetHandle, struct IVIMDDD_IO_LIST value, char oldPath[])
{
  char newPath[300]; 
  int i;
  int result;

  result = 0;

  value.length = C2xGetTokenInt(packetHandle, "IVIM", oldPath);
  if((result = CheckLastError("IVIM", gkFuncRefGet, result))==0)
  {
    for(i=0; i<value.length; i++)
    {
      snprintf(newPath, elcount(newPath), "%s[%d]", oldPath, i);
      GetIVIMDDD_IOParams(packetHandle, value.arrayValue[i], newPath);
      result = CheckLastError("IVIM", gkFuncRefGet, result);
    }
  }
  return result;
}

int SetIVIMDDD_IO_LISTParams(LONG packetHandle, struct IVIMDDD_IO_LIST value, char oldPath[])
{
  char newPath[300]; 
  int i;
  int result;

  result = 0;

  C2xRemoveToken(packetHandle, "IVIM", oldPath);
  for(i=0; i<value.length; i++)
  {
    snprintf(newPath, elcount(newPath), "%s[%d]", oldPath, i);
    SetIVIMDDD_IOParams(packetHandle, value.arrayValue[i], newPath);
    result = CheckLastError("IVIM", gkFuncRefGet, result);
  }
  return result;
}

int GetIVIMISO14823AttributeParams(LONG packetHandle, struct IVIMISO14823Attribute value, char oldPath[])
{
  char newPath[300];
  int result;

  result = 0;

  value.choice = C2xGetTokenInt(packetHandle, "IVIM", oldPath);

  switch(value.choice)
  {
    case 0:
    {
      snprintf(newPath, elcount(newPath), "%s.%s", oldPath, "dtm");
      GetIVIMInternationalSign_applicablePeriodParams(packetHandle, value.dtm, newPath);
      result = CheckLastError("IVIM", gkFuncRefGet, result);
    }
    break;
    case 1:
    {
      snprintf(newPath, elcount(newPath), "%s.%s", oldPath, "edt");
      GetIVIMInternationalSign_applicablePeriodParams(packetHandle, value.edt, newPath);
      result = CheckLastError("IVIM", gkFuncRefGet, result);
    }
    break;
    case 2:
    {
      snprintf(newPath, elcount(newPath), "%s.%s", oldPath, "dfl");
      value.dfl = C2xGetTokenInt(packetHandle, "IVIM", newPath);
      result = CheckLastError("IVIM", gkFuncRefGet, result);
    }
    break;
    case 3:
    {
      snprintf(newPath, elcount(newPath), "%s.%s", oldPath, "ved");
      GetIVIMInternationalSign_applicableVehicleDimensionsParams(packetHandle, value.ved, newPath);
      result = CheckLastError("IVIM", gkFuncRefGet, result);
    }
    break;
    case 4:
    {
      snprintf(newPath, elcount(newPath), "%s.%s", oldPath, "spe");
      GetIVIMInternationalSign_speedLimitsParams(packetHandle, value.spe, newPath);
      result = CheckLastError("IVIM", gkFuncRefGet, result);
    }
    break;
    case 5:
    {
      snprintf(newPath, elcount(newPath), "%s.%s", oldPath, "roi");
      value.roi = C2xGetTokenInt(packetHandle, "IVIM", newPath);
      result = CheckLastError("IVIM", gkFuncRefGet, result);
    }
    break;
    case 6:
    {
      snprintf(newPath, elcount(newPath), "%s.%s", oldPath, "dbv");
      GetIVIMDistanceParams(packetHandle, value.dbv, newPath);
      result = CheckLastError("IVIM", gkFuncRefGet, result);
    }
    break;
    case 7:
    {
      snprintf(newPath, elcount(newPath), "%s.%s", oldPath, "ddd");
      GetIVIMInternationalSign_destinationInformationParams(packetHandle, value.ddd, newPath);
      result = CheckLastError("IVIM", gkFuncRefGet, result);
    }
    break;
  }
  return result;
}

int SetIVIMISO14823AttributeParams(LONG packetHandle, struct IVIMISO14823Attribute value, char oldPath[])
{
  char newPath[300];
  int result;

  result = 0;

  switch(value.choice)
  {
    case 0:
    {
      snprintf(newPath, elcount(newPath), "%s.%s", oldPath, "dtm");
      SetIVIMInternationalSign_applicablePeriodParams(packetHandle, value.dtm, newPath);
      result = CheckLastError("IVIM", gkFuncRefGet, result);
    }
    break;
    case 1:
    {
      snprintf(newPath, elcount(newPath), "%s.%s", oldPath, "edt");
      SetIVIMInternationalSign_applicablePeriodParams(packetHandle, value.edt, newPath);
      result = CheckLastError("IVIM", gkFuncRefGet, result);
    }
    break;
    case 2:
    {
      snprintf(newPath, elcount(newPath), "%s.%s", oldPath, "dfl");
      C2xSetTokenInt(packetHandle, "IVIM", newPath, value.dfl);
      result = CheckLastError("IVIM", gkFuncRefGet, result);
    }
    break;
    case 3:
    {
      snprintf(newPath, elcount(newPath), "%s.%s", oldPath, "ved");
      SetIVIMInternationalSign_applicableVehicleDimensionsParams(packetHandle, value.ved, newPath);
      result = CheckLastError("IVIM", gkFuncRefGet, result);
    }
    break;
    case 4:
    {
      snprintf(newPath, elcount(newPath), "%s.%s", oldPath, "spe");
      SetIVIMInternationalSign_speedLimitsParams(packetHandle, value.spe, newPath);
      result = CheckLastError("IVIM", gkFuncRefGet, result);
    }
    break;
    case 5:
    {
      snprintf(newPath, elcount(newPath), "%s.%s", oldPath, "roi");
      C2xSetTokenInt(packetHandle, "IVIM", newPath, value.roi);
      result = CheckLastError("IVIM", gkFuncRefGet, result);
    }
    break;
    case 6:
    {
      snprintf(newPath, elcount(newPath), "%s.%s", oldPath, "dbv");
      SetIVIMDistanceParams(packetHandle, value.dbv, newPath);
      result = CheckLastError("IVIM", gkFuncRefGet, result);
    }
    break;
    case 7:
    {
      snprintf(newPath, elcount(newPath), "%s.%s", oldPath, "ddd");
      SetIVIMInternationalSign_destinationInformationParams(packetHandle, value.ddd, newPath);
      result = CheckLastError("IVIM", gkFuncRefGet, result);
    }
    break;
  }
  return result;
}

int GetIVIMISO14823AttributesParams(LONG packetHandle, struct IVIMISO14823Attributes value, char oldPath[])
{
  char newPath[300]; 
  int i;
  int result;

  result = 0;

  value.length = C2xGetTokenInt(packetHandle, "IVIM", oldPath);
  if((result = CheckLastError("IVIM", gkFuncRefGet, result))==0)
  {
    for(i=0; i<value.length; i++)
    {
      snprintf(newPath, elcount(newPath), "%s[%d]", oldPath, i);
      GetIVIMISO14823AttributeParams(packetHandle, value.arrayValue[i], newPath);
      result = CheckLastError("IVIM", gkFuncRefGet, result);
    }
  }
  return result;
}

int SetIVIMISO14823AttributesParams(LONG packetHandle, struct IVIMISO14823Attributes value, char oldPath[])
{
  char newPath[300]; 
  int i;
  int result;

  result = 0;

  C2xRemoveToken(packetHandle, "IVIM", oldPath);
  for(i=0; i<value.length; i++)
  {
    snprintf(newPath, elcount(newPath), "%s[%d]", oldPath, i);
    SetIVIMISO14823AttributeParams(packetHandle, value.arrayValue[i], newPath);
    result = CheckLastError("IVIM", gkFuncRefGet, result);
  }
  return result;
}

int GetIVIMISO14823CodeParams(LONG packetHandle, struct IVIMISO14823Code value, char oldPath[])
{
  char newPath[300];
  int result;

  result = 0;

  snprintf(newPath, elcount(newPath), "%s.%s", oldPath, "pictogramCode");
  GetIVIMISO14823Code_pictogramCodeParams(packetHandle, value.pictogramCode, newPath);
  result = CheckLastError("IVIM", gkFuncRefGet, result);

  snprintf(newPath, elcount(newPath), "%s.%s", oldPath, "attributes");
  value.attributes.isValidFlag = C2xIsTokenAvailable(packetHandle, "IVIM", newPath);
  if(value.attributes.isValidFlag==1)
  {
    GetIVIMISO14823AttributesParams(packetHandle, value.attributes, newPath);
    result = CheckLastError("IVIM", gkFuncRefGet, result);
  }
  return result;
}

int SetIVIMISO14823CodeParams(LONG packetHandle, struct IVIMISO14823Code value, char oldPath[])
{
  char newPath[300];
  int result;

  result = 0;

  snprintf(newPath, elcount(newPath), "%s.%s", oldPath, "pictogramCode");
  SetIVIMISO14823Code_pictogramCodeParams(packetHandle, value.pictogramCode, newPath);
  result = CheckLastError("IVIM", gkFuncRefGet, result);

  snprintf(newPath, elcount(newPath), "%s.%s", oldPath, "attributes");
  if(value.attributes.isValidFlag==1)
  {
    SetIVIMISO14823AttributesParams(packetHandle, value.attributes, newPath);
    result = CheckLastError("IVIM", gkFuncRefGet, result);
  }
  else
  {
    if( C2xIsTokenAvailable(packetHandle, "IVIM", newPath) )
    {
      C2xRemoveToken(packetHandle, "IVIM", newPath);
    }
  }

  return result;
}

int GetIVIMAnyCatalogueParams(LONG packetHandle, struct IVIMAnyCatalogue value, char oldPath[])
{
  char newPath[300];
  int result;

  result = 0;

  snprintf(newPath, elcount(newPath), "%s.%s", oldPath, "owner");
  GetIVIMProviderParams(packetHandle, value.owner, newPath);
  result = CheckLastError("IVIM", gkFuncRefGet, result);

  snprintf(newPath, elcount(newPath), "%s.%s", oldPath, "version");
  value.version = C2xGetTokenInt(packetHandle, "IVIM", newPath);
  result = CheckLastError("IVIM", gkFuncRefGet, result);

  snprintf(newPath, elcount(newPath), "%s.%s", oldPath, "pictogramCode");
  value.pictogramCode = C2xGetTokenInt(packetHandle, "IVIM", newPath);
  result = CheckLastError("IVIM", gkFuncRefGet, result);

  snprintf(newPath, elcount(newPath), "%s.%s", oldPath, "value");
  value.value.isValidFlag = C2xIsTokenAvailable(packetHandle, "IVIM", newPath);
  if(value.value.isValidFlag==1)
  {
    value.value.value = C2xGetTokenInt(packetHandle, "IVIM", newPath);
    result = CheckLastError("IVIM", gkFuncRefGet, result);
  }
  snprintf(newPath, elcount(newPath), "%s.%s", oldPath, "unit");
  value.unit.isValidFlag = C2xIsTokenAvailable(packetHandle, "IVIM", newPath);
  if(value.unit.isValidFlag==1)
  {
    value.unit.value = C2xGetTokenInt(packetHandle, "IVIM", newPath);
    result = CheckLastError("IVIM", gkFuncRefGet, result);
  }
  snprintf(newPath, elcount(newPath), "%s.%s", oldPath, "attributes");
  value.attributes.isValidFlag = C2xIsTokenAvailable(packetHandle, "IVIM", newPath);
  if(value.attributes.isValidFlag==1)
  {
    GetIVIMISO14823AttributesParams(packetHandle, value.attributes, newPath);
    result = CheckLastError("IVIM", gkFuncRefGet, result);
  }
  return result;
}

int SetIVIMAnyCatalogueParams(LONG packetHandle, struct IVIMAnyCatalogue value, char oldPath[])
{
  char newPath[300];
  int result;

  result = 0;

  snprintf(newPath, elcount(newPath), "%s.%s", oldPath, "owner");
  SetIVIMProviderParams(packetHandle, value.owner, newPath);
  result = CheckLastError("IVIM", gkFuncRefGet, result);

  snprintf(newPath, elcount(newPath), "%s.%s", oldPath, "version");
  C2xSetTokenInt(packetHandle, "IVIM", newPath, value.version);
  result = CheckLastError("IVIM", gkFuncRefGet, result);

  snprintf(newPath, elcount(newPath), "%s.%s", oldPath, "pictogramCode");
  C2xSetTokenInt(packetHandle, "IVIM", newPath, value.pictogramCode);
  result = CheckLastError("IVIM", gkFuncRefGet, result);

  snprintf(newPath, elcount(newPath), "%s.%s", oldPath, "value");
  if(value.value.isValidFlag==1)
  {
    C2xSetTokenInt(packetHandle, "IVIM", newPath, value.value.value);
    result = CheckLastError("IVIM", gkFuncRefGet, result);
  }
  else
  {
    if( C2xIsTokenAvailable(packetHandle, "IVIM", newPath) )
    {
      C2xRemoveToken(packetHandle, "IVIM", newPath);
    }
  }

  snprintf(newPath, elcount(newPath), "%s.%s", oldPath, "unit");
  if(value.unit.isValidFlag==1)
  {
    C2xSetTokenInt(packetHandle, "IVIM", newPath, value.unit.value);
    result = CheckLastError("IVIM", gkFuncRefGet, result);
  }
  else
  {
    if( C2xIsTokenAvailable(packetHandle, "IVIM", newPath) )
    {
      C2xRemoveToken(packetHandle, "IVIM", newPath);
    }
  }

  snprintf(newPath, elcount(newPath), "%s.%s", oldPath, "attributes");
  if(value.attributes.isValidFlag==1)
  {
    SetIVIMISO14823AttributesParams(packetHandle, value.attributes, newPath);
    result = CheckLastError("IVIM", gkFuncRefGet, result);
  }
  else
  {
    if( C2xIsTokenAvailable(packetHandle, "IVIM", newPath) )
    {
      C2xRemoveToken(packetHandle, "IVIM", newPath);
    }
  }

  return result;
}

int GetIVIMRSCode_codeParams(LONG packetHandle, struct IVIMRSCode_code value, char oldPath[])
{
  char newPath[300];
  int result;

  result = 0;

  value.choice = C2xGetTokenInt(packetHandle, "IVIM", oldPath);

  switch(value.choice)
  {
    case 0:
    {
      snprintf(newPath, elcount(newPath), "%s.%s", oldPath, "viennaConvention");
      GetIVIMVcCodeParams(packetHandle, value.viennaConvention, newPath);
      result = CheckLastError("IVIM", gkFuncRefGet, result);
    }
    break;
    case 1:
    {
      snprintf(newPath, elcount(newPath), "%s.%s", oldPath, "iso14823");
      GetIVIMISO14823CodeParams(packetHandle, value.iso14823, newPath);
      result = CheckLastError("IVIM", gkFuncRefGet, result);
    }
    break;
    case 2:
    {
      snprintf(newPath, elcount(newPath), "%s.%s", oldPath, "itisCodes");
      value.itisCodes = C2xGetTokenInt(packetHandle, "IVIM", newPath);
      result = CheckLastError("IVIM", gkFuncRefGet, result);
    }
    break;
    case 3:
    {
      snprintf(newPath, elcount(newPath), "%s.%s", oldPath, "anyCatalogue");
      GetIVIMAnyCatalogueParams(packetHandle, value.anyCatalogue, newPath);
      result = CheckLastError("IVIM", gkFuncRefGet, result);
    }
    break;
  }
  return result;
}

int SetIVIMRSCode_codeParams(LONG packetHandle, struct IVIMRSCode_code value, char oldPath[])
{
  char newPath[300];
  int result;

  result = 0;

  switch(value.choice)
  {
    case 0:
    {
      snprintf(newPath, elcount(newPath), "%s.%s", oldPath, "viennaConvention");
      SetIVIMVcCodeParams(packetHandle, value.viennaConvention, newPath);
      result = CheckLastError("IVIM", gkFuncRefGet, result);
    }
    break;
    case 1:
    {
      snprintf(newPath, elcount(newPath), "%s.%s", oldPath, "iso14823");
      SetIVIMISO14823CodeParams(packetHandle, value.iso14823, newPath);
      result = CheckLastError("IVIM", gkFuncRefGet, result);
    }
    break;
    case 2:
    {
      snprintf(newPath, elcount(newPath), "%s.%s", oldPath, "itisCodes");
      C2xSetTokenInt(packetHandle, "IVIM", newPath, value.itisCodes);
      result = CheckLastError("IVIM", gkFuncRefGet, result);
    }
    break;
    case 3:
    {
      snprintf(newPath, elcount(newPath), "%s.%s", oldPath, "anyCatalogue");
      SetIVIMAnyCatalogueParams(packetHandle, value.anyCatalogue, newPath);
      result = CheckLastError("IVIM", gkFuncRefGet, result);
    }
    break;
  }
  return result;
}

int GetIVIMRSCodeParams(LONG packetHandle, struct IVIMRSCode value, char oldPath[])
{
  char newPath[300];
  int result;

  result = 0;

  snprintf(newPath, elcount(newPath), "%s.%s", oldPath, "layoutComponentId");
  value.layoutComponentId.isValidFlag = C2xIsTokenAvailable(packetHandle, "IVIM", newPath);
  if(value.layoutComponentId.isValidFlag==1)
  {
    value.layoutComponentId.value = C2xGetTokenInt(packetHandle, "IVIM", newPath);
    result = CheckLastError("IVIM", gkFuncRefGet, result);
  }
  snprintf(newPath, elcount(newPath), "%s.%s", oldPath, "code");
  GetIVIMRSCode_codeParams(packetHandle, value.code, newPath);
  result = CheckLastError("IVIM", gkFuncRefGet, result);

  return result;
}

int SetIVIMRSCodeParams(LONG packetHandle, struct IVIMRSCode value, char oldPath[])
{
  char newPath[300];
  int result;

  result = 0;

  snprintf(newPath, elcount(newPath), "%s.%s", oldPath, "layoutComponentId");
  if(value.layoutComponentId.isValidFlag==1)
  {
    if (value.layoutComponentId.value < 1)
    {
        C2xSetTokenInt(packetHandle, "IVIM", newPath, 1);
    }
    else if (value.layoutComponentId.value > 4)
    {
        C2xSetTokenInt(packetHandle, "IVIM", newPath, 4);
    }
    else
    {
        C2xSetTokenInt(packetHandle, "IVIM", newPath, value.layoutComponentId.value);
    }
    result = CheckLastError("IVIM", gkFuncRefGet, result);
  }
  else
  {
    if( C2xIsTokenAvailable(packetHandle, "IVIM", newPath) )
    {
      C2xRemoveToken(packetHandle, "IVIM", newPath);
    }
  }

  snprintf(newPath, elcount(newPath), "%s.%s", oldPath, "code");
  SetIVIMRSCode_codeParams(packetHandle, value.code, newPath);
  result = CheckLastError("IVIM", gkFuncRefGet, result);

  return result;
}

int GetIVIMRoadSignCodesParams(LONG packetHandle, struct IVIMRoadSignCodes value, char oldPath[])
{
  char newPath[300]; 
  int i;
  int result;

  result = 0;

  value.length = C2xGetTokenInt(packetHandle, "IVIM", oldPath);
  if((result = CheckLastError("IVIM", gkFuncRefGet, result))==0)
  {
    for(i=0; i<value.length; i++)
    {
      snprintf(newPath, elcount(newPath), "%s[%d]", oldPath, i);
      GetIVIMRSCodeParams(packetHandle, value.arrayValue[i], newPath);
      result = CheckLastError("IVIM", gkFuncRefGet, result);
    }
  }
  return result;
}

int SetIVIMRoadSignCodesParams(LONG packetHandle, struct IVIMRoadSignCodes value, char oldPath[])
{
  char newPath[300]; 
  int i;
  int result;

  result = 0;

  C2xRemoveToken(packetHandle, "IVIM", oldPath);
  for(i=0; i<value.length; i++)
  {
    snprintf(newPath, elcount(newPath), "%s[%d]", oldPath, i);
    SetIVIMRSCodeParams(packetHandle, value.arrayValue[i], newPath);
    result = CheckLastError("IVIM", gkFuncRefGet, result);
  }
  return result;
}

int GetIVIMTextParams(LONG packetHandle, struct IVIMText value, char oldPath[])
{
  char newPath[300]; 
  int j; 
  int k;
  int result;

  result = 0;

  snprintf(newPath, elcount(newPath), "%s.%s", oldPath, "layoutComponentId");
  value.layoutComponentId.isValidFlag = C2xIsTokenAvailable(packetHandle, "IVIM", newPath);
  if(value.layoutComponentId.isValidFlag==1)
  {
    value.layoutComponentId.value = C2xGetTokenInt(packetHandle, "IVIM", newPath);
    result = CheckLastError("IVIM", gkFuncRefGet, result);
  }
  snprintf(newPath, elcount(newPath), "%s.%s", oldPath, "language");
  value.language.isValidFlag = 1;
  value.language.stringLength = C2xGetTokenLengthBit(packetHandle, "IVIM", newPath);
  if ((result = CheckLastError("IVIM", gkFuncRefGet, result))==0)
  {
    if(value.language.stringLength > 0)
    {
      for(j=0; j<value.language.stringLength; j++)
      {
        if(C2xGetTokenBitOfBitString(packetHandle, "IVIM", newPath, j) == 0)
        {
          value.language.string[j] = '0';
        }
        else if(C2xGetTokenBitOfBitString(packetHandle, "IVIM", newPath, j) == 1)
        {
          value.language.string[j] = '1';
        }

        if(value.language.stringLength == 1)
        {
          value.language.string[1] = '0';
        }
        result = CheckLastError("IVIM", gkFuncRefGet, result);
      }
    }
    else
    {
      for(k = value.language.stringLength+1; k > -1; k--)
      {
        if(value.language.string[k] == '1')
        {
          value.language.string[k] = '0';
        }
      }
    }
  }

  snprintf(newPath, elcount(newPath), "%s.%s", oldPath, "textContent");
  value.textContent.stringLength = C2xGetTokenData(packetHandle, "IVIM", newPath, elcount(value.textContent.string), value.textContent.string);
  result = CheckLastError("IVIM", gkFuncRefGet, result);
  return result;
}

int SetIVIMTextParams(LONG packetHandle, struct IVIMText value, char oldPath[])
{
  char newPath[300]; 
  int j;
  int result;

  result = 0;

  snprintf(newPath, elcount(newPath), "%s.%s", oldPath, "layoutComponentId");
  if(value.layoutComponentId.isValidFlag==1)
  {
    if (value.layoutComponentId.value < 1)
    {
        C2xSetTokenInt(packetHandle, "IVIM", newPath, 1);
    }
    else if (value.layoutComponentId.value > 4)
    {
        C2xSetTokenInt(packetHandle, "IVIM", newPath, 4);
    }
    else
    {
        C2xSetTokenInt(packetHandle, "IVIM", newPath, value.layoutComponentId.value);
    }
    result = CheckLastError("IVIM", gkFuncRefGet, result);
  }
  else
  {
    if( C2xIsTokenAvailable(packetHandle, "IVIM", newPath) )
    {
      C2xRemoveToken(packetHandle, "IVIM", newPath);
    }
  }

  snprintf(newPath, elcount(newPath), "%s.%s", oldPath, "language");
    for(j=0; j<value.language.stringLength; j++)
    {
      if(value.language.string[j] == '0')
      {
        C2xSetTokenBitOfBitString(packetHandle, "IVIM", newPath, j, 0);
      }
      else
      {
        C2xSetTokenBitOfBitString(packetHandle, "IVIM", newPath, j, 1);
      }
      result = CheckLastError("IVIM", gkFuncRefGet, result);
    }

  snprintf(newPath, elcount(newPath), "%s.%s", oldPath, "textContent");
  C2xSetTokenData(packetHandle, "IVIM", newPath, value.textContent.stringLength, value.textContent.string);
  result = CheckLastError("IVIM", gkFuncRefGet, result);

  return result;
}

int GetIVIMConstraintTextLines1Params(LONG packetHandle, struct IVIMConstraintTextLines1 value, char oldPath[])
{
  char newPath[300]; 
  int i;
  int result;

  result = 0;

  value.length = C2xGetTokenInt(packetHandle, "IVIM", oldPath);
  if((result = CheckLastError("IVIM", gkFuncRefGet, result))==0)
  {
    for(i=0; i<value.length; i++)
    {
      snprintf(newPath, elcount(newPath), "%s[%d]", oldPath, i);
      GetIVIMTextParams(packetHandle, value.arrayValue[i], newPath);
      result = CheckLastError("IVIM", gkFuncRefGet, result);
    }
  }
  return result;
}

int SetIVIMConstraintTextLines1Params(LONG packetHandle, struct IVIMConstraintTextLines1 value, char oldPath[])
{
  char newPath[300]; 
  int i;
  int result;

  result = 0;

  C2xRemoveToken(packetHandle, "IVIM", oldPath);
  for(i=0; i<value.length; i++)
  {
    snprintf(newPath, elcount(newPath), "%s[%d]", oldPath, i);
    SetIVIMTextParams(packetHandle, value.arrayValue[i], newPath);
    result = CheckLastError("IVIM", gkFuncRefGet, result);
  }
  return result;
}

int GetIVIMGicPartParams(LONG packetHandle, struct IVIMGicPart value, char oldPath[])
{
  char newPath[300];
  int result;

  result = 0;

  snprintf(newPath, elcount(newPath), "%s.%s", oldPath, "detectionZoneIds");
  value.detectionZoneIds.isValidFlag = C2xIsTokenAvailable(packetHandle, "IVIM", newPath);
  if(value.detectionZoneIds.isValidFlag==1)
  {
    GetIVIMZoneIdsParams(packetHandle, value.detectionZoneIds, newPath);
    result = CheckLastError("IVIM", gkFuncRefGet, result);
  }
  snprintf(newPath, elcount(newPath), "%s.%s", oldPath, "its_Rrid");
  value.its_Rrid.isValidFlag = C2xIsTokenAvailable(packetHandle, "IVIM", newPath);
  if(value.its_Rrid.isValidFlag==1)
  {
    GetIVIMVarLengthNumberParams(packetHandle, value.its_Rrid, newPath);
    result = CheckLastError("IVIM", gkFuncRefGet, result);
  }
  snprintf(newPath, elcount(newPath), "%s.%s", oldPath, "relevanceZoneIds");
  value.relevanceZoneIds.isValidFlag = C2xIsTokenAvailable(packetHandle, "IVIM", newPath);
  if(value.relevanceZoneIds.isValidFlag==1)
  {
    GetIVIMZoneIdsParams(packetHandle, value.relevanceZoneIds, newPath);
    result = CheckLastError("IVIM", gkFuncRefGet, result);
  }
  snprintf(newPath, elcount(newPath), "%s.%s", oldPath, "direction");
  value.direction.isValidFlag = C2xIsTokenAvailable(packetHandle, "IVIM", newPath);
  if(value.direction.isValidFlag==1)
  {
    value.direction.value = C2xGetTokenInt(packetHandle, "IVIM", newPath);
    result = CheckLastError("IVIM", gkFuncRefGet, result);
  }
  snprintf(newPath, elcount(newPath), "%s.%s", oldPath, "driverAwarenessZoneIds");
  value.driverAwarenessZoneIds.isValidFlag = C2xIsTokenAvailable(packetHandle, "IVIM", newPath);
  if(value.driverAwarenessZoneIds.isValidFlag==1)
  {
    GetIVIMZoneIdsParams(packetHandle, value.driverAwarenessZoneIds, newPath);
    result = CheckLastError("IVIM", gkFuncRefGet, result);
  }
  snprintf(newPath, elcount(newPath), "%s.%s", oldPath, "minimumAwarenessTime");
  value.minimumAwarenessTime.isValidFlag = C2xIsTokenAvailable(packetHandle, "IVIM", newPath);
  if(value.minimumAwarenessTime.isValidFlag==1)
  {
    value.minimumAwarenessTime.value = C2xGetTokenInt(packetHandle, "IVIM", newPath);
    result = CheckLastError("IVIM", gkFuncRefGet, result);
  }
  snprintf(newPath, elcount(newPath), "%s.%s", oldPath, "applicableLanes");
  value.applicableLanes.isValidFlag = C2xIsTokenAvailable(packetHandle, "IVIM", newPath);
  if(value.applicableLanes.isValidFlag==1)
  {
    GetIVIMLanePositionsParams(packetHandle, value.applicableLanes, newPath);
    result = CheckLastError("IVIM", gkFuncRefGet, result);
  }
  snprintf(newPath, elcount(newPath), "%s.%s", oldPath, "iviType");
  value.iviType = C2xGetTokenInt(packetHandle, "IVIM", newPath);
  result = CheckLastError("IVIM", gkFuncRefGet, result);

  snprintf(newPath, elcount(newPath), "%s.%s", oldPath, "iviPurpose");
  value.iviPurpose.isValidFlag = C2xIsTokenAvailable(packetHandle, "IVIM", newPath);
  if(value.iviPurpose.isValidFlag==1)
  {
    value.iviPurpose.value = C2xGetTokenInt(packetHandle, "IVIM", newPath);
    result = CheckLastError("IVIM", gkFuncRefGet, result);
  }
  snprintf(newPath, elcount(newPath), "%s.%s", oldPath, "laneStatus");
  value.laneStatus.isValidFlag = C2xIsTokenAvailable(packetHandle, "IVIM", newPath);
  if(value.laneStatus.isValidFlag==1)
  {
    value.laneStatus.value = C2xGetTokenInt(packetHandle, "IVIM", newPath);
    result = CheckLastError("IVIM", gkFuncRefGet, result);
  }
  snprintf(newPath, elcount(newPath), "%s.%s", oldPath, "vehicleCharacteristics");
  value.vehicleCharacteristics.isValidFlag = C2xIsTokenAvailable(packetHandle, "IVIM", newPath);
  if(value.vehicleCharacteristics.isValidFlag==1)
  {
    GetIVIMVehicleCharacteristicsListParams(packetHandle, value.vehicleCharacteristics, newPath);
    result = CheckLastError("IVIM", gkFuncRefGet, result);
  }
  snprintf(newPath, elcount(newPath), "%s.%s", oldPath, "driverCharacteristics");
  value.driverCharacteristics.isValidFlag = C2xIsTokenAvailable(packetHandle, "IVIM", newPath);
  if(value.driverCharacteristics.isValidFlag==1)
  {
    value.driverCharacteristics.value = C2xGetTokenInt(packetHandle, "IVIM", newPath);
    result = CheckLastError("IVIM", gkFuncRefGet, result);
  }
  snprintf(newPath, elcount(newPath), "%s.%s", oldPath, "layoutId");
  value.layoutId.isValidFlag = C2xIsTokenAvailable(packetHandle, "IVIM", newPath);
  if(value.layoutId.isValidFlag==1)
  {
    value.layoutId.value = C2xGetTokenInt(packetHandle, "IVIM", newPath);
    result = CheckLastError("IVIM", gkFuncRefGet, result);
  }
  snprintf(newPath, elcount(newPath), "%s.%s", oldPath, "preStoredlayoutId");
  value.preStoredlayoutId.isValidFlag = C2xIsTokenAvailable(packetHandle, "IVIM", newPath);
  if(value.preStoredlayoutId.isValidFlag==1)
  {
    value.preStoredlayoutId.value = C2xGetTokenInt(packetHandle, "IVIM", newPath);
    result = CheckLastError("IVIM", gkFuncRefGet, result);
  }
  snprintf(newPath, elcount(newPath), "%s.%s", oldPath, "roadSignCodes");
  GetIVIMRoadSignCodesParams(packetHandle, value.roadSignCodes, newPath);
  result = CheckLastError("IVIM", gkFuncRefGet, result);

  snprintf(newPath, elcount(newPath), "%s.%s", oldPath, "extraText");
  value.extraText.isValidFlag = C2xIsTokenAvailable(packetHandle, "IVIM", newPath);
  if(value.extraText.isValidFlag==1)
  {
    GetIVIMConstraintTextLines1Params(packetHandle, value.extraText, newPath);
    result = CheckLastError("IVIM", gkFuncRefGet, result);
  }
  return result;
}

int SetIVIMGicPartParams(LONG packetHandle, struct IVIMGicPart value, char oldPath[])
{
  char newPath[300];
  int result;

  result = 0;

  snprintf(newPath, elcount(newPath), "%s.%s", oldPath, "detectionZoneIds");
  if(value.detectionZoneIds.isValidFlag==1)
  {
    SetIVIMZoneIdsParams(packetHandle, value.detectionZoneIds, newPath);
    result = CheckLastError("IVIM", gkFuncRefGet, result);
  }
  else
  {
    if( C2xIsTokenAvailable(packetHandle, "IVIM", newPath) )
    {
      C2xRemoveToken(packetHandle, "IVIM", newPath);
    }
  }

  snprintf(newPath, elcount(newPath), "%s.%s", oldPath, "its_Rrid");
  if(value.its_Rrid.isValidFlag==1)
  {
    SetIVIMVarLengthNumberParams(packetHandle, value.its_Rrid, newPath);
    result = CheckLastError("IVIM", gkFuncRefGet, result);
  }
  else
  {
    if( C2xIsTokenAvailable(packetHandle, "IVIM", newPath) )
    {
      C2xRemoveToken(packetHandle, "IVIM", newPath);
    }
  }

  snprintf(newPath, elcount(newPath), "%s.%s", oldPath, "relevanceZoneIds");
  if(value.relevanceZoneIds.isValidFlag==1)
  {
    SetIVIMZoneIdsParams(packetHandle, value.relevanceZoneIds, newPath);
    result = CheckLastError("IVIM", gkFuncRefGet, result);
  }
  else
  {
    if( C2xIsTokenAvailable(packetHandle, "IVIM", newPath) )
    {
      C2xRemoveToken(packetHandle, "IVIM", newPath);
    }
  }

  snprintf(newPath, elcount(newPath), "%s.%s", oldPath, "direction");
  if(value.direction.isValidFlag==1)
  {
    C2xSetTokenInt(packetHandle, "IVIM", newPath, value.direction.value);
    result = CheckLastError("IVIM", gkFuncRefGet, result);
  }
  else
  {
    if( C2xIsTokenAvailable(packetHandle, "IVIM", newPath) )
    {
      C2xRemoveToken(packetHandle, "IVIM", newPath);
    }
  }

  snprintf(newPath, elcount(newPath), "%s.%s", oldPath, "driverAwarenessZoneIds");
  if(value.driverAwarenessZoneIds.isValidFlag==1)
  {
    SetIVIMZoneIdsParams(packetHandle, value.driverAwarenessZoneIds, newPath);
    result = CheckLastError("IVIM", gkFuncRefGet, result);
  }
  else
  {
    if( C2xIsTokenAvailable(packetHandle, "IVIM", newPath) )
    {
      C2xRemoveToken(packetHandle, "IVIM", newPath);
    }
  }

  snprintf(newPath, elcount(newPath), "%s.%s", oldPath, "minimumAwarenessTime");
  if(value.minimumAwarenessTime.isValidFlag==1)
  {
    C2xSetTokenInt(packetHandle, "IVIM", newPath, value.minimumAwarenessTime.value);
    result = CheckLastError("IVIM", gkFuncRefGet, result);
  }
  else
  {
    if( C2xIsTokenAvailable(packetHandle, "IVIM", newPath) )
    {
      C2xRemoveToken(packetHandle, "IVIM", newPath);
    }
  }

  snprintf(newPath, elcount(newPath), "%s.%s", oldPath, "applicableLanes");
  if(value.applicableLanes.isValidFlag==1)
  {
    SetIVIMLanePositionsParams(packetHandle, value.applicableLanes, newPath);
    result = CheckLastError("IVIM", gkFuncRefGet, result);
  }
  else
  {
    if( C2xIsTokenAvailable(packetHandle, "IVIM", newPath) )
    {
      C2xRemoveToken(packetHandle, "IVIM", newPath);
    }
  }

  snprintf(newPath, elcount(newPath), "%s.%s", oldPath, "iviType");
  C2xSetTokenInt(packetHandle, "IVIM", newPath, value.iviType);
  result = CheckLastError("IVIM", gkFuncRefGet, result);

  snprintf(newPath, elcount(newPath), "%s.%s", oldPath, "iviPurpose");
  if(value.iviPurpose.isValidFlag==1)
  {
    C2xSetTokenInt(packetHandle, "IVIM", newPath, value.iviPurpose.value);
    result = CheckLastError("IVIM", gkFuncRefGet, result);
  }
  else
  {
    if( C2xIsTokenAvailable(packetHandle, "IVIM", newPath) )
    {
      C2xRemoveToken(packetHandle, "IVIM", newPath);
    }
  }

  snprintf(newPath, elcount(newPath), "%s.%s", oldPath, "laneStatus");
  if(value.laneStatus.isValidFlag==1)
  {
    C2xSetTokenInt(packetHandle, "IVIM", newPath, value.laneStatus.value);
    result = CheckLastError("IVIM", gkFuncRefGet, result);
  }
  else
  {
    if( C2xIsTokenAvailable(packetHandle, "IVIM", newPath) )
    {
      C2xRemoveToken(packetHandle, "IVIM", newPath);
    }
  }

  snprintf(newPath, elcount(newPath), "%s.%s", oldPath, "vehicleCharacteristics");
  if(value.vehicleCharacteristics.isValidFlag==1)
  {
    SetIVIMVehicleCharacteristicsListParams(packetHandle, value.vehicleCharacteristics, newPath);
    result = CheckLastError("IVIM", gkFuncRefGet, result);
  }
  else
  {
    if( C2xIsTokenAvailable(packetHandle, "IVIM", newPath) )
    {
      C2xRemoveToken(packetHandle, "IVIM", newPath);
    }
  }

  snprintf(newPath, elcount(newPath), "%s.%s", oldPath, "driverCharacteristics");
  if(value.driverCharacteristics.isValidFlag==1)
  {
    C2xSetTokenInt(packetHandle, "IVIM", newPath, value.driverCharacteristics.value);
    result = CheckLastError("IVIM", gkFuncRefGet, result);
  }
  else
  {
    if( C2xIsTokenAvailable(packetHandle, "IVIM", newPath) )
    {
      C2xRemoveToken(packetHandle, "IVIM", newPath);
    }
  }

  snprintf(newPath, elcount(newPath), "%s.%s", oldPath, "layoutId");
  if(value.layoutId.isValidFlag==1)
  {
    if (value.layoutId.value < 1)
    {
        C2xSetTokenInt(packetHandle, "IVIM", newPath, 1);
    }
    else if (value.layoutId.value > 4)
    {
        C2xSetTokenInt(packetHandle, "IVIM", newPath, 4);
    }
    else
    {
        C2xSetTokenInt(packetHandle, "IVIM", newPath, value.layoutId.value);
    }
    result = CheckLastError("IVIM", gkFuncRefGet, result);
  }
  else
  {
    if( C2xIsTokenAvailable(packetHandle, "IVIM", newPath) )
    {
      C2xRemoveToken(packetHandle, "IVIM", newPath);
    }
  }

  snprintf(newPath, elcount(newPath), "%s.%s", oldPath, "preStoredlayoutId");
  if(value.preStoredlayoutId.isValidFlag==1)
  {
    if (value.preStoredlayoutId.value < 1)
    {
        C2xSetTokenInt(packetHandle, "IVIM", newPath, 1);
    }
    else if (value.preStoredlayoutId.value > 64)
    {
        C2xSetTokenInt(packetHandle, "IVIM", newPath, 64);
    }
    else
    {
        C2xSetTokenInt(packetHandle, "IVIM", newPath, value.preStoredlayoutId.value);
    }
    result = CheckLastError("IVIM", gkFuncRefGet, result);
  }
  else
  {
    if( C2xIsTokenAvailable(packetHandle, "IVIM", newPath) )
    {
      C2xRemoveToken(packetHandle, "IVIM", newPath);
    }
  }

  snprintf(newPath, elcount(newPath), "%s.%s", oldPath, "roadSignCodes");
  SetIVIMRoadSignCodesParams(packetHandle, value.roadSignCodes, newPath);
  result = CheckLastError("IVIM", gkFuncRefGet, result);

  snprintf(newPath, elcount(newPath), "%s.%s", oldPath, "extraText");
  if(value.extraText.isValidFlag==1)
  {
    SetIVIMConstraintTextLines1Params(packetHandle, value.extraText, newPath);
    result = CheckLastError("IVIM", gkFuncRefGet, result);
  }
  else
  {
    if( C2xIsTokenAvailable(packetHandle, "IVIM", newPath) )
    {
      C2xRemoveToken(packetHandle, "IVIM", newPath);
    }
  }

  return result;
}

int GetIVIMGeneralIviContainerParams(LONG packetHandle, struct IVIMGeneralIviContainer value, char oldPath[])
{
  char newPath[300]; 
  int i;
  int result;

  result = 0;

  value.length = C2xGetTokenInt(packetHandle, "IVIM", oldPath);
  if((result = CheckLastError("IVIM", gkFuncRefGet, result))==0)
  {
    for(i=0; i<value.length; i++)
    {
      snprintf(newPath, elcount(newPath), "%s[%d]", oldPath, i);
      GetIVIMGicPartParams(packetHandle, value.arrayValue[i], newPath);
      result = CheckLastError("IVIM", gkFuncRefGet, result);
    }
  }
  return result;
}

int SetIVIMGeneralIviContainerParams(LONG packetHandle, struct IVIMGeneralIviContainer value, char oldPath[])
{
  char newPath[300]; 
  int i;
  int result;

  result = 0;

  C2xRemoveToken(packetHandle, "IVIM", oldPath);
  for(i=0; i<value.length; i++)
  {
    snprintf(newPath, elcount(newPath), "%s[%d]", oldPath, i);
    SetIVIMGicPartParams(packetHandle, value.arrayValue[i], newPath);
    result = CheckLastError("IVIM", gkFuncRefGet, result);
  }
  return result;
}

int GetIVIMLaneCharacteristicsParams(LONG packetHandle, struct IVIMLaneCharacteristics value, char oldPath[])
{
  char newPath[300];
  int result;

  result = 0;

  snprintf(newPath, elcount(newPath), "%s.%s", oldPath, "zoneDefinitionAccuracy");
  value.zoneDefinitionAccuracy = C2xGetTokenInt(packetHandle, "IVIM", newPath);
  result = CheckLastError("IVIM", gkFuncRefGet, result);

  snprintf(newPath, elcount(newPath), "%s.%s", oldPath, "existinglaneMarkingStatus");
  value.existinglaneMarkingStatus = C2xGetTokenInt64(packetHandle, "IVIM", newPath);
  result = CheckLastError("IVIM", gkFuncRefGet, result);

  snprintf(newPath, elcount(newPath), "%s.%s", oldPath, "newlaneMarkingColour");
  value.newlaneMarkingColour = C2xGetTokenInt(packetHandle, "IVIM", newPath);
  result = CheckLastError("IVIM", gkFuncRefGet, result);

  snprintf(newPath, elcount(newPath), "%s.%s", oldPath, "laneDelimitationLeft");
  value.laneDelimitationLeft = C2xGetTokenInt(packetHandle, "IVIM", newPath);
  result = CheckLastError("IVIM", gkFuncRefGet, result);

  snprintf(newPath, elcount(newPath), "%s.%s", oldPath, "laneDelimitationRight");
  value.laneDelimitationRight = C2xGetTokenInt(packetHandle, "IVIM", newPath);
  result = CheckLastError("IVIM", gkFuncRefGet, result);

  snprintf(newPath, elcount(newPath), "%s.%s", oldPath, "mergingWith");
  value.mergingWith = C2xGetTokenInt(packetHandle, "IVIM", newPath);
  result = CheckLastError("IVIM", gkFuncRefGet, result);

  return result;
}

int SetIVIMLaneCharacteristicsParams(LONG packetHandle, struct IVIMLaneCharacteristics value, char oldPath[])
{
  char newPath[300];
  int result;

  result = 0;

  snprintf(newPath, elcount(newPath), "%s.%s", oldPath, "zoneDefinitionAccuracy");
  C2xSetTokenInt(packetHandle, "IVIM", newPath, value.zoneDefinitionAccuracy);
  result = CheckLastError("IVIM", gkFuncRefGet, result);

  snprintf(newPath, elcount(newPath), "%s.%s", oldPath, "existinglaneMarkingStatus");
  C2xSetTokenInt64(packetHandle, "IVIM", newPath, value.existinglaneMarkingStatus);
  result = CheckLastError("IVIM", gkFuncRefGet, result);

  snprintf(newPath, elcount(newPath), "%s.%s", oldPath, "newlaneMarkingColour");
  C2xSetTokenInt(packetHandle, "IVIM", newPath, value.newlaneMarkingColour);
  result = CheckLastError("IVIM", gkFuncRefGet, result);

  snprintf(newPath, elcount(newPath), "%s.%s", oldPath, "laneDelimitationLeft");
  C2xSetTokenInt(packetHandle, "IVIM", newPath, value.laneDelimitationLeft);
  result = CheckLastError("IVIM", gkFuncRefGet, result);

  snprintf(newPath, elcount(newPath), "%s.%s", oldPath, "laneDelimitationRight");
  C2xSetTokenInt(packetHandle, "IVIM", newPath, value.laneDelimitationRight);
  result = CheckLastError("IVIM", gkFuncRefGet, result);

  snprintf(newPath, elcount(newPath), "%s.%s", oldPath, "mergingWith");
  if (value.mergingWith < 1)
  {
    C2xSetTokenInt(packetHandle, "IVIM", newPath, 1);
  }
  else if (value.mergingWith > 32)
  {
    C2xSetTokenInt(packetHandle, "IVIM", newPath, 32);
  }
  else
  {
    C2xSetTokenInt(packetHandle, "IVIM", newPath, value.mergingWith);
  }
  result = CheckLastError("IVIM", gkFuncRefGet, result);

  return result;
}

int GetIVIMRoadSurfaceStaticCharacteristicsParams(LONG packetHandle, struct IVIMRoadSurfaceStaticCharacteristics value, char oldPath[])
{
  char newPath[300];
  int result;

  result = 0;

  snprintf(newPath, elcount(newPath), "%s.%s", oldPath, "frictionCoefficient");
  value.frictionCoefficient = C2xGetTokenInt(packetHandle, "IVIM", newPath);
  result = CheckLastError("IVIM", gkFuncRefGet, result);

  snprintf(newPath, elcount(newPath), "%s.%s", oldPath, "material");
  value.material = C2xGetTokenInt(packetHandle, "IVIM", newPath);
  result = CheckLastError("IVIM", gkFuncRefGet, result);

  snprintf(newPath, elcount(newPath), "%s.%s", oldPath, "wear");
  value.wear = C2xGetTokenInt(packetHandle, "IVIM", newPath);
  result = CheckLastError("IVIM", gkFuncRefGet, result);

  snprintf(newPath, elcount(newPath), "%s.%s", oldPath, "avBankingAngle");
  value.avBankingAngle = C2xGetTokenInt(packetHandle, "IVIM", newPath);
  result = CheckLastError("IVIM", gkFuncRefGet, result);

  return result;
}

int SetIVIMRoadSurfaceStaticCharacteristicsParams(LONG packetHandle, struct IVIMRoadSurfaceStaticCharacteristics value, char oldPath[])
{
  char newPath[300];
  int result;

  result = 0;

  snprintf(newPath, elcount(newPath), "%s.%s", oldPath, "frictionCoefficient");
  C2xSetTokenInt(packetHandle, "IVIM", newPath, value.frictionCoefficient);
  result = CheckLastError("IVIM", gkFuncRefGet, result);

  snprintf(newPath, elcount(newPath), "%s.%s", oldPath, "material");
  C2xSetTokenInt(packetHandle, "IVIM", newPath, value.material);
  result = CheckLastError("IVIM", gkFuncRefGet, result);

  snprintf(newPath, elcount(newPath), "%s.%s", oldPath, "wear");
  C2xSetTokenInt(packetHandle, "IVIM", newPath, value.wear);
  result = CheckLastError("IVIM", gkFuncRefGet, result);

  snprintf(newPath, elcount(newPath), "%s.%s", oldPath, "avBankingAngle");
  C2xSetTokenInt(packetHandle, "IVIM", newPath, value.avBankingAngle);
  result = CheckLastError("IVIM", gkFuncRefGet, result);

  return result;
}

int GetIVIMRoadSurfaceDynamicCharacteristicsParams(LONG packetHandle, struct IVIMRoadSurfaceDynamicCharacteristics value, char oldPath[])
{
  char newPath[300];
  int result;

  result = 0;

  snprintf(newPath, elcount(newPath), "%s.%s", oldPath, "condition");
  value.condition = C2xGetTokenInt(packetHandle, "IVIM", newPath);
  result = CheckLastError("IVIM", gkFuncRefGet, result);

  snprintf(newPath, elcount(newPath), "%s.%s", oldPath, "temperature");
  value.temperature = C2xGetTokenInt(packetHandle, "IVIM", newPath);
  result = CheckLastError("IVIM", gkFuncRefGet, result);

  snprintf(newPath, elcount(newPath), "%s.%s", oldPath, "iceOrWaterDepth");
  value.iceOrWaterDepth = C2xGetTokenInt(packetHandle, "IVIM", newPath);
  result = CheckLastError("IVIM", gkFuncRefGet, result);

  snprintf(newPath, elcount(newPath), "%s.%s", oldPath, "treatment");
  value.treatment = C2xGetTokenInt(packetHandle, "IVIM", newPath);
  result = CheckLastError("IVIM", gkFuncRefGet, result);

  return result;
}

int SetIVIMRoadSurfaceDynamicCharacteristicsParams(LONG packetHandle, struct IVIMRoadSurfaceDynamicCharacteristics value, char oldPath[])
{
  char newPath[300];
  int result;

  result = 0;

  snprintf(newPath, elcount(newPath), "%s.%s", oldPath, "condition");
  C2xSetTokenInt(packetHandle, "IVIM", newPath, value.condition);
  result = CheckLastError("IVIM", gkFuncRefGet, result);

  snprintf(newPath, elcount(newPath), "%s.%s", oldPath, "temperature");
  C2xSetTokenInt(packetHandle, "IVIM", newPath, value.temperature);
  result = CheckLastError("IVIM", gkFuncRefGet, result);

  snprintf(newPath, elcount(newPath), "%s.%s", oldPath, "iceOrWaterDepth");
  C2xSetTokenInt(packetHandle, "IVIM", newPath, value.iceOrWaterDepth);
  result = CheckLastError("IVIM", gkFuncRefGet, result);

  snprintf(newPath, elcount(newPath), "%s.%s", oldPath, "treatment");
  C2xSetTokenInt(packetHandle, "IVIM", newPath, value.treatment);
  result = CheckLastError("IVIM", gkFuncRefGet, result);

  return result;
}

int GetIVIMLaneInformationParams(LONG packetHandle, struct IVIMLaneInformation value, char oldPath[])
{
  char newPath[300];
  int result;

  result = 0;

  snprintf(newPath, elcount(newPath), "%s.%s", oldPath, "laneNumber");
  value.laneNumber = C2xGetTokenInt(packetHandle, "IVIM", newPath);
  result = CheckLastError("IVIM", gkFuncRefGet, result);

  snprintf(newPath, elcount(newPath), "%s.%s", oldPath, "direction");
  value.direction = C2xGetTokenInt(packetHandle, "IVIM", newPath);
  result = CheckLastError("IVIM", gkFuncRefGet, result);

  snprintf(newPath, elcount(newPath), "%s.%s", oldPath, "validity");
  value.validity.isValidFlag = C2xIsTokenAvailable(packetHandle, "IVIM", newPath);
  if(value.validity.isValidFlag==1)
  {
    GetIVIMInternationalSign_applicablePeriodParams(packetHandle, value.validity, newPath);
    result = CheckLastError("IVIM", gkFuncRefGet, result);
  }
  snprintf(newPath, elcount(newPath), "%s.%s", oldPath, "laneType");
  value.laneType = C2xGetTokenInt(packetHandle, "IVIM", newPath);
  result = CheckLastError("IVIM", gkFuncRefGet, result);

  snprintf(newPath, elcount(newPath), "%s.%s", oldPath, "laneTypeQualifier");
  value.laneTypeQualifier.isValidFlag = C2xIsTokenAvailable(packetHandle, "IVIM", newPath);
  if(value.laneTypeQualifier.isValidFlag==1)
  {
    GetIVIMCompleteVehicleCharacteristicsParams(packetHandle, value.laneTypeQualifier, newPath);
    result = CheckLastError("IVIM", gkFuncRefGet, result);
  }
  snprintf(newPath, elcount(newPath), "%s.%s", oldPath, "laneStatus");
  value.laneStatus = C2xGetTokenInt(packetHandle, "IVIM", newPath);
  result = CheckLastError("IVIM", gkFuncRefGet, result);

  snprintf(newPath, elcount(newPath), "%s.%s", oldPath, "laneWidth");
  value.laneWidth.isValidFlag = C2xIsTokenAvailable(packetHandle, "IVIM", newPath);
  if(value.laneWidth.isValidFlag==1)
  {
    value.laneWidth.value = C2xGetTokenInt(packetHandle, "IVIM", newPath);
    result = CheckLastError("IVIM", gkFuncRefGet, result);
  }
  snprintf(newPath, elcount(newPath), "%s.%s", oldPath, "detectionZoneIds");
  value.detectionZoneIds.isValidFlag = C2xIsTokenAvailable(packetHandle, "IVIM", newPath);
  if(value.detectionZoneIds.isValidFlag==1)
  {
    GetIVIMZoneIdsParams(packetHandle, value.detectionZoneIds, newPath);
    result = CheckLastError("IVIM", gkFuncRefGet, result);
  }
  snprintf(newPath, elcount(newPath), "%s.%s", oldPath, "relevanceZoneIds");
  value.relevanceZoneIds.isValidFlag = C2xIsTokenAvailable(packetHandle, "IVIM", newPath);
  if(value.relevanceZoneIds.isValidFlag==1)
  {
    GetIVIMZoneIdsParams(packetHandle, value.relevanceZoneIds, newPath);
    result = CheckLastError("IVIM", gkFuncRefGet, result);
  }
  snprintf(newPath, elcount(newPath), "%s.%s", oldPath, "laneCharacteristics");
  value.laneCharacteristics.isValidFlag = C2xIsTokenAvailable(packetHandle, "IVIM", newPath);
  if(value.laneCharacteristics.isValidFlag==1)
  {
    GetIVIMLaneCharacteristicsParams(packetHandle, value.laneCharacteristics, newPath);
    result = CheckLastError("IVIM", gkFuncRefGet, result);
  }
  snprintf(newPath, elcount(newPath), "%s.%s", oldPath, "laneSurfaceStaticCharacteristics");
  value.laneSurfaceStaticCharacteristics.isValidFlag = C2xIsTokenAvailable(packetHandle, "IVIM", newPath);
  if(value.laneSurfaceStaticCharacteristics.isValidFlag==1)
  {
    GetIVIMRoadSurfaceStaticCharacteristicsParams(packetHandle, value.laneSurfaceStaticCharacteristics, newPath);
    result = CheckLastError("IVIM", gkFuncRefGet, result);
  }
  snprintf(newPath, elcount(newPath), "%s.%s", oldPath, "laneSurfaceDynamicCharacteristics");
  value.laneSurfaceDynamicCharacteristics.isValidFlag = C2xIsTokenAvailable(packetHandle, "IVIM", newPath);
  if(value.laneSurfaceDynamicCharacteristics.isValidFlag==1)
  {
    GetIVIMRoadSurfaceDynamicCharacteristicsParams(packetHandle, value.laneSurfaceDynamicCharacteristics, newPath);
    result = CheckLastError("IVIM", gkFuncRefGet, result);
  }
  return result;
}

int SetIVIMLaneInformationParams(LONG packetHandle, struct IVIMLaneInformation value, char oldPath[])
{
  char newPath[300];
  int result;

  result = 0;

  snprintf(newPath, elcount(newPath), "%s.%s", oldPath, "laneNumber");
  C2xSetTokenInt(packetHandle, "IVIM", newPath, value.laneNumber);
  result = CheckLastError("IVIM", gkFuncRefGet, result);

  snprintf(newPath, elcount(newPath), "%s.%s", oldPath, "direction");
  C2xSetTokenInt(packetHandle, "IVIM", newPath, value.direction);
  result = CheckLastError("IVIM", gkFuncRefGet, result);

  snprintf(newPath, elcount(newPath), "%s.%s", oldPath, "validity");
  if(value.validity.isValidFlag==1)
  {
    SetIVIMInternationalSign_applicablePeriodParams(packetHandle, value.validity, newPath);
    result = CheckLastError("IVIM", gkFuncRefGet, result);
  }
  else
  {
    if( C2xIsTokenAvailable(packetHandle, "IVIM", newPath) )
    {
      C2xRemoveToken(packetHandle, "IVIM", newPath);
    }
  }

  snprintf(newPath, elcount(newPath), "%s.%s", oldPath, "laneType");
  C2xSetTokenInt(packetHandle, "IVIM", newPath, value.laneType);
  result = CheckLastError("IVIM", gkFuncRefGet, result);

  snprintf(newPath, elcount(newPath), "%s.%s", oldPath, "laneTypeQualifier");
  if(value.laneTypeQualifier.isValidFlag==1)
  {
    SetIVIMCompleteVehicleCharacteristicsParams(packetHandle, value.laneTypeQualifier, newPath);
    result = CheckLastError("IVIM", gkFuncRefGet, result);
  }
  else
  {
    if( C2xIsTokenAvailable(packetHandle, "IVIM", newPath) )
    {
      C2xRemoveToken(packetHandle, "IVIM", newPath);
    }
  }

  snprintf(newPath, elcount(newPath), "%s.%s", oldPath, "laneStatus");
  C2xSetTokenInt(packetHandle, "IVIM", newPath, value.laneStatus);
  result = CheckLastError("IVIM", gkFuncRefGet, result);

  snprintf(newPath, elcount(newPath), "%s.%s", oldPath, "laneWidth");
  if(value.laneWidth.isValidFlag==1)
  {
    C2xSetTokenInt(packetHandle, "IVIM", newPath, value.laneWidth.value);
    result = CheckLastError("IVIM", gkFuncRefGet, result);
  }
  else
  {
    if( C2xIsTokenAvailable(packetHandle, "IVIM", newPath) )
    {
      C2xRemoveToken(packetHandle, "IVIM", newPath);
    }
  }

  snprintf(newPath, elcount(newPath), "%s.%s", oldPath, "detectionZoneIds");
  if(value.detectionZoneIds.isValidFlag==1)
  {
    SetIVIMZoneIdsParams(packetHandle, value.detectionZoneIds, newPath);
    result = CheckLastError("IVIM", gkFuncRefGet, result);
  }
  else
  {
    if( C2xIsTokenAvailable(packetHandle, "IVIM", newPath) )
    {
      C2xRemoveToken(packetHandle, "IVIM", newPath);
    }
  }

  snprintf(newPath, elcount(newPath), "%s.%s", oldPath, "relevanceZoneIds");
  if(value.relevanceZoneIds.isValidFlag==1)
  {
    SetIVIMZoneIdsParams(packetHandle, value.relevanceZoneIds, newPath);
    result = CheckLastError("IVIM", gkFuncRefGet, result);
  }
  else
  {
    if( C2xIsTokenAvailable(packetHandle, "IVIM", newPath) )
    {
      C2xRemoveToken(packetHandle, "IVIM", newPath);
    }
  }

  snprintf(newPath, elcount(newPath), "%s.%s", oldPath, "laneCharacteristics");
  if(value.laneCharacteristics.isValidFlag==1)
  {
    SetIVIMLaneCharacteristicsParams(packetHandle, value.laneCharacteristics, newPath);
    result = CheckLastError("IVIM", gkFuncRefGet, result);
  }
  else
  {
    if( C2xIsTokenAvailable(packetHandle, "IVIM", newPath) )
    {
      C2xRemoveToken(packetHandle, "IVIM", newPath);
    }
  }

  snprintf(newPath, elcount(newPath), "%s.%s", oldPath, "laneSurfaceStaticCharacteristics");
  if(value.laneSurfaceStaticCharacteristics.isValidFlag==1)
  {
    SetIVIMRoadSurfaceStaticCharacteristicsParams(packetHandle, value.laneSurfaceStaticCharacteristics, newPath);
    result = CheckLastError("IVIM", gkFuncRefGet, result);
  }
  else
  {
    if( C2xIsTokenAvailable(packetHandle, "IVIM", newPath) )
    {
      C2xRemoveToken(packetHandle, "IVIM", newPath);
    }
  }

  snprintf(newPath, elcount(newPath), "%s.%s", oldPath, "laneSurfaceDynamicCharacteristics");
  if(value.laneSurfaceDynamicCharacteristics.isValidFlag==1)
  {
    SetIVIMRoadSurfaceDynamicCharacteristicsParams(packetHandle, value.laneSurfaceDynamicCharacteristics, newPath);
    result = CheckLastError("IVIM", gkFuncRefGet, result);
  }
  else
  {
    if( C2xIsTokenAvailable(packetHandle, "IVIM", newPath) )
    {
      C2xRemoveToken(packetHandle, "IVIM", newPath);
    }
  }

  return result;
}

int GetIVIMLaneConfigurationParams(LONG packetHandle, struct IVIMLaneConfiguration value, char oldPath[])
{
  char newPath[300]; 
  int i;
  int result;

  result = 0;

  value.length = C2xGetTokenInt(packetHandle, "IVIM", oldPath);
  if((result = CheckLastError("IVIM", gkFuncRefGet, result))==0)
  {
    for(i=0; i<value.length; i++)
    {
      snprintf(newPath, elcount(newPath), "%s[%d]", oldPath, i);
      GetIVIMLaneInformationParams(packetHandle, value.arrayValue[i], newPath);
      result = CheckLastError("IVIM", gkFuncRefGet, result);
    }
  }
  return result;
}

int SetIVIMLaneConfigurationParams(LONG packetHandle, struct IVIMLaneConfiguration value, char oldPath[])
{
  char newPath[300]; 
  int i;
  int result;

  result = 0;

  C2xRemoveToken(packetHandle, "IVIM", oldPath);
  for(i=0; i<value.length; i++)
  {
    snprintf(newPath, elcount(newPath), "%s[%d]", oldPath, i);
    SetIVIMLaneInformationParams(packetHandle, value.arrayValue[i], newPath);
    result = CheckLastError("IVIM", gkFuncRefGet, result);
  }
  return result;
}

int GetIVIMRccPartParams(LONG packetHandle, struct IVIMRccPart value, char oldPath[])
{
  char newPath[300];
  int result;

  result = 0;

  snprintf(newPath, elcount(newPath), "%s.%s", oldPath, "relevanceZoneIds");
  GetIVIMZoneIdsParams(packetHandle, value.relevanceZoneIds, newPath);
  result = CheckLastError("IVIM", gkFuncRefGet, result);

  snprintf(newPath, elcount(newPath), "%s.%s", oldPath, "roadType");
  value.roadType = C2xGetTokenInt(packetHandle, "IVIM", newPath);
  result = CheckLastError("IVIM", gkFuncRefGet, result);

  snprintf(newPath, elcount(newPath), "%s.%s", oldPath, "laneConfiguration");
  GetIVIMLaneConfigurationParams(packetHandle, value.laneConfiguration, newPath);
  result = CheckLastError("IVIM", gkFuncRefGet, result);

  return result;
}

int SetIVIMRccPartParams(LONG packetHandle, struct IVIMRccPart value, char oldPath[])
{
  char newPath[300];
  int result;

  result = 0;

  snprintf(newPath, elcount(newPath), "%s.%s", oldPath, "relevanceZoneIds");
  SetIVIMZoneIdsParams(packetHandle, value.relevanceZoneIds, newPath);
  result = CheckLastError("IVIM", gkFuncRefGet, result);

  snprintf(newPath, elcount(newPath), "%s.%s", oldPath, "roadType");
  C2xSetTokenInt(packetHandle, "IVIM", newPath, value.roadType);
  result = CheckLastError("IVIM", gkFuncRefGet, result);

  snprintf(newPath, elcount(newPath), "%s.%s", oldPath, "laneConfiguration");
  SetIVIMLaneConfigurationParams(packetHandle, value.laneConfiguration, newPath);
  result = CheckLastError("IVIM", gkFuncRefGet, result);

  return result;
}

int GetIVIMRoadConfigurationContainerParams(LONG packetHandle, struct IVIMRoadConfigurationContainer value, char oldPath[])
{
  char newPath[300]; 
  int i;
  int result;

  result = 0;

  value.length = C2xGetTokenInt(packetHandle, "IVIM", oldPath);
  if((result = CheckLastError("IVIM", gkFuncRefGet, result))==0)
  {
    for(i=0; i<value.length; i++)
    {
      snprintf(newPath, elcount(newPath), "%s[%d]", oldPath, i);
      GetIVIMRccPartParams(packetHandle, value.arrayValue[i], newPath);
      result = CheckLastError("IVIM", gkFuncRefGet, result);
    }
  }
  return result;
}

int SetIVIMRoadConfigurationContainerParams(LONG packetHandle, struct IVIMRoadConfigurationContainer value, char oldPath[])
{
  char newPath[300]; 
  int i;
  int result;

  result = 0;

  C2xRemoveToken(packetHandle, "IVIM", oldPath);
  for(i=0; i<value.length; i++)
  {
    snprintf(newPath, elcount(newPath), "%s[%d]", oldPath, i);
    SetIVIMRccPartParams(packetHandle, value.arrayValue[i], newPath);
    result = CheckLastError("IVIM", gkFuncRefGet, result);
  }
  return result;
}

int GetIVIMTextLinesParams(LONG packetHandle, struct IVIMTextLines value, char oldPath[])
{
  char newPath[300]; 
  int i;
  int result;

  result = 0;

  value.length = C2xGetTokenInt(packetHandle, "IVIM", oldPath);
  if((result = CheckLastError("IVIM", gkFuncRefGet, result))==0)
  {
    for(i=0; i<value.length; i++)
    {
      snprintf(newPath, elcount(newPath), "%s[%d]", oldPath, i);
      GetIVIMTextParams(packetHandle, value.arrayValue[i], newPath);
      result = CheckLastError("IVIM", gkFuncRefGet, result);
    }
  }
  return result;
}

int SetIVIMTextLinesParams(LONG packetHandle, struct IVIMTextLines value, char oldPath[])
{
  char newPath[300]; 
  int i;
  int result;

  result = 0;

  C2xRemoveToken(packetHandle, "IVIM", oldPath);
  for(i=0; i<value.length; i++)
  {
    snprintf(newPath, elcount(newPath), "%s[%d]", oldPath, i);
    SetIVIMTextParams(packetHandle, value.arrayValue[i], newPath);
    result = CheckLastError("IVIM", gkFuncRefGet, result);
  }
  return result;
}

int GetIVIMTcPartParams(LONG packetHandle, struct IVIMTcPart value, char oldPath[])
{
  char newPath[300];
  int result;

  result = 0;

  snprintf(newPath, elcount(newPath), "%s.%s", oldPath, "detectionZoneIds");
  value.detectionZoneIds.isValidFlag = C2xIsTokenAvailable(packetHandle, "IVIM", newPath);
  if(value.detectionZoneIds.isValidFlag==1)
  {
    GetIVIMZoneIdsParams(packetHandle, value.detectionZoneIds, newPath);
    result = CheckLastError("IVIM", gkFuncRefGet, result);
  }
  snprintf(newPath, elcount(newPath), "%s.%s", oldPath, "relevanceZoneIds");
  GetIVIMZoneIdsParams(packetHandle, value.relevanceZoneIds, newPath);
  result = CheckLastError("IVIM", gkFuncRefGet, result);

  snprintf(newPath, elcount(newPath), "%s.%s", oldPath, "direction");
  value.direction.isValidFlag = C2xIsTokenAvailable(packetHandle, "IVIM", newPath);
  if(value.direction.isValidFlag==1)
  {
    value.direction.value = C2xGetTokenInt(packetHandle, "IVIM", newPath);
    result = CheckLastError("IVIM", gkFuncRefGet, result);
  }
  snprintf(newPath, elcount(newPath), "%s.%s", oldPath, "driverAwarenessZoneIds");
  value.driverAwarenessZoneIds.isValidFlag = C2xIsTokenAvailable(packetHandle, "IVIM", newPath);
  if(value.driverAwarenessZoneIds.isValidFlag==1)
  {
    GetIVIMZoneIdsParams(packetHandle, value.driverAwarenessZoneIds, newPath);
    result = CheckLastError("IVIM", gkFuncRefGet, result);
  }
  snprintf(newPath, elcount(newPath), "%s.%s", oldPath, "minimumAwarenessTime");
  value.minimumAwarenessTime.isValidFlag = C2xIsTokenAvailable(packetHandle, "IVIM", newPath);
  if(value.minimumAwarenessTime.isValidFlag==1)
  {
    value.minimumAwarenessTime.value = C2xGetTokenInt(packetHandle, "IVIM", newPath);
    result = CheckLastError("IVIM", gkFuncRefGet, result);
  }
  snprintf(newPath, elcount(newPath), "%s.%s", oldPath, "applicableLanes");
  value.applicableLanes.isValidFlag = C2xIsTokenAvailable(packetHandle, "IVIM", newPath);
  if(value.applicableLanes.isValidFlag==1)
  {
    GetIVIMLanePositionsParams(packetHandle, value.applicableLanes, newPath);
    result = CheckLastError("IVIM", gkFuncRefGet, result);
  }
  snprintf(newPath, elcount(newPath), "%s.%s", oldPath, "layoutId");
  value.layoutId.isValidFlag = C2xIsTokenAvailable(packetHandle, "IVIM", newPath);
  if(value.layoutId.isValidFlag==1)
  {
    value.layoutId.value = C2xGetTokenInt(packetHandle, "IVIM", newPath);
    result = CheckLastError("IVIM", gkFuncRefGet, result);
  }
  snprintf(newPath, elcount(newPath), "%s.%s", oldPath, "preStoredlayoutId");
  value.preStoredlayoutId.isValidFlag = C2xIsTokenAvailable(packetHandle, "IVIM", newPath);
  if(value.preStoredlayoutId.isValidFlag==1)
  {
    value.preStoredlayoutId.value = C2xGetTokenInt(packetHandle, "IVIM", newPath);
    result = CheckLastError("IVIM", gkFuncRefGet, result);
  }
  snprintf(newPath, elcount(newPath), "%s.%s", oldPath, "text");
  value.text.isValidFlag = C2xIsTokenAvailable(packetHandle, "IVIM", newPath);
  if(value.text.isValidFlag==1)
  {
    GetIVIMTextLinesParams(packetHandle, value.text, newPath);
    result = CheckLastError("IVIM", gkFuncRefGet, result);
  }
  snprintf(newPath, elcount(newPath), "%s.%s", oldPath, "data");
  value.data.stringLength = C2xGetTokenData(packetHandle, "IVIM", newPath, elcount(value.data.string), value.data.string);
  snprintf(newPath, elcount(newPath), "%s.%s", oldPath, "iviType");
  value.iviType = C2xGetTokenInt(packetHandle, "IVIM", newPath);
  result = CheckLastError("IVIM", gkFuncRefGet, result);

  snprintf(newPath, elcount(newPath), "%s.%s", oldPath, "laneStatus");
  value.laneStatus.isValidFlag = C2xIsTokenAvailable(packetHandle, "IVIM", newPath);
  if(value.laneStatus.isValidFlag==1)
  {
    value.laneStatus.value = C2xGetTokenInt(packetHandle, "IVIM", newPath);
    result = CheckLastError("IVIM", gkFuncRefGet, result);
  }
  snprintf(newPath, elcount(newPath), "%s.%s", oldPath, "vehicleCharacteristics");
  value.vehicleCharacteristics.isValidFlag = C2xIsTokenAvailable(packetHandle, "IVIM", newPath);
  if(value.vehicleCharacteristics.isValidFlag==1)
  {
    GetIVIMVehicleCharacteristicsListParams(packetHandle, value.vehicleCharacteristics, newPath);
    result = CheckLastError("IVIM", gkFuncRefGet, result);
  }
  return result;
}

int SetIVIMTcPartParams(LONG packetHandle, struct IVIMTcPart value, char oldPath[])
{
  char newPath[300];
  int result;

  result = 0;

  snprintf(newPath, elcount(newPath), "%s.%s", oldPath, "detectionZoneIds");
  if(value.detectionZoneIds.isValidFlag==1)
  {
    SetIVIMZoneIdsParams(packetHandle, value.detectionZoneIds, newPath);
    result = CheckLastError("IVIM", gkFuncRefGet, result);
  }
  else
  {
    if( C2xIsTokenAvailable(packetHandle, "IVIM", newPath) )
    {
      C2xRemoveToken(packetHandle, "IVIM", newPath);
    }
  }

  snprintf(newPath, elcount(newPath), "%s.%s", oldPath, "relevanceZoneIds");
  SetIVIMZoneIdsParams(packetHandle, value.relevanceZoneIds, newPath);
  result = CheckLastError("IVIM", gkFuncRefGet, result);

  snprintf(newPath, elcount(newPath), "%s.%s", oldPath, "direction");
  if(value.direction.isValidFlag==1)
  {
    C2xSetTokenInt(packetHandle, "IVIM", newPath, value.direction.value);
    result = CheckLastError("IVIM", gkFuncRefGet, result);
  }
  else
  {
    if( C2xIsTokenAvailable(packetHandle, "IVIM", newPath) )
    {
      C2xRemoveToken(packetHandle, "IVIM", newPath);
    }
  }

  snprintf(newPath, elcount(newPath), "%s.%s", oldPath, "driverAwarenessZoneIds");
  if(value.driverAwarenessZoneIds.isValidFlag==1)
  {
    SetIVIMZoneIdsParams(packetHandle, value.driverAwarenessZoneIds, newPath);
    result = CheckLastError("IVIM", gkFuncRefGet, result);
  }
  else
  {
    if( C2xIsTokenAvailable(packetHandle, "IVIM", newPath) )
    {
      C2xRemoveToken(packetHandle, "IVIM", newPath);
    }
  }

  snprintf(newPath, elcount(newPath), "%s.%s", oldPath, "minimumAwarenessTime");
  if(value.minimumAwarenessTime.isValidFlag==1)
  {
    C2xSetTokenInt(packetHandle, "IVIM", newPath, value.minimumAwarenessTime.value);
    result = CheckLastError("IVIM", gkFuncRefGet, result);
  }
  else
  {
    if( C2xIsTokenAvailable(packetHandle, "IVIM", newPath) )
    {
      C2xRemoveToken(packetHandle, "IVIM", newPath);
    }
  }

  snprintf(newPath, elcount(newPath), "%s.%s", oldPath, "applicableLanes");
  if(value.applicableLanes.isValidFlag==1)
  {
    SetIVIMLanePositionsParams(packetHandle, value.applicableLanes, newPath);
    result = CheckLastError("IVIM", gkFuncRefGet, result);
  }
  else
  {
    if( C2xIsTokenAvailable(packetHandle, "IVIM", newPath) )
    {
      C2xRemoveToken(packetHandle, "IVIM", newPath);
    }
  }

  snprintf(newPath, elcount(newPath), "%s.%s", oldPath, "layoutId");
  if(value.layoutId.isValidFlag==1)
  {
    if (value.layoutId.value < 1)
    {
        C2xSetTokenInt(packetHandle, "IVIM", newPath, 1);
    }
    else if (value.layoutId.value > 4)
    {
        C2xSetTokenInt(packetHandle, "IVIM", newPath, 4);
    }
    else
    {
        C2xSetTokenInt(packetHandle, "IVIM", newPath, value.layoutId.value);
    }
    result = CheckLastError("IVIM", gkFuncRefGet, result);
  }
  else
  {
    if( C2xIsTokenAvailable(packetHandle, "IVIM", newPath) )
    {
      C2xRemoveToken(packetHandle, "IVIM", newPath);
    }
  }

  snprintf(newPath, elcount(newPath), "%s.%s", oldPath, "preStoredlayoutId");
  if(value.preStoredlayoutId.isValidFlag==1)
  {
    if (value.preStoredlayoutId.value < 1)
    {
        C2xSetTokenInt(packetHandle, "IVIM", newPath, 1);
    }
    else if (value.preStoredlayoutId.value > 64)
    {
        C2xSetTokenInt(packetHandle, "IVIM", newPath, 64);
    }
    else
    {
        C2xSetTokenInt(packetHandle, "IVIM", newPath, value.preStoredlayoutId.value);
    }
    result = CheckLastError("IVIM", gkFuncRefGet, result);
  }
  else
  {
    if( C2xIsTokenAvailable(packetHandle, "IVIM", newPath) )
    {
      C2xRemoveToken(packetHandle, "IVIM", newPath);
    }
  }

  snprintf(newPath, elcount(newPath), "%s.%s", oldPath, "text");
  if(value.text.isValidFlag==1)
  {
    SetIVIMTextLinesParams(packetHandle, value.text, newPath);
    result = CheckLastError("IVIM", gkFuncRefGet, result);
  }
  else
  {
    if( C2xIsTokenAvailable(packetHandle, "IVIM", newPath) )
    {
      C2xRemoveToken(packetHandle, "IVIM", newPath);
    }
  }

  snprintf(newPath, elcount(newPath), "%s.%s", oldPath, "data");
  C2xSetTokenData(packetHandle, "IVIM", newPath, value.data.stringLength, value.data.string);

  snprintf(newPath, elcount(newPath), "%s.%s", oldPath, "iviType");
  C2xSetTokenInt(packetHandle, "IVIM", newPath, value.iviType);
  result = CheckLastError("IVIM", gkFuncRefGet, result);

  snprintf(newPath, elcount(newPath), "%s.%s", oldPath, "laneStatus");
  if(value.laneStatus.isValidFlag==1)
  {
    C2xSetTokenInt(packetHandle, "IVIM", newPath, value.laneStatus.value);
    result = CheckLastError("IVIM", gkFuncRefGet, result);
  }
  else
  {
    if( C2xIsTokenAvailable(packetHandle, "IVIM", newPath) )
    {
      C2xRemoveToken(packetHandle, "IVIM", newPath);
    }
  }

  snprintf(newPath, elcount(newPath), "%s.%s", oldPath, "vehicleCharacteristics");
  if(value.vehicleCharacteristics.isValidFlag==1)
  {
    SetIVIMVehicleCharacteristicsListParams(packetHandle, value.vehicleCharacteristics, newPath);
    result = CheckLastError("IVIM", gkFuncRefGet, result);
  }
  else
  {
    if( C2xIsTokenAvailable(packetHandle, "IVIM", newPath) )
    {
      C2xRemoveToken(packetHandle, "IVIM", newPath);
    }
  }

  return result;
}

int GetIVIMTextContainerParams(LONG packetHandle, struct IVIMTextContainer value, char oldPath[])
{
  char newPath[300]; 
  int i;
  int result;

  result = 0;

  value.length = C2xGetTokenInt(packetHandle, "IVIM", oldPath);
  if((result = CheckLastError("IVIM", gkFuncRefGet, result))==0)
  {
    for(i=0; i<value.length; i++)
    {
      snprintf(newPath, elcount(newPath), "%s[%d]", oldPath, i);
      GetIVIMTcPartParams(packetHandle, value.arrayValue[i], newPath);
      result = CheckLastError("IVIM", gkFuncRefGet, result);
    }
  }
  return result;
}

int SetIVIMTextContainerParams(LONG packetHandle, struct IVIMTextContainer value, char oldPath[])
{
  char newPath[300]; 
  int i;
  int result;

  result = 0;

  C2xRemoveToken(packetHandle, "IVIM", oldPath);
  for(i=0; i<value.length; i++)
  {
    snprintf(newPath, elcount(newPath), "%s[%d]", oldPath, i);
    SetIVIMTcPartParams(packetHandle, value.arrayValue[i], newPath);
    result = CheckLastError("IVIM", gkFuncRefGet, result);
  }
  return result;
}

int GetIVIMLayoutComponentParams(LONG packetHandle, struct IVIMLayoutComponent value, char oldPath[])
{
  char newPath[300];
  int result;

  result = 0;

  snprintf(newPath, elcount(newPath), "%s.%s", oldPath, "layoutComponentId");
  value.layoutComponentId = C2xGetTokenInt(packetHandle, "IVIM", newPath);
  result = CheckLastError("IVIM", gkFuncRefGet, result);

  snprintf(newPath, elcount(newPath), "%s.%s", oldPath, "height");
  value.height = C2xGetTokenInt(packetHandle, "IVIM", newPath);
  result = CheckLastError("IVIM", gkFuncRefGet, result);

  snprintf(newPath, elcount(newPath), "%s.%s", oldPath, "width");
  value.width = C2xGetTokenInt(packetHandle, "IVIM", newPath);
  result = CheckLastError("IVIM", gkFuncRefGet, result);

  snprintf(newPath, elcount(newPath), "%s.%s", oldPath, "x");
  value.x = C2xGetTokenInt(packetHandle, "IVIM", newPath);
  result = CheckLastError("IVIM", gkFuncRefGet, result);

  snprintf(newPath, elcount(newPath), "%s.%s", oldPath, "y");
  value.y = C2xGetTokenInt(packetHandle, "IVIM", newPath);
  result = CheckLastError("IVIM", gkFuncRefGet, result);

  snprintf(newPath, elcount(newPath), "%s.%s", oldPath, "textScripting");
  value.textScripting = C2xGetTokenInt(packetHandle, "IVIM", newPath);
  result = CheckLastError("IVIM", gkFuncRefGet, result);

  return result;
}

int SetIVIMLayoutComponentParams(LONG packetHandle, struct IVIMLayoutComponent value, char oldPath[])
{
  char newPath[300];
  int result;

  result = 0;

  snprintf(newPath, elcount(newPath), "%s.%s", oldPath, "layoutComponentId");
  if (value.layoutComponentId < 1)
  {
    C2xSetTokenInt(packetHandle, "IVIM", newPath, 1);
  }
  else if (value.layoutComponentId > 8)
  {
    C2xSetTokenInt(packetHandle, "IVIM", newPath, 8);
  }
  else
  {
    C2xSetTokenInt(packetHandle, "IVIM", newPath, value.layoutComponentId);
  }
  result = CheckLastError("IVIM", gkFuncRefGet, result);

  snprintf(newPath, elcount(newPath), "%s.%s", oldPath, "height");
  if (value.height < 10)
  {
    C2xSetTokenInt(packetHandle, "IVIM", newPath, 10);
  }
  else if (value.height > 73)
  {
    C2xSetTokenInt(packetHandle, "IVIM", newPath, 73);
  }
  else
  {
    C2xSetTokenInt(packetHandle, "IVIM", newPath, value.height);
  }
  result = CheckLastError("IVIM", gkFuncRefGet, result);

  snprintf(newPath, elcount(newPath), "%s.%s", oldPath, "width");
  if (value.width < 10)
  {
    C2xSetTokenInt(packetHandle, "IVIM", newPath, 10);
  }
  else if (value.width > 265)
  {
    C2xSetTokenInt(packetHandle, "IVIM", newPath, 265);
  }
  else
  {
    C2xSetTokenInt(packetHandle, "IVIM", newPath, value.width);
  }
  result = CheckLastError("IVIM", gkFuncRefGet, result);

  snprintf(newPath, elcount(newPath), "%s.%s", oldPath, "x");
  if (value.x < 10)
  {
    C2xSetTokenInt(packetHandle, "IVIM", newPath, 10);
  }
  else if (value.x > 265)
  {
    C2xSetTokenInt(packetHandle, "IVIM", newPath, 265);
  }
  else
  {
    C2xSetTokenInt(packetHandle, "IVIM", newPath, value.x);
  }
  result = CheckLastError("IVIM", gkFuncRefGet, result);

  snprintf(newPath, elcount(newPath), "%s.%s", oldPath, "y");
  if (value.y < 10)
  {
    C2xSetTokenInt(packetHandle, "IVIM", newPath, 10);
  }
  else if (value.y > 73)
  {
    C2xSetTokenInt(packetHandle, "IVIM", newPath, 73);
  }
  else
  {
    C2xSetTokenInt(packetHandle, "IVIM", newPath, value.y);
  }
  result = CheckLastError("IVIM", gkFuncRefGet, result);

  snprintf(newPath, elcount(newPath), "%s.%s", oldPath, "textScripting");
  C2xSetTokenInt(packetHandle, "IVIM", newPath, value.textScripting);
  result = CheckLastError("IVIM", gkFuncRefGet, result);

  return result;
}

int GetIVIMLayoutComponentsParams(LONG packetHandle, struct IVIMLayoutComponents value, char oldPath[])
{
  char newPath[300]; 
  int i;
  int result;

  result = 0;

  value.length = C2xGetTokenInt(packetHandle, "IVIM", oldPath);
  if((result = CheckLastError("IVIM", gkFuncRefGet, result))==0)
  {
    for(i=0; i<value.length; i++)
    {
      snprintf(newPath, elcount(newPath), "%s[%d]", oldPath, i);
      GetIVIMLayoutComponentParams(packetHandle, value.arrayValue[i], newPath);
      result = CheckLastError("IVIM", gkFuncRefGet, result);
    }
  }
  return result;
}

int SetIVIMLayoutComponentsParams(LONG packetHandle, struct IVIMLayoutComponents value, char oldPath[])
{
  char newPath[300]; 
  int i;
  int result;

  result = 0;

  C2xRemoveToken(packetHandle, "IVIM", oldPath);
  for(i=0; i<value.length; i++)
  {
    snprintf(newPath, elcount(newPath), "%s[%d]", oldPath, i);
    SetIVIMLayoutComponentParams(packetHandle, value.arrayValue[i], newPath);
    result = CheckLastError("IVIM", gkFuncRefGet, result);
  }
  return result;
}

int GetIVIMLayoutContainerParams(LONG packetHandle, struct IVIMLayoutContainer value, char oldPath[])
{
  char newPath[300];
  int result;

  result = 0;

  snprintf(newPath, elcount(newPath), "%s.%s", oldPath, "layoutId");
  value.layoutId = C2xGetTokenInt(packetHandle, "IVIM", newPath);
  result = CheckLastError("IVIM", gkFuncRefGet, result);

  snprintf(newPath, elcount(newPath), "%s.%s", oldPath, "height");
  value.height.isValidFlag = C2xIsTokenAvailable(packetHandle, "IVIM", newPath);
  if(value.height.isValidFlag==1)
  {
    value.height.value = C2xGetTokenInt(packetHandle, "IVIM", newPath);
    result = CheckLastError("IVIM", gkFuncRefGet, result);
  }
  snprintf(newPath, elcount(newPath), "%s.%s", oldPath, "width");
  value.width.isValidFlag = C2xIsTokenAvailable(packetHandle, "IVIM", newPath);
  if(value.width.isValidFlag==1)
  {
    value.width.value = C2xGetTokenInt(packetHandle, "IVIM", newPath);
    result = CheckLastError("IVIM", gkFuncRefGet, result);
  }
  snprintf(newPath, elcount(newPath), "%s.%s", oldPath, "layoutComponents");
  GetIVIMLayoutComponentsParams(packetHandle, value.layoutComponents, newPath);
  result = CheckLastError("IVIM", gkFuncRefGet, result);

  return result;
}

int SetIVIMLayoutContainerParams(LONG packetHandle, struct IVIMLayoutContainer value, char oldPath[])
{
  char newPath[300];
  int result;

  result = 0;

  snprintf(newPath, elcount(newPath), "%s.%s", oldPath, "layoutId");
  if (value.layoutId < 1)
  {
    C2xSetTokenInt(packetHandle, "IVIM", newPath, 1);
  }
  else if (value.layoutId > 4)
  {
    C2xSetTokenInt(packetHandle, "IVIM", newPath, 4);
  }
  else
  {
    C2xSetTokenInt(packetHandle, "IVIM", newPath, value.layoutId);
  }
  result = CheckLastError("IVIM", gkFuncRefGet, result);

  snprintf(newPath, elcount(newPath), "%s.%s", oldPath, "height");
  if(value.height.isValidFlag==1)
  {
    if (value.height.value < 10)
    {
        C2xSetTokenInt(packetHandle, "IVIM", newPath, 10);
    }
    else if (value.height.value > 73)
    {
        C2xSetTokenInt(packetHandle, "IVIM", newPath, 73);
    }
    else
    {
        C2xSetTokenInt(packetHandle, "IVIM", newPath, value.height.value);
    }
    result = CheckLastError("IVIM", gkFuncRefGet, result);
  }
  else
  {
    if( C2xIsTokenAvailable(packetHandle, "IVIM", newPath) )
    {
      C2xRemoveToken(packetHandle, "IVIM", newPath);
    }
  }

  snprintf(newPath, elcount(newPath), "%s.%s", oldPath, "width");
  if(value.width.isValidFlag==1)
  {
    if (value.width.value < 10)
    {
        C2xSetTokenInt(packetHandle, "IVIM", newPath, 10);
    }
    else if (value.width.value > 265)
    {
        C2xSetTokenInt(packetHandle, "IVIM", newPath, 265);
    }
    else
    {
        C2xSetTokenInt(packetHandle, "IVIM", newPath, value.width.value);
    }
    result = CheckLastError("IVIM", gkFuncRefGet, result);
  }
  else
  {
    if( C2xIsTokenAvailable(packetHandle, "IVIM", newPath) )
    {
      C2xRemoveToken(packetHandle, "IVIM", newPath);
    }
  }

  snprintf(newPath, elcount(newPath), "%s.%s", oldPath, "layoutComponents");
  SetIVIMLayoutComponentsParams(packetHandle, value.layoutComponents, newPath);
  result = CheckLastError("IVIM", gkFuncRefGet, result);

  return result;
}

int GetIVIMSaeAutomationLevelsParams(LONG packetHandle, struct IVIMSaeAutomationLevels value, char oldPath[])
{
  char newPath[300]; 
  int i;
  int result;

  result = 0;

  value.length = C2xGetTokenInt(packetHandle, "IVIM", oldPath);
  if((result = CheckLastError("IVIM", gkFuncRefGet, result))==0)
  {
    for(i=0; i<value.length; i++)
    {
      snprintf(newPath, elcount(newPath), "%s[%d]", oldPath, i);
      value.arrayValue[i] = C2xGetTokenInt64(packetHandle, "IVIM", newPath);
      result = CheckLastError("IVIM", gkFuncRefGet, result);
    }
  }
  return result;
}

int SetIVIMSaeAutomationLevelsParams(LONG packetHandle, struct IVIMSaeAutomationLevels value, char oldPath[])
{
  char newPath[300]; 
  int i;
  int result;

  result = 0;

  C2xRemoveToken(packetHandle, "IVIM", oldPath);
  for(i=0; i<value.length; i++)
  {
    snprintf(newPath, elcount(newPath), "%s[%d]", oldPath, i);
    C2xSetTokenInt64(packetHandle, "IVIM", newPath, value.arrayValue[i]);
    result = CheckLastError("IVIM", gkFuncRefGet, result);
  }
  return result;
}

int GetIVIMConstraintTextLines2Params(LONG packetHandle, struct IVIMConstraintTextLines2 value, char oldPath[])
{
  char newPath[300]; 
  int i;
  int result;

  result = 0;

  value.length = C2xGetTokenInt(packetHandle, "IVIM", oldPath);
  if((result = CheckLastError("IVIM", gkFuncRefGet, result))==0)
  {
    for(i=0; i<value.length; i++)
    {
      snprintf(newPath, elcount(newPath), "%s[%d]", oldPath, i);
      GetIVIMTextParams(packetHandle, value.arrayValue[i], newPath);
      result = CheckLastError("IVIM", gkFuncRefGet, result);
    }
  }
  return result;
}

int SetIVIMConstraintTextLines2Params(LONG packetHandle, struct IVIMConstraintTextLines2 value, char oldPath[])
{
  char newPath[300]; 
  int i;
  int result;

  result = 0;

  C2xRemoveToken(packetHandle, "IVIM", oldPath);
  for(i=0; i<value.length; i++)
  {
    snprintf(newPath, elcount(newPath), "%s[%d]", oldPath, i);
    SetIVIMTextParams(packetHandle, value.arrayValue[i], newPath);
    result = CheckLastError("IVIM", gkFuncRefGet, result);
  }
  return result;
}

int GetIVIMAutomatedVehicleRuleParams(LONG packetHandle, struct IVIMAutomatedVehicleRule value, char oldPath[])
{
  char newPath[300];
  int result;

  result = 0;

  snprintf(newPath, elcount(newPath), "%s.%s", oldPath, "priority");
  value.priority = C2xGetTokenInt(packetHandle, "IVIM", newPath);
  result = CheckLastError("IVIM", gkFuncRefGet, result);

  snprintf(newPath, elcount(newPath), "%s.%s", oldPath, "allowedSaeAutomationLevels");
  GetIVIMSaeAutomationLevelsParams(packetHandle, value.allowedSaeAutomationLevels, newPath);
  result = CheckLastError("IVIM", gkFuncRefGet, result);

  snprintf(newPath, elcount(newPath), "%s.%s", oldPath, "minGapBetweenVehicles");
  value.minGapBetweenVehicles.isValidFlag = C2xIsTokenAvailable(packetHandle, "IVIM", newPath);
  if(value.minGapBetweenVehicles.isValidFlag==1)
  {
    value.minGapBetweenVehicles.value = C2xGetTokenInt(packetHandle, "IVIM", newPath);
    result = CheckLastError("IVIM", gkFuncRefGet, result);
  }
  snprintf(newPath, elcount(newPath), "%s.%s", oldPath, "recGapBetweenVehicles");
  value.recGapBetweenVehicles.isValidFlag = C2xIsTokenAvailable(packetHandle, "IVIM", newPath);
  if(value.recGapBetweenVehicles.isValidFlag==1)
  {
    value.recGapBetweenVehicles.value = C2xGetTokenInt(packetHandle, "IVIM", newPath);
    result = CheckLastError("IVIM", gkFuncRefGet, result);
  }
  snprintf(newPath, elcount(newPath), "%s.%s", oldPath, "automatedVehicleMaxSpeedLimit");
  value.automatedVehicleMaxSpeedLimit.isValidFlag = C2xIsTokenAvailable(packetHandle, "IVIM", newPath);
  if(value.automatedVehicleMaxSpeedLimit.isValidFlag==1)
  {
    value.automatedVehicleMaxSpeedLimit.value = C2xGetTokenInt(packetHandle, "IVIM", newPath);
    result = CheckLastError("IVIM", gkFuncRefGet, result);
  }
  snprintf(newPath, elcount(newPath), "%s.%s", oldPath, "automatedVehicleMinSpeedLimit");
  value.automatedVehicleMinSpeedLimit.isValidFlag = C2xIsTokenAvailable(packetHandle, "IVIM", newPath);
  if(value.automatedVehicleMinSpeedLimit.isValidFlag==1)
  {
    value.automatedVehicleMinSpeedLimit.value = C2xGetTokenInt(packetHandle, "IVIM", newPath);
    result = CheckLastError("IVIM", gkFuncRefGet, result);
  }
  snprintf(newPath, elcount(newPath), "%s.%s", oldPath, "automatedVehicleSpeedRecommendation");
  value.automatedVehicleSpeedRecommendation.isValidFlag = C2xIsTokenAvailable(packetHandle, "IVIM", newPath);
  if(value.automatedVehicleSpeedRecommendation.isValidFlag==1)
  {
    value.automatedVehicleSpeedRecommendation.value = C2xGetTokenInt(packetHandle, "IVIM", newPath);
    result = CheckLastError("IVIM", gkFuncRefGet, result);
  }
  snprintf(newPath, elcount(newPath), "%s.%s", oldPath, "roadSignCodes");
  value.roadSignCodes.isValidFlag = C2xIsTokenAvailable(packetHandle, "IVIM", newPath);
  if(value.roadSignCodes.isValidFlag==1)
  {
    GetIVIMRoadSignCodesParams(packetHandle, value.roadSignCodes, newPath);
    result = CheckLastError("IVIM", gkFuncRefGet, result);
  }
  snprintf(newPath, elcount(newPath), "%s.%s", oldPath, "extraText");
  value.extraText.isValidFlag = C2xIsTokenAvailable(packetHandle, "IVIM", newPath);
  if(value.extraText.isValidFlag==1)
  {
    GetIVIMConstraintTextLines2Params(packetHandle, value.extraText, newPath);
    result = CheckLastError("IVIM", gkFuncRefGet, result);
  }
  return result;
}

int SetIVIMAutomatedVehicleRuleParams(LONG packetHandle, struct IVIMAutomatedVehicleRule value, char oldPath[])
{
  char newPath[300];
  int result;

  result = 0;

  snprintf(newPath, elcount(newPath), "%s.%s", oldPath, "priority");
  C2xSetTokenInt(packetHandle, "IVIM", newPath, value.priority);
  result = CheckLastError("IVIM", gkFuncRefGet, result);

  snprintf(newPath, elcount(newPath), "%s.%s", oldPath, "allowedSaeAutomationLevels");
  SetIVIMSaeAutomationLevelsParams(packetHandle, value.allowedSaeAutomationLevels, newPath);
  result = CheckLastError("IVIM", gkFuncRefGet, result);

  snprintf(newPath, elcount(newPath), "%s.%s", oldPath, "minGapBetweenVehicles");
  if(value.minGapBetweenVehicles.isValidFlag==1)
  {
    C2xSetTokenInt(packetHandle, "IVIM", newPath, value.minGapBetweenVehicles.value);
    result = CheckLastError("IVIM", gkFuncRefGet, result);
  }
  else
  {
    if( C2xIsTokenAvailable(packetHandle, "IVIM", newPath) )
    {
      C2xRemoveToken(packetHandle, "IVIM", newPath);
    }
  }

  snprintf(newPath, elcount(newPath), "%s.%s", oldPath, "recGapBetweenVehicles");
  if(value.recGapBetweenVehicles.isValidFlag==1)
  {
    C2xSetTokenInt(packetHandle, "IVIM", newPath, value.recGapBetweenVehicles.value);
    result = CheckLastError("IVIM", gkFuncRefGet, result);
  }
  else
  {
    if( C2xIsTokenAvailable(packetHandle, "IVIM", newPath) )
    {
      C2xRemoveToken(packetHandle, "IVIM", newPath);
    }
  }

  snprintf(newPath, elcount(newPath), "%s.%s", oldPath, "automatedVehicleMaxSpeedLimit");
  if(value.automatedVehicleMaxSpeedLimit.isValidFlag==1)
  {
    C2xSetTokenInt(packetHandle, "IVIM", newPath, value.automatedVehicleMaxSpeedLimit.value);
    result = CheckLastError("IVIM", gkFuncRefGet, result);
  }
  else
  {
    if( C2xIsTokenAvailable(packetHandle, "IVIM", newPath) )
    {
      C2xRemoveToken(packetHandle, "IVIM", newPath);
    }
  }

  snprintf(newPath, elcount(newPath), "%s.%s", oldPath, "automatedVehicleMinSpeedLimit");
  if(value.automatedVehicleMinSpeedLimit.isValidFlag==1)
  {
    C2xSetTokenInt(packetHandle, "IVIM", newPath, value.automatedVehicleMinSpeedLimit.value);
    result = CheckLastError("IVIM", gkFuncRefGet, result);
  }
  else
  {
    if( C2xIsTokenAvailable(packetHandle, "IVIM", newPath) )
    {
      C2xRemoveToken(packetHandle, "IVIM", newPath);
    }
  }

  snprintf(newPath, elcount(newPath), "%s.%s", oldPath, "automatedVehicleSpeedRecommendation");
  if(value.automatedVehicleSpeedRecommendation.isValidFlag==1)
  {
    C2xSetTokenInt(packetHandle, "IVIM", newPath, value.automatedVehicleSpeedRecommendation.value);
    result = CheckLastError("IVIM", gkFuncRefGet, result);
  }
  else
  {
    if( C2xIsTokenAvailable(packetHandle, "IVIM", newPath) )
    {
      C2xRemoveToken(packetHandle, "IVIM", newPath);
    }
  }

  snprintf(newPath, elcount(newPath), "%s.%s", oldPath, "roadSignCodes");
  if(value.roadSignCodes.isValidFlag==1)
  {
    SetIVIMRoadSignCodesParams(packetHandle, value.roadSignCodes, newPath);
    result = CheckLastError("IVIM", gkFuncRefGet, result);
  }
  else
  {
    if( C2xIsTokenAvailable(packetHandle, "IVIM", newPath) )
    {
      C2xRemoveToken(packetHandle, "IVIM", newPath);
    }
  }

  snprintf(newPath, elcount(newPath), "%s.%s", oldPath, "extraText");
  if(value.extraText.isValidFlag==1)
  {
    SetIVIMConstraintTextLines2Params(packetHandle, value.extraText, newPath);
    result = CheckLastError("IVIM", gkFuncRefGet, result);
  }
  else
  {
    if( C2xIsTokenAvailable(packetHandle, "IVIM", newPath) )
    {
      C2xRemoveToken(packetHandle, "IVIM", newPath);
    }
  }

  return result;
}

int GetIVIMAutomatedVehicleRulesParams(LONG packetHandle, struct IVIMAutomatedVehicleRules value, char oldPath[])
{
  char newPath[300]; 
  int i;
  int result;

  result = 0;

  value.length = C2xGetTokenInt(packetHandle, "IVIM", oldPath);
  if((result = CheckLastError("IVIM", gkFuncRefGet, result))==0)
  {
    for(i=0; i<value.length; i++)
    {
      snprintf(newPath, elcount(newPath), "%s[%d]", oldPath, i);
      GetIVIMAutomatedVehicleRuleParams(packetHandle, value.arrayValue[i], newPath);
      result = CheckLastError("IVIM", gkFuncRefGet, result);
    }
  }
  return result;
}

int SetIVIMAutomatedVehicleRulesParams(LONG packetHandle, struct IVIMAutomatedVehicleRules value, char oldPath[])
{
  char newPath[300]; 
  int i;
  int result;

  result = 0;

  C2xRemoveToken(packetHandle, "IVIM", oldPath);
  for(i=0; i<value.length; i++)
  {
    snprintf(newPath, elcount(newPath), "%s[%d]", oldPath, i);
    SetIVIMAutomatedVehicleRuleParams(packetHandle, value.arrayValue[i], newPath);
    result = CheckLastError("IVIM", gkFuncRefGet, result);
  }
  return result;
}

int GetIVIMPlatooningRuleParams(LONG packetHandle, struct IVIMPlatooningRule value, char oldPath[])
{
  char newPath[300];
  int result;

  result = 0;

  snprintf(newPath, elcount(newPath), "%s.%s", oldPath, "priority");
  value.priority = C2xGetTokenInt(packetHandle, "IVIM", newPath);
  result = CheckLastError("IVIM", gkFuncRefGet, result);

  snprintf(newPath, elcount(newPath), "%s.%s", oldPath, "allowedSaeAutomationLevels");
  GetIVIMSaeAutomationLevelsParams(packetHandle, value.allowedSaeAutomationLevels, newPath);
  result = CheckLastError("IVIM", gkFuncRefGet, result);

  snprintf(newPath, elcount(newPath), "%s.%s", oldPath, "maxNoOfVehicles");
  value.maxNoOfVehicles.isValidFlag = C2xIsTokenAvailable(packetHandle, "IVIM", newPath);
  if(value.maxNoOfVehicles.isValidFlag==1)
  {
    value.maxNoOfVehicles.value = C2xGetTokenInt(packetHandle, "IVIM", newPath);
    result = CheckLastError("IVIM", gkFuncRefGet, result);
  }
  snprintf(newPath, elcount(newPath), "%s.%s", oldPath, "maxLenghtOfPlatoon");
  value.maxLenghtOfPlatoon.isValidFlag = C2xIsTokenAvailable(packetHandle, "IVIM", newPath);
  if(value.maxLenghtOfPlatoon.isValidFlag==1)
  {
    value.maxLenghtOfPlatoon.value = C2xGetTokenInt(packetHandle, "IVIM", newPath);
    result = CheckLastError("IVIM", gkFuncRefGet, result);
  }
  snprintf(newPath, elcount(newPath), "%s.%s", oldPath, "minGapBetweenVehicles");
  value.minGapBetweenVehicles.isValidFlag = C2xIsTokenAvailable(packetHandle, "IVIM", newPath);
  if(value.minGapBetweenVehicles.isValidFlag==1)
  {
    value.minGapBetweenVehicles.value = C2xGetTokenInt(packetHandle, "IVIM", newPath);
    result = CheckLastError("IVIM", gkFuncRefGet, result);
  }
  snprintf(newPath, elcount(newPath), "%s.%s", oldPath, "platoonMaxSpeedLimit");
  value.platoonMaxSpeedLimit.isValidFlag = C2xIsTokenAvailable(packetHandle, "IVIM", newPath);
  if(value.platoonMaxSpeedLimit.isValidFlag==1)
  {
    value.platoonMaxSpeedLimit.value = C2xGetTokenInt(packetHandle, "IVIM", newPath);
    result = CheckLastError("IVIM", gkFuncRefGet, result);
  }
  snprintf(newPath, elcount(newPath), "%s.%s", oldPath, "platoonMinSpeedLimit");
  value.platoonMinSpeedLimit.isValidFlag = C2xIsTokenAvailable(packetHandle, "IVIM", newPath);
  if(value.platoonMinSpeedLimit.isValidFlag==1)
  {
    value.platoonMinSpeedLimit.value = C2xGetTokenInt(packetHandle, "IVIM", newPath);
    result = CheckLastError("IVIM", gkFuncRefGet, result);
  }
  snprintf(newPath, elcount(newPath), "%s.%s", oldPath, "platoonSpeedRecommendation");
  value.platoonSpeedRecommendation.isValidFlag = C2xIsTokenAvailable(packetHandle, "IVIM", newPath);
  if(value.platoonSpeedRecommendation.isValidFlag==1)
  {
    value.platoonSpeedRecommendation.value = C2xGetTokenInt(packetHandle, "IVIM", newPath);
    result = CheckLastError("IVIM", gkFuncRefGet, result);
  }
  snprintf(newPath, elcount(newPath), "%s.%s", oldPath, "roadSignCodes");
  value.roadSignCodes.isValidFlag = C2xIsTokenAvailable(packetHandle, "IVIM", newPath);
  if(value.roadSignCodes.isValidFlag==1)
  {
    GetIVIMRoadSignCodesParams(packetHandle, value.roadSignCodes, newPath);
    result = CheckLastError("IVIM", gkFuncRefGet, result);
  }
  snprintf(newPath, elcount(newPath), "%s.%s", oldPath, "extraText");
  value.extraText.isValidFlag = C2xIsTokenAvailable(packetHandle, "IVIM", newPath);
  if(value.extraText.isValidFlag==1)
  {
    GetIVIMConstraintTextLines2Params(packetHandle, value.extraText, newPath);
    result = CheckLastError("IVIM", gkFuncRefGet, result);
  }
  return result;
}

int SetIVIMPlatooningRuleParams(LONG packetHandle, struct IVIMPlatooningRule value, char oldPath[])
{
  char newPath[300];
  int result;

  result = 0;

  snprintf(newPath, elcount(newPath), "%s.%s", oldPath, "priority");
  C2xSetTokenInt(packetHandle, "IVIM", newPath, value.priority);
  result = CheckLastError("IVIM", gkFuncRefGet, result);

  snprintf(newPath, elcount(newPath), "%s.%s", oldPath, "allowedSaeAutomationLevels");
  SetIVIMSaeAutomationLevelsParams(packetHandle, value.allowedSaeAutomationLevels, newPath);
  result = CheckLastError("IVIM", gkFuncRefGet, result);

  snprintf(newPath, elcount(newPath), "%s.%s", oldPath, "maxNoOfVehicles");
  if(value.maxNoOfVehicles.isValidFlag==1)
  {
    if (value.maxNoOfVehicles.value < 2)
    {
        C2xSetTokenInt(packetHandle, "IVIM", newPath, 2);
    }
    else if (value.maxNoOfVehicles.value > 64)
    {
        C2xSetTokenInt(packetHandle, "IVIM", newPath, 64);
    }
    else
    {
        C2xSetTokenInt(packetHandle, "IVIM", newPath, value.maxNoOfVehicles.value);
    }
    result = CheckLastError("IVIM", gkFuncRefGet, result);
  }
  else
  {
    if( C2xIsTokenAvailable(packetHandle, "IVIM", newPath) )
    {
      C2xRemoveToken(packetHandle, "IVIM", newPath);
    }
  }

  snprintf(newPath, elcount(newPath), "%s.%s", oldPath, "maxLenghtOfPlatoon");
  if(value.maxLenghtOfPlatoon.isValidFlag==1)
  {
    if (value.maxLenghtOfPlatoon.value < 1)
    {
        C2xSetTokenInt(packetHandle, "IVIM", newPath, 1);
    }
    else if (value.maxLenghtOfPlatoon.value > 64)
    {
        C2xSetTokenInt(packetHandle, "IVIM", newPath, 64);
    }
    else
    {
        C2xSetTokenInt(packetHandle, "IVIM", newPath, value.maxLenghtOfPlatoon.value);
    }
    result = CheckLastError("IVIM", gkFuncRefGet, result);
  }
  else
  {
    if( C2xIsTokenAvailable(packetHandle, "IVIM", newPath) )
    {
      C2xRemoveToken(packetHandle, "IVIM", newPath);
    }
  }

  snprintf(newPath, elcount(newPath), "%s.%s", oldPath, "minGapBetweenVehicles");
  if(value.minGapBetweenVehicles.isValidFlag==1)
  {
    C2xSetTokenInt(packetHandle, "IVIM", newPath, value.minGapBetweenVehicles.value);
    result = CheckLastError("IVIM", gkFuncRefGet, result);
  }
  else
  {
    if( C2xIsTokenAvailable(packetHandle, "IVIM", newPath) )
    {
      C2xRemoveToken(packetHandle, "IVIM", newPath);
    }
  }

  snprintf(newPath, elcount(newPath), "%s.%s", oldPath, "platoonMaxSpeedLimit");
  if(value.platoonMaxSpeedLimit.isValidFlag==1)
  {
    C2xSetTokenInt(packetHandle, "IVIM", newPath, value.platoonMaxSpeedLimit.value);
    result = CheckLastError("IVIM", gkFuncRefGet, result);
  }
  else
  {
    if( C2xIsTokenAvailable(packetHandle, "IVIM", newPath) )
    {
      C2xRemoveToken(packetHandle, "IVIM", newPath);
    }
  }

  snprintf(newPath, elcount(newPath), "%s.%s", oldPath, "platoonMinSpeedLimit");
  if(value.platoonMinSpeedLimit.isValidFlag==1)
  {
    C2xSetTokenInt(packetHandle, "IVIM", newPath, value.platoonMinSpeedLimit.value);
    result = CheckLastError("IVIM", gkFuncRefGet, result);
  }
  else
  {
    if( C2xIsTokenAvailable(packetHandle, "IVIM", newPath) )
    {
      C2xRemoveToken(packetHandle, "IVIM", newPath);
    }
  }

  snprintf(newPath, elcount(newPath), "%s.%s", oldPath, "platoonSpeedRecommendation");
  if(value.platoonSpeedRecommendation.isValidFlag==1)
  {
    C2xSetTokenInt(packetHandle, "IVIM", newPath, value.platoonSpeedRecommendation.value);
    result = CheckLastError("IVIM", gkFuncRefGet, result);
  }
  else
  {
    if( C2xIsTokenAvailable(packetHandle, "IVIM", newPath) )
    {
      C2xRemoveToken(packetHandle, "IVIM", newPath);
    }
  }

  snprintf(newPath, elcount(newPath), "%s.%s", oldPath, "roadSignCodes");
  if(value.roadSignCodes.isValidFlag==1)
  {
    SetIVIMRoadSignCodesParams(packetHandle, value.roadSignCodes, newPath);
    result = CheckLastError("IVIM", gkFuncRefGet, result);
  }
  else
  {
    if( C2xIsTokenAvailable(packetHandle, "IVIM", newPath) )
    {
      C2xRemoveToken(packetHandle, "IVIM", newPath);
    }
  }

  snprintf(newPath, elcount(newPath), "%s.%s", oldPath, "extraText");
  if(value.extraText.isValidFlag==1)
  {
    SetIVIMConstraintTextLines2Params(packetHandle, value.extraText, newPath);
    result = CheckLastError("IVIM", gkFuncRefGet, result);
  }
  else
  {
    if( C2xIsTokenAvailable(packetHandle, "IVIM", newPath) )
    {
      C2xRemoveToken(packetHandle, "IVIM", newPath);
    }
  }

  return result;
}

int GetIVIMPlatooningRulesParams(LONG packetHandle, struct IVIMPlatooningRules value, char oldPath[])
{
  char newPath[300]; 
  int i;
  int result;

  result = 0;

  value.length = C2xGetTokenInt(packetHandle, "IVIM", oldPath);
  if((result = CheckLastError("IVIM", gkFuncRefGet, result))==0)
  {
    for(i=0; i<value.length; i++)
    {
      snprintf(newPath, elcount(newPath), "%s[%d]", oldPath, i);
      GetIVIMPlatooningRuleParams(packetHandle, value.arrayValue[i], newPath);
      result = CheckLastError("IVIM", gkFuncRefGet, result);
    }
  }
  return result;
}

int SetIVIMPlatooningRulesParams(LONG packetHandle, struct IVIMPlatooningRules value, char oldPath[])
{
  char newPath[300]; 
  int i;
  int result;

  result = 0;

  C2xRemoveToken(packetHandle, "IVIM", oldPath);
  for(i=0; i<value.length; i++)
  {
    snprintf(newPath, elcount(newPath), "%s[%d]", oldPath, i);
    SetIVIMPlatooningRuleParams(packetHandle, value.arrayValue[i], newPath);
    result = CheckLastError("IVIM", gkFuncRefGet, result);
  }
  return result;
}

int GetIVIMAvcPartParams(LONG packetHandle, struct IVIMAvcPart value, char oldPath[])
{
  char newPath[300];
  int result;

  result = 0;

  snprintf(newPath, elcount(newPath), "%s.%s", oldPath, "detectionZoneIds");
  value.detectionZoneIds.isValidFlag = C2xIsTokenAvailable(packetHandle, "IVIM", newPath);
  if(value.detectionZoneIds.isValidFlag==1)
  {
    GetIVIMZoneIdsParams(packetHandle, value.detectionZoneIds, newPath);
    result = CheckLastError("IVIM", gkFuncRefGet, result);
  }
  snprintf(newPath, elcount(newPath), "%s.%s", oldPath, "relevanceZoneIds");
  GetIVIMZoneIdsParams(packetHandle, value.relevanceZoneIds, newPath);
  result = CheckLastError("IVIM", gkFuncRefGet, result);

  snprintf(newPath, elcount(newPath), "%s.%s", oldPath, "direction");
  value.direction.isValidFlag = C2xIsTokenAvailable(packetHandle, "IVIM", newPath);
  if(value.direction.isValidFlag==1)
  {
    value.direction.value = C2xGetTokenInt(packetHandle, "IVIM", newPath);
    result = CheckLastError("IVIM", gkFuncRefGet, result);
  }
  snprintf(newPath, elcount(newPath), "%s.%s", oldPath, "applicableLanes");
  value.applicableLanes.isValidFlag = C2xIsTokenAvailable(packetHandle, "IVIM", newPath);
  if(value.applicableLanes.isValidFlag==1)
  {
    GetIVIMLanePositionsParams(packetHandle, value.applicableLanes, newPath);
    result = CheckLastError("IVIM", gkFuncRefGet, result);
  }
  snprintf(newPath, elcount(newPath), "%s.%s", oldPath, "vehicleCharacteristics");
  value.vehicleCharacteristics.isValidFlag = C2xIsTokenAvailable(packetHandle, "IVIM", newPath);
  if(value.vehicleCharacteristics.isValidFlag==1)
  {
    GetIVIMVehicleCharacteristicsListParams(packetHandle, value.vehicleCharacteristics, newPath);
    result = CheckLastError("IVIM", gkFuncRefGet, result);
  }
  snprintf(newPath, elcount(newPath), "%s.%s", oldPath, "automatedVehicleRules");
  value.automatedVehicleRules.isValidFlag = C2xIsTokenAvailable(packetHandle, "IVIM", newPath);
  if(value.automatedVehicleRules.isValidFlag==1)
  {
    GetIVIMAutomatedVehicleRulesParams(packetHandle, value.automatedVehicleRules, newPath);
    result = CheckLastError("IVIM", gkFuncRefGet, result);
  }
  snprintf(newPath, elcount(newPath), "%s.%s", oldPath, "platooningRules");
  value.platooningRules.isValidFlag = C2xIsTokenAvailable(packetHandle, "IVIM", newPath);
  if(value.platooningRules.isValidFlag==1)
  {
    GetIVIMPlatooningRulesParams(packetHandle, value.platooningRules, newPath);
    result = CheckLastError("IVIM", gkFuncRefGet, result);
  }
  return result;
}

int SetIVIMAvcPartParams(LONG packetHandle, struct IVIMAvcPart value, char oldPath[])
{
  char newPath[300];
  int result;

  result = 0;

  snprintf(newPath, elcount(newPath), "%s.%s", oldPath, "detectionZoneIds");
  if(value.detectionZoneIds.isValidFlag==1)
  {
    SetIVIMZoneIdsParams(packetHandle, value.detectionZoneIds, newPath);
    result = CheckLastError("IVIM", gkFuncRefGet, result);
  }
  else
  {
    if( C2xIsTokenAvailable(packetHandle, "IVIM", newPath) )
    {
      C2xRemoveToken(packetHandle, "IVIM", newPath);
    }
  }

  snprintf(newPath, elcount(newPath), "%s.%s", oldPath, "relevanceZoneIds");
  SetIVIMZoneIdsParams(packetHandle, value.relevanceZoneIds, newPath);
  result = CheckLastError("IVIM", gkFuncRefGet, result);

  snprintf(newPath, elcount(newPath), "%s.%s", oldPath, "direction");
  if(value.direction.isValidFlag==1)
  {
    C2xSetTokenInt(packetHandle, "IVIM", newPath, value.direction.value);
    result = CheckLastError("IVIM", gkFuncRefGet, result);
  }
  else
  {
    if( C2xIsTokenAvailable(packetHandle, "IVIM", newPath) )
    {
      C2xRemoveToken(packetHandle, "IVIM", newPath);
    }
  }

  snprintf(newPath, elcount(newPath), "%s.%s", oldPath, "applicableLanes");
  if(value.applicableLanes.isValidFlag==1)
  {
    SetIVIMLanePositionsParams(packetHandle, value.applicableLanes, newPath);
    result = CheckLastError("IVIM", gkFuncRefGet, result);
  }
  else
  {
    if( C2xIsTokenAvailable(packetHandle, "IVIM", newPath) )
    {
      C2xRemoveToken(packetHandle, "IVIM", newPath);
    }
  }

  snprintf(newPath, elcount(newPath), "%s.%s", oldPath, "vehicleCharacteristics");
  if(value.vehicleCharacteristics.isValidFlag==1)
  {
    SetIVIMVehicleCharacteristicsListParams(packetHandle, value.vehicleCharacteristics, newPath);
    result = CheckLastError("IVIM", gkFuncRefGet, result);
  }
  else
  {
    if( C2xIsTokenAvailable(packetHandle, "IVIM", newPath) )
    {
      C2xRemoveToken(packetHandle, "IVIM", newPath);
    }
  }

  snprintf(newPath, elcount(newPath), "%s.%s", oldPath, "automatedVehicleRules");
  if(value.automatedVehicleRules.isValidFlag==1)
  {
    SetIVIMAutomatedVehicleRulesParams(packetHandle, value.automatedVehicleRules, newPath);
    result = CheckLastError("IVIM", gkFuncRefGet, result);
  }
  else
  {
    if( C2xIsTokenAvailable(packetHandle, "IVIM", newPath) )
    {
      C2xRemoveToken(packetHandle, "IVIM", newPath);
    }
  }

  snprintf(newPath, elcount(newPath), "%s.%s", oldPath, "platooningRules");
  if(value.platooningRules.isValidFlag==1)
  {
    SetIVIMPlatooningRulesParams(packetHandle, value.platooningRules, newPath);
    result = CheckLastError("IVIM", gkFuncRefGet, result);
  }
  else
  {
    if( C2xIsTokenAvailable(packetHandle, "IVIM", newPath) )
    {
      C2xRemoveToken(packetHandle, "IVIM", newPath);
    }
  }

  return result;
}

int GetIVIMAutomatedVehicleContainerParams(LONG packetHandle, struct IVIMAutomatedVehicleContainer value, char oldPath[])
{
  char newPath[300]; 
  int i;
  int result;

  result = 0;

  value.length = C2xGetTokenInt(packetHandle, "IVIM", oldPath);
  if((result = CheckLastError("IVIM", gkFuncRefGet, result))==0)
  {
    for(i=0; i<value.length; i++)
    {
      snprintf(newPath, elcount(newPath), "%s[%d]", oldPath, i);
      GetIVIMAvcPartParams(packetHandle, value.arrayValue[i], newPath);
      result = CheckLastError("IVIM", gkFuncRefGet, result);
    }
  }
  return result;
}

int SetIVIMAutomatedVehicleContainerParams(LONG packetHandle, struct IVIMAutomatedVehicleContainer value, char oldPath[])
{
  char newPath[300]; 
  int i;
  int result;

  result = 0;

  C2xRemoveToken(packetHandle, "IVIM", oldPath);
  for(i=0; i<value.length; i++)
  {
    snprintf(newPath, elcount(newPath), "%s[%d]", oldPath, i);
    SetIVIMAvcPartParams(packetHandle, value.arrayValue[i], newPath);
    result = CheckLastError("IVIM", gkFuncRefGet, result);
  }
  return result;
}

int GetIVIMRoadSegmentReferenceIDParams(LONG packetHandle, struct IVIMRoadSegmentReferenceID value, char oldPath[])
{
  char newPath[300];
  int result;

  result = 0;

  snprintf(newPath, elcount(newPath), "%s.%s", oldPath, "region");
  value.region.isValidFlag = C2xIsTokenAvailable(packetHandle, "IVIM", newPath);
  if(value.region.isValidFlag==1)
  {
    value.region.value = C2xGetTokenInt(packetHandle, "IVIM", newPath);
    result = CheckLastError("IVIM", gkFuncRefGet, result);
  }
  snprintf(newPath, elcount(newPath), "%s.%s", oldPath, "id");
  value.id = C2xGetTokenInt(packetHandle, "IVIM", newPath);
  result = CheckLastError("IVIM", gkFuncRefGet, result);

  return result;
}

int SetIVIMRoadSegmentReferenceIDParams(LONG packetHandle, struct IVIMRoadSegmentReferenceID value, char oldPath[])
{
  char newPath[300];
  int result;

  result = 0;

  snprintf(newPath, elcount(newPath), "%s.%s", oldPath, "region");
  if(value.region.isValidFlag==1)
  {
    C2xSetTokenInt(packetHandle, "IVIM", newPath, value.region.value);
    result = CheckLastError("IVIM", gkFuncRefGet, result);
  }
  else
  {
    if( C2xIsTokenAvailable(packetHandle, "IVIM", newPath) )
    {
      C2xRemoveToken(packetHandle, "IVIM", newPath);
    }
  }

  snprintf(newPath, elcount(newPath), "%s.%s", oldPath, "id");
  C2xSetTokenInt(packetHandle, "IVIM", newPath, value.id);
  result = CheckLastError("IVIM", gkFuncRefGet, result);

  return result;
}

int GetIVIMIntersectionReferenceIDParams(LONG packetHandle, struct IVIMIntersectionReferenceID value, char oldPath[])
{
  char newPath[300];
  int result;

  result = 0;

  snprintf(newPath, elcount(newPath), "%s.%s", oldPath, "region");
  value.region.isValidFlag = C2xIsTokenAvailable(packetHandle, "IVIM", newPath);
  if(value.region.isValidFlag==1)
  {
    value.region.value = C2xGetTokenInt(packetHandle, "IVIM", newPath);
    result = CheckLastError("IVIM", gkFuncRefGet, result);
  }
  snprintf(newPath, elcount(newPath), "%s.%s", oldPath, "id");
  value.id = C2xGetTokenInt(packetHandle, "IVIM", newPath);
  result = CheckLastError("IVIM", gkFuncRefGet, result);

  return result;
}

int SetIVIMIntersectionReferenceIDParams(LONG packetHandle, struct IVIMIntersectionReferenceID value, char oldPath[])
{
  char newPath[300];
  int result;

  result = 0;

  snprintf(newPath, elcount(newPath), "%s.%s", oldPath, "region");
  if(value.region.isValidFlag==1)
  {
    C2xSetTokenInt(packetHandle, "IVIM", newPath, value.region.value);
    result = CheckLastError("IVIM", gkFuncRefGet, result);
  }
  else
  {
    if( C2xIsTokenAvailable(packetHandle, "IVIM", newPath) )
    {
      C2xRemoveToken(packetHandle, "IVIM", newPath);
    }
  }

  snprintf(newPath, elcount(newPath), "%s.%s", oldPath, "id");
  C2xSetTokenInt(packetHandle, "IVIM", newPath, value.id);
  result = CheckLastError("IVIM", gkFuncRefGet, result);

  return result;
}

int GetIVIMMapReferenceParams(LONG packetHandle, struct IVIMMapReference value, char oldPath[])
{
  char newPath[300];
  int result;

  result = 0;

  value.choice = C2xGetTokenInt(packetHandle, "IVIM", oldPath);

  switch(value.choice)
  {
    case 0:
    {
      snprintf(newPath, elcount(newPath), "%s.%s", oldPath, "roadsegment");
      GetIVIMRoadSegmentReferenceIDParams(packetHandle, value.roadsegment, newPath);
      result = CheckLastError("IVIM", gkFuncRefGet, result);
    }
    break;
    case 1:
    {
      snprintf(newPath, elcount(newPath), "%s.%s", oldPath, "intersection");
      GetIVIMIntersectionReferenceIDParams(packetHandle, value.intersection, newPath);
      result = CheckLastError("IVIM", gkFuncRefGet, result);
    }
    break;
  }
  return result;
}

int SetIVIMMapReferenceParams(LONG packetHandle, struct IVIMMapReference value, char oldPath[])
{
  char newPath[300];
  int result;

  result = 0;

  switch(value.choice)
  {
    case 0:
    {
      snprintf(newPath, elcount(newPath), "%s.%s", oldPath, "roadsegment");
      SetIVIMRoadSegmentReferenceIDParams(packetHandle, value.roadsegment, newPath);
      result = CheckLastError("IVIM", gkFuncRefGet, result);
    }
    break;
    case 1:
    {
      snprintf(newPath, elcount(newPath), "%s.%s", oldPath, "intersection");
      SetIVIMIntersectionReferenceIDParams(packetHandle, value.intersection, newPath);
      result = CheckLastError("IVIM", gkFuncRefGet, result);
    }
    break;
  }
  return result;
}

int GetIVIMLaneIdsParams(LONG packetHandle, struct IVIMLaneIds value, char oldPath[])
{
  char newPath[300]; 
  int i;
  int result;

  result = 0;

  value.length = C2xGetTokenInt(packetHandle, "IVIM", oldPath);
  if((result = CheckLastError("IVIM", gkFuncRefGet, result))==0)
  {
    for(i=0; i<value.length; i++)
    {
      snprintf(newPath, elcount(newPath), "%s[%d]", oldPath, i);
      value.arrayValue[i] = C2xGetTokenInt64(packetHandle, "IVIM", newPath);
      result = CheckLastError("IVIM", gkFuncRefGet, result);
    }
  }
  return result;
}

int SetIVIMLaneIdsParams(LONG packetHandle, struct IVIMLaneIds value, char oldPath[])
{
  char newPath[300]; 
  int i;
  int result;

  result = 0;

  C2xRemoveToken(packetHandle, "IVIM", oldPath);
  for(i=0; i<value.length; i++)
  {
    snprintf(newPath, elcount(newPath), "%s[%d]", oldPath, i);
    C2xSetTokenInt64(packetHandle, "IVIM", newPath, value.arrayValue[i]);
    result = CheckLastError("IVIM", gkFuncRefGet, result);
  }
  return result;
}

int GetIVIMMlcPartParams(LONG packetHandle, struct IVIMMlcPart value, char oldPath[])
{
  char newPath[300];
  int result;

  result = 0;

  snprintf(newPath, elcount(newPath), "%s.%s", oldPath, "zoneId");
  value.zoneId = C2xGetTokenInt(packetHandle, "IVIM", newPath);
  result = CheckLastError("IVIM", gkFuncRefGet, result);

  snprintf(newPath, elcount(newPath), "%s.%s", oldPath, "laneIds");
  value.laneIds.isValidFlag = C2xIsTokenAvailable(packetHandle, "IVIM", newPath);
  if(value.laneIds.isValidFlag==1)
  {
    GetIVIMLaneIdsParams(packetHandle, value.laneIds, newPath);
    result = CheckLastError("IVIM", gkFuncRefGet, result);
  }
  return result;
}

int SetIVIMMlcPartParams(LONG packetHandle, struct IVIMMlcPart value, char oldPath[])
{
  char newPath[300];
  int result;

  result = 0;

  snprintf(newPath, elcount(newPath), "%s.%s", oldPath, "zoneId");
  if (value.zoneId < 1)
  {
    C2xSetTokenInt(packetHandle, "IVIM", newPath, 1);
  }
  else if (value.zoneId > 32)
  {
    C2xSetTokenInt(packetHandle, "IVIM", newPath, 32);
  }
  else
  {
    C2xSetTokenInt(packetHandle, "IVIM", newPath, value.zoneId);
  }
  result = CheckLastError("IVIM", gkFuncRefGet, result);

  snprintf(newPath, elcount(newPath), "%s.%s", oldPath, "laneIds");
  if(value.laneIds.isValidFlag==1)
  {
    SetIVIMLaneIdsParams(packetHandle, value.laneIds, newPath);
    result = CheckLastError("IVIM", gkFuncRefGet, result);
  }
  else
  {
    if( C2xIsTokenAvailable(packetHandle, "IVIM", newPath) )
    {
      C2xRemoveToken(packetHandle, "IVIM", newPath);
    }
  }

  return result;
}

int GetIVIMMlcPartsParams(LONG packetHandle, struct IVIMMlcParts value, char oldPath[])
{
  char newPath[300]; 
  int i;
  int result;

  result = 0;

  value.length = C2xGetTokenInt(packetHandle, "IVIM", oldPath);
  if((result = CheckLastError("IVIM", gkFuncRefGet, result))==0)
  {
    for(i=0; i<value.length; i++)
    {
      snprintf(newPath, elcount(newPath), "%s[%d]", oldPath, i);
      GetIVIMMlcPartParams(packetHandle, value.arrayValue[i], newPath);
      result = CheckLastError("IVIM", gkFuncRefGet, result);
    }
  }
  return result;
}

int SetIVIMMlcPartsParams(LONG packetHandle, struct IVIMMlcParts value, char oldPath[])
{
  char newPath[300]; 
  int i;
  int result;

  result = 0;

  C2xRemoveToken(packetHandle, "IVIM", oldPath);
  for(i=0; i<value.length; i++)
  {
    snprintf(newPath, elcount(newPath), "%s[%d]", oldPath, i);
    SetIVIMMlcPartParams(packetHandle, value.arrayValue[i], newPath);
    result = CheckLastError("IVIM", gkFuncRefGet, result);
  }
  return result;
}

int GetIVIMMapLocationContainerParams(LONG packetHandle, struct IVIMMapLocationContainer value, char oldPath[])
{
  char newPath[300];
  int result;

  result = 0;

  snprintf(newPath, elcount(newPath), "%s.%s", oldPath, "reference");
  GetIVIMMapReferenceParams(packetHandle, value.reference, newPath);
  result = CheckLastError("IVIM", gkFuncRefGet, result);

  snprintf(newPath, elcount(newPath), "%s.%s", oldPath, "parts");
  GetIVIMMlcPartsParams(packetHandle, value.parts, newPath);
  result = CheckLastError("IVIM", gkFuncRefGet, result);

  return result;
}

int SetIVIMMapLocationContainerParams(LONG packetHandle, struct IVIMMapLocationContainer value, char oldPath[])
{
  char newPath[300];
  int result;

  result = 0;

  snprintf(newPath, elcount(newPath), "%s.%s", oldPath, "reference");
  SetIVIMMapReferenceParams(packetHandle, value.reference, newPath);
  result = CheckLastError("IVIM", gkFuncRefGet, result);

  snprintf(newPath, elcount(newPath), "%s.%s", oldPath, "parts");
  SetIVIMMlcPartsParams(packetHandle, value.parts, newPath);
  result = CheckLastError("IVIM", gkFuncRefGet, result);

  return result;
}

int GetIVIMRscPartParams(LONG packetHandle, struct IVIMRscPart value, char oldPath[])
{
  char newPath[300];
  int result;

  result = 0;

  snprintf(newPath, elcount(newPath), "%s.%s", oldPath, "detectionZoneIds");
  value.detectionZoneIds.isValidFlag = C2xIsTokenAvailable(packetHandle, "IVIM", newPath);
  if(value.detectionZoneIds.isValidFlag==1)
  {
    GetIVIMZoneIdsParams(packetHandle, value.detectionZoneIds, newPath);
    result = CheckLastError("IVIM", gkFuncRefGet, result);
  }
  snprintf(newPath, elcount(newPath), "%s.%s", oldPath, "relevanceZoneIds");
  GetIVIMZoneIdsParams(packetHandle, value.relevanceZoneIds, newPath);
  result = CheckLastError("IVIM", gkFuncRefGet, result);

  snprintf(newPath, elcount(newPath), "%s.%s", oldPath, "direction");
  value.direction.isValidFlag = C2xIsTokenAvailable(packetHandle, "IVIM", newPath);
  if(value.direction.isValidFlag==1)
  {
    value.direction.value = C2xGetTokenInt(packetHandle, "IVIM", newPath);
    result = CheckLastError("IVIM", gkFuncRefGet, result);
  }
  snprintf(newPath, elcount(newPath), "%s.%s", oldPath, "roadSurfaceStaticCharacteristics");
  value.roadSurfaceStaticCharacteristics.isValidFlag = C2xIsTokenAvailable(packetHandle, "IVIM", newPath);
  if(value.roadSurfaceStaticCharacteristics.isValidFlag==1)
  {
    GetIVIMRoadSurfaceStaticCharacteristicsParams(packetHandle, value.roadSurfaceStaticCharacteristics, newPath);
    result = CheckLastError("IVIM", gkFuncRefGet, result);
  }
  snprintf(newPath, elcount(newPath), "%s.%s", oldPath, "roadSurfaceDynamicCharacteristics");
  value.roadSurfaceDynamicCharacteristics.isValidFlag = C2xIsTokenAvailable(packetHandle, "IVIM", newPath);
  if(value.roadSurfaceDynamicCharacteristics.isValidFlag==1)
  {
    GetIVIMRoadSurfaceDynamicCharacteristicsParams(packetHandle, value.roadSurfaceDynamicCharacteristics, newPath);
    result = CheckLastError("IVIM", gkFuncRefGet, result);
  }
  return result;
}

int SetIVIMRscPartParams(LONG packetHandle, struct IVIMRscPart value, char oldPath[])
{
  char newPath[300];
  int result;

  result = 0;

  snprintf(newPath, elcount(newPath), "%s.%s", oldPath, "detectionZoneIds");
  if(value.detectionZoneIds.isValidFlag==1)
  {
    SetIVIMZoneIdsParams(packetHandle, value.detectionZoneIds, newPath);
    result = CheckLastError("IVIM", gkFuncRefGet, result);
  }
  else
  {
    if( C2xIsTokenAvailable(packetHandle, "IVIM", newPath) )
    {
      C2xRemoveToken(packetHandle, "IVIM", newPath);
    }
  }

  snprintf(newPath, elcount(newPath), "%s.%s", oldPath, "relevanceZoneIds");
  SetIVIMZoneIdsParams(packetHandle, value.relevanceZoneIds, newPath);
  result = CheckLastError("IVIM", gkFuncRefGet, result);

  snprintf(newPath, elcount(newPath), "%s.%s", oldPath, "direction");
  if(value.direction.isValidFlag==1)
  {
    C2xSetTokenInt(packetHandle, "IVIM", newPath, value.direction.value);
    result = CheckLastError("IVIM", gkFuncRefGet, result);
  }
  else
  {
    if( C2xIsTokenAvailable(packetHandle, "IVIM", newPath) )
    {
      C2xRemoveToken(packetHandle, "IVIM", newPath);
    }
  }

  snprintf(newPath, elcount(newPath), "%s.%s", oldPath, "roadSurfaceStaticCharacteristics");
  if(value.roadSurfaceStaticCharacteristics.isValidFlag==1)
  {
    SetIVIMRoadSurfaceStaticCharacteristicsParams(packetHandle, value.roadSurfaceStaticCharacteristics, newPath);
    result = CheckLastError("IVIM", gkFuncRefGet, result);
  }
  else
  {
    if( C2xIsTokenAvailable(packetHandle, "IVIM", newPath) )
    {
      C2xRemoveToken(packetHandle, "IVIM", newPath);
    }
  }

  snprintf(newPath, elcount(newPath), "%s.%s", oldPath, "roadSurfaceDynamicCharacteristics");
  if(value.roadSurfaceDynamicCharacteristics.isValidFlag==1)
  {
    SetIVIMRoadSurfaceDynamicCharacteristicsParams(packetHandle, value.roadSurfaceDynamicCharacteristics, newPath);
    result = CheckLastError("IVIM", gkFuncRefGet, result);
  }
  else
  {
    if( C2xIsTokenAvailable(packetHandle, "IVIM", newPath) )
    {
      C2xRemoveToken(packetHandle, "IVIM", newPath);
    }
  }

  return result;
}

int GetIVIMRoadSurfaceContainerParams(LONG packetHandle, struct IVIMRoadSurfaceContainer value, char oldPath[])
{
  char newPath[300]; 
  int i;
  int result;

  result = 0;

  value.length = C2xGetTokenInt(packetHandle, "IVIM", oldPath);
  if((result = CheckLastError("IVIM", gkFuncRefGet, result))==0)
  {
    for(i=0; i<value.length; i++)
    {
      snprintf(newPath, elcount(newPath), "%s[%d]", oldPath, i);
      GetIVIMRscPartParams(packetHandle, value.arrayValue[i], newPath);
      result = CheckLastError("IVIM", gkFuncRefGet, result);
    }
  }
  return result;
}

int SetIVIMRoadSurfaceContainerParams(LONG packetHandle, struct IVIMRoadSurfaceContainer value, char oldPath[])
{
  char newPath[300]; 
  int i;
  int result;

  result = 0;

  C2xRemoveToken(packetHandle, "IVIM", oldPath);
  for(i=0; i<value.length; i++)
  {
    snprintf(newPath, elcount(newPath), "%s[%d]", oldPath, i);
    SetIVIMRscPartParams(packetHandle, value.arrayValue[i], newPath);
    result = CheckLastError("IVIM", gkFuncRefGet, result);
  }
  return result;
}

int GetIVIMIviContainerParams(LONG packetHandle, struct IVIMIviContainer value, char oldPath[])
{
  char newPath[300];
  int result;

  result = 0;

  value.choice = C2xGetTokenInt(packetHandle, "IVIM", oldPath);

  switch(value.choice)
  {
    case 0:
    {
      snprintf(newPath, elcount(newPath), "%s.%s", oldPath, "glc");
      GetIVIMGeographicLocationContainerParams(packetHandle, value.glc, newPath);
      result = CheckLastError("IVIM", gkFuncRefGet, result);
    }
    break;
    case 1:
    {
      snprintf(newPath, elcount(newPath), "%s.%s", oldPath, "giv");
      GetIVIMGeneralIviContainerParams(packetHandle, value.giv, newPath);
      result = CheckLastError("IVIM", gkFuncRefGet, result);
    }
    break;
    case 2:
    {
      snprintf(newPath, elcount(newPath), "%s.%s", oldPath, "rcc");
      GetIVIMRoadConfigurationContainerParams(packetHandle, value.rcc, newPath);
      result = CheckLastError("IVIM", gkFuncRefGet, result);
    }
    break;
    case 3:
    {
      snprintf(newPath, elcount(newPath), "%s.%s", oldPath, "tc");
      GetIVIMTextContainerParams(packetHandle, value.tc, newPath);
      result = CheckLastError("IVIM", gkFuncRefGet, result);
    }
    break;
    case 4:
    {
      snprintf(newPath, elcount(newPath), "%s.%s", oldPath, "lac");
      GetIVIMLayoutContainerParams(packetHandle, value.lac, newPath);
      result = CheckLastError("IVIM", gkFuncRefGet, result);
    }
    break;
    case 5:
    {
      snprintf(newPath, elcount(newPath), "%s.%s", oldPath, "avc");
      GetIVIMAutomatedVehicleContainerParams(packetHandle, value.avc, newPath);
      result = CheckLastError("IVIM", gkFuncRefGet, result);
    }
    break;
    case 6:
    {
      snprintf(newPath, elcount(newPath), "%s.%s", oldPath, "mlc");
      GetIVIMMapLocationContainerParams(packetHandle, value.mlc, newPath);
      result = CheckLastError("IVIM", gkFuncRefGet, result);
    }
    break;
    case 7:
    {
      snprintf(newPath, elcount(newPath), "%s.%s", oldPath, "rsc");
      GetIVIMRoadSurfaceContainerParams(packetHandle, value.rsc, newPath);
      result = CheckLastError("IVIM", gkFuncRefGet, result);
    }
    break;
  }
  return result;
}

int SetIVIMIviContainerParams(LONG packetHandle, struct IVIMIviContainer value, char oldPath[])
{
  char newPath[300];
  int result;

  result = 0;

  switch(value.choice)
  {
    case 0:
    {
      snprintf(newPath, elcount(newPath), "%s.%s", oldPath, "glc");
      SetIVIMGeographicLocationContainerParams(packetHandle, value.glc, newPath);
      result = CheckLastError("IVIM", gkFuncRefGet, result);
    }
    break;
    case 1:
    {
      snprintf(newPath, elcount(newPath), "%s.%s", oldPath, "giv");
      SetIVIMGeneralIviContainerParams(packetHandle, value.giv, newPath);
      result = CheckLastError("IVIM", gkFuncRefGet, result);
    }
    break;
    case 2:
    {
      snprintf(newPath, elcount(newPath), "%s.%s", oldPath, "rcc");
      SetIVIMRoadConfigurationContainerParams(packetHandle, value.rcc, newPath);
      result = CheckLastError("IVIM", gkFuncRefGet, result);
    }
    break;
    case 3:
    {
      snprintf(newPath, elcount(newPath), "%s.%s", oldPath, "tc");
      SetIVIMTextContainerParams(packetHandle, value.tc, newPath);
      result = CheckLastError("IVIM", gkFuncRefGet, result);
    }
    break;
    case 4:
    {
      snprintf(newPath, elcount(newPath), "%s.%s", oldPath, "lac");
      SetIVIMLayoutContainerParams(packetHandle, value.lac, newPath);
      result = CheckLastError("IVIM", gkFuncRefGet, result);
    }
    break;
    case 5:
    {
      snprintf(newPath, elcount(newPath), "%s.%s", oldPath, "avc");
      SetIVIMAutomatedVehicleContainerParams(packetHandle, value.avc, newPath);
      result = CheckLastError("IVIM", gkFuncRefGet, result);
    }
    break;
    case 6:
    {
      snprintf(newPath, elcount(newPath), "%s.%s", oldPath, "mlc");
      SetIVIMMapLocationContainerParams(packetHandle, value.mlc, newPath);
      result = CheckLastError("IVIM", gkFuncRefGet, result);
    }
    break;
    case 7:
    {
      snprintf(newPath, elcount(newPath), "%s.%s", oldPath, "rsc");
      SetIVIMRoadSurfaceContainerParams(packetHandle, value.rsc, newPath);
      result = CheckLastError("IVIM", gkFuncRefGet, result);
    }
    break;
  }
  return result;
}

int GetIVIMIviContainersParams(LONG packetHandle, struct IVIMIviContainers value, char oldPath[])
{
  char newPath[300]; 
  int i;
  int result;

  result = 0;

  value.length = C2xGetTokenInt(packetHandle, "IVIM", oldPath);
  if((result = CheckLastError("IVIM", gkFuncRefGet, result))==0)
  {
    for(i=0; i<value.length; i++)
    {
      snprintf(newPath, elcount(newPath), "%s[%d]", oldPath, i);
      GetIVIMIviContainerParams(packetHandle, value.arrayValue[i], newPath);
      result = CheckLastError("IVIM", gkFuncRefGet, result);
    }
  }
  return result;
}

int SetIVIMIviContainersParams(LONG packetHandle, struct IVIMIviContainers value, char oldPath[])
{
  char newPath[300]; 
  int i;
  int result;

  result = 0;

  C2xRemoveToken(packetHandle, "IVIM", oldPath);
  for(i=0; i<value.length; i++)
  {
    snprintf(newPath, elcount(newPath), "%s[%d]", oldPath, i);
    SetIVIMIviContainerParams(packetHandle, value.arrayValue[i], newPath);
    result = CheckLastError("IVIM", gkFuncRefGet, result);
  }
  return result;
}

int GetIVIMIviStructureParams(LONG packetHandle, struct IVIMIviStructure value, char oldPath[])
{
  char newPath[300];
  int result;

  result = 0;

  snprintf(newPath, elcount(newPath), "%s.%s", oldPath, "mandatory");
  GetIVIMIviManagementContainerParams(packetHandle, value.mandatory, newPath);
  result = CheckLastError("IVIM", gkFuncRefGet, result);

  snprintf(newPath, elcount(newPath), "%s.%s", oldPath, "optional");
  value.optional.isValidFlag = C2xIsTokenAvailable(packetHandle, "IVIM", newPath);
  if(value.optional.isValidFlag==1)
  {
    GetIVIMIviContainersParams(packetHandle, value.optional, newPath);
    result = CheckLastError("IVIM", gkFuncRefGet, result);
  }
  return result;
}

int SetIVIMIviStructureParams(LONG packetHandle, struct IVIMIviStructure value, char oldPath[])
{
  char newPath[300];
  int result;

  result = 0;

  snprintf(newPath, elcount(newPath), "%s.%s", oldPath, "mandatory");
  SetIVIMIviManagementContainerParams(packetHandle, value.mandatory, newPath);
  result = CheckLastError("IVIM", gkFuncRefGet, result);

  snprintf(newPath, elcount(newPath), "%s.%s", oldPath, "optional");
  if(value.optional.isValidFlag==1)
  {
    SetIVIMIviContainersParams(packetHandle, value.optional, newPath);
    result = CheckLastError("IVIM", gkFuncRefGet, result);
  }
  else
  {
    if( C2xIsTokenAvailable(packetHandle, "IVIM", newPath) )
    {
      C2xRemoveToken(packetHandle, "IVIM", newPath);
    }
  }

  return result;
}

int API_GetIVIMParams(LONG packetHandle, struct IVIM value)
{
  int result;
  result = 0;

  value.header.isValidFlag = 1;
  GetIVIMItsPduHeaderParams(packetHandle, value.header, "header");
  result = CheckLastError("IVIM", gkFuncRefGet, result);

  value.ivi.isValidFlag = 1;
  GetIVIMIviStructureParams(packetHandle, value.ivi, "ivi");
  result = CheckLastError("IVIM", gkFuncRefGet, result);

  return result;
}

int API_SetIVIMParams(LONG packetHandle, struct IVIM value)
{
  int result;
  result = 0;

  SetIVIMItsPduHeaderParams(packetHandle, value.header, "header");
  result = CheckLastError("IVIM", gkFuncRefGet, result);

  SetIVIMIviStructureParams(packetHandle, value.ivi, "ivi");
  result = CheckLastError("IVIM", gkFuncRefGet, result);

  return result;
}

