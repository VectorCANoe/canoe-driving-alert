/*@!Encoding:1252*/
includes
{
	#include "Car2xAPI.cin"
}

variables
{
  char routeFile[255];
  char routeName[50];
   
  msTimer gpsTimer;
  int timeStep = 100;
  
  int routeSize = 0;
  int routePointIndex = 0;
  
  float currentDist = 0;
  
  float latMap[int64];
  float lonMap[int64];
  float headMap[int64];
  float totalDistMap[int64];
}

on start
{
  if (isSimulated() == 0)
  {
    write("Started in real bus, simulation of ego vehicle is turned off.");
    C2xStopNode();
  }
  else
  {
    loadAndStoreRoute();
    C2xStartNode();
  }
}

/****************************************************************
 *********Load and store route, start DuT Simulation*************
 ****************************************************************/
void loadAndStoreRoute()
{
  int i;
  sysGetVariableString(sysvar::RouteCtrl::FileName, routeFile, elCount(routeFile));
  sysGetVariableString(sysvar::RouteCtrl::RouteName, routeName, elCount(routeName));

  // reset timer and all variables
  cancelTimer(gpsTimer);
  latMap.clear();
  lonMap.clear();
  headMap.clear();
  routePointIndex = 0;
  currentDist = 0;
  
  // load route and store route points in maps
  C2xLoadRoute(routeFile, routeName, @sysvar::RouteCtrl::LoopFlag);
  routeSize = C2xGetNumberOfRoutePoints(routeName);
  
  C2xGetRoutePoint(routeName,0, latMap[0],lonMap[0],headMap[0]);

  totalDistMap[0] = 0;
  
  for (i = 1; i < routeSize; i = i+1)
  {
    C2xGetRoutePoint(routeName,i, latMap[i],lonMap[i],headMap[i]);  
    totalDistMap[i] = totalDistMap[i-1] + API_PosCalcDistance(latMap[i], lonMap[i], latMap[i-1], lonMap[i-1]);
  }
    // start timer
  if (routeSize > 0) 
  {
    @GNSS::Ath1.Latitude = latMap[0];
    @GNSS::Ath1.Longitude = lonMap[0];
    @GNSS::Ath1.Direction = headMap[0];
    @GNSS::Ath1.Speed = 0.0;
    setTimerCyclic(gpsTimer, timeStep);
  }
}


/****************************************************************
 ***************Timer to update GNSS position********************
 ****************************************************************/
on timer gpsTimer
{
  double restDist;
  double diffLat, diffLong;
  float conversion = 6371000.8 * (pi / 180);
  
  if (@sysvar::GNSS_Ctrl::SimulatedSpeed == 0)
  {
    @GNSS::Ath1.Latitude = latMap[routePointIndex];
    @GNSS::Ath1.Longitude = lonMap[routePointIndex];
    @GNSS::Ath1.Direction = headMap[routePointIndex];
    @GNSS::Ath1.Speed = 0.0;
    return;
  }
  
  // get current Distance on route
  currentDist += (timeStep / 1000.0) * (@sysvar::GNSS_Ctrl::SimulatedSpeed / 3.6);  
  // update current route point
  while (routePointIndex < routeSize && currentDist > totalDistMap[routePointIndex])
  {
    routePointIndex++;
  }
  routePointIndex-=1;
  if (routePointIndex == routeSize - 1)
  {
    if (@RouteCtrl::LoopFlag == 1)
    {
      routePointIndex = 0;
      currentDist = 0;
    }
    else
    {
      return;
    }
  }
  
  // calculate current position on route
  restDist = currentDist - totalDistMap[routePointIndex];
  diffLat = restDist * cos(headMap[routePointIndex] * (pi/180));
  diffLong = restDist * sin(headMap[routePointIndex] * (pi/180));
    
  @GNSS::Ath1.Latitude = latMap[routePointIndex] + (diffLat / conversion);
  @GNSS::Ath1.Longitude = lonMap[routePointIndex] + (diffLong / (conversion * cos(latMap[routePointIndex] * (pi/180))));
  @GNSS::Ath1.Direction = headMap[routePointIndex];
  @GNSS::Ath1.Speed = @sysvar::GNSS_Ctrl::SimulatedSpeed / 3.6;
}


/****************************************************************
 ********************Control Buttons*****************************
 ****************************************************************/
on sysvar GNSS_Ctrl::SimGNSSBtnState
{
  if (@this == 1 /*button pressed*/)
  {
    loadAndStoreRoute();
  }
}