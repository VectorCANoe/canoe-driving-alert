/*@!Encoding:1252*/
includes
{
  #include "..\DataSources_Templates\ASNV_Template_BaseDatatypes.cin"
  #include "..\DataSources_Templates\ASNV_Template_DENM.cin"
}

variables
{
    int originalSize;
    int needsReset = 0;
}

on start
{
  enum CallbackType { OnRx, PreTx };
  C2xRegisterCallback(PreTx, "OnPreTxDENM" , "DENM" );
}

void OnScenarioStateChanged(long newState)
{
  if (@HLN_Ctrl::overwriteValues == 1)
  {
    if (newState == 0)
    {
      // save original value in loaded scenario
      originalSize = C2xGetStationAttributeInt64("Events_Vehicle_Events_DENM1::EventZone");
      needsReset = 1;
      //set attribute to custom value
      C2xSetStationAttributeInt64("Events_Vehicle_Events_DENM1::EventZone", 0, @sysvar::HLN_Ctrl::eventHistorySize);
    }
    else if (newState == 1)
    {
      //set attribute to custom value
      C2xSetStationAttributeInt64("Events_Vehicle_Events_DENM1::EventZone", 0, @sysvar::HLN_Ctrl::eventHistorySize);
    }
  }
  else
  {
    if (newState == 0)
    {
      needsReset = 0;
    }
    if (newState == 1 && needsReset == 1)
    {
      //set attribute to original value
      C2xSetStationAttributeInt64("Events_Vehicle_Events_DENM1::EventZone", 0, originalSize);
    }
  }
}

/*
  Set custom values for DENM message.
*/
void OnPreTxDENM(LONG packet)
{
  if (C2xIsNodeStarted() && C2xGetStationAttributeInt64("Events_Vehicle_Events_DENM1") == 1 && @HLN_Ctrl::overwriteValues == 1)
  {
    // check if linear or circular event type
    if (sysGetVariableLong("HLN_Ctrl", "eventHistory") == 0)
    {
      C2xRemoveToken(packet, "DENM", "denm.situation.eventHistory");
    }
    
    // check if relevance distance should be set
    if (sysGetVariableLong("HLN_Ctrl", "relevanceDistance") != -1)
    {
      C2xSetTokenInt64(packet, "DENM", "denm.management.relevanceDistance", @sysvar::HLN_Ctrl::relevanceDistance);
    }
    else
    {
      C2xRemoveToken(packet, "DENM", "denm.management.relevanceDistance");
    }
    
    // set custom informationQuality, validityDuration and trafficDirection
    C2xSetTokenInt64(packet, "DENM", "denm.situation.informationQuality", @sysvar::HLN_Ctrl::informationQuality);
    setEventHistoryInfoQuality(packet);
    
    C2xSetTokenInt64(packet, "DENM", "denm.management.validityDuration", @sysvar::HLN_Ctrl::validyDuration);
    C2xSetTokenInt64(packet, "DENM", "denm.management.relevanceTrafficDirection", @sysvar::HLN_Ctrl::trafficDirection);
  }
}

void setEventHistoryInfoQuality(LONG packet)
{
  int i;
  char  eventHistoryIQ[100];
  
  for (i=0; i<23; i++)
  {
    snprintf(eventHistoryIQ, elcount(eventHistoryIQ), "denm.situation.eventHistory.[%d].informationQuality;", i);
    if (C2xIsTokenAvailable(packet, "DENM", eventHistoryIQ) == 1)
    {
      C2xSetTokenInt64(packet, "DENM", eventHistoryIQ, @sysvar::HLN_Ctrl::informationQuality);
    }
    else
    {
      break;
    }
  }
}