/*@!Encoding:1252*/
/*
//  (c) Vector Informatik GmbH. All rights reserved.
//
//  This file contains definitions of structs and methods that may be used
//  to set and get the values of an ASN.1 defined packet's payload.
//
//  //This example demonstrates how to set a packet's payload:
//  LONG packetHandle;
//  struct SSEM payload;
//  //you need to set the values of the variable "payload" yourself
//  packetHandle = API_InitSSEMPacket();
//  if (packetHandle!=0) {
//    if (API_SetSSEMParams(packetHandle, payload)==0) {
//      if (C2xCompletePacket(packetHandle)==0) {
//        C2xOutputPacket(packetHandle);
//      }
//    }
//  }
//                                                                             */
includes
{

}
variables
{
    struct SSEMITS_Container_ItsPduHeader {
        INT isValidFlag;   // necessary if this struct is used as an optional field of a SEQUENCE
        BYTE protocolVersion;  // INTEGER, 0..255;
        BYTE messageID;  // INTEGER, 0..255, denm(1), cam(2), poi(3), spatem(4), mapem(5), ivim(6), ev_rsr(7), tistpgtransaction(8), srem(9), ssem(10), evcsn(11), saem(12), rtcmem(13);
        DWORD stationID;  // INTEGER, 0..4294967295;
    };
    
    struct SSEMDSRC_IntersectionReferenceID {
        INT isValidFlag;   // necessary if this struct is used as an optional field of a SEQUENCE
        struct OPT_WORD_ASN region;  // INTEGER, OPTIONAL, 0..65535;
        WORD id;  // INTEGER, 0..65535;
    };
    
    struct SSEMDSRC_TemporaryID {
        INT isValidFlag;   // necessary if this struct is used as an optional field of a SEQUENCE
        CHAR string[5];
        INT  stringLength;
    };
    
    struct SSEMDSRC_VehicleID {
        INT isValidFlag;   // necessary if this struct is used as an optional field of a SEQUENCE
        INT choice;
        struct SSEMDSRC_TemporaryID entityID;  // OCTETSTRING;
        DWORD stationID;  // INTEGER, 0..4294967295;
    };
    
    struct SSEMReg_Empty {
    };
    
    struct SSEMDSRC_RegionalExtensionEmpty {
        INT isValidFlag;   // necessary if this struct is used as an optional field of a SEQUENCE
        BYTE regionId;  // INTEGER, 0..255, noRegion(0), addGrpA(1), addGrpB(2), addGrpC(3);
        struct SSEMReg_Empty regExtValue;  // TABLE;
    };
    
    struct SSEMDSRC_RequestorType {
        INT isValidFlag;   // necessary if this struct is used as an optional field of a SEQUENCE
        INT role;  // ENUMERATED, basicVehicle(0), publicTransport(1), specialTransport(2), dangerousGoods(3), roadWork(4), roadRescue(5), emergency(6), safetyCar(7), none_unknown(8), truck(9), motorcycle(10), roadSideSource(11), police(12), fire(13), ambulance(14), dot(15), transit(16), slowMoving(17), stopNgo(18), cyclist(19), pedestrian(20), nonMotorized(21), military(22);
        struct OPT_ENUM_ASN subrole;  // ENUMERATED, OPTIONAL, requestSubRoleUnKnown(0), requestSubRole1(1), requestSubRole2(2), requestSubRole3(3), requestSubRole4(4), requestSubRole5(5), requestSubRole6(6), requestSubRole7(7), requestSubRole8(8), requestSubRole9(9), requestSubRole10(10), requestSubRole11(11), requestSubRole12(12), requestSubRole13(13), requestSubRole14(14), requestSubRoleReserved(15);
        struct OPT_ENUM_ASN request;  // ENUMERATED, OPTIONAL, requestImportanceLevelUnKnown(0), requestImportanceLevel1(1), requestImportanceLevel2(2), requestImportanceLevel3(3), requestImportanceLevel4(4), requestImportanceLevel5(5), requestImportanceLevel6(6), requestImportanceLevel7(7), requestImportanceLevel8(8), requestImportanceLevel9(9), requestImportanceLevel10(10), requestImportanceLevel11(11), requestImportanceLevel12(12), requestImportanceLevel13(13), requestImportanceLevel14(14), requestImportanceReserved(15);
        struct OPT_BYTE_ASN iso3883;  // INTEGER, OPTIONAL, 0..255, passengerCar(0), saloon(1), convertibleSaloon(2), pullmanSaloon(3), stationWagon(4), truckStationWagon(5), coupe(6), convertible(7), multipurposePassengerCar(8), forwardControlPassengerCar(9), specialPassengerCar(10), bus(11), minibus(12), urbanBus(13), interurbanCoach(14), longDistanceCoach(15), articulatedBus(16), trolleyBus(17), specialBus(18), commercialVehicle(19), specialCommercialVehicle(20), specialVehicle(21), trailingTowingVehicle(22), semiTrailerTowingVehicle(23), trailer(24), busTrailer(25), generalPurposeTrailer(26), caravan(27), specialTrailer(28), semiTrailer(29), busSemiTrailer(30), generalPurposeSemiTrailer(31), specialSemiTrailer(32), roadTrain(33), passengerRoadTrain(34), articulatedRoadTrain(35), doubleRoadTrain(36), compositeRoadTrain(37), specialRoadTrain(38), moped(39), motorCycle(40);
        struct OPT_ENUM_ASN hpmsType;  // ENUMERATED, OPTIONAL, none(0), unknown(1), special(2), moto(3), car(4), carOther(5), bus(6), axleCnt2(7), axleCnt3(8), axleCnt4(9), axleCnt4Trailer(10), axleCnt5Trailer(11), axleCnt6Trailer(12), axleCnt5MultiTrailer(13), axleCnt6MultiTrailer(14), axleCnt7MultiTrailer(15);
        struct SSEMDSRC_RegionalExtensionEmpty regional;  // SEQUENCE, OPTIONAL;
    };
    
    struct SSEMDSRC_SignalRequesterInfo {
        INT isValidFlag;   // necessary if this struct is used as an optional field of a SEQUENCE
        struct SSEMDSRC_VehicleID id;  // CHOICE;
        BYTE request;  // INTEGER, 0..255;
        BYTE sequenceNumber;  // INTEGER, 0..127;
        struct OPT_ENUM_ASN role;  // ENUMERATED, OPTIONAL, basicVehicle(0), publicTransport(1), specialTransport(2), dangerousGoods(3), roadWork(4), roadRescue(5), emergency(6), safetyCar(7), none_unknown(8), truck(9), motorcycle(10), roadSideSource(11), police(12), fire(13), ambulance(14), dot(15), transit(16), slowMoving(17), stopNgo(18), cyclist(19), pedestrian(20), nonMotorized(21), military(22);
        struct SSEMDSRC_RequestorType typeData;  // SEQUENCE, OPTIONAL;
    };
    
    struct SSEMDSRC_IntersectionAccessPoint {
        INT isValidFlag;   // necessary if this struct is used as an optional field of a SEQUENCE
        INT choice;
        BYTE lane;  // INTEGER, 0..255;
        BYTE approach;  // INTEGER, 0..15;
        BYTE connection;  // INTEGER, 0..255;
    };
    
    struct SSEMAddGrpC_SignalStatusPackage_addGrpC {
        INT isValidFlag;   // necessary if this struct is used as an optional field of a SEQUENCE
        struct OPT_INT_ASN synchToSchedule;  // INTEGER, OPTIONAL, -122..121;
        struct OPT_ENUM_ASN rejectedReason;  // ENUMERATED, OPTIONAL, unknown(0), exceptionalCondition(1), maxWaitingTimeExceeded(2), ptPriorityDisabled(3), higherPTPriorityGranted(4), vehicleTrackingUnknown(5);
    };
    
    struct SSEMReg_SignalStatusPackage {
        struct SSEMAddGrpC_SignalStatusPackage_addGrpC addGrpC;  // SEQUENCE;
    };
    
    struct SSEMDSRC_RegionalExtensionSignalStatusPackage {
        INT isValidFlag;   // necessary if this struct is used as an optional field of a SEQUENCE
        BYTE regionId;  // INTEGER, 0..255, noRegion(0), addGrpA(1), addGrpB(2), addGrpC(3);
        struct SSEMReg_SignalStatusPackage regExtValue;  // TABLE;
    };
    
    struct SSEMDSRC_SignalStatusPackage_regional {
        INT isValidFlag;   // necessary if this struct is used as an optional field of a SEQUENCE
        INT length;
        struct SSEMDSRC_RegionalExtensionSignalStatusPackage arrayValue[4];  // SEQUENCE;
    };
    
    struct SSEMDSRC_SignalStatusPackage {
        INT isValidFlag;   // necessary if this struct is used as an optional field of a SEQUENCE
        struct SSEMDSRC_SignalRequesterInfo requester;  // SEQUENCE, OPTIONAL;
        struct SSEMDSRC_IntersectionAccessPoint inboundOn;  // CHOICE;
        struct SSEMDSRC_IntersectionAccessPoint outboundOn;  // CHOICE, OPTIONAL;
        struct OPT_DWORD_ASN minute;  // INTEGER, OPTIONAL, 0..527040;
        struct OPT_WORD_ASN second;  // INTEGER, OPTIONAL, 0..65535;
        struct OPT_WORD_ASN duration;  // INTEGER, OPTIONAL, 0..65535;
        INT status;  // ENUMERATED, unknown(0), requested(1), processing(2), watchOtherTraffic(3), granted(4), rejected(5), maxPresence(6), reserviceLocked(7);
        struct SSEMDSRC_SignalStatusPackage_regional regional;  // SEQUENCEOF, OPTIONAL;
    };
    
    struct SSEMDSRC_SignalStatusPackageList {
        INT isValidFlag;   // necessary if this struct is used as an optional field of a SEQUENCE
        INT length;
        struct SSEMDSRC_SignalStatusPackage arrayValue[32];  // SEQUENCE;
    };
    
    struct SSEMDSRC_SignalStatus_regional {
        INT isValidFlag;   // necessary if this struct is used as an optional field of a SEQUENCE
        INT length;
        struct SSEMDSRC_RegionalExtensionEmpty arrayValue[4];  // SEQUENCE;
    };
    
    struct SSEMDSRC_SignalStatus {
        INT isValidFlag;   // necessary if this struct is used as an optional field of a SEQUENCE
        BYTE sequenceNumber;  // INTEGER, 0..127;
        struct SSEMDSRC_IntersectionReferenceID id;  // SEQUENCE;
        struct SSEMDSRC_SignalStatusPackageList sigStatus;  // SEQUENCEOF;
        struct SSEMDSRC_SignalStatus_regional regional;  // SEQUENCEOF, OPTIONAL;
    };
    
    struct SSEMDSRC_SignalStatusList {
        INT isValidFlag;   // necessary if this struct is used as an optional field of a SEQUENCE
        INT length;
        struct SSEMDSRC_SignalStatus arrayValue[32];  // SEQUENCE;
    };
    
    struct SSEMDSRC_SignalStatusMessage_regional {
        INT isValidFlag;   // necessary if this struct is used as an optional field of a SEQUENCE
        INT length;
        struct SSEMDSRC_RegionalExtensionEmpty arrayValue[4];  // SEQUENCE;
    };
    
    struct SSEMDSRC_SignalStatusMessage {
        INT isValidFlag;   // necessary if this struct is used as an optional field of a SEQUENCE
        struct OPT_DWORD_ASN timeStamp;  // INTEGER, OPTIONAL, 0..527040;
        WORD second;  // INTEGER, 0..65535;
        struct OPT_BYTE_ASN sequenceNumber;  // INTEGER, OPTIONAL, 0..127;
        struct SSEMDSRC_SignalStatusList status;  // SEQUENCEOF;
        struct SSEMDSRC_SignalStatusMessage_regional regional;  // SEQUENCEOF, OPTIONAL;
    };
    
    struct SSEM {
        INT isValidFlag;   // necessary if this struct is used as an optional field of a SEQUENCE
        struct SSEMITS_Container_ItsPduHeader header;  // SEQUENCE;
        struct SSEMDSRC_SignalStatusMessage ssm;  // SEQUENCE;
    };
    
}

/*
// init function to create a simple packet handle
*/ 
LONG API_InitSSEMPacket()
{
  return C2xInitPacket("SSEM"); 
}

/*
// init function to create a simple packet handle and
// initialize the struct with valid data
*/ 
LONG API_InitSSEMPacket(struct SSEM msgStruct)
{
  long pktHandle;

  pktHandle = API_InitSSEMPacket();

  if (pktHandle != 0)
  {
    // create valid message and application data
    if (C2xCompletePacket(pktHandle) == 0) 
    {
      API_GetSSEMParams(pktHandle, msgStruct);
    }
  }
  return pktHandle;
}

/*
// init function to create a packet with security layer and
// initialize the struct with valid data
*/ 
LONG API_InitSSEMPacket(struct SSEM msgStruct, char packetTypeDesignator[], char certificateName[])
{
  long pktHandle, certHdl;

  // initialize the packet
  pktHandle = C2xInitPacket("SSEM", packetTypeDesignator);

  if (pktHandle != 0)
  {
    certHdl = C2xSecCertificateGetHandle(certificateName);  // get the certificate handle for the cert with name "certificateName"
    if (certHdl != 0) 
    {
      C2xSecPacketSetSignerHandle(pktHandle, certHdl); // set the certHdl to the packet
    }

    // create valid message and application data
    if (C2xCompletePacket(pktHandle) == 0) 
    {
      // copy application data to the application structure
      API_GetSSEMParams(pktHandle, msgStruct);
    }
  }
  return pktHandle;
}
    

int GetSSEMITS_Container_ItsPduHeaderParams(LONG packetHandle, struct SSEMITS_Container_ItsPduHeader value, char oldPath[])
{
  char newPath[300];
  int result;

  result = 0;

  snprintf(newPath, elcount(newPath), "%s.%s", oldPath, "protocolVersion");
  value.protocolVersion = C2xGetTokenInt(packetHandle, "SSEM", newPath);
  result = CheckLastError("SSEM", gkFuncRefGet, result);

  snprintf(newPath, elcount(newPath), "%s.%s", oldPath, "messageID");
  value.messageID = C2xGetTokenInt(packetHandle, "SSEM", newPath);
  result = CheckLastError("SSEM", gkFuncRefGet, result);

  snprintf(newPath, elcount(newPath), "%s.%s", oldPath, "stationID");
  value.stationID = C2xGetTokenInt64(packetHandle, "SSEM", newPath);
  result = CheckLastError("SSEM", gkFuncRefGet, result);

  return result;
}

int SetSSEMITS_Container_ItsPduHeaderParams(LONG packetHandle, struct SSEMITS_Container_ItsPduHeader value, char oldPath[])
{
  char newPath[300];
  int result;

  result = 0;

  snprintf(newPath, elcount(newPath), "%s.%s", oldPath, "protocolVersion");
  C2xSetTokenInt(packetHandle, "SSEM", newPath, value.protocolVersion);
  result = CheckLastError("SSEM", gkFuncRefGet, result);

  snprintf(newPath, elcount(newPath), "%s.%s", oldPath, "messageID");
  C2xSetTokenInt(packetHandle, "SSEM", newPath, value.messageID);
  result = CheckLastError("SSEM", gkFuncRefGet, result);

  snprintf(newPath, elcount(newPath), "%s.%s", oldPath, "stationID");
  C2xSetTokenInt64(packetHandle, "SSEM", newPath, value.stationID);
  result = CheckLastError("SSEM", gkFuncRefGet, result);

  return result;
}

int GetSSEMDSRC_IntersectionReferenceIDParams(LONG packetHandle, struct SSEMDSRC_IntersectionReferenceID value, char oldPath[])
{
  char newPath[300];
  int result;

  result = 0;

  snprintf(newPath, elcount(newPath), "%s.%s", oldPath, "region");
  value.region.isValidFlag = C2xIsTokenAvailable(packetHandle, "SSEM", newPath);
  if(value.region.isValidFlag==1)
  {
    value.region.value = C2xGetTokenInt(packetHandle, "SSEM", newPath);
    result = CheckLastError("SSEM", gkFuncRefGet, result);
  }
  snprintf(newPath, elcount(newPath), "%s.%s", oldPath, "id");
  value.id = C2xGetTokenInt(packetHandle, "SSEM", newPath);
  result = CheckLastError("SSEM", gkFuncRefGet, result);

  return result;
}

int SetSSEMDSRC_IntersectionReferenceIDParams(LONG packetHandle, struct SSEMDSRC_IntersectionReferenceID value, char oldPath[])
{
  char newPath[300];
  int result;

  result = 0;

  snprintf(newPath, elcount(newPath), "%s.%s", oldPath, "region");
  if(value.region.isValidFlag==1)
  {
    C2xSetTokenInt(packetHandle, "SSEM", newPath, value.region.value);
    result = CheckLastError("SSEM", gkFuncRefGet, result);
  }
  else
  {
    if( C2xIsTokenAvailable(packetHandle, "SSEM", newPath) )
    {
      C2xRemoveToken(packetHandle, "SSEM", newPath);
    }
  }

  snprintf(newPath, elcount(newPath), "%s.%s", oldPath, "id");
  C2xSetTokenInt(packetHandle, "SSEM", newPath, value.id);
  result = CheckLastError("SSEM", gkFuncRefGet, result);

  return result;
}

int GetSSEMDSRC_VehicleIDParams(LONG packetHandle, struct SSEMDSRC_VehicleID value, char oldPath[])
{
  char newPath[300];
  char buffer[300];
  int result;

  result = 0;

  value.choice = C2xGetTokenInt(packetHandle, "SSEM", oldPath);

  switch(value.choice)
  {
    case 0:
    {
      snprintf(newPath, elcount(newPath), "%s.%s", oldPath, "entityID");
      value.entityID.stringLength = C2xGetTokenData(packetHandle, "SSEM", newPath, elcount(value.entityID.string), value.entityID.string);
      result = CheckLastError("SSEM", gkFuncRefGet, result);
    }
    break;
    case 1:
    {
      snprintf(newPath, elcount(newPath), "%s.%s", oldPath, "stationID");
      value.stationID = C2xGetTokenInt64(packetHandle, "SSEM", newPath);
      result = CheckLastError("SSEM", gkFuncRefGet, result);
    }
    break;
  }
  return result;
}

int SetSSEMDSRC_VehicleIDParams(LONG packetHandle, struct SSEMDSRC_VehicleID value, char oldPath[])
{
  char newPath[300];
  char buffer[300];
  int result;

  result = 0;

  switch(value.choice)
  {
    case 0:
    {
      snprintf(newPath, elcount(newPath), "%s.%s", oldPath, "entityID");
      C2xSetTokenData(packetHandle, "SSEM", newPath, value.entityID.stringLength, value.entityID.string);
      result = CheckLastError("SSEM", gkFuncRefGet, result);
    }
    break;
    case 1:
    {
      snprintf(newPath, elcount(newPath), "%s.%s", oldPath, "stationID");
      C2xSetTokenInt64(packetHandle, "SSEM", newPath, value.stationID);
      result = CheckLastError("SSEM", gkFuncRefGet, result);
    }
    break;
  }
  return result;
}

int GetSSEMDSRC_RegionalExtensionEmptyParams(LONG packetHandle, struct SSEMDSRC_RegionalExtensionEmpty value, char oldPath[])
{
  char newPath[300];
  int result;

  result = 0;

  snprintf(newPath, elcount(newPath), "%s.%s", oldPath, "regionId");
  value.regionId = C2xGetTokenInt(packetHandle, "SSEM", newPath);
  result = CheckLastError("SSEM", gkFuncRefGet, result);

  return result;
}

int SetSSEMDSRC_RegionalExtensionEmptyParams(LONG packetHandle, struct SSEMDSRC_RegionalExtensionEmpty value, char oldPath[])
{
  char newPath[300];
  int result;

  result = 0;


  return result;
}

int GetSSEMDSRC_RequestorTypeParams(LONG packetHandle, struct SSEMDSRC_RequestorType value, char oldPath[])
{
  char newPath[300];
  int result;

  result = 0;

  snprintf(newPath, elcount(newPath), "%s.%s", oldPath, "role");
  value.role = C2xGetTokenInt(packetHandle, "SSEM", newPath);
  result = CheckLastError("SSEM", gkFuncRefGet, result);

  snprintf(newPath, elcount(newPath), "%s.%s", oldPath, "subrole");
  value.subrole.isValidFlag = C2xIsTokenAvailable(packetHandle, "SSEM", newPath);
  if(value.subrole.isValidFlag==1)
  {
    value.subrole.value = C2xGetTokenInt(packetHandle, "SSEM", newPath);
    result = CheckLastError("SSEM", gkFuncRefGet, result);
  }
  snprintf(newPath, elcount(newPath), "%s.%s", oldPath, "request");
  value.request.isValidFlag = C2xIsTokenAvailable(packetHandle, "SSEM", newPath);
  if(value.request.isValidFlag==1)
  {
    value.request.value = C2xGetTokenInt(packetHandle, "SSEM", newPath);
    result = CheckLastError("SSEM", gkFuncRefGet, result);
  }
  snprintf(newPath, elcount(newPath), "%s.%s", oldPath, "iso3883");
  value.iso3883.isValidFlag = C2xIsTokenAvailable(packetHandle, "SSEM", newPath);
  if(value.iso3883.isValidFlag==1)
  {
    value.iso3883.value = C2xGetTokenInt(packetHandle, "SSEM", newPath);
    result = CheckLastError("SSEM", gkFuncRefGet, result);
  }
  snprintf(newPath, elcount(newPath), "%s.%s", oldPath, "hpmsType");
  value.hpmsType.isValidFlag = C2xIsTokenAvailable(packetHandle, "SSEM", newPath);
  if(value.hpmsType.isValidFlag==1)
  {
    value.hpmsType.value = C2xGetTokenInt(packetHandle, "SSEM", newPath);
    result = CheckLastError("SSEM", gkFuncRefGet, result);
  }
  snprintf(newPath, elcount(newPath), "%s.%s", oldPath, "regional");
  value.regional.isValidFlag = C2xIsTokenAvailable(packetHandle, "SSEM", newPath);
  if(value.regional.isValidFlag==1)
  {
    GetSSEMDSRC_RegionalExtensionEmptyParams(packetHandle, value.regional, newPath);
    result = CheckLastError("SSEM", gkFuncRefGet, result);
  }
  return result;
}

int SetSSEMDSRC_RequestorTypeParams(LONG packetHandle, struct SSEMDSRC_RequestorType value, char oldPath[])
{
  char newPath[300];
  int result;

  result = 0;

  snprintf(newPath, elcount(newPath), "%s.%s", oldPath, "role");
  C2xSetTokenInt(packetHandle, "SSEM", newPath, value.role);
  result = CheckLastError("SSEM", gkFuncRefGet, result);

  snprintf(newPath, elcount(newPath), "%s.%s", oldPath, "subrole");
  if(value.subrole.isValidFlag==1)
  {
    C2xSetTokenInt(packetHandle, "SSEM", newPath, value.subrole.value);
    result = CheckLastError("SSEM", gkFuncRefGet, result);
  }
  else
  {
    if( C2xIsTokenAvailable(packetHandle, "SSEM", newPath) )
    {
      C2xRemoveToken(packetHandle, "SSEM", newPath);
    }
  }

  snprintf(newPath, elcount(newPath), "%s.%s", oldPath, "request");
  if(value.request.isValidFlag==1)
  {
    C2xSetTokenInt(packetHandle, "SSEM", newPath, value.request.value);
    result = CheckLastError("SSEM", gkFuncRefGet, result);
  }
  else
  {
    if( C2xIsTokenAvailable(packetHandle, "SSEM", newPath) )
    {
      C2xRemoveToken(packetHandle, "SSEM", newPath);
    }
  }

  snprintf(newPath, elcount(newPath), "%s.%s", oldPath, "iso3883");
  if(value.iso3883.isValidFlag==1)
  {
    C2xSetTokenInt(packetHandle, "SSEM", newPath, value.iso3883.value);
    result = CheckLastError("SSEM", gkFuncRefGet, result);
  }
  else
  {
    if( C2xIsTokenAvailable(packetHandle, "SSEM", newPath) )
    {
      C2xRemoveToken(packetHandle, "SSEM", newPath);
    }
  }

  snprintf(newPath, elcount(newPath), "%s.%s", oldPath, "hpmsType");
  if(value.hpmsType.isValidFlag==1)
  {
    C2xSetTokenInt(packetHandle, "SSEM", newPath, value.hpmsType.value);
    result = CheckLastError("SSEM", gkFuncRefGet, result);
  }
  else
  {
    if( C2xIsTokenAvailable(packetHandle, "SSEM", newPath) )
    {
      C2xRemoveToken(packetHandle, "SSEM", newPath);
    }
  }

  snprintf(newPath, elcount(newPath), "%s.%s", oldPath, "regional");
  if(value.regional.isValidFlag==1)
  {
    SetSSEMDSRC_RegionalExtensionEmptyParams(packetHandle, value.regional, newPath);
    result = CheckLastError("SSEM", gkFuncRefGet, result);
  }
  else
  {
    if( C2xIsTokenAvailable(packetHandle, "SSEM", newPath) )
    {
      C2xRemoveToken(packetHandle, "SSEM", newPath);
    }
  }

  return result;
}

int GetSSEMDSRC_SignalRequesterInfoParams(LONG packetHandle, struct SSEMDSRC_SignalRequesterInfo value, char oldPath[])
{
  char newPath[300];
  int result;

  result = 0;

  snprintf(newPath, elcount(newPath), "%s.%s", oldPath, "id");
  GetSSEMDSRC_VehicleIDParams(packetHandle, value.id, newPath);
  result = CheckLastError("SSEM", gkFuncRefGet, result);

  snprintf(newPath, elcount(newPath), "%s.%s", oldPath, "request");
  value.request = C2xGetTokenInt(packetHandle, "SSEM", newPath);
  result = CheckLastError("SSEM", gkFuncRefGet, result);

  snprintf(newPath, elcount(newPath), "%s.%s", oldPath, "sequenceNumber");
  value.sequenceNumber = C2xGetTokenInt(packetHandle, "SSEM", newPath);
  result = CheckLastError("SSEM", gkFuncRefGet, result);

  snprintf(newPath, elcount(newPath), "%s.%s", oldPath, "role");
  value.role.isValidFlag = C2xIsTokenAvailable(packetHandle, "SSEM", newPath);
  if(value.role.isValidFlag==1)
  {
    value.role.value = C2xGetTokenInt(packetHandle, "SSEM", newPath);
    result = CheckLastError("SSEM", gkFuncRefGet, result);
  }
  snprintf(newPath, elcount(newPath), "%s.%s", oldPath, "typeData");
  value.typeData.isValidFlag = C2xIsTokenAvailable(packetHandle, "SSEM", newPath);
  if(value.typeData.isValidFlag==1)
  {
    GetSSEMDSRC_RequestorTypeParams(packetHandle, value.typeData, newPath);
    result = CheckLastError("SSEM", gkFuncRefGet, result);
  }
  return result;
}

int SetSSEMDSRC_SignalRequesterInfoParams(LONG packetHandle, struct SSEMDSRC_SignalRequesterInfo value, char oldPath[])
{
  char newPath[300];
  int result;

  result = 0;

  snprintf(newPath, elcount(newPath), "%s.%s", oldPath, "id");
  SetSSEMDSRC_VehicleIDParams(packetHandle, value.id, newPath);
  result = CheckLastError("SSEM", gkFuncRefGet, result);

  snprintf(newPath, elcount(newPath), "%s.%s", oldPath, "request");
  C2xSetTokenInt(packetHandle, "SSEM", newPath, value.request);
  result = CheckLastError("SSEM", gkFuncRefGet, result);

  snprintf(newPath, elcount(newPath), "%s.%s", oldPath, "sequenceNumber");
  C2xSetTokenInt(packetHandle, "SSEM", newPath, value.sequenceNumber);
  result = CheckLastError("SSEM", gkFuncRefGet, result);

  snprintf(newPath, elcount(newPath), "%s.%s", oldPath, "role");
  if(value.role.isValidFlag==1)
  {
    C2xSetTokenInt(packetHandle, "SSEM", newPath, value.role.value);
    result = CheckLastError("SSEM", gkFuncRefGet, result);
  }
  else
  {
    if( C2xIsTokenAvailable(packetHandle, "SSEM", newPath) )
    {
      C2xRemoveToken(packetHandle, "SSEM", newPath);
    }
  }

  snprintf(newPath, elcount(newPath), "%s.%s", oldPath, "typeData");
  if(value.typeData.isValidFlag==1)
  {
    SetSSEMDSRC_RequestorTypeParams(packetHandle, value.typeData, newPath);
    result = CheckLastError("SSEM", gkFuncRefGet, result);
  }
  else
  {
    if( C2xIsTokenAvailable(packetHandle, "SSEM", newPath) )
    {
      C2xRemoveToken(packetHandle, "SSEM", newPath);
    }
  }

  return result;
}

int GetSSEMDSRC_IntersectionAccessPointParams(LONG packetHandle, struct SSEMDSRC_IntersectionAccessPoint value, char oldPath[])
{
  char newPath[300];
  int result;

  result = 0;

  value.choice = C2xGetTokenInt(packetHandle, "SSEM", oldPath);

  switch(value.choice)
  {
    case 0:
    {
      snprintf(newPath, elcount(newPath), "%s.%s", oldPath, "lane");
      value.lane = C2xGetTokenInt(packetHandle, "SSEM", newPath);
      result = CheckLastError("SSEM", gkFuncRefGet, result);
    }
    break;
    case 1:
    {
      snprintf(newPath, elcount(newPath), "%s.%s", oldPath, "approach");
      value.approach = C2xGetTokenInt(packetHandle, "SSEM", newPath);
      result = CheckLastError("SSEM", gkFuncRefGet, result);
    }
    break;
    case 2:
    {
      snprintf(newPath, elcount(newPath), "%s.%s", oldPath, "connection");
      value.connection = C2xGetTokenInt(packetHandle, "SSEM", newPath);
      result = CheckLastError("SSEM", gkFuncRefGet, result);
    }
    break;
  }
  return result;
}

int SetSSEMDSRC_IntersectionAccessPointParams(LONG packetHandle, struct SSEMDSRC_IntersectionAccessPoint value, char oldPath[])
{
  char newPath[300];
  int result;

  result = 0;

  switch(value.choice)
  {
    case 0:
    {
      snprintf(newPath, elcount(newPath), "%s.%s", oldPath, "lane");
      C2xSetTokenInt(packetHandle, "SSEM", newPath, value.lane);
      result = CheckLastError("SSEM", gkFuncRefGet, result);
    }
    break;
    case 1:
    {
      snprintf(newPath, elcount(newPath), "%s.%s", oldPath, "approach");
      C2xSetTokenInt(packetHandle, "SSEM", newPath, value.approach);
      result = CheckLastError("SSEM", gkFuncRefGet, result);
    }
    break;
    case 2:
    {
      snprintf(newPath, elcount(newPath), "%s.%s", oldPath, "connection");
      C2xSetTokenInt(packetHandle, "SSEM", newPath, value.connection);
      result = CheckLastError("SSEM", gkFuncRefGet, result);
    }
    break;
  }
  return result;
}

int GetSSEMAddGrpC_SignalStatusPackage_addGrpCParams(LONG packetHandle, struct SSEMAddGrpC_SignalStatusPackage_addGrpC value, char oldPath[])
{
  char newPath[300];
  int result;

  result = 0;

  snprintf(newPath, elcount(newPath), "%s.%s", oldPath, "synchToSchedule");
  value.synchToSchedule.isValidFlag = C2xIsTokenAvailable(packetHandle, "SSEM", newPath);
  if(value.synchToSchedule.isValidFlag==1)
  {
    value.synchToSchedule.value = C2xGetTokenInt(packetHandle, "SSEM", newPath);
    result = CheckLastError("SSEM", gkFuncRefGet, result);
  }
  snprintf(newPath, elcount(newPath), "%s.%s", oldPath, "rejectedReason");
  value.rejectedReason.isValidFlag = C2xIsTokenAvailable(packetHandle, "SSEM", newPath);
  if(value.rejectedReason.isValidFlag==1)
  {
    value.rejectedReason.value = C2xGetTokenInt(packetHandle, "SSEM", newPath);
    result = CheckLastError("SSEM", gkFuncRefGet, result);
  }
  return result;
}

int SetSSEMAddGrpC_SignalStatusPackage_addGrpCParams(LONG packetHandle, struct SSEMAddGrpC_SignalStatusPackage_addGrpC value, char oldPath[])
{
  char newPath[300];
  int result;

  result = 0;

  snprintf(newPath, elcount(newPath), "%s.%s", oldPath, "synchToSchedule");
  if(value.synchToSchedule.isValidFlag==1)
  {
    C2xSetTokenInt(packetHandle, "SSEM", newPath, value.synchToSchedule.value);
    result = CheckLastError("SSEM", gkFuncRefGet, result);
  }
  else
  {
    if( C2xIsTokenAvailable(packetHandle, "SSEM", newPath) )
    {
      C2xRemoveToken(packetHandle, "SSEM", newPath);
    }
  }

  snprintf(newPath, elcount(newPath), "%s.%s", oldPath, "rejectedReason");
  if(value.rejectedReason.isValidFlag==1)
  {
    C2xSetTokenInt(packetHandle, "SSEM", newPath, value.rejectedReason.value);
    result = CheckLastError("SSEM", gkFuncRefGet, result);
  }
  else
  {
    if( C2xIsTokenAvailable(packetHandle, "SSEM", newPath) )
    {
      C2xRemoveToken(packetHandle, "SSEM", newPath);
    }
  }

  return result;
}

int GetSSEMReg_SignalStatusPackageParams(LONG packetHandle, WORD tableKey, struct SSEMReg_SignalStatusPackage value, char oldPath[])
{
  char newPath[300];
  int result;

  result = 0;

  switch(tableKey)
  {
    case 3:
    {
      snprintf(newPath, elcount(newPath), "%s.%s", oldPath, "addGrpC");
      GetSSEMAddGrpC_SignalStatusPackage_addGrpCParams(packetHandle, value.addGrpC, newPath);
      result = CheckLastError("SSEM", gkFuncRefGet, result);
    }
    break;
  }
  return result;
}

int SetSSEMReg_SignalStatusPackageParams(LONG packetHandle, WORD tableKey, struct SSEMReg_SignalStatusPackage value, char oldPath[])
{
  char newPath[300];
  int result;

  result = 0;

  switch(tableKey)
  {
    case 3:
    {
      snprintf(newPath, elcount(newPath), "%s.%s", oldPath, "addGrpC");
      SetSSEMAddGrpC_SignalStatusPackage_addGrpCParams(packetHandle, value.addGrpC, newPath);
      result = CheckLastError("SSEM", gkFuncRefGet, result);
    }
    break;
  }
  return result;
}

int GetSSEMDSRC_RegionalExtensionSignalStatusPackageParams(LONG packetHandle, struct SSEMDSRC_RegionalExtensionSignalStatusPackage value, char oldPath[])
{
  char newPath[300];
  int result;

  result = 0;

  snprintf(newPath, elcount(newPath), "%s.%s", oldPath, "regionId");
  value.regionId = C2xGetTokenInt(packetHandle, "SSEM", newPath);
  result = CheckLastError("SSEM", gkFuncRefGet, result);

  snprintf(newPath, elcount(newPath), "%s.%s", oldPath, "regExtValue");
  GetSSEMReg_SignalStatusPackageParams(packetHandle, value.regionId, value.regExtValue, newPath);
  result = CheckLastError("SSEM", gkFuncRefGet, result);

  return result;
}

int SetSSEMDSRC_RegionalExtensionSignalStatusPackageParams(LONG packetHandle, struct SSEMDSRC_RegionalExtensionSignalStatusPackage value, char oldPath[])
{
  char newPath[300];
  int result;

  result = 0;


  snprintf(newPath, elcount(newPath), "%s.%s", oldPath, "regExtValue");
  SetSSEMReg_SignalStatusPackageParams(packetHandle, value.regionId, value.regExtValue, newPath);
  result = CheckLastError("SSEM", gkFuncRefGet, result);

  return result;
}

int GetSSEMDSRC_SignalStatusPackage_regionalParams(LONG packetHandle, struct SSEMDSRC_SignalStatusPackage_regional value, char oldPath[])
{
  char newPath[300]; 
  int i;
  int result;

  result = 0;

  value.length = C2xGetTokenInt(packetHandle, "SSEM", oldPath);
  if((result = CheckLastError("SSEM", gkFuncRefGet, result))==0)
  {
    for(i=0; i<value.length; i++)
    {
      snprintf(newPath, elcount(newPath), "%s[%d]", oldPath, i);
      GetSSEMDSRC_RegionalExtensionSignalStatusPackageParams(packetHandle, value.arrayValue[i], newPath);
      result = CheckLastError("SSEM", gkFuncRefGet, result);
    }
  }
  return result;
}

int SetSSEMDSRC_SignalStatusPackage_regionalParams(LONG packetHandle, struct SSEMDSRC_SignalStatusPackage_regional value, char oldPath[])
{
  char newPath[300]; 
  int i;
  int result;

  result = 0;

  C2xRemoveToken(packetHandle, "SSEM", oldPath);
  for(i=0; i<value.length; i++)
  {
    snprintf(newPath, elcount(newPath), "%s[%d]", oldPath, i);
    SetSSEMDSRC_RegionalExtensionSignalStatusPackageParams(packetHandle, value.arrayValue[i], newPath);
    result = CheckLastError("SSEM", gkFuncRefGet, result);
  }
  return result;
}

int GetSSEMDSRC_SignalStatusPackageParams(LONG packetHandle, struct SSEMDSRC_SignalStatusPackage value, char oldPath[])
{
  char newPath[300];
  int result;

  result = 0;

  snprintf(newPath, elcount(newPath), "%s.%s", oldPath, "requester");
  value.requester.isValidFlag = C2xIsTokenAvailable(packetHandle, "SSEM", newPath);
  if(value.requester.isValidFlag==1)
  {
    GetSSEMDSRC_SignalRequesterInfoParams(packetHandle, value.requester, newPath);
    result = CheckLastError("SSEM", gkFuncRefGet, result);
  }
  snprintf(newPath, elcount(newPath), "%s.%s", oldPath, "inboundOn");
  GetSSEMDSRC_IntersectionAccessPointParams(packetHandle, value.inboundOn, newPath);
  result = CheckLastError("SSEM", gkFuncRefGet, result);

  snprintf(newPath, elcount(newPath), "%s.%s", oldPath, "outboundOn");
  value.outboundOn.isValidFlag = C2xIsTokenAvailable(packetHandle, "SSEM", newPath);
  if(value.outboundOn.isValidFlag==1)
  {
    GetSSEMDSRC_IntersectionAccessPointParams(packetHandle, value.outboundOn, newPath);
    result = CheckLastError("SSEM", gkFuncRefGet, result);
  }
  snprintf(newPath, elcount(newPath), "%s.%s", oldPath, "minute");
  value.minute.isValidFlag = C2xIsTokenAvailable(packetHandle, "SSEM", newPath);
  if(value.minute.isValidFlag==1)
  {
    value.minute.value = C2xGetTokenInt(packetHandle, "SSEM", newPath);
    result = CheckLastError("SSEM", gkFuncRefGet, result);
  }
  snprintf(newPath, elcount(newPath), "%s.%s", oldPath, "second");
  value.second.isValidFlag = C2xIsTokenAvailable(packetHandle, "SSEM", newPath);
  if(value.second.isValidFlag==1)
  {
    value.second.value = C2xGetTokenInt(packetHandle, "SSEM", newPath);
    result = CheckLastError("SSEM", gkFuncRefGet, result);
  }
  snprintf(newPath, elcount(newPath), "%s.%s", oldPath, "duration");
  value.duration.isValidFlag = C2xIsTokenAvailable(packetHandle, "SSEM", newPath);
  if(value.duration.isValidFlag==1)
  {
    value.duration.value = C2xGetTokenInt(packetHandle, "SSEM", newPath);
    result = CheckLastError("SSEM", gkFuncRefGet, result);
  }
  snprintf(newPath, elcount(newPath), "%s.%s", oldPath, "status");
  value.status = C2xGetTokenInt(packetHandle, "SSEM", newPath);
  result = CheckLastError("SSEM", gkFuncRefGet, result);

  snprintf(newPath, elcount(newPath), "%s.%s", oldPath, "regional");
  value.regional.isValidFlag = C2xIsTokenAvailable(packetHandle, "SSEM", newPath);
  if(value.regional.isValidFlag==1)
  {
    GetSSEMDSRC_SignalStatusPackage_regionalParams(packetHandle, value.regional, newPath);
    result = CheckLastError("SSEM", gkFuncRefGet, result);
  }
  return result;
}

int SetSSEMDSRC_SignalStatusPackageParams(LONG packetHandle, struct SSEMDSRC_SignalStatusPackage value, char oldPath[])
{
  char newPath[300];
  int result;

  result = 0;

  snprintf(newPath, elcount(newPath), "%s.%s", oldPath, "requester");
  if(value.requester.isValidFlag==1)
  {
    SetSSEMDSRC_SignalRequesterInfoParams(packetHandle, value.requester, newPath);
    result = CheckLastError("SSEM", gkFuncRefGet, result);
  }
  else
  {
    if( C2xIsTokenAvailable(packetHandle, "SSEM", newPath) )
    {
      C2xRemoveToken(packetHandle, "SSEM", newPath);
    }
  }

  snprintf(newPath, elcount(newPath), "%s.%s", oldPath, "inboundOn");
  SetSSEMDSRC_IntersectionAccessPointParams(packetHandle, value.inboundOn, newPath);
  result = CheckLastError("SSEM", gkFuncRefGet, result);

  snprintf(newPath, elcount(newPath), "%s.%s", oldPath, "outboundOn");
  if(value.outboundOn.isValidFlag==1)
  {
    SetSSEMDSRC_IntersectionAccessPointParams(packetHandle, value.outboundOn, newPath);
    result = CheckLastError("SSEM", gkFuncRefGet, result);
  }
  else
  {
    if( C2xIsTokenAvailable(packetHandle, "SSEM", newPath) )
    {
      C2xRemoveToken(packetHandle, "SSEM", newPath);
    }
  }

  snprintf(newPath, elcount(newPath), "%s.%s", oldPath, "minute");
  if(value.minute.isValidFlag==1)
  {
    C2xSetTokenInt(packetHandle, "SSEM", newPath, value.minute.value);
    result = CheckLastError("SSEM", gkFuncRefGet, result);
  }
  else
  {
    if( C2xIsTokenAvailable(packetHandle, "SSEM", newPath) )
    {
      C2xRemoveToken(packetHandle, "SSEM", newPath);
    }
  }

  snprintf(newPath, elcount(newPath), "%s.%s", oldPath, "second");
  if(value.second.isValidFlag==1)
  {
    C2xSetTokenInt(packetHandle, "SSEM", newPath, value.second.value);
    result = CheckLastError("SSEM", gkFuncRefGet, result);
  }
  else
  {
    if( C2xIsTokenAvailable(packetHandle, "SSEM", newPath) )
    {
      C2xRemoveToken(packetHandle, "SSEM", newPath);
    }
  }

  snprintf(newPath, elcount(newPath), "%s.%s", oldPath, "duration");
  if(value.duration.isValidFlag==1)
  {
    C2xSetTokenInt(packetHandle, "SSEM", newPath, value.duration.value);
    result = CheckLastError("SSEM", gkFuncRefGet, result);
  }
  else
  {
    if( C2xIsTokenAvailable(packetHandle, "SSEM", newPath) )
    {
      C2xRemoveToken(packetHandle, "SSEM", newPath);
    }
  }

  snprintf(newPath, elcount(newPath), "%s.%s", oldPath, "status");
  C2xSetTokenInt(packetHandle, "SSEM", newPath, value.status);
  result = CheckLastError("SSEM", gkFuncRefGet, result);

  snprintf(newPath, elcount(newPath), "%s.%s", oldPath, "regional");
  if(value.regional.isValidFlag==1)
  {
    SetSSEMDSRC_SignalStatusPackage_regionalParams(packetHandle, value.regional, newPath);
    result = CheckLastError("SSEM", gkFuncRefGet, result);
  }
  else
  {
    if( C2xIsTokenAvailable(packetHandle, "SSEM", newPath) )
    {
      C2xRemoveToken(packetHandle, "SSEM", newPath);
    }
  }

  return result;
}

int GetSSEMDSRC_SignalStatusPackageListParams(LONG packetHandle, struct SSEMDSRC_SignalStatusPackageList value, char oldPath[])
{
  char newPath[300]; 
  int i;
  int result;

  result = 0;

  value.length = C2xGetTokenInt(packetHandle, "SSEM", oldPath);
  if((result = CheckLastError("SSEM", gkFuncRefGet, result))==0)
  {
    for(i=0; i<value.length; i++)
    {
      snprintf(newPath, elcount(newPath), "%s[%d]", oldPath, i);
      GetSSEMDSRC_SignalStatusPackageParams(packetHandle, value.arrayValue[i], newPath);
      result = CheckLastError("SSEM", gkFuncRefGet, result);
    }
  }
  return result;
}

int SetSSEMDSRC_SignalStatusPackageListParams(LONG packetHandle, struct SSEMDSRC_SignalStatusPackageList value, char oldPath[])
{
  char newPath[300]; 
  int i;
  int result;

  result = 0;

  C2xRemoveToken(packetHandle, "SSEM", oldPath);
  for(i=0; i<value.length; i++)
  {
    snprintf(newPath, elcount(newPath), "%s[%d]", oldPath, i);
    SetSSEMDSRC_SignalStatusPackageParams(packetHandle, value.arrayValue[i], newPath);
    result = CheckLastError("SSEM", gkFuncRefGet, result);
  }
  return result;
}

int GetSSEMDSRC_SignalStatus_regionalParams(LONG packetHandle, struct SSEMDSRC_SignalStatus_regional value, char oldPath[])
{
  char newPath[300]; 
  int i;
  int result;

  result = 0;

  value.length = C2xGetTokenInt(packetHandle, "SSEM", oldPath);
  if((result = CheckLastError("SSEM", gkFuncRefGet, result))==0)
  {
    for(i=0; i<value.length; i++)
    {
      snprintf(newPath, elcount(newPath), "%s[%d]", oldPath, i);
      GetSSEMDSRC_RegionalExtensionEmptyParams(packetHandle, value.arrayValue[i], newPath);
      result = CheckLastError("SSEM", gkFuncRefGet, result);
    }
  }
  return result;
}

int SetSSEMDSRC_SignalStatus_regionalParams(LONG packetHandle, struct SSEMDSRC_SignalStatus_regional value, char oldPath[])
{
  char newPath[300]; 
  int i;
  int result;

  result = 0;

  C2xRemoveToken(packetHandle, "SSEM", oldPath);
  for(i=0; i<value.length; i++)
  {
    snprintf(newPath, elcount(newPath), "%s[%d]", oldPath, i);
    SetSSEMDSRC_RegionalExtensionEmptyParams(packetHandle, value.arrayValue[i], newPath);
    result = CheckLastError("SSEM", gkFuncRefGet, result);
  }
  return result;
}

int GetSSEMDSRC_SignalStatusParams(LONG packetHandle, struct SSEMDSRC_SignalStatus value, char oldPath[])
{
  char newPath[300];
  int result;

  result = 0;

  snprintf(newPath, elcount(newPath), "%s.%s", oldPath, "sequenceNumber");
  value.sequenceNumber = C2xGetTokenInt(packetHandle, "SSEM", newPath);
  result = CheckLastError("SSEM", gkFuncRefGet, result);

  snprintf(newPath, elcount(newPath), "%s.%s", oldPath, "id");
  GetSSEMDSRC_IntersectionReferenceIDParams(packetHandle, value.id, newPath);
  result = CheckLastError("SSEM", gkFuncRefGet, result);

  snprintf(newPath, elcount(newPath), "%s.%s", oldPath, "sigStatus");
  GetSSEMDSRC_SignalStatusPackageListParams(packetHandle, value.sigStatus, newPath);
  result = CheckLastError("SSEM", gkFuncRefGet, result);

  snprintf(newPath, elcount(newPath), "%s.%s", oldPath, "regional");
  value.regional.isValidFlag = C2xIsTokenAvailable(packetHandle, "SSEM", newPath);
  if(value.regional.isValidFlag==1)
  {
    GetSSEMDSRC_SignalStatus_regionalParams(packetHandle, value.regional, newPath);
    result = CheckLastError("SSEM", gkFuncRefGet, result);
  }
  return result;
}

int SetSSEMDSRC_SignalStatusParams(LONG packetHandle, struct SSEMDSRC_SignalStatus value, char oldPath[])
{
  char newPath[300];
  int result;

  result = 0;

  snprintf(newPath, elcount(newPath), "%s.%s", oldPath, "sequenceNumber");
  C2xSetTokenInt(packetHandle, "SSEM", newPath, value.sequenceNumber);
  result = CheckLastError("SSEM", gkFuncRefGet, result);

  snprintf(newPath, elcount(newPath), "%s.%s", oldPath, "id");
  SetSSEMDSRC_IntersectionReferenceIDParams(packetHandle, value.id, newPath);
  result = CheckLastError("SSEM", gkFuncRefGet, result);

  snprintf(newPath, elcount(newPath), "%s.%s", oldPath, "sigStatus");
  SetSSEMDSRC_SignalStatusPackageListParams(packetHandle, value.sigStatus, newPath);
  result = CheckLastError("SSEM", gkFuncRefGet, result);

  snprintf(newPath, elcount(newPath), "%s.%s", oldPath, "regional");
  if(value.regional.isValidFlag==1)
  {
    SetSSEMDSRC_SignalStatus_regionalParams(packetHandle, value.regional, newPath);
    result = CheckLastError("SSEM", gkFuncRefGet, result);
  }
  else
  {
    if( C2xIsTokenAvailable(packetHandle, "SSEM", newPath) )
    {
      C2xRemoveToken(packetHandle, "SSEM", newPath);
    }
  }

  return result;
}

int GetSSEMDSRC_SignalStatusListParams(LONG packetHandle, struct SSEMDSRC_SignalStatusList value, char oldPath[])
{
  char newPath[300]; 
  int i;
  int result;

  result = 0;

  value.length = C2xGetTokenInt(packetHandle, "SSEM", oldPath);
  if((result = CheckLastError("SSEM", gkFuncRefGet, result))==0)
  {
    for(i=0; i<value.length; i++)
    {
      snprintf(newPath, elcount(newPath), "%s[%d]", oldPath, i);
      GetSSEMDSRC_SignalStatusParams(packetHandle, value.arrayValue[i], newPath);
      result = CheckLastError("SSEM", gkFuncRefGet, result);
    }
  }
  return result;
}

int SetSSEMDSRC_SignalStatusListParams(LONG packetHandle, struct SSEMDSRC_SignalStatusList value, char oldPath[])
{
  char newPath[300]; 
  int i;
  int result;

  result = 0;

  C2xRemoveToken(packetHandle, "SSEM", oldPath);
  for(i=0; i<value.length; i++)
  {
    snprintf(newPath, elcount(newPath), "%s[%d]", oldPath, i);
    SetSSEMDSRC_SignalStatusParams(packetHandle, value.arrayValue[i], newPath);
    result = CheckLastError("SSEM", gkFuncRefGet, result);
  }
  return result;
}

int GetSSEMDSRC_SignalStatusMessage_regionalParams(LONG packetHandle, struct SSEMDSRC_SignalStatusMessage_regional value, char oldPath[])
{
  char newPath[300]; 
  int i;
  int result;

  result = 0;

  value.length = C2xGetTokenInt(packetHandle, "SSEM", oldPath);
  if((result = CheckLastError("SSEM", gkFuncRefGet, result))==0)
  {
    for(i=0; i<value.length; i++)
    {
      snprintf(newPath, elcount(newPath), "%s[%d]", oldPath, i);
      GetSSEMDSRC_RegionalExtensionEmptyParams(packetHandle, value.arrayValue[i], newPath);
      result = CheckLastError("SSEM", gkFuncRefGet, result);
    }
  }
  return result;
}

int SetSSEMDSRC_SignalStatusMessage_regionalParams(LONG packetHandle, struct SSEMDSRC_SignalStatusMessage_regional value, char oldPath[])
{
  char newPath[300]; 
  int i;
  int result;

  result = 0;

  C2xRemoveToken(packetHandle, "SSEM", oldPath);
  for(i=0; i<value.length; i++)
  {
    snprintf(newPath, elcount(newPath), "%s[%d]", oldPath, i);
    SetSSEMDSRC_RegionalExtensionEmptyParams(packetHandle, value.arrayValue[i], newPath);
    result = CheckLastError("SSEM", gkFuncRefGet, result);
  }
  return result;
}

int GetSSEMDSRC_SignalStatusMessageParams(LONG packetHandle, struct SSEMDSRC_SignalStatusMessage value, char oldPath[])
{
  char newPath[300];
  int result;

  result = 0;

  snprintf(newPath, elcount(newPath), "%s.%s", oldPath, "timeStamp");
  value.timeStamp.isValidFlag = C2xIsTokenAvailable(packetHandle, "SSEM", newPath);
  if(value.timeStamp.isValidFlag==1)
  {
    value.timeStamp.value = C2xGetTokenInt(packetHandle, "SSEM", newPath);
    result = CheckLastError("SSEM", gkFuncRefGet, result);
  }
  snprintf(newPath, elcount(newPath), "%s.%s", oldPath, "second");
  value.second = C2xGetTokenInt(packetHandle, "SSEM", newPath);
  result = CheckLastError("SSEM", gkFuncRefGet, result);

  snprintf(newPath, elcount(newPath), "%s.%s", oldPath, "sequenceNumber");
  value.sequenceNumber.isValidFlag = C2xIsTokenAvailable(packetHandle, "SSEM", newPath);
  if(value.sequenceNumber.isValidFlag==1)
  {
    value.sequenceNumber.value = C2xGetTokenInt(packetHandle, "SSEM", newPath);
    result = CheckLastError("SSEM", gkFuncRefGet, result);
  }
  snprintf(newPath, elcount(newPath), "%s.%s", oldPath, "status");
  GetSSEMDSRC_SignalStatusListParams(packetHandle, value.status, newPath);
  result = CheckLastError("SSEM", gkFuncRefGet, result);

  snprintf(newPath, elcount(newPath), "%s.%s", oldPath, "regional");
  value.regional.isValidFlag = C2xIsTokenAvailable(packetHandle, "SSEM", newPath);
  if(value.regional.isValidFlag==1)
  {
    GetSSEMDSRC_SignalStatusMessage_regionalParams(packetHandle, value.regional, newPath);
    result = CheckLastError("SSEM", gkFuncRefGet, result);
  }
  return result;
}

int SetSSEMDSRC_SignalStatusMessageParams(LONG packetHandle, struct SSEMDSRC_SignalStatusMessage value, char oldPath[])
{
  char newPath[300];
  int result;

  result = 0;

  snprintf(newPath, elcount(newPath), "%s.%s", oldPath, "timeStamp");
  if(value.timeStamp.isValidFlag==1)
  {
    C2xSetTokenInt(packetHandle, "SSEM", newPath, value.timeStamp.value);
    result = CheckLastError("SSEM", gkFuncRefGet, result);
  }
  else
  {
    if( C2xIsTokenAvailable(packetHandle, "SSEM", newPath) )
    {
      C2xRemoveToken(packetHandle, "SSEM", newPath);
    }
  }

  snprintf(newPath, elcount(newPath), "%s.%s", oldPath, "second");
  C2xSetTokenInt(packetHandle, "SSEM", newPath, value.second);
  result = CheckLastError("SSEM", gkFuncRefGet, result);

  snprintf(newPath, elcount(newPath), "%s.%s", oldPath, "sequenceNumber");
  if(value.sequenceNumber.isValidFlag==1)
  {
    C2xSetTokenInt(packetHandle, "SSEM", newPath, value.sequenceNumber.value);
    result = CheckLastError("SSEM", gkFuncRefGet, result);
  }
  else
  {
    if( C2xIsTokenAvailable(packetHandle, "SSEM", newPath) )
    {
      C2xRemoveToken(packetHandle, "SSEM", newPath);
    }
  }

  snprintf(newPath, elcount(newPath), "%s.%s", oldPath, "status");
  SetSSEMDSRC_SignalStatusListParams(packetHandle, value.status, newPath);
  result = CheckLastError("SSEM", gkFuncRefGet, result);

  snprintf(newPath, elcount(newPath), "%s.%s", oldPath, "regional");
  if(value.regional.isValidFlag==1)
  {
    SetSSEMDSRC_SignalStatusMessage_regionalParams(packetHandle, value.regional, newPath);
    result = CheckLastError("SSEM", gkFuncRefGet, result);
  }
  else
  {
    if( C2xIsTokenAvailable(packetHandle, "SSEM", newPath) )
    {
      C2xRemoveToken(packetHandle, "SSEM", newPath);
    }
  }

  return result;
}

int API_GetSSEMParams(LONG packetHandle, struct SSEM value)
{
  int result;
  result = 0;

  value.header.isValidFlag = 1;
  GetSSEMITS_Container_ItsPduHeaderParams(packetHandle, value.header, "header");
  result = CheckLastError("SSEM", gkFuncRefGet, result);

  value.ssm.isValidFlag = 1;
  GetSSEMDSRC_SignalStatusMessageParams(packetHandle, value.ssm, "ssm");
  result = CheckLastError("SSEM", gkFuncRefGet, result);

  return result;
}

int API_SetSSEMParams(LONG packetHandle, struct SSEM value)
{
  int result;
  result = 0;

  SetSSEMITS_Container_ItsPduHeaderParams(packetHandle, value.header, "header");
  result = CheckLastError("SSEM", gkFuncRefGet, result);

  SetSSEMDSRC_SignalStatusMessageParams(packetHandle, value.ssm, "ssm");
  result = CheckLastError("SSEM", gkFuncRefGet, result);

  return result;
}

