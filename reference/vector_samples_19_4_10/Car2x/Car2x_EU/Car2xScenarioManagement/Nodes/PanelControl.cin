/*@!Encoding:65001*/
/********************************************************************************************************************************
****************************************************Control Buttons and Sysvar***************************************************
*********************************************************************************************************************************/
// Called when pressing/releasing the "Start Scenario" button
// in the "Scenario Control" panel
on sysvar ScenarioCtrl::StartBtnState
{
  int i, n;
  long handle;
  if (@this == 1 /*button pressed*/)
  {
    n = C2xGetScenarioCount();
    for (i=0; i<n; i++)
    {
      handle = C2xGetScenarioHandle(i);
      startScenarioOnRoute(handle);
    }
  }
}
// Called when pressing/releasing the "Stop Scenario" button
// in the "Scenario Control" panel
on sysvar ScenarioCtrl::StopBtnState
{
  int i, n;
  long handle;
  if (@this == 1 /*button pressed*/)
  {
    n = C2xGetScenarioCount();
    for (i=0; i<n; i++)
    {
      handle = C2xGetScenarioHandle(i);
      C2xStopScenario(handle);
    }
  }
}

// Called when pressing/releasing the "Start Scenario" button
// in the "Scenario Control" panel
on sysvar ScenarioCtrl::StartBtnState_1
{
  if (@this == 1 /*button pressed*/)
  {
    scenarioHandle[0] = loadScenario(0);
    startScenarioOnRoute(scenarioHandle[0]);
  }
}
// Called when pressing/releasing the "Stop Scenario" button
// in the "Scenario Control" panel
on sysvar ScenarioCtrl::StopBtnState_1
{
  if (@this == 1 /*button pressed*/)
  {
    // Stop all scenarios
    C2xStopScenario(scenarioHandle[0]);
  }
}

// Called when pressing/releasing the "Start Scenario" button
// in the "Scenario Control" panel
on sysvar ScenarioCtrl::StartBtnState_2
{
  if (@this == 1 /*button pressed*/)
  {
    scenarioHandle[1] = loadScenario(1);
    startScenarioOnRoute(scenarioHandle[1]);
  }
}

// Called when pressing/releasing the "Stop Scenario" button
// in the "Scenario Control" panel
on sysvar ScenarioCtrl::StopBtnState_2
{
  if (@this == 1 /*button pressed*/)
  {
    // Stop all scenarios
    C2xStopScenario(scenarioHandle[1]);
  }
}

// Called when pressing/releasing the "Start Scenario" button
// in the "Scenario Control" panel
on sysvar ScenarioCtrl::StartBtnState_3
{
  if (@this == 1 /*button pressed*/)
  {
    scenarioHandle[2] = loadScenario(2);
    startScenarioOnRoute(scenarioHandle[2]);
  }
}

// Called when pressing/releasing the "Stop Scenario" button
// in the "Scenario Control" panel
on sysvar ScenarioCtrl::StopBtnState_3
{
  if (@this == 1 /*button pressed*/)
  {
    // Stop all scenarios
    C2xStopScenario(scenarioHandle[2]);
  }
}


// Called when pressing/releasing the "Draw Route" button
// in the "Scenario Control" panel
on sysvar RouteCtrl::DrawRouteBtnState
{
  if (@this == 1 /*button pressed*/)
  {
    // get the given file and route name
    sysGetVariableString(sysvar::RouteCtrl::FileName, routeFile, elCount(routeFile));
    sysGetVariableString(sysvar::RouteCtrl::RouteName, loadedRoute, elCount(loadedRoute));
    if (C2xLoadRoute(routeFile, loadedRoute, @RouteCtrl::LoopFlag) == -1)
    {
      write("Route File Path '%s' doesn't exist or file doesn't contain route by name '%s'", routeFile, loadedRoute);
      return;
    }
    DrawRouteInMapWindow(loadedRoute);
  }
}
