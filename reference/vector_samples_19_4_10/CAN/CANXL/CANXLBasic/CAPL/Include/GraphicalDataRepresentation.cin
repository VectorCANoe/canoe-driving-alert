/*@!Encoding:1252*/
includes
{
  
}

variables
{
  dword dataSize;
  dword initialized;
}

void Reset()
{
  initialized = 0;  
}


void InitGraphicalRepresentation(struct MediaTypeKeyValue mediaProperties[char[]])
{
  dataSize    = mediaProperties["AudioBitsPerSample"].DwordValue / 8;  
  initialized = 1;
}

on PDU AudioDataFilePayload
{
  byte useData;
  useData = isSimulated() && this.msgChannel == 1;
  useData|= !isSimulated() && this.msgChannel == 2;
  if(useData)
  {
    if(initialized ==1)
    {
      @sysvar::Graphical::LeftChannel = this.word(0);
      @sysvar::Graphical::RightChannel =  this.word(2); 
    }
  }
}
