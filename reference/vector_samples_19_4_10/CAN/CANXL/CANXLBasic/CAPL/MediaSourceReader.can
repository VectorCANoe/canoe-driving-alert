/*@!Encoding:1252*/
includes
{
  #include "Include\UtilityFunctions.cin"

}

variables
{
  pdu AudioDataFilePayload payload;
  dword sourceReaderHandle;
  const dword kInvalidHandle = 0;
  byte txBuffer[128*1024];  
  dword remainLength;
  dword chunkCount = 0;
  dword chunkSize = 0;
  const dword streamIndex = 0;
  dword streamFlags;
  message 0x221 streamingMessage;
  message 0x220 mediaTypeSinkConfigMessage;
  
  	
  const dword SOURCE_READERF_ERROR = 0x00000001;       //An error occurred. If you receive this flag, do not make any further calls to SourceReader methods.
  const dword SOURCE_READERF_ENDOFSTREAM = 0x00000002; //The source reader reached the end of the stream.
  const dword SOURCE_READERF_NEWSTREAM = 0x00000004;   //One or more new streams were created. Respond to this flag by doing at least one of the following:
                                                        // a) Set the output types on the new streams.
                                                        // b) Update the stream selection by selecting or deselecting streams.
  const dword SOURCE_READERF_NATIVEMEDIATYPECHANGED = 0x00000010;  //The native format has changed for one or more streams. The native format is the format delivered by the media source before any decoders are inserted.
  const dword SOURCE_READERF_CURRENTMEDIATYPECHANGED = 0x00000020; //The current media has type changed for one or more streams. To get the current media type, call the source reader’s GetMediaType method.
  const dword MF_SOURCE_READERF_STREAMTICK = 0x00000100;           //There is a gap in the stream.
  const dword SOURCE_READERF_ALLEFFECTSREMOVED = 0x00000200;       //All transforms inserted by the application have been removed for a particular stream. This could be due to a dynamic format change from a source or decoder that prevents custom transforms from being used because they cannot handle the new media type.
  
  
  enum StreamingSourceStatus
  {
    eNotInitalized = 0,
    eInitialized = 1,
    eMediaTypesGatheringFailed = 2,
    eMediaTypesGathered = 3,
    eMediaSourceAvailable = 4,
    eMediaSourceNotAvailable = 5,
    eStreamingRunning = 6,
    eStreamFinished = 7
  };
  
  dword maxPayloadLength = 64;
  mstimer transmitTimer;
  dword burstMode;
}

void SendNextData()
{
  if(@MediaFileServer::Status == eStreamingRunning)
  {
    if(remainLength > 0)
    {
      TransmitStream(txBuffer, streamFlags, elcount(txBuffer));
    }
    else
    {     
      MediaRead(sourceReaderHandle, streamIndex, txBuffer, elcount(txBuffer), "OnMediaRead");
    }
  }
  else if(@MediaFileServer::Status == eStreamFinished)
  {
    if(burstMode == 0)
	{
      cancelTimer(transmitTimer);
	}
  }
  else
  {
     ReadFromSourceStream(sourceReaderHandle, txBuffer);  
  }
}

on timer transmitTimer
{
  SendNextData();
}

on start
{
 @MediaFileServer::Status = eNotInitalized;
}


byte ProcessMessage(message * receiveMessage)
{
  byte processMessage;
  processMessage = 0;
  if(isSimulated() > 0)
  {
    processMessage = receiveMessage.can == 2 ? 1 : 0;
  }
  else
  {
    processMessage = (receiveMessage.can == 1 && receiveMessage.dir == rx) ? 1 : 0;
  }
  return processMessage;
}

on message 0x219
{  
  if(ProcessMessage(this) == 1)
  {
    if(this.byte(0) == 1)
    {
      if(@MediaFileServer::Status == eNotInitalized || @MediaFileServer::Status == eStreamFinished)
      {
        InitializeStream();
      }    
      if(@MediaFileServer::Status == eMediaTypesGathered)
      {
        CalculateFrameRate();
	      if(burstMode == 0)
	      {
          setTimerCyclic(transmitTimer, @MediaFileServer::FramePeriod);
	      }
	      else
	      {
	        ReadFromSourceStream(sourceReaderHandle, txBuffer);  
	      }
      }
    }
    else if(this.byte(0) == 2)
    {
       if(@MediaFileServer::Status == eStreamingRunning)
      {
        cancelTimer(transmitTimer);
        SendStreamEndMessage();
        @MediaFileServer::Status = eStreamFinished;
        remainLength = 0;
        chunkCount = 0;        
      }
    }
  }
}

void CalculateFrameRate()
{
  dword sampleRate;
  double transmitRate;
  if( mediaProperties["AudioAvgBytesPerSecond"].HasValue == 1)
  {    
    sampleRate = mediaProperties["AudioAvgBytesPerSecond"].DwordValue;
    transmitRate = maxPayloadLength * 1000 / sampleRate;
	  if(transmitRate == 0)
	  {
	    burstMode = 1;
	    @MediaFileServer::FramePeriod = 0;
	    @MediaFileServer::FrameDataLength = maxPayloadLength;
	    chunkSize = @MediaFileServer::FrameDataLength;
	  }
	  else
	  {
	    burstMode = 0;
      @MediaFileServer::FramePeriod = _round(transmitRate); 
      @MediaFileServer::FrameDataLength = sampleRate / (1000/@MediaFileServer::FramePeriod);
      chunkSize = @MediaFileServer::FrameDataLength;
	  }
  }  
}

void ReadOutMediaPropertiesAudio( dword mediaTypeHandle)
{  
  ReadOutProperty(mediaTypeHandle, "AllSamplesIndependent");
  //ReadOutProperty(mediaTypeHandle, "FixedSizeSamples");
  ReadOutProperty(mediaTypeHandle, "MajorType");
  //ReadOutProperty(mediaTypeHandle, "SampleSize");
  ReadOutProperty(mediaTypeHandle, "Subtype");
  //ReadOutProperty(mediaTypeHandle, "AacAudioProfileLevelIndication");
  //ReadOutProperty(mediaTypeHandle, "AacPayloadType");
  ReadOutProperty(mediaTypeHandle, "AudioAvgBytesPerSecond");
  ReadOutProperty(mediaTypeHandle, "AudioBitsPerSample");
  ReadOutProperty(mediaTypeHandle, "AudioBlockAlignment");
 // ReadOutProperty(mediaTypeHandle, "AudioChannelMask");
 // ReadOutProperty(mediaTypeHandle, "AudioFloatSamplesPerSecond");
 // ReadOutProperty(mediaTypeHandle, "AudioFolddownMatrix");
  ReadOutProperty(mediaTypeHandle, "AudioNumChannels");
  //ReadOutProperty(mediaTypeHandle, "AudioSamplesPerBlock");
  ReadOutProperty(mediaTypeHandle, "AudioSamplesPerSecond");
  //ReadOutProperty(mediaTypeHandle, "AudioValidBitsPerSample");
  //ReadOutProperty(mediaTypeHandle, "AudioWmadrcAvgref");
  //ReadOutProperty(mediaTypeHandle, "AudioWmadrcAvgtarget");
  //ReadOutProperty(mediaTypeHandle, "AudioWmadrcPeakref");
  //ReadOutProperty(mediaTypeHandle, "AudioWmadrcPeaktarget");
  //ReadOutProperty(mediaTypeHandle, "OriginalWaveFormatTag");
}

on sysvar MediaFileServer::FrameFormat
{
  if(@MediaFileServer::Status == eNotInitalized || @MediaFileServer::Status == eStreamFinished)
  {
    InitializFrameFormat();
  }
}

void InitializFrameFormat()
{
 if(@MediaFileServer::FrameFormat == 0)
  {
    streamingMessage.fdf = 1;
	  streamingMessage.brs = 0;
    streamingMessage.xlf = 1;
    mediaTypeSinkConfigMessage.FDF = 1;
	  mediaTypeSinkConfigMessage.brs = 0;
    mediaTypeSinkConfigMessage.XLF = 1;
	  maxPayloadLength = 2048;
  }
  else
  {
    streamingMessage.fdf = 1;
	  streamingMessage.brs = 1;
    streamingMessage.xlf = 0;
    mediaTypeSinkConfigMessage.FDF = 1;
	  mediaTypeSinkConfigMessage.brs = 1;
    mediaTypeSinkConfigMessage.XLF = 0;
	  maxPayloadLength = 64;
  }


}

void InitializeStream()
{
  dword mediaTypeHandle;
  char wavFile[255];  
  char propValue[255];

  @MediaFileServer::Status = eNotInitalized;
  
  InitializFrameFormat();
  
  InitalizePropertyMetaInforamtion();
  
  
  sysGetVariableString(sysvar::TransmissionStatistic::MediaFile, wavFile, elcount(wavFile));  
  sourceReaderHandle = MediaCreateSourceReaderFromUrl(wavFile);
  mediaTypeHandle = MediaGetMediaType(sourceReaderHandle, streamIndex);
  
  if(mediaTypeHandle == kInvalidHandle)
  {
    @MediaFileServer::Status = eMediaTypesGatheringFailed;
  }
  else
  {
    ReadOutMediaPropertiesAudio(mediaTypeHandle);
    @MediaFileServer::Status = eMediaTypesGathered;
    MediaReleaseMediaType(mediaTypeHandle);
  }
  
  TransmitMediaTypeInformation();
  @MediaFileServer::SampleRate = mediaProperties["AudioSamplesPerSecond"].DwordValue;
  ConvertDwordToString("Subtype", mediaProperties["Subtype"].DwordValue, propValue);
  sysSetVariableString(sysvar::MediaFileServer::Format, propValue);
}

void ReadFromSourceStream(dword talkerHandle, byte buffer[])
{
  dword ret, length;
    
  length = elCount(buffer);
  
  if (talkerHandle != kInvalidHandle)
  {
    ret = MediaRead(talkerHandle, streamIndex, buffer, elcount(buffer), "OnMediaRead");
  }
}

void CreateStreamMessage(byte buffer[], dword length)
{
 
  int dataIndex;
  dword messageLength;
  dword offsetInBuffer;
 
  
  if(remainLength == 0)
  {
    remainLength = length;
  } 
  else
  {
    length = remainLength;
  }  
  messageLength = length > maxPayloadLength ? @MediaFileServer::FrameDataLength : length;
  
  if(streamingMessage.xlf == 0)
  {
    streamingMessage.dlc = messageLength;
  }
  else
  {
    payload.PduLength = messageLength;
  }
  
  offsetInBuffer = chunkCount * chunkSize;
  
  for(dataIndex = 0; dataIndex < messageLength; ++dataIndex)
  {   
   if(streamingMessage.xlf == 0)
   {
     streamingMessage.byte(dataIndex) = buffer[offsetInBuffer + dataIndex];    
   }
   else
   {
     payload.byte(dataIndex) = buffer[offsetInBuffer + dataIndex];    
   }
  }  
  
  remainLength = remainLength - messageLength;
  if(remainLength > 0)
  {
    ++chunkCount;
  }
  else
  {
    remainLength = 0;
    chunkCount = 0;
  }
  
 
}

void SendStreamEndMessage()
{
   if(mediaTypeSinkConfigMessage.xlf == 0)
   {
     mediaTypeSinkConfigMessage.dlc = 1;
     mediaTypeSinkConfigMessage.byte(0) = 2;
   }
   else
   {
     mediaTypeSinkConfigMessage.dlc = 1;
     mediaTypeSinkConfigMessage.AF = 0x2;
     mediaTypeSinkConfigMessage.dword(0) = streamFlags;
   }

   @MediaFileServer::Status = eStreamFinished;
   output(mediaTypeSinkConfigMessage);
   MediaReleaseSourceReader(sourceReaderHandle);
}

void TransmitStream(byte buffer[], dword streamFlags, dword length)
{
  if(streamFlags == SOURCE_READERF_ENDOFSTREAM)
  {
   SendStreamEndMessage();
  }
  else
  {
    CreateStreamMessage(buffer, length);   
	  if(streamingMessage.xlf == 0)
	  {
	    output(streamingMessage);
	  }
	  else
	  {
	    triggerPDU(payload);
	  }
  }  
}

void WritePropertyNameAndValue(dword nextDataIndex, long propertyNameLength, int& dataLength,  char keyString[])
{
  int currentDataIndex;
  
  for(currentDataIndex = 0; currentDataIndex < propertyNameLength; ++currentDataIndex)
  {
    mediaTypeSinkConfigMessage.byte(dataLength) = keyString[currentDataIndex];
    ++dataLength;
  }
	mediaTypeSinkConfigMessage.byte(dataLength) = 0x00;
  ++dataLength;
  mediaTypeSinkConfigMessage.dword(dataLength) = mediaProperties[keyString].DwordValue;
  dataLength +=4;
  mediaTypeSinkConfigMessage.word(nextDataIndex)   = dataLength;
}

void TransmitMediaTypeInformation()
{
  dword lengthNeededForProperty;
  long  propertyNameLength;
  dword propertyValue;
  int   propertyIndex;
  int   dataLength;
  int   currentDataIndex;
  dword nextData;
  char keyString[255];
  dataLength = 0;
  mediaTypeSinkConfigMessage.AF = 0x1;
  for(char[] aKey : mediaProperties)
  {
    if(mediaProperties[aKey].HasValue == 1)
    {
      nextData = dataLength;
      dataLength += 2; 
  
      strncpy(keyString, aKey, elcount(keyString));
      propertyNameLength = strlen(keyString); 
	    lengthNeededForProperty = propertyNameLength + 1 + 4; //1:= Null-Termination 4:=Dword Value 
      
	    if((lengthNeededForProperty + dataLength) <= maxPayloadLength)
	    {
        WritePropertyNameAndValue(nextData, propertyNameLength, dataLength, keyString);
	    }
	    else
	    {
	      if(mediaTypeSinkConfigMessage.xlf == 0)
		    {
		      mediaTypeSinkConfigMessage.dlc = nextData;
		    }
		    else
		    {
          mediaTypeSinkConfigMessage.dlc = nextData-1;
		    }		
        output(mediaTypeSinkConfigMessage);
		    nextData = 0;
		    dataLength = 2;
		    if(lengthNeededForProperty <= maxPayloadLength)
	      {
          WritePropertyNameAndValue(nextData, propertyNameLength, dataLength, keyString);
	      }
	    }
	  }     
  }
  
  if(dataLength > 0)
  {
    if(mediaTypeSinkConfigMessage.xlf == 0)
    {
	    mediaTypeSinkConfigMessage.dlc = nextData;
	  }
	  else
	  {
      mediaTypeSinkConfigMessage.dlc = dataLength -1;
	  }
    
    output(mediaTypeSinkConfigMessage);
    
	  if(mediaTypeSinkConfigMessage.xlf == 0)
	  {
      mediaTypeSinkConfigMessage.dlc = 1;
	    mediaTypeSinkConfigMessage.byte(0) = 1;
	    output(mediaTypeSinkConfigMessage);
	  }
	
  }
}

void OnMediaRead(dword sourceReaderHandle, long result, dword streamIndex, dword streamFlags, int64 timestamp, byte buffer[], dword length)
{
  byte endReached;
  
  if (result != 0)
  {    
    return;
  }
  streamFlags = streamFlags;
  @MediaFileServer::Status = eStreamingRunning;
  TransmitStream(buffer,streamFlags, length);
}

on stopMeasurement
{
   @MediaFileServer::Status = eNotInitalized;
}

on message CAN1.0x221
{
  if(burstMode == 1)
  {
    if(this.dir == txrequest)
    {
      SendNextData();
    }
  }
}

