/*@!Encoding:1252*/
includes
{
  
  #include "Include\UtilityFunctions.cin"
  #include "Include\GraphicalDataRepresentation.cin"
}

variables
{
  qword startTimeTransmission;
  dword mediaSinkWriterHandle, audioRendererHandle;
  const dword kInvalidHandle = 0;
  const dword streamIndex = 0;  
  dword byteReceiveCount = 0;
  
  enum StreamingSinkStatus
  {
    eMediaTypeError = -1,
    eSpeakerNotAvailable = -2,    
    eMediaWriteError = -3,
    eMediaClientNotIntialized=0,
    eMediaClientInitialized=1,
    eMediaClientStreaming = 2,    
  	eMediaClientStreamingFinished = 3
  };
  
  mstimer transsmissionRate;
  dword   updateTransmissonRate;
}

on sysvar sysvar::TransmissionControl::StartPlayback
{
  if(@this == 2)
  {
    message 0x219 msg;
    
    msg.XLF = 1;
    msg.FDF = 1;
    
    msg.dlc = 1;
    msg.byte(0) = 1;
    output(msg);
  }
}

on sysvar sysvar::TransmissionControl::EndPlayback
{
  if(@this == 2)
  {
    message 0x219 msg;
    
    msg.XLF = 1;
    msg.FDF = 1;
    
    msg.dlc = 1;
    msg.byte(0) = 2;
    output(msg);
  }
}


byte ProcessMessage(message * receiveMessage)
{
  byte processMessage;
  processMessage = 0;
  
  if(receiveMessage.dir == txrequest)
  {
	  processMessage = 0;
  }
  else
  {
    if(isSimulated() > 0)
    {
      processMessage = receiveMessage.can == 1 ? 1 : 0;
    }
    else
    {
      processMessage = (receiveMessage.can == 2 && receiveMessage.dir == rx) ? 1 : 0;
    }
  }
  
  return processMessage;
}


on timer transsmissionRate
{
  updateTransmissonRate = 1;
  
}


on start
{   
   @MediaClient::Status = eMediaClientNotIntialized;
   InitalizePropertyMetaInforamtion();
   startTimeTransmission = 0;
  
}

dword CreateMediaType(dword& mediaTypeHandle)
{
  long res;  
  int currentIndex =0;
  mediaTypeHandle = MediaCreateMediaType();
    
  if (mediaTypeHandle == kInvalidHandle)
  {
    res = -1;    
    return res;
  }
  
  for(char[] aKey : mediaProperties)
  {
    if(mediaProperties[aKey].HasValue == 1)
    {
    char keyAsString[255];
    char valueAsString[255];
    strncpy(keyAsString, aKey, elcount(keyAsString));
    
    if(mediaProperties[keyAsString].MediaValueType == eMediaString)
    {
       ConvertDwordToString(keyAsString, mediaProperties[keyAsString].DwordValue, valueAsString);      
       res = MediaSetProperty(mediaTypeHandle, keyAsString, valueAsString);
    }
    else if(mediaProperties[keyAsString].MediaValueType == eMediaDword)
    {
        res = MediaSetProperty(mediaTypeHandle, keyAsString, mediaProperties[keyAsString].DwordValue);
    }
    if (res != 0)
     {       
       return res;
     }
    }
  }
   InitGraphicalRepresentation(mediaProperties);
  
  return res;
}

void EnableMediaSourceOutput()
{
  long res;
  dword mediaTypeHandle;
  
  res = CreateMediaType(mediaTypeHandle);
  if(res == 0) //Media type was created
  {
    audioRendererHandle = MediaCreateAudioRenderer(); //Create audio renderer
  
    if (audioRendererHandle != kInvalidHandle)
    {
      mediaSinkWriterHandle = MediaCreateSinkWriterFromMediaSink(audioRendererHandle);
     
      if (mediaSinkWriterHandle != kInvalidHandle)
      {
        res = MediaReleaseAudioRenderer(audioRendererHandle);
        res = MediaSetMediaType(mediaSinkWriterHandle, streamIndex, mediaTypeHandle);
        if(res == 0)
        {
          MediaReleaseMediaType(mediaTypeHandle);
          @MediaClient::Status = eMediaClientInitialized;
        }
        else
        {
          dword mediaLastError;
          mediaLastError = MediaGetLastError();
          @MediaClient::Status = eMediaTypeError;          
        }
      }
    }
    else
    {
      write("Please attach a speaker or headphone to playback audio.");
      @MediaClient::Status = eSpeakerNotAvailable;
    }
  }
  else
  {
    @MediaClient::Status = eMediaTypeError;
  }
}

on stopMeasurement
{
  DisableMediaSource();
  @MediaClient::Status = eMediaClientNotIntialized;
}


void DisableMediaSource()
{
 if(@MediaClient::Status > 0 && mediaSinkWriterHandle != kInvalidHandle)
 {   
   MediaReleaseSinkWriter(mediaSinkWriterHandle);
   @MediaClient::Status = eMediaClientStreamingFinished;
   mediaSinkWriterHandle = kInvalidHandle; 
   write("%llu %llu", startTimeTransmission, timeNowInt64());
   
   startTimeTransmission = 0;
 }
}



void ShutdownClientServices()
{
    DisableMediaSource();    
    updateTransmissonRate = 0;
    cancelTimer(transsmissionRate);
    @sysvar::TransmissionStatistic::BytesPerSecond = 0;
}

void InitalizeCLientServices()
{
   EnableMediaSourceOutput(); 
   setTimerCyclic(transsmissionRate, 1000);
   InitGraphicalRepresentation(mediaProperties);
   updateTransmissonRate = 0;
}

void ReadOutProperty(message * msg)
{
  word nextData;
  int currIndex;
  int propertyNameIndex;
  int startPropertyName;
  int endPropertyName;
  currIndex = 0;	
  
  while(currIndex < msg.DataLength)
  {
    char propertyName[255];
    char prNam[255];
    nextData = msg.word(currIndex);
	  if(nextData == 0 || nextData > msg.DataLength)
	  {
	     break;
	  }		  
	  startPropertyName = currIndex + 2;
    endPropertyName = nextData - 4;
    propertyNameIndex = 0;
    for(; startPropertyName < endPropertyName; ++startPropertyName)
    {
      propertyName[propertyNameIndex] = msg.byte(startPropertyName);
      ++propertyNameIndex;
    }    
    strncpy(prNam, propertyName, elcount(prNam));
    currIndex = endPropertyName;
    mediaProperties[prNam].DwordValue = msg.dword(currIndex);
    mediaProperties[prNam].HasValue = 1;    
    currIndex = nextData;   
  }	
  
    
  
}

on message 0x220
{
  word nextData;
  int currIndex;
  int propertyNameIndex;
  int startPropertyName;
  int endPropertyName;
  
  if(ProcessMessage(this) == 1)
  {
    currIndex = 0;
  
    if(this.XLF == 1)
    {
      if(this.AF == 0x1)
      {
        ReadOutProperty(this);
        InitalizeClientServices();
      }
      else if(this.AF == 0x2)
      {
        ShutdownClientServices();
      }
    }
    else if(this.FDF == 1)
    {
      if(this.dlc == 1)
      {
        if (this.byte(0) == 0x1)
        {
           InitalizeClientServices();
        }
        else if(this.byte(0) == 0x2)
        {
           ShutdownClientServices();
        }
      }
      else if(this.dlc > 1)
      {
        ReadOutProperty(this);
      }
    }
  }
}

on message 0x221
{
 dword result;
 byte buffer[2048];
 dword dataReceived;
 int64 startTimeNs;
 int64 timeInStream;
 int dataIndex;  
  
 if(ProcessMessage(this) == 1)
 {
   if(@MediaClient::Status > 0)
   {
 	 if(startTimeTransmission == 0)
 	 {
       startTimeTransmission = timeNowInt64();
 	 }
     else
     {
       @MediaClient::TransmissionTime = (timeNowInt64() - startTimeTransmission) / 1000000000.0;
     }
 	   
     dataReceived = this.DataLength;
     
     for(dataIndex = 0; dataIndex < dataReceived; ++dataIndex)
     {
       buffer[dataIndex] = this.byte(dataIndex);
     }
	 
     result = MediaWrite(mediaSinkWriterHandle, streamIndex, 0, buffer, elcount(buffer)); 

     if(result != 0)
     {
       @MediaClient::Status = eMediaWriteError;
     }
     else
     {
       @MediaClient::Status = eMediaClientStreaming;
     }
     byteReceiveCount += this.DataLength;
     @sysvar::TransmissionStatistic::BytesTransmitted += (this.DataLength * 1.0 / 1024 / 1024);
     if(updateTransmissonRate)
     {
       @sysvar::TransmissionStatistic::BytesPerSecond = byteReceiveCount;
       byteReceiveCount = 0;
       updateTransmissonRate = 0;
     }
    }
  }
}

 



