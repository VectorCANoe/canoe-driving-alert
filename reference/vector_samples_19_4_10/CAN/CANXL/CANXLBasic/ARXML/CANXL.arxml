AUTOSAR XML (schema 00049)
package /VectorAutosarExplorerGeneratedObjects/SYSTEM
  system System
package /VectorAutosarExplorerGeneratedObjects/CAN XL
  can cluster CAN XL: baudrate=500000, protocol-name=CAN, can-xl-baudrate=8000000
    can physical channel CANXLChannel: comm-connectors=[Connector_New_ECU_e978e4e3c7105ace, Connector_New_ECU_2_a60abc251def83c2]
      frame AudioData: id 0x221, from MediaTransmitter, to MediaReceiver, frame-length=2048, can-addressing-mode=STANDARD, can-frame-tx-behavior=CAN-20, can-xl-frame-triggering-props={acceptance-field=0, priority-id=545, sdu-type=1, vcid=0}
        pdu AudioDataFilePayload: length=2048
      frame MediaServerControlFrame: id 0x220, from MediaTransmitter, to MediaReceiver, frame-length=2048, can-addressing-mode=STANDARD, can-frame-tx-behavior=CAN-20, can-xl-frame-triggering-props={acceptance-field=0, priority-id=544, sdu-type=1, vcid=0}
      frame MediaClientControlFrame: id 0x219, from MediaReceiver, to MediaTransmitter, frame-length=8, can-addressing-mode=STANDARD, can-frame-tx-behavior=CAN-20
        pdu MediaClientPDU: length=8
          signal PlaybackStatus: start 0, 8 bit, little-endian, system signal PlaybackStatus_c0f8a716b33e429e, data-type-policy=OVERRIDE, base-type=New_BaseType, to MediaTransmitter
      pdu triggering NewPduTriggering_1d7cd014154506f3: pdu=AudioData_PDU, from MediaTransmitter, to MediaReceiver
package /VectorAutosarExplorerGeneratedObjects/ECU_INSTANCES
  ecu instance MediaTransmitter: associated-com-i-pdu-group=[PduGroup_48e53b2c567746e88f743494573c6388_Tx, PduGroup_d6ebec620ed84ae982361d2a3faa408a_Tx, PduGroup_fe3530ac30ba487f9088ef244ac3cff1_Tx, PduGroup_fed03f04fa2a40f496c9c79edf41525c_Tx, PduGroup_b7dc967b64b549109afd2a16fd5f222f_Rx], diagnostic-address=0
    can communication controller CAN_XL_Media_Transmitter: can-controller-attributes=can-controller-configuration=can-controller-xl-attributes={error-signaling-enabled=True, prop-seg=0, ssp-offset=0, sync-jump-width=9, time-seg-1=10, time-seg-2=9, trcv-pwm-mode-enabled=False}
    can communication connector Connector_New_ECU_e978e4e3c7105ace: comm-controller=CAN_XL_Media_Transmitter
  ecu instance MediaReceiver: associated-com-i-pdu-group=[PduGroup_be026c3960ea493788ffb72bba9a0e95_Rx, PduGroup_633aadd79e28493d8e772dda0bbd983d_Rx, PduGroup_2c35da101a2b493eafbbb1086474b278_Rx, PduGroup_4ce3602d45df4798a25306042a61c633_Rx, PduGroup_0558deceaa70428c83ffd67b28177ace_Tx], diagnostic-address=0
    can communication controller CAN_XL_Media_Receiver: can-controller-attributes=can-controller-configuration=can-controller-xl-attributes={error-signaling-enabled=True, prop-seg=0, ssp-offset=0, sync-jump-width=9, time-seg-1=10, time-seg-2=9, trcv-pwm-mode-enabled=False}
    can communication connector Connector_New_ECU_2_a60abc251def83c2: comm-controller=CAN_XL_Media_Receiver
package /VectorAutosarExplorerGeneratedObjects/PDUS
  pdu New_Frame_NewPDU: length=2048
    signal New_Frame_NewPDU_NewSignal: start 0, 8 bit, little-endian, system signal New_Frame_NewPDU_NewSignal_3773e9f87988bcb5, data-type-policy=OVERRIDE, base-type=New_BaseType, to MediaReceiver
  pdu FilePayload: length=2048
  pdu AudioData_PDU: length=2048
    signal LeftChannel_Audio: start 0, 16 bit, little-endian, system signal LeftChannel_Audio_bce1dbedde7e346f, data-type-policy=OVERRIDE, base-type=New_BaseType, to MediaReceiver
    signal RightChannel_Audio: start 0, 16 bit, little-endian, system signal RightChannel_Audio_637388cf409e40ae, data-type-policy=OVERRIDE, base-type=New_BaseType, to MediaReceiver
  container i pdu AudioData_PayloadPDU: length=2048, contained-pdu-triggering=NewPduTriggering_1d7cd014154506f3, container-timeout=0, container-trigger=DEFAULT-TRIGGER, header-type=NO-HEADER, rx-accept-contained-i-pdu=ACCEPT-CONFIGURED, threshold-size=0, unused-bit-pattern=0
package /VectorAutosarExplorerGeneratedObjects/I_SIGNALS
  i signal LeftChannel: data-type-policy=OVERRIDE, length=16, base-type=New_BaseType, system-signal=LeftChannel_e6dda98ba0ceb9f6
  i signal RightChannel: data-type-policy=OVERRIDE, length=16, base-type=New_BaseType, system-signal=RightChannel_e11d4d50dbbf2a4c
package /VectorAutosarExplorerGeneratedObjects/BASE_TYPES
  base type New_BaseType: base-type-size=16, base-type-encoding=NONE
package /VectorAutosarExplorerGeneratedObjects/SYSTEM_SIGNALS
  system signal LeftChannel_e6dda98ba0ceb9f6
  system signal RightChannel_e11d4d50dbbf2a4c
package /VectorAutosarExplorerGeneratedObjects/PDU_GROUP
  10 x i signal i pdu group:
    PduGroup_48e53b2c567746e88f743494573c6388_Tx: communication-direction=OUT
    PduGroup_be026c3960ea493788ffb72bba9a0e95_Rx: communication-direction=IN
    PduGroup_d6ebec620ed84ae982361d2a3faa408a_Tx: communication-direction=OUT
    PduGroup_633aadd79e28493d8e772dda0bbd983d_Rx: communication-direction=IN
    PduGroup_fe3530ac30ba487f9088ef244ac3cff1_Tx: communication-direction=OUT
    PduGroup_2c35da101a2b493eafbbb1086474b278_Rx: communication-direction=IN
    PduGroup_fed03f04fa2a40f496c9c79edf41525c_Tx: communication-direction=OUT
    PduGroup_4ce3602d45df4798a25306042a61c633_Rx: communication-direction=IN
    PduGroup_0558deceaa70428c83ffd67b28177ace_Tx: communication-direction=OUT
    PduGroup_b7dc967b64b549109afd2a16fd5f222f_Rx: communication-direction=IN
package /Vector/ECUs
  ecu instance VGW
  ecu instance IC
package /Vector/PDUs
  pdu EngineInfo: length=2048, transmission-mode-true-timing=cyclic-timing=time-period=0.5, unused-bit-pattern=0
    signal Speed: start 0, 16 bit, little-endian, data-type-policy=OVERRIDE, base-type=A_UINT16, compu {phys=raw*0.1; unit rpm}
    signal Temperature: start 16, 16 bit, little-endian, data-type-policy=OVERRIDE, base-type=A_UINT16, compu {phys=raw*0.1-273; unit °C}
package /Vector/CompuMethods
  compu method e2e_crc_cm: 
  compu method e2e_seq_cm: 
  compu method e_voltage_cm: phys=raw*0.1-32000; unit V
  compu method e_current_cm: phys=raw*0.1-32000; unit A
  compu method e_power_cm: phys=raw*0.1; unit W
  compu method e_capacity_cm: phys=raw*0.1; unit KWh
package /Vector/Units
  6 x unit:
    rpm_unit: display-name=rpm
    degC_unit: display-name=°C
    e_voltage_unit: display-name=V
    e_current_unit: display-name=A
    e_power_unit: display-name=W
    e_capacity_unit: display-name=KWh
package /AUTOSAR/BaseTypes
  5 x base type:
    A_UINT8: base-type-encoding=BOOLEAN
    A_UINT8: base-type-size=8, base-type-encoding=NONE
    A_UINT16: base-type-size=16, base-type-encoding=NONE
    A_UINT32: base-type-size=32, base-type-encoding=NONE
    A_UINT64: base-type-size=64, base-type-encoding=NONE
