AUTOSAR XML (schema 00050)
package /VectorAutosarExplorerGeneratedObjects/SYSTEM
  system System
package /VectorAutosarExplorerGeneratedObjects/New_CanCluster
  can cluster CANXL: baudrate=250000, protocol-name=CAN, speed=250000
    can physical channel CANChannel
      comm-connectors:
        Connector_StreamingEcu_20e9d7d8a575e435
        Connector_GatewayCanEth_d26f8bcdf979aeb9
        Connector_GatewayEthCan_f033710719b2b6bf
        Connector_QosMonitor_273645f5efc03853
        Connector_HeadUnit_bfd50aa222c14f1d
      frame TunneledEthFrame: id 0xB, from GatewayEthCan, to GatewayCanEth HeadUnit, frame-length=132, can-addressing-mode=STANDARD, can-frame-tx-behavior=CAN-20
      frame HighPriorityFrame: id 0x3, from QosMonitor, to GatewayCanEth GatewayEthCan, frame-length=8, can-addressing-mode=STANDARD, can-frame-tx-behavior=CAN-20
package /VectorAutosarExplorerGeneratedObjects/ECU_INSTANCES
  5 x ecu instance, all with diagnostic-address=0:
    StreamingEcu
      can communication controller Controller_StreamingEcu_812b722f257b92d6
      can communication connector Connector_StreamingEcu_20e9d7d8a575e435: comm-controller=Controller_StreamingEcu_812b722f257b92d6
    GatewayCanEth
      can communication controller Controller_GatewayCanEth_117b770ac8bcae53
      can communication connector Connector_GatewayCanEth_d26f8bcdf979aeb9: comm-controller=Controller_GatewayCanEth_117b770ac8bcae53
    GatewayEthCan
      can communication controller Controller_GatewayEthCan_83f258d742c99f02
      can communication connector Connector_GatewayEthCan_f033710719b2b6bf: comm-controller=Controller_GatewayEthCan_83f258d742c99f02
    QosMonitor
      can communication controller Controller_QosMonitor_d4ca97006143ebac
      can communication connector Connector_QosMonitor_273645f5efc03853: comm-controller=Controller_QosMonitor_d4ca97006143ebac
    HeadUnit
      can communication controller Controller_HeadUnit_f7263e5e2aa59972
      can communication connector Connector_HeadUnit_bfd50aa222c14f1d: comm-controller=Controller_HeadUnit_f7263e5e2aa59972
