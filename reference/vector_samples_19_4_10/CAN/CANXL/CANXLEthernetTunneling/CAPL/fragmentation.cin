/*@!Encoding:65001*/
includes
{
  #include "common.cin"
}

variables
{
  const word HEADER_SIZE = 4;
  const byte NUM_BUFFERS = 3;
  const int MAX_LOW_PRIO_COUNT = 2;
  
  struct Buffer Buffers[NUM_BUFFERS];
  message* completedMsg;
}

/// <summary>
/// Fragment a CAN frame into smaller frames as specified in CiA 613-3.
/// </summary>
/// <param name="msg">The CAN message to fragment.</param>
/// <param name="fragmentSize">The size of each fragment.</param>
void FragmentMessage(message* msg, word fragmentSize)
{
  stack int i;
  stack int pos = 0;
  stack message* fragment;
  stack struct Header header;
  stack dword remainingBytes;
  
  if (msg.DataLength <= fragmentSize)
  {
    output(msg);
    return;
  }
  
  InitFragment(fragment, msg);
  InitHeader(header);
  
  while(pos < msg.DataLength)
  {
    remainingBytes = msg.DataLength - pos;
    
    if (remainingBytes > fragmentSize)
    {
      if (pos == 0)
      {
        SetFirstFragment(header);
      }
      else
      {
        SetConsecutiveFragment(header);
      }
      fragment.DLC = fragmentSize + HEADER_SIZE - 1;
    }
    else
    {
      SetLastFragment(header);
      fragment.DLC = remainingBytes + HEADER_SIZE - 1;
    }
    
    WriteHeader(fragment, header);
    
    for(i = 0; i < (fragment.DataLength - HEADER_SIZE); i++)
    {
      fragment.byte(i + HEADER_SIZE) = msg.byte(pos + i);
    }
    
    output(fragment);
        
    pos+=fragmentSize;
    header.FCNT++;
  }
  
}

/// <summary>
/// Handle reception of a fragmented CAN message.
/// </summary>
/// <param name="msg">The fragmented CAN message to process.</param>
void OnProcessReceiveMessage(message* msg)
{  
  if(!msg.XLF)
  {
    return;
  }
  
  if(!IsAddOnMessage(msg))
  {
    if(IsAssignedToBuffer(msg))
    {
      ReleaseBuffer(GetBufferIndex(msg));
    }
    
    completedMsg = msg;
    @sysvar::OnFragmentationComplete++;
    return;
  }
  
  if(!IsVersionValid(msg))
  {
    return;
  }
  
  if(HasFragmentationAddOn(msg))
  {
    if(IsAssignedToBuffer(msg))
    {      
      HandleLowPrioCount(msg);
      
      OngoingFragmentedTransfer(msg);
      
    }
    else
    {
      NewFragmentedTransfer(msg);
    }
  }
  
  
}

byte IsAssignedToBuffer(message* msg)
{
  return IsIdAssignedToBuffer(msg.Id);
}

byte IsIdAssignedToBuffer(word Id)
{
  stack int i;
  for(i = 0; i < NUM_BUFFERS; i++)
  {
    if(Buffers[i].TID == Id)
    {
      return 1;
    }
  }
  
  return 0;
}

void HandleLowPrioCount(message* msg)
{
  stack int minTid = GetMinTid();
  stack byte bufferIndex = GetBufferIndex(msg);
  
  if (msg.id <= minTid)
  {
    Buffers[bufferIndex].LowPrioCount = 0;
  }
  
  Buffers[bufferIndex].LowPrioCount++;
  
  if (Buffers[bufferIndex].LowPrioCount > MAX_LOW_PRIO_COUNT)
  {
    ReleaseBuffer(bufferIndex);
  }
  
}

word GetMinTid()
{
  stack word localMin = 2047;
  stack int i;
  
  for (i = 0; i < NUM_BUFFERS; i++)
  {
    if (Buffers[i].IsUsed)
    {
      if (Buffers[i].TID < localMin)
      {
        localMin = Buffers[i].TID;
      }
    }
  }
  
  return localMin;
}

void OngoingFragmentedTransfer(message* msg)
{
  if (IsFirstFragment(msg))
  {
    ReleaseBuffer(GetBufferIndex(msg));
    NewFragmentedTransfer(msg);
    return;
  }
  
  if (!IsFcntValid(msg))
  {
    ReleaseBuffer(GetBufferIndex(msg));
    return;
  }
  
  if (IsLastFragment(msg))
  {
    WriteFragmentToBuffer(msg);
    Complete(msg);
    return;
  }
  
  if (IsConsecutiveFragment(msg))
  {
    WriteFragmentToBuffer(msg);
    return;
  }
  
  ReleaseBuffer(GetBufferIndex(msg));
  
}

void NewFragmentedTransfer(message* msg)
{
  if(AllocateNewBuffer(msg))
  {
    WriteFragmentToBuffer(msg);
  }
  else
  {
    WriteEx(-3, 1, "No buffers are available");
  }
}

byte AllocateNewBuffer(message* msg)
{
  stack int i;
  
  for(i = 0; i < NUM_BUFFERS; i++)
  {
    if(Buffers[i].IsUsed == 0)
    {
      InitializeBuffer(i, msg.id);
      return 1;
    }
  }
  
  return 0;
}

void InitializeBuffer(byte index, word id)
{
  Buffers[index].IsUsed = 1;
  Buffers[index].TID = id;
  Buffers[index].SizeUsed = 0;
  Buffers[index].FCNT = 0;
  Buffers[index].LowPrioCount = 0;
}

void ReleaseBuffer(byte index)
{
  Buffers[index].IsUsed = 0;
  Buffers[index].TID = 0;
  Buffers[index].SizeUsed = 0;
  Buffers[index].FCNT = 0;
  Buffers[index].LowPrioCount = 0;
}

void WriteFragmentToBuffer(message* msg)
{
  stack int i;  
  stack int idx = GetBufferIndex(msg);
  
  for(i = HEADER_SIZE; i < msg.DataLength; i++)
  {
    Buffers[idx].Data[Buffers[idx].SizeUsed] = msg.Byte(i);
    Buffers[idx].SizeUsed++;
  }
  
  Buffers[idx].FCNT = GetFcnt(msg);
  
}

int GetBufferIndex(message* msg)
{
  stack int i;
  for(i = 0; i < NUM_BUFFERS; i++)
  {
    if(Buffers[i].TID == msg.id)
    {
      return i;
    }
  }
  
  WriteEx(-3, 1, "Could not find matching buffer.");
  return -1;
}

byte IsFcntValid(message* msg)
{
  return GetFcnt(msg) == Buffers[GetBufferIndex(msg)].FCNT + 1;
}

void Complete(message* msg)
{
  stack int i;
  stack int index = GetBufferIndex(msg);
  
  completedMsg.ID = msg.ID;
  completedMsg.SEC = 0;
  completedMsg.FDF = 1;
  completedMsg.XLF = 1;
  completedMsg.VCID = msg.VCID;
  completedMsg.AF = msg.AF;
  completedMsg.SDT = msg.SDT;
  
  completedMsg.DLC = Buffers[index].SizeUsed - 1;
  
  for (i = 0; i < completedMsg.DataLength; i++)
  {
    completedMsg.Byte(i) = Buffers[index].Data[i];
  } 
  ReleaseBuffer(index);
    
  @sysvar::OnFragmentationComplete++;  
}
