/*@!Encoding:1252*/
includes
{
  #include "General.cin"
  #include "Avb.cin"
}

variables
{
  const long kMedia_OK                      = kOK;
  const long kMedia_InvalidHandle           = kInvalidHandle;
  const dword kMedia_NotAccepting            = 0xC00D36B5;
  const dword kMedia_TransformNeedsMoreInput = 0xC00D6D72;
  
  
  const dword kMedia_SourceReaderFlagError                    = 0x00000001;
  const dword kMedia_SourceReaderFlagEndOfStream              = 0x00000002;
  const dword kMedia_SourceReaderFlagNewStream                = 0x00000004;
  const dword kMedia_SourceReaderFlagNativeMediaTypeChanged   = 0x00000010;
  const dword kMedia_SourceReaderFlagCurrentMediaTypeChanged  = 0x00000020;
  const dword kMedia_SourceReaderFlagStreamTick               = 0x00000100;
  const dword kMedia_SourceReaderFlagAllEffectsRemoved        = 0x00000200;
  
  const dword kMediaStreamIndexFirstVideoStream = 0xFFFFFFFC; /* The first video stream*/
  const dword kMediaStreamIndexFirstAudioStream = 0xFFFFFFFD; /* The first audio stream*/
}

long Media_CheckHandleAndStopIfError(dword handle, char function[])
{
  char text[256];
  
  if (handle == kMedia_InvalidHandle)
  {
    strncpy(text, function, elCount(text));
    strncat(text, " returned 0, MediaGetLastError", elCount(text));
    
    return Avb_StopIfError(MediaGetLastError(), text);
  }
  
  return kMedia_OK;
}

long Media_StopIfError(long returnCode, char function[])
{
  if (returnCode != kMedia_OK)
  {
    Media_WriteErrorAndStop(returnCode, function);
    return returnCode;
  }
  
  return kMedia_OK;
}

void Media_WriteErrorAndStop(char text[], long errorCode)
{
  char textOut[256];
  long ret;
    
  PrependCaplFileName(text, textOut);
  
  snprintf(text, elCount(text), "%d", errorCode);
  strncat(textOut, text, elCount(textOut));
  
  write(textOut);
  Stop();
}

void Media_WriteErrorAndStop(long errorCode, char function[])
{
  char text[256];
  
  snprintf(text, elCount(text), "%s returned ", function);
 
  Media_WriteErrorAndStop(text, errorCode);
}