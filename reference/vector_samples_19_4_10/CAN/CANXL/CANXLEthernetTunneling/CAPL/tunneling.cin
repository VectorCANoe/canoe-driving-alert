/*@!Encoding:1252*/
includes
{

}

variables
{
  
}

/// <summary>
/// Tunnel an Ethernet frame via a CAN message (CiA 611-1).
/// </summary>
/// <param name="msg">The CAN message to populate.</param>
/// <param name="packet">The Ethernet packet to tunnel.</param>
void TunnelEthernetFrame(message* msg, ethernetPacket* packet, int tunnelMode)
{
  stack int i;
  word tpid, tci;
  stack long numVlanTags = 0;
  stack word header = 0;
  
  msg.XLF = 1;
  msg.SDT = tunnelMode;
  
  msg.qword(header) = packet.destination;
  header += 6;
  
  msg.qword(header) = packet.source;
  header += 6;
  
  packet.GetVlan(1, tpid, tci);
  msg.word(header) = tpid;
  header += 2;
  msg.word(header) = tci;
  header += 2;
  
  msg.word(header) = packet.type;
  header += 2;
  
  msg.dlc = packet.Length + header - 1;
  
  for (i = 0; i < packet.Length; i++)
  {
    msg.byte(i + header) = packet.byte(i);
  }
  
  if (tunnelMode == 0x5)
  {
    MapEthernetData(msg, packet);
  }
  
}

void MapEthernetData(message* msg, ethernetPacket* packet)
{
  stack byte firstOctet = 0;
  stack dword last3Octets = 0;
  
  if (packet.HasVlan())
  {
    msg.VCID = packet.GetVlanId() & 0xFF;
  }
  
  firstOctet = (packet.destination >> 40) & 0xFF;
  last3Octets = packet.destination & 0xFFFFFF;
  
  msg.AF = (firstOctet << 24) + last3Octets;
}

byte IsTunneledEthernetFrame(message* msg)
{
  return (msg.SDT == 0x4) || (msg.SDT == 0x5);
}

void UnTunnelEthernetFrame(message* msg, ethernetPacket* packet)
{
  stack int i;
  word tpid, tci;
  stack long numVlanTags = 0;
  
  stack word header = 0;
  
  packet.destination = msg.qword(header);
  header += 6;
  
  packet.source = msg.qword(header);
  header += 6;
  
  tpid = msg.word(header);
  header += 2;
  tci = msg.word(header);
  header += 2;
  
  packet.SetVlanId(tci);
  packet.SetVlanPriority(tpid);
  
  packet.type = msg.word(header);
  header +=2;
  
  packet.Length = msg.dlc - header + 1;
  for (i = 0; i < packet.Length; i++)
  {
    packet.byte(i) = msg.byte(i + header);
  }
  

  
  
}