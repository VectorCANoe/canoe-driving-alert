/*@!Encoding:1252*/

includes
{
  #include "Avb/FileTalker.cin"
}

variables
{
  ethernetPacket txPacket;
  dword gMMP_TalkerHandle;
}

on start {
   AvbSetVerbosity(0/* silent: 0, show all: 3 */);

   PtpSetProperty("PortRole", @sysvar::MMP::PtpPortRole);   
  
   MMP_Open();
}

on stopMeasurement
{
  MMP_Close();
  MMP_Stop();
}

on sysvar_change sysvar::Control::Play
{
  if (@this == 1)
  {
    MMP_Open();
//    MMP_Start();
  }
}

on sysvar_change sysvar::Control::Stop
{
  if (@this == 1)
  {
    MMP_Stop();
    MMP_Close();
  }
}


on sysvar_update sysvar::MMP::FilePath
{
  char mediaFilePath[256];
  
  sysGetVariableString( this, mediaFilePath, elcount(mediaFilePath) );
  
  FileTalker_SetFilePath(gMMP_TalkerHandle, mediaFilePath, (@sysvar::MMP::MajorType == 0) ? kMediaStreamIndexFirstVideoStream : kMediaStreamIndexFirstAudioStream);
}

on sysvar sysvar::MMP::PtpPortRole
{
  PtpSetProperty( "PortRole", @this ); 
}

on sysvar_update sysvar::MMP::PlayingLoop
{
  FileTalker_SetRepeat(gMMP_TalkerHandle, @this);
}

on sysvar_change sysvar::MMP::StartPlaying
{
  if (@this == 1)
  {
    FileTalker_Replay(gMMP_TalkerHandle);
  }
}

void MMP_Open()
{  
  long result;
  char mediaFilePath[256];
  char streamIdStr[32];
  byte streamId[kAvb_StreamIdSize];
  long retCount;
  long channel;
  
  if (gMMP_TalkerHandle != kAvb_InvalidHandle)
  {
    return;
  }
  
  result = sysGetVariableString(sysvar::MMP::FilePath, mediaFilePath, elcount(mediaFilePath));
  
  if (result != 0)
  {
    WriteAndStop("MMP_Open: sysGetVariableString[FilePath] returned %d", result);
    return;
  }
   
  result = sysGetVariableString(sysvar::MMP::StreamId, streamIdStr, elcount(streamIdStr));
  
  if (result != 0)
  {
    WriteAndStop("MMP_Open: sysGetVariableString[StreamId] returned %d", result);
    return;
  }
        
  result = Avb_ParseStreamId(streamIdStr, streamId);
  
  if (result != 0)
  {
    WriteAndStop("MMP_Open: Avb_ParseStreamId returned %d", result);
    return;
  }

  gMMP_TalkerHandle = FileTalker_Open(@sysvar::MMP::VlanId, streamId, mediaFilePath, (@sysvar::MMP::MajorType == 0) ? kMediaStreamIndexFirstVideoStream : kMediaStreamIndexFirstAudioStream, @sysvar::MMP::PlayingLoop);
      
  if (Avb_CheckHandleAndStopIfError(gMMP_TalkerHandle, "AvbSetProperty") != kAvb_OK)
  {
    return;
  }
  
  MMP_Start();
}

void MMP_Start()
{    
  stack long result;
  stack char destinationAddressStr[256];
  stack qword destinationAddress;
  stack byte destinationAddressArr[16];
  
  if (gMMP_TalkerHandle == kAvb_InvalidHandle)
  {
    return;
  }
  
  switch (@sysvar::MMP::Transport)
  {
    case 0: // AVTP
      result = sysGetVariableString(sysvar::MMP::MacDestinationAddress, destinationAddressStr, elcount(destinationAddressStr));

      if (result != 0)
      {
        WriteAndStop("sysGetVariableString returned %d", result);
        return;
      }
            
      destinationAddress = ethGetMacAddressAsNumber(destinationAddressStr);
            
      destinationAddressArr[5] = (destinationAddress >> 40) & 0xFF;
      destinationAddressArr[4] = (destinationAddress >> 32) & 0xFF;
      destinationAddressArr[3] = (destinationAddress >> 24) & 0xFF;
      destinationAddressArr[2] = (destinationAddress >> 16) & 0xFF;
      destinationAddressArr[1] = (destinationAddress >> 8) & 0xFF;
      destinationAddressArr[0] = destinationAddress & 0xFF;
            
      FileTalker_Start(gMMP_TalkerHandle, destinationAddressArr);        

      break;
    case 1: // RTP  
      //ipGetAddressAsArray( "FF00::0001", remoteAddress );
      
      result = sysGetVariableString("MMP", "IpDestinationAddress", destinationAddressStr, elcount(destinationAddressStr));
      
      if (result != 0)
      {
        WriteAndStop("sysGetVariableString returned %d", result);
        return;
      }
      
      if (@sysvar::MMP::IpVersion == 0) // IPv4
      {
        FileTalker_Start(gMMP_TalkerHandle, ipGetAddressAsNumber(destinationAddressStr), @sysvar::MMP::IpDestinationPort);
      }
      else
      {
        long result;
        
        result = ipGetAddressAsArray(destinationAddressStr, destinationAddressArr);
        
        if (result != 0)
        {
          WriteAndStop("ipGetAddressAsArray returned %d", result);
          return;
        }
                
        FileTalker_Start(gMMP_TalkerHandle, destinationAddressArr, @sysvar::MMP::IpDestinationPort);
      }
      
      break;
    default:
      write("Transport %d not supported", @sysvar::MMP::Transport);
      Stop();
      return;
  } 
}

void MMP_Close()
{
  if (gMMP_TalkerHandle == kAvb_InvalidHandle)
  {
    return;
  }
  
  FileTalker_Close(gMMP_TalkerHandle);
  
  gMMP_TalkerHandle = kAvb_InvalidHandle;
}

void MMP_Stop()
{
  if (gMMP_TalkerHandle == kAvb_InvalidHandle)
  {
    return;
  }
  
  FileTalker_Stop(gMMP_TalkerHandle);
}
