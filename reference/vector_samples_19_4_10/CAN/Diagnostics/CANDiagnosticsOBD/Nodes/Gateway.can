/*@!Encoding:1252*/
includes
{
}

variables
{
}

on message *
{
  message * txMsg;

  txMsg=this;
  if (this.dir==Rx) {
    if (this.can == 1) { // DiagAccess_CAN
      txMsg.can=2;
      output(txMsg);
    }
    if (this.can == 2) { // CAN2
      txMsg.can=1;
      output(txMsg);
    }
  }
}