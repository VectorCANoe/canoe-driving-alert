/*@!Encoding:1252*/
includes
{
  #include "../CAPL_Includes/DiagDefinitions.cin"
  #include "../CAPL_Includes/LibFunctions_Write.cin"
  #include "../CAPL_Includes/LibFunctions_Node.cin"
  #include "../CAPL_Includes/CommonDiagImplementation.cin"
  #include "../CAPL_Includes/OBD2_CommonImplementation.cin"
#define OBD2_NO_GENERIC
  #include "../CAPL_Includes/FaultMemory_Sim.cin"
#define OBD2_NO_GENERIC
  #include "../CAPL_Includes/SessionHandler_Sim.cin"
}

variables
{
  char gECU[20]="TCM_OBD2_CAN";
  byte ecuAcronym[20]={'T','C','M', 0, '-', 'T','r','a','n','s','m','i','s','s','i','o','n','C','t','l'};
  const cIsTester=0;
  byte cSupportedPIDs[32]={0xC0, 0x00, 0x00, 0x11,  // PID 0x01: I/M Readiness Data
                                                    // PID 0x02: DTC that Caused Freeze Frame Storage Request Freeze Frame
                                                    // PID 0x1C: OBD requirements for vehicle or engine
                                                    // PID 0x20: PID supported, $21 - $40 Read current
                           0x80, 0x00, 0x80, 0x01,  // PID 0x21: Distance travelled while MIL is activated
                                                    // PID 0x31: Distance traveled since DTCs cleard
                                                    // PID 0x40: PID supported, $41 - $60 Read current
                           0x00, 0x0C, 0x00, 0x01,  // PID 0x4D: Engine Run Time while MIL activated
                                                    // PID 0x4E: Engine Run Time since DTCs cleared
                                                    // PID 0x60: PID supported, $61 - $80 Read current
                           0x00, 0x00, 0x00, 0x01,  // PID 0x80: PID supported, $81 - $A0 Read current
                           0x00, 0x00, 0x00, 0x01,  // PID 0xA0: PID supported, $A1 - $C0 Read current
                           0x10, 0x00, 0x00, 0x00,  // PID 0xA4: Transmission Actual Gear
                           0x00, 0x00, 0x00, 0x00,
                           0x00, 0x00, 0x00, 0x00};
                           
  byte cSupportedFreezeFramePIDs[32]=
                          {0x40, 0x00, 0x00, 0x01,  // PID 0x02: DTC that Caused Freeze Frame Storage Request Freeze Frame
                                                    // PID 0x20: PID supported, $21 - $40 Read current
                           0x80, 0x00, 0x80, 0x00,  // PID 0x21: Distance travelled while MIL is activated
                                                    // PID 0x31: Distance traveled since DTCs cleard
                           0x00, 0x00, 0x00, 0x00,  
                           0x00, 0x00, 0x00, 0x00,
                           0x00, 0x00, 0x00, 0x00,
                           0x00, 0x00, 0x00, 0x00,
                           0x00, 0x00, 0x00, 0x00,
                           0x00, 0x00, 0x00, 0x00};

  byte cSupportedINFOTYPEs[32]={0x00, 0x41, 0x00, 0x00,  
                                                         // INFOTYPE 0x0A: ECUNAME
                                                         // INFOTYPE 0x10: Protocol Identification
                           0x00, 0x00, 0x00, 0x00,
                           0x00, 0x00, 0x00, 0x00,
                           0x00, 0x00, 0x00, 0x00,
                           0x00, 0x00, 0x00, 0x00,
                           0x00, 0x00, 0x00, 0x00,
                           0x00, 0x00, 0x00, 0x00,
                           0x00, 0x00, 0x00, 0x00};
                         
  byte cSupportedOBDMIDs[32]={0x00, 0x00, 0x00, 0x00, 
                           0x00, 0x00, 0x00, 0x00,
                           0x00, 0x00, 0x00, 0x00,
                           0x00, 0x00, 0x00, 0x00,
                           0x00, 0x00, 0x00, 0x00,
                           0x00, 0x00, 0x00, 0x00,
                           0x00, 0x00, 0x00, 0x00,
                           0x00, 0x00, 0x00, 0x00};
                         
  byte cSupportedTIDs[32]={0x80, 0x00, 0x00, 0x00, // TID 0x01: Evaporative system leak test
                           0x00, 0x00, 0x00, 0x00,
                           0x00, 0x00, 0x00, 0x00,
                           0x00, 0x00, 0x00, 0x00,
                           0x00, 0x00, 0x00, 0x00,
                           0x00, 0x00, 0x00, 0x00,
                           0x00, 0x00, 0x00, 0x00,
                           0x00, 0x00, 0x00, 0x00};
                           
// Following DTCs stored in OBD-II fault memory
  const cDtcObd2_StuckInGear1              = 0x00072C; 
  const cDtcObd2_StuckInGear2              = 0x00072D;
  const cDtcObd2_StuckInGear3              = 0x00072E;
  const cDtcObd2_StuckInGear4              = 0x00072F;
                           
  
  const cNumberOfSupportedDTCs=4;
  struct sSupportedDTCs SupportedDTC[cNumberOfSupportedDTCs] = {
                                                // OBD fault memory
                                                {cDtcObd2_StuckInGear1            ,  fmtOBD_II},
                                                {cDtcObd2_StuckInGear2            ,  fmtOBD_II},
                                                {cDtcObd2_StuckInGear3            ,  fmtOBD_II},
                                                {cDtcObd2_StuckInGear4            ,  fmtOBD_II}
                                               };

}

on key 'a'
{
  AddFault(cDtcObd2_StuckInGear1, cStatusBit_TestFailed | cStatusBit_PendingDTC, cSeverityBit_Class0 | cSeverityBit_MaintenanceOnly);
  AddFault(cDtcObd2_StuckInGear2, cStatusBit_TestFailed | cStatusBit_ConfirmedDTC, cSeverityBit_Class0 | cSeverityBit_MaintenanceOnly);
  AddFault(cDtcObd2_StuckInGear3, cStatusBit_TestFailed | cStatusBit_TestFailedSinceLastClear, cSeverityBit_Class1 | cSeverityBit_CheckAtNextHalt);
  AddFault(cDtcObd2_StuckInGear4, cStatusBit_TestFailed | cStatusBit_TestFailedSinceLastClear | cStatusBit_WarningIndicatorRequested, cSeverityBit_Class1 | cSeverityBit_CheckAtNextHalt);
}

on start
{
  @sysvarMember::TCM_OBD2_CAN::FaultMemoryGui.DTC_ToStore=cDtcObd2_StuckInGear1;
  @Vehicle::DistanceTravelledWhileMILActivated=0;
  @Vehicle::EngineRuntimeWhileMILActivated=0;
  @Vehicle::DistanceTravelledSinceDTCsCleared=22025;
  @Vehicle::EngineRuntimeSinceDTCsCleared=20189;
}

void InitECU()
{
  InitFaultmem(SupportedDTC);  

  gS3ServerTimeout=diagGetCommParameter("CANoe.S3ServerTime");
  gP2ClientTimeout=150;
  gP2extClientTimeout=2000;

  ResetSession();
  @sysvar::%BASE_FILE_NAME_NO_EXT%::TesterPresent=0;
}

void ResetMILStatus()
{
  @TCM_OBD2_CAN::OBD.MIL_Status=0;
}