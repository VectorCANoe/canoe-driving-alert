/*@!Encoding:65001*/
includes
{
  
}

variables
{
  struct S_measuredData {
    int throttlePosition;  // [1..100]
    int vehicleSpeed_kmh;
    int RPM;
    int gear; // [0..7]
  };
  
  struct S_DrivingCycle {
    struct S_measuredData dataIncrement;
    word numberOfIncrements;
  };
  
  const drivingCycleSegments = 36;
  struct S_DrivingCycle DrivingCycleData[drivingCycleSegments]={
    {{  0, 0,   0, 0},  10},
    {{  0, 1,   0, 1},   1},
    {{  0, 1,   0, 0},   2},
    {{  4, 4,  48, 1},   1},
    {{  4, 4,  48, 0},   3},
    {{  5, 3, 109, 0},   3},
    {{ -5, 1, -70, 1},   1},
    {{ -5, 1, -70, 0},   1},
    {{ -5, 0, -70, 0},   2},
    {{  2, 2,  52, 0},   4},
    {{ -8, 2,  73, 0},   1},
    {{  0, 0,   0, 0},  20},
    {{  1, 2, 209, 1},   1},
    {{  2, 1, 207, 0},   3},
    {{  1, 3,-160, 1},   1},
    {{  1, 3,-160, 0},   3},
    {{  1, 8,  59, 1},   1},
    {{  0, 7,  57, 0},   3},
    {{  0, 1, -21, 1},   1},
    {{  0, 1, 200, 0},   3},
    {{  0, 0,   0, 0},  20},
    {{ -2,-3,-108,-1},   1},
    {{ -2,-3, -70, 0},   6},
    {{ -1,-7,  47,-1},   1},
    {{ -1,-7,  47, 0},   3},
    {{  0,-2, -57,-1},   1},
    {{ -1,-2, -57, 0},   3},
    {{  0,-3,  74,-1},   1},
    {{  0,-3,  74, 0},   3},
    {{  0,-2,-224,-1},   1},
    {{  0,-2,-224, 0},   3},
    {{  0,-2, -49,-1},   1},
    {{  0,-2,  49, 0},   3},
    {{ -1,-2,-224, 0},   2},
    {{  0,-1,  -1,-1},   1},
    {{  0, 0,   0, 0},  20}
  };
  
  mstimer tUpdateVehicleData;
  
  word drivingCycleIndex;
  word remainingIncrements;
  dword drivenDistance_m;
  dword distanceTravelledWhileMILActivated_m=0;
  dword engineRuntimeWhileMILActivated_s=0;
}

on start
{
  setVehicleData(14, 0, 750, 0, 0, 0);
  drivenDistance_m=@sysvar::ExternalSignals::OdometerValue*1000;
  drivingCycleIndex=0;
  remainingIncrements=DrivingCycleData[drivingCycleIndex].numberOfIncrements;
  setTimerCyclic(tUpdateVehicleData, 1000); // Update every second
}

on stopMeasurement
{
  setVehicleData(0, 0, 0, 0, 0, 0);
}

on timer tUpdateVehicleData
{
  float drivenDistanceIncrement_m;
  word MIL_Status;
  
  drivenDistanceIncrement_m=(((float)@sysvar::Vehicle::VehicleSpeedSensor)*(10.0/36.0));
  drivenDistance_m=(long)drivenDistance_m+drivenDistanceIncrement_m;
  MIL_Status=(@sysvarMember::ECM_OBD2_CAN::OBD.MIL_Status || @sysvarMember::ECM_OBDonUDS_CAN::OBD.MIL_Status || @sysvarMember::TCM_OBD2_CAN::OBD.MIL_Status || @sysvarMember::TCM_OBDonUDS_CAN::OBD.MIL_Status);
  if (MIL_Status) {
    distanceTravelledWhileMILActivated_m+=drivenDistanceIncrement_m;
    engineRuntimeWhileMILActivated_s++;
    @Vehicle::DistanceTravelledWhileMILActivated=distanceTravelledWhileMILActivated_m/1000;
    @Vehicle::EngineRuntimeWhileMILActivated=engineRuntimeWhileMILActivated_s/60;
  }
  
  ChangeVehicleData(DrivingCycleData[drivingCycleIndex].dataIncrement.throttlePosition,
                    DrivingCycleData[drivingCycleIndex].dataIncrement.vehicleSpeed_kmh,
                    DrivingCycleData[drivingCycleIndex].dataIncrement.RPM,
                    DrivingCycleData[drivingCycleIndex].dataIncrement.gear,
                    (int)(drivenDistance_m/1000),
                    MIL_Status);
  
  if (remainingIncrements>0) remainingIncrements--;

  if (remainingIncrements==0) {
    drivingCycleIndex=(drivingCycleIndex+1)%drivingCycleSegments;
    remainingIncrements=DrivingCycleData[drivingCycleIndex].numberOfIncrements;
  }
}

ChangeVehicleData(int throttlePositionIncrement, int vehicleSpeedIncrement_kmh, int RPM_Increment, int gearIncrement, word odometerValue_km, word MIL_Status)
{
  setVehicleData(@sysvar::Vehicle::ThrottlePosition+throttlePositionIncrement, 
                 @sysvar::Vehicle::VehicleSpeedSensor+vehicleSpeedIncrement_kmh,
                 @sysvar::Vehicle::RPM+RPM_Increment,
                 @sysvar::Vehicle::Gear+gearIncrement,
                 odometerValue_km,
                 MIL_Status);
}

setVehicleData(word throttlePosition, word vehicleSpeed_kmh, word RPM, word gear, word odometerValue_km, word MIL_Status)
{
  @sysvar::Vehicle::ThrottlePosition=throttlePosition;
  @sysvar::Vehicle::VehicleSpeedSensor=vehicleSpeed_kmh;
  @sysvar::Vehicle::RPM=RPM;
  @sysvar::Vehicle::Gear=gear;
  @sysvar::ExternalSignals::OdometerValue=odometerValue_km;  
  @sysvar::Vehicle::MIL_Status=MIL_Status;
}