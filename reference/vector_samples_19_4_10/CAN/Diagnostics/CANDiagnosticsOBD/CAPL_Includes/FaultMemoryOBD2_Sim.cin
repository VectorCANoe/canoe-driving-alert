/*@!Encoding:1252*/

//*********************************
// Mode 0x01 (PIDs / Request Current Powertrain Diagnostic Data)
//*********************************

on diagRequest %BASE_FILE_NAME_NO_EXT%._PID_02_DTC_that_Caused_Freeze_Frame_Storage_REQUEST_CURR_PWRTRAIN_DATA
{
  diagResponse this resp;

  refreshS3Timer();
  resp.SetParameter("DTCCausedFreezeFrame", @sysvarMember::%BASE_FILE_NAME_NO_EXT%::FaultMemoryInternal.DtcThatCausedFreezeFrameStorage); 
  diagSendPositiveResponse(resp);  
}

//*********************************
// OBD-II specific DTC read services
//*********************************

//*********************************
// Mode 0x02 (Request Powertrain Freeze Frame Data)
//*********************************

on diagRequest %BASE_FILE_NAME_NO_EXT%._PID_00_PID_supported_01_20_REQUEST_PWRTRAIN_FREEZE_FRAME_DATA
{
  diagResponse this resp;

  refreshS3Timer();
  if (this.GetParameter("FrameNumber") == 0) {
    resp.SetParameter("FrameNumber", 0); 
    determineSupportedIdsAndSendResponse(resp, 0, "Supported_PIDs", cSupportedFreezeFramePIDs);
  }
}

on diagRequest %BASE_FILE_NAME_NO_EXT%._PID_20_PID_supported_21_40_REQUEST_PWRTRAIN_FREEZE_FRAME_DATA
{
  diagResponse this resp;

  refreshS3Timer();
  if (this.GetParameter("FrameNumber") == 0) {
    resp.SetParameter("FrameNumber", 0); 
    determineSupportedIdsAndSendResponse(resp, 4, "Supported_PIDs", cSupportedFreezeFramePIDs);
  }
}

on diagRequest %BASE_FILE_NAME_NO_EXT%._PID_02_DTC_that_Caused_Freeze_Frame_Storage_REQUEST_PWRTRAIN_FREEZE_FRAME_DATA
{
  diagResponse this resp;
  
  refreshS3Timer();
  if (this.GetParameter("FrameNumber") == 0) {
    resp.SetParameter("DTCCausedFreezeFrame", @sysvarMember::%BASE_FILE_NAME_NO_EXT%::FaultMemoryInternal.DtcThatCausedFreezeFrameStorage); 
    resp.SetParameter("FrameNumber", 0); 
    diagSendPositiveResponse(resp);  
  }
}

on diagRequest %BASE_FILE_NAME_NO_EXT%._PID_21_Travel_Distance_While_MIL_Activated_REQUEST_PWRTRAIN_FREEZE_FRAME_DATA
{
  diagResponse this resp;

  refreshS3Timer();
  if (this.GetParameter("FrameNumber") == 0 && @sysvarMember::%BASE_FILE_NAME_NO_EXT%::FaultMemoryInternal.DtcThatCausedFreezeFrameStorage != 0) {
    resp.SetParameter("FrameNumber", 0); 
    resp.SetParameter("MIL_Distance", gFM.fault[GetFaultIndex(@sysvarMember::%BASE_FILE_NAME_NO_EXT%::FaultMemoryInternal.DtcThatCausedFreezeFrameStorage)].freezeFrame.distanceTravelledWhileMILActivated); 
    diagSendPositiveResponse(resp);  
  }
}

on diagRequest %BASE_FILE_NAME_NO_EXT%._PID_31_Distance_since_DTCs_cleared_REQUEST_PWRTRAIN_FREEZE_FRAME_DATA
{
  diagResponse this resp;

  refreshS3Timer();
  if (this.GetParameter("FrameNumber") == 0 && @sysvarMember::%BASE_FILE_NAME_NO_EXT%::FaultMemoryInternal.DtcThatCausedFreezeFrameStorage != 0) {
    resp.SetParameter("FrameNumber", 0); 
    resp.SetParameter("Distance_since_clear_DTC", gFM.fault[GetFaultIndex(@sysvarMember::%BASE_FILE_NAME_NO_EXT%::FaultMemoryInternal.DtcThatCausedFreezeFrameStorage)].freezeFrame.distanceSinceDtcsCleared); 
    diagSendPositiveResponse(resp);  
  }
}

//*********************************
// Mode 0x03 (Request Emission-Related Diagnostic Trouble Codes)
//*********************************

// OBD-II
on diagRequest %BASE_FILE_NAME_NO_EXT%.OBD_II_DTCs_Read_Powertrain
{
  byte statusMask= (cStatusBit_TestFailed | cStatusBit_ConfirmedDTC);
  diagResponse this resp;

  ReadAllIdentified(resp, statusMask, fmtOBD_II);  
}

//*********************************
// Mode 0x04 (Clear/Reset Emission-Related Diagnostic Information)
//*********************************

on diagRequest %BASE_FILE_NAME_NO_EXT%.OBD_II_DTCs_Clear_Reset
{
  diagResponse this resp;
  
  refreshS3Timer();
  ClearFaultmem(fmtOBD_II);
  diagSendPositiveResponse(resp);  
}

//*********************************
// Mode 0x07 (Request Emission-Related Diagnostic Trouble Codes Detected During Current or Last Completed Driving Cycle)
//*********************************

on diagRequest %BASE_FILE_NAME_NO_EXT%.OBD_II_DTCs_Read_detection_time_dependent
{
  byte statusMask=(cStatusBit_TestFailedThisMonitoringCycle | cStatusBit_PendingDTC);
  diagResponse this resp;
  
  ReadAllIdentified(resp, statusMask, fmtOBD_II);  
}

//*********************************
// Mode 0x0A (Request Emission-Related Diagnostic Trouble Codes with Permanent Status), only for ISO 15765-4
//*********************************

on diagRequest %BASE_FILE_NAME_NO_EXT%.OBD_II_DTCs_Read_Permanent_Status
{
  byte statusMask=(cStatusBit_TestFailedSinceLastClear);
  diagResponse this resp;
  
  ReadAllIdentified(resp, statusMask, fmtOBD_II);  
}
