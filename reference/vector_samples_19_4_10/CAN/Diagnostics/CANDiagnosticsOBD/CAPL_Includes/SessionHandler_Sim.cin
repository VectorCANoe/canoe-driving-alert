/*@!Encoding:1252*/
//=========================================================
// Session Handler for Example CDD ECUs
// Expects following callback functions in simulation node:
// void S3ServerReset(void)
// void ResetSession(void)
// void ResetLock(void)
// long sendNegativeResponse(diagRequest * req, dword nrc)
// long sendNegativeResponse(diagResponse * resp, dword nrc)
//
// Expects following constant definitions:
// cSessionTypeParameterName: Name of SessionType parameter in Diagnostic Description
//=========================================================

includes
{
  #include "..\CAPL_Includes\SessionTimerHandling.cin"
}

// Use diagnostic class handler to save some identical lines of code
// (Variant for Example CDD)
on diagRequest %BASE_FILE_NAME_NO_EXT%.Sessions::*
{
  diagResponse this resp;
  word SessionType;
  word errorFlag;
  long supResp;
  
  errorFlag=0;
  
  refreshS3Timer();
  supResp=diagGetSuppressResp(this);
  if (supResp)
  {
    SessionType=((word)diagGetParameter(this, cSessionTypeParameterName)) & 0x7F; // Filter out SPRMIB
  }
  else 
  {
    SessionType=((word)diagGetParameter(this, cSessionTypeParameterName));
  }
    
  if (SessionType != @sysvarMember::%BASE_FILE_NAME_NO_EXT%::Session.CurrentSession) {
    ResetLock();
  }
  switch(SessionType) {
    case DefaultSession: 
    case KWP_DefaultSession: // equal to DefaultSessionNoResponse
      @sysvarMember::%BASE_FILE_NAME_NO_EXT%::Session.CurrentSession=SessionType;
      cancelTimer( tSessionTimer);
      break;
    case KWP_ProgrammingSession:
      @sysvarMember::%BASE_FILE_NAME_NO_EXT%::Session.CurrentSession=SessionType;
      refreshSessionTimer();
      break;
    case ProgrammingSession: 
    case ProgrammingSessionNoResponse: 
      if (ExtendedSession==@sysvarMember::%BASE_FILE_NAME_NO_EXT%::Session.CurrentSession) {
        @sysvarMember::%BASE_FILE_NAME_NO_EXT%::Session.CurrentSession=ProgrammingSession;
        refreshSessionTimer();
      }
      else {
        errorFlag=1;
      }
      break;
    case ExtendedSession: 
    case ExtendedSessionNoResponse:
      if (ProgrammingSession!=@sysvarMember::%BASE_FILE_NAME_NO_EXT%::Session.CurrentSession) {
        @sysvarMember::%BASE_FILE_NAME_NO_EXT%::Session.CurrentSession=ExtendedSession;
        refreshSessionTimer();
      }
      else {
        errorFlag=1;
      }
      break;
    default:
      errorFlag=1;
      break;
  }
  if (errorFlag) {
    ResetSession();
    sendNegativeResponse(resp, cNRC_ConditionsNotCorrectOrRequestSequenceError); 
    cancelTimer( tSessionTimer);
  }
  else {
    if (supResp) {
      writeDbgLvlPrefix( 3, "Suppressed %BASE_FILE_NAME_NO_EXT%.Sessions::* response!");
    }
    else {
      if (SessionType==DefaultSession || SessionType==ProgrammingSession || SessionType==ExtendedSession)
      {
        diagSetParameter(resp, cParamAccessPhysical, "P2", gP2ClientTimeout);
        diagSetParameter(resp, cParamAccessPhysical, "P2Ex", gP2extClientTimeout);
      }
      diagSendPositiveResponse(resp);
    }
  }
}
