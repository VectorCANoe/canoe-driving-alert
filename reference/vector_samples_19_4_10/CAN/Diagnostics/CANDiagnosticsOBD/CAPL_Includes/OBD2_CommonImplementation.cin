/*@!Encoding:1252*/
variables
{
  char VIN[18]="VECT0RVEH1CLE0001";
}


on sysvar sysvarMember::%BASE_FILE_NAME_NO_EXT%::FaultMemoryGui.BtnStoreDTC
{
  byte status, severity;
  
  if (@this) { // only when button was pressed (not when released)
    status =   (@sysvarMember::%BASE_FILE_NAME_NO_EXT%::FaultMemoryGui.StatusByte[7] << 7)
             | (@sysvarMember::%BASE_FILE_NAME_NO_EXT%::FaultMemoryGui.StatusByte[6] << 6)
             | (@sysvarMember::%BASE_FILE_NAME_NO_EXT%::FaultMemoryGui.StatusByte[5] << 5)
             | (@sysvarMember::%BASE_FILE_NAME_NO_EXT%::FaultMemoryGui.StatusByte[4] << 4)
             | (@sysvarMember::%BASE_FILE_NAME_NO_EXT%::FaultMemoryGui.StatusByte[3] << 3)
             | (@sysvarMember::%BASE_FILE_NAME_NO_EXT%::FaultMemoryGui.StatusByte[2] << 2)
             | (@sysvarMember::%BASE_FILE_NAME_NO_EXT%::FaultMemoryGui.StatusByte[1] << 1)
             |  @sysvarMember::%BASE_FILE_NAME_NO_EXT%::FaultMemoryGui.StatusByte[0];
    
    severity = (@sysvarMember::%BASE_FILE_NAME_NO_EXT%::FaultMemoryGui.SeverityByte[7] << 7)
             | (@sysvarMember::%BASE_FILE_NAME_NO_EXT%::FaultMemoryGui.SeverityByte[6] << 6)
             | (@sysvarMember::%BASE_FILE_NAME_NO_EXT%::FaultMemoryGui.SeverityByte[5] << 5)
             | (@sysvarMember::%BASE_FILE_NAME_NO_EXT%::FaultMemoryGui.SeverityByte[4] << 4)
             | (@sysvarMember::%BASE_FILE_NAME_NO_EXT%::FaultMemoryGui.SeverityByte[3] << 3)
             | (@sysvarMember::%BASE_FILE_NAME_NO_EXT%::FaultMemoryGui.SeverityByte[2] << 2)
             | (@sysvarMember::%BASE_FILE_NAME_NO_EXT%::FaultMemoryGui.SeverityByte[1] << 1)
             |  @sysvarMember::%BASE_FILE_NAME_NO_EXT%::FaultMemoryGui.SeverityByte[0];
    
    AddFault(@sysvarMember::%BASE_FILE_NAME_NO_EXT%::FaultMemoryGui.DTC_ToStore, status, severity);
  }
}

on sysvar sysvarMember::%BASE_FILE_NAME_NO_EXT%::FaultMemoryInternal.FaultMemoryActivated
{
  setControlVisibility("%BASE_FILE_NAME_NO_EXT%_FaultMemory", "DtcStorageWarningText", @this?0:1);
}

determineSupportedIdsAndSendResponse(diagResponse * resp, word offset, char parameterName[], byte supportedIDs[])
{
  byte supportedIDsWithOffset[4];
  
  memcpy_off(supportedIDsWithOffset, 0, supportedIDs, offset, elcount(supportedIDsWithOffset));
  
  resp.SetParameterRaw(parameterName, supportedIDsWithOffset, elcount(supportedIDsWithOffset));
  resp.SendResponse();
}

on diagRequest %BASE_FILE_NAME_NO_EXT%.*
{
  diagResponse this resp;
  
  // As this handler should only be called in case of functional requests for services 
  // which are not supported by this ECU, send no response at all as specified in J1979-2, chapter 6.2.5
}

//*********************************
// Mode 0x01 (PIDs / Request Current Powertrain Diagnostic Data)
//*********************************

on diagRequest %BASE_FILE_NAME_NO_EXT%._PID_00_PID_supported_01_20_REQUEST_CURR_PWRTRAIN_DATA
{
  diagResponse this resp;

  refreshS3Timer();
  determineSupportedIdsAndSendResponse(resp, 0, "Supported_PIDs", cSupportedPIDs);
}

on diagRequest %BASE_FILE_NAME_NO_EXT%._PID_20_PID_supported_21_40_REQUEST_CURR_PWRTRAIN_DATA
{
  diagResponse this resp;
  
  refreshS3Timer();
  determineSupportedIdsAndSendResponse(resp, 4, "Supported_PIDs", cSupportedPIDs);
}

on diagRequest %BASE_FILE_NAME_NO_EXT%._PID_40_PID_supported_41_60_REQUEST_CURR_PWRTRAIN_DATA
{
  diagResponse this resp;
  
  refreshS3Timer();
  determineSupportedIdsAndSendResponse(resp, 8, "Supported_PIDs", cSupportedPIDs);
}

on diagRequest %BASE_FILE_NAME_NO_EXT%._PID_60_PID_supported_61_80_REQUEST_CURR_PWRTRAIN_DATA
{
  diagResponse this resp;
  
  refreshS3Timer();
  determineSupportedIdsAndSendResponse(resp, 12, "Supported_PIDs", cSupportedPIDs);
}

on diagRequest %BASE_FILE_NAME_NO_EXT%._PID_80_PID_supported_81_A0_REQUEST_CURR_PWRTRAIN_DATA
{
  diagResponse this resp;
  
  refreshS3Timer();
  determineSupportedIdsAndSendResponse(resp, 16, "Supported_PIDs", cSupportedPIDs);
}

on diagRequest %BASE_FILE_NAME_NO_EXT%._PID_A0_PID_supported_A1_C0_REQUEST_CURR_PWRTRAIN_DATA
{
  diagResponse this resp;
  
  refreshS3Timer();
  determineSupportedIdsAndSendResponse(resp, 20, "Supported_PIDs", cSupportedPIDs);
}

on diagRequest %BASE_FILE_NAME_NO_EXT%._PID_C0_PID_supported_C1_E0_REQUEST_CURR_PWRTRAIN_DATA
{
  diagResponse this resp;
  
  refreshS3Timer();
  determineSupportedIdsAndSendResponse(resp, 24, "Supported_PIDs", cSupportedPIDs);
}

on diagRequest %BASE_FILE_NAME_NO_EXT%._PID_E0_PID_supported_E1_FF_REQUEST_CURR_PWRTRAIN_DATA
{
  diagResponse this resp;
  
  refreshS3Timer();
  determineSupportedIdsAndSendResponse(resp, 28, "Supported_PIDs", cSupportedPIDs);
}

on diagRequest %BASE_FILE_NAME_NO_EXT%._PID_01_Status_of_monitors_REQUEST_CURR_PWRTRAIN_DATA
{
  diagResponse this resp;
  
  refreshS3Timer();
  resp.SetParameter("NbrOfEmissionRelatedDTCsAndMILStatus.MILStatus", @sysvarMember::%BASE_FILE_NAME_NO_EXT%::OBD.MIL_Status); 
  resp.SetParameter("NbrOfEmissionRelatedDTCsAndMILStatus.NumEmissionRelatedDTCs", @sysvarMember::%BASE_FILE_NAME_NO_EXT%::FaultMemoryInternal.NumberOfStoredEmissionRelatedDTCs); 

  resp.SetParameter("SuppContTests.ComprehensiveComponentMonitoringComplete", @sysvarMember::ECM_OBD2_CAN::IncompleteMonitors.ComprehensiveComponent); 
  resp.SetParameter("SuppContTests.ComprehensiveComponentMonitoringSupported", @sysvarMember::ECM_OBD2_CAN::SupportedMonitors.ComprehensiveComponent); 
  resp.SetParameter("SuppContTests.FuelSystemMonitoringComplete", @sysvarMember::ECM_OBD2_CAN::IncompleteMonitors.FuelSystem); 
  resp.SetParameter("SuppContTests.FuelSystemMonitoringSupported", @sysvarMember::ECM_OBD2_CAN::SupportedMonitors.FuelSystem); 
  resp.SetParameter("SuppContTests.MisfireMonitoringComplete", @sysvarMember::ECM_OBD2_CAN::IncompleteMonitors.Misfire); 
  resp.SetParameter("SuppContTests.MisfireMonitoringSupported", @sysvarMember::ECM_OBD2_CAN::SupportedMonitors.Misfire); 
  
  resp.SetParameter("SuppTestRunMinOnce.ACSysRefrigMonRunOnce", @sysvarMember::ECM_OBD2_CAN::SupportedMonitors.A_C_SystemRefrigerant);
  resp.SetParameter("SuppTestRunMinOnce.EgrSysMon", @sysvarMember::ECM_OBD2_CAN::SupportedMonitors.EgrSystem);
  resp.SetParameter("SuppTestRunMinOnce.OxySensHeaterMonRunOnce", @sysvarMember::ECM_OBD2_CAN::SupportedMonitors.OxygenSensorHeater);
  resp.SetParameter("SuppTestRunMinOnce.OxySensMonRunOnce", @sysvarMember::ECM_OBD2_CAN::SupportedMonitors.OxygenSensor);
  resp.SetParameter("SuppTestRunMinOnce.SecondaryAirSysMonRunOnce", @sysvarMember::ECM_OBD2_CAN::SupportedMonitors.SecondaryAir);
  resp.SetParameter("SuppTestRunMinOnce.SuppCatalystMon", @sysvarMember::ECM_OBD2_CAN::SupportedMonitors.Catalyst);
  resp.SetParameter("SuppTestRunMinOnce.SuppEvaporativeSystemMon", @sysvarMember::ECM_OBD2_CAN::SupportedMonitors.EvaporativeSystem);
  resp.SetParameter("SuppTestRunMinOnce.SuppHeatedCatalystMon", @sysvarMember::ECM_OBD2_CAN::SupportedMonitors.HeatedCatalyst);
  
  resp.SetParameter("SuppTestStatus.ACSystemRefrigMonStat", @sysvarMember::ECM_OBD2_CAN::IncompleteMonitors.A_C_SystemRefrigerant); 
  resp.SetParameter("SuppTestStatus.CatalystMonStat", @sysvarMember::ECM_OBD2_CAN::IncompleteMonitors.Catalyst); 
  resp.SetParameter("SuppTestStatus.EgrSystemMonStat", @sysvarMember::ECM_OBD2_CAN::IncompleteMonitors.EgrSystem); 
  resp.SetParameter("SuppTestStatus.EvaporativeSystemMonStat", @sysvarMember::ECM_OBD2_CAN::IncompleteMonitors.EvaporativeSystem); 
  resp.SetParameter("SuppTestStatus.HeatedCatalystMonStat", @sysvarMember::ECM_OBD2_CAN::IncompleteMonitors.HeatedCatalyst); 
  resp.SetParameter("SuppTestStatus.OxygenSensorMonStatus", @sysvarMember::ECM_OBD2_CAN::IncompleteMonitors.OxygenSensor); 
  resp.SetParameter("SuppTestStatus.OxySensHeaterMonStat", @sysvarMember::ECM_OBD2_CAN::IncompleteMonitors.OxygenSensorHeater); 
  resp.SetParameter("SuppTestStatus.SecondaryAirSystemMonStat", @sysvarMember::ECM_OBD2_CAN::IncompleteMonitors.SecondaryAir); 

  resp.SendResponse();
}  

on diagRequest %BASE_FILE_NAME_NO_EXT%._PID_0C_Engine_RPM_REQUEST_CURR_PWRTRAIN_DATA
{
  diagResponse this resp;
  
  refreshS3Timer();
  resp.SetParameter(cParamAccessPhysical, "EngineRpm", @Vehicle::RPM); 
  resp.SendResponse();  
}

on diagRequest %BASE_FILE_NAME_NO_EXT%._PID_0D_Vehicle_Speed_Sensor_REQUEST_CURR_PWRTRAIN_DATA
{
  diagResponse this resp;
  
  refreshS3Timer();
  resp.SetParameter(cParamAccessPhysical, "VehicleSpeedSensor", @Vehicle::VehicleSpeedSensor); 
  resp.SendResponse();  
}


on diagRequest %BASE_FILE_NAME_NO_EXT%._PID_1C_OBD_requirements_for_vehicle_or_engine_REQUEST_CURR_PWRTRAIN_DATA
{
  diagResponse this resp;
  
  refreshS3Timer();
  resp.SetParameter("OBD_Requirements", @Vehicle::OBD_Requirements); 
  resp.SendResponse();
}  

on diagRequest %BASE_FILE_NAME_NO_EXT%._PID_21_Travel_Distance_While_MIL_Activated_REQUEST_CURR_PWRTRAIN_DATA
{
  diagResponse this resp;
  
  refreshS3Timer();
  resp.SetParameter("MIL_Distance", @sysvar::Vehicle::DistanceTravelledWhileMILActivated); 
  resp.SendResponse();
}  

on diagRequest %BASE_FILE_NAME_NO_EXT%._PID_31_Distance_since_DTCs_cleared_REQUEST_CURR_PWRTRAIN_DATA
{
  diagResponse this resp;
  
  refreshS3Timer();
  resp.SetParameter("Distance_since_clear_DTC", @sysvar::Vehicle::DistanceTravelledSinceDTCsCleared); 
  resp.SendResponse();
}  

on diagRequest %BASE_FILE_NAME_NO_EXT%._PID_41_Enable_status_of_supported_monitors_this_monitoring_cycl_REQUEST_CURR_PWRTRAIN_DATA
{
  diagResponse this resp;
  byte bSuppContTests, bSuppTestRunMinOnce, bSuppTestStatus;
  
  refreshS3Timer();
  
  bSuppContTests=@ECM_OBD2_CAN::SupportedMonitors.Misfire |
  ((@ECM_OBD2_CAN::SupportedMonitors.FuelSystem) << 1) |
  ((@ECM_OBD2_CAN::SupportedMonitors.ComprehensiveComponent) << 2) |
  ((@ECM_OBD2_CAN::IncompleteMonitors.Misfire) << 4) |
  ((@ECM_OBD2_CAN::IncompleteMonitors.FuelSystem) << 5) |
  ((@ECM_OBD2_CAN::IncompleteMonitors.ComprehensiveComponent) << 6);
  
  bSuppTestRunMinOnce=@ECM_OBD2_CAN::SupportedMonitors.Catalyst  |
  ((@ECM_OBD2_CAN::SupportedMonitors.HeatedCatalyst) << 1) |
  ((@ECM_OBD2_CAN::SupportedMonitors.EvaporativeSystem) << 2) |
  ((@ECM_OBD2_CAN::SupportedMonitors.SecondaryAir) << 3) |
  ((@ECM_OBD2_CAN::SupportedMonitors.A_C_SystemRefrigerant) << 4) |
  ((@ECM_OBD2_CAN::SupportedMonitors.OxygenSensor) << 5) |
  ((@ECM_OBD2_CAN::SupportedMonitors.OxygenSensorHeater) << 6) |
  ((@ECM_OBD2_CAN::SupportedMonitors.EgrSystem) << 7);

  bSuppTestStatus=@ECM_OBD2_CAN::IncompleteMonitors.Catalyst  |
  ((@ECM_OBD2_CAN::IncompleteMonitors.HeatedCatalyst) << 1) |
  ((@ECM_OBD2_CAN::IncompleteMonitors.EvaporativeSystem) << 2) |
  ((@ECM_OBD2_CAN::IncompleteMonitors.SecondaryAir) << 3) |
  ((@ECM_OBD2_CAN::IncompleteMonitors.A_C_SystemRefrigerant) << 4) |
  ((@ECM_OBD2_CAN::IncompleteMonitors.OxygenSensor) << 5) |
  ((@ECM_OBD2_CAN::IncompleteMonitors.OxygenSensorHeater) << 6) |
  ((@ECM_OBD2_CAN::IncompleteMonitors.EgrSystem) << 7);
  
  resp.SetParameter("SuppContTests", bSuppContTests); 
  resp.SetParameter("SuppTestRunMinOnce", bSuppTestRunMinOnce); 
  resp.SetParameter("SuppTestStatus", bSuppTestStatus); 
  resp.SendResponse();
}  

on diagRequest %BASE_FILE_NAME_NO_EXT%._PID_4D_Engine_run_time_while_MIL_activated_REQUEST_CURR_PWRTRAIN_DATA
{
  diagResponse this resp;
  
  refreshS3Timer();
  resp.SetParameter("MIL_Time", @Vehicle::EngineRuntimeWhileMILActivated); 
  resp.SendResponse();
}  

on diagRequest %BASE_FILE_NAME_NO_EXT%._PID_4E_Engine_run_time_since_DTCs_cleared_REQUEST_CURR_PWRTRAIN_DATA
{
  diagResponse this resp;
  
  refreshS3Timer();
  resp.SetParameter("Clear_Time", @Vehicle::EngineRuntimeSinceDTCsCleared); 
  resp.SendResponse();
}  

on diagRequest %BASE_FILE_NAME_NO_EXT%._PID_51_Type_of_fuel_currently_being_utilized_by_the_internal_co_REQUEST_CURR_PWRTRAIN_DATA
{
  diagResponse this resp;
  
  refreshS3Timer();
  resp.SetParameter("Type_of_fuel_currently_being_utilized_by_the_vehicle", @Vehicle::Fuel_Type); 
  resp.SendResponse();
}  


on diagRequest %BASE_FILE_NAME_NO_EXT%._PID_A4_Transmission_Actual_Gear_REQUEST_CURR_PWRTRAIN_DATA
{
  diagResponse this resp;
  
  refreshS3Timer();
  resp.SetParameter("Transmission_Actual_Gear_Status_Supported.Transmission_Actual_Gear_Status_Supported", 1); 
  resp.SetParameter("Transmission_Actual_Gear_Status_Supported.Transmission_Actual_Gear_Ratio_Supported", 0); 
  resp.SetParameter("Transmission_Actual_Gear_Status.Transmission_Actual_Gear_Status", @sysvar::Vehicle::Gear); 
  resp.SendResponse();  
}

//*********************************
// Mode 0x06 (OBDMIDs)
//*********************************

on diagRequest %BASE_FILE_NAME_NO_EXT%._OBDMID_00_OBD_MIDs_01_20_supported_Request_OnBoard_Monitoring_Test_Results_Read_Supported
{
  diagResponse this resp;
  
  refreshS3Timer();
  determineSupportedIdsAndSendResponse(resp, 0, "Support_OBD_MIDs", cSupportedOBDMIDs);
}

on diagRequest %BASE_FILE_NAME_NO_EXT%._OBDMID_20_OBD_MIDs_21_40_supported_Request_OnBoard_Monitoring_Test_Results_Read_Supported
{
  diagResponse this resp;
  
  refreshS3Timer();
  determineSupportedIdsAndSendResponse(resp, 4, "Support_OBD_MIDs", cSupportedOBDMIDs);
}

on diagRequest %BASE_FILE_NAME_NO_EXT%._OBDMID_40_OBD_MIDs_41_60_supported_Request_OnBoard_Monitoring_Test_Results_Read_Supported
{
  diagResponse this resp;
  
  refreshS3Timer();
  determineSupportedIdsAndSendResponse(resp, 8, "Support_OBD_MIDs", cSupportedOBDMIDs);
}

on diagRequest %BASE_FILE_NAME_NO_EXT%._OBDMID_60_OBD_MIDs_61_80_supported_Request_OnBoard_Monitoring_Test_Results_Read_Supported
{
  diagResponse this resp;
  
  refreshS3Timer();
  determineSupportedIdsAndSendResponse(resp, 12, "Support_OBD_MIDs", cSupportedOBDMIDs);
}

on diagRequest %BASE_FILE_NAME_NO_EXT%._OBDMID_80_OBD_MIDs_81_A0_supported_Request_OnBoard_Monitoring_Test_Results_Read_Supported
{
  diagResponse this resp;
  
  refreshS3Timer();
  determineSupportedIdsAndSendResponse(resp, 16, "Support_OBD_MIDs", cSupportedOBDMIDs);
}

on diagRequest %BASE_FILE_NAME_NO_EXT%._OBDMID_A0_OBD_MIDs_A1_C0_supported_Request_OnBoard_Monitoring_Test_Results_Read_Supported
{
  diagResponse this resp;
  
  refreshS3Timer();
  determineSupportedIdsAndSendResponse(resp, 20, "Support_OBD_MIDs", cSupportedOBDMIDs);
}

on diagRequest %BASE_FILE_NAME_NO_EXT%._OBDMID_C0_OBD_MIDs_C1_E0_supported_Request_OnBoard_Monitoring_Test_Results_Read_Supported
{
  diagResponse this resp;
  
  refreshS3Timer();
  determineSupportedIdsAndSendResponse(resp, 24, "Support_OBD_MIDs", cSupportedOBDMIDs);
}

on diagRequest %BASE_FILE_NAME_NO_EXT%._OBDMID_E0_OBD_MIDs_E1_FF_supported_Request_OnBoard_Monitoring_Test_Results_Read_Supported
{
  diagResponse this resp;
  
  refreshS3Timer();
  determineSupportedIdsAndSendResponse(resp, 28, "Support_OBD_MIDs", cSupportedOBDMIDs);
}

on diagRequest %BASE_FILE_NAME_NO_EXT%._OBDMID_08_Exhaust_Gas_Sensor_Monitor_Bank_2_Sensor_4_Request_OnBoard_Monitoring_Test_Results
{
  diagResponse this resp;
  
  refreshS3Timer();
  if (strncmp("%BASE_FILE_NAME_NO_EXT%", "ECM_OBD2_CAN", 13) == 0) {
    resp.SetComplexParameter("OBDMIDIteration", 0, "OBDMID", 0x08);
    resp.SetComplexParameter("OBDMIDIteration", 0, "Standard_Manufacturer_Defined_TID", 0x8E);
    resp.SetComplexParameter("OBDMIDIteration", 0, "Unit_And_Scaling_ID", 0x10);
    resp.SetComplexParameter("OBDMIDIteration", 0, "TestValueMultiplexer", 0x0000);
    resp.SetComplexParameter("OBDMIDIteration", 0, "Min_Test_Limit", 0x0000);
    resp.SetComplexParameter("OBDMIDIteration", 0, "Max_Test_Limit", 0x0320);
    resp.SetComplexParameter("OBDMIDIteration", 1, "OBDMID", 0x08);
    resp.SetComplexParameter("OBDMIDIteration", 1, "Standard_Manufacturer_Defined_TID", 0x8B);
    resp.SetComplexParameter("OBDMIDIteration", 1, "Unit_And_Scaling_ID", 0x85);
    resp.SetComplexParameter("OBDMIDIteration", 1, "TestValueMultiplexer", 0x0012);
    resp.SetComplexParameter("OBDMIDIteration", 1, "Min_Test_Limit", 0xF5BF);
    resp.SetComplexParameter("OBDMIDIteration", 1, "Max_Test_Limit", 0x7FFF);
    resp.SetComplexParameter("OBDMIDIteration", 2, "OBDMID", 0x08);
    resp.SetComplexParameter("OBDMIDIteration", 2, "Standard_Manufacturer_Defined_TID", 0x8A);
    resp.SetComplexParameter("OBDMIDIteration", 2, "Unit_And_Scaling_ID", 0x85);
    resp.SetComplexParameter("OBDMIDIteration", 2, "TestValueMultiplexer", 0x0012);
    resp.SetComplexParameter("OBDMIDIteration", 2, "Min_Test_Limit", 0x8000);
    resp.SetComplexParameter("OBDMIDIteration", 2, "Max_Test_Limit", 0x0A3F);
    resp.SetComplexParameter("OBDMIDIteration", 3, "OBDMID", 0x08);
    resp.SetComplexParameter("OBDMIDIteration", 3, "Standard_Manufacturer_Defined_TID", 0x85);
    resp.SetComplexParameter("OBDMIDIteration", 3, "Unit_And_Scaling_ID", 0x33);
    resp.SetComplexParameter("OBDMIDIteration", 3, "TestValueMultiplexer", 0x103E);
    resp.SetComplexParameter("OBDMIDIteration", 3, "Min_Test_Limit", 0x0000);
    resp.SetComplexParameter("OBDMIDIteration", 3, "Max_Test_Limit", 0x3800);
    resp.SetComplexParameter("OBDMIDIteration", 4, "OBDMID", 0x08);
    resp.SetComplexParameter("OBDMIDIteration", 4, "Standard_Manufacturer_Defined_TID", 0x81);
    resp.SetComplexParameter("OBDMIDIteration", 4, "Unit_And_Scaling_ID", 0x10);
    resp.SetComplexParameter("OBDMIDIteration", 4, "TestValueMultiplexer", 0x0000);
    resp.SetComplexParameter("OBDMIDIteration", 4, "Min_Test_Limit", 0x0000);
    resp.SetComplexParameter("OBDMIDIteration", 4, "Max_Test_Limit", 0x0190);
  
    resp.SendResponse();  
  }
}

//*********************************
// Mode 0x08 (TIDs)
//*********************************

on diagRequest %BASE_FILE_NAME_NO_EXT%._TID_00_TID_supported_01_20_READ_SUPP_TIDS
{
  diagResponse this resp;
  
  refreshS3Timer();
  determineSupportedIdsAndSendResponse(resp, 0, "Supported_OBD_TID", cSupportedOBDMIDs);
}

on diagRequest %BASE_FILE_NAME_NO_EXT%._TID_20_TID_supported_21_40_READ_SUPP_TIDS
{
  diagResponse this resp;
  
  refreshS3Timer();
  determineSupportedIdsAndSendResponse(resp, 4, "Supported_OBD_TID", cSupportedOBDMIDs);
}

on diagRequest %BASE_FILE_NAME_NO_EXT%._TID_40_TID_supported_41_60_READ_SUPP_TIDS
{
  diagResponse this resp;
  
  refreshS3Timer();
  determineSupportedIdsAndSendResponse(resp, 8, "Supported_OBD_TID", cSupportedOBDMIDs);
}

on diagRequest %BASE_FILE_NAME_NO_EXT%._TID_60_TID_supported_61_80_READ_SUPP_TIDS
{
  diagResponse this resp;
  
  refreshS3Timer();
  determineSupportedIdsAndSendResponse(resp, 12, "Supported_OBD_TID", cSupportedOBDMIDs);
}

on diagRequest %BASE_FILE_NAME_NO_EXT%._TID_80_TID_supported_81_A0_READ_SUPP_TIDS
{
  diagResponse this resp;
  
  refreshS3Timer();
  determineSupportedIdsAndSendResponse(resp, 16, "Supported_OBD_TID", cSupportedOBDMIDs);
}

on diagRequest %BASE_FILE_NAME_NO_EXT%._TID_A0_TID_supported_A1_C0_READ_SUPP_TIDS
{
  diagResponse this resp;
  
  refreshS3Timer();
  determineSupportedIdsAndSendResponse(resp, 20, "Supported_OBD_TID", cSupportedOBDMIDs);
}

on diagRequest %BASE_FILE_NAME_NO_EXT%._TID_C0_TID_supported_C1_E0_READ_SUPP_TIDS
{
  diagResponse this resp;
  
  refreshS3Timer();
  determineSupportedIdsAndSendResponse(resp, 24, "Supported_OBD_TID", cSupportedOBDMIDs);
}

on diagRequest %BASE_FILE_NAME_NO_EXT%._TID_E0_TID_supported_E1_FF_READ_SUPP_TIDS
{
  diagResponse this resp;
  
  refreshS3Timer();
  determineSupportedIdsAndSendResponse(resp, 28, "Supported_OBD_TID", cSupportedOBDMIDs);
}

on diagRequest %BASE_FILE_NAME_NO_EXT%._TID_01_Evaporative_system_leak_test_CONTROL_TID
{
  diagResponse this resp;
  
  refreshS3Timer();
  resp.SendResponse();
}

//*********************************
// Mode 0x09 (INFOTYPES)
//*********************************

on diagRequest %BASE_FILE_NAME_NO_EXT%._InfoType_00_InfoType_supported_01_20_REQUEST_VEHICLE_INFO
{
  diagResponse this resp;
  
  refreshS3Timer();
  determineSupportedIdsAndSendResponse(resp, 0, "Supported_InfoTypes", cSupportedINFOTYPEs);
}

on diagRequest %BASE_FILE_NAME_NO_EXT%._InfoType_20_InfoType_supported_21_40_REQUEST_VEHICLE_INFO
{
  diagResponse this resp;
  
  refreshS3Timer();
  determineSupportedIdsAndSendResponse(resp, 4, "Supported_InfoTypes", cSupportedINFOTYPEs);
}

on diagRequest %BASE_FILE_NAME_NO_EXT%._InfoType_40_InfoType_supported_41_60_REQUEST_VEHICLE_INFO
{
  diagResponse this resp;
  
  refreshS3Timer();
  determineSupportedIdsAndSendResponse(resp, 8, "Supported_InfoTypes", cSupportedINFOTYPEs);
}

on diagRequest %BASE_FILE_NAME_NO_EXT%._InfoType_60_InfoType_supported_61_80_REQUEST_VEHICLE_INFO
{
  diagResponse this resp;
  
  refreshS3Timer();
  determineSupportedIdsAndSendResponse(resp, 12, "Supported_InfoTypes", cSupportedINFOTYPEs);
}

on diagRequest %BASE_FILE_NAME_NO_EXT%._InfoType_80_InfoType_supported_81_A0_REQUEST_VEHICLE_INFO
{
  diagResponse this resp;
  
  refreshS3Timer();
  determineSupportedIdsAndSendResponse(resp, 16, "Supported_InfoTypes", cSupportedINFOTYPEs);
}

on diagRequest %BASE_FILE_NAME_NO_EXT%._InfoType_A0_InfoType_supported_A1_C0_REQUEST_VEHICLE_INFO
{
  diagResponse this resp;
  
  refreshS3Timer();
  determineSupportedIdsAndSendResponse(resp, 20, "Supported_InfoTypes", cSupportedINFOTYPEs);
}

on diagRequest %BASE_FILE_NAME_NO_EXT%._InfoType_C0_InfoType_supported_C1_E0_REQUEST_VEHICLE_INFO
{
  diagResponse this resp;
  
  refreshS3Timer();
  determineSupportedIdsAndSendResponse(resp, 24, "Supported_InfoTypes", cSupportedINFOTYPEs);
}

on diagRequest %BASE_FILE_NAME_NO_EXT%._InfoType_E0_InfoType_supported_E1_FF_REQUEST_VEHICLE_INFO
{
  diagResponse this resp;
  
  refreshS3Timer();
  determineSupportedIdsAndSendResponse(resp, 28, "Supported_InfoTypes", cSupportedINFOTYPEs);
}

on diagRequest %BASE_FILE_NAME_NO_EXT%.InfoTyp_10_Protocol_Identification_Read_InfoType_Data
{
  diagResponse this resp;

  refreshS3Timer();
  resp.SetComplexParameter("List_of_InfoType_Data", 0, "Protocol_Identification", 1);
  resp.SendResponse();
}

on diagRequest %BASE_FILE_NAME_NO_EXT%._InfoType_02_Vehicle_Identification_Number_Read_InfoType_Data
{
  diagResponse this resp;
  char VIN_String[18];
  byte VIN[17];
  
  refreshS3Timer();
  sysGetVariableString(sysvar::Vehicle::VIN, VIN_String, elcount(VIN_String));
  memcpy(VIN,VIN_String, elcount(VIN));
  resp.SetComplexParameterRaw("List_of_InfoType_Data", 0, "Data.Vehicle_Identification_Number", VIN, elcount(VIN));

  if (strncmp("%BASE_FILE_NAME_NO_EXT%", "ECM_OBD2_CAN", 8)) {
    resp.SendResponse();
  }
}

on diagRequest %BASE_FILE_NAME_NO_EXT%._InfoType_08_In_use_Performance_Tracking
{
  diagResponse this resp;
  
  refreshS3Timer();
  if (!strncmp("%BASE_FILE_NAME_NO_EXT%", "ECM_OBD2_CAN", 8)) {

    resp.SetParameter("Number_of_Data_Items", 28);
    resp.SetParameter("OBD_Monitoring_Conditions_Encountered_Counts", @sysvarMember::%BASE_FILE_NAME_NO_EXT%::OBD.OBD_MonitoringConditionsEncounteredCounts);
    resp.SetParameter("Ignition_Cycle_Counter", @sysvarMember::%BASE_FILE_NAME_NO_EXT%::OBD.IgnitionCycleCounter);
    resp.SetParameter("Catalyst_Monitor_Completion_Counts_Bank_1", @sysvarMember::%BASE_FILE_NAME_NO_EXT%::OBD.CatalystMonitorCompletionCountsBank1);
    resp.SetParameter("Catalyst_Monitor_Conditions_Encountered_Counts_Bank_1", @sysvarMember::%BASE_FILE_NAME_NO_EXT%::OBD.CatalystMonitorConditionsEncounteredCountsBank1);
    resp.SetParameter("O2_Sensor_Monitor_Completion_Counts_Bank_1", @sysvarMember::%BASE_FILE_NAME_NO_EXT%::OBD.O2SensorMonitorCompletionCountsBank1);
    resp.SetParameter("O2_Sensor_Monitor_Conditions_Encountered_Counts_Bank_1", @sysvarMember::%BASE_FILE_NAME_NO_EXT%::OBD.O2SensorMonitorConditionsEncounteredCountsBank1);
    resp.SetParameter("EGR_and_or_VVT_Monitor_Completion_Condition_Counts", @sysvarMember::%BASE_FILE_NAME_NO_EXT%::OBD.EGR_AndOrVVT_MonitorCompletionCounts);
    resp.SetParameter("EGR_and_or_VVT_Monitor_Conditions_Encountered_Counts", @sysvarMember::%BASE_FILE_NAME_NO_EXT%::OBD.EGR_AndOrVVT_MonitorConditionsEncounteredCounts);
    resp.SetParameter("Secondary_O2_Sensor_Monitor_Completion_Counts_Bank_1", @sysvarMember::%BASE_FILE_NAME_NO_EXT%::OBD.SecondaryO2SensorMonitorCompletionCountsBank1);
    resp.SetParameter("Secondary_O2_Sensor_Monitor_Conditions_Encountered_Counts_Bank_1", @sysvarMember::%BASE_FILE_NAME_NO_EXT%::OBD.SecondaryO2SensorMonitorConditionsEncounteredCountsBank1);
    resp.SetParameter("Particulate_Filter_Monitor_Completion_Counts_Bank_1", @sysvarMember::%BASE_FILE_NAME_NO_EXT%::OBD.ParticulateFilterMonitorCompletionCountsBank1);
    resp.SetParameter("Particulate_Filter_Monitor_Conditions_Encountered_Counts_Bank_1", @sysvarMember::%BASE_FILE_NAME_NO_EXT%::OBD.ParticulateFilterMonitorConditionsEncounteredCountsBank1);
  
    resp.SendResponse();  
  }
}

on diagRequest %BASE_FILE_NAME_NO_EXT%._InfoType_0A_ECU_Module_Acronym_and_Text_Name_Read_InfoType_Data
{
  diagResponse this resp;
  long ret;
  
  refreshS3Timer();
  resp.SetParameter("Number_of_Data_Items", 1);
  resp.SetComplexParameterRaw("List_of_InfoType_Data", 0, "Data.ECU_Module_Acronym", ecuAcronym, elcount(ecuAcronym));
  resp.SendResponse();
}

on diagRequest %BASE_FILE_NAME_NO_EXT%._InfoType_0B_In_use_Performance_Tracking
{
  diagResponse this resp;
  
  refreshS3Timer();

  if (!strncmp("%BASE_FILE_NAME_NO_EXT%", "ECM_OBD2_CAN", 8)) {
    resp.SetParameter("OBD_Monitoring_Conditions_Encountered_Counts", 1);
    resp.SetParameter("Ignition_Cycle_Counter", 2);
    resp.SetParameter("NMHC_Catalyst_Monitor_Completion_Condition_Counts", 3);
    resp.SetParameter("NMHC_Catalyst_Monitor_Conditions_Encountered_Counts", 4);
    resp.SetParameter("NOx_Catalyst_Monitor_Completion_Condition_Counts", 5);
    resp.SetParameter("NOx_Catalyst_Monitor_Conditions_Encountered_Counts", 6);
    resp.SetParameter("NOx_Adsorber_Monitor_Completion_Condition_Counts", 7);
    resp.SetParameter("NOx_Adsorber_Monitor_Conditions_Encountered_Counts", 8);
    resp.SetParameter("PM_Filter_Monitor_Completion_Condition_Counts", 9);
    resp.SetParameter("PM_Filter_Monitor_Conditions_Encountered_Counts", 10);
    resp.SetParameter("Exhaust_Gas_Sensor_Monitor_Completion_Condition_Counts", 11);
    resp.SetParameter("Exhaust_Gas_Sensor_Monitor_Conditions_Encountered_Counts", 12);
    resp.SetParameter("EGR_and_or_VVT_Monitor_Completion_Condition_Counts", 13);
    resp.SetParameter("EGR_and_or_VVT_Monitor_Conditions_Encountered_Counts", 14);
    resp.SetParameter("Boost_Pressure_Monitor_Completion_Conditions_Counts", 15);
    resp.SetParameter("Boost_Pressure_Monitor_Conditions_Encountered_Counts", 16);
    if (@sysvar::Vehicle::FuelSystemMonitoringSupported) {
      resp.SetParameter("Number_of_Data_Items", 18);
      resp.SetParameter("Fuel_Monitor_Completion_Conditions_Counts", 17);
      resp.SetParameter("Fuel_Monitor_Conditions_Encountered_Counts", 18);
    }
    else {
      //resp.resize(35);
    }

    resp.SendResponse();  
  }
}