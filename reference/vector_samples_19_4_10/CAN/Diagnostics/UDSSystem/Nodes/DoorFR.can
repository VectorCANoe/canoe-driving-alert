/*@!Encoding:1252*/
includes
{
  #include "..\CAPL_Includes\CommonDiagImplementation.cin"
}

variables
{
  char gECU[20]="DoorFR";
}

void InitECU()
{
  InitFaultmem(SupportedDTC);  
  InitDDDIDs();
  InitVariantCoding();

  SetLedColor();

  @sysvarMember::%BASE_FILE_NAME_NO_EXT%::RewritableData.SerialNumber=@sysvar::%BASE_FILE_NAME_NO_EXT%::DefaultSerialNumber;

  gS3ServerTimeout=diagGetCommParameter("CANoe.S3ServerTime");
  gP2ClientTimeout=150;
  gP2extClientTimeout=2000;

  // Switch off sending of periodic Data Identifiers
  gSineSendMode=Off;
  gSawtoothSendMode=Off;
  gDDDIDSendMode=Off;

  setTimerCyclic(tUpdateInternalValues, 100);  // Update internal values every 100 ms

  // Set timers for periodic Data Identifiers
  setTimerCyclic(tDIDSendSlow, 5000);  
  setTimerCyclic(tDIDSendMedium, 1000);
  setTimerCyclic(tDIDSendFast, 100);  
  
  ResetSession();
  @sysvar::%BASE_FILE_NAME_NO_EXT%::TesterPresent=0;
  @sysvar::%BASE_FILE_NAME_NO_EXT%::AuthenticationStatus=0;
}

on diagRequest %BASE_FILE_NAME_NO_EXT%.KeyLevel_0x01_Send
{
  diagResponse this resp;
  long securityKey, receivedKey;
  byte seedArray[2];
  byte keyArray[2];
  dword keyArraySize;
  
  refreshS3Timer();
  if (ExtendedSession==@sysvarMember::%BASE_FILE_NAME_NO_EXT%::Session.CurrentSession || ProgrammingSession==@sysvarMember::%BASE_FILE_NAME_NO_EXT%::Session.CurrentSession) {
    seedArray[0]=(gLastSecuritySeedLevel1>>8)&0xFF;
    seedArray[1]=gLastSecuritySeedLevel1&0xFF;
    diagGenerateKeyFromSeed("%BASE_FILE_NAME_NO_EXT%", seedArray, 2, 1, "Common", "AB", keyArray, 2, keyArraySize); // Use 2-byte random value as seed with option string 'AB'
    securityKey=keyArray[0];
    securityKey=(securityKey<<8) + keyArray[1];
    receivedKey=diagGetParameter(this, "SecurityKey");
    if (securityKey==receivedKey) {
      @sysvarMember::%BASE_FILE_NAME_NO_EXT%::Session.SecurityStatus=Unlocked;
      @sysvarMember::%BASE_FILE_NAME_NO_EXT%::Session.SecurityLevel=Unlocked_Level_1;
      refreshSessionTimerAndSendPositiveResponse(resp);
      return;
    }
  }
  ResetSessionAndSendNegativeResponse( this, cNRC_InvalidKey); 
}

on diagRequest %BASE_FILE_NAME_NO_EXT%.KeyLevel_0x11_Send
{
  diagResponse this resp;
  dword securityKey, receivedKey;
  byte seedArray[4];
  byte keyArray[4];
  dword keyArraySize;
  word k;
  
  refreshS3Timer();
  if (ExtendedSession==@sysvarMember::%BASE_FILE_NAME_NO_EXT%::Session.CurrentSession || ProgrammingSession==@sysvarMember::%BASE_FILE_NAME_NO_EXT%::Session.CurrentSession) {
    
    for (k=0; k<4; k++) {
      seedArray[k]=(gLastSecuritySeedLevel17>>(8*(3-k)))&0xFF;
    }
    diagGenerateKeyFromSeed("%BASE_FILE_NAME_NO_EXT%", seedArray, 4, 17, "Common", "CDEF", keyArray, 4, keyArraySize); // Use 4-byte random value as seed with option string 'CDEF'
    securityKey=0;
    for (k=0; k<4; k++) {
      securityKey=(securityKey<<8) + keyArray[k];
    }
    receivedKey=diagGetParameter(this, "SecurityKey");
    if (securityKey==receivedKey) {
      @sysvarMember::%BASE_FILE_NAME_NO_EXT%::Session.SecurityStatus=Unlocked;
      @sysvarMember::%BASE_FILE_NAME_NO_EXT%::Session.SecurityLevel=Unlocked_Level_17;
      refreshSessionTimerAndSendPositiveResponse(resp);
      return;
    }
  }
  ResetSessionAndSendNegativeResponse( this, cNRC_InvalidKey); 
}

on diagRequest %BASE_FILE_NAME_NO_EXT%.Mirror_Settings_Write
{
  diagResponse this resp;
  byte buffer[30];
  
  refreshS3Timer(); 
  if (!VarcodeWriteAccessGranted(this)) return;

  @sysvarMember::%BASE_FILE_NAME_NO_EXT%::RewritableData.MirrorSettings.Availability=((byte)(diagGetParameter(this, "Folding_mirror")))<<1;
  @sysvarMember::%BASE_FILE_NAME_NO_EXT%::RewritableData.MirrorSettings.Availability|=(byte)(diagGetParameter(this, "Heating"));
  @sysvarMember::%BASE_FILE_NAME_NO_EXT%::RewritableData.MirrorSettings.MaximumHeatingPower=diagGetParameter(this, "Maximum_heating_power");
  diagGetParameterRaw(this, "Motor_calibration", buffer, elcount(buffer));
  sysSetVariableData(sysvarMember::%BASE_FILE_NAME_NO_EXT%::RewritableData.MirrorSettings.MotorCalibration, buffer, elCount(buffer));
  
  refreshSessionTimerAndSendPositiveResponse(resp);
}

on diagRequest %BASE_FILE_NAME_NO_EXT%.Window_Lift_Settings_Write
{
  diagResponse this resp;
  byte buffer[30];
  
  refreshS3Timer(); 
  if (!VarcodeWriteAccessGranted(this)) return;

  @sysvarMember::%BASE_FILE_NAME_NO_EXT%::RewritableData.WindowLiftSettings.Availability=diagGetParameter(this, "Child_protection");
  @sysvarMember::%BASE_FILE_NAME_NO_EXT%::RewritableData.WindowLiftSettings.AnitPinchMaxForce=diagGetParameter(this, "Anti_pinch_max_force");
  @sysvarMember::%BASE_FILE_NAME_NO_EXT%::RewritableData.WindowLiftSettings.AntiPinchReversingGap=diagGetParameter(this, "Anti_pinch_reversing_gap");
  diagGetParameterRaw(this, "Motor_calibration", buffer, elcount(buffer));
  sysSetVariableData(sysvarMember::%BASE_FILE_NAME_NO_EXT%::RewritableData.WindowLiftSettings.MotorCalibration, buffer, elCount(buffer));
  
  refreshSessionTimerAndSendPositiveResponse(resp);
}