/*@!Encoding:1252*/
// ===================================================================================
// Common application implementation on diagnostic layer for all simulation nodes
// ===================================================================================

includes
{
  #include "..\CAPL_Includes\DiagDefinitions.cin"
  #include "..\CAPL_Includes\LibFunctions_Write.cin"
  #include "..\CAPL_Includes\LibFunctions_Node.cin"
  #include "..\CAPL_Includes\FaultMemoryUDS_Sim.cin"
  #include "..\CAPL_Includes\Download_Sim.cin"
  #include "..\CAPL_Includes\SessionHandler_Sim.cin"
}

variables
{
  long gCANFDavailable = 0;        // set to 1 if the bus supports CAN FD
  const cHardResetDuration_ms=1500;
  
  char cSessionTypeParameterName[20] = "DiagSessionType";

  enum eSecurityStatus {Locked=0, Unlocked=1};
  enum eSecurityLevel {Locked_Level_1=0, Unlocked_Level_1=1, Locked_Level_17=2, Unlocked_Level_17=3};
  word gLastSecuritySeedLevel1;
  dword gLastSecuritySeedLevel17;
  
  word gVariantSpecificData;
  
  enum eVoltageRange {VoltageTooLow, VoltageNormal, VoltageTooHigh} gVoltageRange;
  msTimer tVoltageTooHigh;
  msTimer tVoltageTooLow;
  
  msTimer tUpdateInternalValues;

  msTimer tDIDSendFast;
  msTimer tDIDSendMedium;
  msTimer tDIDSendSlow;
  msTimer tDelayedResponse;

  enum eDIDSendMode gSineSendMode;
  enum eDIDSendMode gSawtoothSendMode;
  enum eDIDSendMode gDDDIDSendMode;

  word gNumberOfDDDIDs;
  word previousNumberOfDDDIDs;
  long gSizeOfDDDID;
  long previousSizeOfDDDID;
  const cMaxNumberOfDDDIDs = 6;
  word gDDDID[cMaxNumberOfDDDIDs];

  const cMaxNumberOfSupportedDIDs=cMaxNumberOfDDDIDs;
  struct sDIDInfo {
    word DID;
    word sizeInBytes;
  };
  struct sDIDInfo gSupportedDIDs[cMaxNumberOfSupportedDIDs] = {
    {0x0001, 4},  // Sine Wave
    {0x0002, 2},  // Sawtooth
    {0x0107, 2},  // Voltage
    {0x0108, 4},  // Odometer Value
    {0x0201, 1},  // Window Rough Position
    {0x0202, 8}   // Window Fine Position
  };
  
  double gTargetWindowLiftPosition;
  const cWindowPositionDeltaPerUpdateInterval=1.6;

  // Following DTCs stored only in primary fault memory
  const cDtcVoltageTooLow=0x000016;
  const cDtcVoltageTooHigh=0x000017;
  const cDtcFailureInDoorContactFrontLeft  = 0x80012F;
  const cDtcFailureInDoorContactFrontRight = 0x80022F;
  const cDtcFailureInDoorContactRearLeft   = 0x80032F;
  const cDtcFailureInDoorContactRearRight  = 0x80042F;
  // Following DTCs stored only in user-defined fault memory
  const cDtcUsingNullCipher                = 0x9001F0; 
  const cDtcTestWatchdogTriggered          = 0x9002F0;
  
  const cNumberOfSupportedDTCs=8;
  struct sSupportedDTCs SupportedDTC[cNumberOfSupportedDTCs] = {
                                                // Primary fault memory
                                                {cDtcVoltageTooLow,                  fmtPrimary},
                                                {cDtcVoltageTooHigh,                 fmtPrimary},
                                                {cDtcFailureInDoorContactFrontLeft,  fmtPrimary}, 
                                                {cDtcFailureInDoorContactFrontRight, fmtPrimary},
                                                {cDtcFailureInDoorContactRearLeft,   fmtPrimary},
                                                {cDtcFailureInDoorContactRearRight,  fmtPrimary},
                                                // User-defined fault memory
                                                {cDtcUsingNullCipher,                fmtUserDefined},
                                                {cDtcTestWatchdogTriggered,          fmtUserDefined}
                                               };
  
  const cIsTester=0;
}

on start
{
  long value;

  setWriteDbgLevel(0);
  
  value = diagGetCommParameter( "CANoe.BusContext");
  writeDbgLevel(1, "(CanTP) %BASE_FILE_NAME_NO_EXT%: Setting bus context %x", value);
  SetBusContext( value);
  {
    // check if CAN FD is available at all
    CANSettings arbitration;
    CANSettings data;
    canFdGetConfiguration( (WORD) value, arbitration, data);
    gCANFDavailable = (arbitration.flags & 0x100 ? 1 : 0);
    if( gCANFDavailable)
      writeDbgLevel(1, "(CanTP) %BASE_FILE_NAME_NO_EXT%: CAN FD is available");
  }
  
  InitECU();
}

on timer tVoltageTooLow
{
  AddFault(cDtcVoltageTooLow, cStatusBit_TestFailed | cStatusBit_ConfirmedDTC, cSeverityBit_Class1 | cSeverityBit_CheckAtNextHalt );
}

on timer tVoltageTooHigh
{
  AddFault(cDtcVoltageTooHigh, cStatusBit_TestFailed | cStatusBit_ConfirmedDTC, cSeverityBit_Class1 | cSeverityBit_CheckAtNextHalt );
}

on timer tUpdateInternalValues
{
  double currentPos;
  
  // Update waveform values (for demo purposes)
  @sysvarMember::%BASE_FILE_NAME_NO_EXT%::InternalData.SineWave=sin(timeNowFloat()/1000000);
  @sysvarMember::%BASE_FILE_NAME_NO_EXT%::InternalData.Sawtooth=((double)((timeNow()%2000000)))/2000000;
  
  // Move the window from the current towards the target position
  currentPos=@sysvarMember::%BASE_FILE_NAME_NO_EXT%::InternalData.WindowFinePosition;
  if (currentPos < gTargetWindowLiftPosition) {
    currentPos=((currentPos+cWindowPositionDeltaPerUpdateInterval)<gTargetWindowLiftPosition)? currentPos+cWindowPositionDeltaPerUpdateInterval : gTargetWindowLiftPosition;
  }
  if (currentPos > gTargetWindowLiftPosition) {
    currentPos=((currentPos-cWindowPositionDeltaPerUpdateInterval)>gTargetWindowLiftPosition)? currentPos-cWindowPositionDeltaPerUpdateInterval : gTargetWindowLiftPosition;
  }
  @sysvarMember::%BASE_FILE_NAME_NO_EXT%::InternalData.WindowFinePosition=currentPos;
  @sysvarMember::%BASE_FILE_NAME_NO_EXT%::InternalData.WindowRoughPosition=(dword)((@sysvarMember::%BASE_FILE_NAME_NO_EXT%::InternalData.WindowFinePosition)/100*16);
}

on timer tDIDSendFast
{
  sendPeriodicDIDs(Fast);
}

on timer tDIDSendMedium
{
  sendPeriodicDIDs(Medium);
}

on timer tDIDSendSlow
{
  sendPeriodicDIDs(Slow);
}

sendPeriodicDIDs(enum eDIDSendMode sendMode)
{
  diagResponse %BASE_FILE_NAME_NO_EXT%.SineWave_Send_fast respSine;
  diagResponse %BASE_FILE_NAME_NO_EXT%.Sawtooth_Send_fast respSawtooth;
  diagResponse %BASE_FILE_NAME_NO_EXT%.Dynamically_Define_Periodic_Data_Send_fast respDDDID;
  byte buffer[100];
  dword bufLenUsed;  
  
  if (gSineSendMode==sendMode) {
    diagSetParameter(respSine, cParamAccessPhysical, "SineValue", @sysvarMember::%BASE_FILE_NAME_NO_EXT%::InternalData.SineWave);
    SendUUDT(respSine);
  }
  if (gSawtoothSendMode==sendMode) {
    diagSetParameter(respSawtooth, cParamAccessPhysical, "SawtoothValue", @sysvarMember::%BASE_FILE_NAME_NO_EXT%::InternalData.Sawtooth);
    SendUUDT(respSawtooth);
  }
  if (gDDDIDSendMode==sendMode) {
    diagResize(respDDDID, 100);
    buffer[0]=0xF0;
    bufLenUsed=PrepareDIDParameters(buffer, 1, gDDDID, gNumberOfDDDIDs, FALSE);
    diagResize(respDDDID, bufLenUsed);
    diagSetPrimitiveData(respDDDID, buffer, bufLenUsed);       
    sendUUDT(respDDDID);
  }
}

// Prepare response payload for Dynamic Data Identifiers
dword PrepareDIDParameters(byte buffer[], word offset, word DID[], word noOfDIDs, enum bool addDIDsToBuffer)
{
  word k;
  struct sWrapLong {
    dword lw;
  } longWrapper;  
  struct sWrapWord {
    word w;
  } wordWrapper;
  struct sWrapDword {
    dword dw;
  } dwordWrapper;
  struct sQword {
    qword value;
  } rawQWord;

  for (k=0; k<noOfDIDs; k++) {
    if (addDIDsToBuffer) {
      wordWrapper.w=DID[k];
      memcpy_h2n(buffer, (long)offset, wordWrapper);
      offset+=2; 
    }
    switch (DID[k]) {
      case 0x01: // SineWave (raw: long, i.e. 4 byte signed, Motorola format, encoding float/double)
        longWrapper.lw=(long)(@sysvarMember::%BASE_FILE_NAME_NO_EXT%::InternalData.SineWave * 2147483647.0);  // Datatype in diagnostic description is normalized!
        memcpy_h2n(buffer, (long)offset, longWrapper); // Motorola format ==> h2n
        offset+=4; 
        break;
      case 0x02: // Sawtooth (raw: word, i.e. 2 byte unsigned, Intel format, encoding float/single)
        wordWrapper.w=(word)(@sysvarMember::%BASE_FILE_NAME_NO_EXT%::InternalData.Sawtooth * 65535.0);        // Datatype in diagnostic description is normalized!
        memcpy(buffer, (long)offset, wordWrapper); // Intel format
        offset+=2; 
        break;
      case 0x107: // Voltage (2 x 1 byte unsigned, encoding float/double)
        buffer[offset++]=(byte)((@sysvar::ExternalSignals::SupplyVoltage)*10.0);
        buffer[offset++]=(byte)(InternalVoltage(@sysvar::ExternalSignals::SupplyVoltage)*10.0);
        break;
      case 0x108: // OdometerValue (4 byte unsigned, encoding unsigned)
        dwordWrapper.dw=swapDWord(@sysvar::ExternalSignals::OdometerValue);
        memcpy(buffer, (long)offset, dwordWrapper);
        offset+=4; 
        break;
      case 0x201: // WindowLiftRoughPosition (1 byte texttable, encoding unsigned)
        buffer[offset++]=@sysvarMember::%BASE_FILE_NAME_NO_EXT%::InternalData.WindowRoughPosition;
        break;
      case 0x202: // WindowLiftFinePosition (Basic Diagnostics 64bit double, Intel format)
        rawQWord.value=interpretAsQword(@sysvarMember::%BASE_FILE_NAME_NO_EXT%::InternalData.WindowFinePosition);
        memcpy(buffer, (long)offset, rawQWord);
        offset+=8; // 64bit ==> 8 byte
        break;
      default:
        writeDbgLvlPrefix( 0,"Error: Unknown Data Identifier 0x%04X!", DID[k]);
        break;
    }
  }
  return(offset);
}

On timer tDelayedResponse
{
  diagResponse %BASE_FILE_NAME_NO_EXT%.Hard_Reset_Reset resp;

  diagSendPositiveResponse(resp);
}

on sysvar sysvarMember::%BASE_FILE_NAME_NO_EXT%::FaultMemoryGui.BtnStoreDTC
{
  byte status, severity;
  
  if (@this) { // only when button was pressed (not when released)
    status =   (@sysvarMember::%BASE_FILE_NAME_NO_EXT%::FaultMemoryGui.StatusByte[7] << 7)
             | (@sysvarMember::%BASE_FILE_NAME_NO_EXT%::FaultMemoryGui.StatusByte[6] << 6)
             | (@sysvarMember::%BASE_FILE_NAME_NO_EXT%::FaultMemoryGui.StatusByte[5] << 5)
             | (@sysvarMember::%BASE_FILE_NAME_NO_EXT%::FaultMemoryGui.StatusByte[4] << 4)
             | (@sysvarMember::%BASE_FILE_NAME_NO_EXT%::FaultMemoryGui.StatusByte[3] << 3)
             | (@sysvarMember::%BASE_FILE_NAME_NO_EXT%::FaultMemoryGui.StatusByte[2] << 2)
             | (@sysvarMember::%BASE_FILE_NAME_NO_EXT%::FaultMemoryGui.StatusByte[1] << 1)
             |  @sysvarMember::%BASE_FILE_NAME_NO_EXT%::FaultMemoryGui.StatusByte[0];
    
    severity = (@sysvarMember::%BASE_FILE_NAME_NO_EXT%::FaultMemoryGui.SeverityByte[7] << 7)
             | (@sysvarMember::%BASE_FILE_NAME_NO_EXT%::FaultMemoryGui.SeverityByte[6] << 6)
             | (@sysvarMember::%BASE_FILE_NAME_NO_EXT%::FaultMemoryGui.SeverityByte[5] << 5)
             | (@sysvarMember::%BASE_FILE_NAME_NO_EXT%::FaultMemoryGui.SeverityByte[4] << 4)
             | (@sysvarMember::%BASE_FILE_NAME_NO_EXT%::FaultMemoryGui.SeverityByte[3] << 3)
             | (@sysvarMember::%BASE_FILE_NAME_NO_EXT%::FaultMemoryGui.SeverityByte[2] << 2)
             | (@sysvarMember::%BASE_FILE_NAME_NO_EXT%::FaultMemoryGui.SeverityByte[1] << 1)
             |  @sysvarMember::%BASE_FILE_NAME_NO_EXT%::FaultMemoryGui.SeverityByte[0];

    AddFault(@sysvarMember::%BASE_FILE_NAME_NO_EXT%::FaultMemoryGui.DTC_ToStore, status, severity);
  }
}

on sysvar sysvarMember::%BASE_FILE_NAME_NO_EXT%::FaultMemoryInternal.FaultMemoryActivated
{
  setControlVisibility("%BASE_FILE_NAME_NO_EXT%_FaultMemory", "DtcStorageWarningText", @this?0:1);
}

on sysvar sysvar::ExternalSignals::SupplyVoltage
{
  @sysvarMember::%BASE_FILE_NAME_NO_EXT%::InternalData.Current=@sysvar::ExternalSignals::SupplyVoltage / 10;
  if (@this < 10) {
    gVoltageRange=VoltageTooLow;
    @sysvar::%BASE_FILE_NAME_NO_EXT%::VoltageOutOfRange=1;
    setTimer(tVoltageTooLow, 1000);    // store fault if error condition present for 1000 ms
  }
  else {
    if (@this > 14) {
      gVoltageRange=VoltageTooHigh;
      @sysvar::%BASE_FILE_NAME_NO_EXT%::VoltageOutOfRange=1;
      setTimer(tVoltageTooHigh, 1000); // store fault if error condition present for 1000 ms
    }
    else {
      gVoltageRange=VoltageNormal;
      @sysvar::%BASE_FILE_NAME_NO_EXT%::VoltageOutOfRange=0;
      cancelTimer(tVoltageTooLow);
      cancelTimer(tVoltageTooHigh);
    }
  }
}

on sysvar sysvarMember::%BASE_FILE_NAME_NO_EXT%::Download.InProgress
{
  if (@this) {
    cancelTimer(tS3ServerTimer);
  }
  else {
    setTimer(tS3ServerTimer, gS3ServerTimeout);
  }
}

on sysvar sysvar::%BASE_FILE_NAME_NO_EXT%::RewritableData.VariantCoding.WindowLiftSupport
{
  SetControlVisibility("%BASE_FILE_NAME_NO_EXT%_Application", "WindowPositionDisplay", @this);
  SetControlVisibility("%BASE_FILE_NAME_NO_EXT%_Application", "WindowsFinePositionValue", @this);
  SetControlVisibility("%BASE_FILE_NAME_NO_EXT%_Application", "WindowsFinePositionUnit", @this);
}

void S3ServerReset()
{
  ResetCyclicDIDUpdates();  
  ResetSession();  
}

void ResetLock()
{
  @sysvarMember::%BASE_FILE_NAME_NO_EXT%::Session.SecurityStatus = Locked;  
  @sysvarMember::%BASE_FILE_NAME_NO_EXT%::Session.SecurityLevel = Locked_Level_1;
}

void ResetSession()
{
  @sysvarMember::%BASE_FILE_NAME_NO_EXT%::Session.CurrentSession = DefaultSession;
  @sysvar::%BASE_FILE_NAME_NO_EXT%::AuthenticationStatus = 0;

  ResetLock();
  ResetDownload();
}

void SetLedColor(void)
{
  @sysvarMember::%BASE_FILE_NAME_NO_EXT%::InternalData.LED_Color=makeARGB(@sysvarMember::%BASE_FILE_NAME_NO_EXT%::RewritableData.UserInterfaceSettings.LED_Brightness,
                                      @sysvarMember::%BASE_FILE_NAME_NO_EXT%::RewritableData.UserInterfaceSettings.LED_Color_Red,
                                      @sysvarMember::%BASE_FILE_NAME_NO_EXT%::RewritableData.UserInterfaceSettings.LED_Color_Green,
                                      @sysvarMember::%BASE_FILE_NAME_NO_EXT%::RewritableData.UserInterfaceSettings.LED_Color_Blue);
}

InitVariantCoding()
{
  @sysvarMember::%BASE_FILE_NAME_NO_EXT%::RewritableData.VariantCoding.VehicleType=1; // Coupe
  @sysvarMember::%BASE_FILE_NAME_NO_EXT%::RewritableData.VariantCoding.CountryCode=1; // Europe
  @sysvarMember::%BASE_FILE_NAME_NO_EXT%::RewritableData.VariantCoding.WindowLiftSupport=1; // on
  @sysvarMember::%BASE_FILE_NAME_NO_EXT%::RewritableData.VariantCoding.VehicleSpeedToLockDoor=20;
}

void ResetSessionAndSendNegativeResponse(diagResponse * resp, dword nrc)
{
  ResetSession();
  sendNegativeResponse( resp, nrc); 
}

void ResetSessionAndSendNegativeResponse(diagRequest * req, dword nrc)
{
  ResetSession();
  sendNegativeResponse( req, nrc); 
}

void ResetCyclicDIDUpdates()
{
  gSineSendMode=Off;
  gSawtoothSendMode=Off; 
  gDDDIDSendMode=Off;

  @sysvar::Tester::BtnInternalsCyclicRead=0;
}

void ResetDownload()
{
  @sysvarMember::%BASE_FILE_NAME_NO_EXT%::Download.BlockSequenceCounter=0;
  @sysvarMember::%BASE_FILE_NAME_NO_EXT%::Download.InProgress=0;
}

InitDDDIDs()
{
  word k;
  
  for (k=0; k<cMaxNumberOfDDDIDs; k++) {
    gDDDID[k]=0;
  }
  gNumberOfDDDIDs=0;
  gSizeOfDDDID=0;
}

double InternalVoltage(double SupplyVoltage)
{
  return (SupplyVoltage>5.0)?5.0:SupplyVoltage;
}

void SetWindowLiftPosition(double posInPercent)
{
  gTargetWindowLiftPosition=posInPercent;
}

SendUUDT( diagResponse * resp)
{
  BYTE data[64]; // limited to 64Byte to simplify this example
  message * sUUDT;
  long i;

  i = diagGetPrimitiveData( resp, data, elcount(data));
  if( i < 0)
    return;

  if (!gCANFDavailable) {
    if (i>8) {
      writeDbgLevel(0, "%BASE_FILE_NAME_NO_EXT%: Data too long to send as UUDT via CAN (max. 8 Byte)!");
      return;
    }
  }
  else {
    if (i>64) {
      writeDbgLvlPrefix(0, "Data too long to send as UUDT via CAN FD (max. 64 Byte supported)!");
      return;
    }
  }

  sUUDT.id = diagGetCommParameter( "CANoe.UudtId");
  if (i<=8) {  // Standard CAN
     sUUDT.dlc = i;
  }
  else {       // CAN FD
    sUUDT.FDF=1;
    if (i<=12) {
      sUUDT.dlc = 0x9;
    }
    else if (i<=16){
      sUUDT.dlc = 0xA;
    }
    else if (i<=20){
      sUUDT.dlc = 0xB;
    }
    else if (i<=24){
      sUUDT.dlc = 0xC;
    }
    else if (i<=32){
      sUUDT.dlc = 0xD;
    }
    else if (i<=48){
      sUUDT.dlc = 0xE;
    }
    else if (i<=64){
      sUUDT.dlc = 0xF;
    }
    else return;
  }

  while( i-- > 0)
    sUUDT.byte(i) = data[i];

  output( sUUDT);
}

enum bool PreventAccessInsideDefaultSession(diagRequest * req, byte nrc)
{
  if(DefaultSession==@sysvarMember::%BASE_FILE_NAME_NO_EXT%::Session.CurrentSession)
  {
    // The ECU is in default session, so send negative response.
    ResetSessionAndSendNegativeResponse( req, nrc);
    return TRUE;
  }
  
  return FALSE;
}

enum bool ReadAccessGranted(diagRequest * req)
{
  if(DefaultSession==@sysvarMember::%BASE_FILE_NAME_NO_EXT%::Session.CurrentSession || 0==@sysvar::%BASE_FILE_NAME_NO_EXT%::AuthenticationStatus)
  {
    // The ECU is in default session or tester is not authenticated, so deny access.
    ResetSessionAndSendNegativeResponse( req, cNRC_SecurityAccessDenied);
    return FALSE;
  }
  
  return TRUE;
}

enum bool VarcodeWriteAccessGranted(diagRequest * req)
{
  if(DefaultSession==@sysvarMember::%BASE_FILE_NAME_NO_EXT%::Session.CurrentSession || 0==@sysvar::%BASE_FILE_NAME_NO_EXT%::AuthenticationStatus)
  {
    // The ECU is in default session or tester not authenticated, so deny access.
    ResetSessionAndSendNegativeResponse( req, cNRC_SecurityAccessDenied);
    return FALSE;
  }
  
  return TRUE;
}

enum bool PrivilegedWriteAccessGranted(diagRequest * req)
{
  if( @sysvarMember::%BASE_FILE_NAME_NO_EXT%::Session.CurrentSession < ProgrammingSession || @sysvar::%BASE_FILE_NAME_NO_EXT%::Session.SecurityStatus!=Unlocked || 0==@sysvar::%BASE_FILE_NAME_NO_EXT%::AuthenticationStatus)
  {
    // The ECU was not unlocked or not in Programming session, or tester is not authenticated, so deny access.
    ResetSessionAndSendNegativeResponse( req, cNRC_ConditionsNotCorrectOrRequestSequenceError);
    return FALSE;
  }
  
  return TRUE;
}

int sizeOfDID(word DID)
{
  word DIDIndex;

  for (DIDIndex=0; DIDIndex<cMaxNumberOfSupportedDIDs; DIDIndex++) {
    if (DID==gSupportedDIDs[DIDIndex].DID) {
      return(gSupportedDIDs[DIDIndex].sizeInBytes);
    }
  }
  return(-1); // DID not supported
}

HandleCombinedDIDs(diagRequest * req, diagResponse * resp)
{
  word numberOfDIDsInPDU;
  word k;
  word DID[cMaxNumberOfSupportedDIDs];
  byte buffer[200];
  dword count;

  numberOfDIDsInPDU=(req.GetPrimitiveSize()-1)/2;
  req.GetPrimitiveData(buffer, elcount(buffer));
  for (k=0; k<numberOfDIDsInPDU; k++) {
    DID[k]=((word)buffer[1+(k*2)])*256 + ((word)buffer[2+(k*2)]);
    if (sizeOfDID(DID[k])<0) { // DID not supported
      ResetSessionAndSendNegativeResponse(req, cNRC_RequestOutOfRange); // DID not supported for combined DIDs
      return;
    }
  }
  buffer[0]=0x62;
  count=PrepareDIDParameters(buffer, 1, DID, numberOfDIDsInPDU, TRUE);
  resp.Resize(count);
  resp.SetPrimitiveData(buffer, count);
  
  refreshS3Timer();
  resp.sendResponse();
}

// If no combined DID and not handled explicitly, send negative response with negative response code (NRC) "Service not supported"
on diagRequest %BASE_FILE_NAME_NO_EXT%.*
{
  diagResponse this resp;
  
  if (this.GetPrimitiveByte(0)==0x22 && this.GetPrimitiveSize() > 3) { // Read Data By Identifier with more than one DID
    HandleCombinedDIDs(this, resp);
  }
  else {
    ResetSessionAndSendNegativeResponse( this, cNRC_ServiceNotSupported); 
  }
}

// If Tester present is received, reply with positive response
on diagRequest %BASE_FILE_NAME_NO_EXT%.TesterPresent_Send
{
  diagResponse this resp;
  
  refreshS3Timer();
  
  if (0==diagGetSuppressResp(this)) {
    diagSendPositiveResponse(resp);
  }
  else {
    @Tester::ResponseSuppressed=1;
    SetTimer(tResetResponseSuppressedLED, cDurationIndicationLED_ms);
    writeDbgLvlPrefix( 3, "Suppressed TesterPresent response!");
  }
}

on diagRequest %BASE_FILE_NAME_NO_EXT%.Authentication_Authentication_Configuration
{
  diagResponse this resp;

  refreshS3Timer();
  
  refreshSessionTimerAndSendPositiveResponse(resp);
}

on diagRequest %BASE_FILE_NAME_NO_EXT%.Authentication_Verify_Certificate_Unidirectional
{
  diagResponse this resp;
  byte challengeServer[18]={0x00, 0x10, 0xAD, 0x95, 0x37, 0xF6, 0xC8, 0x04, 0x56, 0x99, 0xCE, 0x04, 0x19, 0x88, 0x68, 0x83, 0xB3, 0xA1};

  refreshS3Timer();
  // send positive response without verifying trust chain for this example
  diagSetParameter(resp, "Authentication_Return_Parameter", 0x11); // Certificate verified, ownership verification necessary
  diagSetParameterRaw(resp, "Challenge_Server", challengeServer, elcount(challengeServer));

  refreshSessionTimerAndSendPositiveResponse(resp);
}

on diagRequest %BASE_FILE_NAME_NO_EXT%.Authentication_Proof_Of_Ownership
{
  diagResponse this resp;

  refreshS3Timer();

  // Check of authentication data omitted here
  @sysvar::%BASE_FILE_NAME_NO_EXT%::AuthenticationStatus=1;  // Tester is now authenticated at this ECU

  // send positive response without verifying proof of ownership for this example
  diagSetParameter(resp, "Authentication_Return_Parameter", 0x12); // Ownership verified, Authentication complete

  refreshSessionTimerAndSendPositiveResponse(resp);
}

on diagRequest %BASE_FILE_NAME_NO_EXT%.Authentication_Deauthentication
{
  diagResponse this resp;

  refreshS3Timer();
  
  @sysvar::%BASE_FILE_NAME_NO_EXT%::AuthenticationStatus=0;  // Tester is no longer authenticated
  
  diagSetParameter(resp, "AuthenticationReturnParameter", 0x10); // DeAuthentication successful

  refreshSessionTimerAndSendPositiveResponse(resp);
}

on diagRequest %BASE_FILE_NAME_NO_EXT%.SeedLevel_0x01_Request
{
  diagResponse this resp;

  refreshS3Timer();
  if (ExtendedSession==@sysvarMember::%BASE_FILE_NAME_NO_EXT%::Session.CurrentSession || ProgrammingSession==@sysvarMember::%BASE_FILE_NAME_NO_EXT%::Session.CurrentSession) {
    gLastSecuritySeedLevel1=random(0x10000);
    diagSetParameter(resp, "SecuritySeed", gLastSecuritySeedLevel1); // Use 2-byte random value as seed
    refreshSessionTimerAndSendPositiveResponse(resp);
  }
  else {
    ResetSessionAndSendNegativeResponse( this, cNRC_ConditionsNotCorrectOrRequestSequenceError); 
  }
}

on diagRequest %BASE_FILE_NAME_NO_EXT%.SeedLevel_0x11_Request
{
  diagResponse this resp;

  refreshS3Timer();
  if (ExtendedSession==@sysvarMember::%BASE_FILE_NAME_NO_EXT%::Session.CurrentSession || ProgrammingSession==@sysvarMember::%BASE_FILE_NAME_NO_EXT%::Session.CurrentSession) {
    gLastSecuritySeedLevel17=random(0xFFFFFFFFLL);
    diagSetParameter(resp, "SecuritySeed", gLastSecuritySeedLevel17); // Use 4-byte random value as seed
    @sysvarMember::%BASE_FILE_NAME_NO_EXT%::Session.SecurityLevel=Locked_Level_17;
    refreshSessionTimerAndSendPositiveResponse(resp);
  }
  else {
    ResetSessionAndSendNegativeResponse( this, cNRC_ConditionsNotCorrectOrRequestSequenceError); 
  }
}

on diagRequest %BASE_FILE_NAME_NO_EXT%.DevelopmentData_Read
{
  diagResponse this resp;

  refreshS3Timer();
  // Set the parameters in the response.
  diagSetParameter( resp, "OperatingSystemVersion", 1);
  diagSetParameter( resp, "CanDriverVersion", 5);
  diagSetParameter( resp, "NmVersion", 2);
  diagSetParameter( resp, "DiagnosticModuleVersion", 1);
  diagSetParameter( resp, "TransportLayerVersion", 4);

  diagSendResponse( resp);
}

// Example how to set a raw parameter value
on diagRequest %BASE_FILE_NAME_NO_EXT%.SerialNumber_Read
{
  diagResponse this resp;
  byte rawSerialNumber[4];
  
  refreshS3Timer();
  // Since the serial number here is only 4 bytes long, this could simply be done via 
  // diagSetParameter(resp, "SerialNumber", @%BASE_FILE_NAME_NO_EXT%::RewritableData.SerialNumber);
  // But we want to demonstrate the setting of raw values:
  rawSerialNumber[0]=@%BASE_FILE_NAME_NO_EXT%::RewritableData.SerialNumber>>24;
  rawSerialNumber[1]=(@%BASE_FILE_NAME_NO_EXT%::RewritableData.SerialNumber>>16) & 0xFF;
  rawSerialNumber[2]=(@%BASE_FILE_NAME_NO_EXT%::RewritableData.SerialNumber>>8) & 0xFF;
  rawSerialNumber[3]=@%BASE_FILE_NAME_NO_EXT%::RewritableData.SerialNumber & 0xFF;
  diagSetParameterRaw(resp, "SerialNumber", rawSerialNumber, elcount(rawSerialNumber));
  diagSendPositiveResponse(resp);
}

on diagRequest %BASE_FILE_NAME_NO_EXT%.SerialNumber_Write
{
  diagResponse this resp;
  dword newSerialNumber;

  refreshS3Timer();
  if (!PrivilegedWriteAccessGranted(this)) return;
  
  @sysvarMember::%BASE_FILE_NAME_NO_EXT%::RewritableData.SerialNumber=diagGetParameter(this, "SerialNumber");

  refreshSessionTimerAndSendPositiveResponse(resp);
}

on diagRequest %BASE_FILE_NAME_NO_EXT%.Variant_Coding_Read
{
  diagResponse this resp;

  refreshS3Timer();
  if (!ReadAccessGranted(this)) return;

  // Set the parameters in the response.
  diagSetParameter( resp, "Codingstring.CountryType", @sysvarMember::%BASE_FILE_NAME_NO_EXT%::RewritableData.VariantCoding.CountryCode);
  diagSetParameter( resp, "Codingstring.VehicleType", @sysvarMember::%BASE_FILE_NAME_NO_EXT%::RewritableData.VariantCoding.VehicleType);
  diagSetParameter( resp, "Codingstring.WindowLift_Support", @sysvarMember::%BASE_FILE_NAME_NO_EXT%::RewritableData.VariantCoding.WindowLiftSupport);
  diagSetParameter( resp, cParamAccessPhysical, "VehicleSpeedToLockDoor", @sysvarMember::%BASE_FILE_NAME_NO_EXT%::RewritableData.VariantCoding.VehicleSpeedToLockDoor);
  
  refreshSessionTimerAndSendPositiveResponse(resp);
}

on diagRequest %BASE_FILE_NAME_NO_EXT%.Variant_Coding_Write
{
  diagResponse this resp;
  long CountryCode;
  long VehicleType;
  long WindowLiftSupport;
  long VehicleSpeedToLockDoor;

  refreshS3Timer();
  if (!VarcodeWriteAccessGranted(this)) return;

  // Retrieve the parameters from the request.
  CountryCode = diagGetParameter( this, "Codingstring.CountryType");
  VehicleType = diagGetParameter( this, "Codingstring.VehicleType");
  WindowLiftSupport = diagGetParameter( this, "Codingstring.WindowLift_Support");
  VehicleSpeedToLockDoor = diagGetParameter( this, cParamAccessPhysical, "VehicleSpeedToLockDoor");

  if(CountryCode>3 || CountryCode<0 || VehicleType>3 || VehicleType<0 ||
     WindowLiftSupport>1 || WindowLiftSupport<0 || VehicleSpeedToLockDoor>50 || VehicleSpeedToLockDoor<0)
  {
    // The ECU was not unlocked, so deny access.
    ResetSessionAndSendNegativeResponse( this, cNRC_RequestOutOfRange);
    return;
  }
  @sysvarMember::%BASE_FILE_NAME_NO_EXT%::RewritableData.VariantCoding.CountryCode = CountryCode;
  @sysvarMember::%BASE_FILE_NAME_NO_EXT%::RewritableData.VariantCoding.VehicleType = VehicleType;
  @sysvarMember::%BASE_FILE_NAME_NO_EXT%::RewritableData.VariantCoding.WindowLiftSupport = WindowLiftSupport;
  @sysvarMember::%BASE_FILE_NAME_NO_EXT%::RewritableData.VariantCoding.VehicleSpeedToLockDoor = VehicleSpeedToLockDoor;

  refreshSessionTimerAndSendPositiveResponse(resp);
}

on diagRequest %BASE_FILE_NAME_NO_EXT%.Mirror_Settings_Read
{
  diagResponse this resp;
  byte buffer[30];
  long copiedBytes;
  
  refreshS3Timer();
  if (!ReadAccessGranted(this)) return;

  diagSetParameter(resp, "Availability", @sysvarMember::%BASE_FILE_NAME_NO_EXT%::RewritableData.MirrorSettings.Availability);
  diagSetParameter(resp, "Maximum_heating_power", @sysvarMember::%BASE_FILE_NAME_NO_EXT%::RewritableData.MirrorSettings.MaximumHeatingPower);
  sysGetVariableData(sysvarMember::%BASE_FILE_NAME_NO_EXT%::RewritableData.MirrorSettings.MotorCalibration, buffer, copiedBytes);
  diagSetParameterRaw(resp, "Motor_calibration", buffer, elcount(buffer));
  
  refreshSessionTimerAndSendPositiveResponse(resp);
}

on diagRequest %BASE_FILE_NAME_NO_EXT%.User_Interface_Settings_Read
{
  diagResponse this resp;
  
  refreshS3Timer();
  if (!ReadAccessGranted(this)) return;

  diagSetParameter(resp, "LED_colour_Red", @sysvarMember::%BASE_FILE_NAME_NO_EXT%::RewritableData.UserInterfaceSettings.LED_Color_Red);
  diagSetParameter(resp, "LED_colour_Green", @sysvarMember::%BASE_FILE_NAME_NO_EXT%::RewritableData.UserInterfaceSettings.LED_Color_Green);
  diagSetParameter(resp, "LED_colour_Blue", @sysvarMember::%BASE_FILE_NAME_NO_EXT%::RewritableData.UserInterfaceSettings.LED_Color_Blue);
  diagSetParameter(resp, "LED_Brightness", @sysvarMember::%BASE_FILE_NAME_NO_EXT%::RewritableData.UserInterfaceSettings.LED_Brightness);
  
  refreshSessionTimerAndSendPositiveResponse(resp);
}

on diagRequest %BASE_FILE_NAME_NO_EXT%.User_Interface_Settings_Write
{
  diagResponse this resp;
  
  refreshS3Timer(); 
  if (!VarcodeWriteAccessGranted(this)) return;

  @sysvarMember::%BASE_FILE_NAME_NO_EXT%::RewritableData.UserInterfaceSettings.LED_Color_Red=diagGetParameter(this, "LED_colour_Red");
  @sysvarMember::%BASE_FILE_NAME_NO_EXT%::RewritableData.UserInterfaceSettings.LED_Color_Green=diagGetParameter(this, "LED_colour_Green");
  @sysvarMember::%BASE_FILE_NAME_NO_EXT%::RewritableData.UserInterfaceSettings.LED_Color_Blue=diagGetParameter(this, "LED_colour_Blue");
  @sysvarMember::%BASE_FILE_NAME_NO_EXT%::RewritableData.UserInterfaceSettings.LED_Brightness=diagGetParameter(this, "LED_Brightness");
  SetLedColor();
  
  refreshSessionTimerAndSendPositiveResponse(resp);
}

on diagRequest %BASE_FILE_NAME_NO_EXT%.Window_Lift_Settings_Read
{
  diagResponse this resp;
  byte buffer[30];
  long copiedBytes;
  
  refreshS3Timer();
  if (!ReadAccessGranted(this)) return;

  diagSetParameter(resp, "Availability", @sysvarMember::%BASE_FILE_NAME_NO_EXT%::RewritableData.WindowLiftSettings.Availability);
  diagSetParameter(resp, "Anti_pinch_max_force", @sysvarMember::%BASE_FILE_NAME_NO_EXT%::RewritableData.WindowLiftSettings.AnitPinchMaxForce);
  diagSetParameter(resp, "Anti_pinch_reversing_gap", @sysvarMember::%BASE_FILE_NAME_NO_EXT%::RewritableData.WindowLiftSettings.AntiPinchReversingGap);
  sysGetVariableData(sysvarMember::%BASE_FILE_NAME_NO_EXT%::RewritableData.WindowLiftSettings.MotorCalibration, buffer, copiedBytes);
  diagSetParameterRaw(resp, "Motor_calibration", buffer, elcount(buffer));
  
  refreshSessionTimerAndSendPositiveResponse(resp);
}

on diagRequest %BASE_FILE_NAME_NO_EXT%.EcuIdentification_Read
{
  diagResponse this resp;
  char buffer[30];  

  refreshS3Timer();
  sysGetVariableString(sysvar::%BASE_FILE_NAME_NO_EXT%::ECUIdentification, buffer, elcount(buffer));
  diagSetParameter( resp, "Part_Number", buffer);
  diagSendPositiveResponse( resp);
}

on diagRequest %BASE_FILE_NAME_NO_EXT%.EcuIdentification_Write
{
  diagResponse this resp;
  char buffer[30];

  refreshS3Timer();
  
  if( @sysvarMember::%BASE_FILE_NAME_NO_EXT%::Session.CurrentSession < ProgrammingSession || @sysvarMember::%BASE_FILE_NAME_NO_EXT%::Session.SecurityStatus!=Unlocked)
  {
    ResetSessionAndSendNegativeResponse( this, cNRC_ConditionsNotCorrectOrRequestSequenceError); // Conditions not correct or request sequence error
    return;
  }
  
  diagGetParameter( this, "Part_Number", buffer, elcount(buffer));
  sysSetVariableString(sysvar::%BASE_FILE_NAME_NO_EXT%::ECUIdentification, buffer);

  refreshSessionTimerAndSendPositiveResponse(resp);
}

on diagRequest %BASE_FILE_NAME_NO_EXT%.DID_SineWave_Read
{
  diagResponse this resp;
  
  refreshS3Timer();
  
  diagSetParameter(resp, cParamAccessPhysical, "SineValue", @sysvarMember::%BASE_FILE_NAME_NO_EXT%::InternalData.SineWave);

  diagSendPositiveResponse(resp);
}

on diagRequest %BASE_FILE_NAME_NO_EXT%.DID_Sawtooth_Read
{
  diagResponse this resp;
  
  refreshS3Timer();
  
  diagSetParameter(resp, cParamAccessPhysical, "SawtoothValue", @sysvarMember::%BASE_FILE_NAME_NO_EXT%::InternalData.Sawtooth);

  diagSendPositiveResponse(resp);
}

// Example how to set the numerical and physical value of a parameter 
on diagRequest %BASE_FILE_NAME_NO_EXT%.DID_Voltage_Read
{
  diagResponse this resp;
  double physicalSupplyVoltage;
  double numericalSupplyVoltage;
  double physicalInternalVoltage;
  
  refreshS3Timer();
  
  physicalSupplyVoltage=@sysvar::ExternalSignals::SupplyVoltage;
  numericalSupplyVoltage=physicalSupplyVoltage*10;
  physicalInternalVoltage=InternalVoltage(physicalSupplyVoltage);
  diagSetParameter(resp, cParamAccessNumerical, "SupplyVoltage", numericalSupplyVoltage); // Set numerical value (e.g.: 142 * 1/10 Volt = 14.2 Volt)
  diagSetParameter(resp, cParamAccessPhysical, "InternalVoltage", physicalInternalVoltage);  

  diagSendPositiveResponse(resp);
}

// Example how to set the coded value of a parameter (numerical access would also be possible here)
on diagRequest %BASE_FILE_NAME_NO_EXT%.DID_OdometerValue_Read
{
  diagResponse this resp;
  
  refreshS3Timer();
  diagSetParameter(resp, cParamAccessCoded, "OdometerValue", @sysvar::ExternalSignals::OdometerValue);

  diagSendPositiveResponse(resp);
}

on diagRequest %BASE_FILE_NAME_NO_EXT%.DID_Fingerprint_Write
{
  diagResponse this resp;
  byte fingerprint[9];

  refreshS3Timer();  

  diagGetParameterRaw(this, "Fingerprint", fingerprint, elcount(fingerprint));

  // Ignore the fingerprint contents and always send a positive response (do not expect this from a real ECU!)
  @sysvarMember::%BASE_FILE_NAME_NO_EXT%::Session.SecurityStatus=Unlocked;
  @sysvarMember::%BASE_FILE_NAME_NO_EXT%::Session.SecurityLevel=Unlocked_Level_17;

  refreshSessionTimerAndSendPositiveResponse(resp);
}

on diagRequest %BASE_FILE_NAME_NO_EXT%.DID_WindowLiftRoughPosition_Read
{
  diagResponse this resp;

  if (@%BASE_FILE_NAME_NO_EXT%::RewritableData.VariantCoding.WindowLiftSupport) {
    refreshS3Timer();  

    diagSetParameter(resp, "WindowLiftRoughPosition", @sysvarMember::%BASE_FILE_NAME_NO_EXT%::InternalData.WindowRoughPosition);

    diagSendResponse(resp);
  }
  else {
    ResetSessionAndSendNegativeResponse( resp, cNRC_ConditionsNotCorrectOrRequestSequenceError);
  }
}

on diagRequest %BASE_FILE_NAME_NO_EXT%.DID_WindowLiftRoughPosition_Write
{
  diagResponse this resp;
  double targetPosition;

  if (@%BASE_FILE_NAME_NO_EXT%::RewritableData.VariantCoding.WindowLiftSupport) {
    refreshS3Timer();
    refreshSessionTimer();

    targetPosition=this.GetParameter("WindowLiftRoughPosition")*6.25;
    SetWindowLiftPosition(targetPosition);

    diagSendResponse(resp);
  }
  else {
    ResetSessionAndSendNegativeResponse( resp, cNRC_ConditionsNotCorrectOrRequestSequenceError);
  }
}

// Use diagnostic class to save some lines of code
on diagRequest %BASE_FILE_NAME_NO_EXT%.Periodic_Data::*
{
  diagResponse this resp;
  long DID;
  long TransmissionMode;
  long size;
  
  refreshS3Timer();

  size=diagGetPrimitiveSize(this);
  if (size<=1) {
    diagSendNegativeResponse(resp, cNRC_IncorrectMessageLengthOrInvalidFormat);
    return;
  }
  TransmissionMode=diagGetParameter(this, "TransmissionMode");
  if (size==2) { // Sawtooth_Stop_all or SineWave_Stop_all or Dynamically_Define_Periodic_Data_Stop, containing no DID information
    if (TransmissionMode==Off) {
      gSineSendMode=Off;
      gSawtoothSendMode=Off; 
      gDDDIDSendMode=Off;

      @sysvar::Tester::BtnInternalsCyclicRead=0;
      
      diagSendPositiveResponse(resp);
    }
    else {
      ResetSessionAndSendNegativeResponse( resp, cNRC_RequestOutOfRange);
    };
    return;
  }
  
  DID=diagGetParameter(this, "PeriodicDataIdentifier");
  writeDbgLvlPrefix( 3, "DID=%d", DID);
  
  switch (TransmissionMode) {
    case Once:
      switch (DID) {
        case 0x00: // SineWave
          diagSetParameter(resp, cParamAccessPhysical, "SineValue", @sysvarMember::%BASE_FILE_NAME_NO_EXT%::InternalData.SineWave);
          gSineSendMode=Off;
          @sysvar::Tester::BtnInternalsCyclicRead=0;
          break;
        case 0x01: // Sawtooth
          diagSetParameter(resp, cParamAccessPhysical, "SawtoothValue", @sysvarMember::%BASE_FILE_NAME_NO_EXT%::InternalData.Sawtooth);
          gSawtoothSendMode=Off;  
          @sysvar::Tester::BtnInternalsCyclicRead=0;
          break;
        default:
          ResetSessionAndSendNegativeResponse( resp, cNRC_RequestOutOfRange);
          return;
      }
      break;
      
    case Fast:
    case Medium:
    case Slow:
      switch (DID) {
        case 0x00: // SineWave
          gSineSendMode=(enum eDIDSendMode)TransmissionMode;
          break;
        case 0x01: // Sawtooth
          gSawtoothSendMode=(enum eDIDSendMode)TransmissionMode;
          break;
        default:
          ResetSessionAndSendNegativeResponse( resp, cNRC_RequestOutOfRange);
          return;
      }
      diagResize(resp,1);
      DiagSetPrimitiveByte(resp,0,0x6A);
      break;
    case Off:
      switch (DID) {
        case 0x00: // SineWave
          gSineSendMode=Off;
          @sysvar::Tester::BtnInternalsCyclicRead=0;
          break;
        case 0x01: // Sawtooth
          gSawtoothSendMode=Off;  
          @sysvar::Tester::BtnInternalsCyclicRead=0;
          break;
        default:
          ResetSessionAndSendNegativeResponse( resp, cNRC_RequestOutOfRange);
          return;
      }
      break;
    default:
      ResetSessionAndSendNegativeResponse( resp, cNRC_RequestOutOfRange);
      return;
  }
  diagSendPositiveResponse(resp);
}

on diagRequest %BASE_FILE_NAME_NO_EXT%.Dynamically_Define_Periodic_Data_Define_By_Identifier
{
  diagResponse this resp;
  long sizeOfPrimitive;
  word NumberOfDIDsInPDU;
  word maxDataLength;
  word k;
  word DID;
  word DIDPosition;
  word DIDSizeRequested;
  int DIDSize;

  save_DDDID_Definition();
  maxDataLength=gCANFDavailable?63:7;
  
  refreshS3Timer();

  sizeOfPrimitive=diagGetPrimitiveSize(this);
  if (((sizeOfPrimitive-4)%4)>0) {
    ResetSessionAndSendNegativeResponse( resp, cNRC_RequestOutOfRange);
    return;
  }
  else {
    NumberOfDIDsInPDU=(sizeOfPrimitive-4)/4;
    if (NumberOfDIDsInPDU+gNumberOfDDDIDs>cMaxNumberOfDDDIDs) {
      ResetSessionAndSendNegativeResponse( resp, cNRC_RequestOutOfRange);
      return;
    }
    else {
      for (k=0; k<NumberOfDIDsInPDU; k++) {
        DID=diagGetComplexParameter(this, "ListOfParameter", k, "SourceDID");
        DIDPosition=diagGetComplexParameter(this, "ListOfParameter", k, "PositionInSourceDID");
        DIDSizeRequested=diagGetComplexParameter(this, "ListOfParameter", k, "MemorySize");
        DIDSize=sizeOfDID(DID);
        if (1!=DIDPosition || DIDSize<0 || DIDSizeRequested!=DIDSize) {
          ResetSessionAndSendNegativeResponse( resp, cNRC_RequestOutOfRange);
          restore_DDDID_Definition();
          return;
        }
        else {
          if (gSizeOfDDDID+DIDSize>maxDataLength) { // Length of DDDID too long
            ResetSessionAndSendNegativeResponse( resp, cNRC_RequestOutOfRange); 
            restore_DDDID_Definition();
            return;
          }
          else {
            if (DID_AlreadyDynamicallyDefined(DID)) {
              ResetSessionAndSendNegativeResponse( resp, cNRC_RequestOutOfRange);
              restore_DDDID_Definition();
              return;
            }
            else {
              char tempStr[50];
              gDDDID[gNumberOfDDDIDs++]=DID;
              gSizeOfDDDID+=DIDSize;
              snprintf(tempStr, elcount(tempStr), "DIDSize=%d, gSizeOfDDDID=%d, maxDataLength=%d",DIDSize, gSizeOfDDDID, maxDataLength);
              writeDbgLvlPrefix( 3, tempStr);
            }
          }
        }
      }
      diagSendPositiveResponse(resp);
    }
  }
}

save_DDDID_Definition()
{
  previousSizeOfDDDID=gSizeOfDDDID;
  previousNumberOfDDDIDs=gNumberOfDDDIDs;
}

restore_DDDID_Definition()
{
  gSizeOfDDDID=previousSizeOfDDDID;
  gNumberOfDDDIDs=previousNumberOfDDDIDs;
}

word DID_AlreadyDynamicallyDefined(word DID)
{
  word k;
  
  for (k=0; k<gNumberOfDDDIDs; k++) {
    if (gDDDID[k]==DID) {
      return 1;
    }
  }
  return 0;
}

on diagRequest %BASE_FILE_NAME_NO_EXT%.Dynamically_Define_Periodic_Data_Read
{
  diagResponse this resp;
  byte buffer[100];
  dword count;  
  
  refreshS3Timer();

  if (0xF0 != diagGetParameter(this, "Identifier")) {
    ResetSessionAndSendNegativeResponse( resp, cNRC_RequestOutOfRange);
  }
  else {
    buffer[0]=0x62;
    buffer[1]=0xF2;
    buffer[2]=0xF0;
    count=PrepareDIDParameters(buffer, 3, gDDDID, gNumberOfDDDIDs, FALSE);
    diagResize(resp, count);
    diagSetPrimitiveData(resp, buffer, count);
    diagSendPositiveResponse(resp);
  }
}

on diagRequest %BASE_FILE_NAME_NO_EXT%.Dynamically_Define_Periodic_Data_Clear
{
  diagResponse this resp;
  
  refreshS3Timer();

  if (0xF0 != diagGetParameter(this, "DynamicallyDefinedIdentifier")) {
    ResetSessionAndSendNegativeResponse( resp, cNRC_RequestOutOfRange);
  }
  else {
    gDDDIDSendMode=Off;
    InitDDDIDs();
    diagSendPositiveResponse(resp);
  }
}

on diagRequest %BASE_FILE_NAME_NO_EXT%.Dynamically_Define_Periodic_Data_ClearAll
{
  diagResponse this resp;
  
  refreshS3Timer();

  gDDDIDSendMode=Off;
  InitDDDIDs();
  diagSendPositiveResponse(resp);
}

on diagRequest %BASE_FILE_NAME_NO_EXT%.Dynamically_Define_Periodic_Data::*
{
  diagResponse this resp;
  long TransmissionMode;
  
  if (PreventAccessInsideDefaultSession(this, cNRC_RequestOutOfRange)) return;

  refreshS3Timer();

  TransmissionMode=diagGetParameter(this, "TransmissionMode");

  switch (TransmissionMode) {
    case Fast:
    case Medium:
    case Slow:
      gDDDIDSendMode=(enum eDIDSendMode)TransmissionMode;
      diagResize(resp,1);
      DiagSetPrimitiveByte(resp,0,0x6A);
      break;
    case Off:
      gDDDIDSendMode=Off;
      diagResize(resp,1);
      DiagSetPrimitiveByte(resp,0,0x6A);
      break;
    default:
      ResetSessionAndSendNegativeResponse( resp, cNRC_RequestOutOfRange);
      return;
  }
  diagSendPositiveResponse(resp);
}

setDoorStatusValuesAndSendResponse(diagResponse * resp)
{
  if (@sysvar::%BASE_FILE_NAME_NO_EXT%::DoorContactStatusOverwritten & 0x01) {
    diagSetParameter(resp, "Door_contact_front_left", @sysvarMember::%BASE_FILE_NAME_NO_EXT%::OverwrittenDoorContacts.FrontLeft);
  }
  else {
    diagSetParameter(resp, "Door_contact_front_left", @sysvarMember::ExternalSignals::OpenDoorContacts.FrontLeft);
  }

  if (@sysvar::%BASE_FILE_NAME_NO_EXT%::DoorContactStatusOverwritten & 0x02) {
    diagSetParameter(resp, "Door_contact_front_right", @sysvarMember::%BASE_FILE_NAME_NO_EXT%::OverwrittenDoorContacts.FrontRight);
  }
  else {
    diagSetParameter(resp, "Door_contact_front_right", @sysvarMember::ExternalSignals::OpenDoorContacts.FrontRight);
  }
  
  if (@sysvar::%BASE_FILE_NAME_NO_EXT%::DoorContactStatusOverwritten & 0x04) {
    diagSetParameter(resp, "Door_contact_rear_left", @sysvarMember::%BASE_FILE_NAME_NO_EXT%::OverwrittenDoorContacts.RearLeft);
  }
  else {
    diagSetParameter(resp, "Door_contact_rear_left", @sysvarMember::ExternalSignals::OpenDoorContacts.RearLeft);
  }

  if (@sysvar::%BASE_FILE_NAME_NO_EXT%::DoorContactStatusOverwritten & 0x08) {
    diagSetParameter(resp, "Door_contact_rear_right", @sysvarMember::%BASE_FILE_NAME_NO_EXT%::OverwrittenDoorContacts.RearRight);
  }
  else {
    diagSetParameter(resp, "Door_contact_rear_right", @sysvarMember::ExternalSignals::OpenDoorContacts.RearRight);
  }
  
  diagSendPositiveResponse(resp);    
}

on diagRequest %BASE_FILE_NAME_NO_EXT%.Door_Status_Read
{
  diagResponse this resp;
  
  refreshS3Timer();
  
  setDoorStatusValuesAndSendResponse(resp);  
}

on diagRequest %BASE_FILE_NAME_NO_EXT%.Door_Status_Control
{
  diagResponse this resp;
  long ret;
  
  refreshS3Timer();
  
  @sysvar::%BASE_FILE_NAME_NO_EXT%::DoorContactStatusOverwritten|=(word)diagGetParameter(this, "CEMR_Byte_0");

  if (diagGetParameter(this, "CEMR_Byte_0.EM_Door_contact_front_left")) {
    ret=diagGetParameter(this, "Door_contact_front_left");
    @sysvarMember::%BASE_FILE_NAME_NO_EXT%::OverwrittenDoorContacts.FrontLeft=ret;
  }

  if (diagGetParameter(this, "CEMR_Byte_0.EM_Door_contact_front_right")) {
    ret=diagGetParameter(this, "Door_contact_front_right");
    @sysvarMember::%BASE_FILE_NAME_NO_EXT%::OverwrittenDoorContacts.FrontRight=ret;
  }
  
  if (diagGetParameter(this, "CEMR_Byte_0.EM_Door_contact_rear_left")) {
    ret=diagGetParameter(this, "Door_contact_rear_left");
    @sysvarMember::%BASE_FILE_NAME_NO_EXT%::OverwrittenDoorContacts.RearLeft=ret;
  }

  if (diagGetParameter(this, "CEMR_Byte_0.EM_Door_contact_rear_right")) {
    ret=diagGetParameter(this, "Door_contact_rear_right");
    @sysvarMember::%BASE_FILE_NAME_NO_EXT%::OverwrittenDoorContacts.RearRight=ret;
  }
  
  setDoorStatusValuesAndSendResponse(resp);  
}

on diagRequest %BASE_FILE_NAME_NO_EXT%.Door_Status_ReturnControl
{
  diagResponse this resp;

  refreshS3Timer();

  @sysvar::%BASE_FILE_NAME_NO_EXT%::DoorContactStatusOverwritten&=((~((word)diagGetParameter(this, "CEMR_Byte_0"))) & 0xFF);

  setDoorStatusValuesAndSendResponse(resp);  
}

on diagRequest %BASE_FILE_NAME_NO_EXT%.Door_Status_Freeze
{
  diagResponse this resp;

  refreshS3Timer();

  if (diagGetParameter(this, "CEMR_Byte_0.EM_Door_contact_front_left") && !(@sysvar::%BASE_FILE_NAME_NO_EXT%::DoorContactStatusOverwritten & 0x01)) {  // Only freeze if not already overwritten
    @sysvarMember::%BASE_FILE_NAME_NO_EXT%::OverwrittenDoorContacts.FrontLeft=@sysvarMember::ExternalSignals::OpenDoorContacts.FrontLeft;
  }

  if (diagGetParameter(this, "CEMR_Byte_0.EM_Door_contact_front_right") && !(@sysvar::%BASE_FILE_NAME_NO_EXT%::DoorContactStatusOverwritten & 0x02)) {
    @sysvarMember::%BASE_FILE_NAME_NO_EXT%::OverwrittenDoorContacts.FrontRight=@sysvarMember::ExternalSignals::OpenDoorContacts.FrontRight;
  }
  
  if (diagGetParameter(this, "CEMR_Byte_0.EM_Door_contact_rear_left") && !(@sysvar::%BASE_FILE_NAME_NO_EXT%::DoorContactStatusOverwritten & 0x04)) {
    @sysvarMember::%BASE_FILE_NAME_NO_EXT%::OverwrittenDoorContacts.RearLeft=@sysvarMember::ExternalSignals::OpenDoorContacts.RearLeft;
  }

  if (diagGetParameter(this, "CEMR_Byte_0.EM_Door_contact_rear_right") && !(@sysvar::%BASE_FILE_NAME_NO_EXT%::DoorContactStatusOverwritten & 0x08)) {
    @sysvarMember::%BASE_FILE_NAME_NO_EXT%::OverwrittenDoorContacts.RearRight=@sysvarMember::ExternalSignals::OpenDoorContacts.RearRight;
  }
  
  @sysvar::%BASE_FILE_NAME_NO_EXT%::DoorContactStatusOverwritten|=(word)diagGetParameter(this, "CEMR_Byte_0");
  setDoorStatusValuesAndSendResponse(resp);  
}

on diagRequest %BASE_FILE_NAME_NO_EXT%.Door_Status_Reset
{
  diagResponse this resp;

  refreshS3Timer();
  
  @sysvar::%BASE_FILE_NAME_NO_EXT%::DoorContactStatusOverwritten&=((~((word)diagGetParameter(this, "CEMR_Byte_0"))) & 0xFF);

  if (diagGetParameter(this, "CEMR_Byte_0.EM_Door_contact_front_left")) {
    diagSetParameter(resp, "Door_contact_front_left", @sysvarMember::ExternalSignals::OpenDoorContacts.FrontLeft);
    @sysvarMember::%BASE_FILE_NAME_NO_EXT%::OverwrittenDoorContacts.FrontLeft=@sysvarMember::ExternalSignals::OpenDoorContacts.FrontLeft;
  }

  if (diagGetParameter(this, "CEMR_Byte_0.EM_Door_contact_front_right")) {
    diagSetParameter(resp, "Door_contact_front_right", @sysvarMember::ExternalSignals::OpenDoorContacts.FrontRight );
    @sysvarMember::%BASE_FILE_NAME_NO_EXT%::OverwrittenDoorContacts.FrontRight=@sysvarMember::ExternalSignals::OpenDoorContacts.FrontRight;
  }
  
  if (diagGetParameter(this, "CEMR_Byte_0.EM_Door_contact_rear_left")) {
    diagSetParameter(resp, "Door_contact_rear_left", @sysvarMember::ExternalSignals::OpenDoorContacts.RearLeft);
    @sysvarMember::%BASE_FILE_NAME_NO_EXT%::OverwrittenDoorContacts.RearLeft=@sysvarMember::ExternalSignals::OpenDoorContacts.RearLeft;
  }

  if (diagGetParameter(this, "CEMR_Byte_0.EM_Door_contact_rear_right")) {
    diagSetParameter(resp, "Door_contact_rear_right", @sysvarMember::ExternalSignals::OpenDoorContacts.RearRight);
    @sysvarMember::%BASE_FILE_NAME_NO_EXT%::OverwrittenDoorContacts.RearRight=@sysvarMember::ExternalSignals::OpenDoorContacts.RearRight;
  }

  setDoorStatusValuesAndSendResponse(resp);  
}

// Dummy positive responses to satisfy flash tool requirements, use diagnostic class to save some lines of code
on diagRequest %BASE_FILE_NAME_NO_EXT%.Communication_Control::*
{
  diagResponse this resp;  

  refreshS3Timer();
  diagSendPositiveResponse( resp);
}

// Handle both Hard and soft reset within one function (i.e. handle all services within one class)
on diagRequest %BASE_FILE_NAME_NO_EXT%.Reset::*
{
  diagResponse this resp;
  byte subFunction;

  subFunction=diagGetPrimitiveByte(this, 1);
  
  refreshS3Timer();
  
  if (subFunction==0x01) { // simulate HW Reset taking longer than SW reset
    sendNegativeResponse(this, cNRC_RequestCorrectlyReceivedResponsePending);
    setTimer(tDelayedResponse, cHardResetDuration_ms); // positive response needs to be sent within P2ext after RP
  }
  else {
    diagSetPrimitiveByte(resp, 1, subFunction);
    diagSendPositiveResponse(resp);
  }
  InitECU();
}