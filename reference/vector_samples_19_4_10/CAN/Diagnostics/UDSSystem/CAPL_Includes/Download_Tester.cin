/*@!Encoding:1252*/
variables
{
  diagRequest DefaultSession_Start                  sessionDefault;
  diagRequest ExtendedDiagnosticSession_Start       sessionExtended;
  diagRequest ProgrammingSession_Start              sessionProgramming;
  diagRequest SeedLevel_0x11_Request                securitySeed;
  diagRequest KeyLevel_0x11_Send                    securityKey;
  diagRequest Upload_Download_RequestDownload       downloadRequest;
  diagRequest Upload_Download_Transmit              downloadTransmit;
  diagRequest Upload_Download_Stop                  downloadStop;

  byte  memorySpecification[8];
  long  maxBlockSize;
  dword transmittedSize;

  dword downloadSize;
  byte  downloadBuffer[64 * 1024];
  byte  downloadCounter;
  
  char moduleID[20]="TCDownload";
}

tsFailWithRetCode(char error_text[], long ret)
{
  snprintf(gResultString, elcount(gResultString), "%s failed (Return code=%ld)!", error_text, ret);
  testStepFail(gTestIdStr, gResultString);
}

//===================================================================================
// Testcase: Download data to an ECU
//===================================================================================

export testcase TCDownload(int tcId, char gDiagTarget[])
{
  long ret;
  byte seedArray[4]; 
  byte keyArray[4];
  dword keyActualSize;
  dword i;
  
  byte  lengthFormatIdentifier;
  dword blockSpecSize;
  byte  blockSpec[4];
  
  //---------------------------------------------------------------------------------
  // Fill buffer to be downloaded to simulated ECU with data unequal zero
  //---------------------------------------------------------------------------------
  downloadSize=@sysvar::Tester::DownloadSize;
  for (i=0;i<downloadSize; i++) {
    downloadBuffer[i]=i%256;
  }

  SetTestId(tcId,1);

  //---------------------------------------------------------------------------------
  testStep("", "Setting diag target to '%s'.", gDiagTarget);
  //---------------------------------------------------------------------------------

  ret=DiagSetTarget(gDiagTarget);
  if (0 > ret) {
    tsFailWithRetCode("DiagSetTarget()", ret);
  }
  TestStepPass( gTestIdStr, "Diag target was set successfully to '%s'.", gDiagTarget);

  IncTestStepId();

  //---------------------------------------------------------------------------------
  TestStep( "", "Authenticating...");
  //---------------------------------------------------------------------------------

  // As the subsequent authentication step might switch to extended session and switching from programming
  // to extended session is forbidden, switch to default session first in case ECU is currently in programming session
  if (!SendRequestAndWaitForFirstResponse(sessionDefault, TRUE, FALSE)) return;
  TestStepPass( gTestIdStr, "Default session started.");  
  
  TFAuthenticate(gTestIdStr, gDiagTarget, "Cert=UDS 0x29 Supplier;AutoSessionChange=1;"); // Authenticate at ECU with supplier certificate

  IncTestStepId();
  //---------------------------------------------------------------------------------
  TestStep( "", "Stop Tester Present to reduce unnecessary bus traffic...");
  //---------------------------------------------------------------------------------

  ret=DiagStopTesterPresent(gDiagTarget);
  if (0 !=ret) {
    tsFailWithRetCode("DiagStopTesterPresent()", ret);
  }
  TestStepPass( gTestIdStr, "Tester Present stopped.");

  IncTestStepId();
  //---------------------------------------------------------------------------------
  TestStep( "", "Switch to extended session...");
  //---------------------------------------------------------------------------------

  if (!SendRequestAndWaitForFirstResponse(sessionExtended, TRUE, FALSE)) return;
  TestStepPass( "", "Extended session started.");

  
  IncTestStepId();
  //---------------------------------------------------------------------------------
  TestStep( "", "Switch to programming session...");
  //---------------------------------------------------------------------------------

  if (!SendRequestAndWaitForFirstResponse(sessionProgramming, TRUE, FALSE)) return;
  TestStepPass( "", "Programming session started.");


  IncTestStepId();
  //---------------------------------------------------------------------------------
  TestStep( "", "Request security seed...");
  //---------------------------------------------------------------------------------
  if (!SendRequestAndWaitForFirstResponse(securitySeed, TRUE, FALSE)) return;
  if ( (ret=diagGetRespParameterRaw(securitySeed, "SecuritySeed", seedArray, elCount(seedArray)))<0) {
    tsFailWithRetCode("diagGetRespParameterRaw()", ret); 
    return;
  }
  else {
    if ( (ret=diagGenerateKeyFromSeed(gDiagTarget, seedArray, elcount(seedArray), 1, "", "", keyArray, elcount(keyArray), keyActualSize)) !=0) {
      tsFailWithRetCode("diagGenerateKeyFromSeed()", ret);
      return;
    };
  }
  TestStepPass( "", "Got security seed and generated key.");
  

  IncTestStepId();
  //---------------------------------------------------------------------------------
  TestStep( "", "Write security key...");
  //---------------------------------------------------------------------------------
  DiagSetParameterRaw( securityKey, "SecurityKey", keyArray, elcount(keyArray));
  if (!SendRequestAndWaitForFirstResponse(securityKey, TRUE, FALSE)) return;
  TestStepPass( "", "Security key written");


  IncTestStepId();
  //---------------------------------------------------------------------------------
  TestStep( "", "Request download session...");
  //---------------------------------------------------------------------------------
  maxBlockSize = 0;
  memorySpecification[7] = ( byte)( ( downloadSize & 0x000000FF) >>  0);
  memorySpecification[6] = ( byte)( ( downloadSize & 0x0000FF00) >>  8);
  memorySpecification[5] = ( byte)( ( downloadSize & 0x00FF0000) >> 16);
  memorySpecification[4] = ( byte)( ( downloadSize & 0xFF000000) >> 24);
  DiagSetParameter( downloadRequest, "DFI_", 0); // dataFormatIdentifier
  DiagSetParameter( downloadRequest, "ALFID", 0x44); // addressAndLengthFormatIdentifier: 4 Byte memorySize, 4 Byte memoryAddress
  DiagSetParameterRaw( downloadRequest, "MA_MS_", memorySpecification, elCount(memorySpecification));
  if (!SendRequestAndWaitForFirstResponse(downloadRequest, TRUE, FALSE)) return;

  lengthFormatIdentifier = DiagGetRespParameter( downloadRequest, "LFID"); // lengthFormatIdentifier
  blockSpecSize = ( lengthFormatIdentifier & 0xF0) >> 4;
  if ( blockSpecSize > 4)
  {
    writeDbgLvlPrefix( 0, "%s: ERROR: Unexpected blockSpecSize (%d)", moduleID, blockSpecSize);
    testStepFail(gTestIdStr, "Unexpected blockSpecSize (%d)!", blockSpecSize);
    return;
  }
  
  for (i=0; i<blockSpecSize; i++) { //MaxNumberOfBlockLength
    if ((ret=DiagGetRespPrimitiveByte(downloadRequest, i+2))<0) {
      tsFailWithRetCode("DiagGetRespPrimitiveByte()", ret);
      return;
    }
    else {
      blockSpec[i]=(byte)ret;
    }
  }
  
  maxBlockSize = 0;
  for ( i = 0; i < blockSpecSize; ++i)
  {
    maxBlockSize <<= 8;
    maxBlockSize += blockSpec[i];
  }

  maxBlockSize -= 2;
  if ( maxBlockSize < 0)                                                          {
    snprintf(gResultString, elcount(gResultString), "Unexpected maxBlockSize(=%d)!", maxBlockSize);
    testStepFail(gTestIdStr, gResultString);
    return;
  }
  TestStepPass( "", "Download session activated.");

  writeDbgLvlPrefix( 3, "%s: Using block size %d bytes", moduleID, maxBlockSize);

  //---------------------------------------------------------------------------------
  TestStep( "", "Download data...");
  //---------------------------------------------------------------------------------
  transmittedSize = 0;
  downloadCounter = 0;
  while ( transmittedSize < downloadSize)
  {
    if ( downloadSize - transmittedSize < maxBlockSize)
    {
      maxBlockSize = downloadSize - transmittedSize;
    }
    downloadCounter++;
    DiagSetParameter( downloadTransmit, "Block_Sequence_Counter", downloadCounter);
    DiagSetParameterRaw( downloadTransmit, "Transfer_Request_Parameter_Record", downloadBuffer, maxBlockSize);

    IncTestStepId();
    if (!SendRequestAndWaitForFirstResponse(downloadTransmit, TRUE, FALSE)) return;
    transmittedSize += maxBlockSize;
  }
  TestStepPass( "", "Download data completed.");

  
  IncTestStepId();
  //---------------------------------------------------------------------------------
  TestStep( "", "Request download stop...");
  //---------------------------------------------------------------------------------
  if (!SendRequestAndWaitForFirstResponse(downloadStop, TRUE, FALSE)) return;
  TestStepPass( "", "Download stopped.");
  writeDbgLvlPrefix( 2, "%s: Flashed %d bytes", moduleID, downloadSize);


  IncTestStepId();
  //---------------------------------------------------------------------------------
  TestStep( "", "Start Tester Present...");
  //---------------------------------------------------------------------------------
  ret=DiagStartTesterPresent(gDiagTarget);
  if (0 !=ret) {
    tsFailWithRetCode("DiagStartTesterPresent", ret);
  }
  TestStepPass( gTestIdStr, "Tester Present started.");
}
