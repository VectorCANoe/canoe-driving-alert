/* !Encoding: 65001  */
includes
{
  #include "__DiagLibrary.cin"
  #include "__VariablesLib.cin"
  #include "__CaplGeneratorLib.cin"
  #include "__CANoeReportFuntionsLib.cin"
}

variables
{
  // Global variables defined within this CAPL file
}

void Tt516bfa5_Tet_TtInit()
{
  stack long __tableHandle;
}

void Tt516bfa5_Tet_Tc0()
{
  CreateTTEIFFunction("Tt516bfa5_Tc0", __eTcDef, __eLocal);  
  CallInterfaceFunction("Start engine", __cEmpty , __cEmpty );
}
testcase Tt516bfa5_Tc0()
{
  stack long __tableHandle;
dword __h0;

  SetBreakOnFail(1);

  TestPreparationBegin();
  {
    TestCommandBegin(__eSet, __cSet, "Setting ignition switch to state one", "0");
    {
      __tableHandle = ReportTableHead3Columns(__cSetCaption , __cTSym, __cTOp, __cAssigned); 
      {
        @sysvarInt::`IL::`IgnitionSwitch = 1;
        snprintf(__cArray, 8192, "%s", "IgnitionSwitch");
        snprintf(__cArray2, 8192, "%s '%s'", __cSysVar, __cArray);
        snprintf(__cArray3, 8192, "%s", "");
        
        ReportTableRow(__tableHandle, 0, __cArray2, __cAOp, 1, __cArray3, __oneOfFlag, __bSetInCheckAlignment);
        
    
      }
      ReportTableEndTestStep(__tableHandle, "1");
    }
    TestCommandEnd();


    TestCommandBegin(__eWait, __cWait, "", "1");
    {
      Wait("1", (500 * 1000000LL), 1000000, "");
    }
    TestCommandEnd();

    TestCommandBegin(__eSet, __cSet, "Turning ignition switch further", "2");
    {
      __tableHandle = ReportTableHead3Columns(__cSetCaption , __cTSym, __cTOp, __cAssigned); 
      {
        @sysvarInt::`IL::`IgnitionSwitch = 2;
        snprintf(__cArray, 8192, "%s", "IgnitionSwitch");
        snprintf(__cArray2, 8192, "%s '%s'", __cSysVar, __cArray);
        snprintf(__cArray3, 8192, "%s", "");
        
        ReportTableRow(__tableHandle, 0, __cArray2, __cAOp, 2, __cArray3, __oneOfFlag, __bSetInCheckAlignment);
        
    
      }
      ReportTableEndTestStep(__tableHandle, "1");
    }
    TestCommandEnd();


    TestCommandBegin(__eWait, __cWait, "", "3");
    {
      Wait("1", (2000 * 1000000LL), 1000000, "");
    }
    TestCommandEnd();

    if(SetBusContextByName("PowerTrain", __eSaveCurrent, __nBusContextNew, __nBusContextOld))
    {
      ChkConfig_SetPrecision(3);
      __h0 = ChkCreate_NodeDeadNS(`PowerTrain::dbNode::`Engine, 1000 * 1000000LL);
      ChkConfig_SetPrecision(3);
    }
    if (ChkQuery_Valid(__h0) > 0)
    {
      ChkConfig_SetTitle(__h0, "");
      TestAddCondition(__h0);
      ChkControl_Start(__h0, "4");
    }
    ResetBusContext(__nBusContextNew, __nBusContextOld);


    TestCommandBegin(__eWait, __cWait, "", "5");
    {
      Wait("1", (2000 * 1000000LL), 1000000, "");
    }
    TestCommandEnd();

  }
  TestPreparationEnd();

}

void Tt516bfa5_Tet_Tc1()
{
  CreateTTEIFFunction("Tt516bfa5_Tc1", __eTcDef, __eLocal);  
  CallInterfaceFunction("Acceleration setting pedal positions", __cEmpty , __cEmpty );
}
testcase Tt516bfa5_Tc1()
{
  stack long __tableHandle;
  SetBreakOnFail(1);

  CreateTTEIFFunction("Tt516bfa5_Tet_Tc1_Completion", __eFct, __eLocal);
  
  AddIFAsCleanUpFunction();

  TestCommandBegin(__eSet, __cSet, "Fully press brake pedal ", "0");
  {
    __tableHandle = ReportTableHead3Columns(__cSetCaption , __cTSym, __cTOp, __cAssigned); 
    {
      @sysvarInt::`PowerTrain::`PedalPressure_Brake = 1;
      snprintf(__cArray, 8192, "%s", "PedalPressure_Brake");
      snprintf(__cArray2, 8192, "%s '%s'", __cSysVar, __cArray);
      snprintf(__cArray3, 8192, "%s", "");
      
      ReportTableRow(__tableHandle, 0, __cArray2, __cAOp, 1, __cArray3, __oneOfFlag, __bSetInCheckAlignment);
      
  
    }
    ReportTableEndTestStep(__tableHandle, "1");
  }
  TestCommandEnd();


  TestCommandBegin(__eWait, __cWait, "", "1");
  {
    Wait("1", (500 * 1000000LL), 1000000, "");
  }
  TestCommandEnd();

  TestCommandBegin(__eAwaitValueMatch, __cAwaitValueMatch, "Make sure vehicle is stationary", "2");
  {
  
    int64 __time;
    long __setFailed;
    __setFailed = 0;
    __time = 7000 * 1000000LL;
    if (__time < 0)
    {
      testStepErrorInTestSystem(0, "1", "Unable to wait for %.3f %s. Please check input parameter.", __time / ((float)1000000), "ms");
    }
    else
    {
                        snprintf(__cArray, elCount(__cArray), "System variable '%s'", "CarSpeed_kmh");
      __setFailed |= testJoinSignal(sysvarFloat::`PowerTrain::`CarSpeed_kmh, __cArray,
                        delegate dword(sysvar * __cbParam)
                        {
                          __csr = CheckSignalMatch(__cbParam, 0, IsNegative(0), "==") == 1;
                          return __csr;
                        }) < 0;
      if (__setFailed != 0)
      {
        testStepErrorInTestSystem(0, "1", "Unable to set value condition.");
      }
      else
      {
        __bVerdict = testWaitForAllJoinedEventsNS(__time) > 0;
        __tableHandle = ReportTableHead5Columns("Waited for occurrence of 1 value condition.", __cTSym, __cTOp, __cRefVal, __cActual, __cRes);
                        __csr = CheckSignalMatch(sysvarFloat::`PowerTrain::`CarSpeed_kmh, 0, IsNegative(0), "==") == 1;
                        snprintf(__cArray, 8192, "%s", "CarSpeed_kmh");
                        snprintf(__cArray2, 8192, "%s '%s'", __cSysVar, __cArray);
                        snprintf(__cArray3, 8192, "%s", "");
                        ReportTableRow(__tableHandle, 0, __cArray2, "==", 0, __cArray3, __oneOfFlag, __bSetInCheckAlignment);
                        ReportCell(__tableHandle, @sysvarFloat::`PowerTrain::`CarSpeed_kmh);
                        ReportCellResult(__tableHandle, __csr, __ePassFail);
        ReportTableEndVerdict(__tableHandle, "1", __bVerdict);
      }
    }
  }
  TestCommandEnd();

  TestCommandBegin(__eWait, __cWait, "", "4");
  {
    Wait("1", (1000 * 1000000LL), 1000000, "");
  }
  TestCommandEnd();

  TestCommandBegin(__eSet, __cSet, "Start acceleration", "5");
  {
    __tableHandle = ReportTableHead3Columns(__cSetCaption , __cTSym, __cTOp, __cAssigned); 
    {
      @sysvarInt::`PowerTrain::`PedalPressure_Brake = 0;
      snprintf(__cArray, 8192, "%s", "PedalPressure_Brake");
      snprintf(__cArray2, 8192, "%s '%s'", __cSysVar, __cArray);
      snprintf(__cArray3, 8192, "%s", "");
      
      ReportTableRow(__tableHandle, 0, __cArray2, __cAOp, 0, __cArray3, __oneOfFlag, __bSetInCheckAlignment);
      
  
    }
    {
      @sysvarInt::`PowerTrain::`PedalPressure_Gas = 1;
      snprintf(__cArray, 8192, "%s", "PedalPressure_Gas");
      snprintf(__cArray2, 8192, "%s '%s'", __cSysVar, __cArray);
      snprintf(__cArray3, 8192, "%s", "");
      
      ReportTableRow(__tableHandle, 0, __cArray2, __cAOp, 1, __cArray3, __oneOfFlag, __bSetInCheckAlignment);
      
  
    }
    ReportTableEndTestStep(__tableHandle, "1");
  }
  TestCommandEnd();


  TestCommandBegin(__eWait, __cWait, "", "6");
  {
    Wait("1", (1000 * 1000000LL), 1000000, "");
  }
  TestCommandEnd();

  TestCommandBegin(__eAwaitValueMatch, __cAwaitValueMatch, "Wait until vehicle reaches 100 kph", "7");
  {
  
    int64 __time;
    long __setFailed;
    __setFailed = 0;
    __time = 20000 * 1000000LL;
    if (__time < 0)
    {
      testStepErrorInTestSystem(0, "1", "Unable to wait for %.3f %s. Please check input parameter.", __time / ((float)1000000), "ms");
    }
    else
    {
                        snprintf(__cArray, elCount(__cArray), "System variable '%s'", "CarSpeed_kmh");
      __setFailed |= testJoinSignal(sysvarFloat::`PowerTrain::`CarSpeed_kmh, __cArray,
                        delegate dword(sysvar * __cbParam)
                        {
                          __csr = CheckSignalMatch(__cbParam, 100, IsNegative(100), ">=") == 1;
                          return __csr;
                        }) < 0;
      if (__setFailed != 0)
      {
        testStepErrorInTestSystem(0, "1", "Unable to set value condition.");
      }
      else
      {
        __bVerdict = testWaitForAllJoinedEventsNS(__time) > 0;
        __tableHandle = ReportTableHead5Columns("Waited for occurrence of 1 value condition.", __cTSym, __cTOp, __cRefVal, __cActual, __cRes);
                        __csr = CheckSignalMatch(sysvarFloat::`PowerTrain::`CarSpeed_kmh, 100, IsNegative(100), ">=") == 1;
                        snprintf(__cArray, 8192, "%s", "CarSpeed_kmh");
                        snprintf(__cArray2, 8192, "%s '%s'", __cSysVar, __cArray);
                        snprintf(__cArray3, 8192, "%s", "");
                        ReportTableRow(__tableHandle, 0, __cArray2, ">=", 100, __cArray3, __oneOfFlag, __bSetInCheckAlignment);
                        ReportCell(__tableHandle, @sysvarFloat::`PowerTrain::`CarSpeed_kmh);
                        ReportCellResult(__tableHandle, __csr, __ePassFail);
        ReportTableEndVerdict(__tableHandle, "1", __bVerdict);
      }
    }
  }
  TestCommandEnd();


}

void Tt516bfa5_Tet_Tc1_Completion()
{
  stack long __tableHandle;
  TestCompletionBegin();
  {
    TestCommandBegin(__eSet, __cSet, "Setting Cruise Control", "8");
    {
      __tableHandle = ReportTableHead3Columns(__cSetCaption , __cTSym, __cTOp, __cAssigned); 
      {
        @sysvarInt::`CruiseControl::`CCTargetSpeed = 100;
        snprintf(__cArray, 8192, "%s", "CCTargetSpeed");
        snprintf(__cArray2, 8192, "%s '%s'", __cSysVar, __cArray);
        snprintf(__cArray3, 8192, "%s", "");
        
        ReportTableRow(__tableHandle, 0, __cArray2, __cAOp, 100, __cArray3, __oneOfFlag, __bSetInCheckAlignment);
        
    
      }
      {
        @sysvarInt::`CruiseControl::`CC_Active = 1;
        snprintf(__cArray, 8192, "%s", "CC_Active");
        snprintf(__cArray2, 8192, "%s '%s'", __cSysVar, __cArray);
        snprintf(__cArray3, 8192, "%s", "");
        
        ReportTableRow(__tableHandle, 0, __cArray2, __cAOp, 1, __cArray3, __oneOfFlag, __bSetInCheckAlignment);
        
    
      }
      {
        @sysvarInt::`PowerTrain::`PedalPressure_Gas = 0;
        snprintf(__cArray, 8192, "%s", "PedalPressure_Gas");
        snprintf(__cArray2, 8192, "%s '%s'", __cSysVar, __cArray);
        snprintf(__cArray3, 8192, "%s", "");
        
        ReportTableRow(__tableHandle, 0, __cArray2, __cAOp, 0, __cArray3, __oneOfFlag, __bSetInCheckAlignment);
        
    
      }
      ReportTableEndTestStep(__tableHandle, "1");
    }
    TestCommandEnd();


    TestCommandBegin(__eWait, __cWait, "", "9");
    {
      Wait("1", (5000 * 1000000LL), 1000000, "");
    }
    TestCommandEnd();

  }
  TestCompletionEnd();
}

void Tt516bfa5_Tet_Tc2()
{
  CreateTTEIFFunction("Tt516bfa5_Tc2", __eTcDef, __eLocal);  
  CallInterfaceFunction("Braking test: Checking ABS functionality", __cEmpty , __cEmpty );
}
testcase Tt516bfa5_Tc2()
{
  stack long __tableHandle;
  SetBreakOnFail(1);

  CreateTTEIFFunction("Tt516bfa5_Tet_Tc2_Completion", __eFct, __eLocal);
  
  AddIFAsCleanUpFunction();

  TestPreparationBegin();
  {
    TestCommandBegin(__eAwaitValueMatch, __cAwaitValueMatch, "Wait until car reaches 100 kph", "0");
    {
    
      dword __signalTimes[1];
      int64 __time;
      long __setFailed;
      __setFailed = 0;
      __time = 20000 * 1000000LL;
      if (__time < 0)
      {
        testStepErrorInTestSystem(0, "1", "Unable to wait for %.3f %s. Please check input parameter.", __time / ((float)1000000), "ms");
      }
      else
      {
        __signalTimes[0] = getSignalTime(`PowerTrain::dbNode::`Engine::`ABSdata::`CarSpeed);
                          snprintf(__cArray, elCount(__cArray), "PDU signal '%s'", "ABSdata::CarSpeed");
        __setFailed |= testJoinSignal(`PowerTrain::dbNode::`Engine::`ABSdata::`CarSpeed, __cArray, 0,
                          delegate dword(signal * __cbParam)
                          {
                            __csr = CheckSignalMatch(__cbParam, 99.5, ">=") == 1;
                            return __csr;
                          }) < 0;
        if (__setFailed != 0)
        {
          testStepErrorInTestSystem(0, "1", "Unable to set value condition.");
        }
        else
        {
          __bVerdict = testWaitForAllJoinedEventsNS(__time) > 0;
          __tableHandle = ReportTableHead5Columns("Waited for occurrence of 1 value condition.", __cTSym, __cTOp, __cRefVal, __cActual, __cRes);
                          __csr = CheckSignalMatch(`PowerTrain::dbNode::`Engine::`ABSdata::`CarSpeed, 99.5, ">=") == 1;
                          snprintf(__cArray, 8192, "%s", "ABSdata::CarSpeed");
                          snprintf(__cArray2, 8192, "%s '%s'", __cPduSignal, __cArray);
                          snprintf(__cArray3, 8192, "%s", "");
                          ReportTableRow(__tableHandle, 0, __cArray2, ">=", 99.5, __cArray3, __oneOfFlag, __bSetInCheckAlignment);
                          ReportLValueOrSignalNotOnline(`PowerTrain::dbNode::`Engine::`ABSdata::`CarSpeed, __cArray5, 8192);
                          ReportCell(__tableHandle, __cArray5);
                          ReportCellResult(__tableHandle, __csr, __ePassFail);
          ReportTableEndVerdict(__tableHandle, "1", __bVerdict);
        }
      }
    }
    TestCommandEnd();

    TestCommandBegin(__eSet, __cSet, "Fully pressing brake pedal and reset error code", "1");
    {
      __tableHandle = ReportTableHead3Columns(__cSetCaption , __cTSym, __cTOp, __cAssigned); 
      {
        @sysvarInt::`PowerTrain::`PedalPressure_Brake = 1;
        snprintf(__cArray, 8192, "%s", "PedalPressure_Brake");
        snprintf(__cArray2, 8192, "%s '%s'", __cSysVar, __cArray);
        snprintf(__cArray3, 8192, "%s", "");
        
        ReportTableRow(__tableHandle, 0, __cArray2, __cAOp, 1, __cArray3, __oneOfFlag, __bSetInCheckAlignment);
        
    
      }
      {
        $`PowerTrain::dbNode::`Engine::`EngineStatus::`ErrorCode.phys = 0;
        snprintf(__cArray, 8192, "%s", "ErrorCode");
        snprintf(__cArray2, 8192, "%s '%s'", __cPduSignal, __cArray);
        snprintf(__cArray3, 8192, "%s", "NoError");
        
        ReportSetLValueOrSignalNotOnline(getSignalTime(`PowerTrain::dbNode::`Engine::`EngineStatus::`ErrorCode), __cArray2, __cArray4, 8192);
        ReportTableRow(__tableHandle, 0, __cArray4, __cAOp, 0, __cArray3, __oneOfFlag, __bSetInCheckAlignment);
        
    
      }
      ReportTableEndTestStep(__tableHandle, "1");
    }
    TestCommandEnd();


    TestCommandBegin(__eAwaitValueMatch, __cAwaitValueMatch, "Wait until the car starts to brake", "2");
    {
    
      int64 __time;
      long __setFailed;
      __setFailed = 0;
      __time = 2500 * 1000000LL;
      if (__time < 0)
      {
        testStepErrorInTestSystem(0, "1", "Unable to wait for %.3f %s. Please check input parameter.", __time / ((float)1000000), "ms");
      }
      else
      {
                          snprintf(__cArray, elCount(__cArray), "System variable '%s'", "ABSactive");
        __setFailed |= testJoinSignal(sysvarInt::`PowerTrain::`ABSactive, __cArray,
                          delegate dword(sysvar * __cbParam)
                          {
                            __csr = CheckSignalMatch(__cbParam, 1, IsNegative(1), "==") == 1;
                            return __csr;
                          }) < 0;
        if (__setFailed != 0)
        {
          testStepErrorInTestSystem(0, "1", "Unable to set value condition.");
        }
        else
        {
          __bVerdict = testWaitForAllJoinedEventsNS(__time) > 0;
          __tableHandle = ReportTableHead5Columns("Waited for occurrence of 1 value condition.", __cTSym, __cTOp, __cRefVal, __cActual, __cRes);
                          __csr = CheckSignalMatch(sysvarInt::`PowerTrain::`ABSactive, 1, IsNegative(1), "==") == 1;
                          snprintf(__cArray, 8192, "%s", "ABSactive");
                          snprintf(__cArray2, 8192, "%s '%s'", __cSysVar, __cArray);
                          snprintf(__cArray3, 8192, "%s", "");
                          ReportTableRow(__tableHandle, 0, __cArray2, "==", 1, __cArray3, __oneOfFlag, __bSetInCheckAlignment);
                          ReportCell(__tableHandle, @sysvarInt::`PowerTrain::`ABSactive);
                          ReportCellResult(__tableHandle, __csr, __ePassFail);
          ReportTableEndVerdict(__tableHandle, "1", __bVerdict);
        }
      }
    }
    TestCommandEnd();

    TestCommandBegin(__eCAPLInline, __cCAPLInline, "", "3");
    {
      __ci516bfa5CaplInline0();
    }
    TestCommandEnd();

    TestCommandBegin(__eAwaitValueMatch, __cAwaitValueMatch, "Wait until car is stationary", "4");
    {
    
      dword __signalTimes[1];
      int64 __time;
      long __setFailed;
      __setFailed = 0;
      __time = 10000 * 1000000LL;
      if (__time < 0)
      {
        testStepErrorInTestSystem(0, "1", "Unable to wait for %.3f %s. Please check input parameter.", __time / ((float)1000000), "ms");
      }
      else
      {
        __signalTimes[0] = getSignalTime(`PowerTrain::dbNode::`Engine::`ABSdata::`CarSpeed);
                          snprintf(__cArray, elCount(__cArray), "PDU signal '%s'", "ABSdata::CarSpeed");
        __setFailed |= testJoinSignal(`PowerTrain::dbNode::`Engine::`ABSdata::`CarSpeed, __cArray, 0,
                          delegate dword(signal * __cbParam)
                          {
                            __csr = CheckSignalMatch(__cbParam, 0, "==") == 1;
                            return __csr;
                          }) < 0;
        if (__setFailed != 0)
        {
          testStepErrorInTestSystem(0, "1", "Unable to set value condition.");
        }
        else
        {
          __bVerdict = testWaitForAllJoinedEventsNS(__time) > 0;
          __tableHandle = ReportTableHead5Columns("Waited for occurrence of 1 value condition.", __cTSym, __cTOp, __cRefVal, __cActual, __cRes);
                          __csr = CheckSignalMatch(`PowerTrain::dbNode::`Engine::`ABSdata::`CarSpeed, 0, "==") == 1;
                          snprintf(__cArray, 8192, "%s", "ABSdata::CarSpeed");
                          snprintf(__cArray2, 8192, "%s '%s'", __cPduSignal, __cArray);
                          snprintf(__cArray3, 8192, "%s", "");
                          ReportTableRow(__tableHandle, 0, __cArray2, "==", 0, __cArray3, __oneOfFlag, __bSetInCheckAlignment);
                          ReportLValueOrSignalNotOnline(`PowerTrain::dbNode::`Engine::`ABSdata::`CarSpeed, __cArray5, 8192);
                          ReportCell(__tableHandle, __cArray5);
                          ReportCellResult(__tableHandle, __csr, __ePassFail);
          ReportTableEndVerdict(__tableHandle, "1", __bVerdict);
        }
      }
    }
    TestCommandEnd();

    TestCommandBegin(__eCheck, __cCheck, "Check is Shift Down during braking was successfull", "5");
    {
      __bVerdict = __eVerdictPass;
      __tableHandle = ReportTableHead5Columns(__cCheckCaption, __cTSym, __cTOp, __cRefVal, __cActual, __cRes);
      {
        __csr = CheckSignalMatch(`PowerTrain::dbNode::`Engine::`GearBoxInfo::`Gear, 0, "==") == 1;
        snprintf(__cArray, 8192, "%s", "GearBoxInfo::Gear");
        snprintf(__cArray2, 8192, "%s '%s'", __cPduSignal, __cArray);
        snprintf(__cArray3, 8192, "%s", "");
        ReportTableRow(__tableHandle, 0, __cArray2, "==", 0, __cArray3, __oneOfFlag, __bSetInCheckAlignment);
        ReportLValueOrSignalNotOnline(`PowerTrain::dbNode::`Engine::`GearBoxInfo::`Gear, __cArray5, 8192);
        ReportCell(__tableHandle, __cArray5);
        ReportCellResult(__tableHandle, __csr, __ePassFail);
    
        __bVerdict = __bVerdict && __csr;
      }
      ReportTableEndVerdict(__tableHandle, "1", __bVerdict);
    }
    TestCommandEnd();


  }
  TestPreparationEnd();


}

void __ci516bfa5CaplInline0()
{
  stack long __tableHandle;
  {
    graphicsWindowClear("Graphics Simulation");

  }
}
void Tt516bfa5_Tet_Tc2_Completion()
{
  stack long __tableHandle;
  TestCompletionBegin();
  {
    TestCommandBegin(__eSet, __cSet, "Deactivate brake", "6");
    {
      __tableHandle = ReportTableHead3Columns(__cSetCaption , __cTSym, __cTOp, __cAssigned); 
      {
        @sysvarInt::`PowerTrain::`PedalPressure_Brake = 0;
        snprintf(__cArray, 8192, "%s", "PedalPressure_Brake");
        snprintf(__cArray2, 8192, "%s '%s'", __cSysVar, __cArray);
        snprintf(__cArray3, 8192, "%s", "");
        
        ReportTableRow(__tableHandle, 0, __cArray2, __cAOp, 0, __cArray3, __oneOfFlag, __bSetInCheckAlignment);
        
    
      }
      ReportTableEndTestStep(__tableHandle, "1");
    }
    TestCommandEnd();


    TestCommandBegin(__eWait, __cWait, "", "7");
    {
      Wait("1", (1000 * 1000000LL), 1000000, "");
    }
    TestCommandEnd();

  }
  TestCompletionEnd();
}

void Tt516bfa5_Tet_Tc3()
{
  CreateTTEIFFunction("Tt516bfa5_Tc3", __eTcDef, __eLocal);  
  CallInterfaceFunction("Check the gateway routing by background checks ", __cEmpty , __cEmpty );
}
testcase Tt516bfa5_Tc3()
{
  stack long __tableHandle;
dword __h1;
dword __h2;

  SetBreakOnFail(1);

  {
  
    ChkConfig_SetPrecision(3);
    __h1 = ChkCreate_RequestResponseNS(200 * 1000000LL, 0, 0, 0);
    ChkConfig_SetPrecision(3);
    if(!SetBusContextByName("PowerTrain", __eSaveCurrent, __nBusContextNew, __nBusContextOld))
      ChkControl_Destroy(__h1);
    if (ChkQuery_Valid(__h1) > 0)
    {
      if (0 != ChkConfig_AddParameter(__h1, `PowerTrain::dbPDU::`ABSdata, "request"))
        ChkControl_Destroy(__h1);
    }
    if(!SetBusContextByName("Comfort", __eSaveCurrent, __nBusContextNew, __nBusContextOld))
      ChkControl_Destroy(__h1);
    if (ChkQuery_Valid(__h1) > 0)
    {
      snprintf(__cArray, elCount(__cArray), "PDU '%s' on bus Comfort", "Gateway_2");
      strncpy(__cCheckReportString2, __cArray, 8192);
      
      if (0 != ChkConfig_AddParameterCallbackHandle(__h1, `Comfort::dbPDU::`Gateway_2, "response", __cCheckReportString2,
                                        delegate dword(dword __handle)
                                        {
                                          dword __msg_callback_ret;
                                          pdu `Comfort::`Gateway::`Gateway_2 __m;
                                          pdu `PowerTrain::`Engine::`ABSdata __m2;
                                          pdu * __req;
                                          pdu * __resp;
                                          if (ChkConfig_GetParameter(__handle, "request", __req) != 0)
                                          {
                                            testStepErrorInTestSystem("\'Request Response\' check failed. Cannot access request in callback.");
                                            return 1;
                                          }
                                          if (ChkConfig_GetParameter(__handle, "response", __resp) != 0)
                                          {
                                            testStepErrorInTestSystem("\'Request Response\' check failed. Cannot access response in callback.");
                                            return 1;
                                          }
                                          __msg_callback_ret = 1;
                                          __m = __resp;
                                          __m2 = __req;
                                          __csr = CheckSignalMatch(`Comfort::dbNode::`Gateway::`Gateway_2::`CarSpeed, __m.`CarSpeed.phys, __m2.`CarSpeed.phys, "==") == 1;
                                          __msg_callback_ret &= __csr;
                                          return __msg_callback_ret;
                                        }))
        ChkControl_Destroy(__h1);
    }
    if (ChkQuery_Valid(__h1) > 0)
    {
      ChkConfig_SetTitle(__h1, "Check the routing of the car speed");
      TestAddCondition(__h1);
      ChkControl_Start(__h1, "0");
    }
    ResetBusContext(__nBusContextNew, __nBusContextOld);
  }

  {
  
    ChkConfig_SetPrecision(3);
    __h2 = ChkCreate_RequestResponseNS(200 * 1000000LL, 0, 0, 0);
    ChkConfig_SetPrecision(3);
    if(!SetBusContextByName("PowerTrain", __eSaveCurrent, __nBusContextNew, __nBusContextOld))
      ChkControl_Destroy(__h2);
    if (ChkQuery_Valid(__h2) > 0)
    {
      if (0 != ChkConfig_AddParameter(__h2, `PowerTrain::dbPDU::`GearBoxInfo, "request"))
        ChkControl_Destroy(__h2);
    }
    if(!SetBusContextByName("Comfort", __eSaveCurrent, __nBusContextNew, __nBusContextOld))
      ChkControl_Destroy(__h2);
    if (ChkQuery_Valid(__h2) > 0)
    {
      snprintf(__cArray, elCount(__cArray), "PDU '%s' on bus Comfort", "Gateway_1");
      strncpy(__cCheckReportString2, __cArray, 8192);
      
      if (0 != ChkConfig_AddParameterCallbackHandle(__h2, `Comfort::dbPDU::`Gateway_1, "response", __cCheckReportString2,
                                        delegate dword(dword __handle)
                                        {
                                          dword __msg_callback_ret;
                                          pdu `Comfort::`Gateway::`Gateway_1 __m;
                                          pdu `PowerTrain::`Engine::`GearBoxInfo __m2;
                                          pdu * __req;
                                          pdu * __resp;
                                          if (ChkConfig_GetParameter(__handle, "request", __req) != 0)
                                          {
                                            testStepErrorInTestSystem("\'Request Response\' check failed. Cannot access request in callback.");
                                            return 1;
                                          }
                                          if (ChkConfig_GetParameter(__handle, "response", __resp) != 0)
                                          {
                                            testStepErrorInTestSystem("\'Request Response\' check failed. Cannot access response in callback.");
                                            return 1;
                                          }
                                          __msg_callback_ret = 1;
                                          __m = __resp;
                                          __m2 = __req;
                                          __csr = CheckSignalMatch(`Comfort::dbNode::`Gateway::`Gateway_1::`Gear, __m.`Gear.phys, __m2.`Gear.phys, "==") == 1;
                                          __msg_callback_ret &= __csr;
                                          return __msg_callback_ret;
                                        }))
        ChkControl_Destroy(__h2);
    }
    if (ChkQuery_Valid(__h2) > 0)
    {
      ChkConfig_SetTitle(__h2, "Check the routing of the gearbox state");
      TestAddCondition(__h2);
      ChkControl_Start(__h2, "1");
    }
    ResetBusContext(__nBusContextNew, __nBusContextOld);
  }

  TestCommandBegin(__eWait, __cWait, "", "2");
  {
    Wait("1", (1000 * 1000000LL), 1000000, "");
  }
  TestCommandEnd();

  TestCommandBegin(__eWait, __cWait, "", "3");
  {
    Wait("1", (1000 * 1000000LL), 1000000, "");
  }
  TestCommandEnd();

}

void Tt516bfa5_Tet_Tc4()
{
  CreateTTEIFFunction("Tt516bfa5_Tc4", __eTcDef, __eLocal);  
  CallInterfaceFunction("Check ECU information", __cEmpty , __cEmpty );
}
testcase Tt516bfa5_Tc4()
{
  stack long __tableHandle;
  SetBreakOnFail(1);

  CreateTTEIFFunction("Tt516bfa5_Tet_Tc4_Completion", __eFct, __eLocal);
  
  AddIFAsCleanUpFunction();

  TestPreparationBegin();
  {
    TestCommandBegin(__eWait, __cWait, "", "0");
    {
      Wait("1", (5000 * 1000000LL), 1000000, "");
    }
    TestCommandEnd();

    TestCommandBegin(__eDiagService, __cDiagService, "Enable Default Session", "1");
    {
      if (DiagIsFunctionalGroup("Engine"))
      {
        DiagResponse * __resp;
        DiagRequest Engine.DEFAULT_SESSION_Start __req;
        __diagService516bfa5_0(__req, __resp);
      }
      else
      {
        DiagResponse Engine.* __resp;
        DiagRequest Engine.DEFAULT_SESSION_Start __req;
        __diagService516bfa5_0(__req, __resp);
      }
    }
    TestCommandEnd();


  }
  TestPreparationEnd();

  TestCaseDescription("This test case asks the ECU \"Engine\" for some information:\n- ECU identification\n- Serial Number\n- Coding\nThe return values are checked.");

  TestCommandBegin(__eDiagService, __cDiagService, "Check ECU Identification", "2");
  {
    if (DiagIsFunctionalGroup("Engine"))
    {
      DiagResponse * __resp;
      DiagRequest Engine.ECU_Identification_Read __req;
      __diagService516bfa5_2(__req, __resp);
    }
    else
    {
      DiagResponse Engine.* __resp;
      DiagRequest Engine.ECU_Identification_Read __req;
      __diagService516bfa5_2(__req, __resp);
    }
  }
  TestCommandEnd();


  TestCommandBegin(__eDiagService, __cDiagService, "Check Serial Number", "3");
  {
    if (DiagIsFunctionalGroup("Engine"))
    {
      DiagResponse * __resp;
      DiagRequest Engine.Serial_Number_Read __req;
      __diagService516bfa5_3(__req, __resp);
    }
    else
    {
      DiagResponse Engine.* __resp;
      DiagRequest Engine.Serial_Number_Read __req;
      __diagService516bfa5_3(__req, __resp);
    }
  }
  TestCommandEnd();


  TestCommandBegin(__eDiagService, __cDiagService, "Check Coding", "4");
  {
    if (DiagIsFunctionalGroup("Engine"))
    {
      DiagResponse * __resp;
      DiagRequest Engine.Coding_Read __req;
      __diagService516bfa5_4(__req, __resp);
    }
    else
    {
      DiagResponse Engine.* __resp;
      DiagRequest Engine.Coding_Read __req;
      __diagService516bfa5_4(__req, __resp);
    }
  }
  TestCommandEnd();



}

  
void __diagService516bfa5_0(DiagRequest * __req, DiagResponse * __resp )
{
  stack long __tableHandle;
  long __res, __paramLen, __bytePos;

   __bVerdict = __eVerdictPass;

  do {
    TestReportResetDiagObjectList();
    DiagSetReportDetailLevel("Engine", EnumServiceDetails_onfail);
    // Request aspect
    {

      if (0 >= DiagSendReqAndWaitForResp("Engine", __req, __resp, __res, -1, -1, -1, (long)(500), -1, EnumResult_pos, EnumServiceDetails_onfail, EnumSendingMode_physical, EnumSuppressPosResBit_asconfigured, EnumVerdictOnInvalidValues_fail))
        break;
    }

  }
  while(0);


  if (__bVerdict == __eVerdictFail)
    TestReportWriteDiagObjectList();
}
  
void __diagService516bfa5_1(DiagRequest * __req, DiagResponse * __resp )
{
  stack long __tableHandle;
  long __res, __paramLen, __bytePos;

   __bVerdict = __eVerdictPass;

  do {
    TestReportResetDiagObjectList();
    DiagSetReportDetailLevel("Engine", EnumServiceDetails_onfail);
    // Request aspect
    {

      if (0 >= DiagSendReqAndWaitForResp("Engine", __req, __resp, __res, -1, -1, -1, (long)(200), -1, EnumResult_pos, EnumServiceDetails_onfail, EnumSendingMode_physical, EnumSuppressPosResBit_asconfigured, EnumVerdictOnInvalidValues_fail))
        break;
    }

  }
  while(0);


  if (__bVerdict == __eVerdictFail)
    TestReportWriteDiagObjectList();
}
  
void __diagService516bfa5_2(DiagRequest * __req, DiagResponse * __resp )
{
  stack long __tableHandle;
  long __res, __paramLen, __bytePos;

   __bVerdict = __eVerdictPass;

  do {
    TestReportResetDiagObjectList();
    DiagSetReportDetailLevel("Engine", EnumServiceDetails_onfail);
    // Request aspect
    {

      if (0 >= DiagSendReqAndWaitForResp("Engine", __req, __resp, __res, -1, -1, -1, (long)(200), -1, EnumResult_pos, EnumServiceDetails_onfail, EnumSendingMode_physical, EnumSuppressPosResBit_asconfigured, EnumVerdictOnInvalidValues_fail))
        break;
    }

    __res = DiagErrCodeTestStep(__res, "Can't retrieve last response for request! No check possible.") < 0;
    if(__res)
    {
	  __bVerdict = __eVerdictFail;
      break;
    }
  }
  while(0);


  // Response, check & read aspect
  {
    __res = 1;
    __tableHandle = ReportTableHead5Columns(__cCheckCaption, __cTSym, __cTOp, __cRefVal, __cActual, __cRes);
    {
      double __nDiagValue;
      DiagGetParameterErrorHandled(__resp, "Diagnostic_Identification", __nDiagValue);
      __csr = CheckSignalMatch(__nDiagValue, 0x01, "==") == 1;
      snprintf(__cArray, 8192, "%s", "Diagnostic parameter \'Diagnostic_Identification\'");
      snprintf(__cArray2, 8192, "%s", __cArray);
      snprintf(__cArray3, 8192, "%s", "");
      ReportTableRow(__tableHandle, 0, __cArray2, "==", 0x01, __cArray3, __oneOfFlag, __bSetInCheckAlignment);
      ReportCell(__tableHandle, __nDiagValue);
      ReportCellResult(__tableHandle, __csr, __ePassFail);
    
      __res = __res && __csr;
    
    }
    ReportTableEndVerdict(__tableHandle, __cEvaluateResponse, __res);
	__bVerdict = __bVerdict && __res;
  }
  if (__bVerdict == __eVerdictFail)
    TestReportWriteDiagObjectList();
}
  
void __diagService516bfa5_3(DiagRequest * __req, DiagResponse * __resp )
{
  stack long __tableHandle;
  long __res, __paramLen, __bytePos;

   __bVerdict = __eVerdictPass;

  do {
    TestReportResetDiagObjectList();
    DiagSetReportDetailLevel("Engine", EnumServiceDetails_onfail);
    // Request aspect
    {

      if (0 >= DiagSendReqAndWaitForResp("Engine", __req, __resp, __res, -1, -1, -1, (long)(200), -1, EnumResult_pos, EnumServiceDetails_onfail, EnumSendingMode_physical, EnumSuppressPosResBit_asconfigured, EnumVerdictOnInvalidValues_fail))
        break;
    }

    __res = DiagErrCodeTestStep(__res, "Can't retrieve last response for request! No check possible.") < 0;
    if(__res)
    {
	  __bVerdict = __eVerdictFail;
      break;
    }
  }
  while(0);


  // Response, check & read aspect
  {
    __res = 1;
    __tableHandle = ReportTableHead5Columns(__cCheckCaption, __cTSym, __cTOp, __cRefVal, __cActual, __cRes);
    {
      double __nDiagValue;
      DiagGetParameterErrorHandled(__resp, "Serial_Number", __nDiagValue);
      __csr = CheckSignalMatch(__nDiagValue, 3141528, "==") == 1;
      snprintf(__cArray, 8192, "%s", "Diagnostic parameter \'Serial_Number\'");
      snprintf(__cArray2, 8192, "%s", __cArray);
      snprintf(__cArray3, 8192, "%s", "");
      ReportTableRow(__tableHandle, 0, __cArray2, "==", 3141528, __cArray3, __oneOfFlag, __bSetInCheckAlignment);
      ReportCell(__tableHandle, __nDiagValue);
      ReportCellResult(__tableHandle, __csr, __ePassFail);
    
      __res = __res && __csr;
    
    }
    ReportTableEndVerdict(__tableHandle, __cEvaluateResponse, __res);
	__bVerdict = __bVerdict && __res;
  }
  if (__bVerdict == __eVerdictFail)
    TestReportWriteDiagObjectList();
}
  
void __diagService516bfa5_4(DiagRequest * __req, DiagResponse * __resp )
{
  stack long __tableHandle;
  long __res, __paramLen, __bytePos;

   __bVerdict = __eVerdictPass;

  do {
    TestReportResetDiagObjectList();
    DiagSetReportDetailLevel("Engine", EnumServiceDetails_always);
    // Request aspect
    {

      if (0 >= DiagSendReqAndWaitForResp("Engine", __req, __resp, __res, -1, -1, -1, (long)(200), -1, EnumResult_pos, EnumServiceDetails_always, EnumSendingMode_physical, EnumSuppressPosResBit_asconfigured, EnumVerdictOnInvalidValues_fail))
        break;
    }

    __res = DiagErrCodeTestStep(__res, "Can't retrieve last response for request! No check possible.") < 0;
    if(__res)
    {
	  __bVerdict = __eVerdictFail;
      break;
    }
  }
  while(0);


  // Response, check & read aspect
  {
    __res = 1;
    __tableHandle = ReportTableHead5Columns(__cCheckCaption, __cTSym, __cTOp, __cRefVal, __cActual, __cRes);
    {
      DiagGetParameterErrorHandled(__resp, "Code_string.Country_variant", __bDiagValueArray, elcount(__bDiagValueArray), __cDiagValueArray, elcount(__cDiagValueArray));
      {
        int __resOneOf;
        __resOneOf = 0;
        __oneOfFlag = 1;
        {
          CheckCaplGenVarStringBufferConsistency(__cDiagValueArray, 8192);
          snprintf(__cArray, 8192, "%s", __cDiagValueArray);
          CheckLiteralGetStringBufferConsistency("Europe", 8192);
          snprintf(__cArray2, 8192, "%s", "Europe");
          __csr = strncmp(__cArray, __cArray2, 8192) == 0;
          snprintf(__cArray3, 8192, "%s", "Diagnostic parameter \'Code_string.Country_variant\'");
          snprintf(__cArray4, 8192, "%s", __cArray3);
          snprintf(__cArray5, 8192, "%s", "");
          ReportTableRow(__tableHandle, 0, __cArray4, "==", __cArray2, __cArray5, __oneOfFlag, __bSetInCheckAlignment);
          ReportCell(__tableHandle, __cArray);
          ReportCellResult(__tableHandle, __csr, __eTrueFalse);
         
          __resOneOf |= __csr;
          __oneOfFlag = 2;
          CheckCaplGenVarStringBufferConsistency(__cDiagValueArray, 8192);
          snprintf(__cArray, 8192, "%s", __cDiagValueArray);
          CheckLiteralGetStringBufferConsistency("USA", 8192);
          snprintf(__cArray2, 8192, "%s", "USA");
          __csr = strncmp(__cArray, __cArray2, 8192) == 0;
          snprintf(__cArray3, 8192, "%s", "Diagnostic parameter \'Code_string.Country_variant\'");
          snprintf(__cArray4, 8192, "%s", __cArray3);
          snprintf(__cArray5, 8192, "%s", "");
          ReportTableRow(__tableHandle, 0, __cArray4, "==", __cArray2, __cArray5, __oneOfFlag, __bSetInCheckAlignment);
          ReportCell(__tableHandle, __cArray);
          ReportCellResult(__tableHandle, __csr, __eTrueFalse);
         
          __resOneOf |= __csr;
        }
        __csr = __resOneOf;
        __oneOfFlag = 0;
      }
    
      __res = __res && __csr;
    
    }
    {
      DiagGetParameterErrorHandled(__resp, "Code_string.Vehicle_type", __bDiagValueArray, elcount(__bDiagValueArray), __cDiagValueArray, elcount(__cDiagValueArray));
      CheckCaplGenVarStringBufferConsistency(__cDiagValueArray, 8192);
      snprintf(__cArray, 8192, "%s", __cDiagValueArray);
      CheckLiteralGetStringBufferConsistency("Coupe", 8192);
      snprintf(__cArray2, 8192, "%s", "Coupe");
      __csr = strncmp(__cArray, __cArray2, 8192) == 0;
      snprintf(__cArray3, 8192, "%s", "Diagnostic parameter \'Code_string.Vehicle_type\'");
      snprintf(__cArray4, 8192, "%s", __cArray3);
      snprintf(__cArray5, 8192, "%s", "");
      ReportTableRow(__tableHandle, 0, __cArray4, "==", __cArray2, __cArray5, __oneOfFlag, __bSetInCheckAlignment);
      ReportCell(__tableHandle, __cArray);
      ReportCellResult(__tableHandle, __csr, __ePassFail);
    
      __res = __res && __csr;
    
    }
    ReportTableEndVerdict(__tableHandle, __cEvaluateResponse, __res);
	__bVerdict = __bVerdict && __res;
  }
  if (__bVerdict == __eVerdictFail)
    TestReportWriteDiagObjectList();
}
void Tt516bfa5_Tet_Tc4_Completion()
{
  stack long __tableHandle;
  TestCompletionBegin();
  {
    TestCommandBegin(__eDiagService, __cDiagService, "Disable Default Session", "5");
    {
      if (DiagIsFunctionalGroup("Engine"))
      {
        DiagResponse * __resp;
        DiagRequest Engine.STOP_SESSION_Stop __req;
        __diagService516bfa5_1(__req, __resp);
      }
      else
      {
        DiagResponse Engine.* __resp;
        DiagRequest Engine.STOP_SESSION_Stop __req;
        __diagService516bfa5_1(__req, __resp);
      }
    }
    TestCommandEnd();


  }
  TestCompletionEnd();
}

void Tt516bfa5_Tet_Tc5()
{
  CreateTTEIFFunction("Tt516bfa5_Tc5", __eTcDef, __eLocal);  
  CallInterfaceFunction("Clear / basically check fault memory", __cEmpty , __cEmpty );
}
testcase Tt516bfa5_Tc5()
{
  stack long __tableHandle;
  SetBreakOnFail(1);

    
  TestCommandBegin(__eFaultMemoryStatus, __cFaultMemoryStatus, "Number of DTCs >= 0", "0");
  {
    long  __res;
    DWORD __statusByte;
    
    __bVerdict = __eVerdictPass;
    DiagSetReportDetailLevel("Engine", EnumServiceDetails_always);
    TestStep("Query fault memory", "Checking status of fault memory for Diagnostic ECU  'Engine'");
  
    __statusByte = 0 | 1 | 8;
  
    __res = TestWaitForDiagTroubleCodes("Engine", __statusByte, cDiagAppTimeoutDefault);
    if(__EvaluateWaitResWithVerdict("Engine", __res, 1))
    {
      long __dtcCount;
  	  
      __dtcCount = DiagGetDTCCount("Engine");
      if(__dtcCount >= 0)
      {
        __tableHandle = ReportTableHead5Columns("Check received number of relevant DTCs", __cTSym, __cTOp, __cRefVal, __cActual, __cRes);
        __csr = CheckSignalMatch(__dtcCount, 0, ">=") == 1;
        snprintf(__cArray, 8192, "%s", "Expected number of DTCs");
        snprintf(__cArray2, 8192, "%s", __cArray);
        snprintf(__cArray3, 8192, "%s", "");
        ReportTableRow(__tableHandle, 0, __cArray2, ">=", 0, __cArray3, __oneOfFlag, __bSetInCheckAlignment);
        ReportCell(__tableHandle, __dtcCount);
        ReportCellResult(__tableHandle, __csr, __ePassFail);
  
        ReportTableEndVerdict(__tableHandle, __cEmpty, __csr);
        __bVerdict = __bVerdict && __csr;
      }
  
      TestReportWriteFaultMemoryDetails("Engine", __bVerdict);
    }
  }
  TestCommandEnd();


  TestCommandBegin(__eFaultMemoryClear, __cFaultMemoryClear, "Clear all DTCs", "1");
  {
    long __res;
    long __dtc;
    
    DiagSetReportDetailLevel("Engine", EnumServiceDetails_onfail);
    TestStep("Query fault memory", "Clearing fault memory of target Diagnostic ECU 'Engine'");
  
    __res = TestWaitForDiagTroubleCodesCleared("Engine", -1, cDiagAppTimeoutDefault);
    if (__EvaluateWaitResWithVerdict("Engine", __res, 1, "DTC cleared successfully"))
      TestReportWriteFaultMemoryDetails("Engine", __bVerdict); }
  TestCommandEnd();


    
  TestCommandBegin(__eFaultMemoryStatus, __cFaultMemoryStatus, "Number of DTCs == 0", "2");
  {
    long  __res;
    DWORD __statusByte;
    
    __bVerdict = __eVerdictPass;
    DiagSetReportDetailLevel("Engine", EnumServiceDetails_onfail);
    TestStep("Query fault memory", "Checking status of fault memory for Diagnostic ECU  'Engine'");
  
    __statusByte = 0 | 1 | 8;
  
    __res = TestWaitForDiagTroubleCodes("Engine", __statusByte, cDiagAppTimeoutDefault);
    if(__EvaluateWaitResWithVerdict("Engine", __res, 1))
    {
      long __dtcCount;
  	  
      __dtcCount = DiagGetDTCCount("Engine");
      if(__dtcCount >= 0)
      {
        __tableHandle = ReportTableHead5Columns("Check received number of relevant DTCs", __cTSym, __cTOp, __cRefVal, __cActual, __cRes);
        __csr = CheckSignalMatch(__dtcCount, 0, "==") == 1;
        snprintf(__cArray, 8192, "%s", "Expected number of DTCs");
        snprintf(__cArray2, 8192, "%s", __cArray);
        snprintf(__cArray3, 8192, "%s", "");
        ReportTableRow(__tableHandle, 0, __cArray2, "==", 0, __cArray3, __oneOfFlag, __bSetInCheckAlignment);
        ReportCell(__tableHandle, __dtcCount);
        ReportCellResult(__tableHandle, __csr, __ePassFail);
  
        ReportTableEndVerdict(__tableHandle, __cEmpty, __csr);
        __bVerdict = __bVerdict && __csr;
      }
  
      TestReportWriteFaultMemoryDetails("Engine", __bVerdict);
    }
  }
  TestCommandEnd();


}

void Tt516bfa5_Tet_Tc6()
{
  CreateTTEIFFunction("Tt516bfa5_Tc6", __eTcDef, __eLocal);  
  CallInterfaceFunction("Stop Engine", __cEmpty , __cEmpty );
}
testcase Tt516bfa5_Tc6()
{
  stack long __tableHandle;
dword __h3;

  SetBreakOnFail(1);

  TestPreparationBegin();
  {
    TestCommandBegin(__eWait, __cWait, "", "0");
    {
      Wait("1", (5000 * 1000000LL), 1000000, "");
    }
    TestCommandEnd();

    TestCommandBegin(__eSet, __cSet, "Stop engine", "1");
    {
      __tableHandle = ReportTableHead3Columns(__cSetCaption , __cTSym, __cTOp, __cAssigned); 
      {
        @sysvarInt::`IL::`IgnitionSwitch = 0;
        snprintf(__cArray, 8192, "%s", "IgnitionSwitch");
        snprintf(__cArray2, 8192, "%s '%s'", __cSysVar, __cArray);
        snprintf(__cArray3, 8192, "%s", "");
        
        ReportTableRow(__tableHandle, 0, __cArray2, __cAOp, 0, __cArray3, __oneOfFlag, __bSetInCheckAlignment);
        
    
      }
      ReportTableEndTestStep(__tableHandle, "1");
    }
    TestCommandEnd();


    TestCommandBegin(__eWait, __cWait, "", "2");
    {
      Wait("1", (1000 * 1000000LL), 1000000, "");
    }
    TestCommandEnd();

  }
  TestPreparationEnd();

  if(SetBusContextByName("PowerTrain", __eSaveCurrent, __nBusContextNew, __nBusContextOld))
  {
    ChkConfig_SetPrecision(3);
    __h3 = ChkCreate_NodeBabblingNS(`PowerTrain::dbNode::`Engine, 8 * 1000000000LL);
    ChkConfig_SetPrecision(3);
  }
  if (ChkQuery_Valid(__h3) > 0)
  {
    ChkConfig_SetTitle(__h3, "");
    TestAddCondition(__h3);
    ChkControl_Start(__h3, "3");
  }
  ResetBusContext(__nBusContextNew, __nBusContextOld);


  TestCommandBegin(__eWait, __cWait, "Wait for 10 seconds", "4");
  {
    Wait("1", (10 * 1000000000LL), 1000000000, "");
  }
  TestCommandEnd();

}

void Tt516bfa5_Tet_Tc7()
{
  CreateTTEIFFunction("Tt516bfa5_Tc7", __eTcDef, __eLocal);  
  CallInterfaceFunction("Wake Up for a short time", __cEmpty , __cEmpty );
}
testcase Tt516bfa5_Tc7()
{
  stack long __tableHandle;
dword __h4;

  SetBreakOnFail(1);

  if(SetBusContextByName("PowerTrain", __eSaveCurrent, __nBusContextNew, __nBusContextOld))
  {
    ChkConfig_SetPrecision(3);
    __h4 = ChkCreate_NodeDeadNS(`PowerTrain::dbNode::`Engine, 2000 * 1000000LL);
    ChkConfig_SetPrecision(3);
  }
  if (ChkQuery_Valid(__h4) > 0)
  {
    ChkConfig_SetTitle(__h4, "");
    TestAddCondition(__h4);
    ChkControl_Start(__h4, "0");
  }
  ResetBusContext(__nBusContextNew, __nBusContextOld);


  TestCommandBegin(__eSet, __cSet, "Wake up node Engine", "1");
  {
    __tableHandle = ReportTableHead3Columns(__cSetCaption , __cTSym, __cTOp, __cAssigned); 
    {
      @sysvarInt::`_NMControl::`PowerTrain::`StateControl::`BusRequestAll = 1;
      snprintf(__cArray, 8192, "%s", "PowerTrain::StateControl::BusRequestAll");
      snprintf(__cArray2, 8192, "%s '%s'", __cSysVar, __cArray);
      snprintf(__cArray3, 8192, "%s", "");
      
      ReportTableRow(__tableHandle, 0, __cArray2, __cAOp, 1, __cArray3, __oneOfFlag, __bSetInCheckAlignment);
      
  
    }
    ReportTableEndTestStep(__tableHandle, "1");
  }
  TestCommandEnd();


  TestCommandBegin(__eWait, __cWait, "", "2");
  {
    Wait("1", (500 * 1000000LL), 1000000, "");
  }
  TestCommandEnd();

  TestCommandBegin(__eSet, __cSet, "Reset Wake Up Signal", "3");
  {
    __tableHandle = ReportTableHead3Columns(__cSetCaption , __cTSym, __cTOp, __cAssigned); 
    {
      @sysvarInt::`_NMControl::`PowerTrain::`StateControl::`BusRequestAll = 0;
      snprintf(__cArray, 8192, "%s", "PowerTrain::StateControl::BusRequestAll");
      snprintf(__cArray2, 8192, "%s '%s'", __cSysVar, __cArray);
      snprintf(__cArray3, 8192, "%s", "");
      
      ReportTableRow(__tableHandle, 0, __cArray2, __cAOp, 0, __cArray3, __oneOfFlag, __bSetInCheckAlignment);
      
  
    }
    ReportTableEndTestStep(__tableHandle, "1");
  }
  TestCommandEnd();


  TestCommandBegin(__eWait, __cWait, "Wait for 3 seconds", "4");
  {
    Wait("1", (3 * 1000000000LL), 1000000000, "");
  }
  TestCommandEnd();

}

void Tt516bfa5_Tet_Tc8()
{
  CreateTTEIFFunction("Tt516bfa5_Tc8", __eTcDef, __eLocal);  
  CallInterfaceFunction("Goes to sleep after a short time", __cEmpty , __cEmpty );
}
testcase Tt516bfa5_Tc8()
{
  stack long __tableHandle;
dword __h5;

  SetBreakOnFail(1);

  if(SetBusContextByName("PowerTrain", __eSaveCurrent, __nBusContextNew, __nBusContextOld))
  {
    ChkConfig_SetPrecision(3);
    __h5 = ChkCreate_NodeBabblingNS(`PowerTrain::dbNode::`Engine, 8 * 1000000000LL);
    ChkConfig_SetPrecision(3);
  }
  if (ChkQuery_Valid(__h5) > 0)
  {
    ChkConfig_SetTitle(__h5, "");
    TestAddCondition(__h5);
    ChkControl_Start(__h5, "0");
  }
  ResetBusContext(__nBusContextNew, __nBusContextOld);


  TestCommandBegin(__eWait, __cWait, "Wait for 10 seconds", "1");
  {
    Wait("1", (10 * 1000000000LL), 1000000000, "");
  }
  TestCommandEnd();

}

