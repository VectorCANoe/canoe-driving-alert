/* !Encoding: 65001  */
includes
{
  #include "__VariablesLib.cin"
  #include "__CaplGeneratorLib.cin"
  #include "__CANoeReportFuntionsLib.cin"
}

variables
{
  // Global variables defined within this CAPL file
}

void Ttsv2hgsd_Tet_TtInit()
{
  stack long __tableHandle;
}

void Ttsv2hgsd_Tet_Tf_Preparation0()
{
  stack long __tableHandle;
  TestPreparationBegin();
  {
    {
      CreateCaplIFFunction("car_preparation", __eTestFct);
      CallInterfaceFunction("car_preparation ()", __cEmpty, __cEmpty);
    }


  }
  TestPreparationEnd();
}


void Ttsv2hgsd_Tet_CaplTcCall0()
{
  stack long __tableHandle;
  CreateCaplIFFunction("DiagTestCase", __eTcDef);
  CallInterfaceFunction(__cEmpty , "", __cEmpty );
}

void Ttsv2hgsd_Tet_CaplTcCall1()
{
  stack long __tableHandle;
  CreateCaplIFFunction("CheckMsgABSData", __eTcDef);
  CallInterfaceFunction(__cEmpty , "", __cEmpty );
}

void Ttsv2hgsd_Tet_CaplTcCall2()
{
  stack long __tableHandle;
  CreateCaplIFFunction("CheckMsgGearBoxInfo", __eTcDef);
  CallInterfaceFunction(__cEmpty , "", __cEmpty );
}

void Ttsv2hgsd_Tet_CaplTcCall3()
{
  stack long __tableHandle;
  CreateCaplIFFunction("CheckMsgEngineData", __eTcDef);
  CallInterfaceFunction(__cEmpty , "", __cEmpty );
}

void Ttsv2hgsd_Tet_CaplTcCall4()
{
  stack long __tableHandle;
  CreateCaplIFFunction("CheckUndefinedMessage", __eTcDef);
  AddIFParameterInt(0);
  CallInterfaceFunction(__cEmpty , "", __cEmpty );
}

void Ttsv2hgsd_Tet_CaplTcCall5()
{
  stack long __tableHandle;
  CreateCaplIFFunction("CheckUndefinedMessage", __eTcDef);
  AddIFParameterInt(1);
  CallInterfaceFunction(__cEmpty , "", __cEmpty );
}

