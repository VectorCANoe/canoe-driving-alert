/*@!Encoding:1252*/
variables
{
  int flag = 1;
}

on start
{  
  dword mNewPage; // Sink identifier 

  //Create a Instruction page at the write window
  mNewPage= writeCreate("Logging Instruction");

  //Clear content of CAPL page
  writeclear(1);

  //Show the description of the program
  writeLineEx(mNewPage,1,"Logging is disabled by default. Enable it first in the measurement setup. Then you can interact with the logging as follows:");
  writeLineEx(mNewPage,1,"Press <1> to continue logging");
  writeLineEx(mNewPage,1,"Press <2> to interrupt logging");
  
  stoplogging("Logging",0);
}

on message *
{
  output(this); 
}

on key '1'
{

  if(flag==0)
  {
    flag=1;
    write("Logging starts");
    //start logging Log CAN1 with a pretrigger with 500ms
    startlogging("Logging",0);
  }
//  else 
//  {
//    flag=0;
//    write("Comfort logging ends");
//    //stop logging Log CAN1 with a posttrigger with 1000ms
//    stoplogging("Log CAN1",1000);
//  }   
}

on key '2'
{

  if(flag==1)
  {
    flag=0;
    write("Logging ends");
    //stop logging Log CAN2 with a posttrigger with 1000ms
    stoplogging("Logging",0);  
  }  
}

