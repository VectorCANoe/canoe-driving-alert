includes
{
  // Import required CAPL include files
  //--- begin generated part --- Block start #GlobalBody_Includes#; do not delete this line and do not add application code in this code block!
  /* #ChannelGlobalStart# |CAN1| #BusGlobalStart# |PowerTrain| */
  /* #ChannelGlobalEnd# |CAN1| #BusGlobalEnd# |PowerTrain| */
  //--- end generated part --- Block end #GlobalBody_Includes#; do not delete this line! Add application code below this line.
  //--- begin generated part --- Block start #Body_Includes#; do not delete this line and do not add application code in this code block!
  /* #ChannelStart# |CAN1| #BusStart# |PowerTrain| */
  #include "..\CAPL\PDU-IL-KL30-Helper_CAN1.cin"
  #include "..\CAPL\PDU-NM-Panel-Helper_CAN1.cin"
  #include "..\CAPL\PDU-NM-ASR-Helper_CAN1.cin"
  /* #ChannelEnd# |CAN1| #BusEnd# |PowerTrain| */
  /* #ChannelStart# |CAN2| #BusStart# |Comfort| */
  #include "..\CAPL\PDU-IL-KL30-Helper_CAN2.cin"
  #include "..\CAPL\PDU-NM-Panel-Helper_CAN2.cin"
  #include "..\CAPL\PDU-NM-ASR-Helper_CAN2.cin"
  /* #ChannelEnd# |CAN2| #BusEnd# |Comfort| */
  //--- end generated part --- Block end #Body_Includes#; do not delete this line! Add application code below this line.
}

variables
{
  // Define global variables for this CAPL file

  /*--- #GenHeader Begin# --- begin generated comment ---
  | Generated on Wednesday, November 06, 2024, 12:57:19
  | By ModelGenerator for Vector 4.7.5, ModelGeneratorVectorDLL 4.7.5
  | Package Vector 4.0.79
  | Vector Modeling Components Addon 4.0.79
  | Target Bus: PowerTrain; Channel: CAN1; DB Cluster: PowerTrain;
  | From Database: PowerTrain_FD.arxml
  | CANoe Version 18.3.118.0
  | 
  | Extended on Wednesday, November 06, 2024, 12:59:23
  | By ModelGenerator for Vector 4.7.5, ModelGeneratorVectorDLL 4.7.5
  | Package Vector 4.0.79
  | Vector Modeling Components Addon 4.0.79
  | Target Bus: Comfort; Channel: CAN2; DB Cluster: Comfort;
  | From Database: Comfort_FD_2021_12_1.arxml
  | CANoe Version 18.3.118.0
    --- #GenHeader End  # --- end generated comment --- */

  char gECU[256] = "VectorSimulationNode";
  //--- begin generated part --- Block start #Hdr_GlobalVariables#; do not delete this line and do not add application code in this code block!
  /* #ChannelStart# |CAN1| #BusStart# |PowerTrain| */
  /* #ChannelEnd# |CAN1| #BusEnd# |PowerTrain| */
  //--- end generated part --- Block end #Hdr_GlobalVariables#; do not delete this line! Add application code below this line.
  //--- begin generated part --- Block start #GlobalBody_GlobalVariables#; do not delete this line and do not add application code in this code block!
  /* #ChannelGlobalStart# |CAN1| #BusGlobalStart# |PowerTrain| */
  /* #ChannelGlobalEnd# |CAN1| #BusGlobalEnd# |PowerTrain| */
  //--- end generated part --- Block end #GlobalBody_GlobalVariables#; do not delete this line! Add application code below this line.
  //--- begin generated part --- Block start #Body_GlobalVariables#; do not delete this line and do not add application code in this code block!
  /* #ChannelStart# |CAN1| #BusStart# |PowerTrain| */
  char gCAN1BusName[256] = "PowerTrain";
  int gCAN1Channel = 1; // The channel the bus is attached to
  int gCAN1TXEnable = 1; // enable/disable TX of application messages

  long gCAN1DisturbanceMode;
  long gCAN1DisturbanceCount;
  long gCAN1DisturbanceValue;
  long gCAN1DisturbanceContinueMode;
  double gCAN1DisturbancePeriod;
  qword gCAN1DisturbanceValue64;
  /* #ChannelEnd# |CAN1| #BusEnd# |PowerTrain| */
  /* #ChannelStart# |CAN2| #BusStart# |Comfort| */
  char gCAN2BusName[256] = "Comfort";
  int gCAN2Channel = 2; // The channel the bus is attached to
  int gCAN2TXEnable = 1; // enable/disable TX of application messages

  long gCAN2DisturbanceMode;
  long gCAN2DisturbanceCount;
  long gCAN2DisturbanceValue;
  long gCAN2DisturbanceContinueMode;
  double gCAN2DisturbancePeriod;
  qword gCAN2DisturbanceValue64;
  /* #ChannelEnd# |CAN2| #BusEnd# |Comfort| */
  //--- end generated part --- Block end #Body_GlobalVariables#; do not delete this line! Add application code below this line.
}

on preStart
{
  // Initialize CAPL includes and node's modules/DLLs
  //--- begin generated part --- Block start #Hdr_OnInit#; do not delete this line and do not add application code in this code block!
  /* #ChannelStart# |CAN1| #BusStart# |PowerTrain| */
  /* #ChannelEnd# |CAN1| #BusEnd# |PowerTrain| */
  //--- end generated part --- Block end #Hdr_OnInit#; do not delete this line! Add application code below this line.
  //--- begin generated part --- Block start #GlobalBody_OnInit#; do not delete this line and do not add application code in this code block!
  /* #ChannelGlobalStart# |CAN1| #BusGlobalStart# |PowerTrain| */
  /* #ChannelGlobalEnd# |CAN1| #BusGlobalEnd# |PowerTrain| */
  //--- end generated part --- Block end #GlobalBody_OnInit#; do not delete this line! Add application code below this line.
  //--- begin generated part --- Block start #Body_OnInit#; do not delete this line and do not add application code in this code block!
  /* #ChannelStart# |CAN1| #BusStart# |PowerTrain| */
  ILCAN1_OnInit();
  NMCAN1_OnInit();
  /* #ChannelEnd# |CAN1| #BusEnd# |PowerTrain| */
  /* #ChannelStart# |CAN2| #BusStart# |Comfort| */
  ILCAN2_OnInit();
  NMCAN2_OnInit();
  /* #ChannelEnd# |CAN2| #BusEnd# |Comfort| */
  //--- end generated part --- Block end #Body_OnInit#; do not delete this line! Add application code below this line.
}

on start
{
  // Start CAPL includes and node's modules/DLLs
  //--- begin generated part --- Block start #Hdr_OnStart#; do not delete this line and do not add application code in this code block!
  /* #ChannelStart# |CAN1| #BusStart# |PowerTrain| */
  /* #ChannelEnd# |CAN1| #BusEnd# |PowerTrain| */
  //--- end generated part --- Block end #Hdr_OnStart#; do not delete this line! Add application code below this line.
  //--- begin generated part --- Block start #GlobalBody_OnStart#; do not delete this line and do not add application code in this code block!
  /* #ChannelGlobalStart# |CAN1| #BusGlobalStart# |PowerTrain| */
  /* #ChannelGlobalEnd# |CAN1| #BusGlobalEnd# |PowerTrain| */
  //--- end generated part --- Block end #GlobalBody_OnStart#; do not delete this line! Add application code below this line.
  //--- begin generated part --- Block start #Body_OnStart#; do not delete this line and do not add application code in this code block!
  /* #ChannelStart# |CAN1| #BusStart# |PowerTrain| */
  ILCAN1_OnStart();
  NMCAN1_OnStart();
  if (@sysvar::NM_CAN1::NODES::N_VectorSimulationNode::DeactivateNM == 0)
  {
    NMCAN1_PassiveBusStart();
  }
  /* #ChannelEnd# |CAN1| #BusEnd# |PowerTrain| */
  /* #ChannelStart# |CAN2| #BusStart# |Comfort| */
  ILCAN2_OnStart();
  NMCAN2_OnStart();
  if (@sysvar::NM_CAN2::NODES::N_VectorSimulationNode::DeactivateNM == 0)
  {
    NMCAN2_PassiveBusStart();
  }
  /* #ChannelEnd# |CAN2| #BusEnd# |Comfort| */
  //--- end generated part --- Block end #Body_OnStart#; do not delete this line! Add application code below this line.
}

on preStop
{
  // Prepare stopping
  //--- begin generated part --- Block start #Hdr_OnStopping#; do not delete this line and do not add application code in this code block!
  /* #ChannelStart# |CAN1| #BusStart# |PowerTrain| */
  /* #ChannelEnd# |CAN1| #BusEnd# |PowerTrain| */
  //--- end generated part --- Block end #Hdr_OnStopping#; do not delete this line! Add application code below this line.
  //--- begin generated part --- Block start #GlobalBody_OnStopping#; do not delete this line and do not add application code in this code block!
  /* #ChannelGlobalStart# |CAN1| #BusGlobalStart# |PowerTrain| */
  /* #ChannelGlobalEnd# |CAN1| #BusGlobalEnd# |PowerTrain| */
  //--- end generated part --- Block end #GlobalBody_OnStopping#; do not delete this line! Add application code below this line.
  //--- begin generated part --- Block start #Body_OnStopping#; do not delete this line and do not add application code in this code block!
  /* #ChannelStart# |CAN1| #BusStart# |PowerTrain| */
  /* #ChannelEnd# |CAN1| #BusEnd# |PowerTrain| */
  //--- end generated part --- Block end #Body_OnStopping#; do not delete this line! Add application code below this line.
}

on stopMeasurement
{
  // Stop actions
  //--- begin generated part --- Block start #Hdr_OnStop#; do not delete this line and do not add application code in this code block!
  /* #ChannelStart# |CAN1| #BusStart# |PowerTrain| */
  /* #ChannelEnd# |CAN1| #BusEnd# |PowerTrain| */
  //--- end generated part --- Block end #Hdr_OnStop#; do not delete this line! Add application code below this line.
  //--- begin generated part --- Block start #GlobalBody_OnStop#; do not delete this line and do not add application code in this code block!
  /* #ChannelGlobalStart# |CAN1| #BusGlobalStart# |PowerTrain| */
  /* #ChannelGlobalEnd# |CAN1| #BusGlobalEnd# |PowerTrain| */
  //--- end generated part --- Block end #GlobalBody_OnStop#; do not delete this line! Add application code below this line.
  //--- begin generated part --- Block start #Body_OnStop#; do not delete this line and do not add application code in this code block!
  /* #ChannelStart# |CAN1| #BusStart# |PowerTrain| */
  /* #ChannelEnd# |CAN1| #BusEnd# |PowerTrain| */
  //--- end generated part --- Block end #Body_OnStop#; do not delete this line! Add application code below this line.
}

void StartSim(dword busContext, int busActive, int mode)
{
  // Called when ... due to ...
  //   mode == 1: ILControlResume
  //   mode == 2: ILControlStart
  //   mode == 3: ILControlSimulationOn
  //--- begin generated part --- Block start #Hdr_StartSim#; do not delete this line and do not add application code in this code block!
  /* #ChannelStart# |CAN1| #BusStart# |PowerTrain| */
  /* #ChannelEnd# |CAN1| #BusEnd# |PowerTrain| */
  //--- end generated part --- Block end #Hdr_StartSim#; do not delete this line! Add application code below this line.
  //write("[%.6f %NODE_NAME%] StartSim(0x%X, %d, %d)", TimeNowNS()/1e9, busContext, busActive, mode);
  //--- begin generated part --- Block start #Body_StartSim#; do not delete this line and do not add application code in this code block!
  /* #ChannelStart# |CAN1| #BusStart# |PowerTrain| */
  /* #ChannelEnd# |CAN1| #BusEnd# |PowerTrain| */
  //--- end generated part --- Block end #Body_StartSim#; do not delete this line! Add application code below this line.
}

void StopSim(dword busContext, int busActive, int mode)
{
  // Called when ... due to ...
  //   mode == 1: ILControlWait
  //   mode == 2: ILControlStop
  //   mode == 3: ILControlSimulationOff
  //--- begin generated part --- Block start #Hdr_StopSim#; do not delete this line and do not add application code in this code block!
  /* #ChannelStart# |CAN1| #BusStart# |PowerTrain| */
  /* #ChannelEnd# |CAN1| #BusEnd# |PowerTrain| */
  //--- end generated part --- Block end #Hdr_StopSim#; do not delete this line! Add application code below this line.
  //write("[%.6f %NODE_NAME%] StopSim(0x%X, %d, %d)", TimeNowNS()/1e9, busContext, busActive, mode);
  //--- begin generated part --- Block start #Body_StopSim#; do not delete this line and do not add application code in this code block!
  /* #ChannelStart# |CAN1| #BusStart# |PowerTrain| */
  /* #ChannelEnd# |CAN1| #BusEnd# |PowerTrain| */
  //--- end generated part --- Block end #Body_StopSim#; do not delete this line! Add application code below this line.
}

on sysvar_update sysvar::IL::Klemme15
{
  // Handle system state variable
  //--- begin generated part --- Block start #Hdr_KL15_Klemme15#; do not delete this line and do not add application code in this code block!
  /* #ChannelStart# |CAN1| #BusStart# |PowerTrain| */
  /* #ChannelEnd# |CAN1| #BusEnd# |PowerTrain| */
  //--- end generated part --- Block end #Hdr_KL15_Klemme15#; do not delete this line! Add application code below this line.
  //--- begin generated part --- Block start #Body_KL15_Klemme15#; do not delete this line and do not add application code in this code block!
  /* #ChannelStart# |CAN1| #BusStart# |PowerTrain| */
  ILCAN1_OnEnvKlemme15(@this);
  /* #ChannelEnd# |CAN1| #BusEnd# |PowerTrain| */
  /* #ChannelStart# |CAN2| #BusStart# |Comfort| */
  ILCAN2_OnEnvKlemme15(@this);
  /* #ChannelEnd# |CAN2| #BusEnd# |Comfort| */
  //--- end generated part --- Block end #Body_KL15_Klemme15#; do not delete this line! Add application code below this line.
}

on sysvar_update sysvar::IL::Klemme30
{
  // Handle system state variable
  //--- begin generated part --- Block start #Hdr_KL30_Klemme30#; do not delete this line and do not add application code in this code block!
  /* #ChannelStart# |CAN1| #BusStart# |PowerTrain| */
  /* #ChannelEnd# |CAN1| #BusEnd# |PowerTrain| */
  //--- end generated part --- Block end #Hdr_KL30_Klemme30#; do not delete this line! Add application code below this line.
  //--- begin generated part --- Block start #Body_KL30_Klemme30#; do not delete this line and do not add application code in this code block!
  /* #ChannelStart# |CAN1| #BusStart# |PowerTrain| */
  ILCAN1_OnEnvKlemme30(@this);
  /* #ChannelEnd# |CAN1| #BusEnd# |PowerTrain| */
  /* #ChannelStart# |CAN2| #BusStart# |Comfort| */
  ILCAN2_OnEnvKlemme30(@this);
  /* #ChannelEnd# |CAN2| #BusEnd# |Comfort| */
  //--- end generated part --- Block end #Body_KL30_Klemme30#; do not delete this line! Add application code below this line.
}

dword applPDUILTxPending(dword busContext, dword shortId, dword longId, char name[], dword& aPDULength, byte data[])
{
  dword ret = 1;
  //--- begin generated part --- Block start #Hdr_applPDUILTxPending#; do not delete this line and do not add application code in this code block!
  /* #ChannelStart# |CAN1| #BusStart# |PowerTrain| */
  /* #ChannelEnd# |CAN1| #BusEnd# |PowerTrain| */
  //--- end generated part --- Block end #Hdr_applPDUILTxPending#; do not delete this line! Add application code below this line.
  //write("[%.6f %NODE_NAME%] applPDUILTxPending(0x%X, 0x%X, 0x%X, %s, %d, %d)", TimeNowNS()/1e9, busContext, shortId, longId, name, aPDULength, elcount(data));
  //--- begin generated part --- Block start #Body_applPDUILTxPending#; do not delete this line and do not add application code in this code block!
  /* #ChannelStart# |CAN1| #BusStart# |PowerTrain| */
  /* #ChannelEnd# |CAN1| #BusEnd# |PowerTrain| */
  //--- end generated part --- Block end #Body_applPDUILTxPending#; do not delete this line! Add application code below this line.
  return ret;
}

dword applPDUILStart(dword busContext, dword busActive, dword mode)
{
  dword ret = 1;
  //--- begin generated part --- Block start #Hdr_applPDUILStart#; do not delete this line and do not add application code in this code block!
  /* #ChannelStart# |CAN1| #BusStart# |PowerTrain| */
  /* #ChannelEnd# |CAN1| #BusEnd# |PowerTrain| */
  //--- end generated part --- Block end #Hdr_applPDUILStart#; do not delete this line! Add application code below this line.
  //write("[%.6f %NODE_NAME%] applPDUILStart(0x%X, %d, %d)", TimeNowNS()/1e9, busContext, busActive, mode);
  //--- begin generated part --- Block start #Body_applPDUILStart#; do not delete this line and do not add application code in this code block!
  /* #ChannelStart# |CAN1| #BusStart# |PowerTrain| */
  /* #ChannelEnd# |CAN1| #BusEnd# |PowerTrain| */
  //--- end generated part --- Block end #Body_applPDUILStart#; do not delete this line! Add application code below this line.
  //--- begin generated part --- Block start #Footer_applPDUILStart#; do not delete this line and do not add application code in this code block!
  /* #ChannelStart# |CAN1| #BusStart# |PowerTrain| */
  StartSim(busContext, busActive, mode);
  /* #ChannelEnd# |CAN1| #BusEnd# |PowerTrain| */
  //--- end generated part --- Block end #Footer_applPDUILStart#; do not delete this line! Add application code below this line.
  return ret;
}

dword applPDUILStop(dword busContext, dword busActive, dword mode)
{
  dword ret = 1;
  //--- begin generated part --- Block start #Hdr_applPDUILStop#; do not delete this line and do not add application code in this code block!
  /* #ChannelStart# |CAN1| #BusStart# |PowerTrain| */
  /* #ChannelEnd# |CAN1| #BusEnd# |PowerTrain| */
  //--- end generated part --- Block end #Hdr_applPDUILStop#; do not delete this line! Add application code below this line.
  //write("[%.6f %NODE_NAME%] applPDUILStop(0x%X, %d, %d)", TimeNowNS()/1e9, busContext, busActive, mode);
  //--- begin generated part --- Block start #Body_applPDUILStop#; do not delete this line and do not add application code in this code block!
  /* #ChannelStart# |CAN1| #BusStart# |PowerTrain| */
  StopSim(busContext, busActive, mode);
  /* #ChannelEnd# |CAN1| #BusEnd# |PowerTrain| */
  //--- end generated part --- Block end #Body_applPDUILStop#; do not delete this line! Add application code below this line.
  //--- begin generated part --- Block start #Footer_applPDUILStop#; do not delete this line and do not add application code in this code block!
  /* #ChannelStart# |CAN1| #BusStart# |PowerTrain| */
  /* #ChannelEnd# |CAN1| #BusEnd# |PowerTrain| */
  //--- end generated part --- Block end #Footer_applPDUILStop#; do not delete this line! Add application code below this line.
  return ret;
}

void Nm_NetworkStartInd()
{
  // Callback of CAN AUTOSAR NM DLL
  dword lBusContext;
  //--- begin generated part --- Block start #Hdr_Nm_NetworkStartInd#; do not delete this line and do not add application code in this code block!
  /* #ChannelStart# |CAN1| #BusStart# |PowerTrain| */
  /* #ChannelEnd# |CAN1| #BusEnd# |PowerTrain| */
  //--- end generated part --- Block end #Hdr_Nm_NetworkStartInd#; do not delete this line! Add application code below this line.
  lBusContext = GetBusContext();
  //--- begin generated part --- Block start #Body_Nm_NetworkStartInd#; do not delete this line and do not add application code in this code block!
  /* #ChannelStart# |CAN1| #BusStart# |PowerTrain| */
  if (lBusContext == gNMCAN1_BusContext) NMCAN1_IndNetworkStart();
  /* #ChannelEnd# |CAN1| #BusEnd# |PowerTrain| */
  /* #ChannelStart# |CAN2| #BusStart# |Comfort| */
  if (lBusContext == gNMCAN2_BusContext) NMCAN2_IndNetworkStart();
  /* #ChannelEnd# |CAN2| #BusEnd# |Comfort| */
  //--- end generated part --- Block end #Body_Nm_NetworkStartInd#; do not delete this line! Add application code below this line.
  SetBusContext(lBusContext);
}

void Nm_NetworkModeInd()
{
  // Callback of CAN AUTOSAR NM DLL
  dword lBusContext;
  //--- begin generated part --- Block start #Hdr_Nm_NetworkModeInd#; do not delete this line and do not add application code in this code block!
  /* #ChannelStart# |CAN1| #BusStart# |PowerTrain| */
  /* #ChannelEnd# |CAN1| #BusEnd# |PowerTrain| */
  //--- end generated part --- Block end #Hdr_Nm_NetworkModeInd#; do not delete this line! Add application code below this line.
  lBusContext = GetBusContext();
  //--- begin generated part --- Block start #Body_Nm_NetworkModeInd#; do not delete this line and do not add application code in this code block!
  /* #ChannelStart# |CAN1| #BusStart# |PowerTrain| */
  if (lBusContext == gNMCAN1_BusContext) NMCAN1_IndNetworkMode();
  /* #ChannelEnd# |CAN1| #BusEnd# |PowerTrain| */
  /* #ChannelStart# |CAN2| #BusStart# |Comfort| */
  if (lBusContext == gNMCAN2_BusContext) NMCAN2_IndNetworkMode();
  /* #ChannelEnd# |CAN2| #BusEnd# |Comfort| */
  //--- end generated part --- Block end #Body_Nm_NetworkModeInd#; do not delete this line! Add application code below this line.
  SetBusContext(lBusContext);
}

void Nm_NetworkTimeoutInd()
{
  // Callback of CAN AUTOSAR NM DLL
  dword lBusContext;
  //--- begin generated part --- Block start #Hdr_Nm_NetworkTimeoutInd#; do not delete this line and do not add application code in this code block!
  /* #ChannelStart# |CAN1| #BusStart# |PowerTrain| */
  /* #ChannelEnd# |CAN1| #BusEnd# |PowerTrain| */
  //--- end generated part --- Block end #Hdr_Nm_NetworkTimeoutInd#; do not delete this line! Add application code below this line.
  lBusContext = GetBusContext();
  //--- begin generated part --- Block start #Body_Nm_NetworkTimeoutInd#; do not delete this line and do not add application code in this code block!
  /* #ChannelStart# |CAN1| #BusStart# |PowerTrain| */
  if (lBusContext == gNMCAN1_BusContext) NMCAN1_IndNetworkTimeout();
  /* #ChannelEnd# |CAN1| #BusEnd# |PowerTrain| */
  /* #ChannelStart# |CAN2| #BusStart# |Comfort| */
  if (lBusContext == gNMCAN2_BusContext) NMCAN2_IndNetworkTimeout();
  /* #ChannelEnd# |CAN2| #BusEnd# |Comfort| */
  //--- end generated part --- Block end #Body_Nm_NetworkTimeoutInd#; do not delete this line! Add application code below this line.
  SetBusContext(lBusContext);
}

void Nm_PrepareBusSleepModeInd()
{
  // Callback of CAN AUTOSAR NM DLL
  dword lBusContext;
  //--- begin generated part --- Block start #Hdr_Nm_PrepareBusSleepModeInd#; do not delete this line and do not add application code in this code block!
  /* #ChannelStart# |CAN1| #BusStart# |PowerTrain| */
  /* #ChannelEnd# |CAN1| #BusEnd# |PowerTrain| */
  //--- end generated part --- Block end #Hdr_Nm_PrepareBusSleepModeInd#; do not delete this line! Add application code below this line.
  lBusContext = GetBusContext();
  //--- begin generated part --- Block start #Body_Nm_PrepareBusSleepModeInd#; do not delete this line and do not add application code in this code block!
  /* #ChannelStart# |CAN1| #BusStart# |PowerTrain| */
  if (lBusContext == gNMCAN1_BusContext) NMCAN1_IndPrepareBusSleepMode();
  /* #ChannelEnd# |CAN1| #BusEnd# |PowerTrain| */
  /* #ChannelStart# |CAN2| #BusStart# |Comfort| */
  if (lBusContext == gNMCAN2_BusContext) NMCAN2_IndPrepareBusSleepMode();
  /* #ChannelEnd# |CAN2| #BusEnd# |Comfort| */
  //--- end generated part --- Block end #Body_Nm_PrepareBusSleepModeInd#; do not delete this line! Add application code below this line.
  SetBusContext(lBusContext);
}

void Nm_BusSleepModeInd()
{
  // Callback of CAN AUTOSAR NM DLL
  dword lBusContext;
  //--- begin generated part --- Block start #Hdr_Nm_BusSleepModeInd#; do not delete this line and do not add application code in this code block!
  /* #ChannelStart# |CAN1| #BusStart# |PowerTrain| */
  /* #ChannelEnd# |CAN1| #BusEnd# |PowerTrain| */
  //--- end generated part --- Block end #Hdr_Nm_BusSleepModeInd#; do not delete this line! Add application code below this line.
  lBusContext = GetBusContext();
  //--- begin generated part --- Block start #Body_Nm_BusSleepModeInd#; do not delete this line and do not add application code in this code block!
  /* #ChannelStart# |CAN1| #BusStart# |PowerTrain| */
  if (lBusContext == gNMCAN1_BusContext) NMCAN1_IndBusSleepMode();
  /* #ChannelEnd# |CAN1| #BusEnd# |PowerTrain| */
  /* #ChannelStart# |CAN2| #BusStart# |Comfort| */
  if (lBusContext == gNMCAN2_BusContext) NMCAN2_IndBusSleepMode();
  /* #ChannelEnd# |CAN2| #BusEnd# |Comfort| */
  //--- end generated part --- Block end #Body_Nm_BusSleepModeInd#; do not delete this line! Add application code below this line.
  SetBusContext(lBusContext);
}

void Nm_StateChangeNotification(long previousState, long currentState)
{
  // Callback of CAN AUTOSAR NM DLL
  dword lBusContext;
  //--- begin generated part --- Block start #Hdr_Nm_StateChangeNotification#; do not delete this line and do not add application code in this code block!
  /* #ChannelStart# |CAN1| #BusStart# |PowerTrain| */
  /* #ChannelEnd# |CAN1| #BusEnd# |PowerTrain| */
  //--- end generated part --- Block end #Hdr_Nm_StateChangeNotification#; do not delete this line! Add application code below this line.
  lBusContext = GetBusContext();
  //--- begin generated part --- Block start #Body_Nm_StateChangeNotification#; do not delete this line and do not add application code in this code block!
  /* #ChannelStart# |CAN1| #BusStart# |PowerTrain| */
  if (lBusContext == gNMCAN1_BusContext) NMCAN1_IndStateChangeNotification(previousState, currentState);
  /* #ChannelEnd# |CAN1| #BusEnd# |PowerTrain| */
  /* #ChannelStart# |CAN2| #BusStart# |Comfort| */
  if (lBusContext == gNMCAN2_BusContext) NMCAN2_IndStateChangeNotification(previousState, currentState);
  /* #ChannelEnd# |CAN2| #BusEnd# |Comfort| */
  //--- end generated part --- Block end #Body_Nm_StateChangeNotification#; do not delete this line! Add application code below this line.
  SetBusContext(lBusContext);
}

//--- begin generated part --- Block start <#Helper_Functions#> do not delete this line and do not add application code in this code block!
/* #ChannelStart# |CAN1| #BusStart# |PowerTrain| */
/* #ChannelEnd# |CAN1| #BusEnd# |PowerTrain| */
//--- end generated part --- Block end <#Helper_Functions#> do not delete this line! Add application code below this line.

//--- begin generated part --- Block start <#SysVar_Handler#> do not delete this line and do not add application code in this code block!
/* #ChannelStart# |CAN1| #BusStart# |PowerTrain| */
on sysvar_update sysvar::IL_CAN1::NODES::N_VectorSimulationNode::EnableNode
{
  ILCAN1_Enable(@this && @sysvar::IL_CAN1::enable_AllNodes && @sysvar::IL::Klemme30);
}

on sysvar_update sysvar::IL_CAN1::enable_AllNodes
{
  ILCAN1_Enable(@this && @sysvar::IL_CAN1::NODES::N_VectorSimulationNode::EnableNode && @sysvar::IL::Klemme30);
}

on sysvar_update sysvar::NM_CAN1::NODES::N_VectorSimulationNode::DeactivateNM
{
  if( @this == 1 || @sysvar::NM_CAN1::StateControl::DeactivateNM == 1)
  {
    NMCAN1_Enable(0);
  }
  else
  {
    NMCAN1_Enable(1);
  }
}

on sysvar_update sysvar::NM_CAN1::StateControl::DeactivateNM
{
  if( @this == 1 || @sysvar::NM_CAN1::NODES::N_VectorSimulationNode::DeactivateNM == 1)
  {
    NMCAN1_Enable(0);
  }
  else
  {
    NMCAN1_Enable(1);
  }
}

on sysvar_update sysvar::NM_CAN1::NODES::N_VectorSimulationNode::OpenNodePanel
{
  OpenNodePanel("PowerTrain::VectorSimulationNode", 1);
}

on sysvar_update sysvar::NM_CAN1::StateControl::CloseNodePanels
{
  OpenNodePanel("PowerTrain::VectorSimulationNode", 0);
}

/* #ChannelEnd# |CAN1| #BusEnd# |PowerTrain| */
/* #ChannelStart# |CAN2| #BusStart# |Comfort| */
on sysvar_update sysvar::IL_CAN2::NODES::N_VectorSimulationNode::EnableNode
{
  ILCAN2_Enable(@this && @sysvar::IL_CAN2::enable_AllNodes && @sysvar::IL::Klemme30);
}

on sysvar_update sysvar::IL_CAN2::enable_AllNodes
{
  ILCAN2_Enable(@this && @sysvar::IL_CAN2::NODES::N_VectorSimulationNode::EnableNode && @sysvar::IL::Klemme30);
}

on sysvar_update sysvar::NM_CAN2::NODES::N_VectorSimulationNode::DeactivateNM
{
  if( @this == 1 || @sysvar::NM_CAN2::StateControl::DeactivateNM == 1)
  {
    NMCAN2_Enable(0);
  }
  else
  {
    NMCAN2_Enable(1);
  }
}

on sysvar_update sysvar::NM_CAN2::StateControl::DeactivateNM
{
  if( @this == 1 || @sysvar::NM_CAN2::NODES::N_VectorSimulationNode::DeactivateNM == 1)
  {
    NMCAN2_Enable(0);
  }
  else
  {
    NMCAN2_Enable(1);
  }
}

on sysvar_update sysvar::NM_CAN2::NODES::N_VectorSimulationNode::OpenNodePanel
{
  OpenNodePanel("Comfort::VectorSimulationNode", 1);
}

on sysvar_update sysvar::NM_CAN2::StateControl::CloseNodePanels
{
  OpenNodePanel("Comfort::VectorSimulationNode", 0);
}

/* #ChannelEnd# |CAN2| #BusEnd# |Comfort| */
//--- end generated part --- Block end <#SysVar_Handler#> do not delete this line! Add application code below this line.

//--- begin generated part --- Block start <#MsgUpdateFcns#> do not delete this line and do not add application code in this code block!
/* #ChannelStart# |CAN1| #BusStart# |PowerTrain| */
/* #ChannelEnd# |CAN1| #BusEnd# |PowerTrain| */
//--- end generated part --- Block end <#MsgUpdateFcns#> do not delete this line! Add application code below this line.

