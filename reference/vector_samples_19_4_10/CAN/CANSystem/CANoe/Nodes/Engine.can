/*@!Encoding:1252*/
includes
{
  // Import required CAPL include files
  //--- begin generated part --- Block start #GlobalBody_Includes#; do not delete this line and do not add application code in this code block!
  /* #ChannelGlobalStart# |CAN1| #BusGlobalStart# |PowerTrain| */
  /* #ChannelGlobalEnd# |CAN1| #BusGlobalEnd# |PowerTrain| */
  //--- end generated part --- Block end #GlobalBody_Includes#; do not delete this line! Add application code below this line.
  //--- begin generated part --- Block start #Body_Includes#; do not delete this line and do not add application code in this code block!
  /* #ChannelStart# |CAN1| #BusStart# |PowerTrain| */
  #include "..\CAPL\PDU-IL-KL30-Helper_CAN1.cin"
  #include "..\CAPL\PDU-NM-Panel-Helper_CAN1.cin"
  #include "..\CAPL\PDU-NM-ASR-Helper_CAN1.cin"
  /* #ChannelEnd# |CAN1| #BusEnd# |PowerTrain| */
  //--- end generated part --- Block end #Body_Includes#; do not delete this line! Add application code below this line.
}

variables
{
  
  
   double cc_integral = 0;

  
  // variables for diagnostics
  int gDefaultSession = 1;
  int gProgrammingSession = 0;
  double gSerNum = 3141528;
  int gCountryVar = 1;
  int gVehicleType = 1;
  byte gSpecialSetting = 0x0;
  int gFaultMemClear = 0;
  int previousCCTargetSpeed; //Is used to reset CCTargetSpeed if configuration user enters invalid speed
  
  long gWakeUpDspTime = 500;

  enum enumIgnition{IGN_OFF = 0, IGN_KEY = 1, IGN_KL15R = 2, IGN_KL15 = 3};

  // variables for powertrain simulation
  int CCSwitchCounter = 0;
  double TargetSpeed = 0;
  double SpeedDiff_last = 0;
  double SollPedal = 0;
  double SpeedDiff = 0;
  
  //timers for recurring calculations and for simulation of vehicle behaviour
  msTimer mstTimestep;
  msTimer TimestepSlow;
  
  //timers and intervalls for capl driving cycle simulation sequences
  Timer Braking; 
  msTimer tIgSwitch;

  
  const int tTimestep_Interval=1;
  const int cIgSwitchTimer_Interval=20;
  
  // simulate torque loss during shifting (dual clutch system) 
  int upshift_active=0;
  int downshift_active=0;
  int upshift_completed=0;
  int downshift_completed=0;
  int upshift_timecounter=0;
  int downshift_timecounter=0;
  msTimer tupshift_active;
  msTimer tdownshift_active;
  const int upshift_active_Interval=150;
  const int downshift_active_Interval=150;
  
  
  int prev_engStatus;
  
  // environmental constants
  double gravitational_acceleration=9.81;        // [m/(s^2)]
  
  // car specific constants and variables
  double car_mass=1300.0;                          // [kg]
  double maxEngineRPM = 6000;                    // [1/min]
  int EngSpeed_idle_rpm=800;                     // [1/min]   
  double wheelradius_effective=0.96*0.317;       // effective wheelradius deviates slightly from wheel radius
  double engtorque;                              // [N]
  double rollingresistance_coefficient=0.014;    // unitless

  
  // drive train specs
  double gear_ratio[7]   = { 0, 3.77, 2.09, 1.32, 1.1, 0.97, 0.81 };
  long upshiftRpm[7]     = { 0, 4000, 3600, 3200, 3000, 2800, 2600 };    // [1/min]
  long downshiftRpm[7]   = { 0, 1100, 1300, 1500, 1600, 1700, 1800 };    // [1/min]
  double diffratio=3.24;
  double drivetrain_efficiency=0.9;
  double transmitionratio_overall[7];
  
  double fuel_consumption_total;        // [L]
  double distance_travelled;            // [km]
  double petrollevel_initial = 50;      // [L]
  
  int i;

  


  /*--- #GenHeader Begin# --- begin generated comment ---
  | Generated on Tuesday, Dezember 03, 2024, 16:47:28
  | By ModelGenerator for Vector 4.7.6, ModelGeneratorVectorDLL 4.7.6
  | Package Vector 4.0.81
  | Vector Modeling Components Addon 4.0.81
  | Target Bus: PowerTrain; Channel: CAN1; DB Cluster: PowerTrain;
  | From Database: PowerTrain_FD.arxml
  | CANoe Version 18.3.118.0
    --- #GenHeader End  # --- end generated comment --- */

  char gECU[256] = "Engine";
  
  //--- begin generated part --- Block start #Hdr_GlobalVariables#; do not delete this line and do not add application code in this code block!
  /* #ChannelStart# |CAN1| #BusStart# |PowerTrain| */
  /* #ChannelEnd# |CAN1| #BusEnd# |PowerTrain| */
  //--- end generated part --- Block end #Hdr_GlobalVariables#; do not delete this line! Add application code below this line.
  //--- begin generated part --- Block start #GlobalBody_GlobalVariables#; do not delete this line and do not add application code in this code block!
  /* #ChannelGlobalStart# |CAN1| #BusGlobalStart# |PowerTrain| */
  /* #ChannelGlobalEnd# |CAN1| #BusGlobalEnd# |PowerTrain| */
  //--- end generated part --- Block end #GlobalBody_GlobalVariables#; do not delete this line! Add application code below this line.
  //--- begin generated part --- Block start #Body_GlobalVariables#; do not delete this line and do not add application code in this code block!
  /* #ChannelStart# |CAN1| #BusStart# |PowerTrain| */
  char gCAN1BusName[256] = "PowerTrain";
  int gCAN1Channel = 1; // The channel the bus is attached to
  int gCAN1TXEnable = 1; // enable/disable TX of application messages

  long gCAN1DisturbanceMode;
  long gCAN1DisturbanceCount;
  long gCAN1DisturbanceValue;
  long gCAN1DisturbanceContinueMode;
  double gCAN1DisturbancePeriod;
  qword gCAN1DisturbanceValue64;
  /* #ChannelEnd# |CAN1| #BusEnd# |PowerTrain| */
  //--- end generated part --- Block end #Body_GlobalVariables#; do not delete this line! Add application code below this line.
}




on preStart
{
  // Initialize CAPL includes and node's modules/DLLs
  //--- begin generated part --- Block start #Hdr_OnInit#; do not delete this line and do not add application code in this code block!
  /* #ChannelStart# |CAN1| #BusStart# |PowerTrain| */
  /* #ChannelEnd# |CAN1| #BusEnd# |PowerTrain| */
  //--- end generated part --- Block end #Hdr_OnInit#; do not delete this line! Add application code below this line.
  //--- begin generated part --- Block start #GlobalBody_OnInit#; do not delete this line and do not add application code in this code block!
  /* #ChannelGlobalStart# |CAN1| #BusGlobalStart# |PowerTrain| */
  /* #ChannelGlobalEnd# |CAN1| #BusGlobalEnd# |PowerTrain| */
  //--- end generated part --- Block end #GlobalBody_OnInit#; do not delete this line! Add application code below this line.
  //--- begin generated part --- Block start #Body_OnInit#; do not delete this line and do not add application code in this code block!
  /* #ChannelStart# |CAN1| #BusStart# |PowerTrain| */
  ILCAN1_OnInit();
  NMCAN1_OnInit();
  /* #ChannelEnd# |CAN1| #BusEnd# |PowerTrain| */
  //--- end generated part --- Block end #Body_OnInit#; do not delete this line! Add application code below this line.
}

on start
{
  
  ILSetOperationMode (2, 0); // form 1
  
  setTimer(mstTimestep, 0); 
  setTimer(TimestepSlow, 5000);
  @sysvar::PowerTrain::EngineStatus=2; //Engine status set to GoSleep on start of configuration
  $GearBoxInfo::Gear = 0;
  $PetrolLevel.raw = 250;
  $EngTemp = 80;
  // Start CAPL includes and node's modules/DLLs
  //--- begin generated part --- Block start #Hdr_OnStart#; do not delete this line and do not add application code in this code block!
  /* #ChannelStart# |CAN1| #BusStart# |PowerTrain| */
  /* #ChannelEnd# |CAN1| #BusEnd# |PowerTrain| */
  //--- end generated part --- Block end #Hdr_OnStart#; do not delete this line! Add application code below this line.
  //--- begin generated part --- Block start #GlobalBody_OnStart#; do not delete this line and do not add application code in this code block!
  /* #ChannelGlobalStart# |CAN1| #BusGlobalStart# |PowerTrain| */
  /* #ChannelGlobalEnd# |CAN1| #BusGlobalEnd# |PowerTrain| */
  //--- end generated part --- Block end #GlobalBody_OnStart#; do not delete this line! Add application code below this line.
  //--- begin generated part --- Block start #Body_OnStart#; do not delete this line and do not add application code in this code block!
  /* #ChannelStart# |CAN1| #BusStart# |PowerTrain| */
  ILCAN1_OnStart();
  NMCAN1_OnStart();
  /* #ChannelEnd# |CAN1| #BusEnd# |PowerTrain| */
  //--- end generated part --- Block end #Body_OnStart#; do not delete this line! Add application code below this line.
  
  previousCCTargetSpeed=@sysvar::CruiseControl::CCTargetSpeed;
  
  for (i = 0; i < 7; i++) {
    transmitionratio_overall[i] = gear_ratio[i] * diffratio;
  }
}

on preStop
{
  // Prepare stopping
  //--- begin generated part --- Block start #Hdr_OnStopping#; do not delete this line and do not add application code in this code block!
  /* #ChannelStart# |CAN1| #BusStart# |PowerTrain| */
  /* #ChannelEnd# |CAN1| #BusEnd# |PowerTrain| */
  //--- end generated part --- Block end #Hdr_OnStopping#; do not delete this line! Add application code below this line.
  //--- begin generated part --- Block start #GlobalBody_OnStopping#; do not delete this line and do not add application code in this code block!
  /* #ChannelGlobalStart# |CAN1| #BusGlobalStart# |PowerTrain| */
  /* #ChannelGlobalEnd# |CAN1| #BusGlobalEnd# |PowerTrain| */
  //--- end generated part --- Block end #GlobalBody_OnStopping#; do not delete this line! Add application code below this line.
  //--- begin generated part --- Block start #Body_OnStopping#; do not delete this line and do not add application code in this code block!
  /* #ChannelStart# |CAN1| #BusStart# |PowerTrain| */
  /* #ChannelEnd# |CAN1| #BusEnd# |PowerTrain| */
  //--- end generated part --- Block end #Body_OnStopping#; do not delete this line! Add application code below this line.
}

on stopMeasurement
{
  // Stop actions
  //--- begin generated part --- Block start #Hdr_OnStop#; do not delete this line and do not add application code in this code block!
  /* #ChannelStart# |CAN1| #BusStart# |PowerTrain| */
  /* #ChannelEnd# |CAN1| #BusEnd# |PowerTrain| */
  //--- end generated part --- Block end #Hdr_OnStop#; do not delete this line! Add application code below this line.
  //--- begin generated part --- Block start #GlobalBody_OnStop#; do not delete this line and do not add application code in this code block!
  /* #ChannelGlobalStart# |CAN1| #BusGlobalStart# |PowerTrain| */
  /* #ChannelGlobalEnd# |CAN1| #BusGlobalEnd# |PowerTrain| */
  //--- end generated part --- Block end #GlobalBody_OnStop#; do not delete this line! Add application code below this line.
  //--- begin generated part --- Block start #Body_OnStop#; do not delete this line and do not add application code in this code block!
  /* #ChannelStart# |CAN1| #BusStart# |PowerTrain| */
  /* #ChannelEnd# |CAN1| #BusEnd# |PowerTrain| */
  //--- end generated part --- Block end #Body_OnStop#; do not delete this line! Add application code below this line.
}

void StartSim(dword busContext, int busActive, int mode)
{
  // Called when ... due to ...
  //   mode == 1: ILControlResume
  //   mode == 2: ILControlStart
  //   mode == 3: ILControlSimulationOn
  //--- begin generated part --- Block start #Hdr_StartSim#; do not delete this line and do not add application code in this code block!
  /* #ChannelStart# |CAN1| #BusStart# |PowerTrain| */
  /* #ChannelEnd# |CAN1| #BusEnd# |PowerTrain| */
  //--- end generated part --- Block end #Hdr_StartSim#; do not delete this line! Add application code below this line.
  //write("[%.6f %NODE_NAME%] StartSim(0x%X, %d, %d)", TimeNowNS()/1e9, busContext, busActive, mode);
  //--- begin generated part --- Block start #Body_StartSim#; do not delete this line and do not add application code in this code block!
  /* #ChannelStart# |CAN1| #BusStart# |PowerTrain| */
  /* #ChannelEnd# |CAN1| #BusEnd# |PowerTrain| */
  //--- end generated part --- Block end #Body_StartSim#; do not delete this line! Add application code below this line.
}

void StopSim(dword busContext, int busActive, int mode)
{
  // Called when ... due to ...
  //   mode == 1: ILControlWait
  //   mode == 2: ILControlStop
  //   mode == 3: ILControlSimulationOff
  //--- begin generated part --- Block start #Hdr_StopSim#; do not delete this line and do not add application code in this code block!
  /* #ChannelStart# |CAN1| #BusStart# |PowerTrain| */
  /* #ChannelEnd# |CAN1| #BusEnd# |PowerTrain| */
  //--- end generated part --- Block end #Hdr_StopSim#; do not delete this line! Add application code below this line.
  //write("[%.6f %NODE_NAME%] StopSim(0x%X, %d, %d)", TimeNowNS()/1e9, busContext, busActive, mode);
  //--- begin generated part --- Block start #Body_StopSim#; do not delete this line and do not add application code in this code block!
  /* #ChannelStart# |CAN1| #BusStart# |PowerTrain| */
  /* #ChannelEnd# |CAN1| #BusEnd# |PowerTrain| */
  //--- end generated part --- Block end #Body_StopSim#; do not delete this line! Add application code below this line.
}

on timer TimestepSlow 
{
  setTimer(TimestepSlow, 5000);


  EngineTempCalc();
}

on timer mstTimestep
{
  setTimer(mstTimestep, tTimestep_Interval);                      // timer is set at beginning of on timer so that mstTimestep intervalls dont vary 
  
  // not allowing capl sequences to be activated while engine is off or car is moving
  if(@sysvar::PowerTrain::EngineStatus!=1 || @sysvar::PowerTrain::CarSpeed_kmh>0){
    enableControl("Control","Switch / Indicator 6",0); 
    enableControl("Control","Switch / Indicator 7",0); 
  }
  else{
    enableControl("Control","Switch / Indicator 6",1); 
    enableControl("Control","Switch / Indicator 7",1); 
  }
  
  // for simplification purposes the user will not be able to turn the key to the "GoSleep", nor the "WakeUp" state while the Car is moving
  if (@sysvar::PowerTrain::CarSpeed_kmh>0){
    enableControl("MainPanel","Switch / Indicator 2",0);        // disables ignition switch control
    enableControl("MainPanel","Switch / Indicator 1",0); 
  }
  else {
    enableControl("MainPanel","Switch / Indicator 2",1);        // enables ignition switch control
    enableControl("MainPanel","Switch / Indicator 1",1); 
  }
  
  // allowing the capl sequences to be deactivated when running
  if(@sysvar::CruiseControl::DrivingCycleAcceleration_Switch ==1){ 
    enableControl("Control","Switch / Indicator 7",1); 
  }
  else if(@sysvar::CruiseControl::DrivingCycleDeceleration_Switch ==1){
    enableControl("Control","Switch / Indicator 6",1);
  }
  

  
  // simulating car behaviour according to engine status
  switch(@sysvar::PowerTrain::EngineStatus){
    
    case 0: // WakeUp
      if(@sysvar::PowerTrain::CarSpeed_kmh!=0){
       compute_vehicledynamics();
       compute_enginespeed(@sysvar::PowerTrain::Gear);            // calculates engine speed from car speed
       PetrolLevelCalc();
      }
      break;
      
      
    case 1: // Running
            
      if (@sysvar::CruiseControl::CC_Active == 1) {
        @sysvar::PowerTrain::ThrottlePosition = CCThrottleCalc();   // automatically calculating new throttle value in case cruise control is activated
      }
      
      compute_vehicledynamics();                                    // approximates engine power, air resistance etc. and therefore longitudinal acceleration on car as well as car speed
      compute_enginespeed(@sysvar::PowerTrain::Gear);               // calculates engine speed from car speed

      
      AutomaticGearShifting();                                      //automatically shifting gears
      compute_distance_travelled();                                 // calculating distance travelled since simulation start
      PetrolLevelCalc();
      
      //update database values
      update_database();
      break;
      
      
    case 2: //GoSleep
      @sysvar::PowerTrain::EngSpeed=0;
      @sysvar::PowerTrain::CarSpeed_kmh=0;
      @sysvar::PowerTrain::CarSpeed_m_per_s=0;
      @sysvar::PowerTrain::Gear=0;
      update_database();
      break;
    
    case 3: //Error
        
    break; 
  }
}

// updating database values
void update_database(){
  $PowerTrain::Engine::EngineData::EngSpeed=@sysvar::PowerTrain::EngSpeed;
  $ABSdata::CarSpeed=@sysvar::PowerTrain::CarSpeed_kmh;
  $EngSpeed = $EngSpeedIEEE;
  $EngForce = @sysvar::PowerTrain::EngForce;
  $EngPower = @sysvar::PowerTrain::EngPower;
  $EngineStatus::Status= @sysvar::PowerTrain::EngineStatus;
  $GearBoxInfo::Gear= @sysvar::PowerTrain::Gear;
  $ABSdata::AccelerationForce=@sysvar::PowerTrain::Vehicle_Acceleration*car_mass; // F [N] = m [kg] * a [m/(s^2)]
}

// calculating overall distance travelled since simulation start
void compute_distance_travelled(){
  distance_travelled = distance_travelled + ( @sysvar::PowerTrain::CarSpeed_m_per_s*0.001 ) /1000; // [km]
}

// reacting to actuation of the ignition switch
on sysvar_update sysvar::IL::IgnitionSwitch
{
  switch(@this){
    case 0:
      sysSetVariableString(sysvar::IL::IgnitionSwitch_Status,"OFF");
      @sysvar::PowerTrain::EngSpeed=0;
      @sysvar::PowerTrain::CarSpeed_kmh=0;
      @sysvar::PowerTrain::CarSpeed_m_per_s=0;
      @sysvar::PowerTrain::Gear=0;
      update_database();
      
      @sysvar::IL::Klemme15=0;
      @sysvar::ComfortBus::IG_15R=0;
      @sysvar::PowerTrain::EngineStatus=2;             // setting EngineStatus to "GoSleep"
      prev_engStatus=2;                                // needed in order to instantly update a variable, autosar database has a cyclic delay
      
      break;
    case 1: 
      sysSetVariableString(sysvar::IL::IgnitionSwitch_Status,"ON");
      @sysvar::IL::Klemme15=1;
      @sysvar::ComfortBus::IG_15R=1;
      if(prev_engStatus!=1){
        @sysvar::PowerTrain::EngineStatus=0;           // setting EngineStatus to "WakeUp", if previous EngineStatus wasn`t "Running"
        prev_engStatus=0;                              // needed in order to instantly update a variable, autosar database has a cyclic delay
      }
      break;
    case 2: 
      sysSetVariableString(sysvar::IL::IgnitionSwitch_Status,"START");
      @sysvar::IL::Klemme15=1;
      @sysvar::ComfortBus::IG_15R=0;
      setTimer(tIgSwitch,cIgSwitchTimer_Interval+500);     // setting a timer to simulate engine cranking process delay
      enableControl("MainPanel","Switch / Indicator 2",0);
      break;
  }
}

on timer tIgSwitch{
  if(@sysvar::IL::IgnitionSwitch==2){
    
    // simulating engine cranking, increasing EngSpeed to idle engine speed of 800rpm
    if(@sysvar::PowerTrain::EngSpeed<EngSpeed_idle_rpm){
      setTimer(tIgSwitch,cIgSwitchTimer_Interval);
      @sysvar::PowerTrain::EngSpeed=@sysvar::PowerTrain::EngSpeed+40;
    }
    else{
      @sysvar::PowerTrain::EngineStatus=1;               // setting EngineStatus to "Running"
      prev_engStatus=1;                                  // needed in order to instantly update a variable, AUTOSAR database has a cyclic delay
      @sysvar::IL::IgnitionSwitch=1;                     // letting ignition switch rotate back into position 2
      enableControl("MainPanel","Switch / Indicator 2",1);
    }
    
    $EngSpeedIEEE=@sysvar::PowerTrain::EngSpeed;
  }
}




// calculates engine RPM
void compute_vehicledynamics(){
  
  // total force off vehicle in forward direction
  // the usage of the stack keyword to create a non static local variable
  stack double vehiclelongitudinal_force=0;          //  [N]
  stack double airresistance_force=0;                //  [N]
  stack double braking_force=0;                      //  [N]
  stack double engbraking_force=0;                   //  [N]  
  stack double rollingresistance_force=0;            //  [N]
  stack double resulting_force=0;                    //  [N]
  stack double vehicle_acelleration=0;               //  [m/(s^2)]
  
  stack double speed_result=0;                       //  [m/s] 
  

  
  airresistance_force=calculate_airresistance();   // calculating air resistance
  engtorque=gettorque_value();                     //gets engine torque value depending on current rpm
  
  if (@sysvar::PowerTrain::ThrottlePosition>0)     //Acelleration, gas pedal pressed
  {
    vehiclelongitudinal_force=longitudinalforce_calc(engtorque);   //calculating longitudinal force caused by opening the throttle 
    @sysvar::PowerTrain::EngForce=vehiclelongitudinal_force;                           // reading the engine force value to the 
    @sysvar::PowerTrain::EngPower=EnginePowerCalc(engtorque);
  }
  else if (@sysvar::PowerTrain::BrakePressure>0 && @sysvar::PowerTrain::CarSpeed_m_per_s>0) //Braking, 
  {
    
    braking_force = brakingforce_calc();
    
    
    @sysvar::PowerTrain::ThrottlePosition = 0;   // making sure that there is no concurrent braking and accelerating
    @sysvar::CruiseControl::CC_Active = 0;       // braking deactivates cruise control
    @sysvar::PowerTrain::EngForce=0;
    @sysvar::PowerTrain::EngPower=0;
  }
  else if(@sysvar::PowerTrain::PedalPressure_Gas==0 && @sysvar::PowerTrain::PedalPressure_Brake==0 && @sysvar::PowerTrain::Gear > 0) // engine braking
  {
    // engine assumed to rise linearily until plateau_lowervalue and pleateau at higher rpm
    double engbrake_torque;        // [Nm]
    long engbrake_torque_max=100;  // [Nm]
    long plateau_lowervalue=4000;  // [1/min]
    
    
    if(@sysvar::PowerTrain::EngSpeed <= EngSpeed_idle_rpm)
    {
      engbrake_torque  =  engbrake_torque_max * ( @sysvar::PowerTrain::EngSpeed / plateau_lowervalue);
    }
    else if(@sysvar::PowerTrain::EngSpeed<=plateau_lowervalue)
    {
      engbrake_torque  =  engbrake_torque_max * ( @sysvar::PowerTrain::EngSpeed / plateau_lowervalue);
    }
    else if(@sysvar::PowerTrain::EngSpeed<plateau_lowervalue)
    {
      engbrake_torque  =  100; 
    }
    @sysvar::PowerTrain::EngForce=0;
    @sysvar::PowerTrain::EngPower=0;
  }
  

  rollingresistance_force = rollingresistance_calc();
    
  resulting_force = vehiclelongitudinal_force - airresistance_force - braking_force - engbraking_force - rollingresistance_force;
  $AccelerationForce = resulting_force;
  
  
  // acceleration is force devided by mass
  vehicle_acelleration = resulting_force / car_mass;
  @sysvar::PowerTrain::Vehicle_Acceleration=vehicle_acelleration;
  
  // the vehicle acelleration was now calculated for this moment, it will be calculated again the next time that mstTimestep timer is called
  // therefore the speed and rpm value that the car will have in 1ms will be calculated and set in order to bridge that time and simulate realistic car behaviour
  // nextspeed [m/s] = speed [m/s] + acceleration [m/(s^2)] * one ms intervall [s] 
  
  if(resulting_force>0 || @sysvar::PowerTrain::CarSpeed_m_per_s>0 ){
    speed_result = @sysvar::PowerTrain::CarSpeed_m_per_s + vehicle_acelleration * 0.001;
    
    if(speed_result>0.0){
      @sysvar::PowerTrain::CarSpeed_m_per_s = speed_result;
    }
    else{
      @sysvar::PowerTrain::CarSpeed_m_per_s = 0;
    }
    
    @sysvar::PowerTrain::CarSpeed_kmh = @sysvar::PowerTrain::CarSpeed_m_per_s * 3.6;
  }
  
}
    
double calculate_airresistance(){
  //                            
  // force caused by airresistance =   0.5  * air density   * car front cross section * drag coefficient * (car speed)^2
  // note: drag significantly increases with car speed 
  double airdensity =1.225;       //  [kg/(m^3)]
  double front_crossection=2.2;   //  [m^2]
  double dragcoefficient=0.285;   //  unitless
  double airresistance;           //  [N]
  
  airresistance= 0.5 * airdensity * front_crossection * dragcoefficient * (@sysvar::PowerTrain::CarSpeed_m_per_s*@sysvar::PowerTrain::CarSpeed_m_per_s);
  
  return airresistance;
}

double longitudinalforce_calc(double engine_torque){
  double vehiclelongitudinal_force;
  //                                 EngineTorque [Nm]  * gear ratio * differential ratio * drivetrain efficiency
  // force in forward direction [N] =   ------------------------------------------------------------------------------
  //                                                        effective wheel radius  [m]

  if(@sysvar::PowerTrain::Gear > 0 && @sysvar::PowerTrain::ThrottlePosition > 0 ){ 
    vehiclelongitudinal_force = (  engtorque  *    transmitionratio_overall[@sysvar::PowerTrain::Gear] *     drivetrain_efficiency       ) /  wheelradius_effective;
    vehiclelongitudinal_force = vehiclelongitudinal_force * ( @sysvar::PowerTrain::ThrottlePosition / 100.0 );
    
  }
  else{
    vehiclelongitudinal_force = 0; // when gear is in neutral, no force is forwarded by the drivetrain
  }

  return vehiclelongitudinal_force;
}

double brakingforce_calc(){
  //                                                                brake pressure [bar]
  // braking force = mass * maximum deceleration [m/(s^2)] * ------------------------------------
  //                                                            maximum brake pressure  [bar]
  
  long brakepressure_max=100;   // [bar]
  double deceleration_max=9.81; // [m/(s^2)]
  double braking_force=0;       // [N]
    
  if(@sysvar::PowerTrain::CarSpeed_m_per_s>0){
    braking_force = car_mass  *  deceleration_max  *  ( @sysvar::PowerTrain::BrakePressure /  brakepressure_max ); // [N]
  }
  else{
    braking_force=0;
  } 
  
  return braking_force;
}

double engbrakingforce_calc(double engbrake_torque){  
  // calculating force in forward direction
  //                                 EngineTorque [Nm]  * gear ratio * differential ratio * drivetrain efficiency
  // force in forward direction [N] =   ------------------------------------------------------------------------------
  //                                                        effective wheel radius  [m]
    
  double engbraking_force;
  
  engbraking_force = (  engbrake_torque  *    transmitionratio_overall[@sysvar::PowerTrain::Gear] *     drivetrain_efficiency       ) /  wheelradius_effective;

  return engbraking_force;
}

double rollingresistance_calc(){
  // rolling resistance allways applies, assumed to be approximately constant as it only increases slightly at high speeds
  //
  // rolling resistance force [N]  =  rolling resistance coefficient * vehicle mass * gravitational acceleration
  //
  
  double rollingresistance_force;
  
  if(@sysvar::PowerTrain::CarSpeed_m_per_s>0){
    rollingresistance_force  =  rollingresistance_coefficient * car_mass * gravitational_acceleration; 
  }
  else{
    rollingresistance_force  =  0;
  }
  
  return rollingresistance_force;
}

double gettorque_value(){
  // the following engine torque/rpm specs are a very rough approximation and w
  // the Assumption is that torque rises linearily until it plateaus from rpm_plateau_lowerbarrier to rpm_plateau_upperbarrier
  // then torque decreases linearily again
  // values are inspired by a Volkswagen 1.5l four cylinder tsi engine with about 110kW
  double engtorque;
  double maxtorque=250;                  // [Nm]
  double rpm_plateau_lowerbarrier=1500;  // [1/min] 
  double rpm_plateau_upperbarrier=3500;  // [1/min]
  
  if(downshift_active != 1 || upshift_active != 1 ){
    if(@sysvar::PowerTrain::EngSpeed<rpm_plateau_lowerbarrier){
      engtorque  =    maxtorque   *   (         @sysvar::PowerTrain::EngSpeed  /  rpm_plateau_lowerbarrier  );
    }
    else if (@sysvar::PowerTrain::EngSpeed>rpm_plateau_upperbarrier){
      engtorque  =     maxtorque * ( ( -1.0 / 6250.0 ) * (@sysvar::PowerTrain::EngSpeed - 3500.0) + 1.0 );
    }
    else{
      engtorque  =    maxtorque;
    }
  }
  else{
    if(@sysvar::PowerTrain::EngSpeed<rpm_plateau_lowerbarrier){
      engtorque  =  0.7 *   maxtorque   *   (         @sysvar::PowerTrain::EngSpeed  /  rpm_plateau_lowerbarrier  );
    }
    else if (@sysvar::PowerTrain::EngSpeed>rpm_plateau_upperbarrier){
      engtorque  =  0.7 *   maxtorque * ( ( -1.0 / 6250.0 ) * (@sysvar::PowerTrain::EngSpeed - 3500.0) + 1.0 );
    }
    else{
      engtorque  =    maxtorque;
    }
  }
  
  // assuming quadratic dependency of torque on throttle position
  engtorque  =  engtorque  *  ( (@sysvar::PowerTrain::ThrottlePosition/100.0) * (@sysvar::PowerTrain::ThrottlePosition/100.0) ); 

  return engtorque;
  }


long compute_enginespeed(int gear){
  // assuming there is no tire slip
  //                           car speed [km/h] * gear ratio * differential ratio * 60
  // engine speed [1/min] = ----------------------------------------------------------------
  //                                        wheel circumference [m]
  
  double wheel_circumference ;
  stack long engspeed=0;
  wheel_circumference = 2 * wheelradius_effective * pi;
  
  if(@sysvar::PowerTrain::Gear>0 && @sysvar::PowerTrain::CarSpeed_m_per_s>2 ){
    engspeed = ( @sysvar::PowerTrain::CarSpeed_m_per_s * transmitionratio_overall[gear]  * 60 ) / 
                                          ( wheel_circumference );
  }
  else if (@sysvar::PowerTrain::Gear>0 && @sysvar::PowerTrain::CarSpeed_m_per_s<=2 ) {
    engspeed = 0.8 * EngSpeed_idle_rpm + 0.2 * EngSpeed_idle_rpm * (@sysvar::PowerTrain::CarSpeed_m_per_s/2);
  }

  
  if(upshift_active!=1 && downshift_active!=1){
    if(@sysvar::PowerTrain::Gear>0 && @sysvar::PowerTrain::CarSpeed_m_per_s>2 ){
      @sysvar::PowerTrain::EngSpeed = engspeed;
    }
    else if (@sysvar::PowerTrain::Gear==0 && @sysvar::PowerTrain::EngineStatus==1) {
      @sysvar::PowerTrain::EngSpeed = EngSpeed_idle_rpm;
    }
    else if (@sysvar::PowerTrain::Gear>0 && @sysvar::PowerTrain::CarSpeed_m_per_s<=2 ){
      @sysvar::PowerTrain::EngSpeed = engspeed;
    }
  }
  // if upshift or downshift are active, engine speed calculation will be handled by the AutomaticGearShifting() function

  
  
  return engspeed;
} 


// calculate the throttle position for cruise control
double CCThrottleCalc() 
{ 
  double P = 50;
  double I = 10000;
  double cc_integral;
  double dt=0.001;
  

  TargetSpeed = @sysvar::CruiseControl::CCTargetSpeed ;  // or just use CCTargetSpeed
  SpeedDiff = TargetSpeed - @sysvar::PowerTrain::CarSpeed_kmh;

  cc_integral += SpeedDiff * dt; // true integral

  SollPedal = P * SpeedDiff + I * cc_integral + (SpeedDiff - SpeedDiff_last);

  if (SollPedal > 100) {
    SollPedal = 100;
    cc_integral *= 0.9; 
  }
  else if (SollPedal < 0) {
    SollPedal = 0;
    cc_integral *= 0.9;
  }
  
  if(SollPedal>70){
    SollPedal=80;
  }

  SpeedDiff_last = SpeedDiff;
  return SollPedal;
  
}



void EngineTempCalc()
{
  if ($EngTemp >= 80 && $EngTemp <= 127){
    if ($EngTemp <= 126 && @sysvar::PowerTrain::ThrottlePosition > 50) 
    {
      $EngTemp = $EngTemp + 1;
    }
    else if ($EngTemp >= 81 && @sysvar::PowerTrain::ThrottlePosition < 50) 
    {
      $EngTemp = $EngTemp - 1;
    }
  }
}


void PetrolLevelCalc() 
{ 
  // fuel consumption is mostly dependant on engine power and engine efficiency
  //                    engine power [kW] * specific fuel consumption [g/kWh]
  // fuel flow [g/s] = --------------------------------------------------------
  //                                           3600 [s/h]
  
  long specific_fuelconsumption = 250;    // [g/kWh]
  double fuel_flow_weight;                // [g/s]     
  double fuel_flow_volume;                // [L/s] 
  double fuel_density=0.745;              // [kg/L]
  
  fuel_flow_weight = ( $EngPower  *  specific_fuelconsumption )  /  3600.0;
  fuel_flow_volume = fuel_flow_weight / ( 1000.0 * fuel_density);
  
  if(@sysvar::PowerTrain::CarSpeed_kmh>0){
    @sysvar::PowerTrain::fuelconsumption_momentary = ( fuel_flow_volume * 3600.0 * 100.0 ) / @sysvar::PowerTrain::CarSpeed_kmh;
  }
  else{
    // when throttle no throttle is applied, fuel consumption will be assumed to be zero for simplification
    @sysvar::PowerTrain::fuelconsumption_momentary = 0;
  }
  
  
  fuel_consumption_total = fuel_consumption_total + fuel_flow_volume * 0.001;
  
  if(distance_travelled!=0){
    @sysvar::PowerTrain::fuelconsumption_average = (fuel_consumption_total / distance_travelled ) * 100  ;
  }
  else{
    @sysvar::PowerTrain::fuelconsumption_average=0;
  }
  
  $EngineData::PetrolLevel = petrollevel_initial - fuel_consumption_total;
}




double EnginePowerCalc (double engine_torque)
{
  double engine_power;      // [kW]
  double angular_velocity;  // [1/s]
  
  //  calculating engine power from engine torque
  //                          engine torque [Nm]  *  angular velocity [1/s]
  //  engine power [kW]  =  -------------------------------------------------
  //                                             1000
  
  angular_velocity = ( 2.0 * pi * @sysvar::PowerTrain::EngSpeed ) / 60.0;
  
  engine_power = ( engine_torque * angular_velocity ) / 1000.0;
  
  
  return engine_power;
}

void AutomaticGearShifting()
{ 
  // new engine speed after shift is: =oldenginespeed*(newgearratio/oldgearratio)
  
  // Upshift gear 1 to gear 6
  if (upshift_active!=1 && downshift_active!=1){
    
    if (@sysvar::PowerTrain::Gear < 6 &&  @sysvar::PowerTrain::Gear>0 &&  @sysvar::PowerTrain::EngSpeed > upshiftRpm[@sysvar::PowerTrain::Gear] && @sysvar::PowerTrain::ThrottlePosition != 0) {
      setTimer(tupshift_active,upshift_active_Interval);
      upshift_active=1;
    }
    
    // Upshift from neutral
    else if (@sysvar::PowerTrain::Gear== 0 && @sysvar::PowerTrain::ThrottlePosition > 20)
    {
      @sysvar::PowerTrain::Gear += 1;
      @sysvar::PowerTrain::EngSpeed=@sysvar::PowerTrain::EngSpeed*0.8;
    }
    
    // Downshift between gear 6 and gear 1
    else if (@sysvar::PowerTrain::Gear > 1 && @sysvar::PowerTrain::EngSpeed < downshiftRpm[@sysvar::PowerTrain::Gear] && @sysvar::PowerTrain::ThrottlePosition == 0) {
      setTimer(tdownshift_active,downshift_active_Interval);
      downshift_active=1;
    }
    
    //Downshift to neutral
    else if (@sysvar::PowerTrain::Gear == 1 && @sysvar::PowerTrain::EngSpeed < downshiftRpm[@sysvar::PowerTrain::Gear] && @sysvar::PowerTrain::ThrottlePosition <20 ){
      @sysvar::PowerTrain::Gear -= 1;  
      
    }
  }
  
  // handling upshift behaviour during shifting
  else if(upshift_active==1){
    
    // approximating DCT behaviour with linear rpm decrease during shifting
    if (upshift_completed!=1){
      stack int upshift_rpmdelta=0;
      upshift_timecounter=upshift_timecounter+1;
      upshift_rpmdelta  =  @sysvar::PowerTrain::EngSpeed - @sysvar::PowerTrain::EngSpeed * (gear_ratio[@sysvar::PowerTrain::Gear +1] / gear_ratio[@sysvar::PowerTrain::Gear ]);
      @sysvar::PowerTrain::EngSpeed =   @sysvar::PowerTrain::EngSpeed  -  (1.0 / upshift_active_Interval ) * upshift_rpmdelta;
    }
    
    else{
      upshift_timecounter=0;
      
      @sysvar::PowerTrain::Gear += 1;
      upshift_completed=0;
      upshift_active=0;
    }
  }
  
  // handling downshift behaviour during shifting
  else if (downshift_active==1){
    
    // approximating double clutch transmission behaviour with linear rpm increase during shifting
    if (downshift_completed!=1){
      stack int downshift_rpmdelta=0;
      stack long theoretical_engspeed;
      downshift_timecounter=downshift_timecounter+1;
      downshift_rpmdelta  = - @sysvar::PowerTrain::EngSpeed + @sysvar::PowerTrain::EngSpeed * (gear_ratio[@sysvar::PowerTrain::Gear-1] / gear_ratio[@sysvar::PowerTrain::Gear ]);
      
      // adjusting engine speed during downshift so that it also is realistic when the car is braking
      theoretical_engspeed=compute_enginespeed(@sysvar::PowerTrain::Gear-1);
      if(@sysvar::PowerTrain::EngSpeed<theoretical_engspeed){
        @sysvar::PowerTrain::EngSpeed =   @sysvar::PowerTrain::EngSpeed  +  (1.0 / downshift_active_Interval ) * downshift_rpmdelta ; //( upshift_timecounter / upshift_active_Interval );
      }
      else{
        @sysvar::PowerTrain::EngSpeed=theoretical_engspeed;
      }
    }
    else{
      @sysvar::PowerTrain::Gear -= 1;
      downshift_timecounter=0;
      
      downshift_completed=0;
      downshift_active=0;
    }
  }
}

on timer tupshift_active{
  upshift_completed=1;
}

on timer tdownshift_active{
  downshift_completed=1;
}

on sysvar_update sysvar::IL::Klemme15
{
  // Handle system state variable
  //--- begin generated part --- Block start #Hdr_KL15_Klemme15#; do not delete this line and do not add application code in this code block!
  /* #ChannelStart# |CAN1| #BusStart# |PowerTrain| */
  /* #ChannelEnd# |CAN1| #BusEnd# |PowerTrain| */
  //--- end generated part --- Block end #Hdr_KL15_Klemme15#; do not delete this line! Add application code below this line.
  //--- begin generated part --- Block start #Body_KL15_Klemme15#; do not delete this line and do not add application code in this code block!
  /* #ChannelStart# |CAN1| #BusStart# |PowerTrain| */
  ILCAN1_OnEnvKlemme15(@this);
  /* #ChannelEnd# |CAN1| #BusEnd# |PowerTrain| */
  //--- end generated part --- Block end #Body_KL15_Klemme15#; do not delete this line! Add application code below this line.
}

on sysvar_update sysvar::IL::Klemme30
{
  // Handle system state variable
  //--- begin generated part --- Block start #Hdr_KL30_Klemme30#; do not delete this line and do not add application code in this code block!
  /* #ChannelStart# |CAN1| #BusStart# |PowerTrain| */
  /* #ChannelEnd# |CAN1| #BusEnd# |PowerTrain| */
  //--- end generated part --- Block end #Hdr_KL30_Klemme30#; do not delete this line! Add application code below this line.
  //--- begin generated part --- Block start #Body_KL30_Klemme30#; do not delete this line and do not add application code in this code block!
  /* #ChannelStart# |CAN1| #BusStart# |PowerTrain| */
  ILCAN1_OnEnvKlemme30(@this);
  /* #ChannelEnd# |CAN1| #BusEnd# |PowerTrain| */
  //--- end generated part --- Block end #Body_KL30_Klemme30#; do not delete this line! Add application code below this line.
}

dword applPDUILTxPending(dword busContext, dword shortId, dword longId, char name[], dword& aPDULength, byte data[])
{
  dword ret = 1;
  //--- begin generated part --- Block start #Hdr_applPDUILTxPending#; do not delete this line and do not add application code in this code block!
  /* #ChannelStart# |CAN1| #BusStart# |PowerTrain| */
  /* #ChannelEnd# |CAN1| #BusEnd# |PowerTrain| */
  //--- end generated part --- Block end #Hdr_applPDUILTxPending#; do not delete this line! Add application code below this line.
  //write("[%.6f %NODE_NAME%] applPDUILTxPending(0x%X, 0x%X, 0x%X, %s, %d, %d)", TimeNowNS()/1e9, busContext, shortId, longId, name, aPDULength, elcount(data));
  //--- begin generated part --- Block start #Body_applPDUILTxPending#; do not delete this line and do not add application code in this code block!
  /* #ChannelStart# |CAN1| #BusStart# |PowerTrain| */
  /* #ChannelEnd# |CAN1| #BusEnd# |PowerTrain| */
  //--- end generated part --- Block end #Body_applPDUILTxPending#; do not delete this line! Add application code below this line.
  return ret;
}

dword applPDUILStart(dword busContext, dword busActive, dword mode)
{
  dword ret = 1;
  //--- begin generated part --- Block start #Hdr_applPDUILStart#; do not delete this line and do not add application code in this code block!
  /* #ChannelStart# |CAN1| #BusStart# |PowerTrain| */
  /* #ChannelEnd# |CAN1| #BusEnd# |PowerTrain| */
  //--- end generated part --- Block end #Hdr_applPDUILStart#; do not delete this line! Add application code below this line.
  //write("[%.6f %NODE_NAME%] applPDUILStart(0x%X, %d, %d)", TimeNowNS()/1e9, busContext, busActive, mode);
  //--- begin generated part --- Block start #Body_applPDUILStart#; do not delete this line and do not add application code in this code block!
  /* #ChannelStart# |CAN1| #BusStart# |PowerTrain| */
  /* #ChannelEnd# |CAN1| #BusEnd# |PowerTrain| */
  //--- end generated part --- Block end #Body_applPDUILStart#; do not delete this line! Add application code below this line.
  //--- begin generated part --- Block start #Footer_applPDUILStart#; do not delete this line and do not add application code in this code block!
  /* #ChannelStart# |CAN1| #BusStart# |PowerTrain| */
  StartSim(busContext, busActive, mode);
  /* #ChannelEnd# |CAN1| #BusEnd# |PowerTrain| */
  //--- end generated part --- Block end #Footer_applPDUILStart#; do not delete this line! Add application code below this line.
  return ret;
}

dword applPDUILStop(dword busContext, dword busActive, dword mode)
{
  dword ret = 1;
  //--- begin generated part --- Block start #Hdr_applPDUILStop#; do not delete this line and do not add application code in this code block!
  /* #ChannelStart# |CAN1| #BusStart# |PowerTrain| */
  /* #ChannelEnd# |CAN1| #BusEnd# |PowerTrain| */
  //--- end generated part --- Block end #Hdr_applPDUILStop#; do not delete this line! Add application code below this line.
  //write("[%.6f %NODE_NAME%] applPDUILStop(0x%X, %d, %d)", TimeNowNS()/1e9, busContext, busActive, mode);
  //--- begin generated part --- Block start #Body_applPDUILStop#; do not delete this line and do not add application code in this code block!
  /* #ChannelStart# |CAN1| #BusStart# |PowerTrain| */
  StopSim(busContext, busActive, mode);
  /* #ChannelEnd# |CAN1| #BusEnd# |PowerTrain| */
  //--- end generated part --- Block end #Body_applPDUILStop#; do not delete this line! Add application code below this line.
  //--- begin generated part --- Block start #Footer_applPDUILStop#; do not delete this line and do not add application code in this code block!
  /* #ChannelStart# |CAN1| #BusStart# |PowerTrain| */
  /* #ChannelEnd# |CAN1| #BusEnd# |PowerTrain| */
  //--- end generated part --- Block end #Footer_applPDUILStop#; do not delete this line! Add application code below this line.
  return ret;
}

void Nm_NetworkStartInd()
{
  // Callback of CAN AUTOSAR NM DLL
  dword lBusContext;
  //--- begin generated part --- Block start #Hdr_Nm_NetworkStartInd#; do not delete this line and do not add application code in this code block!
  /* #ChannelStart# |CAN1| #BusStart# |PowerTrain| */
  /* #ChannelEnd# |CAN1| #BusEnd# |PowerTrain| */
  //--- end generated part --- Block end #Hdr_Nm_NetworkStartInd#; do not delete this line! Add application code below this line.
  lBusContext = GetBusContext();
  //--- begin generated part --- Block start #Body_Nm_NetworkStartInd#; do not delete this line and do not add application code in this code block!
  /* #ChannelStart# |CAN1| #BusStart# |PowerTrain| */
  if (lBusContext == gNMCAN1_BusContext) NMCAN1_IndNetworkStart();
  /* #ChannelEnd# |CAN1| #BusEnd# |PowerTrain| */
  //--- end generated part --- Block end #Body_Nm_NetworkStartInd#; do not delete this line! Add application code below this line.
  SetBusContext(lBusContext);
}

void Nm_NetworkModeInd()
{
  // Callback of CAN AUTOSAR NM DLL
  dword lBusContext;
  //--- begin generated part --- Block start #Hdr_Nm_NetworkModeInd#; do not delete this line and do not add application code in this code block!
  /* #ChannelStart# |CAN1| #BusStart# |PowerTrain| */
  /* #ChannelEnd# |CAN1| #BusEnd# |PowerTrain| */
  //--- end generated part --- Block end #Hdr_Nm_NetworkModeInd#; do not delete this line! Add application code below this line.
  lBusContext = GetBusContext();
  //--- begin generated part --- Block start #Body_Nm_NetworkModeInd#; do not delete this line and do not add application code in this code block!
  /* #ChannelStart# |CAN1| #BusStart# |PowerTrain| */
  if (lBusContext == gNMCAN1_BusContext) NMCAN1_IndNetworkMode();
  /* #ChannelEnd# |CAN1| #BusEnd# |PowerTrain| */
  //--- end generated part --- Block end #Body_Nm_NetworkModeInd#; do not delete this line! Add application code below this line.
  SetBusContext(lBusContext);
}

void Nm_NetworkTimeoutInd()
{
  // Callback of CAN AUTOSAR NM DLL
  dword lBusContext;
  //--- begin generated part --- Block start #Hdr_Nm_NetworkTimeoutInd#; do not delete this line and do not add application code in this code block!
  /* #ChannelStart# |CAN1| #BusStart# |PowerTrain| */
  /* #ChannelEnd# |CAN1| #BusEnd# |PowerTrain| */
  //--- end generated part --- Block end #Hdr_Nm_NetworkTimeoutInd#; do not delete this line! Add application code below this line.
  lBusContext = GetBusContext();
  //--- begin generated part --- Block start #Body_Nm_NetworkTimeoutInd#; do not delete this line and do not add application code in this code block!
  /* #ChannelStart# |CAN1| #BusStart# |PowerTrain| */
  if (lBusContext == gNMCAN1_BusContext) NMCAN1_IndNetworkTimeout();
  /* #ChannelEnd# |CAN1| #BusEnd# |PowerTrain| */
  //--- end generated part --- Block end #Body_Nm_NetworkTimeoutInd#; do not delete this line! Add application code below this line.
  SetBusContext(lBusContext);
}

void Nm_PrepareBusSleepModeInd()
{
  // Callback of CAN AUTOSAR NM DLL
  dword lBusContext;
  //--- begin generated part --- Block start #Hdr_Nm_PrepareBusSleepModeInd#; do not delete this line and do not add application code in this code block!
  /* #ChannelStart# |CAN1| #BusStart# |PowerTrain| */
  /* #ChannelEnd# |CAN1| #BusEnd# |PowerTrain| */
  //--- end generated part --- Block end #Hdr_Nm_PrepareBusSleepModeInd#; do not delete this line! Add application code below this line.
  lBusContext = GetBusContext();
  //--- begin generated part --- Block start #Body_Nm_PrepareBusSleepModeInd#; do not delete this line and do not add application code in this code block!
  /* #ChannelStart# |CAN1| #BusStart# |PowerTrain| */
  if (lBusContext == gNMCAN1_BusContext) NMCAN1_IndPrepareBusSleepMode();
  /* #ChannelEnd# |CAN1| #BusEnd# |PowerTrain| */
  //--- end generated part --- Block end #Body_Nm_PrepareBusSleepModeInd#; do not delete this line! Add application code below this line.
  SetBusContext(lBusContext);
}

void Nm_BusSleepModeInd()
{
  // Callback of CAN AUTOSAR NM DLL
  dword lBusContext;
  //--- begin generated part --- Block start #Hdr_Nm_BusSleepModeInd#; do not delete this line and do not add application code in this code block!
  /* #ChannelStart# |CAN1| #BusStart# |PowerTrain| */
  /* #ChannelEnd# |CAN1| #BusEnd# |PowerTrain| */
  //--- end generated part --- Block end #Hdr_Nm_BusSleepModeInd#; do not delete this line! Add application code below this line.
  lBusContext = GetBusContext();
  //--- begin generated part --- Block start #Body_Nm_BusSleepModeInd#; do not delete this line and do not add application code in this code block!
  /* #ChannelStart# |CAN1| #BusStart# |PowerTrain| */
  if (lBusContext == gNMCAN1_BusContext) NMCAN1_IndBusSleepMode();
  /* #ChannelEnd# |CAN1| #BusEnd# |PowerTrain| */
  //--- end generated part --- Block end #Body_Nm_BusSleepModeInd#; do not delete this line! Add application code below this line.
  SetBusContext(lBusContext);
}

void Nm_StateChangeNotification(long previousState, long currentState)
{
  // Callback of CAN AUTOSAR NM DLL
  dword lBusContext;
  //--- begin generated part --- Block start #Hdr_Nm_StateChangeNotification#; do not delete this line and do not add application code in this code block!
  /* #ChannelStart# |CAN1| #BusStart# |PowerTrain| */
  /* #ChannelEnd# |CAN1| #BusEnd# |PowerTrain| */
  //--- end generated part --- Block end #Hdr_Nm_StateChangeNotification#; do not delete this line! Add application code below this line.
  lBusContext = GetBusContext();
  //--- begin generated part --- Block start #Body_Nm_StateChangeNotification#; do not delete this line and do not add application code in this code block!
  /* #ChannelStart# |CAN1| #BusStart# |PowerTrain| */
  if (lBusContext == gNMCAN1_BusContext) NMCAN1_IndStateChangeNotification(previousState, currentState);
  /* #ChannelEnd# |CAN1| #BusEnd# |PowerTrain| */
  //--- end generated part --- Block end #Body_Nm_StateChangeNotification#; do not delete this line! Add application code below this line.
  SetBusContext(lBusContext);
}

//--- begin generated part --- Block start <#Helper_Functions#> do not delete this line and do not add application code in this code block!
/* #ChannelStart# |CAN1| #BusStart# |PowerTrain| */
/* #ChannelEnd# |CAN1| #BusEnd# |PowerTrain| */
//--- end generated part --- Block end <#Helper_Functions#> do not delete this line! Add application code below this line.

//--- begin generated part --- Block start <#SysVar_Handler#> do not delete this line and do not add application code in this code block!
/* #ChannelStart# |CAN1| #BusStart# |PowerTrain| */
on sysvar_update sysvar::IL_CAN1::NODES::N_Engine::EnableNode
{
  ILCAN1_Enable(@this && @sysvar::IL_CAN1::enable_AllNodes && @sysvar::IL::Klemme30);
}

on sysvar_update sysvar::IL_CAN1::enable_AllNodes
{
  ILCAN1_Enable(@this && @sysvar::IL_CAN1::NODES::N_Engine::EnableNode && @sysvar::IL::Klemme30);
}

on sysvar_update sysvar::NM_CAN1::NODES::N_Engine::DeactivateNM
{
  if( @this == 1 || @sysvar::NM_CAN1::StateControl::DeactivateNM == 1)
  {
    NMCAN1_Enable(0);
  }
  else
  {
    NMCAN1_Enable(1);
  }
}

on sysvar_update sysvar::NM_CAN1::StateControl::DeactivateNM
{
  if( @this == 1 || @sysvar::NM_CAN1::NODES::N_Engine::DeactivateNM == 1)
  {
    NMCAN1_Enable(0);
  }
  else
  {
    NMCAN1_Enable(1);
  }
}

on sysvar_update sysvar::NM_CAN1::NODES::N_Engine::OpenNodePanel
{
  OpenNodePanel("PowerTrain::Engine", 1);
}

on sysvar_update sysvar::NM_CAN1::StateControl::CloseNodePanels
{
  OpenNodePanel("PowerTrain::Engine", 0);
}

/* #ChannelEnd# |CAN1| #BusEnd# |PowerTrain| */
//--- end generated part --- Block end <#SysVar_Handler#> do not delete this line! Add application code below this line.

//--- begin generated part --- Block start <#MsgUpdateFcns#> do not delete this line and do not add application code in this code block!
/* #ChannelStart# |CAN1| #BusStart# |PowerTrain| */
/* #ChannelEnd# |CAN1| #BusEnd# |PowerTrain| */
//--- end generated part --- Block end <#MsgUpdateFcns#> do not delete this line! Add application code below this line.

on diagRequest Engine.DEFAULT_SESSION_Start
{
  /* The application functionality starts here the default session. */

  diagResponse this resp;

  gDefaultSession = 1;
  gProgrammingSession = 0;

  /* Sends the response object back to the tester. 
  Can only be called in the ECU simulation. */
  DiagSendResponse( resp);
}

on diagRequest Engine.ProgrammingSession_Start
{
  /* The application functionality starts here the programming session. */

  diagResponse this resp;

  gDefaultSession = 0;
  gProgrammingSession = 1;

  /* Sends the response object back to the tester. 
  Can only be called in the ECU simulation. */
  DiagSendResponse( resp);
}

on diagRequest Engine.STOP_SESSION_Stop
{
  /* The application functionality stops 
  here the active default session. */

  diagResponse this resp;

  gDefaultSession = 0;
  gProgrammingSession = 0;

  /* Sends the response object back to the tester. 
  Can only be called in the ECU simulation. */
  DiagSendResponse(resp);
}

on diagRequest Engine.ECU_Identification_Read
{
  /* The server sends an identification datarecord included in the 
  ReadECUIdentification positive response message. */

  diagResponse this resp;

  if(!gDefaultSession)
  {
    //Service not supported in active diagnostic mode
    DiagSendNegativeResponse(this,0x80);
    return;
  }

  // Set the parameters in the response.
  DiagSetParameter( resp, "Ident_Number_7_6", "9876");
  DiagSetParameter( resp, "Ident_Number_5_4", "5432");
  DiagSetParameter( resp, "Ident_Number_3_2", "1000");
  DiagSetParameter( resp, "Ident_Number_1_0", "9999");
  DiagSetParameter( resp, "Diagnostic_Identification", 1);

  /* Sends the response object back to the tester. 
  Can only be called in the ECU simulation. */
  DiagSendResponse( resp);
}

on diagRequest Engine.FAULT_MEMORY_DeleteAll
{
  diagResponse this resp;
  word dtc;

  gFaultMemClear = 1;

  dtc = DiagGetParameter(this, "GROUP_OF_DTC_RQ");

  // Set the parameters in the response.
  DiagSetParameter( resp, "GROUP_OF_DTC_RQ", dtc);

  /* Sends the response object back to the tester. 
  Can only be called in the ECU simulation. */
  DiagSendResponse( resp);
}

on diagRequest Engine.FAULT_MEMORY_ReadAllIdentifiedTroubleCodes
{
  /* This request of the tester, will read the identified trouble code 
  of the ECU. The ECU will send back the List of selected DTC status */
  diagResponse this respFaultMem;
  int count = 0; 
  int curDTC1;
  int curDTC2;
  int curDTC3;
  int curDTC4;
  int curDTC5;
  int curDTC6;
  int nrOfcurDTCs;

  curDTC2 = 0;
  curDTC4 = 0;

  if(gFaultMemClear)
  {
    gFaultMemClear=0;
    DiagSetParameter(respFaultMem, "NUMBER_OF_DTC", 0);
    DiagSendResponse(respFaultMem);    
    return;
  } 

  curDTC1 = random(2);
  if(!curDTC1) curDTC2 = random(2);
  curDTC3 = random(2);
  if(!curDTC3) curDTC4 = random(2);
  curDTC5 = random(2);
  curDTC6 = random(2);

  nrOfcurDTCs = curDTC1 + curDTC2 + curDTC3 + curDTC4 + curDTC5 + curDTC6;

  /* Sets a parameter to the symbolically-specified value. This is possible 
  for all parameters, also numeric ones.  */
  DiagSetParameter(respFaultMem, "NUMBER_OF_DTC", nrOfcurDTCs);

  /* Size adjustment of the diagnostics object to the desired number of 
  repetitions of the complex parameters. */
  if(nrOfcurDTCs!=0) DiagResize(respFaultMem);

  /* DiagSetComplexParameter functions sets one of the sub-parameters within a 
  complex parameter to the specified (numeric or symbolic) value. For this 
  first the complex parameter, that is, the name of the iteration, must be 
  specified; then the number of repetitions of the sub-parameter list that 
  is the goal, and then the sub-parameter in the iteration itself. 
  */
//  if(curDTC1)
//  { 
//    DiagSetComplexParameter( respFaultMem, "LIST_OF_DTC_AND_STATUS", count, "DTC",0x9001);
//    DiagSetComplexParameter( respFaultMem, "LIST_OF_DTC_AND_STATUS", count, "DTCStatusByte.TestFailed",random(2));
//    DiagSetComplexParameter( respFaultMem, "LIST_OF_DTC_AND_STATUS", count, "DTCStatusByte.TestFailedThisMonitoringCycle",random(2));
//    DiagSetComplexParameter( respFaultMem, "LIST_OF_DTC_AND_STATUS", count, "DTCStatusByte.PendingDTC",random(2));
//    DiagSetComplexParameter( respFaultMem, "LIST_OF_DTC_AND_STATUS", count, "DTCStatusByte.ConfirmedDTC",random(2));
//    DiagSetComplexParameter( respFaultMem, "LIST_OF_DTC_AND_STATUS", count, "DTCStatusByte.TestNotCompletedSinceLastClear",random(2));
//    DiagSetComplexParameter( respFaultMem, "LIST_OF_DTC_AND_STATUS", count, "DTCStatusByte.TestFailedSinceLastClear",random(2));
//    DiagSetComplexParameter( respFaultMem, "LIST_OF_DTC_AND_STATUS", count, "DTCStatusByte.TestNotCompletedThisMonitoringCycle",random(2));
//    DiagSetComplexParameter( respFaultMem, "LIST_OF_DTC_AND_STATUS", count, "DTCStatusByte.WarningIndicatorRequested",random(2));
//    count = count + 1;
//  }
//  if(curDTC2)
//  { 
//    DiagSetComplexParameter( respFaultMem, "LIST_OF_DTC_AND_STATUS", count, "DTC",0x9002);
//    DiagSetComplexParameter( respFaultMem, "LIST_OF_DTC_AND_STATUS", count, "DTCStatusByte.TestFailed",random(2));
//    DiagSetComplexParameter( respFaultMem, "LIST_OF_DTC_AND_STATUS", count, "DTCStatusByte.TestFailedThisMonitoringCycle",random(2));
//    DiagSetComplexParameter( respFaultMem, "LIST_OF_DTC_AND_STATUS", count, "DTCStatusByte.PendingDTC",random(2));
//    DiagSetComplexParameter( respFaultMem, "LIST_OF_DTC_AND_STATUS", count, "DTCStatusByte.ConfirmedDTC",random(2));
//    DiagSetComplexParameter( respFaultMem, "LIST_OF_DTC_AND_STATUS", count, "DTCStatusByte.TestNotCompletedSinceLastClear",random(2));
//    DiagSetComplexParameter( respFaultMem, "LIST_OF_DTC_AND_STATUS", count, "DTCStatusByte.TestFailedSinceLastClear",random(2));
//    DiagSetComplexParameter( respFaultMem, "LIST_OF_DTC_AND_STATUS", count, "DTCStatusByte.TestNotCompletedThisMonitoringCycle",random(2));
//    DiagSetComplexParameter( respFaultMem, "LIST_OF_DTC_AND_STATUS", count, "DTCStatusByte.WarningIndicatorRequested",random(2));
//    count = count + 1;
//  }

//  if(curDTC3)
//  { 
//    DiagSetComplexParameter( respFaultMem, "LIST_OF_DTC_AND_STATUS", count, "DTC",0x9011);
//    DiagSetComplexParameter( respFaultMem, "LIST_OF_DTC_AND_STATUS", count, "DTCStatusByte.TestFailed",random(2));
//    DiagSetComplexParameter( respFaultMem, "LIST_OF_DTC_AND_STATUS", count, "DTCStatusByte.TestFailedThisMonitoringCycle",random(2));
//    DiagSetComplexParameter( respFaultMem, "LIST_OF_DTC_AND_STATUS", count, "DTCStatusByte.PendingDTC",random(2));
//    DiagSetComplexParameter( respFaultMem, "LIST_OF_DTC_AND_STATUS", count, "DTCStatusByte.ConfirmedDTC",random(2));
//    DiagSetComplexParameter( respFaultMem, "LIST_OF_DTC_AND_STATUS", count, "DTCStatusByte.TestNotCompletedSinceLastClear",random(2));
//    DiagSetComplexParameter( respFaultMem, "LIST_OF_DTC_AND_STATUS", count, "DTCStatusByte.TestFailedSinceLastClear",random(2));
//    DiagSetComplexParameter( respFaultMem, "LIST_OF_DTC_AND_STATUS", count, "DTCStatusByte.TestNotCompletedThisMonitoringCycle",random(2));
//    DiagSetComplexParameter( respFaultMem, "LIST_OF_DTC_AND_STATUS", count, "DTCStatusByte.WarningIndicatorRequested",random(2));
//    count = count + 1;
//  }

//  if(curDTC4)
//  { 
//    DiagSetComplexParameter( respFaultMem, "LIST_OF_DTC_AND_STATUS", count, "DTC",0x9012);
//    DiagSetComplexParameter( respFaultMem, "LIST_OF_DTC_AND_STATUS", count, "DTCStatusByte.TestFailed",random(2));
//    DiagSetComplexParameter( respFaultMem, "LIST_OF_DTC_AND_STATUS", count, "DTCStatusByte.TestFailedThisMonitoringCycle",random(2));
//    DiagSetComplexParameter( respFaultMem, "LIST_OF_DTC_AND_STATUS", count, "DTCStatusByte.PendingDTC",random(2));
//    DiagSetComplexParameter( respFaultMem, "LIST_OF_DTC_AND_STATUS", count, "DTCStatusByte.ConfirmedDTC",random(2));
//    DiagSetComplexParameter( respFaultMem, "LIST_OF_DTC_AND_STATUS", count, "DTCStatusByte.TestNotCompletedSinceLastClear",random(2));
//    DiagSetComplexParameter( respFaultMem, "LIST_OF_DTC_AND_STATUS", count, "DTCStatusByte.TestFailedSinceLastClear",random(2));
//    DiagSetComplexParameter( respFaultMem, "LIST_OF_DTC_AND_STATUS", count, "DTCStatusByte.TestNotCompletedThisMonitoringCycle",random(2));
//    DiagSetComplexParameter( respFaultMem, "LIST_OF_DTC_AND_STATUS", count, "DTCStatusByte.WarningIndicatorRequested",random(2));
//    count = count + 1;
//  }
//  if(curDTC5)
//  { 
//    DiagSetComplexParameter( respFaultMem, "LIST_OF_DTC_AND_STATUS", count, "DTC",0x9013);
//    DiagSetComplexParameter( respFaultMem, "LIST_OF_DTC_AND_STATUS", count, "DTCStatusByte.TestFailed",random(2));
//    DiagSetComplexParameter( respFaultMem, "LIST_OF_DTC_AND_STATUS", count, "DTCStatusByte.TestFailedThisMonitoringCycle",random(2));
//    DiagSetComplexParameter( respFaultMem, "LIST_OF_DTC_AND_STATUS", count, "DTCStatusByte.PendingDTC",random(2));
//    DiagSetComplexParameter( respFaultMem, "LIST_OF_DTC_AND_STATUS", count, "DTCStatusByte.ConfirmedDTC",random(2));
//    DiagSetComplexParameter( respFaultMem, "LIST_OF_DTC_AND_STATUS", count, "DTCStatusByte.TestNotCompletedSinceLastClear",random(2));
//    DiagSetComplexParameter( respFaultMem, "LIST_OF_DTC_AND_STATUS", count, "DTCStatusByte.TestFailedSinceLastClear",random(2));
//    DiagSetComplexParameter( respFaultMem, "LIST_OF_DTC_AND_STATUS", count, "DTCStatusByte.TestNotCompletedThisMonitoringCycle",random(2));
//    DiagSetComplexParameter( respFaultMem, "LIST_OF_DTC_AND_STATUS", count, "DTCStatusByte.WarningIndicatorRequested",random(2));
//    count = count + 1;
//  }
//  if(curDTC6)
//  { 
//    DiagSetComplexParameter( respFaultMem, "LIST_OF_DTC_AND_STATUS", count, "DTC",0x9014);
//    DiagSetComplexParameter( respFaultMem, "LIST_OF_DTC_AND_STATUS", count, "DTCStatusByte.TestFailed",random(2));
//    DiagSetComplexParameter( respFaultMem, "LIST_OF_DTC_AND_STATUS", count, "DTCStatusByte.TestFailedThisMonitoringCycle",random(2));
//    DiagSetComplexParameter( respFaultMem, "LIST_OF_DTC_AND_STATUS", count, "DTCStatusByte.PendingDTC",random(2));
//    DiagSetComplexParameter( respFaultMem, "LIST_OF_DTC_AND_STATUS", count, "DTCStatusByte.ConfirmedDTC",random(2));
//    DiagSetComplexParameter( respFaultMem, "LIST_OF_DTC_AND_STATUS", count, "DTCStatusByte.TestNotCompletedSinceLastClear",random(2));
//    DiagSetComplexParameter( respFaultMem, "LIST_OF_DTC_AND_STATUS", count, "DTCStatusByte.TestFailedSinceLastClear",random(2));
//    DiagSetComplexParameter( respFaultMem, "LIST_OF_DTC_AND_STATUS", count, "DTCStatusByte.TestNotCompletedThisMonitoringCycle",random(2));
//    DiagSetComplexParameter( respFaultMem, "LIST_OF_DTC_AND_STATUS", count, "DTCStatusByte.WarningIndicatorRequested",random(2));
//  }


  /* Sends the response object back to the tester. 
  Can only be called in the ECU simulation. */
  count = 0; 
  DiagSendResponse(respFaultMem);
}

on diagRequest Engine.Serial_Number_Read
{
  /* The server sends an identification datarecord included in the 
  ReadECUIdentification positive response message. */

  diagResponse this resp;

  if(!gDefaultSession)
  {
    //Service not supported in active diagnostic mode
    DiagSendNegativeResponse(this,0x80);
    return;
  }

  // Set the parameters in the response.
  DiagSetParameter( resp, "Serial_Number", gSerNum);

  /* Sends the response object back to the tester. 
  Can only be called in the ECU simulation. */
  DiagSendResponse( resp);
}

on diagRequest Engine.Development_Data_Read
{
  /* The server sends an identification datarecord included 
  in the ReadECUIdentification positive response message.*/

  diagResponse this resp;

  if(!gDefaultSession)
  {
    //Service not supported in active diagnostic mode
    DiagSendNegativeResponse(this,0x80);
    return;
  }

  /* Sets a parameter to the symbolically-specified value. This is possible 
  for all parameters, also numeric ones.  */
  DiagSetParameter( resp, "Operating_System_Version", 0x10);
  DiagSetParameter( resp, "CAN_Driver_Version", 0x32);
  DiagSetParameter( resp, "NM_Version", 0x99A4);
  DiagSetParameter( resp, "Diagnostic_Module_Version", 76);
  DiagSetParameter( resp, "Transport_Layer_Version", 98);

  /* Sends the response object back to the tester. 
  Can only be called in the ECU simulation. */
  DiagSendResponse( resp);
}

on diagRequest Engine.Coding_Write
{
  /* This service is used by the client to write record values 
  (data values) to a server. The data are identified by a Local 
  Identifier. */ 

  diagResponse this resp;

  if(!gProgrammingSession)
  {
    //Service not supported in active diagnostic mode
    DiagSendNegativeResponse(this,0x80);
    return;
  }

  /* Returns the value of the numeric parameter. */
  gCountryVar = DiagGetParameter(this, "Code_string.Country_variant");
  gVehicleType = DiagGetParameter(this, "Code_string.Vehicle_type");
  gSpecialSetting = DiagGetParameter(this, "Code_string.Special_setting");


  /* Sends the response object back to the tester. 
  Can only be called in the ECU simulation. */
  DiagSendResponse(resp);
}

on diagRequest Engine.Coding_Read
{
  /* The server sends an identification datarecord included 
  in the ReadECUIdentification positive response message.*/

  diagResponse this resp;

  if(!gDefaultSession)
  {
    //Service not supported in active diagnostic mode
    DiagSendNegativeResponse(this,0x80);
    return;
  }

  /* Sets a parameter to the symbolically-specified value. This is possible 
  for all parameters, also numeric ones.  */
  DiagSetParameter( resp, "Code_string.Country_variant", gCountryVar);
  DiagSetParameter( resp, "Code_string.Vehicle_type", gVehicleType);
  DiagSetParameter( resp, "Code_string.Special_setting", gSpecialSetting);

  /* Sends the response object back to the tester. 
  Can only be called in the ECU simulation. */
  DiagSendResponse( resp);
}

on diagRequest Engine.Tester_Present_Send_No_Response
{
  //send no response, because no response is required
}

on diagRequest Engine.Tester_Present_Send_Response
{
  diagResponse this diagResp;

  DiagSendResponse(diagResp);
}

on sysvar CruiseControl::CCTargetSpeedDecrease{
  if(@this==1){
    if(@sysvar::CruiseControl::CCTargetSpeed>=35){
      @sysvar::CruiseControl::CCTargetSpeed-=10;
    }
    else{
      @sysvar::CruiseControl::CCTargetSpeed=30;
    }
    previousCCTargetSpeed=@sysvar::CruiseControl::CCTargetSpeed;
  }
}

on sysvar CruiseControl::CCTargetSpeedIncrease{
  if(@this==1){
    if(@sysvar::CruiseControl::CCTargetSpeed<=215){
      @sysvar::CruiseControl::CCTargetSpeed+=10;
    }
    else{
      @sysvar::CruiseControl::CCTargetSpeed=220;
    }
    previousCCTargetSpeed=@sysvar::CruiseControl::CCTargetSpeed;
  }
}

on sysvar CruiseControl::CCTargetSpeed{
  if(@this>220){
    write("Error while setting cruise control target speed: The target speed cannot exceed 220 km/h");
    @sysvar::CruiseControl::CCTargetSpeed=previousCCTargetSpeed;
  }
  else if(@this<30){
    write("Error while setting cruise control target speed: The target speed cannot be less than than 30 km/h");
    @sysvar::CruiseControl::CCTargetSpeed=previousCCTargetSpeed;
  }
  previousCCTargetSpeed=@sysvar::CruiseControl::CCTargetSpeed;
}

