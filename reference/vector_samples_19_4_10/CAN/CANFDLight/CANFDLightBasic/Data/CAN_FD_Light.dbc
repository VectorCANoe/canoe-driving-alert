VERSION ""

NS_ :

BS_:

BU_: Engine Gateway

BO_ 3221225472 VECTOR__INDEPENDENT_SIG_MSG: 0 Vector__XXX
 SG_ EngInjectionVol : 0|64@1- (1,0) [0|0] "" Vector__XXX
 SG_ FallbackMessage_Byte_06_10 : 0|48@0- (1,0) [0|0] "" Vector__XXX
 SG_ FallbackMessage_Byte_00_05 : 0|48@0- (1,0) [0|0] "" Vector__XXX
 SG_ DropOutMessage_Byte_06_10 : 0|48@0- (1,0) [0|0] "" Vector__XXX
 SG_ DropOutMessage_Byte_00_05 : 0|48@0- (1,0) [0|0] "" Vector__XXX
 SG_ StarterKey : 0|1@1+ (1,0) [0|1] "" Vector__XXX
 SG_ SleepInd : 0|1@1+ (1,0) [0|1] "" Vector__XXX
 SG_ Gear : 0|3@1+ (1,0) [0|5] "" Vector__XXX
 SG_ EngStatusFD_FillByte4 : 0|16@1- (1,0) [0|0] "" Vector__XXX
 SG_ EngStatusFD_FillByte3 : 0|24@1- (1,0) [0|0] "" Vector__XXX
 SG_ EngStatusFD_FillByte2 : 0|8@1- (1,0) [0|0] "" Vector__XXX
 SG_ EngStatusFD_FillByte1 : 0|8@1- (1,0) [0|0] "" Vector__XXX
 SG_ ErrorCode : 0|6@1+ (1,0) [0|0] "" Vector__XXX
 SG_ Status : 0|2@1+ (1,0) [0|0] "" Vector__XXX
 SG_ AccelarationForce : 0|16@1+ (1,-10000) [0|0] "N" Vector__XXX
 SG_ Diagnostics : 0|8@1+ (1,0) [0|0] "" Vector__XXX
 SG_ GearLock : 0|1@1+ (1,0) [0|0] "" Vector__XXX
 SG_ CarSpeed : 0|10@1+ (0.5,0) [0|300] "mph" Vector__XXX

BO_ 1012 TestBroadcast: 64 Vector__XXX
 SG_ Test_signal_Byte_56_62 : 448|52@1- (1,0) [-2.25179981368525E+15|2.25179981368525E+15] "" Vector__XXX
 SG_ Test_signal_Byte_49_55 : 392|52@1- (1,0) [-2.25179981368525E+15|2.25179981368525E+15] "" Vector__XXX
 SG_ Test_Signal_Byte_63 : 504|8@1- (1,0) [0|0] "" Vector__XXX
 SG_ Test_Signal_Byte_06_09 : 48|32@1- (1,0) [0|0] "" Vector__XXX
 SG_ Test_Signal_Byte_03_05 : 24|24@1- (1,0) [0|0] "" Vector__XXX
 SG_ Test_signal_Byte_42_48 : 336|52@1- (1,0) [-2.25179981368525E+15|2.25179981368525E+15] "" Vector__XXX
 SG_ Test_Signal_Byte_35_41 : 280|52@1- (1,0) [-2.25179981368525E+15|2.25179981368525E+15] "" Vector__XXX
 SG_ Test_Signal_Byte_28_34 : 224|52@1- (1,0) [-2.25179981368525E+15|2.25179981368525E+15] "" Vector__XXX
 SG_ Test_Signal_Byte_21_27 : 168|52@1- (1,0) [-2.25179981368525E+15|2.25179981368525E+15] "" Vector__XXX
 SG_ Test_Signal_Byte_15_20 : 120|48@1- (1,0) [-140737488355328|140737488355327] "" Vector__XXX
 SG_ Test_Signal_Byte_10_14 : 80|40@1- (1,0) [0|0] "" Vector__XXX
 SG_ Test_Signal_Byte_01_02 : 8|16@1- (1,0) [0|0] "" Vector__XXX
 SG_ Test_Signal_Byte_00 : 0|8@1- (1,0) [0|0] "" Vector__XXX

BO_ 766 TestUnicast: 64 Engine
 SG_ Test_signal_Byte_56_62 : 448|52@1- (1,0) [-2.25179981368525E+15|2.25179981368525E+15] "" Vector__XXX
 SG_ Test_signal_Byte_49_55 : 392|52@1- (1,0) [-2.25179981368525E+15|2.25179981368525E+15] "" Vector__XXX
 SG_ Test_Signal_Byte_63 : 504|8@1- (1,0) [0|0] "" Vector__XXX
 SG_ Test_Signal_Byte_06_09 : 48|32@1- (1,0) [0|0] "" Vector__XXX
 SG_ Test_Signal_Byte_03_05 : 24|24@1- (1,0) [0|0] "" Vector__XXX
 SG_ Test_signal_Byte_42_48 : 336|52@1- (1,0) [-2.25179981368525E+15|2.25179981368525E+15] "" Vector__XXX
 SG_ Test_Signal_Byte_35_41 : 280|52@1- (1,0) [-2.25179981368525E+15|2.25179981368525E+15] "" Vector__XXX
 SG_ Test_Signal_Byte_28_34 : 224|52@1- (1,0) [-2.25179981368525E+15|2.25179981368525E+15] "" Vector__XXX
 SG_ Test_Signal_Byte_21_27 : 168|52@1- (1,0) [-2.25179981368525E+15|2.25179981368525E+15] "" Vector__XXX
 SG_ Test_Signal_Byte_15_20 : 120|48@1- (1,0) [-140737488355328|140737488355327] "" Vector__XXX
 SG_ Test_Signal_Byte_10_14 : 80|40@1- (1,0) [0|0] "" Vector__XXX
 SG_ Test_Signal_Byte_01_02 : 8|16@1- (1,0) [0|0] "" Vector__XXX
 SG_ Test_Signal_Byte_00 : 0|8@1- (1,0) [0|0] "" Vector__XXX

BO_ 254 TestResponse: 64 Engine
 SG_ EngKnocking : 464|48@1- (1,0) [0|0] "" Vector__XXX
 SG_ EngIgnitionAngle : 400|64@1- (1,0) [0|0] "" Vector__XXX
 SG_ EngStates : 336|64@1- (1,0) [0|0] "" Vector__XXX
 SG_ EngValvePos : 272|64@1- (1,0) [0|0] "" Vector__XXX
 SG_ EngTubePressure : 208|64@1- (1,0) [0|0] "" Vector__XXX
 SG_ SleepInd : 201|1@1+ (1,0) [0|1] "" Vector__XXX
 SG_ ShiftRequest : 200|1@1+ (1,0) [0|0] "" Vector__XXX
 SG_ Gear : 44|3@1+ (1,0) [0|5] "" Vector__XXX
 SG_ EcoMode : 42|2@1+ (1,0) [0|1] "" Vector__XXX
 SG_ EngTorque : 128|64@1- (1,0) [0|0] "" Vector__XXX
 SG_ EngSpeed : 96|16@1- (1,0) [-32768|32767] "rpm" Vector__XXX
 SG_ EngForce : 64|32@1- (1,0) [0|0] "N" Vector__XXX
 SG_ PetrolLevel : 24|8@1+ (1,0) [0|255] "l" Vector__XXX
 SG_ EngPower : 48|16@1+ (0.01,0) [0|150] "kW" Vector__XXX
 SG_ IdleRunning : 15|1@1+ (1,0) [0|0] "" Vector__XXX
 SG_ EngTemp : 16|7@1+ (2,-50) [-50|150] "degC" Vector__XXX

CM_ BO_ 3221225472 "This is a message for not used signals, created by Vector CANdb++ DBC OLE DB Provider.";
BA_DEF_ SG_  "GenSigSendType" ENUM  "Cyclic","OnWrite","OnWriteWithRepetition","OnChange","OnChangeWithRepetition","IfActive","IfActiveWithRepetition","NoSigSendType","NotUsed","NotUsed","NotUsed","NotUsed","NotUsed";
BA_DEF_ BO_  "GenMsgSendType" ENUM  "Cyclic","NotUsed","NotUsed","NotUsed","NotUsed","Cyclic","NotUsed","IfActive","NoMsgSendType","NotUsed","vector_leerstring";
BA_DEF_ BO_  "GenMsgCycleTime" INT 0 50000;
BA_DEF_ BO_  "GenMsgILSupport" ENUM  "No","Yes";
BA_DEF_  "NmBaseAddress" HEX 1024 1087;
BA_DEF_ BO_  "CANFD_BRS" ENUM  "0","1";
BA_DEF_  "DBName" STRING ;
BA_DEF_  "BusType" STRING ;
BA_DEF_ BU_  "NodeLayerModules" STRING ;
BA_DEF_ BO_  "VFrameFormat" ENUM  "StandardCAN","ExtendedCAN","reserved","reserved","reserved","reserved","reserved","reserved","reserved","reserved","reserved","reserved","reserved","reserved","StandardCAN_FD","ExtendedCAN_FD";
BA_DEF_DEF_  "GenSigSendType" "Cyclic";
BA_DEF_DEF_  "GenMsgSendType" "NoMsgSendType";
BA_DEF_DEF_  "GenMsgCycleTime" 0;
BA_DEF_DEF_  "GenMsgILSupport" "Yes";
BA_DEF_DEF_  "NmBaseAddress" 1024;
BA_DEF_DEF_  "CANFD_BRS" "1";
BA_DEF_DEF_  "DBName" "";
BA_DEF_DEF_  "BusType" "";
BA_DEF_DEF_  "NodeLayerModules" "";
BA_DEF_DEF_  "VFrameFormat" "StandardCAN";
BA_ "BusType" "CAN FD";
BA_ "DBName" "CAN_FD_Powertrain";
BA_ "NodeLayerModules" BU_ Engine "CANoeILNLVector.dll";
BA_ "NodeLayerModules" BU_ Gateway "CANoeILNLVector.dll";
BA_ "CANFD_BRS" BO_ 1012 0;
BA_ "GenMsgCycleTime" BO_ 1012 100;
BA_ "VFrameFormat" BO_ 1012 14;
BA_ "GenMsgCycleTime" BO_ 766 100;
BA_ "CANFD_BRS" BO_ 766 0;
BA_ "VFrameFormat" BO_ 766 14;
BA_ "CANFD_BRS" BO_ 254 0;
BA_ "GenMsgCycleTime" BO_ 254 100;
BA_ "VFrameFormat" BO_ 254 14;
BA_ "GenSigSendType" SG_ 3221225472 FallbackMessage_Byte_06_10 7;
BA_ "GenSigSendType" SG_ 3221225472 FallbackMessage_Byte_00_05 7;
BA_ "GenSigSendType" SG_ 3221225472 DropOutMessage_Byte_06_10 7;
BA_ "GenSigSendType" SG_ 3221225472 DropOutMessage_Byte_00_05 7;
BA_ "GenSigSendType" SG_ 3221225472 SleepInd 1;
BA_ "GenSigSendType" SG_ 254 SleepInd 1;
VAL_ 3221225472 Gear 0 "Idle" 1 "Gear_1" 2 "Gear_2" 3 "Gear_3" 4 "Gear_4" 5 "Gear_5" ;
VAL_ 3221225472 Status 3 "Error" 2 "GoSleep" 1 "Running" 0 "WakeUp" ;
VAL_ 3221225472 GearLock 1 "Gear_Lock_On" 0 "Gear_Lock_Off" ;
VAL_ 254 ShiftRequest 1 "Shift_Request_On" 0 "Shift_Request_Off" ;
VAL_ 254 Gear 0 "Idle" 1 "Gear_1" 2 "Gear_2" 3 "Gear_3" 4 "Gear_4" 5 "Gear_5" ;
VAL_ 254 IdleRunning 0 "Running" 1 "Idle" ;
SIG_VALTYPE_ 254 EngForce : 1;
