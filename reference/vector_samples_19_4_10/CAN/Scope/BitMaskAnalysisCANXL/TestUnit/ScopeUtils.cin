/*@!Encoding:1252*/
includes
{
    #include "scope\ScopeBitAnalyse.cin"
}

variables
{
  char scopeTestStepName[256];

  const long domVoltageThreshold = 900; //mV
  const long recVoltageThreshold = 500; // mV

  //bit masks used for analysis
  ScopeBitMaskPolygon bitMaskArb;
  ScopeBitMaskPolygon bitMaskData;

  
  //bit lengths in ns
  double bitLengthArb, bitLengthBRS, bitLengthData, bitLengthCRCdel;

  //the one and only analysis handle used for all analysis functions
  ScopeAnalyseHandle scopeAnlyzHandle = {Handle = 999};
  
  long maxNumOfErrorsToShow = 20; //max. number of errors added in test report
  
  BitTiming communicationSettings[3];
}

int CheckStatusInternal(long status, char text[])
{
 char statusMessage[255];
 if(status <= 0)
 {
   GetStatusCodeAsMessage(status, statusMessage, elcount(statusMessage));
   testStepFail(scopeTestStepName, " Internal error in %s, %s(%d)", text, statusMessage, status);
   return 0;
 }
 return 1;
}

int DoScopeConnect()
{
  long res;
  res = scopeConnect();
  if(!CheckStatusInternal(res, "scopeConnect"))return 0; 

  if(res == 2) return 1;

  if(res < 0)
    return res;
  
  res = testWaitForScopeEvent(eScopeConnected, 8000);
  if(!CheckStatusInternal(res, "scopeConnect"))return 0; 
  return 1;
}

int DoScopeTrigger()
{
  long res;
  res = scopeTriggerNow();
  if(!CheckStatusInternal(res, "scopeTriggerNow")) return 0;

  // wait till action done
  res =(testWaitForScopeEvent(eScopeTriggered, 5000));
  if(!CheckStatusInternal(res, "scopeTriggerNow")) return 0;

  return 1; 
}

int DoGetCAPLViolationMask(ScopeAnalyseHandle handle, long index, ScopeMaskViolationData maskViolationData)
{
  long res;
  res = TestWaitScopeGetMaskViolation(handle, index, maskViolationData);
  if(!CheckStatusInternal(res, "TestWaitScopeGetMaskViolation")) return 0;

  return 1;
}

int ShowBitMask(ScopeAnalyseHandle handle, int invalidMaskNumber, ScopeMaskViolationData bitMaskViolation, ScopeBitMaskPolygon bitMaskPolygon, double bitLength)
{
  const int   textlen = 512;
  char        text[textlen], bitFieldName[textlen];

  if(0) //sometimes write window messages are helpful
  {
    write("Output violated bit mask: \n");
    write("CorruptBitField: %d", bitMaskViolation.bitField);  
    write("ErrorType: %d", bitMaskViolation.ErrorType);  
    write("BitIndex: %d", bitMaskViolation.bitNo);  
    write("bitStartTime: %.6fs", bitMaskViolation.bitStartTime/1000000000.);  //in ns : Bit-Start bzgl. Simulationszeit (Zeitbezugspunkt)
    write("thresholdTimeOffset: %d", bitMaskViolation.thresholdTimeOffset); //distance to bit start in ns - Threshold-Zeit bzgl. Bit-Sart
    write("disturbanceTimeStart: %d", bitMaskViolation.disturbanceTimeStart);	//distance of disturbance to bit start in ns - Start der Störung bzg. Bit-Start
    write("disturbanceTimeEnd: %d", bitMaskViolation.disturbanceTimeEnd);	//distance of end of disturbance to bit start in ns - Ende der Störung bzg. Bit-Start
    write("sample point voltage: %d", bitMaskViolation.samplePointVoltage);	//distance of end of disturbance to bit start in ns - Ende der Störung bzg. Bit-Start
    write("ThresholdVoltage: %d", bitMaskViolation.ThresholdVoltage);// threshold level in mV realtive to scope ground
  }
  
  
  GetCANBitFieldName(bitMaskViolation.bitField, bitFieldName, elcount(bitFieldName));
  
  snprintf(text, textlen, "Error #%d: bit field %s, bit %d. The start of the disturbance was found at %d ns after start of bit (%.2f%% of the bit). The disturbance length is %d ns, %.2f%% of the bit is disturbed (configured bit length: %d ns)." 
              , invalidMaskNumber
              , bitFieldName
              , bitMaskViolation.bitNo
              , bitMaskViolation.disturbanceTimeStart - bitMaskViolation.thresholdTimeOffset
              , (bitMaskViolation.disturbanceTimeStart - bitMaskViolation.thresholdTimeOffset)/bitLength*100
              , bitMaskViolation.disturbanceTimeEnd-bitMaskViolation.disturbanceTimeStart
              , ((double)(bitMaskViolation.disturbanceTimeEnd-bitMaskViolation.disturbanceTimeStart))/bitLength*100
              , (int)bitLength);

 return DoShowBitMask(handle, bitMaskViolation.bitField, bitMaskViolation.bitNo, @sysvar::BitmaskTest::BitsShown, text);
}

int DoBitAnlyz(ScopeBitMaskPolygon bitMask, dword startField, dword endField, char text[], double bitLength)
{
  long res;
  int i;
  const int testRepetitions = 3;
  const long textLength = 256;
  char text1[textLength], bitNameStartField[textLength], bitNameEndField[textLength], statusText[textLength];
  
  long flags, numOfInValidMasks, invalidMaskNumber;
 
  GetCANBitFieldName(startField, bitNameStartField, elcount(bitNameStartField));
  GetCANBitFieldName(endField, bitNameEndField, elcount(bitNameEndField));
  
  if(startField != endField) testReportAddExtendedInfo("text", "Analysing bits from %s to %s", bitNameStartField, bitNameEndField);
  else testReportAddExtendedInfo("text", "Analysing bit %s", bitNameStartField);
  
  flags = 0;

  for(i=0;;++i)
  {
    numOfInValidMasks = TestWaitScopeAnalyseSignal(canTestMessage, flags, startField, endField, bitMask, domVoltageThreshold, recVoltageThreshold, scopeAnlyzHandle);
    if(numOfInValidMasks < 0)
    {
      GetStatusCodeAsMessage(numOfInValidMasks, statusText, textLength);
      if(i<testRepetitions)
      {
        testStepWarning(testStepName, " Internal error %s return %s(%d)", "TestWaitScopeAnalyseSignal", statusText, numOfInValidMasks);
      }
      else
      {
        testStepFail(testStepName, " Internal error %s return code %s (%d)", "TestWaitScopeAnalyseSignal", statusText, numOfInValidMasks);
        return 0;
      }
    }
    else break;
  }
  if(numOfInValidMasks == 0)
  {
    //no mask violations found
    snprintf(text1, textLength, "First bit(s) of the analyzed cutout");
    DoShowBitMask(scopeAnlyzHandle, startField, 0,@sysvar::BitmaskTest::BitsShown, text1);
  }
  else if(numOfInValidMasks > 0)
  {
    //there are bit mask violations
    testStepFail(scopeTestStepName, "%d bit mask violations found.", numOfInValidMasks);

    //iterate through all erroneous bits, make a screen shot, and  add a description to the test report
    for(invalidMaskNumber = 1; invalidMaskNumber <= numOfInValidMasks && invalidMaskNumber <= @sysvar::BitmaskTest::BitViolationCount; ++invalidMaskNumber)
    {
      ScopeMaskViolationData maskViolationData;
      
      if(DoGetCAPLViolationMask(scopeAnlyzHandle, invalidMaskNumber, maskViolationData))
      {
        
        res = ShowBitMask(scopeAnlyzHandle, invalidMaskNumber, maskViolationData, bitMask, bitLength);
        if(res == 0)
          break;
      }
    }
  }
  
  //get average voltages
  if(startField != endField)
  {
   
    ScopeMaskViolationData maskViolationData;
    res = testWaitScopeGetBitInfo(scopeAnlyzHandle, startField, 0, endField, 0, maskViolationData);
    if(!CheckStatusInternal(res, "testWaitScopeGetBitInfo")) return 0;
    
    TestReportAddExtendedInfo("text", "Average voltages:\nCAN high dominant = %d mV, CAN high recessive = %d mV\nCAN low dominant = %d mV, CAN low recessive = %d mV\nCAN diff dominant = %d mV, CAN diff recessive = %d mV", 
     maskViolationData.domVoltageCANH, maskViolationData.recVoltageCANH,
     maskViolationData.domVoltageCANL, maskViolationData.recVoltageCANL,
     maskViolationData.domVoltageDiff, maskViolationData.recVoltageDiff);
  }
  return 1;
}


int DoShowBitMask(ScopeAnalyseHandle handle, long msgFieldStart, long bitIndex, long bitCount, char text[])
{
  long res;

  //display the cutout in the scope window
  res = TestWaitScopeShowMask(handle, msgFieldStart, bitIndex, bitCount);
  if(res != 1) 
  {
    testStepFail(scopeTestStepName, " Internal error in TestWaitScopeShowMask, return code = %d", res);
    return 0;
  }

  //make a scrren shot and add it to the test report
  TestReportAddWindowCapture("Scope", scopeTestStepName, text);
  
  return 1;
}

int DoScopeDisconnect()
{
  long res;
  
  res = scopeDisconnect();
  if(!CheckStatusInternal(res, "scopeDisconnect")) return 0;

  res =testWaitForScopeEvent(eScopeDisconnected, 8000);
  if(!CheckStatusInternal(res, "scopeDisconnect")) return 0;

  return 1;
}

int RequestCurrentCommunicationParameters()
{
  communicationSettings[0].BitTimingPhase = eCANNominalPhase;
  communicationSettings[1].BitTimingPhase = eCANFDPhase;
  communicationSettings[2].BitTimingPhase = eCANXLPhase;
  
  if(GetCanBitTimingConfiguration(%CHANNEL%, communicationSettings, 3))
  {
    return 0;
  }
  
  return 1;
}

//init the default bit mask used for arbitration phase bits
int InitBitMaskArbitration()
{
  double arbSamplingPointInPercent;
  
  if(RequestCurrentCommunicationParameters())
  {
    arbSamplingPointInPercent = GetSamplingPointInPercent(communicationSettings[0].Tseg1, communicationSettings[0].Tseg2);
    bitLengthArb = 1e9/communicationSettings[0].Bitrate;
    
    bitMaskArb.maskPointCount = 4;
    bitMaskArb.data_0_Mask[0] = domVoltageThreshold; //mV
    bitMaskArb.data_0_Mask[1] = domVoltageThreshold + 1000; //mV
    bitMaskArb.data_0_Mask[2] = domVoltageThreshold + 1000; //mV
    bitMaskArb.data_0_Mask[3] = domVoltageThreshold; //mV
    
    bitMaskArb.data_1_Mask[0] = recVoltageThreshold; //mV
    bitMaskArb.data_1_Mask[1] = recVoltageThreshold /4; //mV
    bitMaskArb.data_1_Mask[2] = recVoltageThreshold /4; //mV
    bitMaskArb.data_1_Mask[3] = recVoltageThreshold; //mV
    
    bitMaskArb.timeOffset[0] = 30 ; // in %
    bitMaskArb.timeOffset[1] = 35; // in %
    bitMaskArb.timeOffset[2] = arbSamplingPointInPercent + (100.0 - arbSamplingPointInPercent)/3; // in %
    bitMaskArb.timeOffset[3] = arbSamplingPointInPercent + (100.0 - arbSamplingPointInPercent)/2; // in %
    
    return 1;
  }
  
  return 0;
}

//init the default bit mask used for data phase bits (CAN FD only)
int  InitBitMaskData()
{
  int result;
  double dataSamplingPointInPercent;
  CanChannelOption channelOption;

  channelOption.OptionTag = eCANChannelOptionTransceiverFastMode;
  result = GetCanChannelOption(%CHANNEL%, channelOption);
  

  if(RequestCurrentCommunicationParameters())
  {
    dataSamplingPointInPercent = GetSamplingPointInPercent(communicationSettings[2].Tseg1, communicationSettings[2].Tseg2);
    
    write("Bitrate [0] %f",communicationSettings[0].Bitrate);
    write("Bitrate [1] %f",communicationSettings[1].Bitrate);
    write("Bitrate [2] %f",communicationSettings[2].Bitrate);
    
    bitLengthData = 1e9/communicationSettings[2].Bitrate;
    
    if(channelOption.OptionValue == 1) //TFM mode active
    {
       bitMaskData.maskPointCount = 4;
       bitMaskData.data_0_Mask[0] = 0 ; //mV
       bitMaskData.data_0_Mask[1] = 300; //mV
       bitMaskData.data_0_Mask[2] = 300; //mV
       bitMaskData.data_0_Mask[3] = 0; //mV
       
       bitMaskData.data_1_Mask[0] = 0; //mV
       bitMaskData.data_1_Mask[1] = -300; //mV
       bitMaskData.data_1_Mask[2] = -300; //mV
       bitMaskData.data_1_Mask[3] = 0; //mV
       
       bitMaskData.timeOffset[0] = 50 ; // in %
       bitMaskData.timeOffset[1] = 50; // in %
       bitMaskData.timeOffset[2] = 62; // in %
       bitMaskData.timeOffset[3] = 62; // in %
    }
    else  
    {
      bitMaskData.maskPointCount = 4;
      bitMaskData.data_0_Mask[0] = domVoltageThreshold ; //mV
      bitMaskData.data_0_Mask[1] = domVoltageThreshold + 1000; //mV
      bitMaskData.data_0_Mask[2] = domVoltageThreshold + 1000; //mV
      bitMaskData.data_0_Mask[3] = domVoltageThreshold ; //mV
      
      bitMaskData.data_1_Mask[0] = recVoltageThreshold; //mV
      bitMaskData.data_1_Mask[1] = recVoltageThreshold/4; //mV
      bitMaskData.data_1_Mask[2] = recVoltageThreshold/4; //mV
      bitMaskData.data_1_Mask[3] = recVoltageThreshold; //mV
      
      bitMaskData.timeOffset[0] = 30 ; // in %
      bitMaskData.timeOffset[1] = 35; // in %
      bitMaskData.timeOffset[2] = dataSamplingPointInPercent + (100 - dataSamplingPointInPercent)/3; // in %
      bitMaskData.timeOffset[3] = dataSamplingPointInPercent + (100 - dataSamplingPointInPercent)/2; // in %
    }
    return 1;
  }
  
  return 0;
}

void ModifyMaskToProvokeError()
{
   double arbSamplingPointInPercent;
   CanChannelOption channelOption;
   channelOption.OptionTag = eCANChannelOptionTransceiverFastMode;
   GetCanChannelOption(%CHANNEL%, channelOption);
  
   if(channelOption.OptionValue == 1)
   {
     arbSamplingPointInPercent = GetSamplingPointInPercent(communicationSettings[0].Tseg1, communicationSettings[0].Tseg2);
     bitMaskData.timeOffset[2] = arbSamplingPointInPercent + (100.0 - arbSamplingPointInPercent)/2; // in %
     bitMaskData.timeOffset[3]  = arbSamplingPointInPercent + (100.0 - arbSamplingPointInPercent)*1.2; // in %
   }
   else
   {
    arbSamplingPointInPercent = GetSamplingPointInPercent(communicationSettings[0].Tseg1, communicationSettings[0].Tseg2);
    bitMaskData.timeOffset[2] = arbSamplingPointInPercent + (100.0 - arbSamplingPointInPercent)/2; // in %
    bitMaskData.timeOffset[3]  = arbSamplingPointInPercent + (100.0 - arbSamplingPointInPercent)*0.75; // in %
   }
}


testfunction AddBitmaskInfoCANFD()
{
  TestReportAddMiscInfoBlock("Bit mask settings");

  AddSetupInfo(bitMaskArb,  "Arbitration phase mask");
  AddSetupInfo(bitMaskData, "Data phase mask");
}

testfunction AddBitmaskInfoCANClassic()
{
  TestReportAddMiscInfoBlock("Bit mask settings");

  AddSetupInfo(bitMaskArb,  "Bit mask");
}

void AddSetupInfo(ScopeBitMaskPolygon bitmask, char name[])
{
  int i;
  const long bufLength = 512;
  char buffer[bufLength], buffer1[bufLength];
  
  i = 0;
  snprintf(buffer1, bufLength, "%2.2f%%%% (%4d mV, %4d mV)", bitmask.timeOffset[i], bitmask.data_0_Mask[i], bitmask.data_1_Mask[i]);
  for(i=1;i< bitmask.maskPointCount; ++i)
  {
    snprintf(buffer, bufLength, ", %2.2f%%%% (%4d mV, %4d mV)", bitmask.timeOffset[i], bitmask.data_0_Mask[i], bitmask.data_1_Mask[i]);
    strncat(buffer1, buffer, bufLength);
  }
  TestReportAddMiscInfo(name, buffer1);
}

double GetSamplingPointInPercent(long tseg1, long tseg2)
{
  return 100.0 * (1. + tseg1)/(1. + tseg1 + tseg2);
}


