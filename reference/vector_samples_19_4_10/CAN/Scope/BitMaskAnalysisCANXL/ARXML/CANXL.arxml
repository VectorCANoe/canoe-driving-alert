AUTOSAR XML (schema 00050)
package /VectorAutosarExplorerGeneratedObjects/SYSTEM
  system System
package /VectorAutosarExplorerGeneratedObjects/New_CanCluster
  can cluster New_CanCluster: baudrate=500000, protocol-name=CAN, speed=250000, can-fd-baudrate=5000000, can-xl-baudrate=8000000
    can physical channel CANXLChannel: comm-connectors=Connector_SUT_710d4d3e2289df96
      frame SUT_Frame: id 0x200, from SUT, frame-length=2048, can-xl-frame-triggering-props={acceptance-field=0, priority-id=544, sdu-type=1, vcid=0}, can-addressing-mode=STANDARD, can-frame-tx-behavior=CAN-20
        pdu SUT_PDU: length=2048
          signal Sinus: start 0, 16 bit, little-endian, system signal Sinus_5567891b3fa4c877, data-type-policy=OVERRIDE, base-type=New_BaseType
          signal Rectangle: start 16, 16 bit, little-endian, system signal Rectangle_b9d49db2fcd1aa4d, data-type-policy=OVERRIDE, base-type=New_BaseType
package /VectorAutosarExplorerGeneratedObjects/ECU_INSTANCES
  ecu instance SUT: associated-com-i-pdu-group=PduGroup_0d19da25fa594381abd9f229c9658dac_Tx, diagnostic-address=0
    can communication controller Controller_SUT_cf122a3f9fdc338c: can-controller-attributes=can-controller-configuration=can-controller-xl-attributes={error-signaling-enabled=True, prop-seg=0, sync-jump-width=9, time-seg-1=10, time-seg-2=9, trcv-pwm-mode-enabled=False}
    can communication connector Connector_SUT_710d4d3e2289df96: comm-controller=Controller_SUT_cf122a3f9fdc338c
package /VectorAutosarExplorerGeneratedObjects/BASE_TYPES
  base type New_BaseType: base-type-size=16, base-type-encoding=NONE
package /VectorAutosarExplorerGeneratedObjects/PDU_GROUP
  i signal i pdu group PduGroup_0d19da25fa594381abd9f229c9658dac_Tx: communication-direction=OUT
