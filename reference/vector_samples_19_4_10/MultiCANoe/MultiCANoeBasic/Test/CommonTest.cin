/*@!Encoding:65001*/
includes
{
}

variables
{
  const int cMaxTestExecutionTimeMs = 11000;
  const int cTestCount = 10;
}

void WaitForCounter(sysvarInt * counterSysVar, int countValue)
{
  for(;;)
  {
    TestWaitForSysVar(counterSysVar, 1000);
    if (@counterSysVar == countValue)
    {
      break;
    }
  }
}

void CountingTest(char testName[], sysvarInt * startCounter, sysvarInt * count, int finalCount)
{
  @count = 0;
  @startCounter = 1;
  WaitForCounter(count, finalCount);
  @startCounter = 0;

  if (@count == finalCount)
  {
    TestStepPass(testName, "Counted successfully to %d", finalCount);
  }
  else
  {
    TestStepFail(testName, "Did not count to %d, counter-value = %d", finalCount, @count);
  }
}

void VerifyCount(char testName[], sysvarInt * count, int expected)
{
  if (@count == expected)
  {
    TestStepPass(testName, "Counter has expected value: %d", expected);
  }
  else
  {
    TestStepFail(testName, "Counter has unexpected value: %d (expected: %d)", @count, expected);
  }
  // When executed with Virtual CAN this test is too short and will trigger data race warnings, thus we extend the
  // execution of the test
  TestWaitForTimeout(100);
}

testcase EndDistributedTest()
{
  int i;

  #if AGENT
  // This function is called almost simultaneously in the agent and coordinator, thus we have to
  // postpone the execution in one instance, otherwise we can get a data race for the
  // SuccessfulTestModules variable.
  TestWaitForTimeout(100);
  #endif
  @sysvar::MultiCANoe::Control::Test::SuccessfulTestModules++;

  // Reset variables ExecuteTests, CoordinatorTestRunning and AgentTestRunning from both, Coordinator and Agent,
  // to ensure a valid state even if a test is cancelled by user
  if (@sysvar::MultiCANoe::Control::Test::ExecuteTests != 0) @sysvar::MultiCANoe::Control::Test::ExecuteTests = 0;
  if (@sysvar::MultiCANoe::Control::Test::CoordinatorTestRunning != 0) @sysvar::MultiCANoe::Control::Test::CoordinatorTestRunning = 0;
  if (@sysvar::MultiCANoe::Control::Test::AgentTestRunning != 0) @sysvar::MultiCANoe::Control::Test::AgentTestRunning = 0;

  for (i = 0; i < 2 ; i++)
  {
    if (@sysvar::MultiCANoe::Control::Test::SuccessfulTestModules < 2)
    {
      TestWaitForSysVar(sysvar::MultiCANoe::Control::Test::SuccessfulTestModules, 1000);
    }
  }
  if (@sysvar::MultiCANoe::Control::Test::SuccessfulTestModules == 2)
  {
    TestStepPass("All tests successful");
  }
  else
  {
    TestStepFail("Some tests failed");
  }
}
