/*@!Encoding:65001*/
includes
{
  #include "CommonSimultaneousEvent.cin"
}

variables
{
}

on timer simultaneousTimer
{
  // This timer is fired in all Multi CANoe participants 10 ms after the 'TriggerSimultaneousEvents'
  // system variable is set.
  message CAN1.AgentMessage canMsg;
  output(canMsg);
  @MultiCANoe::Events::SysVarEventAgent++;
}
