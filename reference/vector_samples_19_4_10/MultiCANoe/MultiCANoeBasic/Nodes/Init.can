/*@!Encoding:65001*/
includes
{
  #if MULTI_CANOE
  #include "MultiCanoeClusterRunning.cin"
  #endif
}

variables
{
}

on start
{
  // The 'on start' handler is called before the cluster is complete. Nevertheless, it is safe to
  // assign Multi CANoe system variables because once the cluster is running, the system variables
  // are synchronized.
  @sysvar::MultiCANoe::Control::CounterDelay = 100;
  @sysvar::MultiCANoe::Control::CountInAgent = 0;
  @sysvar::MultiCANoe::Control::CountInAll = 0;
  @sysvar::MultiCANoe::Control::CountInCoordinator = 0;
  @sysvar::MultiCANoe::Control::StartSystem = 0;
  @sysvar::MultiCANoe::Control::Test::ExecuteTests = 0;

  #if MULTI_CANOE
  write("Multi CANoe is enabled!");
  // start message is sent in 'on sysvar CANoe::MultiCANoeClusterRunning' (see MultiCanoeClusterRunning.cin)
  #else
  write("Multi CANoe is disabled!");
  SendStartMessage(); // send start message directly because we do not have to wait for other CANoe instances
  #endif
}

void SendStartMessage()
{
  message CAN1.StartMessage canMsg;
  output(canMsg);
}

on sysvar MultiCANoe::Control::Test::ExecuteTests
{
  if (@this == 1 && @MultiCANoe::Control::Test::CoordinatorTestRunning == 0)
  {
    @MultiCANoe::Control::Test::ExecuteTestOnCoordinator = 1;
  }
}
