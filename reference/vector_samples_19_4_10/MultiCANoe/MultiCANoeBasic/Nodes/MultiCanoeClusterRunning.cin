/*@!Encoding:65001*/
includes
{
}

variables
{
}

on sysvar CANoe::MultiCANoeClusterRunning
{
  // If a CAN message is sent in 'on start' it might not reach all Multi CANoe participants because
  // they might not yet be fully up and running. Thus, bus communication that should reach all
  // Multi CANoe participants should wait for the Multi CANoe cluster to be running.
  SendStartMessage();
}
