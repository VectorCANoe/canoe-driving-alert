/*@!Encoding:65001*/
includes
{
  // declare common handlers for all counters in CommonCounter.cin
  #include "CommonCounter.cin"
}

variables
{
  msTimer counterTimer;
}

on start
{
  @MultiCANoe::Counter::CounterCoordinator = 0;
}

on sysvar MultiCANoe::Control::CountInCoordinator
{
  programCounterTimer();
}

void programCounterTimer()
{
  if(@MultiCANoe::Control::StartSystem && @MultiCANoe::Control::CountInCoordinator)
  {
    setTimerCyclic(counterTimer, @MultiCANoe::Control::CounterDelay);
  }
  else
  {
    cancelTimer(counterTimer);
  }
}

on timer counterTimer
{
  @MultiCANoe::Counter::CounterCoordinator++;
}
