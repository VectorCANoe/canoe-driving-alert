/*@!Encoding:1252*/
includes
{
  
}

variables
{
  msTimer heartVisibilityTimer;
}

on preStart{
  setControlVisibility("Start and Stop Sending Sample Data to SUT", "LeftExclamationMark", 0);
  setControlVisibility("Start and Stop Sending Sample Data to SUT", "RightExclamationMark", 0);
}

on start{
  heartVisibilityTimer.set(100);
}

on value_update SampleDataControl.isEmergencySimulationRunning{
  if ($SampleDataControl.isEmergencySimulationRunning.impl){
    setControlVisibility("Start and Stop Sending Sample Data to SUT", "LeftExclamationMark", 1);
    setControlVisibility("Start and Stop Sending Sample Data to SUT", "RightExclamationMark", 1);
  }else{
    setControlVisibility("Start and Stop Sending Sample Data to SUT", "LeftExclamationMark", 0);
    setControlVisibility("Start and Stop Sending Sample Data to SUT", "RightExclamationMark", 0);
  }
   
}

on value_update SmartECG::SmartECG_IO.heartRateAlarmOn{
  
  if ($SmartECG::SmartECG_IO.heartRateAlarmOn.impl){
    setControlVisibility("Start and Stop Sending Sample Data to SUT", "RedHeart", 1);
    setControlVisibility("Start and Stop Sending Sample Data to SUT", "BlackHeart", 0);
  }else{
    setControlVisibility("Start and Stop Sending Sample Data to SUT", "RedHeart", 0);
    setControlVisibility("Start and Stop Sending Sample Data to SUT", "BlackHeart", 1);
    
  }
   
}

on timer heartVisibilityTimer{
    setControlVisibility("Start and Stop Sending Sample Data to SUT", "RedHeart", 0);
    setControlVisibility("Start and Stop Sending Sample Data to SUT", "BlackHeart", 1);
}

