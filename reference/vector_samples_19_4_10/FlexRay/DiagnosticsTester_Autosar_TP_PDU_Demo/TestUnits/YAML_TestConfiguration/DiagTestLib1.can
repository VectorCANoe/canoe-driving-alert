/*@!Encoding:1252*/
includes
{
  #include "..\..\Nodes\DiagTester_SessionManagement.cin"
}

variables
{
  char gECU[20] = "ECM"; // Diagnostic target
  char gTesterNode[20] = "TC SetSN";

  // ------- Variant Coding ---------
  byte  gCountryType;
  byte  gVehicleType;
  word  gSpecialSetting;
}

export testcase SetSN ()
{
  diagRequest ECM.ExtendedDiagnosticSession_Start reqStartExtendedSession;
  diagRequest ECM.SeedLevel1_Request              reqGetSeed;
  diagRequest ECM.KeyLevel1_Send                  reqSendKey;
  diagRequest ECM.ProgrammingSession_Start        reqStartProgrammingSession;
  diagRequest ECM.SerialNumber_Write              reqWriteSerial;
  diagRequest ECM.DefaultSession_Start            reqStartDefaultSession;

  double param[1];
  long resultSetSN;
  DWORD seedValue, sn;
  int testerPresentBackup;

  setWriteDbgLevel( 0);

  StartSessionManagement();

  diagStopTesterPresent();
  testerPresentBackup = @sysvar::DiagTester::EnableTesterPresent;
  @sysvar::DiagTester::EnableTesterPresent = 0;

  resultSetSN = 1;

  if (resultSetSN == 1)
  {
    // start step 1
    GotoExtendedSession();

    resultSetSN = WaitForResponse(reqStartExtendedSession, "Start Extended Session", "", param);

    if (resultSetSN == 1)
    {
      // start step 2
      OnRespExtendedSession();

      resultSetSN = WaitForResponse(reqGetSeed, "Request Security Seed", "SecuritySeed", param);

      if (resultSetSN == 1)
      {
        // start step 3
        seedValue = param[0];
        OnRespSeedLevel1(seedValue);

        resultSetSN = WaitForResponse(reqSendKey, "Send Security Key", "", param);

        if (resultSetSN == 1)
        {
          // start step 4
          OnRespKeyLevel1();

          GotoProgrammingSession();

          resultSetSN = WaitForResponse(reqStartProgrammingSession, "Start Programming Session", "", param);

          if (resultSetSN == 1)
          {
            // start step 5
            OnRespExtendedSession();

            resultSetSN = WaitForResponse(reqGetSeed, "Request Security Seed", "SecuritySeed", param);

            if (resultSetSN == 1)
            {
              // start step 6
              seedValue = param[0];
              OnRespSeedLevel1(seedValue);

              resultSetSN = WaitForResponse(reqSendKey, "Send Security Key", "", param);

              if (resultSetSN == 1)
              {
                // start step 7
                OnRespKeyLevel1();

                sn = @sysvar::DiagTester::SerialNumberOut;
                @sysvar::DiagTester::SerialNumberOut += 1;

                resultSetSN = WriteSerial(reqWriteSerial, sn);

                if (resultSetSN == 1)
                  TestStepPass("Write Serial Number", "Request was sent");    
                else
                  TestStepFail("Write Serial Number", "Request could not be sent");    

                resultSetSN = WaitForResponse(reqWriteSerial, "Write Serial Number", "", param);

              } // end step 7
            } // end step 6
          } // end step 5
        } // end step 4
      } // end step 3

      GotoDefaultSession();

      resultSetSN = WaitForResponse(reqStartDefaultSession, "Start Default Session", "", param);

      if (resultSetSN == 1)
      {
        OnRespDefaultSession();
      }
    } // end step 2
  } // end step 1

  @sysvar::DiagTester::EnableTesterPresent = testerPresentBackup;

  TestWaitForTimeout(10);
}

on preStart
{
  InitializeSessionManagement();
}

int WaitForResponse (diagRequest * idReq, char label[], char paramName[], double param[])
{
  int waitResult;
  
  waitResult = 0;

  switch( TestWaitForDiagResponse(idReq, 250))  
  { 
    case 0: // Timeout: The ECU did not respond within 250 ms.    
            TestStepFail(label, "No answer from ECU!");    
            break;  

    case 1: // response received    
            TestReportWriteDiagResponse(idReq);  // write response to report    
            if( diagGetLastResponseCode(idReq) == -1)    
            { // A positive response was received      
              TestStepPass(label, "Positive response received");    
              waitResult = 1;
              if (strlen(paramName) > 0)
              {
                diagGetRespParameter(idReq, 0, paramName, param);  
              }
            }    
            else  
            { // A negative response was received  
              TestStepFail(label, "Negative response received");    
            }    
            break;  

    default: // internal or setup error    
            TestStepFail(label, "Error in TestCase! Verdict unreliable.");  

  } // end switch

  if (waitResult == 1)
    SetRequestResult(cOk);
  else
    SetRequestResult(cBad);

  return waitResult;
}

int WriteSerial (diagRequest * request, DWORD sn)
{
  int result;

  request.SetParameter("SerialNumber", sn);
  result = request.SendRequest();

  SetRequestResult(cUnknown);

  snprintf( text, elcount(text), "CAPL: %s: Identification::SerialNumber::Write result %d", gTesterNode, result);
  writeDbgLevel( gDiagDbgLevel, text);

  return (result) ? 0 : 1;
}

export testcase SetVariant ()
{
  diagRequest ECM.ExtendedDiagnosticSession_Start reqStartExtendedSession;
  diagRequest ECM.SeedLevel1_Request              reqGetSeed;
  diagRequest ECM.KeyLevel1_Send                  reqSendKey;
  diagRequest ECM.ProgrammingSession_Start        reqStartProgrammingSession;
  diagRequest ECM.Coding_Write                    reqWriteVariant;
  diagRequest ECM.DefaultSession_Start           reqStartDefaultSession;

  double param[1];
  long result;
  DWORD seedValue, sn;
  int testerPresentBackup;

  setWriteDbgLevel( 0);

  StartSessionManagement();

  diagStopTesterPresent();
  testerPresentBackup = @sysvar::DiagTester::EnableTesterPresent;
  @sysvar::DiagTester::EnableTesterPresent = 0;

  result = 1;

  if (result == 1)
  {
    // start step 1
    GotoExtendedSession();

    result = WaitForResponse(reqStartExtendedSession, "Start Extended Session", "", param);

    if (result == 1)
    {
      // start step 2
      OnRespExtendedSession();

      result = WaitForResponse(reqGetSeed, "Request Security Seed", "SecuritySeed", param);

      if (result == 1)
      {
        // start step 3
        seedValue = param[0];
        OnRespSeedLevel1(seedValue);

        result = WaitForResponse(reqSendKey, "Send Security Key", "", param);

        if (result == 1)
        {
          // start step 4
          OnRespKeyLevel1();

          GotoProgrammingSession();

          result = WaitForResponse(reqStartProgrammingSession, "Start Programming Session", "", param);

          if (result == 1)
          {
            // start step 5
            OnRespExtendedSession();

            result = WaitForResponse(reqGetSeed, "Request Security Seed", "SecuritySeed", param);

            if (result == 1)
            {
              // start step 6
              seedValue = param[0];
              OnRespSeedLevel1(seedValue);

              result = WaitForResponse(reqSendKey, "Send Security Key", "", param);

              if (result == 1)
              {
                // start step 7
                OnRespKeyLevel1();

                CreateVariantCoding();

                result = WriteVariant(reqWriteVariant);

                if (result == 1)
                  TestStepPass("Write Variant Coding", "Request was sent");    
                else
                  TestStepFail("Write Variant Coding", "Request could not be sent");    

                result = WaitForResponse(reqWriteVariant, "Write Variant Coding", "", param);

              } // end step 7
            } // end step 6
          } // end step 5
        } // end step 4
      } // end step 3

      GotoDefaultSession();

      result = WaitForResponse(reqStartDefaultSession, "Start Default Session", "", param);

      if (result == 1)
      {
        OnRespDefaultSession();
      }
    } // end step 2
  } // end step 1

  @sysvar::DiagTester::EnableTesterPresent = testerPresentBackup;

  TestWaitForTimeout(10);
}

export testcase ReadECUIDentification(){ 
  long response;
  char Parameter_Value[100];
  char Parameter_Condition_Value[20];
  char Parameter[20];
  diagRequest ECM.EcuIdentification_Read ReqEcuidentificationRead;
  
  strncpy(Parameter_Condition_Value,"CANoe UDS ECU",20);
  strncpy(Parameter,"Part_Number",20);
  
  ReqEcuidentificationRead.SendRequest();
  response=testWaitForDiagRequestSent(ReqEcuidentificationRead,2000);
  if(response==0){
    testStepFail("Sending of diag request failed: The Timeout was reached, i.e. the event of interest did not occur within the specified time");
  }
  else if(response<0){
    testStepFail("Sending of diag request failed: An internal error occurred, e.g. a faulty configuration of the diagnostic layer");
  }
  response=testWaitForDiagResponse(ReqEcuidentificationRead,200);
  if(response==0){
    testStepFail("Diag request failed: The Timeout was reached, i.e. the event of interest did not occur within the specified time");
  }
  else if(response<0){
    testStepFail("Diag request failed: An internal error occurred, e.g. a protocol error or a faulty configuration of the diagnostic layer");
  }
  

  response=diagGetLastResponseCode(ReqEcuidentificationRead);
  switch (response){
    case -1:
      testStepPass("2","Positive response arrived");
      break;
    case 0:
      testStepFail("2","No response has been received yet");
      break;
    case 1:
      testStepFail("2","Negative response received");
      break;
  }

  testReportWriteDiagResponse(ReqEcuidentificationRead);

  diagGetRespParameter(ReqEcuidentificationRead,Parameter, Parameter_Value, elcount(Parameter_Value));
  TestStep("","Validate Condition: == \"%s\" ",Parameter_Condition_Value); 
  TestStep("","Part_Number: \"%s\"", Parameter_Value);
  

  if (strncmp(Parameter_Value,Parameter_Condition_Value,20)==0){
    testStepPass("3","Validation of the expected parameters");
  }
  else{
    testStepFail("3","Validation of the expected parameters");
  }
  
} 

export testcase TestProcessorType(){ 
  diagRequest ECM.ProcessorType_Read ReqProcessorType_Read;

  DiagResponseCheck(ReqProcessorType_Read,"Processor_Type",0,'>',2000,150);
} 

export testcase TestDiagnosticsVersion(){ 
  diagRequest ECM.DiagnosticVersion_Read ReqDiagnosticVersion_Read;

  DiagResponseCheck(ReqDiagnosticVersion_Read,"Diagnostic_Version_dump",0x0100, '==',2000,150);
} 

export testcase TestDevelopmentData(){
  diagRequest ECM.DevelopmentData_Read ReqDevelopmentData_Read;

  DiagResponseCheck(ReqDevelopmentData_Read,"TransportLayerVersion",4,'==',2000,150);
}

export testcase TestSerialNumber(){
  diagRequest ECM.SerialNumber_Read ReqSerialNumber_Read;

  DiagResponseCheck(ReqSerialNumber_Read,"SerialNumber",170000,'<',2000,200);
}

void DiagResponseCheck(diagRequest *req,char Parameter[],long Parameter_Condition_Value,char operator, long sendwaittimeout, long responsewaittimeout){
  long response;
  long Parameter_Value;

  response=0;
  req.SendRequest();
  response=testWaitForDiagRequestSent(req,sendwaittimeout);
  if(response==0){
    testStepFail("Sending of diag request failed: The Timeout was reached, i.e. the event of interest did not occur within the specified time");
  }
  else if(response<0){
    testStepFail("Sending of diag request failed: An internal error occurred, e.g. a faulty configuration of the diagnostic layer");
  }
  response=testWaitForDiagResponse(req,responsewaittimeout);
  if(response==0){
    testStepFail("Diag request failed: The Timeout was reached, i.e. the event of interest did not occur within the specified time");
  }
  else if(response<0){
    testStepFail("Diag request failed: An internal error occurred, e.g. a protocol error or a faulty configuration of the diagnostic layer");
  }
  
  response=diagGetLastResponseCode(req);
  switch (response){
    case -1:
      testStepPass("2","Positive response arrived");
      break;
    case 0:
      testStepFail("2","No response has been received yet");
      break;
    case 1:
      testStepFail("2","Negative response received");
      break;
  }

  testReportWriteDiagResponse(req);
  Parameter_Value=req.GetRespParameter(Parameter);
  TestStep("","Validate Condition: %c \"%d\"",operator,Parameter_Condition_Value); 
  TestStep("","%s: %d", Parameter,Parameter_Value);

  switch(operator){
    case '=':
      if (Parameter_Value==Parameter_Condition_Value){
        testStepPass("3","Validation of the expected parameters");
      }
      else{
        testStepFail("3","Validation of the expected parameters");
      }
      break;
    case '>':
      if (Parameter_Value>Parameter_Condition_Value){
        testStepPass("3","Validation of the expected parameters");
      }
      else{
        testStepFail("3","Validation of the expected parameters");
      }
      break;
    case '<':
      if (Parameter_Value<Parameter_Condition_Value){
        testStepPass("3","Validation of the expected parameters");
      }
      else{
        testStepFail("3","Validation of the expected parameters");
      }
      break;
  }
}


CreateVariantCoding ()
{
  gCountryType       = @sysvar::DiagTester::CountryType;
  gVehicleType       = @sysvar::DiagTester::VehicleType;
  gSpecialSetting    = @sysvar::DiagTester::SpecialSetting;

  gCountryType       = random(3)+1;
  gVehicleType       = random(3)+1;
  gSpecialSetting    += 1;

  @sysvar::DiagTester::CountryType    = gCountryType;
  @sysvar::DiagTester::VehicleType    = gVehicleType;
  @sysvar::DiagTester::SpecialSetting = gSpecialSetting;
}

int WriteVariant (diagRequest * request)
{
  int result;

  request.SetParameter( "Codingstring.CountryType", gCountryType);
  request.SetParameter( "Codingstring.VehicleType", gVehicleType);
  request.SetParameter( "Codingstring.SpecialAdjustment", gSpecialSetting);
  result = request.SendRequest();

  SetRequestResult(cUnknown);

  snprintf( text, elcount(text), "CAPL: %s: VariantCoding::Coding::Write result %d", gTesterNode, result);
  writeDbgLevel( gDiagDbgLevel, text);

  return (result) ? 0 : 1;
}

