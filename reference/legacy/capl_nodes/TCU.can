/*@@=================================================================
 * CANoe CAPL Node: TCU (Transmission Control Unit)
 *==================================================================@@*/

includes {}

variables
{
  int gGearPosition = 0;  // 0=P, 1=R, 2=N, 3=D
  int gShiftStatus = 0;
  int gOilTemperature = 60;

  msTimer tGearStatus;
}

on start
{
  write("TCU (Transmission Control Unit) Started");
  gGearPosition = 0; // Park
  setTimer(tGearStatus, 20);  // 20ms
}

on timer tGearStatus
{
  message TCU_GearStatus msg;

  msg.Gear_Position = gGearPosition;
  msg.Shift_Status = gShiftStatus;
  msg.Oil_Temperature = gOilTemperature;
  msg.Torque_Converter_Lock = (gGearPosition == 3) ? 1 : 0;

  output(msg);
  setEnvironmentVariable("Gear_Position", gGearPosition);
  setTimer(tGearStatus, 20);
}

on key 'P' { gGearPosition = 0; write("Gear: PARK"); }
on key 'R' { gGearPosition = 1; write("Gear: REVERSE"); }
on key 'N' { gGearPosition = 2; write("Gear: NEUTRAL"); }
on key 'D' { gGearPosition = 3; write("Gear: DRIVE"); }

on stopMeasurement
{
  cancelTimer(tGearStatus);
}
