/*@@=================================================================
 * CANoe CAPL Node: BCM (Body Control Module)
 * Project: CANoe-IVI-OTA - Hyundai Mobis Bootcamp
 *
 * Description:
 *   Body Control Module managing exterior/interior lighting, door locks,
 *   seat sensors, and environmental sensors. Receives RGB commands from
 *   IVI and provides feedback with actual LED values.
 *
 * Features:
 *   - Ambient lighting LED driver simulation
 *   - Door status monitoring (4 doors)
 *   - Seat occupancy and seat belt detection
 *   - Environmental sensors (ambient light, rain, wiper)
 *   - Headlight control and status
 *
 * Messages Received:
 *   - IVI_AmbientLight (0x400) - RGB lighting commands
 *   - IVI_Profile (0x410) - User profile changes
 *
 * Messages Transmitted:
 *   - BCM_LightControl (0x510, 100ms) - Lighting feedback
 *   - BCM_DoorStatus (0x500, 100ms) - Door and lock status
 *   - BCM_SensorStatus (0x520, 200ms) - Environmental sensors
 *   - BCM_SeatStatus (0x522, 500ms) - Seat occupancy and belts
 *
 * Author: Hyundai Mobis Bootcamp with Vector Korea
 * Date: 2026-02-12
 * Version: 1.0.0
 *==================================================================@@*/

includes
{
}

/*==================================================================
 * GLOBAL VARIABLES
 *==================================================================*/

variables
{
  // RGB Lighting (commanded from IVI)
  int gRequested_R = 0;
  int gRequested_G = 0;
  int gRequested_B = 0;
  int gRequested_Brightness = 50;

  // Actual RGB output (simulated LED driver)
  int gActual_R = 0;
  int gActual_G = 0;
  int gActual_B = 0;
  int gAmbientActive = 1; // 0=INACTIVE, 1=ACTIVE

  // Headlight control
  int gHeadlightStatus = 0; // 0=OFF, 1=PARKING, 2=LOW_BEAM, 3=HIGH_BEAM

  // Door status (0=CLOSED, 1=OPEN, 2=AJAR, 3=ERROR)
  int gDoor_FL = 0;
  int gDoor_FR = 0;
  int gDoor_RL = 0;
  int gDoor_RR = 0;
  int gCentralLockStatus = 0; // 0=UNLOCKED, 1=LOCKED

  // Seat occupancy and seat belts
  int gSeat_FL_Occupied = 0;
  int gSeat_FR_Occupied = 0;
  int gSeat_RL_Occupied = 0;
  int gSeat_RC_Occupied = 0;
  int gSeat_RR_Occupied = 0;

  int gSeatBelt_FL = 0;
  int gSeatBelt_FR = 0;
  int gSeatBelt_RL = 0;
  int gSeatBelt_RC = 0;
  int gSeatBelt_RR = 0;

  // Environmental sensors
  int gAmbientLightLevel = 50;   // 0-100%
  int gRainSensorLevel = 0;       // 0-100%
  int gWiperStatus = 0;           // 0=OFF, 1=INTERMITTENT, 2=LOW, etc.
  int gHeadlightAutoStatus = 1;   // 0=MANUAL, 1=AUTO_ACTIVE

  // Timers
  msTimer tLightControl;
  msTimer tDoorStatus;
  msTimer tSensorStatus;
  msTimer tSeatStatus;

  // LED driver simulation (smooth transition)
  float gTransition_R = 0.0;
  float gTransition_G = 0.0;
  float gTransition_B = 0.0;
  float gTransitionSpeed = 0.2; // 20% per cycle (smooth fade)
}

/*==================================================================
 * INITIALIZATION
 *==================================================================*/

on start
{
  write("========================================");
  write("BCM (Body Control Module) Started");
  write("Project: CANoe-IVI-OTA");
  write("Features: Lighting, Doors, Sensors");
  write("========================================");

  // Initialize values
  gActual_R = 0;
  gActual_G = 0;
  gActual_B = 0;
  gAmbientActive = 1;
  gHeadlightStatus = 0; // Headlights OFF initially

  // Simulate driver seat occupied with belt fastened
  gSeat_FL_Occupied = 1;
  gSeatBelt_FL = 1;

  // Start cyclic message transmission
  setTimer(tLightControl, 100);  // 100ms
  setTimer(tDoorStatus, 100);    // 100ms
  setTimer(tSensorStatus, 200);  // 200ms
  setTimer(tSeatStatus, 500);    // 500ms

  write("BCM initialized - Ambient lighting ACTIVE");
}

/*==================================================================
 * LED DRIVER SIMULATION (Smooth RGB Transition)
 *==================================================================*/

void UpdateLEDDriver()
{
  // Smooth transition to requested RGB values
  if (gActual_R != gRequested_R) {
    float diff = gRequested_R - gActual_R;
    gTransition_R += diff * gTransitionSpeed;

    if (abs(gTransition_R) >= 1.0) {
      int step = (int)gTransition_R;
      gActual_R += step;
      gTransition_R -= step;

      if (gActual_R < 0) gActual_R = 0;
      if (gActual_R > 255) gActual_R = 255;
    }
  }

  if (gActual_G != gRequested_G) {
    float diff = gRequested_G - gActual_G;
    gTransition_G += diff * gTransitionSpeed;

    if (abs(gTransition_G) >= 1.0) {
      int step = (int)gTransition_G;
      gActual_G += step;
      gTransition_G -= step;

      if (gActual_G < 0) gActual_G = 0;
      if (gActual_G > 255) gActual_G = 255;
    }
  }

  if (gActual_B != gRequested_B) {
    float diff = gRequested_B - gActual_B;
    gTransition_B += diff * gTransitionSpeed;

    if (abs(gTransition_B) >= 1.0) {
      int step = (int)gTransition_B;
      gActual_B += step;
      gTransition_B -= step;

      if (gActual_B < 0) gActual_B = 0;
      if (gActual_B > 255) gActual_B = 255;
    }
  }
}

/*==================================================================
 * MESSAGE RECEPTION - IVI Ambient Light Command
 *==================================================================*/

on message IVI_AmbientLight
{
  // Store requested values
  gRequested_R = this.Ambient_Light_R;
  gRequested_G = this.Ambient_Light_G;
  gRequested_B = this.Ambient_Light_B;
  gRequested_Brightness = (this.Brightness * 100) / 255; // Convert to %

  // Verify AliveCounter (optional - for fault detection)
  // byte expectedCounter = (gLastAliveCounter + 1) & 0x0F;
  // if (this.AliveCounter != expectedCounter) {
  //   write("⚠️ AliveCounter mismatch in IVI_AmbientLight");
  // }

  // write("RGB command received: R:%d, G:%d, B:%d (Brightness: %d%%)",
  //       gRequested_R, gRequested_G, gRequested_B, gRequested_Brightness);
}

on message IVI_Profile
{
  int profileID = this.Profile_ID;
  int scenarioID = this.Scenario_ID;

  write("User profile changed: Profile=%d, Scenario=%d", profileID, scenarioID);

  // Could adjust lighting based on profile preferences here
  // For example: Profile 0 (DRIVER1) might prefer certain lighting
}

/*==================================================================
 * MESSAGE TRANSMISSION - Light Control Feedback
 *==================================================================*/

on timer tLightControl
{
  message BCM_LightControl msg;

  // Update LED driver (smooth transition)
  UpdateLEDDriver();

  // Set feedback values
  msg.Headlight_Status = gHeadlightStatus;
  msg.Ambient_Light_Active = gAmbientActive;
  msg.Ambient_R_Actual = gActual_R;
  msg.Ambient_G_Actual = gActual_G;
  msg.Ambient_B_Actual = gActual_B;

  // Transmit message
  output(msg);

  // Restart timer (100ms)
  setTimer(tLightControl, 100);
}

/*==================================================================
 * MESSAGE TRANSMISSION - Door Status
 *==================================================================*/

on timer tDoorStatus
{
  message BCM_DoorStatus msg;

  msg.Door_Status_FL = gDoor_FL;
  msg.Door_Status_FR = gDoor_FR;
  msg.Door_Status_RL = gDoor_RL;
  msg.Door_Status_RR = gDoor_RR;
  msg.Central_Lock_Status = gCentralLockStatus;

  output(msg);

  setTimer(tDoorStatus, 100);
}

/*==================================================================
 * MESSAGE TRANSMISSION - Sensor Status
 *==================================================================*/

on timer tSensorStatus
{
  message BCM_SensorStatus msg;

  msg.Ambient_Light_Level = gAmbientLightLevel;
  msg.Rain_Sensor_Level = gRainSensorLevel;
  msg.Wiper_Status = gWiperStatus;
  msg.Headlight_Auto_Status = gHeadlightAutoStatus;
  msg.Reserved = 0;

  output(msg);

  setTimer(tSensorStatus, 200);
}

/*==================================================================
 * MESSAGE TRANSMISSION - Seat Status
 *==================================================================*/

on timer tSeatStatus
{
  message BCM_SeatStatus msg;

  // Occupancy
  msg.Front_Left_Occupied = gSeat_FL_Occupied;
  msg.Front_Right_Occupied = gSeat_FR_Occupied;
  msg.Rear_Left_Occupied = gSeat_RL_Occupied;
  msg.Rear_Center_Occupied = gSeat_RC_Occupied;
  msg.Rear_Right_Occupied = gSeat_RR_Occupied;

  // Seat belts
  msg.Seat_Belt_FL = gSeatBelt_FL;
  msg.Seat_Belt_FR = gSeatBelt_FR;
  msg.Seat_Belt_RL = gSeatBelt_RL;
  msg.Seat_Belt_RC = gSeatBelt_RC;
  msg.Seat_Belt_RR = gSeatBelt_RR;

  output(msg);

  setTimer(tSeatStatus, 500);
}

/*==================================================================
 * DOOR CONTROL FUNCTIONS
 *==================================================================*/

void OpenDoor(char* door)
{
  if (strcmp(door, "FL") == 0) {
    gDoor_FL = 1; // OPEN
    write("Front-Left door OPENED");
  } else if (strcmp(door, "FR") == 0) {
    gDoor_FR = 1;
    write("Front-Right door OPENED");
  } else if (strcmp(door, "RL") == 0) {
    gDoor_RL = 1;
    write("Rear-Left door OPENED");
  } else if (strcmp(door, "RR") == 0) {
    gDoor_RR = 1;
    write("Rear-Right door OPENED");
  }
}

void CloseDoor(char* door)
{
  if (strcmp(door, "FL") == 0) {
    gDoor_FL = 0; // CLOSED
    write("Front-Left door CLOSED");
  } else if (strcmp(door, "FR") == 0) {
    gDoor_FR = 0;
    write("Front-Right door CLOSED");
  } else if (strcmp(door, "RL") == 0) {
    gDoor_RL = 0;
    write("Rear-Left door CLOSED");
  } else if (strcmp(door, "RR") == 0) {
    gDoor_RR = 0;
    write("Rear-Right door CLOSED");
  }
}

void ToggleCentralLock()
{
  gCentralLockStatus = !gCentralLockStatus;
  write("Central lock: %s", gCentralLockStatus ? "LOCKED" : "UNLOCKED");
}

/*==================================================================
 * HEADLIGHT CONTROL
 *==================================================================*/

void SetHeadlight(int status)
{
  if (status >= 0 && status <= 3) {
    gHeadlightStatus = status;
    char* statusStr[] = {"OFF", "PARKING", "LOW_BEAM", "HIGH_BEAM"};
    write("Headlight: %s", statusStr[status]);
  }
}

void CycleHeadlight()
{
  gHeadlightStatus = (gHeadlightStatus + 1) % 4;
  SetHeadlight(gHeadlightStatus);
}

/*==================================================================
 * ENVIRONMENTAL SENSORS SIMULATION
 *==================================================================*/

void SimulateRain(int level)
{
  if (level >= 0 && level <= 100) {
    gRainSensorLevel = level;

    // Auto wiper control
    if (level == 0) {
      gWiperStatus = 0; // OFF
    } else if (level < 30) {
      gWiperStatus = 1; // INTERMITTENT
    } else if (level < 70) {
      gWiperStatus = 2; // LOW
    } else {
      gWiperStatus = 3; // HIGH
    }

    write("Rain sensor: %d%% → Wiper: %d", level, gWiperStatus);
  }
}

/*==================================================================
 * KEYBOARD SHORTCUTS (for testing)
 *==================================================================*/

on key 'h' { CycleHeadlight(); }
on key 'l' { ToggleCentralLock(); }

on key 'q' { OpenDoor("FL"); }   // Front-Left
on key 'w' { OpenDoor("FR"); }   // Front-Right
on key 'e' { OpenDoor("RL"); }   // Rear-Left
on key 'r' { OpenDoor("RR"); }   // Rear-Right

on key 'a' { CloseDoor("FL"); }
on key 's' { CloseDoor("FR"); }
on key 'd' { CloseDoor("RL"); }
on key 'f' { CloseDoor("RR"); }

on key '5' { SimulateRain(0); }    // No rain
on key '6' { SimulateRain(30); }   // Light rain
on key '7' { SimulateRain(60); }   // Medium rain
on key '8' { SimulateRain(90); }   // Heavy rain

/*==================================================================
 * CLEANUP
 *==================================================================*/

on stopMeasurement
{
  write("BCM node stopped");
  cancelTimer(tLightControl);
  cancelTimer(tDoorStatus);
  cancelTimer(tSensorStatus);
  cancelTimer(tSeatStatus);
}

/*==================================================================
 * END OF BCM.can
 *==================================================================*/
