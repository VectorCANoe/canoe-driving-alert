/*@@=================================================================
 * CANoe CAPL Node: IVI (In-Vehicle Infotainment)
 * Project: CANoe-IVI-OTA - Hyundai Mobis Bootcamp
 *
 * Description:
 *   Main IVI node controlling ambient lighting, user profiles, and
 *   multimedia integration. This is the PROJECT MAIN NODE for Phase 1.
 *
 * Features:
 *   - Ambient lighting control (RGB + 11 themes)
 *   - User profile management (6 profiles, 21 scenarios)
 *   - ADAS event coordination
 *   - Speed-linked lighting intensity
 *
 * Messages Transmitted:
 *   - IVI_AmbientLight (0x400, 100ms) - RGB lighting control
 *   - IVI_Profile (0x410, event-based) - User profile changes
 *
 * Messages Received:
 *   - BCM_LightControl (0x510) - Lighting feedback
 *   - EMS_EngineStatus (0x100) - Vehicle speed for dynamic lighting
 *   - Camera_LDW (0x300) - ADAS events for warning lighting
 *
 * Author: Hyundai Mobis Bootcamp with Vector Korea
 * Date: 2026-02-12
 * Version: 1.0.0
 *==================================================================@@*/

includes
{
  // No additional includes needed for basic implementation
}

/*==================================================================
 * GLOBAL VARIABLES
 *==================================================================*/

// Ambient Lighting Control
variables
{
  // Current RGB values (0-255)
  int gAmbient_R = 255;
  int gAmbient_G = 255;
  int gAmbient_B = 255;
  int gBrightness = 50;          // 0-100%
  int gTheme = 0;                 // 0-10 (SPORT, COMFORT, ECO, etc.)

  // User Profile
  int gProfileID = 0;             // 0=DRIVER1, 1=DRIVER2, etc.
  int gScenarioID = 0;            // 0-20
  dword gScenarioParams = 0;      // 32-bit parameters

  // Message counters
  byte gAliveCounter_AmbientLight = 0;
  byte gAliveCounter_Profile = 0;

  // Vehicle state (received from other ECUs)
  float gVehicleSpeed = 0.0;      // km/h (from EMS)
  int gGearPosition = 0;          // 0=P, 1=R, 2=N, 3=D
  int gADAS_LDW_Active = 0;       // Lane departure warning
  int gADAS_AEB_Active = 0;       // Emergency braking

  // BCM Feedback (actual RGB values)
  int gActual_R = 0;
  int gActual_G = 0;
  int gActual_B = 0;
  int gAmbientActive = 0;

  // Timers
  msTimer tAmbientLight;          // 100ms cyclic
  msTimer tProfileUpdate;         // Event-based (only when changed)

  // Theme definitions (R, G, B)
  int gThemeColors[11][3] = {
    {255, 50, 0},    // 0: SPORT (Red-Orange)
    {100, 150, 255}, // 1: COMFORT (Soft Blue)
    {50, 255, 100},  // 2: ECO (Green)
    {255, 255, 255}, // 3: CUSTOM1 (White - user editable)
    {255, 255, 255}, // 4: CUSTOM2 (White - user editable)
    {255, 255, 255}, // 5: CUSTOM3 (White - user editable)
    {50, 50, 150},   // 6: NIGHT (Dark Blue)
    {255, 0, 255},   // 7: PARTY (Magenta)
    {255, 200, 150}, // 8: RELAX (Warm White)
    {255, 100, 0},   // 9: DYNAMIC (Orange - speed-linked)
    {255, 255, 255}  // 10: USER_DEFINED (Full RGB control)
  };
}

/*==================================================================
 * INITIALIZATION
 *==================================================================*/

on start
{
  write("========================================");
  write("IVI (In-Vehicle Infotainment) Started");
  write("Project: CANoe-IVI-OTA");
  write("Phase 1: Ambient Lighting Control");
  write("========================================");

  // Initialize environment variables
  setEnvironmentVariable("IVI_Theme_Selected", gTheme);
  setEnvironmentVariable("IVI_Brightness", gBrightness);
  setEnvironmentVariable("IVI_RGB_R", gAmbient_R);
  setEnvironmentVariable("IVI_RGB_G", gAmbient_G);
  setEnvironmentVariable("IVI_RGB_B", gAmbient_B);

  // Apply initial theme
  ApplyTheme(gTheme);

  // Start cyclic message transmission
  setTimer(tAmbientLight, 100);  // 100ms cycle time

  write("IVI initialized with theme %d (Brightness: %d%%)", gTheme, gBrightness);
}

/*==================================================================
 * THEME MANAGEMENT
 *==================================================================*/

void ApplyTheme(int themeID)
{
  if (themeID >= 0 && themeID <= 10) {
    if (themeID != 10) { // Not USER_DEFINED
      gAmbient_R = gThemeColors[themeID][0];
      gAmbient_G = gThemeColors[themeID][1];
      gAmbient_B = gThemeColors[themeID][2];

      write("Theme applied: %d (R:%d, G:%d, B:%d)", themeID, gAmbient_R, gAmbient_G, gAmbient_B);
    }
    // For USER_DEFINED (10), keep current RGB values

    // Update environment variables
    setEnvironmentVariable("IVI_RGB_R", gAmbient_R);
    setEnvironmentVariable("IVI_RGB_G", gAmbient_G);
    setEnvironmentVariable("IVI_RGB_B", gAmbient_B);
  }
}

void SetTheme(int themeID)
{
  if (themeID >= 0 && themeID <= 10) {
    gTheme = themeID;
    setEnvironmentVariable("IVI_Theme_Selected", gTheme);
    ApplyTheme(themeID);
  } else {
    write("Invalid theme ID: %d (valid: 0-10)", themeID);
  }
}

void SetBrightness(int brightness)
{
  if (brightness >= 0 && brightness <= 100) {
    gBrightness = brightness;
    setEnvironmentVariable("IVI_Brightness", gBrightness);
    write("Brightness set to: %d%%", gBrightness);
  }
}

void SetRGB(int r, int g, int b)
{
  gAmbient_R = r;
  gAmbient_G = g;
  gAmbient_B = b;
  gTheme = 10; // Switch to USER_DEFINED

  setEnvironmentVariable("IVI_RGB_R", r);
  setEnvironmentVariable("IVI_RGB_G", g);
  setEnvironmentVariable("IVI_RGB_B", b);
  setEnvironmentVariable("IVI_Theme_Selected", 10);

  write("Custom RGB set: R:%d, G:%d, B:%d", r, g, b);
}

/*==================================================================
 * SPEED-LINKED DYNAMIC LIGHTING
 *==================================================================*/

void UpdateDynamicLighting()
{
  if (gTheme == 9) { // DYNAMIC theme
    // Increase brightness with speed (0 km/h = 30%, 120 km/h = 100%)
    int dynamicBrightness = (int)(30 + (gVehicleSpeed / 120.0) * 70);
    if (dynamicBrightness > 100) dynamicBrightness = 100;
    if (dynamicBrightness < 30) dynamicBrightness = 30;

    if (gBrightness != dynamicBrightness) {
      gBrightness = dynamicBrightness;
      setEnvironmentVariable("IVI_Brightness", gBrightness);
    }
  }
}

/*==================================================================
 * ADAS EVENT COORDINATION
 *==================================================================*/

void HandleADASEvents()
{
  // Flash red on emergency braking (AEB)
  if (gADAS_AEB_Active) {
    gAmbient_R = 255;
    gAmbient_G = 0;
    gAmbient_B = 0;
    gBrightness = 100;
    write("⚠️ AEB ACTIVE - Red warning lighting");
  }
  // Yellow flash on lane departure warning
  else if (gADAS_LDW_Active) {
    gAmbient_R = 255;
    gAmbient_G = 200;
    gAmbient_B = 0;
    gBrightness = 80;
    // write("⚠️ LDW ACTIVE - Yellow warning lighting");
  }
}

/*==================================================================
 * CHECKSUM CALCULATION (CRC-4)
 *==================================================================*/

byte CalculateChecksum(message IVI_AmbientLight msg)
{
  // Simple XOR checksum of data bytes 0-6
  byte checksum = 0;
  checksum ^= msg.byte(0); // R
  checksum ^= msg.byte(1); // G
  checksum ^= msg.byte(2); // B
  checksum ^= msg.byte(3); // Brightness
  checksum ^= msg.byte(4); // Theme
  checksum ^= msg.byte(5); // Reserved LSB
  checksum ^= msg.byte(6); // Reserved MSB

  return checksum & 0x0F; // 4-bit checksum
}

/*==================================================================
 * MESSAGE TRANSMISSION
 *==================================================================*/

on timer tAmbientLight
{
  message IVI_AmbientLight msg;

  // Update dynamic lighting if needed
  UpdateDynamicLighting();

  // Handle ADAS events (overrides theme if active)
  HandleADASEvents();

  // Set signal values
  msg.Ambient_Light_R = gAmbient_R;
  msg.Ambient_Light_G = gAmbient_G;
  msg.Ambient_Light_B = gAmbient_B;
  msg.Brightness = (byte)((gBrightness * 255) / 100); // Convert % to 0-255 (factor 0.4 in DBC)
  msg.Theme_Package = gTheme;
  msg.Reserved = 0;

  // AliveCounter (0-15, increment each cycle)
  msg.AliveCounter = gAliveCounter_AmbientLight;
  gAliveCounter_AmbientLight = (gAliveCounter_AmbientLight + 1) & 0x0F;

  // Checksum (CRC-4)
  msg.Checksum = CalculateChecksum(msg);

  // Transmit message
  output(msg);

  // Restart timer for next cycle (100ms)
  setTimer(tAmbientLight, 100);
}

/*==================================================================
 * PROFILE MANAGEMENT
 *==================================================================*/

void SendProfileUpdate()
{
  message IVI_Profile msg;

  msg.Profile_ID = gProfileID;
  msg.Scenario_ID = gScenarioID;
  msg.Scenario_Params = gScenarioParams;

  output(msg);

  write("Profile updated: ID=%d, Scenario=%d", gProfileID, gScenarioID);
}

void SetProfile(int profileID)
{
  if (profileID >= 0 && profileID <= 5) {
    gProfileID = profileID;
    SendProfileUpdate();
  }
}

void SetScenario(int scenarioID)
{
  if (scenarioID >= 0 && scenarioID <= 20) {
    gScenarioID = scenarioID;
    SendProfileUpdate();
  }
}

/*==================================================================
 * MESSAGE RECEPTION - BCM Feedback
 *==================================================================*/

on message BCM_LightControl
{
  gActual_R = this.Ambient_R_Actual;
  gActual_G = this.Ambient_G_Actual;
  gActual_B = this.Ambient_B_Actual;
  gAmbientActive = this.Ambient_Light_Active;

  // Verify RGB values match requested values (tolerance: ±5)
  int diffR = abs(gActual_R - gAmbient_R);
  int diffG = abs(gActual_G - gAmbient_G);
  int diffB = abs(gActual_B - gAmbient_B);

  if (diffR > 5 || diffG > 5 || diffB > 5) {
    write("⚠️ RGB mismatch - Requested: (%d,%d,%d), Actual: (%d,%d,%d)",
          gAmbient_R, gAmbient_G, gAmbient_B,
          gActual_R, gActual_G, gActual_B);
  }
}

/*==================================================================
 * MESSAGE RECEPTION - Vehicle State
 *==================================================================*/

on message EMS_EngineStatus
{
  gVehicleSpeed = this.Vehicle_Speed;
  setEnvironmentVariable("Vehicle_Speed", gVehicleSpeed);
}

on message Camera_LDW
{
  int ldwStatus = this.LDW_Status;
  int aebEvent = this.AEB_Event;

  // Update ADAS flags
  gADAS_LDW_Active = (ldwStatus == 3) ? 1 : 0; // 3 = WARNING
  gADAS_AEB_Active = (aebEvent >= 2) ? 1 : 0;  // 2 = WARNING, 3 = BRAKING

  setEnvironmentVariable("ADAS_LDW_Active", gADAS_LDW_Active);
  setEnvironmentVariable("ADAS_AEB_Active", gADAS_AEB_Active);
}

/*==================================================================
 * KEYBOARD SHORTCUTS (for testing in CANoe)
 *==================================================================*/

on key '1' { SetTheme(0); }  // SPORT
on key '2' { SetTheme(1); }  // COMFORT
on key '3' { SetTheme(2); }  // ECO
on key '4' { SetTheme(9); }  // DYNAMIC
on key '0' { SetTheme(10); } // USER_DEFINED

on key '+' { SetBrightness(gBrightness + 10); }
on key '-' { SetBrightness(gBrightness - 10); }

on key 'r' { SetRGB(255, 0, 0); }    // Red
on key 'g' { SetRGB(0, 255, 0); }    // Green
on key 'b' { SetRGB(0, 0, 255); }    // Blue
on key 'w' { SetRGB(255, 255, 255); } // White

/*==================================================================
 * SYSTEM VARIABLES INTEGRATION (optional)
 *==================================================================*/

on sysvar_update sysvar::IVI::Theme
{
  int newTheme = @this;
  if (newTheme != gTheme) {
    SetTheme(newTheme);
  }
}

on sysvar_update sysvar::IVI::Brightness
{
  int newBrightness = @this;
  if (newBrightness != gBrightness) {
    SetBrightness(newBrightness);
  }
}

/*==================================================================
 * CLEANUP
 *==================================================================*/

on stopMeasurement
{
  write("IVI node stopped");
  cancelTimer(tAmbientLight);
}

/*==================================================================
 * END OF IVI.can
 *==================================================================*/
