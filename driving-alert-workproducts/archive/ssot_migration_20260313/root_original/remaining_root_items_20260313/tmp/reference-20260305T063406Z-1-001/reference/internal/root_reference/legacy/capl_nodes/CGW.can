/*@@=================================================================
 * CANoe CAPL Node: CGW (Central Gateway)
 * Project: CANoe-IVI-OTA - Hyundai Mobis Bootcamp
 *
 * Description:
 *   Central Gateway for network routing, message filtering, diagnostics,
 *   and OTA coordination. Routes messages between CAN-HS #1, CAN-HS #2,
 *   and CAN-LS networks.
 *
 * Features:
 *   - Multi-network message routing (CAN1 ↔ CAN2 ↔ CAN3)
 *   - Message filtering and security
 *   - Network load monitoring
 *   - UDS diagnostics coordination
 *   - OTA update management
 *
 * Routing Rules:
 *   CAN1 (HS #1) → CAN2 (HS #2):
 *     - EMS_EngineStatus → Cluster, IVI (vehicle speed, RPM)
 *     - ESP_Sensors → Camera, SCC (vehicle dynamics)
 *
 *   CAN2 (HS #2) → CAN3 (LS):
 *     - IVI_AmbientLight → BCM (lighting control)
 *     - IVI_Profile → BCM (user preferences)
 *
 *   CAN3 (LS) → CAN2 (HS #2):
 *     - BCM_LightControl → IVI, Cluster (lighting feedback)
 *     - BCM_DoorStatus → IVI, Cluster (door status)
 *
 * Messages Transmitted:
 *   - CGW_Status (0x700, 1000ms) - Gateway status, network load
 *
 * Author: Hyundai Mobis Bootcamp with Vector Korea
 * Date: 2026-02-12
 * Version: 1.0.0
 *==================================================================@@*/

includes
{
}

/*==================================================================
 * GLOBAL VARIABLES
 *==================================================================*/

variables
{
  // Gateway status
  int gGatewayStatus = 0;        // 0=OK, 1=WARNING, 2=ERROR
  int gDiagnosticActive = 0;     // UDS diagnostic session active
  int gOTA_Active = 0;           // OTA update in progress

  // Network load monitoring (%)
  float gNetworkLoad_HS1 = 0.0;  // CAN1 (500 kbps)
  float gNetworkLoad_HS2 = 0.0;  // CAN2 (500 kbps)
  float gNetworkLoad_LS = 0.0;   // CAN3 (125 kbps)

  // Message statistics
  dword gMessagesRouted = 0;
  dword gMessagesFiltered = 0;

  // Routing enable flags
  int gRouting_Enabled = 1;
  int gRouting_CAN1_to_CAN2 = 1;
  int gRouting_CAN2_to_CAN3 = 1;
  int gRouting_CAN3_to_CAN2 = 1;

  // Timers
  msTimer tGatewayStatus;
  msTimer tNetworkMonitor;
}

/*==================================================================
 * INITIALIZATION
 *==================================================================*/

on start
{
  write("========================================");
  write("CGW (Central Gateway) Started");
  write("Project: CANoe-IVI-OTA");
  write("Features: Multi-Network Routing");
  write("========================================");

  // Initialize gateway
  gGatewayStatus = 0; // OK
  gRouting_Enabled = 1;
  gDiagnosticActive = 0;
  gOTA_Active = 0;

  // Start cyclic tasks
  setTimer(tGatewayStatus, 1000);    // 1000ms (1 Hz)
  setTimer(tNetworkMonitor, 500);    // 500ms

  write("Routing enabled:");
  write("  CAN1 (HS #1) ↔ CAN2 (HS #2)");
  write("  CAN2 (HS #2) ↔ CAN3 (LS)");
  write("  CAN3 (LS) → CAN2 (HS #2)");
}

/*==================================================================
 * MESSAGE TRANSMISSION - Gateway Status
 *==================================================================*/

on timer tGatewayStatus
{
  message CGW_Status msg;

  msg.Gateway_Status = gGatewayStatus;
  msg.Network_Load_HS1 = (byte)((gNetworkLoad_HS1 * 255) / 100); // Convert to 0-255 (factor 0.4)
  msg.Network_Load_HS2 = (byte)((gNetworkLoad_HS2 * 255) / 100);
  msg.Network_Load_LS = (byte)((gNetworkLoad_LS * 255) / 100);
  msg.Diagnostic_Active = gDiagnosticActive;
  msg.OTA_Active = gOTA_Active;

  output(msg);

  // Update environment variables
  setEnvironmentVariable("UDS_Active", gDiagnosticActive);
  setEnvironmentVariable("OTA_Active", gOTA_Active);

  setTimer(tGatewayStatus, 1000);
}

/*==================================================================
 * NETWORK LOAD MONITORING
 *==================================================================*/

on timer tNetworkMonitor
{
  // Get bus statistics (CANoe built-in function)
  // Note: getBusLoad() requires CANoe API access
  // For simulation, we'll estimate based on message counts

  // Simplified estimation (would use real bus statistics in production)
  gNetworkLoad_HS1 = 15.0;  // ~15% estimated (EMS, ESP, MDPS, etc.)
  gNetworkLoad_HS2 = 12.0;  // ~12% estimated (IVI, ADAS, Cluster)
  gNetworkLoad_LS = 5.0;    // ~5% estimated (BCM, HVAC)

  // Check for overload conditions
  if (gNetworkLoad_HS1 > 70.0 || gNetworkLoad_HS2 > 70.0 || gNetworkLoad_LS > 50.0) {
    if (gGatewayStatus == 0) {
      gGatewayStatus = 1; // WARNING
      write("⚠️ Network load high - WARNING");
    }
  } else if (gGatewayStatus == 1) {
    gGatewayStatus = 0; // Back to OK
    write("✅ Network load normal");
  }

  setTimer(tNetworkMonitor, 500);
}

/*==================================================================
 * ROUTING: CAN1 (HS #1) → CAN2 (HS #2)
 *
 * Routes safety-critical vehicle data to infotainment/ADAS
 *==================================================================*/

on message CAN1.EMS_EngineStatus
{
  if (gRouting_Enabled && gRouting_CAN1_to_CAN2) {
    // Route to CAN2 for Cluster and IVI display
    output(this) to CAN2;
    gMessagesRouted++;
  }
}

on message CAN1.ESP_Sensors
{
  if (gRouting_Enabled && gRouting_CAN1_to_CAN2) {
    // Route to CAN2 for Camera and SCC (ADAS)
    output(this) to CAN2;
    gMessagesRouted++;
  }
}

on message CAN1.ESP_VehicleDynamics
{
  if (gRouting_Enabled && gRouting_CAN1_to_CAN2) {
    // Route wheel speeds to CAN2 for SCC (cruise control)
    output(this) to CAN2;
    gMessagesRouted++;
  }
}

on message CAN1.MDPS_SteeringStatus
{
  if (gRouting_Enabled && gRouting_CAN1_to_CAN2) {
    // Route steering data to CAN2 for Camera (LKA) and SCC
    output(this) to CAN2;
    gMessagesRouted++;
  }
}

/*==================================================================
 * ROUTING: CAN2 (HS #2) → CAN3 (LS)
 *
 * Routes IVI commands to body control network
 *==================================================================*/

on message CAN2.IVI_AmbientLight
{
  if (gRouting_Enabled && gRouting_CAN2_to_CAN3) {
    // Route to CAN3 for BCM (ambient lighting control)
    output(this) to CAN3;
    gMessagesRouted++;
  }
}

on message CAN2.IVI_Profile
{
  if (gRouting_Enabled && gRouting_CAN2_to_CAN3) {
    // Route to CAN3 for BCM (user profile management)
    output(this) to CAN3;
    gMessagesRouted++;
  }
}

/*==================================================================
 * ROUTING: CAN3 (LS) → CAN2 (HS #2)
 *
 * Routes body control feedback to infotainment
 *==================================================================*/

on message CAN3.BCM_LightControl
{
  if (gRouting_Enabled && gRouting_CAN3_to_CAN2) {
    // Route to CAN2 for IVI and Cluster (lighting feedback)
    output(this) to CAN2;
    gMessagesRouted++;
  }
}

on message CAN3.BCM_DoorStatus
{
  if (gRouting_Enabled && gRouting_CAN3_to_CAN2) {
    // Route to CAN2 for IVI and Cluster (door status display)
    output(this) to CAN2;
    gMessagesRouted++;
  }
}

on message CAN3.BCM_SensorStatus
{
  if (gRouting_Enabled && gRouting_CAN3_to_CAN2) {
    // Route to CAN2 for IVI (sensor data)
    output(this) to CAN2;
    gMessagesRouted++;
  }
}

on message CAN3.BCM_SeatStatus
{
  if (gRouting_Enabled && gRouting_CAN3_to_CAN2) {
    // Route to CAN2 for Cluster (seat belt warnings)
    output(this) to CAN2;
    gMessagesRouted++;
  }
}

/*==================================================================
 * MESSAGE FILTERING (Security & Validation)
 *==================================================================*/

int ValidateMessage(message * msg)
{
  // Add validation logic here (e.g., checksum verification)
  // Return 1 if valid, 0 if should be filtered

  // Example: Filter messages during OTA update
  if (gOTA_Active) {
    // Block non-critical messages during OTA
    // (only allow diagnostic and safety-critical messages)
    return 0;
  }

  return 1; // Pass by default
}

/*==================================================================
 * DIAGNOSTICS & OTA MANAGEMENT
 *==================================================================*/

void StartDiagnosticSession()
{
  gDiagnosticActive = 1;
  write("🔧 UDS Diagnostic session started");
}

void StopDiagnosticSession()
{
  gDiagnosticActive = 0;
  write("🔧 UDS Diagnostic session stopped");
}

void StartOTA()
{
  gOTA_Active = 1;
  gGatewayStatus = 1; // Set to WARNING during OTA
  write("📦 OTA update started - Routing partially restricted");
}

void StopOTA()
{
  gOTA_Active = 0;
  gGatewayStatus = 0; // Back to OK
  write("✅ OTA update completed");
}

/*==================================================================
 * ROUTING CONTROL
 *==================================================================*/

void EnableRouting()
{
  gRouting_Enabled = 1;
  write("✅ Routing enabled");
}

void DisableRouting()
{
  gRouting_Enabled = 0;
  write("⛔ Routing disabled");
}

void ToggleRouting()
{
  gRouting_Enabled = !gRouting_Enabled;
  write("Routing: %s", gRouting_Enabled ? "ENABLED" : "DISABLED");
}

/*==================================================================
 * STATISTICS & MONITORING
 *==================================================================*/

void PrintStatistics()
{
  write("========================================");
  write("Gateway Statistics:");
  write("  Messages routed: %d", gMessagesRouted);
  write("  Messages filtered: %d", gMessagesFiltered);
  write("  Network load:");
  write("    CAN1 (HS #1): %.1f%%", gNetworkLoad_HS1);
  write("    CAN2 (HS #2): %.1f%%", gNetworkLoad_HS2);
  write("    CAN3 (LS):    %.1f%%", gNetworkLoad_LS);
  write("  Status: %s", gGatewayStatus == 0 ? "OK" : (gGatewayStatus == 1 ? "WARNING" : "ERROR"));
  write("  Diagnostics: %s", gDiagnosticActive ? "ACTIVE" : "INACTIVE");
  write("  OTA: %s", gOTA_Active ? "IN PROGRESS" : "IDLE");
  write("========================================");
}

/*==================================================================
 * KEYBOARD SHORTCUTS (for testing)
 *==================================================================*/

on key 'R' { ToggleRouting(); }
on key 'D' {
  if (gDiagnosticActive) StopDiagnosticSession();
  else StartDiagnosticSession();
}
on key 'O' {
  if (gOTA_Active) StopOTA();
  else StartOTA();
}
on key 'S' { PrintStatistics(); }

/*==================================================================
 * ERROR HANDLING
 *==================================================================*/

on errorFrame
{
  write("⚠️ Error frame detected on network");
  gGatewayStatus = 2; // ERROR

  // Could implement error recovery here
}

on busOff
{
  write("❌ Bus-off detected - Network failure!");
  gGatewayStatus = 2; // ERROR
}

/*==================================================================
 * CLEANUP
 *==================================================================*/

on stopMeasurement
{
  write("CGW node stopped");
  PrintStatistics();

  cancelTimer(tGatewayStatus);
  cancelTimer(tNetworkMonitor);
}

/*==================================================================
 * END OF CGW.can
 *==================================================================*/
