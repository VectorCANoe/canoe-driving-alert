/*@@=================================================================
 * CANoe CAPL Node: HVAC (Climate Control)
 *==================================================================@@*/

includes {}

variables
{
  int gCabinTemperature = 22;
  int gTargetTemperature = 22;
  int gHVAC_Mode = 1;  // 0=OFF, 1=AUTO, 2=COOL, etc.
  int gFanSpeed = 3;

  msTimer tHVAC;
}

on start
{
  write("HVAC (Climate Control) Started");
  setTimer(tHVAC, 200);  // 200ms
}

on timer tHVAC
{
  message HVAC_Status msg;

  msg.Cabin_Temperature = gCabinTemperature;
  msg.Target_Temperature = gTargetTemperature;
  msg.HVAC_Mode = gHVAC_Mode;
  msg.Fan_Speed = gFanSpeed;

  output(msg);
  setTimer(tHVAC, 200);
}

on stopMeasurement
{
  cancelTimer(tHVAC);
}
